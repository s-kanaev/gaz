ASAP2_VERSION 1 3
/begin PROJECT _ "  P079.VC4.VA02  B07902C4.DAM:  DAMPAR_03"
/begin HEADER "EDC15C" PROJECT_NO VAR02 VERSION "MAX_KLKF" /end HEADER
/begin MODULE DIM " "
/begin MOD_COMMON " " S_REC_LAYOUT MSA15 DEPOSIT ABSOLUTE BYTE_ORDER MSB_LAST /end MOD_COMMON
/begin RECORD_LAYOUT MSA15_FW3 FNC_VALUES 1 UWORD COLUMN_DIR DIRECT /end RECORD_LAYOUT
/begin RECORD_LAYOUT MSA15_FW1 FNC_VALUES 1 UBYTE COLUMN_DIR DIRECT /end RECORD_LAYOUT
/begin CHARACTERISTIC fbwEKDPF7B "#SSD KDP F7 Leckage(mittlerer Druck): Intakterkennungszeit" VALUE 0xF35B0 MSA15_FW3 0 ZEIT_ST 0.000000 655350000.000000 /end CHARACTERISTIC
/begin CHARACTERISTIC fbwEKDPF8A "#SSD KDP F8 Raildruckueberhoehung: Defekterkennungszeit  ! ***BC266 BEW2WI" VALUE 0xF35B4 MSA15_FW3 0 ZEIT_ST 0.000000 655350000.000000 /end CHARACTERISTIC
/begin CHARACTERISTIC fbwEKDPF8B "#SSD KDP F8 Raildruckueberhoehung: Intakterkennungszeit  ! ***BC266 BEW2WI" VALUE 0xF35B6 MSA15_FW3 0 ZEIT_ST 0.000000 655350000.000000 /end CHARACTERISTIC
/begin CHARACTERISTIC fbwEKDR_KA "#SSD KDR  Kurzschluss  Defekterkennungs-Zeit" VALUE 0xF3138 MSA15_FW3 0 ZEIT_ST 0.000000 655350000.000000 /end CHARACTERISTIC
/begin CHARACTERISTIC fbwEKDR_KB "#SSD KDR  Kurzschluss  Intakterkennungs-Zeit" VALUE 0xF313A MSA15_FW3 0 ZEIT_ST 0.000000 655350000.000000 /end CHARACTERISTIC
/begin CHARACTERISTIC fbwEKDR_KT "#SSD KDR  Kurzschluss  zeit-/ereignisgesteuert, loeschbar" VALUE 0xF313C MSA15_FW3 0 DEZ_DW_U 0.000000 65535.000000 /end CHARACTERISTIC
/begin CHARACTERISTIC fbwEKDR_OA "#SSD KDR  Leerlauf  Defekterkennungs-Zeit" VALUE 0xF313E MSA15_FW3 0 ZEIT_ST 0.000000 655350000.000000 /end CHARACTERISTIC
/begin CHARACTERISTIC fbwEKDR_OB "#SSD KDR  Leerlauf  Intakterkennungs-Zeit" VALUE 0xF3140 MSA15_FW3 0 ZEIT_ST 0.000000 655350000.000000 /end CHARACTERISTIC
/begin CHARACTERISTIC fbwEKDR_OT "#SSD KDR  Leerlauf  zeit-/ereignisgesteuert, loeschbar" VALUE 0xF3142 MSA15_FW3 0 DEZ_DW_U 0.000000 65535.000000 /end CHARACTERISTIC
/begin CHARACTERISTIC fbwEKDR_PA "#SSD KDR NAchlauf Fehler Defekterkennungs-Zeit" VALUE 0xF3144 MSA15_FW3 0 DEZ_DW_U 0.000000 65535.000000 /end CHARACTERISTIC
/begin CHARACTERISTIC fbwEKDR_PB "#SSD KDR NAchlauf Fehler Intakterkennungs-Zeit" VALUE 0xF3146 MSA15_FW3 0 DEZ_DW_U 0.000000 65535.000000 /end CHARACTERISTIC
/begin CHARACTERISTIC fbwEKDR_PT "#SSD KDR nachlauf Fehler zeit-/ereignisgesteuert, loeschbar" VALUE 0xF3148 MSA15_FW3 0 DEZ_DW_U 0.000000 65535.000000 /end CHARACTERISTIC
/begin CHARACTERISTIC fbwEKDS_SA "KDS  zuspaet  Defekterkennungs-Zeit" VALUE 0xF2B14 MSA15_FW3 0 ZEIT_ST 0.000000 655350000.000000 /end CHARACTERISTIC
/begin CHARACTERISTIC fbwEKDS_SB "KDS  zuspaet  Intakterkennungs-Zeit" VALUE 0xF2B16 MSA15_FW3 0 ZEIT_ST 0.000000 655350000.000000 /end CHARACTERISTIC
/begin CHARACTERISTIC fbwEKDS_ST "KDS  zuspaet  zeit-/ereignisgesteuert, loeschbar" VALUE 0xF2B18 MSA15_FW3 0 DEZ_DW_U 0.000000 65535.000000 /end CHARACTERISTIC
/begin CHARACTERISTIC fbwEKHP_KA "KHP  Kurzschluss  Defekterkennungs-Zeit" VALUE 0xF2FCE MSA15_FW3 0 ZEIT_ST 0.000000 655350000.000000 /end CHARACTERISTIC
/begin CHARACTERISTIC fbwEKHP_KB "KHP  Kurzschluss  Intakterkennungs-Zeit" VALUE 0xF2FD0 MSA15_FW3 0 ZEIT_ST 0.000000 655350000.000000 /end CHARACTERISTIC
/begin CHARACTERISTIC fbwEKHP_KT "KHP  Kurzschluss  zeit-/ereignisgesteuert, loeschbar" VALUE 0xF2FD2 MSA15_FW3 0 DEZ_DW_U 0.000000 65535.000000 /end CHARACTERISTIC
/begin CHARACTERISTIC fbwEKHP_OA "KHP  Leerlauf  Defekterkennungs-Zeit" VALUE 0xF2FD4 MSA15_FW3 0 ZEIT_ST 0.000000 655350000.000000 /end CHARACTERISTIC
/begin CHARACTERISTIC fbwEKHP_OB "KHP  Leerlauf  Intakterkennungs-Zeit" VALUE 0xF2FD6 MSA15_FW3 0 ZEIT_ST 0.000000 655350000.000000 /end CHARACTERISTIC
/begin CHARACTERISTIC fbwEKHP_OT "KHP  Leerlauf  zeit-/ereignisgesteuert, loeschbar" VALUE 0xF2FD8 MSA15_FW3 0 DEZ_DW_U 0.000000 65535.000000 /end CHARACTERISTIC
/begin CHARACTERISTIC fbwEKLI_KA "KLI  Kurzschluss  Defekterkennungs-Zeit" VALUE 0xF350A MSA15_FW3 0 ZEIT_ST 0.000000 655350000.000000 /end CHARACTERISTIC
/begin CHARACTERISTIC fbwEKLI_KB "KLI  Kurzschluss  Intakterkennungs-Zeit" VALUE 0xF350C MSA15_FW3 0 ZEIT_ST 0.000000 655350000.000000 /end CHARACTERISTIC
/begin CHARACTERISTIC fbwEKLI_KT "KLI  Kurzschluss  zeit-/ereignisgesteuert, loeschbar" VALUE 0xF350E MSA15_FW3 0 DEZ_DW_U 0.000000 65535.000000 /end CHARACTERISTIC
/begin CHARACTERISTIC fbwEKLI_OA "KLI  Leerlauf  Defekterkennungs-Zeit" VALUE 0xF3510 MSA15_FW3 0 ZEIT_ST 0.000000 655350000.000000 /end CHARACTERISTIC
/begin CHARACTERISTIC fbwEKLI_OB "KLI  Leerlauf  Intakterkennungs-Zeit" VALUE 0xF3512 MSA15_FW3 0 ZEIT_ST 0.000000 655350000.000000 /end CHARACTERISTIC
/begin CHARACTERISTIC fbwEKLI_OT "KLI  Leerlauf  zeit-/ereignisgesteuert, loeschbar" VALUE 0xF3514 MSA15_FW3 0 DEZ_DW_U 0.000000 65535.000000 /end CHARACTERISTIC
/begin CHARACTERISTIC fbwEKTF_HA "KTF SRC oben  Zeit bis endgueltig defekt" VALUE 0xF28F0 MSA15_FW3 0 ZEIT_ST 0.000000 655350000.000000 /end CHARACTERISTIC
/begin CHARACTERISTIC fbwEKTF_HB "KTF SRC oben  Zeit bis endgueltig geheilt" VALUE 0xF28F2 MSA15_FW3 0 ZEIT_ST 0.000000 655350000.000000 /end CHARACTERISTIC
/begin CHARACTERISTIC fbwEKTF_HT "KTF SRC oben  Zeit/Ereignisgesteuert, Loeschbar" VALUE 0xF28F4 MSA15_FW3 0 DEZ_DW_U 0.000000 65535.000000 /end CHARACTERISTIC
/begin CHARACTERISTIC fbwEKTF_LA "KTF SRC unten  Zeit bis endgueltig defekt" VALUE 0xF28EA MSA15_FW3 0 ZEIT_ST 0.000000 655350000.000000 /end CHARACTERISTIC
/begin CHARACTERISTIC fbwEKTF_LB "KTF SRC unten  Zeit bis endgueltig geheilt" VALUE 0xF28EC MSA15_FW3 0 ZEIT_ST 0.000000 655350000.000000 /end CHARACTERISTIC
/begin CHARACTERISTIC fbwEKTF_LT "KTF SRC unten  Zeit/Ereignisgesteuert, Loeschbar" VALUE 0xF28EE MSA15_FW3 0 DEZ_DW_U 0.000000 65535.000000 /end CHARACTERISTIC
/begin CHARACTERISTIC fbwEKUP_PA "KUP  Plaus. Defekterkennungs-Zeit (in 20ms-Ticks angeb.)" VALUE 0xF3392 MSA15_FW3 0 DEZ_DW_U 0.000000 65535.000000 /end CHARACTERISTIC
/begin CHARACTERISTIC fbwEKUP_PB "KUP  Plausibilitaet  Intakterkennungsereignisse" VALUE 0xF3394 MSA15_FW3 0 DEZ_DW_U 0.000000 65535.000000 /end CHARACTERISTIC
/begin CHARACTERISTIC fbwEKUP_PT "KUP  Plausibilitaet  zeit-/ereignisgesteuert, loeschbar" VALUE 0xF3396 MSA15_FW3 0 DEZ_DW_U 0.000000 65535.000000 /end CHARACTERISTIC
/begin CHARACTERISTIC fbwEKWH2OA "KWH  Fehler 1 Defekterkennungs-Zeit" VALUE 0xF3774 MSA15_FW3 0 ZEIT_ST 0.000000 655350000.000000 /end CHARACTERISTIC
/begin CHARACTERISTIC fbwEKWH2OB "KWH  Fehler 1  Intakterkennungs-Zeit" VALUE 0xF3776 MSA15_FW3 0 ZEIT_ST 0.000000 655350000.000000 /end CHARACTERISTIC
/begin CHARACTERISTIC fbwEKWH2OT "KWH Fehler 1  zeit-/ereignisgesteuert, loeschbar" VALUE 0xF3778 MSA15_FW3 0 DEZ_DW_U 0.000000 65535.000000 /end CHARACTERISTIC
/begin CHARACTERISTIC fbwEKWH3OA "KWH  Fehler 2 Defekterkennungs-Zeit" VALUE 0xF377A MSA15_FW3 0 ZEIT_ST 0.000000 655350000.000000 /end CHARACTERISTIC
/begin CHARACTERISTIC fbwEKWH3OB "KWH  Fehler 2  Intakterkennungs-Zeit" VALUE 0xF377C MSA15_FW3 0 ZEIT_ST 0.000000 655350000.000000 /end CHARACTERISTIC
/begin CHARACTERISTIC fbwEKWH3OT "KWH Fehler 2  zeit-/ereignisgesteuert, loeschbar" VALUE 0xF377E MSA15_FW3 0 DEZ_DW_U 0.000000 65535.000000 /end CHARACTERISTIC
/begin CHARACTERISTIC fbwEKWH4OA "KWH  Fehler 3 Defekterkennungs-Zeit" VALUE 0xF3780 MSA15_FW3 0 ZEIT_ST 0.000000 655350000.000000 /end CHARACTERISTIC
/begin CHARACTERISTIC fbwEKWH4OB "KWH  Fehler 3  Intakterkennungs-Zeit" VALUE 0xF3782 MSA15_FW3 0 ZEIT_ST 0.000000 655350000.000000 /end CHARACTERISTIC
/begin CHARACTERISTIC fbwEKWH4OT "KWH Fehler 3  zeit-/ereignisgesteuert, loeschbar" VALUE 0xF3784 MSA15_FW3 0 DEZ_DW_U 0.000000 65535.000000 /end CHARACTERISTIC
/begin CHARACTERISTIC fbwEKWHK1A "KWH Kurzschluss Defekterkennungs-Zeit" VALUE 0xF3086 MSA15_FW3 0 ZEIT_ST 0.000000 655350000.000000 /end CHARACTERISTIC
/begin CHARACTERISTIC fbwEKWHK1B "KWH Kurzschluss Intakterkennungs-Zeit" VALUE 0xF3088 MSA15_FW3 0 ZEIT_ST 0.000000 655350000.000000 /end CHARACTERISTIC
/begin CHARACTERISTIC fbwEKWHK1T "KWH Kurzschluss zeit-/ereignisgesteuert, loeschbar" VALUE 0xF308A MSA15_FW3 0 DEZ_DW_U 0.000000 65535.000000 /end CHARACTERISTIC
/begin CHARACTERISTIC fbwEKWHO1A "KWH Leerlauf Defekterkennungs-Zeit" VALUE 0xF308C MSA15_FW3 0 ZEIT_ST 0.000000 655350000.000000 /end CHARACTERISTIC
/begin CHARACTERISTIC fbwEKWHO1B "KWH Leerlauf Intakterkennungs-Zeit" VALUE 0xF308E MSA15_FW3 0 ZEIT_ST 0.000000 655350000.000000 /end CHARACTERISTIC
/begin CHARACTERISTIC fbwEKWHO1T "KWH Leerlauf zeit-/ereignisgesteuert, loeschbar" VALUE 0xF3090 MSA15_FW3 0 DEZ_DW_U 0.000000 65535.000000 /end CHARACTERISTIC
/begin CHARACTERISTIC fbwEKWH_1o "Zeitfenster Fehler 1 Obergrenze" VALUE 0xFB1F6 MSA15_FW3 0 ZEIT_ST 0.000000 655350000.000000 /end CHARACTERISTIC
/begin CHARACTERISTIC fbwEKWH_1u "Zeitfenster Fehler 1 Untergrenze" VALUE 0xFB1F8 MSA15_FW3 0 ZEIT_ST 0.000000 655350000.000000 /end CHARACTERISTIC
/begin CHARACTERISTIC fbwEKWH_2o "Zeitfenster Fehler 2 Obergrenze" VALUE 0xFB1FA MSA15_FW3 0 ZEIT_ST 0.000000 655350000.000000 /end CHARACTERISTIC
/begin CHARACTERISTIC fbwEKWH_2u "Zeitfenster Fehler 2 Untergrenze" VALUE 0xFB1FC MSA15_FW3 0 ZEIT_ST 0.000000 655350000.000000 /end CHARACTERISTIC
/begin CHARACTERISTIC fbwEKWH_3o "Zeitfenster Fehler 3 Obergrenze" VALUE 0xFB1FE MSA15_FW3 0 ZEIT_ST 0.000000 655350000.000000 /end CHARACTERISTIC
/begin CHARACTERISTIC fbwEKWH_3u "Zeitfenster Fehler 3 Untergrenze" VALUE 0xFB200 MSA15_FW3 0 ZEIT_ST 0.000000 655350000.000000 /end CHARACTERISTIC
/begin CHARACTERISTIC fbwEKWH_DA "KWH Defekterkennungs-Zeit" VALUE 0xF3052 MSA15_FW3 0 ZEIT_ST 0.000000 655350000.000000 /end CHARACTERISTIC
/begin CHARACTERISTIC fbwEKWH_DB "KWH Intakterkennungs-Zeit" VALUE 0xF3054 MSA15_FW3 0 ZEIT_ST 0.000000 655350000.000000 /end CHARACTERISTIC
/begin CHARACTERISTIC fbwEKWH_DT "KWH zeit-/ereignisgesteuert, loeschbar" VALUE 0xF3056 MSA15_FW3 0 DEZ_DW_U 0.000000 65535.000000 /end CHARACTERISTIC
/begin CHARACTERISTIC fbwEKWH_KA "KWH Kurzschluss Defekterkennungs-Zeit" VALUE 0xF307A MSA15_FW3 0 ZEIT_ST 0.000000 655350000.000000 /end CHARACTERISTIC
/begin CHARACTERISTIC fbwEKWH_KB "KWH Kurzschluss Intakterkennungs-Zeit" VALUE 0xF307C MSA15_FW3 0 ZEIT_ST 0.000000 655350000.000000 /end CHARACTERISTIC
/begin CHARACTERISTIC fbwEKWH_KT "KWH Kurzschluss zeit-/ereignisgesteuert, loeschbar" VALUE 0xF307E MSA15_FW3 0 DEZ_DW_U 0.000000 65535.000000 /end CHARACTERISTIC
/begin CHARACTERISTIC fbwEKWH_OA "KWH Leerlauf Defekterkennungs-Zeit" VALUE 0xF3080 MSA15_FW3 0 ZEIT_ST 0.000000 655350000.000000 /end CHARACTERISTIC
/begin CHARACTERISTIC fbwEKWH_OB "KWH Leerlauf Intakterkennungs-Zeit" VALUE 0xF3082 MSA15_FW3 0 ZEIT_ST 0.000000 655350000.000000 /end CHARACTERISTIC
/begin CHARACTERISTIC fbwEKWH_OT "KWH Leerlauf zeit-/ereignisgesteuert, loeschbar" VALUE 0xF3084 MSA15_FW3 0 DEZ_DW_U 0.000000 65535.000000 /end CHARACTERISTIC
/begin CHARACTERISTIC fbwELA11A "I11  Lastabfall  Defekterkennungs-Zeit" VALUE 0xF3178 MSA15_FW3 0 ZEIT_ST 0.000000 655350000.000000 /end CHARACTERISTIC
/begin CHARACTERISTIC fbwELA11B "I11  Lastabfall  Intakterkennungs-Zeit" VALUE 0xF317A MSA15_FW3 0 ZEIT_ST 655350000.000000 655350000.000000 EXTENDED_LIMITS 0.000000 655350000.000000 /end CHARACTERISTIC
/begin CHARACTERISTIC fbwELA11T "I11  Lastabfall  zeit-/ereignisgesteuert, loeschbar" VALUE 0xF317C MSA15_FW3 0 DEZ_DW_U 0.000000 65535.000000 /end CHARACTERISTIC
/begin CHARACTERISTIC fbwELA12A "I12  Lastabfall  Defekterkennungs-Zeit" VALUE 0xF3260 MSA15_FW3 0 ZEIT_ST 0.000000 655350000.000000 /end CHARACTERISTIC
/begin CHARACTERISTIC fbwELA12B "I12  Lastabfall  Intakterkennungs-Zeit" VALUE 0xF3262 MSA15_FW3 0 ZEIT_ST 655350000.000000 655350000.000000 EXTENDED_LIMITS 0.000000 655350000.000000 /end CHARACTERISTIC
/begin CHARACTERISTIC fbwELA12T "I12  Lastabfall  zeit-/ereignisgesteuert, loeschbar" VALUE 0xF3264 MSA15_FW3 0 DEZ_DW_U 0.000000 65535.000000 /end CHARACTERISTIC
/begin CHARACTERISTIC fbwELA21A "I21  Lastabfall  Defekterkennungs-Zeit" VALUE 0xF31B2 MSA15_FW3 0 ZEIT_ST 0.000000 655350000.000000 /end CHARACTERISTIC
/begin CHARACTERISTIC fbwELA21B "I21  Lastabfall  Intakterkennungs-Zeit" VALUE 0xF31B4 MSA15_FW3 0 ZEIT_ST 655350000.000000 655350000.000000 EXTENDED_LIMITS 0.000000 655350000.000000 /end CHARACTERISTIC
/begin CHARACTERISTIC fbwELA21T "I21  Lastabfall  zeit-/ereignisgesteuert, loeschbar" VALUE 0xF31B6 MSA15_FW3 0 DEZ_DW_U 0.000000 65535.000000 /end CHARACTERISTIC
/begin CHARACTERISTIC fbwELA22A "I22  Lastabfall  Defekterkennungs-Zeit" VALUE 0xF329A MSA15_FW3 0 ZEIT_ST 0.000000 655350000.000000 /end CHARACTERISTIC
/begin CHARACTERISTIC fbwELA22B "I22  Lastabfall  Intakterkennungs-Zeit" VALUE 0xF329C MSA15_FW3 0 ZEIT_ST 655350000.000000 655350000.000000 EXTENDED_LIMITS 0.000000 655350000.000000 /end CHARACTERISTIC
/begin CHARACTERISTIC fbwELA22T "I22  Lastabfall  zeit-/ereignisgesteuert, loeschbar" VALUE 0xF329E MSA15_FW3 0 DEZ_DW_U 0.000000 65535.000000 /end CHARACTERISTIC
/begin CHARACTERISTIC fbwELA31A "I31  Lastabfall  Defekterkennungs-Zeit" VALUE 0xF31EC MSA15_FW3 0 ZEIT_ST 0.000000 655350000.000000 /end CHARACTERISTIC
/begin CHARACTERISTIC fbwELA31B "I31  Lastabfall  Intakterkennungs-Zeit" VALUE 0xF31EE MSA15_FW3 0 ZEIT_ST 655350000.000000 655350000.000000 EXTENDED_LIMITS 0.000000 655350000.000000 /end CHARACTERISTIC
/begin CHARACTERISTIC fbwELA31T "I31  Lastabfall  zeit-/ereignisgesteuert, loeschbar" VALUE 0xF31F0 MSA15_FW3 0 DEZ_DW_U 0.000000 65535.000000 /end CHARACTERISTIC
/begin CHARACTERISTIC fbwELA32A "I32  Lastabfall  Defekterkennungs-Zeit" VALUE 0xF32D4 MSA15_FW3 0 ZEIT_ST 0.000000 655350000.000000 /end CHARACTERISTIC
/begin CHARACTERISTIC fbwELA32B "I32  Lastabfall  Intakterkennungs-Zeit" VALUE 0xF32D6 MSA15_FW3 0 ZEIT_ST 655350000.000000 655350000.000000 EXTENDED_LIMITS 0.000000 655350000.000000 /end CHARACTERISTIC
/begin CHARACTERISTIC fbwELA32T "I32  Lastabfall  zeit-/ereignisgesteuert, loeschbar" VALUE 0xF32D8 MSA15_FW3 0 DEZ_DW_U 0.000000 65535.000000 /end CHARACTERISTIC
/begin CHARACTERISTIC fbwELA41A "I41  Lastabfall  Defekterkennungs-Zeit" VALUE 0xF3226 MSA15_FW3 0 ZEIT_ST 0.000000 655350000.000000 /end CHARACTERISTIC
/begin CHARACTERISTIC fbwELA41B "I41  Lastabfall  Intakterkennungs-Zeit" VALUE 0xF3228 MSA15_FW3 0 ZEIT_ST 655350000.000000 655350000.000000 EXTENDED_LIMITS 0.000000 655350000.000000 /end CHARACTERISTIC
/begin CHARACTERISTIC fbwELA41T "I41  Lastabfall  zeit-/ereignisgesteuert, loeschbar" VALUE 0xF322A MSA15_FW3 0 DEZ_DW_U 0.000000 65535.000000 /end CHARACTERISTIC
/begin CHARACTERISTIC fbwELA42A "I42  Lastabfall  Defekterkennungs-Zeit" VALUE 0xF330E MSA15_FW3 0 ZEIT_ST 0.000000 655350000.000000 /end CHARACTERISTIC
/begin CHARACTERISTIC fbwELA42B "I42  Lastabfall  Intakterkennungs-Zeit" VALUE 0xF3310 MSA15_FW3 0 ZEIT_ST 655350000.000000 655350000.000000 EXTENDED_LIMITS 0.000000 655350000.000000 /end CHARACTERISTIC
/begin CHARACTERISTIC fbwELA42T "I42  Lastabfall  zeit-/ereignisgesteuert, loeschbar" VALUE 0xF3312 MSA15_FW3 0 DEZ_DW_U 0.000000 65535.000000 /end CHARACTERISTIC
/begin CHARACTERISTIC fbwELDF_HA "LDF  Signal oberer  SRC  Defekterkennungs-Zeit" VALUE 0xF2A78 MSA15_FW3 0 ZEIT_ST 0.000000 655350000.000000 /end CHARACTERISTIC
/begin CHARACTERISTIC fbwELDF_HB "LDF  Signal oberer  SRC  Intakterkennungs-Zeit" VALUE 0xF2A7A MSA15_FW3 0 ZEIT_ST 0.000000 655350000.000000 /end CHARACTERISTIC
/begin CHARACTERISTIC fbwELDF_HT "LDF  Signal oberer  SRC  zeit-/ereignisgesteuert, loeschbar" VALUE 0xF2A7C MSA15_FW3 0 DEZ_DW_U 0.000000 65535.000000 /end CHARACTERISTIC
/begin CHARACTERISTIC fbwELDF_LA "LDF  Signal unterer SRC  Defekterkennungs-Zeit" VALUE 0xF2A72 MSA15_FW3 0 ZEIT_ST 0.000000 655350000.000000 /end CHARACTERISTIC
/begin CHARACTERISTIC fbwELDF_LB "LDF  Signal unterer SRC  Intakterkennungs-Zeit" VALUE 0xF2A74 MSA15_FW3 0 ZEIT_ST 0.000000 655350000.000000 /end CHARACTERISTIC
/begin CHARACTERISTIC fbwELDF_LT "LDF  Signal unterer SRC  zeit-/ereignisgesteuert, loeschbar" VALUE 0xF2A76 MSA15_FW3 0 DEZ_DW_U 0.000000 65535.000000 /end CHARACTERISTIC
/begin CHARACTERISTIC fbwELDF_PA "LDF  Plausibilitaet mit ADF  Defekterkennungs-Zeit" VALUE 0xF2A84 MSA15_FW3 0 ZEIT_ST 0.000000 655350000.000000 /end CHARACTERISTIC
/begin CHARACTERISTIC fbwELDF_PB "LDF  Plausibilitaet mit ADF  Intakterkennungs-Zeit" VALUE 0xF2A86 MSA15_FW3 0 ZEIT_ST 0.000000 655350000.000000 /end CHARACTERISTIC
/begin CHARACTERISTIC fbwELDF_PT "LDF  Plausibilitaet mit ADF  zeit-/ereignisgesteuert, loeschbar" VALUE 0xF2A88 MSA15_FW3 0 DEZ_DW_U 0.000000 65535.000000 /end CHARACTERISTIC
/begin CHARACTERISTIC fbwELDF_VA "LDF  Speisespannungsfehler  Defekterkennungs-Zeit" VALUE 0xF2A7E MSA15_FW3 0 ZEIT_ST 0.000000 655350000.000000 /end CHARACTERISTIC
/begin CHARACTERISTIC fbwELDF_VB "LDF  Speisespannungsfehler  Intakterkennungs-Zeit" VALUE 0xF2A80 MSA15_FW3 0 ZEIT_ST 0.000000 655350000.000000 /end CHARACTERISTIC
/begin CHARACTERISTIC fbwELDF_VT "LDF  Speisespannungsfehler  zeit-/ereignisgesteuert, loeschbar" VALUE 0xF2A82 MSA15_FW3 0 DEZ_DW_U 0.000000 65535.000000 /end CHARACTERISTIC
/begin CHARACTERISTIC fbwELDS_AA "LDS  abgefallener Ladeluftschlauch  Defekterkennungs-Zeit" VALUE 0xF3786 MSA15_FW3 0 ZEIT_ST 0.000000 655350000.000000 /end CHARACTERISTIC
/begin CHARACTERISTIC fbwELDS_AB "LDS  abgefallener Ladeluftschlauch   Intakterkennungs-Zeit" VALUE 0xF3788 MSA15_FW3 0 ZEIT_ST 0.000000 655350000.000000 /end CHARACTERISTIC
/begin CHARACTERISTIC fbwELDS_AT "LDS  abgefallener Ladeluftschlauch  zeit-/ereignisgesteuert, loeschbar" VALUE 0xF378A MSA15_FW3 0 DEZ_DW_U 0.000000 65535.000000 /end CHARACTERISTIC
/begin CHARACTERISTIC fbwELDS_KA "LDS  Kurzschluss  Defekterkennungs-Zeit" VALUE 0xF2DC2 MSA15_FW3 0 ZEIT_ST 0.000000 655350000.000000 /end CHARACTERISTIC
/begin CHARACTERISTIC fbwELDS_KB "LDS  Kurzschluss  Intakterkennungs-Zeit" VALUE 0xF2DC4 MSA15_FW3 0 ZEIT_ST 0.000000 655350000.000000 /end CHARACTERISTIC
/begin CHARACTERISTIC fbwELDS_KT "LDS  Kurzschluss  zeit-/ereignisgesteuert, loeschbar" VALUE 0xF2DC6 MSA15_FW3 0 DEZ_DW_U 0.000000 65535.000000 /end CHARACTERISTIC
/begin CHARACTERISTIC fbwELDS_OA "LDS  Leerlauf Defekterkennungs-Zeit" VALUE 0xF2DC8 MSA15_FW3 0 ZEIT_ST 0.000000 655350000.000000 /end CHARACTERISTIC
/begin CHARACTERISTIC fbwELDS_OB "LDS  Leerlauf Intakterkennungs-Zeit" VALUE 0xF2DCA MSA15_FW3 0 ZEIT_ST 0.000000 655350000.000000 /end CHARACTERISTIC
/begin CHARACTERISTIC fbwELDS_OT "LDS  Leerlauf zeit-/ereignisgesteuert, loeschbar" VALUE 0xF2DCC MSA15_FW3 0 DEZ_DW_U 0.000000 65535.000000 /end CHARACTERISTIC
/begin CHARACTERISTIC fbwELDSnRA "LDS  neg. RA  Defekterkennungs-Zeit" VALUE 0xF2DD4 MSA15_FW3 0 ZEIT_ST 0.000000 655350000.000000 /end CHARACTERISTIC
/begin CHARACTERISTIC fbwELDSnRB "LDS  neg. RA  Intakterkennungs-Zeit" VALUE 0xF2DD6 MSA15_FW3 0 ZEIT_ST 0.000000 655350000.000000 /end CHARACTERISTIC
/begin CHARACTERISTIC fbwELDSnRT "LDS  neg. RA  zeit-/ereignisgesteuert, loeschbar" VALUE 0xF2DD8 MSA15_FW3 0 DEZ_DW_U 0.000000 65535.000000 /end CHARACTERISTIC
/begin CHARACTERISTIC fbwELDSpRA "LDS  pos. RA  Defekterkennungs-Zeit" VALUE 0xF2DCE MSA15_FW3 0 ZEIT_ST 0.000000 655350000.000000 /end CHARACTERISTIC
/begin CHARACTERISTIC fbwELDSpRB "LDS  pos. RA  Intakterkennungs-Zeit" VALUE 0xF2DD0 MSA15_FW3 0 ZEIT_ST 0.000000 655350000.000000 /end CHARACTERISTIC
/begin CHARACTERISTIC fbwELDSpRT "LDS  pos. RA  zeit-/ereignisgesteuert, loeschbar" VALUE 0xF2DD2 MSA15_FW3 0 DEZ_DW_U 0.000000 65535.000000 /end CHARACTERISTIC
/begin CHARACTERISTIC fbwELM5_HA "HFM5 Signal oberer  SRC  Defekterkennungs-Zeit" VALUE 0xF2B70 MSA15_FW3 0 ZEIT_ST 0.000000 655350000.000000 /end CHARACTERISTIC
/begin CHARACTERISTIC fbwELM5_HB "HFM5 Signal oberer  SRC  Intakterkennungs-Zeit" VALUE 0xF2B72 MSA15_FW3 0 ZEIT_ST 0.000000 655350000.000000 /end CHARACTERISTIC
/begin CHARACTERISTIC fbwELM5_HT "HFM5 Signal oberer  SRC  zeit-/ereignisgesteuert, loeschbar" VALUE 0xF2B74 MSA15_FW3 0 DEZ_DW_U 0.000000 65535.000000 /end CHARACTERISTIC
/begin CHARACTERISTIC fbwELM5_LA "HFM5 Signal unterer SRC  Defekterkennungs-Zeit" VALUE 0xF2B6A MSA15_FW3 0 ZEIT_ST 0.000000 655350000.000000 /end CHARACTERISTIC
/begin CHARACTERISTIC fbwELM5_LB "HFM5 Signal unterer SRC  Intakterkennungs-Zeit" VALUE 0xF2B6C MSA15_FW3 0 ZEIT_ST 0.000000 655350000.000000 /end CHARACTERISTIC
/begin CHARACTERISTIC fbwELM5_LT "HFM5 Signal unterer SRC  zeit-/ereignisgesteuert, loeschbar" VALUE 0xF2B6E MSA15_FW3 0 DEZ_DW_U 0.000000 65535.000000 /end CHARACTERISTIC
/begin CHARACTERISTIC fbwELMM_AA "LMM  Leerlaufabgleich  Defekterkennungs-Zeit" VALUE 0xF2B8E MSA15_FW3 0 ZEIT_ST 0.000000 655350000.000000 /end CHARACTERISTIC
/begin CHARACTERISTIC fbwELMM_AB "LMM  Leerlaufabgleich  Intakterkennungs-Zeit" VALUE 0xF2B90 MSA15_FW3 0 ZEIT_ST 0.000000 655350000.000000 /end CHARACTERISTIC
/begin CHARACTERISTIC fbwELMM_AT "LMM  Leerlaufabgleich  zeit-/ereignisgesteuert, loeschbar" VALUE 0xF2B92 MSA15_FW3 0 DEZ_DW_U 0.000000 65535.000000 /end CHARACTERISTIC
/begin CHARACTERISTIC fbwELMM_BA "LMM  Plausibilitaet M_L pos. Bereich  Defekterkennungs-Zeit" VALUE 0xF2B82 MSA15_FW3 0 ZEIT_ST 0.000000 655350000.000000 /end CHARACTERISTIC
/begin CHARACTERISTIC fbwELMM_BB "LMM  Plausibilitaet M_L pos. Bereich  Intakterkennungs-Zeit" VALUE 0xF2B84 MSA15_FW3 0 ZEIT_ST 0.000000 655350000.000000 /end CHARACTERISTIC
/begin CHARACTERISTIC fbwELMM_BT "LMM  Plausibilitaet M_L pos. Bereich  zeit-/ereignisgesteuert, loeschbar" VALUE 0xF2B86 MSA15_FW3 0 DEZ_DW_U 0.000000 65535.000000 /end CHARACTERISTIC
/begin CHARACTERISTIC fbwELMM_LA "LMM  Lastabgleich  Defekterkennungs-Zeit" VALUE 0xF2B94 MSA15_FW3 0 ZEIT_ST 0.000000 655350000.000000 /end CHARACTERISTIC
/begin CHARACTERISTIC fbwELMM_LB "LMM  Lastabgleich  Intakterkennungs-Zeit" VALUE 0xF2B96 MSA15_FW3 0 ZEIT_ST 0.000000 655350000.000000 /end CHARACTERISTIC
/begin CHARACTERISTIC fbwELMM_LT "LMM  Lastabgleich  zeit-/ereignisgesteuert, loeschbar" VALUE 0xF2B98 MSA15_FW3 0 DEZ_DW_U 0.000000 65535.000000 /end CHARACTERISTIC
/begin CHARACTERISTIC fbwELMM_NA "LMM  Nullpunktabgleich  Defekterkennungs-Zeit" VALUE 0xF2B88 MSA15_FW3 0 ZEIT_ST 0.000000 655350000.000000 /end CHARACTERISTIC
/begin CHARACTERISTIC fbwELMM_NB "LMM  Nullpunktabgleich  Intakterkennungs-Zeit" VALUE 0xF2B8A MSA15_FW3 0 ZEIT_ST 0.000000 655350000.000000 /end CHARACTERISTIC
/begin CHARACTERISTIC fbwELMM_NT "LMM  Nullpunktabgleich  zeit-/ereignisgesteuert, loeschbar" VALUE 0xF2B8C MSA15_FW3 0 DEZ_DW_U 0.000000 65535.000000 /end CHARACTERISTIC
/begin CHARACTERISTIC fbwELMM_PA "LMM  Plausibilitaet M_L  Defekterkennungs-Zeit" VALUE 0xF2B7C MSA15_FW3 0 ZEIT_ST 0.000000 655350000.000000 /end CHARACTERISTIC
/begin CHARACTERISTIC fbwELMM_PB "LMM  Plausibilitaet M_L  Intakterkennungs-Zeit" VALUE 0xF2B7E MSA15_FW3 0 ZEIT_ST 0.000000 655350000.000000 /end CHARACTERISTIC
/begin CHARACTERISTIC fbwELMM_PT "LMM  Plausibilitaet M_L  zeit-/ereignisgesteuert, loeschbar" VALUE 0xF2B80 MSA15_FW3 0 DEZ_DW_U 0.000000 65535.000000 /end CHARACTERISTIC
/begin CHARACTERISTIC fbwELMM_VA "LMM  Speisespannungsfehler  Defekterkennungs-Zeit" VALUE 0xF2B76 MSA15_FW3 0 ZEIT_ST 0.000000 655350000.000000 /end CHARACTERISTIC
/begin CHARACTERISTIC fbwELMM_VB "LMM  Speisespannungsfehler  Intakterkennungs-Zeit" VALUE 0xF2B78 MSA15_FW3 0 ZEIT_ST 0.000000 655350000.000000 /end CHARACTERISTIC
/begin CHARACTERISTIC fbwELMM_VT "LMM  Speisespannungsfehler  zeit-/ereignisgesteuert, loeschbar" VALUE 0xF2B7A MSA15_FW3 0 DEZ_DW_U 0.000000 65535.000000 /end CHARACTERISTIC
/begin CHARACTERISTIC fbwELRR_IA "LRR Integratorschwelle Defekterkennungs-Zeit" VALUE 0xF30B4 MSA15_FW3 0 DEZ_DW_U 0.000000 65535.000000 /end CHARACTERISTIC
/begin CHARACTERISTIC fbwELRR_IB "LRR Integratorschwelle Intakterkennungs-Zeit" VALUE 0xF30B6 MSA15_FW3 0 DEZ_DW_U 0.000000 65535.000000 /end CHARACTERISTIC
/begin CHARACTERISTIC fbwELRR_IT "LRR Integratorschwelle zeit-/ereignisgesteuert, Loeschbar" VALUE 0xF30B8 MSA15_FW3 0 DEZ_DW_U 0.000000 65535.000000 /end CHARACTERISTIC
/begin CHARACTERISTIC fbwELS11A "I11  Ueberstrom LS  Defekterkennungs-Zeit" VALUE 0xF316C MSA15_FW3 0 ZEIT_ST 0.000000 655350000.000000 /end CHARACTERISTIC
/begin CHARACTERISTIC fbwELS11B "I11  Ueberstrom LS  Intakterkennungs-Zeit" VALUE 0xF316E MSA15_FW3 0 ZEIT_ST 655350000.000000 655350000.000000 EXTENDED_LIMITS 0.000000 655350000.000000 /end CHARACTERISTIC
/begin CHARACTERISTIC fbwELS11T "I11  Ueberstrom LS  zeit-/ereignisgesteuert, loeschbar" VALUE 0xF3170 MSA15_FW3 0 DEZ_DW_U 0.000000 65535.000000 /end CHARACTERISTIC
/begin CHARACTERISTIC fbwELS12A "I12  Ueberstrom LS  Defekterkennungs-Zeit" VALUE 0xF3254 MSA15_FW3 0 ZEIT_ST 0.000000 655350000.000000 /end CHARACTERISTIC
/begin CHARACTERISTIC fbwELS12B "I12  Ueberstrom LS  Intakterkennungs-Zeit" VALUE 0xF3256 MSA15_FW3 0 ZEIT_ST 655350000.000000 655350000.000000 EXTENDED_LIMITS 0.000000 655350000.000000 /end CHARACTERISTIC
/begin CHARACTERISTIC fbwELS12T "I12  Ueberstrom LS  zeit-/ereignisgesteuert, loeschbar" VALUE 0xF3258 MSA15_FW3 0 DEZ_DW_U 0.000000 65535.000000 /end CHARACTERISTIC
/begin CHARACTERISTIC fbwELS21A "I21  Ueberstrom LS  Defekterkennungs-Zeit" VALUE 0xF31A6 MSA15_FW3 0 ZEIT_ST 0.000000 655350000.000000 /end CHARACTERISTIC
/begin CHARACTERISTIC fbwELS21B "I21  Ueberstrom LS  Intakterkennungs-Zeit" VALUE 0xF31A8 MSA15_FW3 0 ZEIT_ST 655350000.000000 655350000.000000 EXTENDED_LIMITS 0.000000 655350000.000000 /end CHARACTERISTIC
/begin CHARACTERISTIC fbwELS21T "I21  Ueberstrom LS  zeit-/ereignisgesteuert, loeschbar" VALUE 0xF31AA MSA15_FW3 0 DEZ_DW_U 0.000000 65535.000000 /end CHARACTERISTIC
/begin CHARACTERISTIC fbwELS22A "I22  Ueberstrom LS  Defekterkennungs-Zeit" VALUE 0xF328E MSA15_FW3 0 ZEIT_ST 0.000000 655350000.000000 /end CHARACTERISTIC
/begin CHARACTERISTIC fbwELS22B "I22  Ueberstrom LS  Intakterkennungs-Zeit" VALUE 0xF3290 MSA15_FW3 0 ZEIT_ST 655350000.000000 655350000.000000 EXTENDED_LIMITS 0.000000 655350000.000000 /end CHARACTERISTIC
/begin CHARACTERISTIC fbwELS22T "I22  Ueberstrom LS  zeit-/ereignisgesteuert, loeschbar" VALUE 0xF3292 MSA15_FW3 0 DEZ_DW_U 0.000000 65535.000000 /end CHARACTERISTIC
/begin CHARACTERISTIC fbwELS31A "I31  Ueberstrom LS  Defekterkennungs-Zeit" VALUE 0xF31E0 MSA15_FW3 0 ZEIT_ST 0.000000 655350000.000000 /end CHARACTERISTIC
/begin CHARACTERISTIC fbwELS31B "I31  Ueberstrom LS  Intakterkennungs-Zeit" VALUE 0xF31E2 MSA15_FW3 0 ZEIT_ST 655350000.000000 655350000.000000 EXTENDED_LIMITS 0.000000 655350000.000000 /end CHARACTERISTIC
/begin CHARACTERISTIC fbwELS31T "I31  Ueberstrom LS  zeit-/ereignisgesteuert, loeschbar" VALUE 0xF31E4 MSA15_FW3 0 DEZ_DW_U 0.000000 65535.000000 /end CHARACTERISTIC
/begin CHARACTERISTIC fbwELS32A "I32  Ueberstrom LS  Defekterkennungs-Zeit" VALUE 0xF32C8 MSA15_FW3 0 ZEIT_ST 0.000000 655350000.000000 /end CHARACTERISTIC
/begin CHARACTERISTIC fbwELS32B "I32  Ueberstrom LS  Intakterkennungs-Zeit" VALUE 0xF32CA MSA15_FW3 0 ZEIT_ST 655350000.000000 655350000.000000 EXTENDED_LIMITS 0.000000 655350000.000000 /end CHARACTERISTIC
/begin CHARACTERISTIC fbwELS32T "I32  Ueberstrom LS  zeit-/ereignisgesteuert, loeschbar" VALUE 0xF32CC MSA15_FW3 0 DEZ_DW_U 0.000000 65535.000000 /end CHARACTERISTIC
/begin CHARACTERISTIC fbwELS41A "I41  Ueberstrom LS  Defekterkennungs-Zeit" VALUE 0xF321A MSA15_FW3 0 ZEIT_ST 0.000000 655350000.000000 /end CHARACTERISTIC
/begin CHARACTERISTIC fbwELS41B "I41  Ueberstrom LS  Intakterkennungs-Zeit" VALUE 0xF321C MSA15_FW3 0 ZEIT_ST 655350000.000000 655350000.000000 EXTENDED_LIMITS 0.000000 655350000.000000 /end CHARACTERISTIC
/begin CHARACTERISTIC fbwELS41T "I41  Ueberstrom LS  zeit-/ereignisgesteuert, loeschbar" VALUE 0xF321E MSA15_FW3 0 DEZ_DW_U 0.000000 65535.000000 /end CHARACTERISTIC
/begin CHARACTERISTIC fbwELS42A "I42  Ueberstrom LS  Defekterkennungs-Zeit" VALUE 0xF3302 MSA15_FW3 0 ZEIT_ST 0.000000 655350000.000000 /end CHARACTERISTIC
/begin CHARACTERISTIC fbwELS42B "I42  Ueberstrom LS  Intakterkennungs-Zeit" VALUE 0xF3304 MSA15_FW3 0 ZEIT_ST 655350000.000000 655350000.000000 EXTENDED_LIMITS 0.000000 655350000.000000 /end CHARACTERISTIC
/begin CHARACTERISTIC fbwELS42T "I42  Ueberstrom LS  zeit-/ereignisgesteuert, loeschbar" VALUE 0xF3306 MSA15_FW3 0 DEZ_DW_U 0.000000 65535.000000 /end CHARACTERISTIC
/begin CHARACTERISTIC fbwELTF_HA "LTF  oberer  SRC  Defekterkennungs-Zeit" VALUE 0xF29EE MSA15_FW3 0 ZEIT_ST 0.000000 655350000.000000 /end CHARACTERISTIC
/begin CHARACTERISTIC fbwELTF_HB "LTF  oberer  SRC  Intakterkennungs-Zeit" VALUE 0xF29F0 MSA15_FW3 0 ZEIT_ST 0.000000 655350000.000000 /end CHARACTERISTIC
/begin CHARACTERISTIC fbwELTF_HT "LTF  oberer  SRC  zeit-/ereignisgesteuert, loeschbar" VALUE 0xF29F2 MSA15_FW3 0 DEZ_DW_U 0.000000 65535.000000 /end CHARACTERISTIC
/begin CHARACTERISTIC fbwELTF_LA "LTF  unterer SRC  Defekterkennungs-Zeit" VALUE 0xF29E8 MSA15_FW3 0 ZEIT_ST 0.000000 655350000.000000 /end CHARACTERISTIC
/begin CHARACTERISTIC fbwELTF_LB "LTF  unterer SRC  Intakterkennungs-Zeit" VALUE 0xF29EA MSA15_FW3 0 ZEIT_ST 0.000000 655350000.000000 /end CHARACTERISTIC
/begin CHARACTERISTIC fbwELTF_LT "LTF  unterer SRC  zeit-/ereignisgesteuert, loeschbar" VALUE 0xF29EC MSA15_FW3 0 DEZ_DW_U 0.000000 65535.000000 /end CHARACTERISTIC
/begin CHARACTERISTIC fbwEMLS1OA "MLS  Fehler 1 Defekterkennungs-Zeit" VALUE 0xF373A MSA15_FW3 0 ZEIT_ST 0.000000 655350000.000000 /end CHARACTERISTIC
/begin CHARACTERISTIC fbwEMLS1OB "MLS  Fehler 1  Intakterkennungs-Zeit" VALUE 0xF373C MSA15_FW3 0 ZEIT_ST 0.000000 655350000.000000 /end CHARACTERISTIC
/begin CHARACTERISTIC fbwEMLS1OT "MLS Fehler 1  zeit-/ereignisgesteuert, loeschbar" VALUE 0xF373E MSA15_FW3 0 DEZ_DW_U 0.000000 65535.000000 /end CHARACTERISTIC
/begin CHARACTERISTIC fbwEMLS2OA "MLS  Fehler 2 Defekterkennungs-Zeit" VALUE 0xF3740 MSA15_FW3 0 ZEIT_ST 0.000000 655350000.000000 /end CHARACTERISTIC
/begin CHARACTERISTIC fbwEMLS2OB "MLS  Fehler 2  Intakterkennungs-Zeit" VALUE 0xF3742 MSA15_FW3 0 ZEIT_ST 0.000000 655350000.000000 /end CHARACTERISTIC
/begin CHARACTERISTIC fbwEMLS2OT "MLS Fehler 2  zeit-/ereignisgesteuert, loeschbar" VALUE 0xF3744 MSA15_FW3 0 DEZ_DW_U 0.000000 65535.000000 /end CHARACTERISTIC
/begin CHARACTERISTIC fbwEMLS3OA "MLS  Fehler 3 Defekterkennungs-Zeit" VALUE 0xF3746 MSA15_FW3 0 ZEIT_ST 0.000000 655350000.000000 /end CHARACTERISTIC
/begin CHARACTERISTIC fbwEMLS3OB "MLS  Fehler 3  Intakterkennungs-Zeit" VALUE 0xF3748 MSA15_FW3 0 ZEIT_ST 0.000000 655350000.000000 /end CHARACTERISTIC
/begin CHARACTERISTIC fbwEMLS3OT "MLS Fehler 3  zeit-/ereignisgesteuert, loeschbar" VALUE 0xF374A MSA15_FW3 0 DEZ_DW_U 0.000000 65535.000000 /end CHARACTERISTIC
/begin CHARACTERISTIC fbwEMLS_1o "Zeitfenster Fehler 1 Obergrenze" VALUE 0xF9888 MSA15_FW3 0 ZEIT_ST 0.000000 655350000.000000 /end CHARACTERISTIC
/begin CHARACTERISTIC fbwEMLS_1u "Zeitfenster Fehler 1 Untergrenze" VALUE 0xF988A MSA15_FW3 0 ZEIT_ST 0.000000 655350000.000000 /end CHARACTERISTIC
/begin CHARACTERISTIC fbwEMLS_2o "Zeitfenster Fehler 2 Obergrenze" VALUE 0xF988C MSA15_FW3 0 ZEIT_ST 0.000000 655350000.000000 /end CHARACTERISTIC
/begin CHARACTERISTIC fbwEMLS_2u "Zeitfenster Fehler 2 Untergrenze" VALUE 0xF988E MSA15_FW3 0 ZEIT_ST 0.000000 655350000.000000 /end CHARACTERISTIC
/begin CHARACTERISTIC fbwEMLS_3o "Zeitfenster Fehler 3 Obergrenze" VALUE 0xF9890 MSA15_FW3 0 ZEIT_ST 0.000000 655350000.000000 /end CHARACTERISTIC
/begin CHARACTERISTIC fbwEMLS_3u "Zeitfenster Fehler 3 Untergrenze" VALUE 0xF9892 MSA15_FW3 0 ZEIT_ST 0.000000 655350000.000000 /end CHARACTERISTIC
/begin CHARACTERISTIC fbwEMLS_KA "MLS  Kurzschluss  Defekterkennungs-Zeit" VALUE 0xF2F16 MSA15_FW3 0 ZEIT_ST 0.000000 655350000.000000 /end CHARACTERISTIC
/begin CHARACTERISTIC fbwEMLS_KB "MLS  Kurzschluss  Intakterkennungs-Zeit" VALUE 0xF2F18 MSA15_FW3 0 ZEIT_ST 0.000000 655350000.000000 /end CHARACTERISTIC
/begin CHARACTERISTIC fbwEMLS_KT "MLS  Kurzschluss  zeit-/ereignisgesteuert, loeschbar" VALUE 0xF2F1A MSA15_FW3 0 DEZ_DW_U 0.000000 65535.000000 /end CHARACTERISTIC
/begin CHARACTERISTIC fbwEMLS_OA "MLS  Leerlauf  Defekterkennungs-Zeit" VALUE 0xF2F1C MSA15_FW3 0 ZEIT_ST 0.000000 655350000.000000 /end CHARACTERISTIC
/begin CHARACTERISTIC fbwEMLS_OB "MLS  Leerlauf  Intakterkennungs-Zeit" VALUE 0xF2F1E MSA15_FW3 0 ZEIT_ST 0.000000 655350000.000000 /end CHARACTERISTIC
/begin CHARACTERISTIC fbwEMLS_OT "MLS  Leerlauf  zeit-/ereignisgesteuert, loeschbar" VALUE 0xF2F20 MSA15_FW3 0 DEZ_DW_U 0.000000 65535.000000 /end CHARACTERISTIC
/begin CHARACTERISTIC fbwEMML_KA "MML  Kurzschluss  Defekterkennungs-Zeit" VALUE 0xF2DFC MSA15_FW3 0 ZEIT_ST 0.000000 655350000.000000 /end CHARACTERISTIC
/begin CHARACTERISTIC fbwEMML_KB "MML  Kurzschluss  Intakterkennungs-Zeit" VALUE 0xF2DFE MSA15_FW3 0 ZEIT_ST 0.000000 655350000.000000 /end CHARACTERISTIC
/begin CHARACTERISTIC fbwEMML_KT "MML  Kurzschluss  zeit-/ereignisgesteuert, loeschbar" VALUE 0xF2E00 MSA15_FW3 0 DEZ_DW_U 0.000000 65535.000000 /end CHARACTERISTIC
/begin CHARACTERISTIC fbwEMML_OA "MML  Leerlauf  Defekterkennungs-Zeit" VALUE 0xF2E02 MSA15_FW3 0 ZEIT_ST 0.000000 655350000.000000 /end CHARACTERISTIC
/begin CHARACTERISTIC fbwEMML_OB "MML  Leerlauf  Intakterkennungs-Zeit" VALUE 0xF2E04 MSA15_FW3 0 ZEIT_ST 0.000000 655350000.000000 /end CHARACTERISTIC
/begin CHARACTERISTIC fbwEMML_OT "MML  Leerlauf  zeit-/ereignisgesteuert, loeschbar" VALUE 0xF2E06 MSA15_FW3 0 DEZ_DW_U 0.000000 65535.000000 /end CHARACTERISTIC
/begin CHARACTERISTIC fbwENLT_NA "#SSD NLT_N  Nullmengenabschaltung Defekterkennungs-Zeit" VALUE 0xF3342 MSA15_FW3 0 DEZ_DW_U 0.000000 65535.000000 /end CHARACTERISTIC
/begin CHARACTERISTIC fbwENLT_NB "#SSD NLT_N  Nullmengenabschaltung Intakterkennungs-Zeit" VALUE 0xF3344 MSA15_FW3 0 DEZ_DW_U 0.000000 65535.000000 /end CHARACTERISTIC
/begin CHARACTERISTIC fbwENLT_NT "#SSD NLT_N  Nullmengenabschaltung zeit-/ereignisgesteuert, loeschbar" VALUE 0xF3346 MSA15_FW3 0 DEZ_DW_U 0.000000 65535.000000 /end CHARACTERISTIC
/begin CHARACTERISTIC fbwENLT_OA "#SSD NLT_O Injektorabschaltung Defekterkennungs-Zeit" VALUE 0xF333C MSA15_FW3 0 DEZ_DW_U 0.000000 65535.000000 /end CHARACTERISTIC
/begin CHARACTERISTIC fbwENLT_OB "#SSD NLT_O Injektorabschaltung Intakterkennungs-Zeit" VALUE 0xF333E MSA15_FW3 0 DEZ_DW_U 0.000000 65535.000000 /end CHARACTERISTIC
/begin CHARACTERISTIC fbwENLT_OT "#SSD NLT_O  Injektorabschaltung zeit-/ereignisgesteuert, loeschbar" VALUE 0xF3340 MSA15_FW3 0 DEZ_DW_U 0.000000 65535.000000 /end CHARACTERISTIC
/begin CHARACTERISTIC fbwENOX_KA "NOX  Kurzschluss  Defekterkennungs-Zeit" VALUE 0xF2F72 MSA15_FW3 0 ZEIT_ST 0.000000 655350000.000000 /end CHARACTERISTIC
/begin CHARACTERISTIC fbwENOX_KB "NOX  Kurzschluss  Intakterkennungs-Zeit" VALUE 0xF2F74 MSA15_FW3 0 ZEIT_ST 0.000000 655350000.000000 /end CHARACTERISTIC
/begin CHARACTERISTIC fbwENOX_KT "NOX  Kurzschluss  zeit-/ereignisgesteuert, loeschbar" VALUE 0xF2F76 MSA15_FW3 0 DEZ_DW_U 0.000000 65535.000000 /end CHARACTERISTIC
/begin CHARACTERISTIC fbwENOX_OA "NOX  Leerlauf  Defekterkennungs-Zeit" VALUE 0xF2F78 MSA15_FW3 0 ZEIT_ST 0.000000 655350000.000000 /end CHARACTERISTIC
/begin CHARACTERISTIC fbwENOX_OB "NOX  Leerlauf  Intakterkennungs-Zeit" VALUE 0xF2F7A MSA15_FW3 0 ZEIT_ST 0.000000 655350000.000000 /end CHARACTERISTIC
/begin CHARACTERISTIC fbwENOX_OT "NOX  Leerlauf  zeit-/ereignisgesteuert, loeschbar" VALUE 0xF2F7C MSA15_FW3 0 DEZ_DW_U 0.000000 65535.000000 /end CHARACTERISTIC
/begin CHARACTERISTIC fbwEODS_KA "ODS  Kurzschluss  Defekterkennungs-Zeit" VALUE 0xF2FFC MSA15_FW3 0 ZEIT_ST 0.000000 655350000.000000 /end CHARACTERISTIC
/begin CHARACTERISTIC fbwEODS_KB "ODS  Kurzschluss  Intakterkennungs-Zeit" VALUE 0xF2FFE MSA15_FW3 0 ZEIT_ST 0.000000 655350000.000000 /end CHARACTERISTIC
/begin CHARACTERISTIC fbwEODS_KT "ODS  Kurzschluss  zeit-/ereignisgesteuert, loeschbar" VALUE 0xF3000 MSA15_FW3 0 DEZ_DW_U 0.000000 65535.000000 /end CHARACTERISTIC
/begin CHARACTERISTIC fbwEODS_OA "ODS  Leerlauf  Defekterkennungs-Zeit" VALUE 0xF3002 MSA15_FW3 0 ZEIT_ST 0.000000 655350000.000000 /end CHARACTERISTIC
/begin CHARACTERISTIC fbwEODS_OB "ODS  Leerlauf  Intakterkennungs-Zeit" VALUE 0xF3004 MSA15_FW3 0 ZEIT_ST 0.000000 655350000.000000 /end CHARACTERISTIC
/begin CHARACTERISTIC fbwEODS_OT "ODS  Leerlauf  zeit-/ereignisgesteuert, loeschbar" VALUE 0xF3006 MSA15_FW3 0 DEZ_DW_U 0.000000 65535.000000 /end CHARACTERISTIC
/begin CHARACTERISTIC fbwEOTF_HA "OTF SRC oben  Zeit bis endgueltig defekt" VALUE 0xF29C0 MSA15_FW3 0 ZEIT_ST 0.000000 655350000.000000 /end CHARACTERISTIC
/begin CHARACTERISTIC fbwEOTF_HB "OTF SRC oben  Zeit bis endgueltig geheilt" VALUE 0xF29C2 MSA15_FW3 0 ZEIT_ST 0.000000 655350000.000000 /end CHARACTERISTIC
/begin CHARACTERISTIC fbwEOTF_HT "OTF SRC oben  Zeit/Ereignisgesteuert, Loeschbar" VALUE 0xF29C4 MSA15_FW3 0 DEZ_DW_U 0.000000 65535.000000 /end CHARACTERISTIC
/begin CHARACTERISTIC fbwEOTF_LA "OTF SRC unten  Zeit bis endgueltig defekt" VALUE 0xF29BA MSA15_FW3 0 ZEIT_ST 0.000000 655350000.000000 /end CHARACTERISTIC
/begin CHARACTERISTIC fbwEOTF_LB "OTF SRC unten  Zeit bis endgueltig geheilt" VALUE 0xF29BC MSA15_FW3 0 ZEIT_ST 0.000000 655350000.000000 /end CHARACTERISTIC
/begin CHARACTERISTIC fbwEOTF_LT "OTF SRC unten  Zeit/Ereignisgesteuert, Loeschbar" VALUE 0xF29BE MSA15_FW3 0 DEZ_DW_U 0.000000 65535.000000 /end CHARACTERISTIC
/begin CHARACTERISTIC fbwEPGP_PA "#SSD PWG Fehlerstrategie Poti1/2  Defekterkennungs-Zeit" VALUE 0xF288E MSA15_FW3 0 ZEIT_ST 0.000000 655350000.000000 /end CHARACTERISTIC
/begin CHARACTERISTIC fbwEPGP_PB "#SSD PWG Fehlerstrategie Poti1/2 Intakterkennungs-Zeit" VALUE 0xF2890 MSA15_FW3 0 ZEIT_ST 0.000000 655350000.000000 /end CHARACTERISTIC
/begin CHARACTERISTIC fbwEPGP_PT "#SSD PWG Fehlerstrategie Poti1/2 zeit-/ereignisgesteuert, loeschbar" VALUE 0xF2892 MSA15_FW3 0 DEZ_DW_U 0.000000 65535.000000 /end CHARACTERISTIC
/begin CHARACTERISTIC fbwEPGS_HA "#SSD PGS  Signal oberer  SRC  Defekterkennungs-Zeit" VALUE 0xF2882 MSA15_FW3 0 ZEIT_ST 0.000000 655350000.000000 /end CHARACTERISTIC
/begin CHARACTERISTIC fbwEPGS_HB "#SSD PGS  Signal oberer  SRC  Intakterkennungs-Zeit" VALUE 0xF2884 MSA15_FW3 0 ZEIT_ST 0.000000 655350000.000000 /end CHARACTERISTIC
/begin CHARACTERISTIC fbwEPGS_HT "#SSD PGS  Signal oberer  SRC  zeit-/ereignisgesteuert, loeschbar" VALUE 0xF2886 MSA15_FW3 0 DEZ_DW_U 0.000000 65535.000000 /end CHARACTERISTIC
/begin CHARACTERISTIC fbwEPGS_LA "#SSD PGS  Signal unterer SRC  Defekterkennungs-Zeit" VALUE 0xF287C MSA15_FW3 0 ZEIT_ST 0.000000 655350000.000000 /end CHARACTERISTIC
/begin CHARACTERISTIC fbwEPGS_LB "#SSD PGS  Signal unterer SRC  Intakterkennungs-Zeit" VALUE 0xF287E MSA15_FW3 0 ZEIT_ST 0.000000 655350000.000000 /end CHARACTERISTIC
/begin CHARACTERISTIC fbwEPGS_LT "#SSD PGS  Signal unterer SRC  zeit-/ereignisgesteuert, loeschbar" VALUE 0xF2880 MSA15_FW3 0 DEZ_DW_U 0.000000 65535.000000 /end CHARACTERISTIC
/begin CHARACTERISTIC fbwEPGS_VA "#SSD PGS  Speisespannungsfehler  Defekterkennungs-Zeit" VALUE 0xF2888 MSA15_FW3 0 ZEIT_ST 0.000000 655350000.000000 /end CHARACTERISTIC
/begin CHARACTERISTIC fbwEPGS_VB "#SSD PGS  Speisespannungsfehler  Intakterkennungs-Zeit" VALUE 0xF288A MSA15_FW3 0 ZEIT_ST 0.000000 655350000.000000 /end CHARACTERISTIC
/begin CHARACTERISTIC fbwEPGS_VT "#SSD PGS  Speisespannungsfehler  zeit-/ereignisgesteuert, loeschbar" VALUE 0xF288C MSA15_FW3 0 DEZ_DW_U 0.000000 65535.000000 /end CHARACTERISTIC
/begin CHARACTERISTIC fbwEPWG_HA "#SSD PWG  Signal oberer  SRC  Defekterkennungs-Zeit" VALUE 0xF2848 MSA15_FW3 0 ZEIT_ST 0.000000 655350000.000000 /end CHARACTERISTIC
/begin CHARACTERISTIC fbwEPWG_HB "#SSD PWG  Signal oberer  SRC  Intakterkennungs-Zeit" VALUE 0xF284A MSA15_FW3 0 ZEIT_ST 0.000000 655350000.000000 /end CHARACTERISTIC
/begin CHARACTERISTIC fbwEPWG_HT "#SSD PWG  Signal oberer  SRC  zeit-/ereignisgesteuert, loeschbar" VALUE 0xF284C MSA15_FW3 0 DEZ_DW_U 0.000000 65535.000000 /end CHARACTERISTIC
/begin CHARACTERISTIC fbwEPWG_LA "#SSD PWG  Signal unterer SRC  Defekterkennungs-Zeit" VALUE 0xF2842 MSA15_FW3 0 ZEIT_ST 0.000000 655350000.000000 /end CHARACTERISTIC
/begin CHARACTERISTIC fbwEPWG_LB "#SSD PWG  Signal unterer SRC  Intakterkennungs-Zeit" VALUE 0xF2844 MSA15_FW3 0 ZEIT_ST 0.000000 655350000.000000 /end CHARACTERISTIC
/begin CHARACTERISTIC fbwEPWG_LT "#SSD PWG  Signal unterer SRC  zeit-/ereignisgesteuert, loeschbar" VALUE 0xF2846 MSA15_FW3 0 DEZ_DW_U 0.000000 65535.000000 /end CHARACTERISTIC
/begin CHARACTERISTIC fbwEPWG_VA "#SSD PWG  Speisespannungsfehler  Defekterkennungs-Zeit" VALUE 0xF284E MSA15_FW3 0 ZEIT_ST 0.000000 655350000.000000 /end CHARACTERISTIC
/begin CHARACTERISTIC fbwEPWG_VB "#SSD PWG  Speisespannungsfehler  Intakterkennungs-Zeit" VALUE 0xF2850 MSA15_FW3 0 ZEIT_ST 0.000000 655350000.000000 /end CHARACTERISTIC
/begin CHARACTERISTIC fbwEPWG_VT "#SSD PWG  Speisespannungsfehler  zeit-/ereignisgesteuert, loeschbar" VALUE 0xF2852 MSA15_FW3 0 DEZ_DW_U 0.000000 65535.000000 /end CHARACTERISTIC
/begin CHARACTERISTIC fbwEPWP_BA "#SSD PWG  Plaus. mit BRE  Defekterkennungs-Zeit" VALUE 0xF2854 MSA15_FW3 0 ZEIT_ST 0.000000 655350000.000000 /end CHARACTERISTIC
/begin CHARACTERISTIC fbwEPWP_BB "#SSD PWG  Plaus. mit BRE  Intakterkennungs-Zeit" VALUE 0xF2856 MSA15_FW3 0 ZEIT_ST 0.000000 655350000.000000 /end CHARACTERISTIC
/begin CHARACTERISTIC fbwEPWP_BT "#SSD PWG  Plaus. mit BRE  zeit-/ereignisgesteuert, loeschbar" VALUE 0xF2858 MSA15_FW3 0 DEZ_DW_U 0.000000 65535.000000 /end CHARACTERISTIC
/begin CHARACTERISTIC fbwERUC_AA "Bypass-ASCET Kommunikation Defekterkennungszeit" VALUE 0xF2C8C MSA15_FW3 0 ZEIT_ST 0.000000 655350000.000000 /end CHARACTERISTIC
/begin CHARACTERISTIC fbwERUC_AB "Bypass-ASCET Kommunikation Intakterkennungszeit" VALUE 0xF2C8E MSA15_FW3 0 ZEIT_ST 0.000000 655350000.000000 /end CHARACTERISTIC
/begin CHARACTERISTIC fbwERUC_AT "Bypass-ASCET Komm. zeit-/ereignisgesteuert, loeschbar" VALUE 0xF2C90 MSA15_FW3 0 DEZ_DW_U 0.000000 32767.000000 EXTENDED_LIMITS 0.000000 65535.000000 /end CHARACTERISTIC
/begin CHARACTERISTIC fbwERUC_KA "#SSD uC   Watchdog-Kommunikation unentprellt Defekterkennungs-Zeit" VALUE 0xF2C86 MSA15_FW3 0 ZEIT_ST 0.000000 655350000.000000 /end CHARACTERISTIC
/begin CHARACTERISTIC fbwERUC_KB "#SSD uC   Watchdog-Kommunikation unentprellt Intakterkennungs-Zeit" VALUE 0xF2C88 MSA15_FW3 0 ZEIT_ST 0.000000 655350000.000000 /end CHARACTERISTIC
/begin CHARACTERISTIC fbwERUC_KT "#SSD uC   Watchdog-Kommunikation unentprellt zeit-/ereignisgesteuert, loeschbar" VALUE 0xF2C8A MSA15_FW3 0 DEZ_DW_U 0.000000 32767.000000 EXTENDED_LIMITS 0.000000 65535.000000 /end CHARACTERISTIC
/begin CHARACTERISTIC fbwERUC_RA "#SSD uC   RECOVERY aufgetreten Defekterkennungs-Zeit" VALUE 0xF2C7A MSA15_FW3 0 DEZ_DW_U 0.000000 65535.000000 /end CHARACTERISTIC
/begin CHARACTERISTIC fbwERUC_RB "#SSD uC   Recovery  Intakterkennungs-Zeit" VALUE 0xF2C7C MSA15_FW3 0 DEZ_DW_U 0.000000 65535.000000 /end CHARACTERISTIC
/begin CHARACTERISTIC fbwERUC_RT "#SSD uC   Recovery  zeit-/ereignisgesteuert, loeschbar" VALUE 0xF2C7E MSA15_FW3 0 DEZ_DW_U 0.000000 65535.000000 /end CHARACTERISTIC
/begin CHARACTERISTIC fbwERUC_SA "#SSD uC   Schubueberwachung  Defekterkennungs-Zeit" VALUE 0xF2C74 MSA15_FW3 0 ZEIT_ST 0.000000 655350000.000000 /end CHARACTERISTIC
/begin CHARACTERISTIC fbwERUC_SB "#SSD uC   Schubueberwachung  Intakterkennungs-Zeit" VALUE 0xF2C76 MSA15_FW3 0 ZEIT_ST 0.000000 655350000.000000 /end CHARACTERISTIC
/begin CHARACTERISTIC fbwERUC_ST "#SSD uC   Schubueberwachung  zeit-/ereignisgesteuert, loeschbar" VALUE 0xF2C78 MSA15_FW3 0 DEZ_DW_U 0.000000 65535.000000 /end CHARACTERISTIC
/begin CHARACTERISTIC fbwERUC_UA "#SSD uC   Watchdog-Kommunikation  Defekterkennungs-Zeit" VALUE 0xF2C80 MSA15_FW3 0 ZEIT_ST 0.000000 655350000.000000 /end CHARACTERISTIC
/begin CHARACTERISTIC fbwERUC_UB "#SSD uC   Watchdog-Kommunikation  Intakterkennungs-Zeit" VALUE 0xF2C82 MSA15_FW3 0 ZEIT_ST 0.000000 655350000.000000 /end CHARACTERISTIC
/begin CHARACTERISTIC fbwERUC_UT "#SSD uC   Watchdog-Kommunikation  zeit-/ereignisgesteuert, loeschbar" VALUE 0xF2C84 MSA15_FW3 0 DEZ_DW_U 0.000000 32767.000000 EXTENDED_LIMITS 0.000000 65535.000000 /end CHARACTERISTIC
/begin CHARACTERISTIC fbwERUC_WA "#SSD uC   Watchdog-NL-Test  Defekterkennungs-Zeit" VALUE 0xF2C6E MSA15_FW3 0 DEZ_DW_U 0.000000 65535.000000 /end CHARACTERISTIC
/begin CHARACTERISTIC fbwERUC_WB "#SSD uC   Watchdog-NL-Test  Intakterkennungs-Zeit" VALUE 0xF2C70 MSA15_FW3 0 DEZ_DW_U 0.000000 65535.000000 /end CHARACTERISTIC
/begin CHARACTERISTIC fbwERUC_WT "#SSD uC   Watchdog-NL-Test  zeit-/ereignisgesteuert, loeschbar" VALUE 0xF2C72 MSA15_FW3 0 DEZ_DW_U 0.000000 65535.000000 /end CHARACTERISTIC
/begin CHARACTERISTIC fbwESL11A "I11  SL-Fehler  Defekterkennungs-Zeit" VALUE 0xF317E MSA15_FW3 0 ZEIT_ST 0.000000 655350000.000000 /end CHARACTERISTIC
/begin CHARACTERISTIC fbwESL11B "I11  SL-Fehler  Intakterkennungs-Zeit" VALUE 0xF3180 MSA15_FW3 0 ZEIT_ST 655350000.000000 655350000.000000 EXTENDED_LIMITS 0.000000 655350000.000000 /end CHARACTERISTIC
/begin CHARACTERISTIC fbwESL11T "I11  SL-Fehler  zeit-/ereignisgesteuert, loeschbar" VALUE 0xF3182 MSA15_FW3 0 DEZ_DW_U 0.000000 65535.000000 /end CHARACTERISTIC
/begin CHARACTERISTIC fbwESL12A "I12  SL-Fehler  Defekterkennungs-Zeit" VALUE 0xF3266 MSA15_FW3 0 ZEIT_ST 0.000000 655350000.000000 /end CHARACTERISTIC
/begin CHARACTERISTIC fbwESL12B "I12  SL-Fehler  Intakterkennungs-Zeit" VALUE 0xF3268 MSA15_FW3 0 ZEIT_ST 655350000.000000 655350000.000000 EXTENDED_LIMITS 0.000000 655350000.000000 /end CHARACTERISTIC
/begin CHARACTERISTIC fbwESL12T "I12  SL-Fehler  zeit-/ereignisgesteuert, loeschbar" VALUE 0xF326A MSA15_FW3 0 DEZ_DW_U 0.000000 65535.000000 /end CHARACTERISTIC
/begin CHARACTERISTIC fbwESL21A "I21  SL-Fehler  Defekterkennungs-Zeit" VALUE 0xF31B8 MSA15_FW3 0 ZEIT_ST 0.000000 655350000.000000 /end CHARACTERISTIC
/begin CHARACTERISTIC fbwESL21B "I21  SL-Fehler  Intakterkennungs-Zeit" VALUE 0xF31BA MSA15_FW3 0 ZEIT_ST 655350000.000000 655350000.000000 EXTENDED_LIMITS 0.000000 655350000.000000 /end CHARACTERISTIC
/begin CHARACTERISTIC fbwESL21T "I21  SL-Fehler  zeit-/ereignisgesteuert, loeschbar" VALUE 0xF31BC MSA15_FW3 0 DEZ_DW_U 0.000000 65535.000000 /end CHARACTERISTIC
/begin CHARACTERISTIC fbwESL22A "I22  SL-Fehler  Defekterkennungs-Zeit" VALUE 0xF32A0 MSA15_FW3 0 ZEIT_ST 0.000000 655350000.000000 /end CHARACTERISTIC
/begin CHARACTERISTIC fbwESL22B "I22  SL-Fehler  Intakterkennungs-Zeit" VALUE 0xF32A2 MSA15_FW3 0 ZEIT_ST 655350000.000000 655350000.000000 EXTENDED_LIMITS 0.000000 655350000.000000 /end CHARACTERISTIC
/begin CHARACTERISTIC fbwESL22T "I22  SL-Fehler  zeit-/ereignisgesteuert, loeschbar" VALUE 0xF32A4 MSA15_FW3 0 DEZ_DW_U 0.000000 65535.000000 /end CHARACTERISTIC
/begin CHARACTERISTIC fbwESL31A "I31  SL-Fehler  Defekterkennungs-Zeit" VALUE 0xF31F2 MSA15_FW3 0 ZEIT_ST 0.000000 655350000.000000 /end CHARACTERISTIC
/begin CHARACTERISTIC fbwESL31B "I31  SL-Fehler  Intakterkennungs-Zeit" VALUE 0xF31F4 MSA15_FW3 0 ZEIT_ST 655350000.000000 655350000.000000 EXTENDED_LIMITS 0.000000 655350000.000000 /end CHARACTERISTIC
/begin CHARACTERISTIC fbwESL31T "I31  SL-Fehler  zeit-/ereignisgesteuert, loeschbar" VALUE 0xF31F6 MSA15_FW3 0 DEZ_DW_U 0.000000 65535.000000 /end CHARACTERISTIC
/begin CHARACTERISTIC fbwESL32A "I32  SL-Fehler  Defekterkennungs-Zeit" VALUE 0xF32DA MSA15_FW3 0 ZEIT_ST 0.000000 655350000.000000 /end CHARACTERISTIC
/begin CHARACTERISTIC fbwESL32B "I32  SL-Fehler  Intakterkennungs-Zeit" VALUE 0xF32DC MSA15_FW3 0 ZEIT_ST 655350000.000000 655350000.000000 EXTENDED_LIMITS 0.000000 655350000.000000 /end CHARACTERISTIC
/begin CHARACTERISTIC fbwESL32T "I32  SL-Fehler  zeit-/ereignisgesteuert, loeschbar" VALUE 0xF32DE MSA15_FW3 0 DEZ_DW_U 0.000000 65535.000000 /end CHARACTERISTIC
/begin CHARACTERISTIC fbwESL41A "I41  SL-Fehler  Defekterkennungs-Zeit" VALUE 0xF322C MSA15_FW3 0 ZEIT_ST 0.000000 655350000.000000 /end CHARACTERISTIC
/begin CHARACTERISTIC fbwESL41B "I41  SL-Fehler  Intakterkennungs-Zeit" VALUE 0xF322E MSA15_FW3 0 ZEIT_ST 655350000.000000 655350000.000000 EXTENDED_LIMITS 0.000000 655350000.000000 /end CHARACTERISTIC
/begin CHARACTERISTIC fbwESL41T "I41  SL-Fehler  zeit-/ereignisgesteuert, loeschbar" VALUE 0xF3230 MSA15_FW3 0 DEZ_DW_U 0.000000 65535.000000 /end CHARACTERISTIC
/begin CHARACTERISTIC fbwESL42A "I42  SL-Fehler  Defekterkennungs-Zeit" VALUE 0xF3314 MSA15_FW3 0 ZEIT_ST 0.000000 655350000.000000 /end CHARACTERISTIC
/begin CHARACTERISTIC fbwESL42B "I42  SL-Fehler  Intakterkennungs-Zeit" VALUE 0xF3316 MSA15_FW3 0 ZEIT_ST 655350000.000000 655350000.000000 EXTENDED_LIMITS 0.000000 655350000.000000 /end CHARACTERISTIC
/begin CHARACTERISTIC fbwESL42T "I42  SL-Fehler  zeit-/ereignisgesteuert, loeschbar" VALUE 0xF3318 MSA15_FW3 0 DEZ_DW_U 0.000000 65535.000000 /end CHARACTERISTIC
/begin CHARACTERISTIC fbwESTB_OA "STAB oberer  SRC  Defekterkennungs-Zeit" VALUE 0xF2CBA MSA15_FW3 0 DEZ_DW_U 0.000000 65535.000000 /end CHARACTERISTIC
/begin CHARACTERISTIC fbwESTB_OB "STAB oberer  SRC  Intakterkennungs-Zeit" VALUE 0xF2CBC MSA15_FW3 0 DEZ_DW_U 0.000000 65535.000000 /end CHARACTERISTIC
/begin CHARACTERISTIC fbwESTB_OT "STAB oberer  SRC  zeit-/ereignisgesteuert, loeschbar" VALUE 0xF2CBE MSA15_FW3 0 DEZ_DW_U 0.000000 65535.000000 /end CHARACTERISTIC
/begin CHARACTERISTIC fbwESTB_UA "STAB unterer SRC  Defekterkennungs-Zeit" VALUE 0xF2CB4 MSA15_FW3 0 DEZ_DW_U 0.000000 65535.000000 /end CHARACTERISTIC
/begin CHARACTERISTIC fbwESTB_UB "STAB unterer SRC  Intakterkennungs-Zeit" VALUE 0xF2CB6 MSA15_FW3 0 DEZ_DW_U 0.000000 65535.000000 /end CHARACTERISTIC
/begin CHARACTERISTIC fbwESTB_UT "STAB unterer SRC  zeit-/ereignisgesteuert, loeschbar" VALUE 0xF2CB8 MSA15_FW3 0 DEZ_DW_U 0.000000 65535.000000 /end CHARACTERISTIC
/begin CHARACTERISTIC fbwETHS_KA "THS  Kurzschluss  Defekterkennungs-Zeit" VALUE 0xF2FA0 MSA15_FW3 0 ZEIT_ST 0.000000 655350000.000000 /end CHARACTERISTIC
/begin CHARACTERISTIC fbwETHS_KB "THS  Kurzschluss  Intakterkennungs-Zeit" VALUE 0xF2FA2 MSA15_FW3 0 ZEIT_ST 0.000000 655350000.000000 /end CHARACTERISTIC
/begin CHARACTERISTIC fbwETHS_KT "THS  Kurzschluss  zeit-/ereignisgesteuert, loeschbar" VALUE 0xF2FA4 MSA15_FW3 0 DEZ_DW_U 0.000000 65535.000000 /end CHARACTERISTIC
/begin CHARACTERISTIC fbwETHS_OA "THS  Leerlauf  Defekterkennungs-Zeit" VALUE 0xF2FA6 MSA15_FW3 0 ZEIT_ST 0.000000 655350000.000000 /end CHARACTERISTIC
/begin CHARACTERISTIC fbwETHS_OB "THS  Leerlauf  Intakterkennungs-Zeit" VALUE 0xF2FA8 MSA15_FW3 0 ZEIT_ST 0.000000 655350000.000000 /end CHARACTERISTIC
/begin CHARACTERISTIC fbwETHS_OT "THS  Leerlauf  zeit-/ereignisgesteuert, loeschbar" VALUE 0xF2FAA MSA15_FW3 0 DEZ_DW_U 0.000000 65535.000000 /end CHARACTERISTIC
/begin CHARACTERISTIC fbwETST_HA "#SSD TST Testspannung SRC oben  Zeit bis endgueltig defekt" VALUE 0xF298C MSA15_FW3 0 ZEIT_ST 0.000000 655350000.000000 /end CHARACTERISTIC
/begin CHARACTERISTIC fbwETST_HB "#SSD TST Testspannung SRC oben  Zeit bis endgueltig geheilt" VALUE 0xF298E MSA15_FW3 0 ZEIT_ST 0.000000 655350000.000000 /end CHARACTERISTIC
/begin CHARACTERISTIC fbwETST_HT "#SSD TST Testspannung SRC oben  Zeit/Ereignisgesteuert, Loeschbar" VALUE 0xF2990 MSA15_FW3 0 DEZ_DW_U 0.000000 65535.000000 /end CHARACTERISTIC
/begin CHARACTERISTIC fbwETST_LA "#SSD TST Testspannung SRC unten  Zeit bis endgueltig defekt" VALUE 0xF2986 MSA15_FW3 0 ZEIT_ST 0.000000 655350000.000000 /end CHARACTERISTIC
/begin CHARACTERISTIC fbwETST_LB "#SSD TST Testspannung SRC unten  Zeit bis endgueltig geheilt" VALUE 0xF2988 MSA15_FW3 0 ZEIT_ST 0.000000 655350000.000000 /end CHARACTERISTIC
/begin CHARACTERISTIC fbwETST_LT "#SSD TST Testspannung SRC unten  Zeit/Ereignisgesteuert, Loeschbar" VALUE 0xF298A MSA15_FW3 0 DEZ_DW_U 0.000000 65535.000000 /end CHARACTERISTIC
/begin CHARACTERISTIC fbwETST_TA "#SSD TST LTI-Fehler  Zeit bis endgueltig defekt" VALUE 0xF2992 MSA15_FW3 0 ZEIT_ST 0.000000 655350000.000000 /end CHARACTERISTIC
/begin CHARACTERISTIC fbwETST_TB "#SSD TST LTI-Fehler  Zeit bis endgueltig geheilt" VALUE 0xF2994 MSA15_FW3 0 ZEIT_ST 0.000000 655350000.000000 /end CHARACTERISTIC
/begin CHARACTERISTIC fbwETST_TT "#SSD TST LTI-Fehler  Zeit/Ereignisgesteuert, Loeschbar" VALUE 0xF2996 MSA15_FW3 0 DEZ_DW_U 0.000000 65535.000000 /end CHARACTERISTIC
/begin CHARACTERISTIC fbwETUM_DA "Umgebungstemperatur Defekterkennungs-Zeit" VALUE 0xF302A MSA15_FW3 0 ZEIT_ST 0.000000 655350000.000000 /end CHARACTERISTIC
/begin CHARACTERISTIC fbwETUM_DB "Umgebungstemperatur Intakterkennungs-Zeit" VALUE 0xF302C MSA15_FW3 0 ZEIT_ST 0.000000 655350000.000000 /end CHARACTERISTIC
/begin CHARACTERISTIC fbwETUM_DT "Umgebungstemperatur zeit-/ereignisgesteuert, loeschbar" VALUE 0xF302E MSA15_FW3 0 DEZ_DW_U 0.000000 65535.000000 /end CHARACTERISTIC
/begin CHARACTERISTIC fbwETXU_FA "TXU1 Botschaftsausfall Defekterkennungs-Zeit" VALUE 0xF33EE MSA15_FW3 0 ZEIT_ST 0.000000 70000.000000 EXTENDED_LIMITS 0.000000 655350000.000000 /end CHARACTERISTIC
/begin CHARACTERISTIC fbwETXU_FB "TXU1 Botschaftsausfall  Intakterkennungszeit" VALUE 0xF33F0 MSA15_FW3 0 ZEIT_ST 0.000000 70000.000000 EXTENDED_LIMITS 0.000000 655350000.000000 /end CHARACTERISTIC
/begin CHARACTERISTIC fbwETXU_FT "TXU1 Botschaftsausfall zeit-/ereignisgesteuert, loeschbar" VALUE 0xF33F2 MSA15_FW3 0 DEZ_DW_U 0.000000 65535.000000 /end CHARACTERISTIC
/begin CHARACTERISTIC fbwEUBT_HA "#SSD UBAT oberer  SRC  Defekterkennungs-Zeit" VALUE 0xF27A6 MSA15_FW3 0 ZEIT_ST 0.000000 655350000.000000 /end CHARACTERISTIC
/begin CHARACTERISTIC fbwEUBT_HB "#SSD UBAT oberer  SRC  Intakterkennungs-Zeit" VALUE 0xF27A8 MSA15_FW3 0 ZEIT_ST 0.000000 655350000.000000 /end CHARACTERISTIC
/begin CHARACTERISTIC fbwEUBT_HT "#SSD UBAT oberer  SRC  zeit-/ereignisgesteuert, loeschbar" VALUE 0xF27AA MSA15_FW3 0 DEZ_DW_U 0.000000 65535.000000 /end CHARACTERISTIC
/begin CHARACTERISTIC fbwEUBT_LA "#SSD UBAT unterer SRC  Defekterkennungs-Zeit" VALUE 0xF27A0 MSA15_FW3 0 ZEIT_ST 0.000000 655350000.000000 /end CHARACTERISTIC
/begin CHARACTERISTIC fbwEUBT_LB "#SSD UBAT unterer SRC  Intakterkennungs-Zeit" VALUE 0xF27A2 MSA15_FW3 0 ZEIT_ST 0.000000 655350000.000000 /end CHARACTERISTIC
/begin CHARACTERISTIC fbwEUBT_LT "#SSD UBAT unterer SRC  zeit-/ereignisgesteuert, loeschbar" VALUE 0xF27A4 MSA15_FW3 0 DEZ_DW_U 0.000000 65535.000000 /end CHARACTERISTIC
/begin CHARACTERISTIC fbwEUC1RHA "UC1 max. Boosterspannung Defekterkennungs-Zeit" VALUE 0xF27E0 MSA15_FW3 0 ZEIT_ST 0.000000 655350000.000000 /end CHARACTERISTIC
/begin CHARACTERISTIC fbwEUC1RHB "UC1 max. Boosterspannung Intakterkennungs-Zeit" VALUE 0xF27E2 MSA15_FW3 0 ZEIT_ST 655350000.000000 655350000.000000 EXTENDED_LIMITS 0.000000 655350000.000000 /end CHARACTERISTIC
/begin CHARACTERISTIC fbwEUC1RHT "UC1 max. Boostersp. zeit-/ereignisgesteuert, loeschbar" VALUE 0xF27E4 MSA15_FW3 0 DEZ_DW_U 0.000000 65535.000000 /end CHARACTERISTIC
/begin CHARACTERISTIC fbwEUC1RLA "UC1 min. Boosterspannung Defekterkennungs-Zeit" VALUE 0xF27DA MSA15_FW3 0 ZEIT_ST 0.000000 655350000.000000 /end CHARACTERISTIC
/begin CHARACTERISTIC fbwEUC1RLB "UC1 min. Boosterspannung Intakterkennungs-Zeit" VALUE 0xF27DC MSA15_FW3 0 ZEIT_ST 655350000.000000 655350000.000000 EXTENDED_LIMITS 0.000000 655350000.000000 /end CHARACTERISTIC
/begin CHARACTERISTIC fbwEUC1RLT "UC1 min. Boostersp. zeit-/ereignisgesteuert, loeschbar" VALUE 0xF27DE MSA15_FW3 0 DEZ_DW_U 0.000000 65535.000000 /end CHARACTERISTIC
/begin CHARACTERISTIC fbwEUC1_HA "UC1 oberer  SRC  Defekterkennungs-Zeit" VALUE 0xF27D4 MSA15_FW3 0 ZEIT_ST 0.000000 655350000.000000 /end CHARACTERISTIC
/begin CHARACTERISTIC fbwEUC1_HB "UC1 oberer  SRC  Intakterkennungs-Zeit" VALUE 0xF27D6 MSA15_FW3 0 ZEIT_ST 0.000000 655350000.000000 /end CHARACTERISTIC
/begin CHARACTERISTIC fbwEUC1_HT "UC1 oberer  SRC  zeit-/ereignisgesteuert, loeschbar" VALUE 0xF27D8 MSA15_FW3 0 DEZ_DW_U 0.000000 65535.000000 /end CHARACTERISTIC
/begin CHARACTERISTIC fbwEUC1_LA "UC1 unterer SRC  Defekterkennungs-Zeit" VALUE 0xF27CE MSA15_FW3 0 ZEIT_ST 0.000000 655350000.000000 /end CHARACTERISTIC
/begin CHARACTERISTIC fbwEUC1_LB "UC1 unterer SRC  Intakterkennungs-Zeit" VALUE 0xF27D0 MSA15_FW3 0 ZEIT_ST 0.000000 655350000.000000 /end CHARACTERISTIC
/begin CHARACTERISTIC fbwEUC1_LT "UC1 unterer SRC  zeit-/ereignisgesteuert, loeschbar" VALUE 0xF27D2 MSA15_FW3 0 DEZ_DW_U 0.000000 65535.000000 /end CHARACTERISTIC
/begin CHARACTERISTIC fbwEUC2RHA "UC2 max. Boosterspannung Defekterkennungs-Zeit" VALUE 0xF281A MSA15_FW3 0 ZEIT_ST 0.000000 655350000.000000 /end CHARACTERISTIC
/begin CHARACTERISTIC fbwEUC2RHB "UC2 max. Boosterspannung Intakterkennungs-Zeit" VALUE 0xF281C MSA15_FW3 0 ZEIT_ST 655350000.000000 655350000.000000 EXTENDED_LIMITS 0.000000 655350000.000000 /end CHARACTERISTIC
/begin CHARACTERISTIC fbwEUC2RHT "UC2 max. Boostersp. zeit-/ereignisgesteuert, loeschbar" VALUE 0xF281E MSA15_FW3 0 DEZ_DW_U 0.000000 65535.000000 /end CHARACTERISTIC
/begin CHARACTERISTIC fbwEUC2RLA "UC2 min. Boosterspannung Defekterkennungs-Zeit" VALUE 0xF2814 MSA15_FW3 0 ZEIT_ST 0.000000 655350000.000000 /end CHARACTERISTIC
/begin CHARACTERISTIC fbwEUC2RLB "UC2 min. Boosterspannung Intakterkennungs-Zeit" VALUE 0xF2816 MSA15_FW3 0 ZEIT_ST 655350000.000000 655350000.000000 EXTENDED_LIMITS 0.000000 655350000.000000 /end CHARACTERISTIC
/begin CHARACTERISTIC fbwEUC2RLT "UC2 min. Boostersp. zeit-/ereignisgesteuert, loeschbar" VALUE 0xF2818 MSA15_FW3 0 DEZ_DW_U 0.000000 65535.000000 /end CHARACTERISTIC
/begin CHARACTERISTIC fbwEUC2_HA "UC2 oberer  SRC  Defekterkennungs-Zeit" VALUE 0xF280E MSA15_FW3 0 ZEIT_ST 0.000000 655350000.000000 /end CHARACTERISTIC
/begin CHARACTERISTIC fbwEUC2_HB "UC2 oberer  SRC  Intakterkennungs-Zeit" VALUE 0xF2810 MSA15_FW3 0 ZEIT_ST 0.000000 655350000.000000 /end CHARACTERISTIC
/begin CHARACTERISTIC fbwEUC2_HT "UC2 oberer  SRC  zeit-/ereignisgesteuert, loeschbar" VALUE 0xF2812 MSA15_FW3 0 DEZ_DW_U 0.000000 65535.000000 /end CHARACTERISTIC
/begin CHARACTERISTIC fbwEUC2_LA "UC2 unterer SRC  Defekterkennungs-Zeit" VALUE 0xF2808 MSA15_FW3 0 ZEIT_ST 0.000000 655350000.000000 /end CHARACTERISTIC
/begin CHARACTERISTIC fbwEUC2_LB "UC2 unterer SRC  Intakterkennungs-Zeit" VALUE 0xF280A MSA15_FW3 0 ZEIT_ST 0.000000 655350000.000000 /end CHARACTERISTIC
/begin CHARACTERISTIC fbwEUC2_LT "UC2 unterer SRC  zeit-/ereignisgesteuert, loeschbar" VALUE 0xF280C MSA15_FW3 0 DEZ_DW_U 0.000000 65535.000000 /end CHARACTERISTIC
/begin CHARACTERISTIC fbwEUG1_HA "#SSD UG1  Speisung oberer  SRC  Defekterkennungs-Zeit" VALUE 0xF2BEA MSA15_FW3 0 ZEIT_ST 0.000000 655350000.000000 /end CHARACTERISTIC
/begin CHARACTERISTIC fbwEUG1_HB "#SSD UG1  Speisung oberer  SRC  Intakterkennungs-Zeit" VALUE 0xF2BEC MSA15_FW3 0 ZEIT_ST 0.000000 655350000.000000 /end CHARACTERISTIC
/begin CHARACTERISTIC fbwEUG1_HT "#SSD UG1  Speisung oberer  SRC  zeit-/ereignisgesteuert, loeschbar" VALUE 0xF2BEE MSA15_FW3 0 DEZ_DW_U 0.000000 65535.000000 /end CHARACTERISTIC
/begin CHARACTERISTIC fbwEUG1_LA "#SSD UG1  Speisung unterer SRC  Defekterkennungs-Zeit" VALUE 0xF2BE4 MSA15_FW3 0 ZEIT_ST 0.000000 655350000.000000 /end CHARACTERISTIC
/begin CHARACTERISTIC fbwEUG1_LB "#SSD UG1  Speisung unterer SRC  Intakterkennungs-Zeit" VALUE 0xF2BE6 MSA15_FW3 0 ZEIT_ST 0.000000 655350000.000000 /end CHARACTERISTIC
/begin CHARACTERISTIC fbwEUG1_LT "#SSD UG1  Speisung unterer SRC  zeit-/ereignisgesteuert, loeschbar" VALUE 0xF2BE8 MSA15_FW3 0 DEZ_DW_U 0.000000 65535.000000 /end CHARACTERISTIC
/begin CHARACTERISTIC fbwEUG2_HA "#SSD UG2  Speisung oberer  SRC  Defekterkennungs-Zeit" VALUE 0xF2C18 MSA15_FW3 0 ZEIT_ST 0.000000 655350000.000000 /end CHARACTERISTIC
/begin CHARACTERISTIC fbwEUG2_HB "#SSD UG2  Speisung oberer  SRC  Intakterkennungs-Zeit" VALUE 0xF2C1A MSA15_FW3 0 ZEIT_ST 0.000000 655350000.000000 /end CHARACTERISTIC
/begin CHARACTERISTIC fbwEUG2_HT "#SSD UG2  Speisung oberer  SRC  zeit-/ereignisgesteuert, loeschbar" VALUE 0xF2C1C MSA15_FW3 0 DEZ_DW_U 0.000000 65535.000000 /end CHARACTERISTIC
/begin CHARACTERISTIC fbwEUG2_LA "#SSD UG2  Speisung unterer SRC  Defekterkennungs-Zeit" VALUE 0xF2C12 MSA15_FW3 0 ZEIT_ST 0.000000 655350000.000000 /end CHARACTERISTIC
/begin CHARACTERISTIC fbwEUG2_LB "#SSD UG2  Speisung unterer SRC  Intakterkennungs-Zeit" VALUE 0xF2C14 MSA15_FW3 0 ZEIT_ST 0.000000 655350000.000000 /end CHARACTERISTIC
/begin CHARACTERISTIC fbwEUG2_LT "#SSD UG2  Speisung unterer SRC  zeit-/ereignisgesteuert, loeschbar" VALUE 0xF2C16 MSA15_FW3 0 DEZ_DW_U 0.000000 65535.000000 /end CHARACTERISTIC
/begin CHARACTERISTIC fbwEVDF_HA "#SSD VDF SRC oben  Zeit bis endgueltig defekt" VALUE 0xF291E MSA15_FW3 0 ZEIT_ST 0.000000 655350000.000000 /end CHARACTERISTIC
/begin CHARACTERISTIC fbwEVDF_HB "#SSD VDF SRC oben  Zeit bis endgueltig geheilt" VALUE 0xF2920 MSA15_FW3 0 ZEIT_ST 0.000000 655350000.000000 /end CHARACTERISTIC
/begin CHARACTERISTIC fbwEVDF_HT "#SSD VDF SRC oben  Zeit/Ereignisgesteuert, Loeschbar" VALUE 0xF2922 MSA15_FW3 0 DEZ_DW_U 0.000000 65535.000000 /end CHARACTERISTIC
/begin CHARACTERISTIC fbwEVDF_LA "#SSD VDF SRC unten  Zeit bis endgueltig defekt" VALUE 0xF2918 MSA15_FW3 0 ZEIT_ST 0.000000 655350000.000000 /end CHARACTERISTIC
/begin CHARACTERISTIC fbwEVDF_LB "#SSD VDF SRC unten  Zeit bis endgueltig geheilt" VALUE 0xF291A MSA15_FW3 0 ZEIT_ST 0.000000 655350000.000000 /end CHARACTERISTIC
/begin CHARACTERISTIC fbwEVDF_LT "#SSD VDF SRC unten  Zeit/Ereignisgesteuert, Loeschbar" VALUE 0xF291C MSA15_FW3 0 DEZ_DW_U 0.000000 65535.000000 /end CHARACTERISTIC
/begin CHARACTERISTIC fbwEVDF_PA "#SSD VDF  P-VDF im Leerlauf  Defekterkennungs-Zeit" VALUE 0xF292A MSA15_FW3 0 ZEIT_ST 0.000000 655350000.000000 /end CHARACTERISTIC
/begin CHARACTERISTIC fbwEVDF_PB "#SSD VDF  P-VDF im Leerlauf  Intakterkennungs-Zeit" VALUE 0xF292C MSA15_FW3 0 ZEIT_ST 0.000000 655350000.000000 /end CHARACTERISTIC
/begin CHARACTERISTIC fbwEVDF_PT "#SSD VDF  P-VDF im Leerlauf  zeit-/ereignisgesteuert, loeschbar" VALUE 0xF292E MSA15_FW3 0 DEZ_DW_U 0.000000 65535.000000 /end CHARACTERISTIC
/begin CHARACTERISTIC fbwEVDF_VA "VDF  Speisespannungsfehler  Defekterkennungs-Zeit" VALUE 0xF2924 MSA15_FW3 0 ZEIT_ST 0.000000 655350000.000000 /end CHARACTERISTIC
/begin CHARACTERISTIC fbwEVDF_VB "VDF  Speisespannungsfehler  Intakterkennungs-Zeit" VALUE 0xF2926 MSA15_FW3 0 ZEIT_ST 0.000000 655350000.000000 /end CHARACTERISTIC
/begin CHARACTERISTIC fbwEVDF_VT "VDF  Speisespannungsfehler  zeit-/ereignisgesteuert, loeschbar" VALUE 0xF2928 MSA15_FW3 0 DEZ_DW_U 0.000000 65535.000000 /end CHARACTERISTIC
/begin CHARACTERISTIC fbwEVDP_MA "VDP Mengenred. wegen P-VDF zu klein  Zeit bis endgueltig defekt" VALUE 0xF2952 MSA15_FW3 0 ZEIT_ST 0.000000 655350000.000000 /end CHARACTERISTIC
/begin CHARACTERISTIC fbwEVDP_MB "VDP Mengenred. wegen P-VDF zu klein  Zeit bis endgueltig geheilt" VALUE 0xF2954 MSA15_FW3 0 ZEIT_ST 0.000000 655350000.000000 /end CHARACTERISTIC
/begin CHARACTERISTIC fbwEVDP_MT "VDP Mengenred. wegen P-VDF zu klein  Zeit/Ereignisgesteuert, Loeschbar" VALUE 0xF2956 MSA15_FW3 0 DEZ_DW_U 0.000000 65535.000000 /end CHARACTERISTIC
/begin CHARACTERISTIC fbwEVDP_PA "VDP Abweichung P-VDF-Soll / P-VDF-Ist  Zeit bis endgueltig defekt" VALUE 0xF2958 MSA15_FW3 0 ZEIT_ST 0.000000 655350000.000000 /end CHARACTERISTIC
/begin CHARACTERISTIC fbwEVDP_PB "VDP Abweichung P-VDF-Soll / P-VDF-Ist  Zeit bis endgueltig geheilt" VALUE 0xF295A MSA15_FW3 0 ZEIT_ST 0.000000 655350000.000000 /end CHARACTERISTIC
/begin CHARACTERISTIC fbwEVDP_PT "VDP Abweichung P-VDF-Soll / P-VDF-Ist  Zeit/Ereignisgesteuert, Loeschbar" VALUE 0xF295C MSA15_FW3 0 DEZ_DW_U 0.000000 65535.000000 /end CHARACTERISTIC
/begin CHARACTERISTIC fbwEVDP_SA "VDP P-VDF unter Mindestwert fuer Start  Zeit bis endgueltig defekt" VALUE 0xF295E MSA15_FW3 0 ZEIT_ST 0.000000 655350000.000000 /end CHARACTERISTIC
/begin CHARACTERISTIC fbwEVDP_SB "VDP P-VDF unter Mindestwert fuer Start  Zeit bis endgueltig geheilt" VALUE 0xF2960 MSA15_FW3 0 ZEIT_ST 0.000000 655350000.000000 /end CHARACTERISTIC
/begin CHARACTERISTIC fbwEVDP_ST "VDP P-VDF unter Mindestwert fuer Start  Zeit/Ereignisgesteuert, Loeschbar" VALUE 0xF2962 MSA15_FW3 0 DEZ_DW_U 0.000000 65535.000000 /end CHARACTERISTIC
/begin CHARACTERISTIC fbwEWHI_00 "CARB  SRC_H-Ersatzwert fuer PID 00" VALUE 0xF3602 MSA15_FW3 0 DEZ_DW_U 0.000000 65535.000000 /end CHARACTERISTIC
/begin CHARACTERISTIC fbwEWHI_01 "CARB  SRC_H-Ersatzwert fuer PID 01" VALUE 0xF3604 MSA15_FW3 0 DEZ_DW_U 0.000000 65535.000000 /end CHARACTERISTIC
/begin CHARACTERISTIC fbwEWHI_02 "CARB  SRC_H-Ersatzwert fuer PID 02" VALUE 0xF3606 MSA15_FW3 0 DEZ_DW_U 0.000000 65535.000000 /end CHARACTERISTIC
/begin CHARACTERISTIC fbwEWHI_03 "CARB  SRC_H-Ersatzwert fuer PID 03" VALUE 0xF3608 MSA15_FW3 0 DEZ_DW_U 0.000000 65535.000000 /end CHARACTERISTIC
/begin CHARACTERISTIC fbwEWHI_04 "CARB  SRC_H-Ersatzwert fuer PID 04" VALUE 0xF360A MSA15_FW3 0 DEZ_DW_U 0.000000 65535.000000 /end CHARACTERISTIC
/begin CHARACTERISTIC fbwEWHI_05 "CARB  SRC_H-Ersatzwert fuer PID 05" VALUE 0xF360C MSA15_FW3 0 DEZ_DW_U 0.000000 65535.000000 /end CHARACTERISTIC
/begin CHARACTERISTIC fbwEWHI_06 "CARB  SRC_H-Ersatzwert fuer PID 06" VALUE 0xF360E MSA15_FW3 0 DEZ_DW_U 0.000000 65535.000000 /end CHARACTERISTIC
/begin CHARACTERISTIC fbwEWHI_07 "CARB  SRC_H-Ersatzwert fuer PID 07" VALUE 0xF3610 MSA15_FW3 0 DEZ_DW_U 0.000000 65535.000000 /end CHARACTERISTIC
/begin CHARACTERISTIC fbwEWHI_08 "CARB  SRC_H-Ersatzwert fuer PID 08" VALUE 0xF3612 MSA15_FW3 0 DEZ_DW_U 0.000000 65535.000000 /end CHARACTERISTIC
/begin CHARACTERISTIC fbwEWHI_09 "CARB  SRC_H-Ersatzwert fuer PID 09" VALUE 0xF3614 MSA15_FW3 0 DEZ_DW_U 0.000000 65535.000000 /end CHARACTERISTIC
/begin CHARACTERISTIC fbwEWHI_0A "CARB  SRC_H-Ersatzwert fuer PID 0A" VALUE 0xF3616 MSA15_FW3 0 DEZ_DW_U 0.000000 65535.000000 /end CHARACTERISTIC
/begin CHARACTERISTIC fbwEWHI_0B "CARB  SRC_H-Ersatzwert fuer PID 0B" VALUE 0xF3618 MSA15_FW3 0 DEZ_DW_U 0.000000 65535.000000 /end CHARACTERISTIC
/begin CHARACTERISTIC fbwEWHI_0C "CARB  SRC_H-Ersatzwert fuer PID 0C" VALUE 0xF361A MSA15_FW3 0 DEZ_DW_U 0.000000 65535.000000 /end CHARACTERISTIC
/begin CHARACTERISTIC fbwEWHI_0D "CARB  SRC_H-Ersatzwert fuer PID 0D" VALUE 0xF361C MSA15_FW3 0 DEZ_DW_U 0.000000 65535.000000 /end CHARACTERISTIC
/begin CHARACTERISTIC fbwEWHI_0E "CARB  SRC_H-Ersatzwert fuer PID 0E" VALUE 0xF361E MSA15_FW3 0 DEZ_DW_U 0.000000 65535.000000 /end CHARACTERISTIC
/begin CHARACTERISTIC fbwEWHI_0F "CARB  SRC_H-Ersatzwert fuer PID 0F" VALUE 0xF3620 MSA15_FW3 0 DEZ_DW_U 0.000000 65535.000000 /end CHARACTERISTIC
/begin CHARACTERISTIC fbwEWHI_10 "CARB  SRC_H-Ersatzwert fuer PID 10" VALUE 0xF3622 MSA15_FW3 0 DEZ_DW_U 0.000000 65535.000000 /end CHARACTERISTIC
/begin CHARACTERISTIC fbwEWHI_11 "CARB  SRC_H-Ersatzwert fuer PID 11" VALUE 0xF3624 MSA15_FW3 0 DEZ_DW_U 0.000000 65535.000000 /end CHARACTERISTIC
/begin CHARACTERISTIC fbwEWLO_00 "CARB  SRC_L-Ersatzwert fuer PID 00" VALUE 0xF35DE MSA15_FW3 0 DEZ_DW_U 0.000000 65535.000000 /end CHARACTERISTIC
/begin CHARACTERISTIC fbwEWLO_01 "CARB  SRC_L-Ersatzwert fuer PID 01" VALUE 0xF35E0 MSA15_FW3 0 DEZ_DW_U 0.000000 65535.000000 /end CHARACTERISTIC
/begin CHARACTERISTIC fbwEWLO_02 "CARB  SRC_L-Ersatzwert fuer PID 02" VALUE 0xF35E2 MSA15_FW3 0 DEZ_DW_U 0.000000 65535.000000 /end CHARACTERISTIC
/begin CHARACTERISTIC fbwEWLO_03 "CARB  SRC_L-Ersatzwert fuer PID 03" VALUE 0xF35E4 MSA15_FW3 0 DEZ_DW_U 0.000000 65535.000000 /end CHARACTERISTIC
/begin CHARACTERISTIC fbwEWLO_04 "CARB  SRC_L-Ersatzwert fuer PID 04" VALUE 0xF35E6 MSA15_FW3 0 DEZ_DW_U 0.000000 65535.000000 /end CHARACTERISTIC
/begin CHARACTERISTIC fbwEWLO_05 "CARB  SRC_L-Ersatzwert fuer PID 05" VALUE 0xF35E8 MSA15_FW3 0 DEZ_DW_U 0.000000 65535.000000 /end CHARACTERISTIC
/begin CHARACTERISTIC fbwEWLO_06 "CARB  SRC_L-Ersatzwert fuer PID 06" VALUE 0xF35EA MSA15_FW3 0 DEZ_DW_U 0.000000 65535.000000 /end CHARACTERISTIC
/begin CHARACTERISTIC fbwEWLO_07 "CARB  SRC_L-Ersatzwert fuer PID 07" VALUE 0xF35EC MSA15_FW3 0 DEZ_DW_U 0.000000 65535.000000 /end CHARACTERISTIC
/begin CHARACTERISTIC fbwEWLO_08 "CARB  SRC_L-Ersatzwert fuer PID 08" VALUE 0xF35EE MSA15_FW3 0 DEZ_DW_U 0.000000 65535.000000 /end CHARACTERISTIC
/begin CHARACTERISTIC fbwEWLO_09 "CARB  SRC_L-Ersatzwert fuer PID 09" VALUE 0xF35F0 MSA15_FW3 0 DEZ_DW_U 0.000000 65535.000000 /end CHARACTERISTIC
/begin CHARACTERISTIC fbwEWLO_0A "CARB  SRC_L-Ersatzwert fuer PID 0A" VALUE 0xF35F2 MSA15_FW3 0 DEZ_DW_U 0.000000 65535.000000 /end CHARACTERISTIC
/begin CHARACTERISTIC fbwEWLO_0B "CARB  SRC_L-Ersatzwert fuer PID 0B" VALUE 0xF35F4 MSA15_FW3 0 DEZ_DW_U 0.000000 65535.000000 /end CHARACTERISTIC
/begin CHARACTERISTIC fbwEWLO_0C "CARB  SRC_L-Ersatzwert fuer PID 0C" VALUE 0xF35F6 MSA15_FW3 0 DEZ_DW_U 0.000000 65535.000000 /end CHARACTERISTIC
/begin CHARACTERISTIC fbwEWLO_0D "CARB  SRC_L-Ersatzwert fuer PID 0D" VALUE 0xF35F8 MSA15_FW3 0 DEZ_DW_U 0.000000 65535.000000 /end CHARACTERISTIC
/begin CHARACTERISTIC fbwEWLO_0E "CARB  SRC_L-Ersatzwert fuer PID 0E" VALUE 0xF35FA MSA15_FW3 0 DEZ_DW_U 0.000000 65535.000000 /end CHARACTERISTIC
/begin CHARACTERISTIC fbwEWLO_0F "CARB  SRC_L-Ersatzwert fuer PID 0F" VALUE 0xF35FC MSA15_FW3 0 DEZ_DW_U 0.000000 65535.000000 /end CHARACTERISTIC
/begin CHARACTERISTIC fbwEWLO_10 "CARB  SRC_L-Ersatzwert fuer PID 10" VALUE 0xF35FE MSA15_FW3 0 DEZ_DW_U 0.000000 65535.000000 /end CHARACTERISTIC
/begin CHARACTERISTIC fbwEWLO_11 "CARB  SRC_L-Ersatzwert fuer PID 11" VALUE 0xF3600 MSA15_FW3 0 DEZ_DW_U 0.000000 65535.000000 /end CHARACTERISTIC
/begin CHARACTERISTIC fbwEWTF_HA "WTF  oberer  SRC  Defekterkennungs-Zeit" VALUE 0xF28BC MSA15_FW3 0 ZEIT_ST 0.000000 655350000.000000 /end CHARACTERISTIC
/begin CHARACTERISTIC fbwEWTF_HB "WTF  oberer  SRC  Intakterkennungs-Zeit" VALUE 0xF28BE MSA15_FW3 0 ZEIT_ST 0.000000 655350000.000000 /end CHARACTERISTIC
/begin CHARACTERISTIC fbwEWTF_HT "WTF  oberer  SRC  zeit-/ereignisgesteuert, loeschbar" VALUE 0xF28C0 MSA15_FW3 0 DEZ_DW_U 0.000000 65535.000000 /end CHARACTERISTIC
/begin CHARACTERISTIC fbwEWTF_LA "WTF  unterer SRC  Defekterkennungs-Zeit" VALUE 0xF28B6 MSA15_FW3 0 ZEIT_ST 0.000000 655350000.000000 /end CHARACTERISTIC
/begin CHARACTERISTIC fbwEWTF_LB "WTF  unterer SRC  Intakterkennungs-Zeit" VALUE 0xF28B8 MSA15_FW3 0 ZEIT_ST 0.000000 655350000.000000 /end CHARACTERISTIC
/begin CHARACTERISTIC fbwEWTF_LT "WTF  unterer SRC  zeit-/ereignisgesteuert, loeschbar" VALUE 0xF28BA MSA15_FW3 0 DEZ_DW_U 0.000000 65535.000000 /end CHARACTERISTIC
/begin CHARACTERISTIC fbwEWTF_SA "WTF  Betriebstemp.  Defekterkennungs-Zeit" VALUE 0xF28C2 MSA15_FW3 0 DEZ_DW_U 0.000000 65535.000000 /end CHARACTERISTIC
/begin CHARACTERISTIC fbwEWTF_SB "WTF  Betriebstemp.  Intakterkennungs-Zeit" VALUE 0xF28C4 MSA15_FW3 0 DEZ_DW_U 0.000000 65535.000000 /end CHARACTERISTIC
/begin CHARACTERISTIC fbwEWTF_ST "WTF  Betriebstemp.  zeit-/ereignisgesteuert, loeschbar" VALUE 0xF28C6 MSA15_FW3 0 DEZ_DW_U 0.000000 65535.000000 /end CHARACTERISTIC
/begin CHARACTERISTIC fbwEZHR_KA "ZHR  Kurzschluss  Defekterkennungs-Zeit" VALUE 0xF2E86 MSA15_FW3 0 ZEIT_ST 0.000000 655350000.000000 /end CHARACTERISTIC
/begin CHARACTERISTIC fbwEZHR_KB "ZHR  Kurzschluss  Intakterkennungs-Zeit" VALUE 0xF2E88 MSA15_FW3 0 ZEIT_ST 0.000000 655350000.000000 /end CHARACTERISTIC
/begin CHARACTERISTIC fbwEZHR_KT "ZHR  Kurzschluss  zeit-/ereignisgesteuert, loeschbar" VALUE 0xF2E8A MSA15_FW3 0 DEZ_DW_U 0.000000 65535.000000 /end CHARACTERISTIC
/begin CHARACTERISTIC fbwEZHR_OA "ZHR  Leerlauf  Defekterkennungs-Zeit" VALUE 0xF2E8C MSA15_FW3 0 ZEIT_ST 0.000000 655350000.000000 /end CHARACTERISTIC
/begin CHARACTERISTIC fbwEZHR_OB "ZHR  Leerlauf  Intakterkennungs-Zeit" VALUE 0xF2E8E MSA15_FW3 0 ZEIT_ST 0.000000 655350000.000000 /end CHARACTERISTIC
/begin CHARACTERISTIC fbwEZHR_OT "ZHR  Leerlauf  zeit-/ereignisgesteuert, loeschbar" VALUE 0xF2E90 MSA15_FW3 0 DEZ_DW_U 0.000000 65535.000000 /end CHARACTERISTIC
/begin CHARACTERISTIC fbwFFRM_01 "DIAG FreezeFrame Umweltbedingung 01" VALUE 0xF3434 MSA15_FW3 0 DEZ_DW_U 0.000000 65535.000000 /end CHARACTERISTIC
/begin CHARACTERISTIC fbwFFRM_02 "FreezeFrame Umweltbedingung 02" VALUE 0xF3436 MSA15_FW3 0 DEZ_DW_U 0.000000 65535.000000 /end CHARACTERISTIC
/begin CHARACTERISTIC fbwFFRM_03 "FreezeFrame Umweltbedingung 03" VALUE 0xF3438 MSA15_FW3 0 DEZ_DW_U 0.000000 65535.000000 /end CHARACTERISTIC
/begin CHARACTERISTIC fbwFFRM_04 "FreezeFrame Umweltbedingung 04" VALUE 0xF343A MSA15_FW3 0 DEZ_DW_U 0.000000 65535.000000 /end CHARACTERISTIC
/begin CHARACTERISTIC fbwFFRM_05 "FreezeFrame Umweltbedingung 05" VALUE 0xF343C MSA15_FW3 0 DEZ_DW_U 0.000000 65535.000000 /end CHARACTERISTIC
/begin CHARACTERISTIC fbwFFRM_06 "FreezeFrame Umweltbedingung 06" VALUE 0xF343E MSA15_FW3 0 DEZ_DW_U 0.000000 65535.000000 /end CHARACTERISTIC
/begin CHARACTERISTIC fbwFFRM_07 "FreezeFrame Umweltbedingung 07" VALUE 0xF3440 MSA15_FW3 0 DEZ_DW_U 0.000000 65535.000000 /end CHARACTERISTIC
/begin CHARACTERISTIC fbwFFRM_08 "FreezeFrame Umweltbedingung 08" VALUE 0xF3442 MSA15_FW3 0 DEZ_DW_U 0.000000 65535.000000 /end CHARACTERISTIC
/begin CHARACTERISTIC fbwFFRM_09 "FreezeFrame Umweltbedingung 09" VALUE 0xF3444 MSA15_FW3 0 DEZ_DW_U 0.000000 65535.000000 /end CHARACTERISTIC
/begin CHARACTERISTIC fbwFFRM_10 "FreezeFrame Umweltbedingung 10" VALUE 0xF3446 MSA15_FW3 0 DEZ_DW_U 0.000000 65535.000000 /end CHARACTERISTIC
/begin CHARACTERISTIC fbwFFRM_11 "FreezeFrame Umweltbedingung 11" VALUE 0xF3448 MSA15_FW3 0 DEZ_DW_U 0.000000 65535.000000 /end CHARACTERISTIC
/begin CHARACTERISTIC fbwFFRM_12 "FreezeFrame Umweltbedingung 12" VALUE 0xF344A MSA15_FW3 0 DEZ_DW_U 0.000000 65535.000000 /end CHARACTERISTIC
/begin CHARACTERISTIC fbwFFRM_13 "FreezeFrame Umweltbedingung 13" VALUE 0xF344C MSA15_FW3 0 DEZ_DW_U 0.000000 65535.000000 /end CHARACTERISTIC
/begin CHARACTERISTIC fbwFFRM_14 "FreezeFrame Umweltbedingung 14" VALUE 0xF344E MSA15_FW3 0 DEZ_DW_U 0.000000 65535.000000 /end CHARACTERISTIC
/begin CHARACTERISTIC fbwFFRM_15 "FreezeFrame Umweltbedingung 15" VALUE 0xF3450 MSA15_FW3 0 DEZ_DW_U 0.000000 65535.000000 /end CHARACTERISTIC
/begin CHARACTERISTIC fbwFFRM_16 "FreezeFrame Umweltbedingung 16" VALUE 0xF3452 MSA15_FW3 0 DEZ_DW_U 0.000000 65535.000000 /end CHARACTERISTIC
/begin CHARACTERISTIC fbwFFRM_17 "FreezeFrame Umweltbedingung 17" VALUE 0xF3454 MSA15_FW3 0 DEZ_DW_U 0.000000 65535.000000 /end CHARACTERISTIC
/begin CHARACTERISTIC fbwFFRM_18 "FreezeFrame Umweltbedingung 18" VALUE 0xF3456 MSA15_FW3 0 DEZ_DW_U 0.000000 65535.000000 /end CHARACTERISTIC
/begin CHARACTERISTIC fbwFFRM_19 "FreezeFrame Umweltbedingung 19" VALUE 0xF3458 MSA15_FW3 0 DEZ_DW_U 0.000000 65535.000000 /end CHARACTERISTIC
/begin CHARACTERISTIC fbwFFRM_20 "FreezeFrame Umweltbedingung 20" VALUE 0xF345A MSA15_FW3 0 DEZ_DW_U 0.000000 65535.000000 /end CHARACTERISTIC
/begin CHARACTERISTIC fbwKMBS_UB "Umweltbedienung Schalter 0 -> Betriebstundenzaehler, 1 -> KM-Stand als Umweltbed" VALUE 0xF3732 MSA15_FW1 0 DEZ_DW_U 0.000000 255.000000 EXTENDED_LIMITS 0.000000 65535.000000 /end CHARACTERISTIC
/begin CHARACTERISTIC fbwPIDPF00 "CARB Pfadnr. fuer PID 00" VALUE 0xF35BA MSA15_FW3 0 DEZ_DW_U 0.000000 65535.000000 /end CHARACTERISTIC
/begin CHARACTERISTIC fbwPIDPF01 "CARB Pfadnr. fuer PID 01" VALUE 0xF35BC MSA15_FW3 0 DEZ_DW_U 0.000000 65535.000000 /end CHARACTERISTIC
/begin CHARACTERISTIC fbwPIDPF02 "CARB Pfadnr. fuer PID 02" VALUE 0xF35BE MSA15_FW3 0 DEZ_DW_U 0.000000 65535.000000 /end CHARACTERISTIC
/begin CHARACTERISTIC fbwPIDPF03 "CARB Pfadnr. fuer PID 03" VALUE 0xF35C0 MSA15_FW3 0 DEZ_DW_U 0.000000 65535.000000 /end CHARACTERISTIC
/begin CHARACTERISTIC fbwPIDPF04 "CARB Pfadnr. fuer PID 04" VALUE 0xF35C2 MSA15_FW3 0 DEZ_DW_U 0.000000 65535.000000 /end CHARACTERISTIC
/begin CHARACTERISTIC fbwPIDPF05 "CARB Pfadnr. fuer PID 05" VALUE 0xF35C4 MSA15_FW3 0 DEZ_DW_U 0.000000 65535.000000 /end CHARACTERISTIC
/begin CHARACTERISTIC fbwPIDPF06 "CARB Pfadnr. fuer PID 06" VALUE 0xF35C6 MSA15_FW3 0 DEZ_DW_U 0.000000 65535.000000 /end CHARACTERISTIC
/begin CHARACTERISTIC fbwPIDPF07 "CARB Pfadnr. fuer PID 07" VALUE 0xF35C8 MSA15_FW3 0 DEZ_DW_U 0.000000 65535.000000 /end CHARACTERISTIC
/begin CHARACTERISTIC fbwPIDPF08 "CARB Pfadnr. fuer PID 08" VALUE 0xF35CA MSA15_FW3 0 DEZ_DW_U 0.000000 65535.000000 /end CHARACTERISTIC
/begin CHARACTERISTIC fbwPIDPF09 "CARB Pfadnr. fuer PID 09" VALUE 0xF35CC MSA15_FW3 0 DEZ_DW_U 0.000000 65535.000000 /end CHARACTERISTIC
/begin CHARACTERISTIC fbwPIDPF0A "CARB Pfadnr. fuer PID 0A" VALUE 0xF35CE MSA15_FW3 0 DEZ_DW_U 0.000000 65535.000000 /end CHARACTERISTIC
/begin CHARACTERISTIC fbwPIDPF0B "CARB Pfadnr. fuer PID 0B" VALUE 0xF35D0 MSA15_FW3 0 DEZ_DW_U 0.000000 65535.000000 /end CHARACTERISTIC
/begin CHARACTERISTIC fbwPIDPF0C "CARB Pfadnr. fuer PID 0C" VALUE 0xF35D2 MSA15_FW3 0 DEZ_DW_U 0.000000 65535.000000 /end CHARACTERISTIC
/begin CHARACTERISTIC fbwPIDPF0D "CARB Pfadnr. fuer PID 0D" VALUE 0xF35D4 MSA15_FW3 0 DEZ_DW_U 0.000000 65535.000000 /end CHARACTERISTIC
/begin CHARACTERISTIC fbwPIDPF0E "CARB Pfadnr. fuer PID 0E" VALUE 0xF35D6 MSA15_FW3 0 DEZ_DW_U 0.000000 65535.000000 /end CHARACTERISTIC
/begin CHARACTERISTIC fbwPIDPF0F "CARB Pfadnr. fuer PID 0F" VALUE 0xF35D8 MSA15_FW3 0 DEZ_DW_U 0.000000 65535.000000 /end CHARACTERISTIC
/begin CHARACTERISTIC fbwPIDPF10 "CARB Pfadnr. fuer PID 10" VALUE 0xF35DA MSA15_FW3 0 DEZ_DW_U 0.000000 65535.000000 /end CHARACTERISTIC
/begin CHARACTERISTIC fbwPIDPF11 "CARB Pfadnr. fuer PID 11" VALUE 0xF35DC MSA15_FW3 0 DEZ_DW_U 0.000000 65535.000000 /end CHARACTERISTIC
/begin CHARACTERISTIC fbwSADFBCO "ADF  Blinkcode" VALUE 0xF2B20 MSA15_FW3 0 DEZ_DW_U 0.000000 65535.000000 /end CHARACTERISTIC
/begin CHARACTERISTIC fbwSADFCC0 "ADF  CARB Speichercode Bit 0" VALUE 0xF2B22 MSA15_FW3 0 DEZ_DW_U 0.000000 65535.000000 /end CHARACTERISTIC
/begin CHARACTERISTIC fbwSADFCC1 "ADF  CARB Speichercode Bit 1" VALUE 0xF2B24 MSA15_FW3 0 DEZ_DW_U 0.000000 65535.000000 /end CHARACTERISTIC
/begin CHARACTERISTIC fbwSADFCC2 "ADF  CARB Speichercode Bit 2" VALUE 0xF2B26 MSA15_FW3 0 DEZ_DW_U 0.000000 65535.000000 /end CHARACTERISTIC
/begin CHARACTERISTIC fbwSADFCC3 "ADF  CARB Speichercode Bit 3" VALUE 0xF2B28 MSA15_FW3 0 DEZ_DW_U 0.000000 65535.000000 /end CHARACTERISTIC
/begin CHARACTERISTIC fbwSADFCC4 "ADF  CARB Speichercode Bit 4" VALUE 0xF2B2A MSA15_FW3 0 DEZ_DW_U 0.000000 65535.000000 /end CHARACTERISTIC
/begin CHARACTERISTIC fbwSADFCC5 "ADF  CARB Speichercode Bit 5" VALUE 0xF2B2C MSA15_FW3 0 DEZ_DW_U 0.000000 65535.000000 /end CHARACTERISTIC
/begin CHARACTERISTIC fbwSADFCC6 "ADF  CARB Speichercode Bit 6" VALUE 0xF2B2E MSA15_FW3 0 DEZ_DW_U 0.000000 65535.000000 /end CHARACTERISTIC
/begin CHARACTERISTIC fbwSADFCC7 "ADF  CARB Speichercode Bit 7" VALUE 0xF2B30 MSA15_FW3 0 DEZ_DW_U 0.000000 65535.000000 /end CHARACTERISTIC
/begin CHARACTERISTIC fbwSADFENT "ADF  Entrprellmodus" VALUE 0xF2B1D MSA15_FW1 0 DEZ_DB_U 0.000000 255.000000 /end CHARACTERISTIC
/begin CHARACTERISTIC fbwSADFFLC "ADF  Startwert Eintragzaehler" VALUE 0xF2B1E MSA15_FW1 0 DEZ_DB_U 0.000000 255.000000 /end CHARACTERISTIC
/begin CHARACTERISTIC fbwSADFHLC "ADF  Startwert Heilungszaehler" VALUE 0xF2B1F MSA15_FW1 0 DEZ_DB_U 0.000000 255.000000 /end CHARACTERISTIC
/begin CHARACTERISTIC fbwSADFPRI "ADF  Prioritaet" VALUE 0xF2B1C MSA15_FW1 0 DEZ_DB_U 0.000000 3.000000 EXTENDED_LIMITS 0.000000 255.000000 /end CHARACTERISTIC
/begin CHARACTERISTIC fbwSADFSPC "ADF  Code fuer Fehlerspeicherung" VALUE 0xF2B1A MSA15_FW3 0 DEZ_DW_U 0.000000 65535.000000 /end CHARACTERISTIC
/begin CHARACTERISTIC fbwSADFUB1 "ADF Umweltbedingung 1 fuer Fehlerspeicherung" VALUE 0xF2B32 MSA15_FW3 0 DEZ_DW_U 0.000000 65535.000000 /end CHARACTERISTIC
/begin CHARACTERISTIC fbwSADFUB2 "ADF Umweltbedingung 2 fuer Fehlerspeicherung" VALUE 0xF2B34 MSA15_FW3 0 DEZ_DW_U 0.000000 65535.000000 /end CHARACTERISTIC
/begin CHARACTERISTIC fbwSADFUB3 "ADF Umweltbedingung 3 fuer Fehlerspeicherung" VALUE 0xF2B36 MSA15_FW3 0 DEZ_DW_U 0.000000 65535.000000 /end CHARACTERISTIC
/begin CHARACTERISTIC fbwSADFUB4 "ADF Umweltbedingung 4 fuer Fehlerspeicherung" VALUE 0xF2B38 MSA15_FW3 0 DEZ_DW_U 0.000000 65535.000000 /end CHARACTERISTIC
/begin CHARACTERISTIC fbwSAKSBCO "AKS  Blinkcode" VALUE 0xF2F28 MSA15_FW3 0 DEZ_DW_U 0.000000 65535.000000 /end CHARACTERISTIC
/begin CHARACTERISTIC fbwSAKSCC0 "AKS  CARB Speichercode Bit 0" VALUE 0xF2F2A MSA15_FW3 0 DEZ_DW_U 0.000000 65535.000000 /end CHARACTERISTIC
/begin CHARACTERISTIC fbwSAKSCC1 "AKS  CARB Speichercode Bit 1" VALUE 0xF2F2C MSA15_FW3 0 DEZ_DW_U 0.000000 65535.000000 /end CHARACTERISTIC
/begin CHARACTERISTIC fbwSAKSCC2 "AKS  CARB Speichercode Bit 2" VALUE 0xF2F2E MSA15_FW3 0 DEZ_DW_U 0.000000 65535.000000 /end CHARACTERISTIC
/begin CHARACTERISTIC fbwSAKSCC3 "AKS  CARB Speichercode Bit 3" VALUE 0xF2F30 MSA15_FW3 0 DEZ_DW_U 0.000000 65535.000000 /end CHARACTERISTIC
/begin CHARACTERISTIC fbwSAKSCC4 "AKS  CARB Speichercode Bit 4" VALUE 0xF2F32 MSA15_FW3 0 DEZ_DW_U 0.000000 65535.000000 /end CHARACTERISTIC
/begin CHARACTERISTIC fbwSAKSCC5 "AKS  CARB Speichercode Bit 5" VALUE 0xF2F34 MSA15_FW3 0 DEZ_DW_U 0.000000 65535.000000 /end CHARACTERISTIC
/begin CHARACTERISTIC fbwSAKSCC6 "AKS  CARB Speichercode Bit 6" VALUE 0xF2F36 MSA15_FW3 0 DEZ_DW_U 0.000000 65535.000000 /end CHARACTERISTIC
/begin CHARACTERISTIC fbwSAKSCC7 "AKS  CARB Speichercode Bit 7" VALUE 0xF2F38 MSA15_FW3 0 DEZ_DW_U 0.000000 65535.000000 /end CHARACTERISTIC
/begin CHARACTERISTIC fbwSAKSENT "AKS  Entrprellmodus" VALUE 0xF2F25 MSA15_FW1 0 DEZ_DB_U 0.000000 255.000000 /end CHARACTERISTIC
/begin CHARACTERISTIC fbwSAKSFLC "AKS  Startwert Eintragzaehler" VALUE 0xF2F26 MSA15_FW1 0 DEZ_DB_U 0.000000 255.000000 /end CHARACTERISTIC
/begin CHARACTERISTIC fbwSAKSHLC "AKS  Startwert Heilungszaehler" VALUE 0xF2F27 MSA15_FW1 0 DEZ_DB_U 0.000000 255.000000 /end CHARACTERISTIC
/begin CHARACTERISTIC fbwSAKSPRI "AKS  Prioritaet" VALUE 0xF2F24 MSA15_FW1 0 DEZ_DB_U 0.000000 3.000000 EXTENDED_LIMITS 0.000000 255.000000 /end CHARACTERISTIC
/begin CHARACTERISTIC fbwSAKSSPC "AKS  Code fuer Fehlerspeicherung" VALUE 0xF2F22 MSA15_FW3 0 DEZ_DW_U 0.000000 65535.000000 /end CHARACTERISTIC
/begin CHARACTERISTIC fbwSAKSUB1 "AKS Umweltbedingung 1 fuer Fehlerspeicherung" VALUE 0xF2F3A MSA15_FW3 0 DEZ_DW_U 0.000000 65535.000000 /end CHARACTERISTIC
/begin CHARACTERISTIC fbwSAKSUB2 "AKS Umweltbedingung 2 fuer Fehlerspeicherung" VALUE 0xF2F3C MSA15_FW3 0 DEZ_DW_U 0.000000 65535.000000 /end CHARACTERISTIC
/begin CHARACTERISTIC fbwSAKSUB3 "AKS Umweltbedingung 3 fuer Fehlerspeicherung" VALUE 0xF2F3E MSA15_FW3 0 DEZ_DW_U 0.000000 65535.000000 /end CHARACTERISTIC
/begin CHARACTERISTIC fbwSAKSUB4 "AKS Umweltbedingung 4 fuer Fehlerspeicherung" VALUE 0xF2F40 MSA15_FW3 0 DEZ_DW_U 0.000000 65535.000000 /end CHARACTERISTIC
/begin CHARACTERISTIC fbwSARSBCO "ARS  Blinkcode" VALUE 0xF2D28 MSA15_FW3 0 DEZ_DW_U 0.000000 65535.000000 /end CHARACTERISTIC
/begin CHARACTERISTIC fbwSARSCC0 "ARS  CARB Speichercode Bit 0" VALUE 0xF2D2A MSA15_FW3 0 DEZ_DW_U 0.000000 65535.000000 /end CHARACTERISTIC
/begin CHARACTERISTIC fbwSARSCC1 "ARS  CARB Speichercode Bit 1" VALUE 0xF2D2C MSA15_FW3 0 DEZ_DW_U 0.000000 65535.000000 /end CHARACTERISTIC
/begin CHARACTERISTIC fbwSARSCC2 "ARS  CARB Speichercode Bit 2" VALUE 0xF2D2E MSA15_FW3 0 DEZ_DW_U 0.000000 65535.000000 /end CHARACTERISTIC
/begin CHARACTERISTIC fbwSARSCC3 "ARS  CARB Speichercode Bit 3" VALUE 0xF2D30 MSA15_FW3 0 DEZ_DW_U 0.000000 65535.000000 /end CHARACTERISTIC
/begin CHARACTERISTIC fbwSARSCC4 "ARS  CARB Speichercode Bit 4" VALUE 0xF2D32 MSA15_FW3 0 DEZ_DW_U 0.000000 65535.000000 /end CHARACTERISTIC
/begin CHARACTERISTIC fbwSARSCC5 "ARS  CARB Speichercode Bit 5" VALUE 0xF2D34 MSA15_FW3 0 DEZ_DW_U 0.000000 65535.000000 /end CHARACTERISTIC
/begin CHARACTERISTIC fbwSARSCC6 "ARS  CARB Speichercode Bit 6" VALUE 0xF2D36 MSA15_FW3 0 DEZ_DW_U 0.000000 65535.000000 /end CHARACTERISTIC
/begin CHARACTERISTIC fbwSARSCC7 "ARS  CARB Speichercode Bit 7" VALUE 0xF2D38 MSA15_FW3 0 DEZ_DW_U 0.000000 65535.000000 /end CHARACTERISTIC
/begin CHARACTERISTIC fbwSARSENT "ARS  Entrprellmodus" VALUE 0xF2D25 MSA15_FW1 0 DEZ_DB_U 0.000000 255.000000 /end CHARACTERISTIC
/begin CHARACTERISTIC fbwSARSFLC "ARS  Startwert Eintragzaehler" VALUE 0xF2D26 MSA15_FW1 0 DEZ_DB_U 0.000000 255.000000 /end CHARACTERISTIC
/begin CHARACTERISTIC fbwSARSHLC "ARS  Startwert Heilungszaehler" VALUE 0xF2D27 MSA15_FW1 0 DEZ_DB_U 0.000000 255.000000 /end CHARACTERISTIC
/begin CHARACTERISTIC fbwSARSPRI "ARS  Prioritaet" VALUE 0xF2D24 MSA15_FW1 0 DEZ_DB_U 0.000000 3.000000 EXTENDED_LIMITS 0.000000 255.000000 /end CHARACTERISTIC
/begin CHARACTERISTIC fbwSARSSPC "ARS  Code fuer Fehlerspeicherung" VALUE 0xF2D22 MSA15_FW3 0 DEZ_DW_U 0.000000 65535.000000 /end CHARACTERISTIC
/begin CHARACTERISTIC fbwSARSUB1 "ARS Umweltbedingung 1 fuer Fehlerspeicherung" VALUE 0xF2D3A MSA15_FW3 0 DEZ_DW_U 0.000000 65535.000000 /end CHARACTERISTIC
/begin CHARACTERISTIC fbwSARSUB2 "ARS Umweltbedingung 2 fuer Fehlerspeicherung" VALUE 0xF2D3C MSA15_FW3 0 DEZ_DW_U 0.000000 65535.000000 /end CHARACTERISTIC
/begin CHARACTERISTIC fbwSARSUB3 "ARS Umweltbedingung 3 fuer Fehlerspeicherung" VALUE 0xF2D3E MSA15_FW3 0 DEZ_DW_U 0.000000 65535.000000 /end CHARACTERISTIC
/begin CHARACTERISTIC fbwSARSUB4 "ARS Umweltbedingung 4 fuer Fehlerspeicherung" VALUE 0xF2D40 MSA15_FW3 0 DEZ_DW_U 0.000000 65535.000000 /end CHARACTERISTIC
/begin CHARACTERISTIC fbwSASKBCO "ASK  Blinkcode" VALUE 0xF2E0E MSA15_FW3 0 DEZ_DW_U 0.000000 65535.000000 /end CHARACTERISTIC
/begin CHARACTERISTIC fbwSASKCC0 "ASK  CARB Speichercode Bit 0" VALUE 0xF2E10 MSA15_FW3 0 DEZ_DW_U 0.000000 65535.000000 /end CHARACTERISTIC
/begin CHARACTERISTIC fbwSASKCC1 "ASK  CARB Speichercode Bit 1" VALUE 0xF2E12 MSA15_FW3 0 DEZ_DW_U 0.000000 65535.000000 /end CHARACTERISTIC
/begin CHARACTERISTIC fbwSASKCC2 "ASK  CARB Speichercode Bit 2" VALUE 0xF2E14 MSA15_FW3 0 DEZ_DW_U 0.000000 65535.000000 /end CHARACTERISTIC
/begin CHARACTERISTIC fbwSASKCC3 "ASK  CARB Speichercode Bit 3" VALUE 0xF2E16 MSA15_FW3 0 DEZ_DW_U 0.000000 65535.000000 /end CHARACTERISTIC
/begin CHARACTERISTIC fbwSASKCC4 "ASK  CARB Speichercode Bit 4" VALUE 0xF2E18 MSA15_FW3 0 DEZ_DW_U 0.000000 65535.000000 /end CHARACTERISTIC
/begin CHARACTERISTIC fbwSASKCC5 "ASK  CARB Speichercode Bit 5" VALUE 0xF2E1A MSA15_FW3 0 DEZ_DW_U 0.000000 65535.000000 /end CHARACTERISTIC
/begin CHARACTERISTIC fbwSASKCC6 "ASK  CARB Speichercode Bit 6" VALUE 0xF2E1C MSA15_FW3 0 DEZ_DW_U 0.000000 65535.000000 /end CHARACTERISTIC
/begin CHARACTERISTIC fbwSASKCC7 "ASK  CARB Speichercode Bit 7" VALUE 0xF2E1E MSA15_FW3 0 DEZ_DW_U 0.000000 65535.000000 /end CHARACTERISTIC
/begin CHARACTERISTIC fbwSASKENT "ASK  Entrprellmodus" VALUE 0xF2E0B MSA15_FW1 0 DEZ_DB_U 0.000000 255.000000 /end CHARACTERISTIC
/begin CHARACTERISTIC fbwSASKFLC "ASK  Startwert Eintragzaehler" VALUE 0xF2E0C MSA15_FW1 0 DEZ_DB_U 0.000000 255.000000 /end CHARACTERISTIC
/begin CHARACTERISTIC fbwSASKHLC "ASK  Startwert Heilungszaehler" VALUE 0xF2E0D MSA15_FW1 0 DEZ_DB_U 0.000000 255.000000 /end CHARACTERISTIC
/begin CHARACTERISTIC fbwSASKPRI "ASK  Prioritaet" VALUE 0xF2E0A MSA15_FW1 0 DEZ_DB_U 0.000000 3.000000 EXTENDED_LIMITS 0.000000 255.000000 /end CHARACTERISTIC
/begin CHARACTERISTIC fbwSASKSPC "ASK  Code fuer Fehlerspeicherung" VALUE 0xF2E08 MSA15_FW3 0 DEZ_DW_U 0.000000 65535.000000 /end CHARACTERISTIC
/begin CHARACTERISTIC fbwSASKUB1 "ASK Umweltbedingung 1 fuer Fehlerspeicherung" VALUE 0xF2E20 MSA15_FW3 0 DEZ_DW_U 0.000000 65535.000000 /end CHARACTERISTIC
/begin CHARACTERISTIC fbwSASKUB2 "ASK Umweltbedingung 2 fuer Fehlerspeicherung" VALUE 0xF2E22 MSA15_FW3 0 DEZ_DW_U 0.000000 65535.000000 /end CHARACTERISTIC
/begin CHARACTERISTIC fbwSASKUB3 "ASK Umweltbedingung 3 fuer Fehlerspeicherung" VALUE 0xF2E24 MSA15_FW3 0 DEZ_DW_U 0.000000 65535.000000 /end CHARACTERISTIC
/begin CHARACTERISTIC fbwSASKUB4 "ASK Umweltbedingung 4 fuer Fehlerspeicherung" VALUE 0xF2E26 MSA15_FW3 0 DEZ_DW_U 0.000000 65535.000000 /end CHARACTERISTIC
/begin CHARACTERISTIC fbwSASKUB5 "ASK Umweltbedingung 5 fuer Fehlerspeicherung" VALUE 0xF2E28 MSA15_FW3 0 DEZ_DW_U 0.000000 65535.000000 /end CHARACTERISTIC
/begin CHARACTERISTIC fbwSAT1BCO "AT1  Blinkcode" VALUE 0xF29FA MSA15_FW3 0 DEZ_DW_U 0.000000 65535.000000 /end CHARACTERISTIC
/begin CHARACTERISTIC fbwSAT1CC0 "AT1  CARB Speichercode Bit 0" VALUE 0xF29FC MSA15_FW3 0 DEZ_DW_U 0.000000 65535.000000 /end CHARACTERISTIC
/begin CHARACTERISTIC fbwSAT1CC1 "AT1  CARB Speichercode Bit 1" VALUE 0xF29FE MSA15_FW3 0 DEZ_DW_U 0.000000 65535.000000 /end CHARACTERISTIC
/begin CHARACTERISTIC fbwSAT1CC2 "AT1  CARB Speichercode Bit 2" VALUE 0xF2A00 MSA15_FW3 0 DEZ_DW_U 0.000000 65535.000000 /end CHARACTERISTIC
/begin CHARACTERISTIC fbwSAT1CC3 "AT1  CARB Speichercode Bit 3" VALUE 0xF2A02 MSA15_FW3 0 DEZ_DW_U 0.000000 65535.000000 /end CHARACTERISTIC
/begin CHARACTERISTIC fbwSAT1CC4 "AT1  CARB Speichercode Bit 4" VALUE 0xF2A04 MSA15_FW3 0 DEZ_DW_U 0.000000 65535.000000 /end CHARACTERISTIC
/begin CHARACTERISTIC fbwSAT1CC5 "AT1  CARB Speichercode Bit 5" VALUE 0xF2A06 MSA15_FW3 0 DEZ_DW_U 0.000000 65535.000000 /end CHARACTERISTIC
/begin CHARACTERISTIC fbwSAT1CC6 "AT1  CARB Speichercode Bit 6" VALUE 0xF2A08 MSA15_FW3 0 DEZ_DW_U 0.000000 65535.000000 /end CHARACTERISTIC
/begin CHARACTERISTIC fbwSAT1CC7 "AT1  CARB Speichercode Bit 7" VALUE 0xF2A0A MSA15_FW3 0 DEZ_DW_U 0.000000 65535.000000 /end CHARACTERISTIC
/begin CHARACTERISTIC fbwSAT1ENT "AT1  Entrprellmodus" VALUE 0xF29F7 MSA15_FW1 0 DEZ_DB_U 0.000000 255.000000 /end CHARACTERISTIC
/begin CHARACTERISTIC fbwSAT1FLC "AT1  Startwert Eintragzaehler" VALUE 0xF29F8 MSA15_FW1 0 DEZ_DB_U 0.000000 255.000000 /end CHARACTERISTIC
/begin CHARACTERISTIC fbwSAT1HLC "AT1  Startwert Heilungszaehler" VALUE 0xF29F9 MSA15_FW1 0 DEZ_DB_U 0.000000 255.000000 /end CHARACTERISTIC
/begin CHARACTERISTIC fbwSAT1PRI "AT1  Prioritaet" VALUE 0xF29F6 MSA15_FW1 0 DEZ_DB_U 0.000000 3.000000 EXTENDED_LIMITS 0.000000 255.000000 /end CHARACTERISTIC
/begin CHARACTERISTIC fbwSAT1SPC "AT1  Code fuer Fehlerspeicherung" VALUE 0xF29F4 MSA15_FW3 0 DEZ_DW_U 0.000000 65535.000000 /end CHARACTERISTIC
/begin CHARACTERISTIC fbwSAT1UB1 "AT1 Umweltbedingung 1 fuer Fehlerspeicherung" VALUE 0xF2A0C MSA15_FW3 0 DEZ_DW_U 0.000000 65535.000000 /end CHARACTERISTIC
/begin CHARACTERISTIC fbwSAT1UB2 "AT1 Umweltbedingung 2 fuer Fehlerspeicherung" VALUE 0xF2A0E MSA15_FW3 0 DEZ_DW_U 0.000000 65535.000000 /end CHARACTERISTIC
/begin CHARACTERISTIC fbwSAT1UB3 "AT1 Umweltbedingung 3 fuer Fehlerspeicherung" VALUE 0xF2A10 MSA15_FW3 0 DEZ_DW_U 0.000000 65535.000000 /end CHARACTERISTIC
/begin CHARACTERISTIC fbwSAT1UB4 "AT1 Umweltbedingung 4 fuer Fehlerspeicherung" VALUE 0xF2A12 MSA15_FW3 0 DEZ_DW_U 0.000000 65535.000000 /end CHARACTERISTIC
/begin CHARACTERISTIC fbwSAT2BCO "AT2  Blinkcode" VALUE 0xF2A28 MSA15_FW3 0 DEZ_DW_U 0.000000 65535.000000 /end CHARACTERISTIC
/begin CHARACTERISTIC fbwSAT2CC0 "AT2  CARB Speichercode Bit 0" VALUE 0xF2A2A MSA15_FW3 0 DEZ_DW_U 0.000000 65535.000000 /end CHARACTERISTIC
/begin CHARACTERISTIC fbwSAT2CC1 "AT2  CARB Speichercode Bit 1" VALUE 0xF2A2C MSA15_FW3 0 DEZ_DW_U 0.000000 65535.000000 /end CHARACTERISTIC
/begin CHARACTERISTIC fbwSAT2CC2 "AT2  CARB Speichercode Bit 2" VALUE 0xF2A2E MSA15_FW3 0 DEZ_DW_U 0.000000 65535.000000 /end CHARACTERISTIC
/begin CHARACTERISTIC fbwSAT2CC3 "AT2  CARB Speichercode Bit 3" VALUE 0xF2A30 MSA15_FW3 0 DEZ_DW_U 0.000000 65535.000000 /end CHARACTERISTIC
/begin CHARACTERISTIC fbwSAT2CC4 "AT2  CARB Speichercode Bit 4" VALUE 0xF2A32 MSA15_FW3 0 DEZ_DW_U 0.000000 65535.000000 /end CHARACTERISTIC
/begin CHARACTERISTIC fbwSAT2CC5 "AT2  CARB Speichercode Bit 5" VALUE 0xF2A34 MSA15_FW3 0 DEZ_DW_U 0.000000 65535.000000 /end CHARACTERISTIC
/begin CHARACTERISTIC fbwSAT2CC6 "AT2  CARB Speichercode Bit 6" VALUE 0xF2A36 MSA15_FW3 0 DEZ_DW_U 0.000000 65535.000000 /end CHARACTERISTIC
/begin CHARACTERISTIC fbwSAT2CC7 "AT2  CARB Speichercode Bit 7" VALUE 0xF2A38 MSA15_FW3 0 DEZ_DW_U 0.000000 65535.000000 /end CHARACTERISTIC
/begin CHARACTERISTIC fbwSAT2ENT "AT2  Entrprellmodus" VALUE 0xF2A25 MSA15_FW1 0 DEZ_DB_U 0.000000 255.000000 /end CHARACTERISTIC
/begin CHARACTERISTIC fbwSAT2FLC "AT2  Startwert Eintragzaehler" VALUE 0xF2A26 MSA15_FW1 0 DEZ_DB_U 0.000000 255.000000 /end CHARACTERISTIC
/begin CHARACTERISTIC fbwSAT2HLC "AT2  Startwert Heilungszaehler" VALUE 0xF2A27 MSA15_FW1 0 DEZ_DB_U 0.000000 255.000000 /end CHARACTERISTIC
/begin CHARACTERISTIC fbwSAT2PRI "AT2  Prioritaet" VALUE 0xF2A24 MSA15_FW1 0 DEZ_DB_U 0.000000 3.000000 EXTENDED_LIMITS 0.000000 255.000000 /end CHARACTERISTIC
/begin CHARACTERISTIC fbwSAT2SPC "AT2  Code fuer Fehlerspeicherung" VALUE 0xF2A22 MSA15_FW3 0 DEZ_DW_U 0.000000 65535.000000 /end CHARACTERISTIC
/begin CHARACTERISTIC fbwSAT2UB1 "AT2 Umweltbedingung 1 fuer Fehlerspeicherung" VALUE 0xF2A3A MSA15_FW3 0 DEZ_DW_U 0.000000 65535.000000 /end CHARACTERISTIC
/begin CHARACTERISTIC fbwSAT2UB2 "AT2 Umweltbedingung 2 fuer Fehlerspeicherung" VALUE 0xF2A3C MSA15_FW3 0 DEZ_DW_U 0.000000 65535.000000 /end CHARACTERISTIC
/begin CHARACTERISTIC fbwSAT2UB3 "AT2 Umweltbedingung 3 fuer Fehlerspeicherung" VALUE 0xF2A3E MSA15_FW3 0 DEZ_DW_U 0.000000 65535.000000 /end CHARACTERISTIC
/begin CHARACTERISTIC fbwSAT2UB4 "AT2 Umweltbedingung 4 fuer Fehlerspeicherung" VALUE 0xF2A40 MSA15_FW3 0 DEZ_DW_U 0.000000 65535.000000 /end CHARACTERISTIC
/begin CHARACTERISTIC fbwSAUZBCO "AUSZ  Blinkcode" VALUE 0xF351C MSA15_FW3 0 DEZ_DW_U 0.000000 65535.000000 /end CHARACTERISTIC
/begin CHARACTERISTIC fbwSAUZCC0 "AUSZANL  CARB Speichercode Bit 0" VALUE 0xF351E MSA15_FW3 0 DEZ_DW_U 0.000000 65535.000000 /end CHARACTERISTIC
/begin CHARACTERISTIC fbwSAUZCC1 "AUSZ  CARB Speichercode Bit 1" VALUE 0xF3520 MSA15_FW3 0 DEZ_DW_U 0.000000 65535.000000 /end CHARACTERISTIC
/begin CHARACTERISTIC fbwSAUZCC2 "AUSZ  CARB Speichercode Bit 2" VALUE 0xF3522 MSA15_FW3 0 DEZ_DW_U 0.000000 65535.000000 /end CHARACTERISTIC
/begin CHARACTERISTIC fbwSAUZCC3 "AUSZ  CARB Speichercode Bit 3" VALUE 0xF3524 MSA15_FW3 0 DEZ_DW_U 0.000000 65535.000000 /end CHARACTERISTIC
/begin CHARACTERISTIC fbwSAUZCC4 "AUSZ  CARB Speichercode Bit 4" VALUE 0xF3526 MSA15_FW3 0 DEZ_DW_U 0.000000 65535.000000 /end CHARACTERISTIC
/begin CHARACTERISTIC fbwSAUZCC5 "AUSZ  CARB Speichercode Bit 5" VALUE 0xF3528 MSA15_FW3 0 DEZ_DW_U 0.000000 65535.000000 /end CHARACTERISTIC
/begin CHARACTERISTIC fbwSAUZCC6 "AUSZ  CARB Speichercode Bit 6" VALUE 0xF352A MSA15_FW3 0 DEZ_DW_U 0.000000 65535.000000 /end CHARACTERISTIC
/begin CHARACTERISTIC fbwSAUZCC7 "AUSZ  CARB Speichercode Bit 7" VALUE 0xF352C MSA15_FW3 0 DEZ_DW_U 0.000000 65535.000000 /end CHARACTERISTIC
/begin CHARACTERISTIC fbwSAUZENT "AUSZ  Entrprellmodus" VALUE 0xF3519 MSA15_FW1 0 DEZ_DB_U 0.000000 255.000000 /end CHARACTERISTIC
/begin CHARACTERISTIC fbwSAUZFLC "AUSZ  Startwert Eintragzaehler" VALUE 0xF351A MSA15_FW1 0 DEZ_DB_U 0.000000 255.000000 /end CHARACTERISTIC
/begin CHARACTERISTIC fbwSAUZHLC "AUSZ  Startwert Heilungszaehler" VALUE 0xF351B MSA15_FW1 0 DEZ_DB_U 0.000000 255.000000 /end CHARACTERISTIC
/begin CHARACTERISTIC fbwSAUZPRI "AUSZ  Prioritaet" VALUE 0xF3518 MSA15_FW1 0 DEZ_DB_U 0.000000 3.000000 EXTENDED_LIMITS 0.000000 255.000000 /end CHARACTERISTIC
/begin CHARACTERISTIC fbwSAUZSPC "AUSZ  Code fuer Fehlerspeicherung" VALUE 0xF3516 MSA15_FW3 0 DEZ_DW_U 0.000000 65535.000000 /end CHARACTERISTIC
/begin CHARACTERISTIC fbwSAUZUB1 "AUSZ  Umweltbedingung 1 fuer Fehlerspeicherung" VALUE 0xF352E MSA15_FW3 0 DEZ_DW_U 0.000000 65535.000000 /end CHARACTERISTIC
/begin CHARACTERISTIC fbwSAUZUB2 "AUSZ  Umweltbedingung 2 fuer Fehlerspeicherung" VALUE 0xF3530 MSA15_FW3 0 DEZ_DW_U 0.000000 65535.000000 /end CHARACTERISTIC
/begin CHARACTERISTIC fbwSAUZUB3 "AUSZ  Umweltbedingung 3 fuer Fehlerspeicherung" VALUE 0xF3532 MSA15_FW3 0 DEZ_DW_U 0.000000 65535.000000 /end CHARACTERISTIC
/begin CHARACTERISTIC fbwSAUZUB4 "AUSZ  Umweltbedingung 4 fuer Fehlerspeicherung" VALUE 0xF3534 MSA15_FW3 0 DEZ_DW_U 0.000000 65535.000000 /end CHARACTERISTIC
/begin CHARACTERISTIC fbwSAX1BCO "ARSX  Blinkcode" VALUE 0xF2D4A MSA15_FW3 0 DEZ_DW_U 0.000000 65535.000000 /end CHARACTERISTIC
/begin CHARACTERISTIC fbwSAX1CC0 "ARSX  CARB Speichercode Bit 0" VALUE 0xF2D4C MSA15_FW3 0 DEZ_DW_U 0.000000 65535.000000 /end CHARACTERISTIC
/begin CHARACTERISTIC fbwSAX1CC1 "ARSX  CARB Speichercode Bit 1" VALUE 0xF2D4E MSA15_FW3 0 DEZ_DW_U 0.000000 65535.000000 /end CHARACTERISTIC
/begin CHARACTERISTIC fbwSAX1CC2 "ARSX  CARB Speichercode Bit 2" VALUE 0xF2D50 MSA15_FW3 0 DEZ_DW_U 0.000000 65535.000000 /end CHARACTERISTIC
/begin CHARACTERISTIC fbwSAX1CC3 "ARSX  CARB Speichercode Bit 3" VALUE 0xF2D52 MSA15_FW3 0 DEZ_DW_U 0.000000 65535.000000 /end CHARACTERISTIC
/begin CHARACTERISTIC fbwSAX1CC4 "ARSX  CARB Speichercode Bit 4" VALUE 0xF2D54 MSA15_FW3 0 DEZ_DW_U 0.000000 65535.000000 /end CHARACTERISTIC
/begin CHARACTERISTIC fbwSAX1CC5 "ARSX  CARB Speichercode Bit 5" VALUE 0xF2D56 MSA15_FW3 0 DEZ_DW_U 0.000000 65535.000000 /end CHARACTERISTIC
/begin CHARACTERISTIC fbwSAX1CC6 "ARSX  CARB Speichercode Bit 6" VALUE 0xF2D58 MSA15_FW3 0 DEZ_DW_U 0.000000 65535.000000 /end CHARACTERISTIC
/begin CHARACTERISTIC fbwSAX1CC7 "ARSX  CARB Speichercode Bit 7" VALUE 0xF2D5A MSA15_FW3 0 DEZ_DW_U 0.000000 65535.000000 /end CHARACTERISTIC
/begin CHARACTERISTIC fbwSAX1ENT "ARSX  Entrprellmodus" VALUE 0xF2D47 MSA15_FW1 0 DEZ_DB_U 0.000000 255.000000 /end CHARACTERISTIC
/begin CHARACTERISTIC fbwSAX1FLC "ARSX  Startwert Eintragzaehler" VALUE 0xF2D48 MSA15_FW1 0 DEZ_DB_U 0.000000 255.000000 /end CHARACTERISTIC
/begin CHARACTERISTIC fbwSAX1HLC "ARSX  Startwert Heilungszaehler" VALUE 0xF2D49 MSA15_FW1 0 DEZ_DB_U 0.000000 255.000000 /end CHARACTERISTIC
/begin CHARACTERISTIC fbwSAX1PRI "ARSX  Prioritaet" VALUE 0xF2D46 MSA15_FW1 0 DEZ_DB_U 0.000000 3.000000 EXTENDED_LIMITS 0.000000 255.000000 /end CHARACTERISTIC
/begin CHARACTERISTIC fbwSAX1SPC "ARSX  Code fuer Fehlerspeicherung" VALUE 0xF2D44 MSA15_FW3 0 DEZ_DW_U 0.000000 65535.000000 /end CHARACTERISTIC
/begin CHARACTERISTIC fbwSAX1UB1 "ARSX Umweltbedingung 1 fuer Fehlerspeicherung" VALUE 0xF2D5C MSA15_FW3 0 DEZ_DW_U 0.000000 65535.000000 /end CHARACTERISTIC
/begin CHARACTERISTIC fbwSAX1UB2 "ARSX Umweltbedingung 2 fuer Fehlerspeicherung" VALUE 0xF2D5E MSA15_FW3 0 DEZ_DW_U 0.000000 65535.000000 /end CHARACTERISTIC
/begin CHARACTERISTIC fbwSAX1UB3 "ARSX Umweltbedingung 3 fuer Fehlerspeicherung" VALUE 0xF2D60 MSA15_FW3 0 DEZ_DW_U 0.000000 65535.000000 /end CHARACTERISTIC
/begin CHARACTERISTIC fbwSAX1UB4 "ARSX Umweltbedingung 4 fuer Fehlerspeicherung" VALUE 0xF2D62 MSA15_FW3 0 DEZ_DW_U 0.000000 65535.000000 /end CHARACTERISTIC
/begin CHARACTERISTIC fbwSAX1UB5 "ARSX Umweltbedingung 5 fuer Fehlerspeicherung" VALUE 0xF2D64 MSA15_FW3 0 DEZ_DW_U 0.000000 65535.000000 /end CHARACTERISTIC
/begin CHARACTERISTIC fbwSBREBCO "BRE  Blinkcode" VALUE 0xF334E MSA15_FW3 0 DEZ_DW_U 0.000000 65535.000000 /end CHARACTERISTIC
/begin CHARACTERISTIC fbwSBRECC0 "BRE  CARB Speichercode Bit 0" VALUE 0xF3350 MSA15_FW3 0 DEZ_DW_U 0.000000 65535.000000 /end CHARACTERISTIC
/begin CHARACTERISTIC fbwSBRECC1 "BRE  CARB Speichercode Bit 1" VALUE 0xF3352 MSA15_FW3 0 DEZ_DW_U 0.000000 65535.000000 /end CHARACTERISTIC
/begin CHARACTERISTIC fbwSBRECC2 "BRE  CARB Speichercode Bit 2" VALUE 0xF3354 MSA15_FW3 0 DEZ_DW_U 0.000000 65535.000000 /end CHARACTERISTIC
/begin CHARACTERISTIC fbwSBRECC3 "BRE  CARB Speichercode Bit 3" VALUE 0xF3356 MSA15_FW3 0 DEZ_DW_U 0.000000 65535.000000 /end CHARACTERISTIC
/begin CHARACTERISTIC fbwSBRECC4 "BRE  CARB Speichercode Bit 4" VALUE 0xF3358 MSA15_FW3 0 DEZ_DW_U 0.000000 65535.000000 /end CHARACTERISTIC
/begin CHARACTERISTIC fbwSBRECC5 "BRE  CARB Speichercode Bit 5" VALUE 0xF335A MSA15_FW3 0 DEZ_DW_U 0.000000 65535.000000 /end CHARACTERISTIC
/begin CHARACTERISTIC fbwSBRECC6 "BRE  CARB Speichercode Bit 6" VALUE 0xF335C MSA15_FW3 0 DEZ_DW_U 0.000000 65535.000000 /end CHARACTERISTIC
/begin CHARACTERISTIC fbwSBRECC7 "BRE  CARB Speichercode Bit 7" VALUE 0xF335E MSA15_FW3 0 DEZ_DW_U 0.000000 65535.000000 /end CHARACTERISTIC
/begin CHARACTERISTIC fbwSBREENT "BRE  Entrprellmodus" VALUE 0xF334B MSA15_FW1 0 DEZ_DB_U 0.000000 255.000000 /end CHARACTERISTIC
/begin CHARACTERISTIC fbwSBREFLC "BRE  Startwert Eintragzaehler" VALUE 0xF334C MSA15_FW1 0 DEZ_DB_U 0.000000 255.000000 /end CHARACTERISTIC
/begin CHARACTERISTIC fbwSBREHLC "BRE  Startwert Heilungszaehler" VALUE 0xF334D MSA15_FW1 0 DEZ_DB_U 0.000000 255.000000 /end CHARACTERISTIC
/begin CHARACTERISTIC fbwSBREPRI "BRE  Prioritaet" VALUE 0xF334A MSA15_FW1 0 DEZ_DB_U 0.000000 3.000000 EXTENDED_LIMITS 0.000000 255.000000 /end CHARACTERISTIC
/begin CHARACTERISTIC fbwSBRESPC "BRE  Code fuer Fehlerspeicherung" VALUE 0xF3348 MSA15_FW3 0 DEZ_DW_U 0.000000 65535.000000 /end CHARACTERISTIC
/begin CHARACTERISTIC fbwSBREUB1 "BRE Umweltbedingung 1 fuer Fehlerspeicherung" VALUE 0xF3360 MSA15_FW3 0 DEZ_DW_U 0.000000 65535.000000 /end CHARACTERISTIC
/begin CHARACTERISTIC fbwSBREUB2 "BRE Umweltbedingung 2 fuer Fehlerspeicherung" VALUE 0xF3362 MSA15_FW3 0 DEZ_DW_U 0.000000 65535.000000 /end CHARACTERISTIC
/begin CHARACTERISTIC fbwSBREUB3 "BRE Umweltbedingung 3 fuer Fehlerspeicherung" VALUE 0xF3364 MSA15_FW3 0 DEZ_DW_U 0.000000 65535.000000 /end CHARACTERISTIC
/begin CHARACTERISTIC fbwSBREUB4 "BRE Umweltbedingung 4 fuer Fehlerspeicherung" VALUE 0xF3366 MSA15_FW3 0 DEZ_DW_U 0.000000 65535.000000 /end CHARACTERISTIC
/begin CHARACTERISTIC fbwSCANBCO "CAN  Blinkcode" VALUE 0xF339E MSA15_FW3 0 DEZ_DW_U 0.000000 65535.000000 /end CHARACTERISTIC
/begin CHARACTERISTIC fbwSCANCC0 "CAN  CARB Speichercode Bit 0" VALUE 0xF33A0 MSA15_FW3 0 DEZ_DW_U 0.000000 65535.000000 /end CHARACTERISTIC
/begin CHARACTERISTIC fbwSCANCC1 "CAN  CARB Speichercode Bit 1" VALUE 0xF33A2 MSA15_FW3 0 DEZ_DW_U 0.000000 65535.000000 /end CHARACTERISTIC
/begin CHARACTERISTIC fbwSCANCC2 "CAN  CARB Speichercode Bit 2" VALUE 0xF33A4 MSA15_FW3 0 DEZ_DW_U 0.000000 65535.000000 /end CHARACTERISTIC
/begin CHARACTERISTIC fbwSCANCC3 "CAN  CARB Speichercode Bit 3" VALUE 0xF33A6 MSA15_FW3 0 DEZ_DW_U 0.000000 65535.000000 /end CHARACTERISTIC
/begin CHARACTERISTIC fbwSCANCC4 "CAN  CARB Speichercode Bit 4" VALUE 0xF33A8 MSA15_FW3 0 DEZ_DW_U 0.000000 65535.000000 /end CHARACTERISTIC
/begin CHARACTERISTIC fbwSCANCC5 "CAN  CARB Speichercode Bit 5" VALUE 0xF33AA MSA15_FW3 0 DEZ_DW_U 0.000000 65535.000000 /end CHARACTERISTIC
/begin CHARACTERISTIC fbwSCANCC6 "CAN  CARB Speichercode Bit 6" VALUE 0xF33AC MSA15_FW3 0 DEZ_DW_U 0.000000 65535.000000 /end CHARACTERISTIC
/begin CHARACTERISTIC fbwSCANCC7 "CAN  CARB Speichercode Bit 7" VALUE 0xF33AE MSA15_FW3 0 DEZ_DW_U 0.000000 65535.000000 /end CHARACTERISTIC
/begin CHARACTERISTIC fbwSCANENT "CAN  Entrprellmodus" VALUE 0xF339B MSA15_FW1 0 DEZ_DB_U 0.000000 255.000000 /end CHARACTERISTIC
/begin CHARACTERISTIC fbwSCANFLC "CAN  Startwert Eintragzaehler" VALUE 0xF339C MSA15_FW1 0 DEZ_DB_U 0.000000 255.000000 /end CHARACTERISTIC
/begin CHARACTERISTIC fbwSCANHLC "CAN  Startwert Heilungszaehler" VALUE 0xF339D MSA15_FW1 0 DEZ_DB_U 0.000000 255.000000 /end CHARACTERISTIC
/begin CHARACTERISTIC fbwSCANPRI "CAN  Prioritaet" VALUE 0xF339A MSA15_FW1 0 DEZ_DB_U 0.000000 3.000000 EXTENDED_LIMITS 0.000000 255.000000 /end CHARACTERISTIC
/begin CHARACTERISTIC fbwSCANSPC "CAN  Code fuer Fehlerspeicherung" VALUE 0xF3398 MSA15_FW3 0 DEZ_DW_U 0.000000 65535.000000 /end CHARACTERISTIC
/begin CHARACTERISTIC fbwSCANUB1 "CAN Umweltbedingung 1 fuer Fehlerspeicherung" VALUE 0xF33B0 MSA15_FW3 0 DEZ_DW_U 0.000000 65535.000000 /end CHARACTERISTIC
/begin CHARACTERISTIC fbwSCANUB2 "CAN Umweltbedingung 2 fuer Fehlerspeicherung" VALUE 0xF33B2 MSA15_FW3 0 DEZ_DW_U 0.000000 65535.000000 /end CHARACTERISTIC
/begin CHARACTERISTIC fbwSCANUB3 "CAN Umweltbedingung 3 fuer Fehlerspeicherung" VALUE 0xF33B4 MSA15_FW3 0 DEZ_DW_U 0.000000 65535.000000 /end CHARACTERISTIC
/begin CHARACTERISTIC fbwSCANUB4 "CAN Umweltbedingung 4 fuer Fehlerspeicherung" VALUE 0xF33B6 MSA15_FW3 0 DEZ_DW_U 0.000000 65535.000000 /end CHARACTERISTIC
/begin CHARACTERISTIC fbwSDLABCO "DLA  Blinkcode" VALUE 0xF3752 MSA15_FW3 0 DEZ_DW_U 0.000000 65535.000000 /end CHARACTERISTIC
/begin CHARACTERISTIC fbwSDLACC0 "DLA  CARB Speichercode Bit 0" VALUE 0xF3754 MSA15_FW3 0 DEZ_DW_U 0.000000 65535.000000 /end CHARACTERISTIC
/begin CHARACTERISTIC fbwSDLACC1 "DLA  CARB Speichercode Bit 1" VALUE 0xF3756 MSA15_FW3 0 DEZ_DW_U 0.000000 65535.000000 /end CHARACTERISTIC
/begin CHARACTERISTIC fbwSDLACC2 "DLA  CARB Speichercode Bit 2" VALUE 0xF3758 MSA15_FW3 0 DEZ_DW_U 0.000000 65535.000000 /end CHARACTERISTIC
/begin CHARACTERISTIC fbwSDLACC3 "DLA  CARB Speichercode Bit 3" VALUE 0xF375A MSA15_FW3 0 DEZ_DW_U 0.000000 65535.000000 /end CHARACTERISTIC
/begin CHARACTERISTIC fbwSDLACC4 "DLA  CARB Speichercode Bit 4" VALUE 0xF375C MSA15_FW3 0 DEZ_DW_U 0.000000 65535.000000 /end CHARACTERISTIC
/begin CHARACTERISTIC fbwSDLACC5 "DLA  CARB Speichercode Bit 5" VALUE 0xF375E MSA15_FW3 0 DEZ_DW_U 0.000000 65535.000000 /end CHARACTERISTIC
/begin CHARACTERISTIC fbwSDLACC6 "DLA  CARB Speichercode Bit 6" VALUE 0xF3760 MSA15_FW3 0 DEZ_DW_U 0.000000 65535.000000 /end CHARACTERISTIC
/begin CHARACTERISTIC fbwSDLACC7 "DLA  CARB Speichercode Bit 7" VALUE 0xF3762 MSA15_FW3 0 DEZ_DW_U 0.000000 65535.000000 /end CHARACTERISTIC
/begin CHARACTERISTIC fbwSDLAENT "DLA  Entrprellmodus" VALUE 0xF374F MSA15_FW1 0 DEZ_DB_U 0.000000 255.000000 /end CHARACTERISTIC
/begin CHARACTERISTIC fbwSDLAFLC "DLA  Startwert Eintragzaehler" VALUE 0xF3750 MSA15_FW1 0 DEZ_DB_U 0.000000 255.000000 /end CHARACTERISTIC
/begin CHARACTERISTIC fbwSDLAHLC "DLA  Startwert Heilungszaehler" VALUE 0xF3751 MSA15_FW1 0 DEZ_DB_U 0.000000 255.000000 /end CHARACTERISTIC
/begin CHARACTERISTIC fbwSDLAPRI "DLA  Prioritaet" VALUE 0xF374E MSA15_FW1 0 DEZ_DB_U 0.000000 3.000000 EXTENDED_LIMITS 0.000000 255.000000 /end CHARACTERISTIC
/begin CHARACTERISTIC fbwSDLASPC "DLA  Code fuer Fehlerspeicherung" VALUE 0xF374C MSA15_FW3 0 DEZ_DW_U 0.000000 65535.000000 /end CHARACTERISTIC
/begin CHARACTERISTIC fbwSDLAUB1 "DLA Umweltbedingung 1 fuer Fehlerspeicherung" VALUE 0xF3764 MSA15_FW3 0 DEZ_DW_U 0.000000 65535.000000 /end CHARACTERISTIC
/begin CHARACTERISTIC fbwSDLAUB2 "DLA Umweltbedingung 2 fuer Fehlerspeicherung" VALUE 0xF3766 MSA15_FW3 0 DEZ_DW_U 0.000000 65535.000000 /end CHARACTERISTIC
/begin CHARACTERISTIC fbwSDLAUB3 "DLA Umweltbedingung 3 fuer Fehlerspeicherung" VALUE 0xF3768 MSA15_FW3 0 DEZ_DW_U 0.000000 65535.000000 /end CHARACTERISTIC
/begin CHARACTERISTIC fbwSDLAUB4 "DLA Umweltbedingung 4 fuer Fehlerspeicherung" VALUE 0xF376A MSA15_FW3 0 DEZ_DW_U 0.000000 65535.000000 /end CHARACTERISTIC
/begin CHARACTERISTIC fbwSDLAUB5 "DLA Umweltbedingung 5 fuer Fehlerspeicherung" VALUE 0xF376C MSA15_FW3 0 DEZ_DW_U 0.000000 65535.000000 /end CHARACTERISTIC
/begin CHARACTERISTIC fbwSDRABCO "DRA  Blinkcode" VALUE 0xF2E3C MSA15_FW3 0 DEZ_DW_U 0.000000 65535.000000 /end CHARACTERISTIC
/begin CHARACTERISTIC fbwSDRACC0 "DRA  CARB Speichercode Bit 0" VALUE 0xF2E3E MSA15_FW3 0 DEZ_DW_U 0.000000 65535.000000 /end CHARACTERISTIC
/begin CHARACTERISTIC fbwSDRACC1 "DRA  CARB Speichercode Bit 1" VALUE 0xF2E40 MSA15_FW3 0 DEZ_DW_U 0.000000 65535.000000 /end CHARACTERISTIC
/begin CHARACTERISTIC fbwSDRACC2 "DRA  CARB Speichercode Bit 2" VALUE 0xF2E42 MSA15_FW3 0 DEZ_DW_U 0.000000 65535.000000 /end CHARACTERISTIC
/begin CHARACTERISTIC fbwSDRACC3 "DRA  CARB Speichercode Bit 3" VALUE 0xF2E44 MSA15_FW3 0 DEZ_DW_U 0.000000 65535.000000 /end CHARACTERISTIC
/begin CHARACTERISTIC fbwSDRACC4 "DRA  CARB Speichercode Bit 4" VALUE 0xF2E46 MSA15_FW3 0 DEZ_DW_U 0.000000 65535.000000 /end CHARACTERISTIC
/begin CHARACTERISTIC fbwSDRACC5 "DRA  CARB Speichercode Bit 5" VALUE 0xF2E48 MSA15_FW3 0 DEZ_DW_U 0.000000 65535.000000 /end CHARACTERISTIC
/begin CHARACTERISTIC fbwSDRACC6 "DRA  CARB Speichercode Bit 6" VALUE 0xF2E4A MSA15_FW3 0 DEZ_DW_U 0.000000 65535.000000 /end CHARACTERISTIC
/begin CHARACTERISTIC fbwSDRACC7 "DRA  CARB Speichercode Bit 7" VALUE 0xF2E4C MSA15_FW3 0 DEZ_DW_U 0.000000 65535.000000 /end CHARACTERISTIC
/begin CHARACTERISTIC fbwSDRAENT "DRA  Entrprellmodus" VALUE 0xF2E39 MSA15_FW1 0 DEZ_DB_U 0.000000 255.000000 /end CHARACTERISTIC
/begin CHARACTERISTIC fbwSDRAFLC "DRA  Startwert Eintragzaehler" VALUE 0xF2E3A MSA15_FW1 0 DEZ_DB_U 0.000000 255.000000 /end CHARACTERISTIC
/begin CHARACTERISTIC fbwSDRAHLC "DRA  Startwert Heilungszaehler" VALUE 0xF2E3B MSA15_FW1 0 DEZ_DB_U 0.000000 255.000000 /end CHARACTERISTIC
/begin CHARACTERISTIC fbwSDRAPRI "DRA  Prioritaet" VALUE 0xF2E38 MSA15_FW1 0 DEZ_DB_U 0.000000 3.000000 EXTENDED_LIMITS 0.000000 255.000000 /end CHARACTERISTIC
/begin CHARACTERISTIC fbwSDRASPC "DRA  Code fuer Fehlerspeicherung" VALUE 0xF2E36 MSA15_FW3 0 DEZ_DW_U 0.000000 65535.000000 /end CHARACTERISTIC
/begin CHARACTERISTIC fbwSDRAUB1 "DRA Umweltbedingung 1 fuer Fehlerspeicherung" VALUE 0xF2E4E MSA15_FW3 0 DEZ_DW_U 0.000000 65535.000000 /end CHARACTERISTIC
/begin CHARACTERISTIC fbwSDRAUB2 "DRA Umweltbedingung 2 fuer Fehlerspeicherung" VALUE 0xF2E50 MSA15_FW3 0 DEZ_DW_U 0.000000 65535.000000 /end CHARACTERISTIC
/begin CHARACTERISTIC fbwSDRAUB3 "DRA Umweltbedingung 3 fuer Fehlerspeicherung" VALUE 0xF2E52 MSA15_FW3 0 DEZ_DW_U 0.000000 65535.000000 /end CHARACTERISTIC
/begin CHARACTERISTIC fbwSDRAUB4 "DRA Umweltbedingung 4 fuer Fehlerspeicherung" VALUE 0xF2E54 MSA15_FW3 0 DEZ_DW_U 0.000000 65535.000000 /end CHARACTERISTIC
/begin CHARACTERISTIC fbwSDRAUB5 "DRA Umweltbedingung 5 fuer Fehlerspeicherung" VALUE 0xF2E56 MSA15_FW3 0 DEZ_DW_U 0.000000 65535.000000 /end CHARACTERISTIC
/begin CHARACTERISTIC fbwSDZGBCO "DZG  Blinkcode" VALUE 0xF2716 MSA15_FW3 0 DEZ_DW_U 0.000000 65535.000000 /end CHARACTERISTIC
/begin CHARACTERISTIC fbwSDZGCC0 "DZG  CARB Speichercode Bit 0" VALUE 0xF2718 MSA15_FW3 0 DEZ_DW_U 0.000000 65535.000000 /end CHARACTERISTIC
/begin CHARACTERISTIC fbwSDZGCC1 "DZG  CARB Speichercode Bit 1" VALUE 0xF271A MSA15_FW3 0 DEZ_DW_U 0.000000 65535.000000 /end CHARACTERISTIC
/begin CHARACTERISTIC fbwSDZGCC2 "DZG  CARB Speichercode Bit 2" VALUE 0xF271C MSA15_FW3 0 DEZ_DW_U 0.000000 65535.000000 /end CHARACTERISTIC
/begin CHARACTERISTIC fbwSDZGCC3 "DZG  CARB Speichercode Bit 3" VALUE 0xF271E MSA15_FW3 0 DEZ_DW_U 0.000000 65535.000000 /end CHARACTERISTIC
/begin CHARACTERISTIC fbwSDZGCC4 "DZG  CARB Speichercode Bit 4" VALUE 0xF2720 MSA15_FW3 0 DEZ_DW_U 0.000000 65535.000000 /end CHARACTERISTIC
/begin CHARACTERISTIC fbwSDZGCC5 "DZG  CARB Speichercode Bit 5" VALUE 0xF2722 MSA15_FW3 0 DEZ_DW_U 0.000000 65535.000000 /end CHARACTERISTIC
/begin CHARACTERISTIC fbwSDZGCC6 "DZG  CARB Speichercode Bit 6" VALUE 0xF2724 MSA15_FW3 0 DEZ_DW_U 0.000000 65535.000000 /end CHARACTERISTIC
/begin CHARACTERISTIC fbwSDZGCC7 "DZG  CARB Speichercode Bit 7" VALUE 0xF2726 MSA15_FW3 0 DEZ_DW_U 0.000000 65535.000000 /end CHARACTERISTIC
/begin CHARACTERISTIC fbwSDZGENT "DZG  Entrprellmodus" VALUE 0xF2713 MSA15_FW1 0 DEZ_DB_U 0.000000 255.000000 /end CHARACTERISTIC
/begin CHARACTERISTIC fbwSDZGFLC "DZG  Startwert Eintragzaehler" VALUE 0xF2714 MSA15_FW1 0 DEZ_DB_U 0.000000 255.000000 /end CHARACTERISTIC
/begin CHARACTERISTIC fbwSDZGHLC "DZG  Startwert Heilungszaehler" VALUE 0xF2715 MSA15_FW1 0 DEZ_DB_U 0.000000 255.000000 /end CHARACTERISTIC
/begin CHARACTERISTIC fbwSDZGPRI "DZG  Prioritaet" VALUE 0xF2712 MSA15_FW1 0 DEZ_DB_U 0.000000 3.000000 EXTENDED_LIMITS 0.000000 255.000000 /end CHARACTERISTIC
/begin CHARACTERISTIC fbwSDZGSPC "DZG  Code fuer Fehlerspeicherung" VALUE 0xF2710 MSA15_FW3 0 DEZ_DW_U 0.000000 65535.000000 /end CHARACTERISTIC
/begin CHARACTERISTIC fbwSDZGUB1 "DZG Umweltbedingung 1 fuer Fehlerspeicherung" VALUE 0xF2728 MSA15_FW3 0 DEZ_DW_U 0.000000 65535.000000 /end CHARACTERISTIC
/begin CHARACTERISTIC fbwSDZGUB2 "DZG Umweltbedingung 2 fuer Fehlerspeicherung" VALUE 0xF272A MSA15_FW3 0 DEZ_DW_U 0.000000 65535.000000 /end CHARACTERISTIC
/begin CHARACTERISTIC fbwSDZGUB3 "DZG Umweltbedingung 3 fuer Fehlerspeicherung" VALUE 0xF272C MSA15_FW3 0 DEZ_DW_U 0.000000 65535.000000 /end CHARACTERISTIC
/begin CHARACTERISTIC fbwSDZGUB4 "DZG Umweltbedingung 4 fuer Fehlerspeicherung" VALUE 0xF272E MSA15_FW3 0 DEZ_DW_U 0.000000 65535.000000 /end CHARACTERISTIC
/begin CHARACTERISTIC fbwSEABBCO "EAB  Blinkcode" VALUE 0xF30F4 MSA15_FW3 0 DEZ_DW_U 0.000000 65535.000000 /end CHARACTERISTIC
/begin CHARACTERISTIC fbwSEABCC0 "EAB  CARB Speichercode Bit 0" VALUE 0xF30F6 MSA15_FW3 0 DEZ_DW_U 0.000000 65535.000000 /end CHARACTERISTIC
/begin CHARACTERISTIC fbwSEABCC1 "EAB  CARB Speichercode Bit 1" VALUE 0xF30F8 MSA15_FW3 0 DEZ_DW_U 0.000000 65535.000000 /end CHARACTERISTIC
/begin CHARACTERISTIC fbwSEABCC2 "EAB  CARB Speichercode Bit 2" VALUE 0xF30FA MSA15_FW3 0 DEZ_DW_U 0.000000 65535.000000 /end CHARACTERISTIC
/begin CHARACTERISTIC fbwSEABCC3 "EAB  CARB Speichercode Bit 3" VALUE 0xF30FC MSA15_FW3 0 DEZ_DW_U 0.000000 65535.000000 /end CHARACTERISTIC
/begin CHARACTERISTIC fbwSEABCC4 "EAB  CARB Speichercode Bit 4" VALUE 0xF30FE MSA15_FW3 0 DEZ_DW_U 0.000000 65535.000000 /end CHARACTERISTIC
/begin CHARACTERISTIC fbwSEABCC5 "EAB  CARB Speichercode Bit 5" VALUE 0xF3100 MSA15_FW3 0 DEZ_DW_U 0.000000 65535.000000 /end CHARACTERISTIC
/begin CHARACTERISTIC fbwSEABCC6 "EAB  CARB Speichercode Bit 6" VALUE 0xF3102 MSA15_FW3 0 DEZ_DW_U 0.000000 65535.000000 /end CHARACTERISTIC
/begin CHARACTERISTIC fbwSEABCC7 "EAB  CARB Speichercode Bit 7" VALUE 0xF3104 MSA15_FW3 0 DEZ_DW_U 0.000000 65535.000000 /end CHARACTERISTIC
/begin CHARACTERISTIC fbwSEABENT "EAB  Entrprellmodus" VALUE 0xF30F1 MSA15_FW1 0 DEZ_DB_U 0.000000 255.000000 /end CHARACTERISTIC
/begin CHARACTERISTIC fbwSEABFLC "EAB  Startwert Eintragzaehler" VALUE 0xF30F2 MSA15_FW1 0 DEZ_DB_U 0.000000 255.000000 /end CHARACTERISTIC
/begin CHARACTERISTIC fbwSEABHLC "EAB  Startwert Heilungszaehler" VALUE 0xF30F3 MSA15_FW1 0 DEZ_DB_U 0.000000 255.000000 /end CHARACTERISTIC
/begin CHARACTERISTIC fbwSEABPRI "EAB  Prioritaet" VALUE 0xF30F0 MSA15_FW1 0 DEZ_DB_U 0.000000 3.000000 EXTENDED_LIMITS 0.000000 255.000000 /end CHARACTERISTIC
/begin CHARACTERISTIC fbwSEABSPC "EAB  Code fuer Fehlerspeicherung" VALUE 0xF30EE MSA15_FW3 0 DEZ_DW_U 0.000000 65535.000000 /end CHARACTERISTIC
/begin CHARACTERISTIC fbwSEABUB1 "EAB Umweltbedingung 1 fuer Fehlerspeicherung" VALUE 0xF3106 MSA15_FW3 0 DEZ_DW_U 0.000000 65535.000000 /end CHARACTERISTIC
/begin CHARACTERISTIC fbwSEABUB2 "EAB Umweltbedingung 2 fuer Fehlerspeicherung" VALUE 0xF3108 MSA15_FW3 0 DEZ_DW_U 0.000000 65535.000000 /end CHARACTERISTIC
/begin CHARACTERISTIC fbwSEABUB3 "EAB Umweltbedingung 3 fuer Fehlerspeicherung" VALUE 0xF310A MSA15_FW3 0 DEZ_DW_U 0.000000 65535.000000 /end CHARACTERISTIC
/begin CHARACTERISTIC fbwSEABUB4 "EAB Umweltbedingung 4 fuer Fehlerspeicherung" VALUE 0xF310C MSA15_FW3 0 DEZ_DW_U 0.000000 65535.000000 /end CHARACTERISTIC
/begin CHARACTERISTIC fbwSEEPBCO "EEP  Blinkcode" VALUE 0xF340C MSA15_FW3 0 DEZ_DW_U 0.000000 65535.000000 /end CHARACTERISTIC
/begin CHARACTERISTIC fbwSEEPCC0 "EEP  CARB Speichercode Bit 0" VALUE 0xF340E MSA15_FW3 0 DEZ_DW_U 0.000000 65535.000000 /end CHARACTERISTIC
/begin CHARACTERISTIC fbwSEEPCC1 "EEP  CARB Speichercode Bit 1" VALUE 0xF3410 MSA15_FW3 0 DEZ_DW_U 0.000000 65535.000000 /end CHARACTERISTIC
/begin CHARACTERISTIC fbwSEEPCC2 "EEP  CARB Speichercode Bit 2" VALUE 0xF3412 MSA15_FW3 0 DEZ_DW_U 0.000000 65535.000000 /end CHARACTERISTIC
/begin CHARACTERISTIC fbwSEEPCC3 "EEP  CARB Speichercode Bit 3" VALUE 0xF3414 MSA15_FW3 0 DEZ_DW_U 0.000000 65535.000000 /end CHARACTERISTIC
/begin CHARACTERISTIC fbwSEEPCC4 "EEP  CARB Speichercode Bit 4" VALUE 0xF3416 MSA15_FW3 0 DEZ_DW_U 0.000000 65535.000000 /end CHARACTERISTIC
/begin CHARACTERISTIC fbwSEEPCC5 "EEP  CARB Speichercode Bit 5" VALUE 0xF3418 MSA15_FW3 0 DEZ_DW_U 0.000000 65535.000000 /end CHARACTERISTIC
/begin CHARACTERISTIC fbwSEEPCC6 "EEP  CARB Speichercode Bit 6" VALUE 0xF341A MSA15_FW3 0 DEZ_DW_U 0.000000 65535.000000 /end CHARACTERISTIC
/begin CHARACTERISTIC fbwSEEPCC7 "EEP  CARB Speichercode Bit 7" VALUE 0xF341C MSA15_FW3 0 DEZ_DW_U 0.000000 65535.000000 /end CHARACTERISTIC
/begin CHARACTERISTIC fbwSEEPENT "EEPROM Entrprellmodus" VALUE 0xF3409 MSA15_FW1 0 DEZ_DB_U 0.000000 255.000000 /end CHARACTERISTIC
/begin CHARACTERISTIC fbwSEEPFLC "EEP  Startwert Eintragzaehler" VALUE 0xF340A MSA15_FW1 0 DEZ_DB_U 0.000000 255.000000 /end CHARACTERISTIC
/begin CHARACTERISTIC fbwSEEPHLC "EEP  Startwert Heilungszaehler" VALUE 0xF340B MSA15_FW1 0 DEZ_DB_U 0.000000 255.000000 /end CHARACTERISTIC
/begin CHARACTERISTIC fbwSEEPPRI "EEPROM" VALUE 0xF3408 MSA15_FW1 0 DEZ_DB_U 0.000000 3.000000 EXTENDED_LIMITS 0.000000 255.000000 /end CHARACTERISTIC
/begin CHARACTERISTIC fbwSEEPSPC "EEPROM Code fuer Fehlerspeicherung" VALUE 0xF3406 MSA15_FW3 0 DEZ_DW_U 0.000000 65535.000000 /end CHARACTERISTIC
/begin CHARACTERISTIC fbwSEEPUB1 "EEPROM Umweltbedingung 1 fuer Fehlerspeicherung" VALUE 0xF341E MSA15_FW3 0 DEZ_DW_U 0.000000 65535.000000 /end CHARACTERISTIC
/begin CHARACTERISTIC fbwSEEPUB2 "EEPROM Umweltbedingung 2 fuer Fehlerspeicherung" VALUE 0xF3420 MSA15_FW3 0 DEZ_DW_U 0.000000 65535.000000 /end CHARACTERISTIC
/begin CHARACTERISTIC fbwSEEPUB3 "EEPROM Umweltbedingung 3 fuer Fehlerspeicherung" VALUE 0xF3422 MSA15_FW3 0 DEZ_DW_U 0.000000 65535.000000 /end CHARACTERISTIC
/begin CHARACTERISTIC fbwSEEPUB4 "EEPROM Umweltbedingung 4 fuer Fehlerspeicherung" VALUE 0xF3424 MSA15_FW3 0 DEZ_DW_U 0.000000 65535.000000 /end CHARACTERISTIC
/begin CHARACTERISTIC fbwSEKPBCO "EKP  Blinkcode" VALUE 0xF2ECC MSA15_FW3 0 DEZ_DW_U 0.000000 65535.000000 /end CHARACTERISTIC
/begin CHARACTERISTIC fbwSEKPCC0 "EKP  CARB Speichercode Bit 0" VALUE 0xF2ECE MSA15_FW3 0 DEZ_DW_U 0.000000 65535.000000 /end CHARACTERISTIC
/begin CHARACTERISTIC fbwSEKPCC1 "EKP  CARB Speichercode Bit 1" VALUE 0xF2ED0 MSA15_FW3 0 DEZ_DW_U 0.000000 65535.000000 /end CHARACTERISTIC
/begin CHARACTERISTIC fbwSEKPCC2 "EKP  CARB Speichercode Bit 2" VALUE 0xF2ED2 MSA15_FW3 0 DEZ_DW_U 0.000000 65535.000000 /end CHARACTERISTIC
/begin CHARACTERISTIC fbwSEKPCC3 "EKP  CARB Speichercode Bit 3" VALUE 0xF2ED4 MSA15_FW3 0 DEZ_DW_U 0.000000 65535.000000 /end CHARACTERISTIC
/begin CHARACTERISTIC fbwSEKPCC4 "EKP  CARB Speichercode Bit 4" VALUE 0xF2ED6 MSA15_FW3 0 DEZ_DW_U 0.000000 65535.000000 /end CHARACTERISTIC
/begin CHARACTERISTIC fbwSEKPCC5 "EKP  CARB Speichercode Bit 5" VALUE 0xF2ED8 MSA15_FW3 0 DEZ_DW_U 0.000000 65535.000000 /end CHARACTERISTIC
/begin CHARACTERISTIC fbwSEKPCC6 "EKP  CARB Speichercode Bit 6" VALUE 0xF2EDA MSA15_FW3 0 DEZ_DW_U 0.000000 65535.000000 /end CHARACTERISTIC
/begin CHARACTERISTIC fbwSEKPCC7 "EKP  CARB Speichercode Bit 7" VALUE 0xF2EDC MSA15_FW3 0 DEZ_DW_U 0.000000 65535.000000 /end CHARACTERISTIC
/begin CHARACTERISTIC fbwSEKPENT "EKP  Entrprellmodus" VALUE 0xF2EC9 MSA15_FW1 0 DEZ_DB_U 0.000000 255.000000 /end CHARACTERISTIC
/begin CHARACTERISTIC fbwSEKPFLC "EKP  Startwert Eintragzaehler" VALUE 0xF2ECA MSA15_FW1 0 DEZ_DB_U 0.000000 255.000000 /end CHARACTERISTIC
/begin CHARACTERISTIC fbwSEKPHLC "EKP  Startwert Heilungszaehler" VALUE 0xF2ECB MSA15_FW1 0 DEZ_DB_U 0.000000 255.000000 /end CHARACTERISTIC
/begin CHARACTERISTIC fbwSEKPPRI "EKP  Prioritaet" VALUE 0xF2EC8 MSA15_FW1 0 DEZ_DB_U 0.000000 3.000000 EXTENDED_LIMITS 0.000000 255.000000 /end CHARACTERISTIC
/begin CHARACTERISTIC fbwSEKPSPC "EKP  Code fuer Fehlerspeicherung" VALUE 0xF2EC6 MSA15_FW3 0 DEZ_DW_U 0.000000 65535.000000 /end CHARACTERISTIC
/begin CHARACTERISTIC fbwSEKPUB1 "EKP Umweltbedingung 1 fuer Fehlerspeicherung" VALUE 0xF2EDE MSA15_FW3 0 DEZ_DW_U 0.000000 65535.000000 /end CHARACTERISTIC
/begin CHARACTERISTIC fbwSEKPUB2 "EKP Umweltbedingung 2 fuer Fehlerspeicherung" VALUE 0xF2EE0 MSA15_FW3 0 DEZ_DW_U 0.000000 65535.000000 /end CHARACTERISTIC
/begin CHARACTERISTIC fbwSEKPUB3 "EKP Umweltbedingung 3 fuer Fehlerspeicherung" VALUE 0xF2EE2 MSA15_FW3 0 DEZ_DW_U 0.000000 65535.000000 /end CHARACTERISTIC
/begin CHARACTERISTIC fbwSEKPUB4 "EKP Umweltbedingung 4 fuer Fehlerspeicherung" VALUE 0xF2EE4 MSA15_FW3 0 DEZ_DW_U 0.000000 65535.000000 /end CHARACTERISTIC
/begin CHARACTERISTIC fbwSEWSBCO "EWS  Blink-Code" VALUE 0xF1B4A MSA15_FW3 0 DEZ_DW_U 0.000000 65535.000000 /end CHARACTERISTIC
/begin CHARACTERISTIC fbwSEWSCC0 "EWS  CARB Speichercode Bit 0" VALUE 0xF1B4C MSA15_FW3 0 DEZ_DW_U 0.000000 65535.000000 /end CHARACTERISTIC
/begin CHARACTERISTIC fbwSEWSCC1 "EWS  CARB Speichercode Bit 1" VALUE 0xF1B4E MSA15_FW3 0 DEZ_DW_U 0.000000 65535.000000 /end CHARACTERISTIC
/begin CHARACTERISTIC fbwSEWSCC2 "EWS  CARB Speichercode Bit 2" VALUE 0xF1B50 MSA15_FW3 0 DEZ_DW_U 0.000000 65535.000000 /end CHARACTERISTIC
/begin CHARACTERISTIC fbwSEWSCC3 "EWS  CARB Speichercode Bit 3" VALUE 0xF1B52 MSA15_FW3 0 DEZ_DW_U 0.000000 65535.000000 /end CHARACTERISTIC
/begin CHARACTERISTIC fbwSEWSCC4 "EWS  CARB Speichercode Bit 4" VALUE 0xF1B54 MSA15_FW3 0 DEZ_DW_U 0.000000 65535.000000 /end CHARACTERISTIC
/begin CHARACTERISTIC fbwSEWSCC5 "EWS  CARB Speichercode Bit 5" VALUE 0xF1B56 MSA15_FW3 0 DEZ_DW_U 0.000000 65535.000000 /end CHARACTERISTIC
/begin CHARACTERISTIC fbwSEWSCC6 "EWS  CARB Speichercode Bit 6" VALUE 0xF1B58 MSA15_FW3 0 DEZ_DW_U 0.000000 65535.000000 /end CHARACTERISTIC
/begin CHARACTERISTIC fbwSEWSCC7 "EWS  CARB Speichercode Bit 7" VALUE 0xF1B5A MSA15_FW3 0 DEZ_DW_U 0.000000 65535.000000 /end CHARACTERISTIC
/begin CHARACTERISTIC fbwSEWSENT "EWS Entrprellmodus" VALUE 0xF1B47 MSA15_FW1 0 DEZ_DB_U 0.000000 255.000000 /end CHARACTERISTIC
/begin CHARACTERISTIC fbwSEWSFLC "EWS  Startwert Eintragzaehler" VALUE 0xF1B48 MSA15_FW1 0 DEZ_DB_U 0.000000 255.000000 /end CHARACTERISTIC
/begin CHARACTERISTIC fbwSEWSHLC "EWS  Startwert Heilungszaehler" VALUE 0xF1B49 MSA15_FW1 0 DEZ_DB_U 0.000000 255.000000 /end CHARACTERISTIC
/begin CHARACTERISTIC fbwSEWSPRI "EWS  Prioritaet+Ansteuerung der Diagnoselampe" VALUE 0xF1B46 MSA15_FW1 0 DEZ_DB_U 0.000000 3.000000 EXTENDED_LIMITS 0.000000 255.000000 /end CHARACTERISTIC
/begin CHARACTERISTIC fbwSEWSSPC "EWS  Code fuer Fehlerspeicherung" VALUE 0xF1B44 MSA15_FW3 0 DEZ_DW_U 0.000000 65535.000000 /end CHARACTERISTIC
/begin CHARACTERISTIC fbwSEWSUB1 "EWS  Umweltbedingung 1 fuer Fehlerspeicherung" VALUE 0xF1B5C MSA15_FW3 0 DEZ_DW_U 0.000000 65535.000000 /end CHARACTERISTIC
/begin CHARACTERISTIC fbwSEWSUB2 "EWS  Umweltbedingung 2 fuer Fehlerspeicherung" VALUE 0xF1B5E MSA15_FW3 0 DEZ_DW_U 0.000000 65535.000000 /end CHARACTERISTIC
/begin CHARACTERISTIC fbwSEWSUB3 "EWS  Umweltbedingung 3 fuer Fehlerspeicherung" VALUE 0xF1B60 MSA15_FW3 0 DEZ_DW_U 0.000000 65535.000000 /end CHARACTERISTIC
/begin CHARACTERISTIC fbwSEWSUB4 "EWS  Umweltbedingung 4 fuer Fehlerspeicherung" VALUE 0xF1B62 MSA15_FW3 0 DEZ_DW_U 0.000000 65535.000000 /end CHARACTERISTIC
/begin CHARACTERISTIC fbwSEXTBCO "CAN  Blinkcode" VALUE 0xF33C6 MSA15_FW3 0 DEZ_DW_U 0.000000 65535.000000 /end CHARACTERISTIC
/begin CHARACTERISTIC fbwSEXTCC0 "CAN  CARB Speichercode Bit 0" VALUE 0xF33C8 MSA15_FW3 0 DEZ_DW_U 0.000000 65535.000000 /end CHARACTERISTIC
/begin CHARACTERISTIC fbwSEXTCC1 "CAN  CARB Speichercode Bit 1" VALUE 0xF33CA MSA15_FW3 0 DEZ_DW_U 0.000000 65535.000000 /end CHARACTERISTIC
/begin CHARACTERISTIC fbwSEXTCC2 "CAN  CARB Speichercode Bit 2" VALUE 0xF33CC MSA15_FW3 0 DEZ_DW_U 0.000000 65535.000000 /end CHARACTERISTIC
/begin CHARACTERISTIC fbwSEXTCC3 "CAN  CARB Speichercode Bit 3" VALUE 0xF33CE MSA15_FW3 0 DEZ_DW_U 0.000000 65535.000000 /end CHARACTERISTIC
/begin CHARACTERISTIC fbwSEXTCC4 "CAN  CARB Speichercode Bit 4" VALUE 0xF33D0 MSA15_FW3 0 DEZ_DW_U 0.000000 65535.000000 /end CHARACTERISTIC
/begin CHARACTERISTIC fbwSEXTCC5 "CAN  CARB Speichercode Bit 5" VALUE 0xF33D2 MSA15_FW3 0 DEZ_DW_U 0.000000 65535.000000 /end CHARACTERISTIC
/begin CHARACTERISTIC fbwSEXTCC6 "CAN  CARB Speichercode Bit 6" VALUE 0xF33D4 MSA15_FW3 0 DEZ_DW_U 0.000000 65535.000000 /end CHARACTERISTIC
/begin CHARACTERISTIC fbwSEXTCC7 "CAN  CARB Speichercode Bit 7" VALUE 0xF33D6 MSA15_FW3 0 DEZ_DW_U 0.000000 65535.000000 /end CHARACTERISTIC
/begin CHARACTERISTIC fbwSEXTENT "CAN  Entprellmodus" VALUE 0xF33C3 MSA15_FW1 0 DEZ_DB_U 0.000000 255.000000 /end CHARACTERISTIC
/begin CHARACTERISTIC fbwSEXTFLC "CAN  Startwert Eintragzaehler" VALUE 0xF33C4 MSA15_FW1 0 DEZ_DB_U 0.000000 255.000000 /end CHARACTERISTIC
/begin CHARACTERISTIC fbwSEXTHLC "CAN  Startwert Heilungszaehler" VALUE 0xF33C5 MSA15_FW1 0 DEZ_DB_U 0.000000 255.000000 /end CHARACTERISTIC
/begin CHARACTERISTIC fbwSEXTPRI "CAN  Prioritaet" VALUE 0xF33C2 MSA15_FW1 0 DEZ_DB_U 0.000000 3.000000 EXTENDED_LIMITS 0.000000 255.000000 /end CHARACTERISTIC
/begin CHARACTERISTIC fbwSEXTSPC "CAN  Code fuer Fehlerspeicherung" VALUE 0xF33C0 MSA15_FW3 0 DEZ_DW_U 0.000000 65535.000000 /end CHARACTERISTIC
/begin CHARACTERISTIC fbwSEXTUB1 "CAN Umweltbedingung 1 fuer Fehlerspeicherung" VALUE 0xF33D8 MSA15_FW3 0 DEZ_DW_U 0.000000 65535.000000 /end CHARACTERISTIC
/begin CHARACTERISTIC fbwSEXTUB2 "CAN Umweltbedingung 2 fuer Fehlerspeicherung" VALUE 0xF33DA MSA15_FW3 0 DEZ_DW_U 0.000000 65535.000000 /end CHARACTERISTIC
/begin CHARACTERISTIC fbwSEXTUB3 "CAN Umweltbedingung 3 fuer Fehlerspeicherung" VALUE 0xF33DC MSA15_FW3 0 DEZ_DW_U 0.000000 65535.000000 /end CHARACTERISTIC
/begin CHARACTERISTIC fbwSEXTUB4 "CAN Umweltbedingung 4 fuer Fehlerspeicherung" VALUE 0xF33DE MSA15_FW3 0 DEZ_DW_U 0.000000 65535.000000 /end CHARACTERISTIC
/begin CHARACTERISTIC fbwSFGABCO "FGA  Blinkcode" VALUE 0xF2BA0 MSA15_FW3 0 DEZ_DW_U 0.000000 65535.000000 /end CHARACTERISTIC
/begin CHARACTERISTIC fbwSFGACC0 "FGA  CARB Speichercode Bit 0" VALUE 0xF2BA2 MSA15_FW3 0 DEZ_DW_U 0.000000 65535.000000 /end CHARACTERISTIC
/begin CHARACTERISTIC fbwSFGACC1 "FGA  CARB Speichercode Bit 1" VALUE 0xF2BA4 MSA15_FW3 0 DEZ_DW_U 0.000000 65535.000000 /end CHARACTERISTIC
/begin CHARACTERISTIC fbwSFGACC2 "FGA  CARB Speichercode Bit 2" VALUE 0xF2BA6 MSA15_FW3 0 DEZ_DW_U 0.000000 65535.000000 /end CHARACTERISTIC
/begin CHARACTERISTIC fbwSFGACC3 "FGA  CARB Speichercode Bit 3" VALUE 0xF2BA8 MSA15_FW3 0 DEZ_DW_U 0.000000 65535.000000 /end CHARACTERISTIC
/begin CHARACTERISTIC fbwSFGACC4 "FGA  CARB Speichercode Bit 4" VALUE 0xF2BAA MSA15_FW3 0 DEZ_DW_U 0.000000 65535.000000 /end CHARACTERISTIC
/begin CHARACTERISTIC fbwSFGACC5 "FGA  CARB Speichercode Bit 5" VALUE 0xF2BAC MSA15_FW3 0 DEZ_DW_U 0.000000 65535.000000 /end CHARACTERISTIC
/begin CHARACTERISTIC fbwSFGACC6 "FGA  CARB Speichercode Bit 6" VALUE 0xF2BAE MSA15_FW3 0 DEZ_DW_U 0.000000 65535.000000 /end CHARACTERISTIC
/begin CHARACTERISTIC fbwSFGACC7 "FGA  CARB Speichercode Bit 7" VALUE 0xF2BB0 MSA15_FW3 0 DEZ_DW_U 0.000000 65535.000000 /end CHARACTERISTIC
/begin CHARACTERISTIC fbwSFGAENT "FGA  Entrprellmodus" VALUE 0xF2B9D MSA15_FW1 0 DEZ_DB_U 0.000000 255.000000 /end CHARACTERISTIC
/begin CHARACTERISTIC fbwSFGAFLC "FGA  Startwert Eintragzaehler" VALUE 0xF2B9E MSA15_FW1 0 DEZ_DB_U 0.000000 255.000000 /end CHARACTERISTIC
/begin CHARACTERISTIC fbwSFGAHLC "FGA  Startwert Heilungszaehler" VALUE 0xF2B9F MSA15_FW1 0 DEZ_DB_U 0.000000 255.000000 /end CHARACTERISTIC
/begin CHARACTERISTIC fbwSFGAPRI "FGA  Prioritaet" VALUE 0xF2B9C MSA15_FW1 0 DEZ_DB_U 0.000000 3.000000 EXTENDED_LIMITS 0.000000 255.000000 /end CHARACTERISTIC
/begin CHARACTERISTIC fbwSFGASPC "FGA Code fuer Fehlerspeicherung" VALUE 0xF2B9A MSA15_FW3 0 DEZ_DW_U 0.000000 65535.000000 /end CHARACTERISTIC
/begin CHARACTERISTIC fbwSFGAUB1 "FGA Umweltbedingung 1 fuer Fehlerspeicherung" VALUE 0xF2BB2 MSA15_FW3 0 DEZ_DW_U 0.000000 65535.000000 /end CHARACTERISTIC
/begin CHARACTERISTIC fbwSFGAUB2 "FGA Umweltbedingung 2 fuer Fehlerspeicherung" VALUE 0xF2BB4 MSA15_FW3 0 DEZ_DW_U 0.000000 65535.000000 /end CHARACTERISTIC
/begin CHARACTERISTIC fbwSFGAUB3 "FGA Umweltbedingung 3 fuer Fehlerspeicherung" VALUE 0xF2BB6 MSA15_FW3 0 DEZ_DW_U 0.000000 65535.000000 /end CHARACTERISTIC
/begin CHARACTERISTIC fbwSFGAUB4 "FGA Umweltbedingung 4 fuer Fehlerspeicherung" VALUE 0xF2BB8 MSA15_FW3 0 DEZ_DW_U 0.000000 65535.000000 /end CHARACTERISTIC
/begin CHARACTERISTIC fbwSFGGBCO "FGG  Blinkcode" VALUE 0xF2CC6 MSA15_FW3 0 DEZ_DW_U 0.000000 65535.000000 /end CHARACTERISTIC
/begin CHARACTERISTIC fbwSFGGCC0 "FGG  CARB Speichercode Bit 0" VALUE 0xF2CC8 MSA15_FW3 0 DEZ_DW_U 0.000000 65535.000000 /end CHARACTERISTIC
/begin CHARACTERISTIC fbwSFGGCC1 "FGG  CARB Speichercode Bit 1" VALUE 0xF2CCA MSA15_FW3 0 DEZ_DW_U 0.000000 65535.000000 /end CHARACTERISTIC
/begin CHARACTERISTIC fbwSFGGCC2 "FGG  CARB Speichercode Bit 2" VALUE 0xF2CCC MSA15_FW3 0 DEZ_DW_U 0.000000 65535.000000 /end CHARACTERISTIC
/begin CHARACTERISTIC fbwSFGGCC3 "FGG  CARB Speichercode Bit 3" VALUE 0xF2CCE MSA15_FW3 0 DEZ_DW_U 0.000000 65535.000000 /end CHARACTERISTIC
/begin CHARACTERISTIC fbwSFGGCC4 "FGG  CARB Speichercode Bit 4" VALUE 0xF2CD0 MSA15_FW3 0 DEZ_DW_U 0.000000 65535.000000 /end CHARACTERISTIC
/begin CHARACTERISTIC fbwSFGGCC5 "FGG  CARB Speichercode Bit 5" VALUE 0xF2CD2 MSA15_FW3 0 DEZ_DW_U 0.000000 65535.000000 /end CHARACTERISTIC
/begin CHARACTERISTIC fbwSFGGCC6 "FGG  CARB Speichercode Bit 6" VALUE 0xF2CD4 MSA15_FW3 0 DEZ_DW_U 0.000000 65535.000000 /end CHARACTERISTIC
/begin CHARACTERISTIC fbwSFGGCC7 "FGG  CARB Speichercode Bit 7" VALUE 0xF2CD6 MSA15_FW3 0 DEZ_DW_U 0.000000 65535.000000 /end CHARACTERISTIC
/begin CHARACTERISTIC fbwSFGGENT "FGG  Entrprellmodus" VALUE 0xF2CC3 MSA15_FW1 0 DEZ_DB_U 0.000000 255.000000 /end CHARACTERISTIC
/begin CHARACTERISTIC fbwSFGGFLC "FGG  Startwert Eintragzaehler" VALUE 0xF2CC4 MSA15_FW1 0 DEZ_DB_U 0.000000 255.000000 /end CHARACTERISTIC
/begin CHARACTERISTIC fbwSFGGHLC "FGG  Startwert Heilungszaehler" VALUE 0xF2CC5 MSA15_FW1 0 DEZ_DB_U 0.000000 255.000000 /end CHARACTERISTIC
/begin CHARACTERISTIC fbwSFGGPRI "FGG  Prioritaet" VALUE 0xF2CC2 MSA15_FW1 0 DEZ_DB_U 0.000000 3.000000 EXTENDED_LIMITS 0.000000 255.000000 /end CHARACTERISTIC
/begin CHARACTERISTIC fbwSFGGSPC "FGG  Code fuer Fehlerspeicherung" VALUE 0xF2CC0 MSA15_FW3 0 DEZ_DW_U 0.000000 65535.000000 /end CHARACTERISTIC
/begin CHARACTERISTIC fbwSFGGUB1 "FGG Umweltbedingung 1 fuer Fehlerspeicherung" VALUE 0xF2CD8 MSA15_FW3 0 DEZ_DW_U 0.000000 65535.000000 /end CHARACTERISTIC
/begin CHARACTERISTIC fbwSFGGUB2 "FGG Umweltbedingung 2 fuer Fehlerspeicherung" VALUE 0xF2CDA MSA15_FW3 0 DEZ_DW_U 0.000000 65535.000000 /end CHARACTERISTIC
/begin CHARACTERISTIC fbwSFGGUB3 "FGG Umweltbedingung 3 fuer Fehlerspeicherung" VALUE 0xF2CDC MSA15_FW3 0 DEZ_DW_U 0.000000 65535.000000 /end CHARACTERISTIC
/begin CHARACTERISTIC fbwSFGGUB4 "FGG Umweltbedingung 4 fuer Fehlerspeicherung" VALUE 0xF2CDE MSA15_FW3 0 DEZ_DW_U 0.000000 65535.000000 /end CHARACTERISTIC
/begin CHARACTERISTIC fbwSGAZBCO "GAZ  Blinkcode" VALUE 0xF30C0 MSA15_FW3 0 DEZ_DW_U 0.000000 65535.000000 /end CHARACTERISTIC
/begin CHARACTERISTIC fbwSGAZCC0 "GAZ  CARB Speichercode Bit 0" VALUE 0xF30C2 MSA15_FW3 0 DEZ_DW_U 0.000000 65535.000000 /end CHARACTERISTIC
/begin CHARACTERISTIC fbwSGAZCC1 "GAZ  CARB Speichercode Bit 1" VALUE 0xF30C4 MSA15_FW3 0 DEZ_DW_U 0.000000 65535.000000 /end CHARACTERISTIC
/begin CHARACTERISTIC fbwSGAZCC2 "GAZ  CARB Speichercode Bit 2" VALUE 0xF30C6 MSA15_FW3 0 DEZ_DW_U 0.000000 65535.000000 /end CHARACTERISTIC
/begin CHARACTERISTIC fbwSGAZCC3 "GAZ  CARB Speichercode Bit 3" VALUE 0xF30C8 MSA15_FW3 0 DEZ_DW_U 0.000000 65535.000000 /end CHARACTERISTIC
/begin CHARACTERISTIC fbwSGAZCC4 "GAZ  CARB Speichercode Bit 4" VALUE 0xF30CA MSA15_FW3 0 DEZ_DW_U 0.000000 65535.000000 /end CHARACTERISTIC
/begin CHARACTERISTIC fbwSGAZCC5 "GAZ  CARB Speichercode Bit 5" VALUE 0xF30CC MSA15_FW3 0 DEZ_DW_U 0.000000 65535.000000 /end CHARACTERISTIC
/begin CHARACTERISTIC fbwSGAZCC6 "GAZ  CARB Speichercode Bit 6" VALUE 0xF30CE MSA15_FW3 0 DEZ_DW_U 0.000000 65535.000000 /end CHARACTERISTIC
/begin CHARACTERISTIC fbwSGAZCC7 "GAZ  CARB Speichercode Bit 7" VALUE 0xF30D0 MSA15_FW3 0 DEZ_DW_U 0.000000 65535.000000 /end CHARACTERISTIC
/begin CHARACTERISTIC fbwSGAZENT "GAZ  Entrprellmodus" VALUE 0xF30BD MSA15_FW1 0 DEZ_DB_U 0.000000 255.000000 /end CHARACTERISTIC
/begin CHARACTERISTIC fbwSGAZFLC "GAZ  Startwert Eintragzaehler" VALUE 0xF30BE MSA15_FW1 0 DEZ_DB_U 0.000000 255.000000 /end CHARACTERISTIC
/begin CHARACTERISTIC fbwSGAZHLC "GAZ  Startwert Heilungszaehler" VALUE 0xF30BF MSA15_FW1 0 DEZ_DB_U 0.000000 255.000000 /end CHARACTERISTIC
/begin CHARACTERISTIC fbwSGAZPRI "GAZ  Prioritaet" VALUE 0xF30BC MSA15_FW1 0 DEZ_DB_U 0.000000 3.000000 EXTENDED_LIMITS 0.000000 255.000000 /end CHARACTERISTIC
/begin CHARACTERISTIC fbwSGAZSPC "GAZ  Code fuer Fehlerspeicherung" VALUE 0xF30BA MSA15_FW3 0 DEZ_DW_U 0.000000 65535.000000 /end CHARACTERISTIC
/begin CHARACTERISTIC fbwSGAZUB1 "GAZ Umweltbedingung 1 fuer Fehlerspeicherung" VALUE 0xF30D2 MSA15_FW3 0 DEZ_DW_U 0.000000 65535.000000 /end CHARACTERISTIC
/begin CHARACTERISTIC fbwSGAZUB2 "GAZ Umweltbedingung 2 fuer Fehlerspeicherung" VALUE 0xF30D4 MSA15_FW3 0 DEZ_DW_U 0.000000 65535.000000 /end CHARACTERISTIC
/begin CHARACTERISTIC fbwSGAZUB3 "GAZ Umweltbedingung 3 fuer Fehlerspeicherung" VALUE 0xF30D6 MSA15_FW3 0 DEZ_DW_U 0.000000 65535.000000 /end CHARACTERISTIC
/begin CHARACTERISTIC fbwSGAZUB4 "GAZ Umweltbedingung 4 fuer Fehlerspeicherung" VALUE 0xF30D8 MSA15_FW3 0 DEZ_DW_U 0.000000 65535.000000 /end CHARACTERISTIC
/begin CHARACTERISTIC fbwSGRSBCO "GRS  Blinkcode" VALUE 0xF2E98 MSA15_FW3 0 DEZ_DW_U 0.000000 65535.000000 /end CHARACTERISTIC
/begin CHARACTERISTIC fbwSGRSCC0 "GRS  CARB Speichercode Bit 0" VALUE 0xF2E9A MSA15_FW3 0 DEZ_DW_U 0.000000 65535.000000 /end CHARACTERISTIC
/begin CHARACTERISTIC fbwSGRSCC1 "GRS  CARB Speichercode Bit 1" VALUE 0xF2E9C MSA15_FW3 0 DEZ_DW_U 0.000000 65535.000000 /end CHARACTERISTIC
/begin CHARACTERISTIC fbwSGRSCC2 "GRS  CARB Speichercode Bit 2" VALUE 0xF2E9E MSA15_FW3 0 DEZ_DW_U 0.000000 65535.000000 /end CHARACTERISTIC
/begin CHARACTERISTIC fbwSGRSCC3 "GRS  CARB Speichercode Bit 3" VALUE 0xF2EA0 MSA15_FW3 0 DEZ_DW_U 0.000000 65535.000000 /end CHARACTERISTIC
/begin CHARACTERISTIC fbwSGRSCC4 "GRS  CARB Speichercode Bit 4" VALUE 0xF2EA2 MSA15_FW3 0 DEZ_DW_U 0.000000 65535.000000 /end CHARACTERISTIC
/begin CHARACTERISTIC fbwSGRSCC5 "GRS  CARB Speichercode Bit 5" VALUE 0xF2EA4 MSA15_FW3 0 DEZ_DW_U 0.000000 65535.000000 /end CHARACTERISTIC
/begin CHARACTERISTIC fbwSGRSCC6 "GRS  CARB Speichercode Bit 6" VALUE 0xF2EA6 MSA15_FW3 0 DEZ_DW_U 0.000000 65535.000000 /end CHARACTERISTIC
/begin CHARACTERISTIC fbwSGRSCC7 "GRS  CARB Speichercode Bit 7" VALUE 0xF2EA8 MSA15_FW3 0 DEZ_DW_U 0.000000 65535.000000 /end CHARACTERISTIC
/begin CHARACTERISTIC fbwSGRSENT "GRS  Entrprellmodus" VALUE 0xF2E95 MSA15_FW1 0 DEZ_DB_U 0.000000 255.000000 /end CHARACTERISTIC
/begin CHARACTERISTIC fbwSGRSFLC "GRS  Startwert Eintragzaehler" VALUE 0xF2E96 MSA15_FW1 0 DEZ_DB_U 0.000000 255.000000 /end CHARACTERISTIC
/begin CHARACTERISTIC fbwSGRSHLC "GRS  Startwert Heilungszaehler" VALUE 0xF2E97 MSA15_FW1 0 DEZ_DB_U 0.000000 255.000000 /end CHARACTERISTIC
/begin CHARACTERISTIC fbwSGRSPRI "GRS  Prioritaet" VALUE 0xF2E94 MSA15_FW1 0 DEZ_DB_U 0.000000 3.000000 EXTENDED_LIMITS 0.000000 255.000000 /end CHARACTERISTIC
/begin CHARACTERISTIC fbwSGRSSPC "GRS  Code fuer Fehlerspeicherung" VALUE 0xF2E92 MSA15_FW3 0 DEZ_DW_U 0.000000 65535.000000 /end CHARACTERISTIC
/begin CHARACTERISTIC fbwSGRSUB1 "GRS Umweltbedingung 1 fuer Fehlerspeicherung" VALUE 0xF2EAA MSA15_FW3 0 DEZ_DW_U 0.000000 65535.000000 /end CHARACTERISTIC
/begin CHARACTERISTIC fbwSGRSUB2 "GRS Umweltbedingung 2 fuer Fehlerspeicherung" VALUE 0xF2EAC MSA15_FW3 0 DEZ_DW_U 0.000000 65535.000000 /end CHARACTERISTIC
/begin CHARACTERISTIC fbwSGRSUB3 "GRS Umweltbedingung 3 fuer Fehlerspeicherung" VALUE 0xF2EAE MSA15_FW3 0 DEZ_DW_U 0.000000 65535.000000 /end CHARACTERISTIC
/begin CHARACTERISTIC fbwSGRSUB4 "GRS Umweltbedingung 4 fuer Fehlerspeicherung" VALUE 0xF2EB0 MSA15_FW3 0 DEZ_DW_U 0.000000 65535.000000 /end CHARACTERISTIC
/begin CHARACTERISTIC fbwSGZ1BCO "GZ1  Blinkcode" VALUE 0xF3462 MSA15_FW3 0 DEZ_DW_U 0.000000 65535.000000 /end CHARACTERISTIC
/begin CHARACTERISTIC fbwSGZ1CC0 "GZ1  CARB Speichercode Bit 0" VALUE 0xF3464 MSA15_FW3 0 DEZ_DW_U 0.000000 65535.000000 /end CHARACTERISTIC
/begin CHARACTERISTIC fbwSGZ1CC1 "GZ1  CARB Speichercode Bit 1" VALUE 0xF3466 MSA15_FW3 0 DEZ_DW_U 0.000000 65535.000000 /end CHARACTERISTIC
/begin CHARACTERISTIC fbwSGZ1CC2 "GZ1  CARB Speichercode Bit 2" VALUE 0xF3468 MSA15_FW3 0 DEZ_DW_U 0.000000 65535.000000 /end CHARACTERISTIC
/begin CHARACTERISTIC fbwSGZ1CC3 "GZ1  CARB Speichercode Bit 3" VALUE 0xF346A MSA15_FW3 0 DEZ_DW_U 0.000000 65535.000000 /end CHARACTERISTIC
/begin CHARACTERISTIC fbwSGZ1CC4 "GZ1  CARB Speichercode Bit 4" VALUE 0xF346C MSA15_FW3 0 DEZ_DW_U 0.000000 65535.000000 /end CHARACTERISTIC
/begin CHARACTERISTIC fbwSGZ1CC5 "GZ1  CARB Speichercode Bit 5" VALUE 0xF346E MSA15_FW3 0 DEZ_DW_U 0.000000 65535.000000 /end CHARACTERISTIC
/begin CHARACTERISTIC fbwSGZ1CC6 "GZ1  CARB Speichercode Bit 6" VALUE 0xF3470 MSA15_FW3 0 DEZ_DW_U 0.000000 65535.000000 /end CHARACTERISTIC
/begin CHARACTERISTIC fbwSGZ1CC7 "GZ1  CARB Speichercode Bit 7" VALUE 0xF3472 MSA15_FW3 0 DEZ_DW_U 0.000000 65535.000000 /end CHARACTERISTIC
/begin CHARACTERISTIC fbwSGZ1ENT "GZ1  Entrprellmodus" VALUE 0xF345F MSA15_FW1 0 DEZ_DB_U 0.000000 255.000000 /end CHARACTERISTIC
/begin CHARACTERISTIC fbwSGZ1FLC "GZ1  Startwert Eintragzaehler" VALUE 0xF3460 MSA15_FW1 0 DEZ_DB_U 0.000000 255.000000 /end CHARACTERISTIC
/begin CHARACTERISTIC fbwSGZ1HLC "GZ1  Startwert Heilungszaehler" VALUE 0xF3461 MSA15_FW1 0 DEZ_DB_U 0.000000 255.000000 /end CHARACTERISTIC
/begin CHARACTERISTIC fbwSGZ1PRI "GZ1  Prioritaet" VALUE 0xF345E MSA15_FW1 0 DEZ_DB_U 0.000000 3.000000 EXTENDED_LIMITS 0.000000 255.000000 /end CHARACTERISTIC
/begin CHARACTERISTIC fbwSGZ1SPC "GZ1  Code fuer Fehlerspeicherung" VALUE 0xF345C MSA15_FW3 0 DEZ_DW_U 0.000000 65535.000000 /end CHARACTERISTIC
/begin CHARACTERISTIC fbwSGZ1UB1 "GZ1  Umweltbedingung 1 fuer Fehlerspeicherung" VALUE 0xF3474 MSA15_FW3 0 DEZ_DW_U 0.000000 65535.000000 /end CHARACTERISTIC
/begin CHARACTERISTIC fbwSGZ1UB2 "GZ1  Umweltbedingung 2 fuer Fehlerspeicherung" VALUE 0xF3476 MSA15_FW3 0 DEZ_DW_U 0.000000 65535.000000 /end CHARACTERISTIC
/begin CHARACTERISTIC fbwSGZ1UB3 "GZ1  Umweltbedingung 3 fuer Fehlerspeicherung" VALUE 0xF3478 MSA15_FW3 0 DEZ_DW_U 0.000000 65535.000000 /end CHARACTERISTIC
/begin CHARACTERISTIC fbwSGZ1UB4 "GZ1  Umweltbedingung 4 fuer Fehlerspeicherung" VALUE 0xF347A MSA15_FW3 0 DEZ_DW_U 0.000000 65535.000000 /end CHARACTERISTIC
/begin CHARACTERISTIC fbwSGZ2BCO "GZ2  Blinkcode" VALUE 0xF34C6 MSA15_FW3 0 DEZ_DW_U 0.000000 65535.000000 /end CHARACTERISTIC
/begin CHARACTERISTIC fbwSGZ2CC0 "GZ2  CARB Speichercode Bit 0" VALUE 0xF34C8 MSA15_FW3 0 DEZ_DW_U 0.000000 65535.000000 /end CHARACTERISTIC
/begin CHARACTERISTIC fbwSGZ2CC1 "GZ2  CARB Speichercode Bit 1" VALUE 0xF34CA MSA15_FW3 0 DEZ_DW_U 0.000000 65535.000000 /end CHARACTERISTIC
/begin CHARACTERISTIC fbwSGZ2CC2 "GZ2  CARB Speichercode Bit 2" VALUE 0xF34CC MSA15_FW3 0 DEZ_DW_U 0.000000 65535.000000 /end CHARACTERISTIC
/begin CHARACTERISTIC fbwSGZ2CC3 "GZ2  CARB Speichercode Bit 3" VALUE 0xF34CE MSA15_FW3 0 DEZ_DW_U 0.000000 65535.000000 /end CHARACTERISTIC
/begin CHARACTERISTIC fbwSGZ2CC4 "GZ2  CARB Speichercode Bit 4" VALUE 0xF34D0 MSA15_FW3 0 DEZ_DW_U 0.000000 65535.000000 /end CHARACTERISTIC
/begin CHARACTERISTIC fbwSGZ2CC5 "GZ2  CARB Speichercode Bit 5" VALUE 0xF34D2 MSA15_FW3 0 DEZ_DW_U 0.000000 65535.000000 /end CHARACTERISTIC
/begin CHARACTERISTIC fbwSGZ2CC6 "GZ2  CARB Speichercode Bit 6" VALUE 0xF34D4 MSA15_FW3 0 DEZ_DW_U 0.000000 65535.000000 /end CHARACTERISTIC
/begin CHARACTERISTIC fbwSGZ2CC7 "GZ2  CARB Speichercode Bit 7" VALUE 0xF34D6 MSA15_FW3 0 DEZ_DW_U 0.000000 65535.000000 /end CHARACTERISTIC
/begin CHARACTERISTIC fbwSGZ2ENT "GZ2  Entrprellmodus" VALUE 0xF34C3 MSA15_FW1 0 DEZ_DB_U 0.000000 255.000000 /end CHARACTERISTIC
/begin CHARACTERISTIC fbwSGZ2FLC "GZ2  Startwert Eintragzaehler" VALUE 0xF34C4 MSA15_FW1 0 DEZ_DB_U 0.000000 255.000000 /end CHARACTERISTIC
/begin CHARACTERISTIC fbwSGZ2HLC "GZ2  Startwert Heilungszaehler" VALUE 0xF34C5 MSA15_FW1 0 DEZ_DB_U 0.000000 255.000000 /end CHARACTERISTIC
/begin CHARACTERISTIC fbwSGZ2PRI "GZ2  Prioritaet" VALUE 0xF34C2 MSA15_FW1 0 DEZ_DB_U 0.000000 3.000000 EXTENDED_LIMITS 0.000000 255.000000 /end CHARACTERISTIC
/begin CHARACTERISTIC fbwSGZ2SPC "GZ2  Code fuer Fehlerspeicherung" VALUE 0xF34C0 MSA15_FW3 0 DEZ_DW_U 0.000000 65535.000000 /end CHARACTERISTIC
/begin CHARACTERISTIC fbwSGZ2UB1 "GZ2  Umweltbedingung 1 fuer Fehlerspeicherung" VALUE 0xF34D8 MSA15_FW3 0 DEZ_DW_U 0.000000 65535.000000 /end CHARACTERISTIC
/begin CHARACTERISTIC fbwSGZ2UB2 "GZ2  Umweltbedingung 2 fuer Fehlerspeicherung" VALUE 0xF34DA MSA15_FW3 0 DEZ_DW_U 0.000000 65535.000000 /end CHARACTERISTIC
/begin CHARACTERISTIC fbwSGZ2UB3 "GZ2  Umweltbedingung 3 fuer Fehlerspeicherung" VALUE 0xF34DC MSA15_FW3 0 DEZ_DW_U 0.000000 65535.000000 /end CHARACTERISTIC
/begin CHARACTERISTIC fbwSGZ2UB4 "GZ2  Umweltbedingung 4 fuer Fehlerspeicherung" VALUE 0xF34DE MSA15_FW3 0 DEZ_DW_U 0.000000 65535.000000 /end CHARACTERISTIC
/begin CHARACTERISTIC fbwSHGBBCO "HGB  Blinkcode" VALUE 0xF26EE MSA15_FW3 0 DEZ_DW_U 0.000000 65535.000000 /end CHARACTERISTIC
/begin CHARACTERISTIC fbwSHGBCC0 "HGB  CARB *!na Speichercode Bit 0" VALUE 0xF26F0 MSA15_FW3 0 DEZ_DW_U 0.000000 65535.000000 /end CHARACTERISTIC
/begin CHARACTERISTIC fbwSHGBCC1 "HGB  CARB *!na Speichercode Bit 1" VALUE 0xF26F2 MSA15_FW3 0 DEZ_DW_U 0.000000 65535.000000 /end CHARACTERISTIC
/begin CHARACTERISTIC fbwSHGBCC2 "HGB  CARB *!na Speichercode Bit 2" VALUE 0xF26F4 MSA15_FW3 0 DEZ_DW_U 0.000000 65535.000000 /end CHARACTERISTIC
/begin CHARACTERISTIC fbwSHGBCC3 "HGB  CARB *!na Speichercode Bit 3" VALUE 0xF26F6 MSA15_FW3 0 DEZ_DW_U 0.000000 65535.000000 /end CHARACTERISTIC
/begin CHARACTERISTIC fbwSHGBCC4 "HGB  CARB *!na Speichercode Bit 4" VALUE 0xF26F8 MSA15_FW3 0 DEZ_DW_U 0.000000 65535.000000 /end CHARACTERISTIC
/begin CHARACTERISTIC fbwSHGBCC5 "HGB  CARB *!na Speichercode Bit 5" VALUE 0xF26FA MSA15_FW3 0 DEZ_DW_U 0.000000 65535.000000 /end CHARACTERISTIC
/begin CHARACTERISTIC fbwSHGBCC6 "HGB  CARB *!na Speichercode Bit 6" VALUE 0xF26FC MSA15_FW3 0 DEZ_DW_U 0.000000 65535.000000 /end CHARACTERISTIC
/begin CHARACTERISTIC fbwSHGBCC7 "HGB  CARB *!na Speichercode Bit 7" VALUE 0xF26FE MSA15_FW3 0 DEZ_DW_U 0.000000 65535.000000 /end CHARACTERISTIC
/begin CHARACTERISTIC fbwSHGBENT "HGB  Entrprellmodus" VALUE 0xF26EB MSA15_FW1 0 DEZ_DB_U 0.000000 255.000000 /end CHARACTERISTIC
/begin CHARACTERISTIC fbwSHGBFLC "HGB  Startwert Eintragzaehler" VALUE 0xF26EC MSA15_FW1 0 DEZ_DB_U 0.000000 255.000000 /end CHARACTERISTIC
/begin CHARACTERISTIC fbwSHGBHLC "HGB  Startwert Heilungszaehler" VALUE 0xF26ED MSA15_FW1 0 DEZ_DB_U 0.000000 255.000000 /end CHARACTERISTIC
/begin CHARACTERISTIC fbwSHGBPRI "HGB  Prioritaet" VALUE 0xF26EA MSA15_FW1 0 DEZ_DB_U 0.000000 3.000000 EXTENDED_LIMITS 0.000000 255.000000 /end CHARACTERISTIC
/begin CHARACTERISTIC fbwSHGBSPC "HGB  Code fuer Fehlerspeicherung" VALUE 0xF26E8 MSA15_FW3 0 DEZ_DW_U 0.000000 65535.000000 /end CHARACTERISTIC
/begin CHARACTERISTIC fbwSHGBUB1 "HGB  *!na Unweltbedingung 1 fuer Fehlerspeicherung" VALUE 0xF2700 MSA15_FW3 0 DEZ_DW_U 0.000000 65535.000000 /end CHARACTERISTIC
/begin CHARACTERISTIC fbwSHGBUB2 "HGB  *!na Unweltbedingung 2 fuer Fehlerspeicherung" VALUE 0xF2702 MSA15_FW3 0 DEZ_DW_U 0.000000 65535.000000 /end CHARACTERISTIC
/begin CHARACTERISTIC fbwSHGBUB3 "HGB  *!na Unweltbedingung 3 fuer Fehlerspeicherung" VALUE 0xF2704 MSA15_FW3 0 DEZ_DW_U 0.000000 65535.000000 /end CHARACTERISTIC
/begin CHARACTERISTIC fbwSHGBUB4 "HGB  *!na Unweltbedingung 4 fuer Fehlerspeicherung" VALUE 0xF2706 MSA15_FW3 0 DEZ_DW_U 0.000000 65535.000000 /end CHARACTERISTIC
/begin CHARACTERISTIC fbwSHRLBCO "HRL  Blinkcode" VALUE 0xF2C24 MSA15_FW3 0 DEZ_DW_U 0.000000 65535.000000 /end CHARACTERISTIC
/begin CHARACTERISTIC fbwSHRLCC0 "HRL  CARB Speichercode Bit 0" VALUE 0xF2C26 MSA15_FW3 0 DEZ_DW_U 0.000000 65535.000000 /end CHARACTERISTIC
/begin CHARACTERISTIC fbwSHRLCC1 "HRL  CARB Speichercode Bit 1" VALUE 0xF2C28 MSA15_FW3 0 DEZ_DW_U 0.000000 65535.000000 /end CHARACTERISTIC
/begin CHARACTERISTIC fbwSHRLCC2 "HRL  CARB Speichercode Bit 2" VALUE 0xF2C2A MSA15_FW3 0 DEZ_DW_U 0.000000 65535.000000 /end CHARACTERISTIC
/begin CHARACTERISTIC fbwSHRLCC3 "HRL  CARB Speichercode Bit 3" VALUE 0xF2C2C MSA15_FW3 0 DEZ_DW_U 0.000000 65535.000000 /end CHARACTERISTIC
/begin CHARACTERISTIC fbwSHRLCC4 "HRL  CARB Speichercode Bit 4" VALUE 0xF2C2E MSA15_FW3 0 DEZ_DW_U 0.000000 65535.000000 /end CHARACTERISTIC
/begin CHARACTERISTIC fbwSHRLCC5 "HRL  CARB Speichercode Bit 5" VALUE 0xF2C30 MSA15_FW3 0 DEZ_DW_U 0.000000 65535.000000 /end CHARACTERISTIC
/begin CHARACTERISTIC fbwSHRLCC6 "HRL  CARB Speichercode Bit 6" VALUE 0xF2C32 MSA15_FW3 0 DEZ_DW_U 0.000000 65535.000000 /end CHARACTERISTIC
/begin CHARACTERISTIC fbwSHRLCC7 "HRL  CARB Speichercode Bit 7" VALUE 0xF2C34 MSA15_FW3 0 DEZ_DW_U 0.000000 65535.000000 /end CHARACTERISTIC
/begin CHARACTERISTIC fbwSHRLENT "HRL  Entrprellmodus" VALUE 0xF2C21 MSA15_FW1 0 DEZ_DB_U 0.000000 255.000000 /end CHARACTERISTIC
/begin CHARACTERISTIC fbwSHRLFLC "HRL  Startwert Eintragzaehler" VALUE 0xF2C22 MSA15_FW1 0 DEZ_DB_U 0.000000 255.000000 /end CHARACTERISTIC
/begin CHARACTERISTIC fbwSHRLHLC "HRL  Startwert Heilungszaehler" VALUE 0xF2C23 MSA15_FW1 0 DEZ_DB_U 0.000000 255.000000 /end CHARACTERISTIC
/begin CHARACTERISTIC fbwSHRLPRI "HRL  Prioritaet" VALUE 0xF2C20 MSA15_FW1 0 DEZ_DB_U 0.000000 3.000000 EXTENDED_LIMITS 0.000000 255.000000 /end CHARACTERISTIC
/begin CHARACTERISTIC fbwSHRLSPC "HRL  Code fuer Fehlerspeicherung" VALUE 0xF2C1E MSA15_FW3 0 DEZ_DW_U 0.000000 65535.000000 /end CHARACTERISTIC
/begin CHARACTERISTIC fbwSHRLUB1 "HRL Umweltbedingung 1 fuer Fehlerspeicherung" VALUE 0xF2C36 MSA15_FW3 0 DEZ_DW_U 0.000000 65535.000000 /end CHARACTERISTIC
/begin CHARACTERISTIC fbwSHRLUB2 "HRL Umweltbedingung 2 fuer Fehlerspeicherung" VALUE 0xF2C38 MSA15_FW3 0 DEZ_DW_U 0.000000 65535.000000 /end CHARACTERISTIC
/begin CHARACTERISTIC fbwSHRLUB3 "HRL Umweltbedingung 3 fuer Fehlerspeicherung" VALUE 0xF2C3A MSA15_FW3 0 DEZ_DW_U 0.000000 65535.000000 /end CHARACTERISTIC
/begin CHARACTERISTIC fbwSHRLUB4 "HRL Umweltbedingung 4 fuer Fehlerspeicherung" VALUE 0xF2C3C MSA15_FW3 0 DEZ_DW_U 0.000000 65535.000000 /end CHARACTERISTIC
/begin CHARACTERISTIC fbwSI11BCO "I11  Blinkcode" VALUE 0xF3150 MSA15_FW3 0 DEZ_DW_U 0.000000 65535.000000 /end CHARACTERISTIC
/begin CHARACTERISTIC fbwSI11CC0 "I11  CARB Speichercode Bit 0" VALUE 0xF3152 MSA15_FW3 0 DEZ_DW_U 0.000000 65535.000000 /end CHARACTERISTIC
/begin CHARACTERISTIC fbwSI11CC1 "I11  CARB Speichercode Bit 1" VALUE 0xF3154 MSA15_FW3 0 DEZ_DW_U 0.000000 65535.000000 /end CHARACTERISTIC
/begin CHARACTERISTIC fbwSI11CC2 "I11  CARB Speichercode Bit 2" VALUE 0xF3156 MSA15_FW3 0 DEZ_DW_U 0.000000 65535.000000 /end CHARACTERISTIC
/begin CHARACTERISTIC fbwSI11CC3 "I11  CARB Speichercode Bit 3" VALUE 0xF3158 MSA15_FW3 0 DEZ_DW_U 0.000000 65535.000000 /end CHARACTERISTIC
/begin CHARACTERISTIC fbwSI11CC4 "I11  CARB Speichercode Bit 4" VALUE 0xF315A MSA15_FW3 0 DEZ_DW_U 0.000000 65535.000000 /end CHARACTERISTIC
/begin CHARACTERISTIC fbwSI11CC5 "I11  CARB Speichercode Bit 5" VALUE 0xF315C MSA15_FW3 0 DEZ_DW_U 0.000000 65535.000000 /end CHARACTERISTIC
/begin CHARACTERISTIC fbwSI11CC6 "I11  CARB Speichercode Bit 6" VALUE 0xF315E MSA15_FW3 0 DEZ_DW_U 0.000000 65535.000000 /end CHARACTERISTIC
/begin CHARACTERISTIC fbwSI11CC7 "I11  CARB Speichercode Bit 7" VALUE 0xF3160 MSA15_FW3 0 DEZ_DW_U 0.000000 65535.000000 /end CHARACTERISTIC
/begin CHARACTERISTIC fbwSI11ENT "I11  Entprellmodus" VALUE 0xF314D MSA15_FW1 0 DEZ_DB_U 0.000000 255.000000 /end CHARACTERISTIC
/begin CHARACTERISTIC fbwSI11FLC "I11  Startwert Eintragzaehler" VALUE 0xF314E MSA15_FW1 0 DEZ_DB_U 0.000000 255.000000 /end CHARACTERISTIC
/begin CHARACTERISTIC fbwSI11HLC "I11  Startwert Heilungszaehler" VALUE 0xF314F MSA15_FW1 0 DEZ_DB_U 0.000000 255.000000 /end CHARACTERISTIC
/begin CHARACTERISTIC fbwSI11PRI "I11  Prioritaet" VALUE 0xF314C MSA15_FW1 0 DEZ_DB_U 0.000000 3.000000 EXTENDED_LIMITS 0.000000 255.000000 /end CHARACTERISTIC
/begin CHARACTERISTIC fbwSI11SPC "I11  Code fuer Fehlerspeicherung" VALUE 0xF314A MSA15_FW3 0 DEZ_DW_U 0.000000 65535.000000 /end CHARACTERISTIC
/begin CHARACTERISTIC fbwSI11UB1 "I11 Umweltbedingung 1 fuer Fehlerspeicherung" VALUE 0xF3162 MSA15_FW3 0 DEZ_DW_U 0.000000 65535.000000 /end CHARACTERISTIC
/begin CHARACTERISTIC fbwSI11UB2 "I11 Umweltbedingung 2 fuer Fehlerspeicherung" VALUE 0xF3164 MSA15_FW3 0 DEZ_DW_U 0.000000 65535.000000 /end CHARACTERISTIC
/begin CHARACTERISTIC fbwSI11UB3 "I11 Umweltbedingung 3 fuer Fehlerspeicherung" VALUE 0xF3166 MSA15_FW3 0 DEZ_DW_U 0.000000 65535.000000 /end CHARACTERISTIC
/begin CHARACTERISTIC fbwSI11UB4 "I11 Umweltbedingung 4 fuer Fehlerspeicherung" VALUE 0xF3168 MSA15_FW3 0 DEZ_DW_U 0.000000 65535.000000 /end CHARACTERISTIC
/begin CHARACTERISTIC fbwSI12BCO "I12  Blinkcode" VALUE 0xF3238 MSA15_FW3 0 DEZ_DW_U 0.000000 65535.000000 /end CHARACTERISTIC
/begin CHARACTERISTIC fbwSI12CC0 "I12  CARB Speichercode Bit 0" VALUE 0xF323A MSA15_FW3 0 DEZ_DW_U 0.000000 65535.000000 /end CHARACTERISTIC
/begin CHARACTERISTIC fbwSI12CC1 "I12  CARB Speichercode Bit 1" VALUE 0xF323C MSA15_FW3 0 DEZ_DW_U 0.000000 65535.000000 /end CHARACTERISTIC
/begin CHARACTERISTIC fbwSI12CC2 "I12  CARB Speichercode Bit 2" VALUE 0xF323E MSA15_FW3 0 DEZ_DW_U 0.000000 65535.000000 /end CHARACTERISTIC
/begin CHARACTERISTIC fbwSI12CC3 "I12  CARB Speichercode Bit 3" VALUE 0xF3240 MSA15_FW3 0 DEZ_DW_U 0.000000 65535.000000 /end CHARACTERISTIC
/begin CHARACTERISTIC fbwSI12CC4 "I12  CARB Speichercode Bit 4" VALUE 0xF3242 MSA15_FW3 0 DEZ_DW_U 0.000000 65535.000000 /end CHARACTERISTIC
/begin CHARACTERISTIC fbwSI12CC5 "I12  CARB Speichercode Bit 5" VALUE 0xF3244 MSA15_FW3 0 DEZ_DW_U 0.000000 65535.000000 /end CHARACTERISTIC
/begin CHARACTERISTIC fbwSI12CC6 "I12  CARB Speichercode Bit 6" VALUE 0xF3246 MSA15_FW3 0 DEZ_DW_U 0.000000 65535.000000 /end CHARACTERISTIC
/begin CHARACTERISTIC fbwSI12CC7 "I12  CARB Speichercode Bit 7" VALUE 0xF3248 MSA15_FW3 0 DEZ_DW_U 0.000000 65535.000000 /end CHARACTERISTIC
/begin CHARACTERISTIC fbwSI12ENT "I12  Entprellmodus" VALUE 0xF3235 MSA15_FW1 0 DEZ_DB_U 0.000000 255.000000 /end CHARACTERISTIC
/begin CHARACTERISTIC fbwSI12FLC "I12  Startwert Eintragzaehler" VALUE 0xF3236 MSA15_FW1 0 DEZ_DB_U 0.000000 255.000000 /end CHARACTERISTIC
/begin CHARACTERISTIC fbwSI12HLC "I12  Startwert Heilungszaehler" VALUE 0xF3237 MSA15_FW1 0 DEZ_DB_U 0.000000 255.000000 /end CHARACTERISTIC
/begin CHARACTERISTIC fbwSI12PRI "I12  Prioritaet" VALUE 0xF3234 MSA15_FW1 0 DEZ_DB_U 0.000000 3.000000 EXTENDED_LIMITS 0.000000 255.000000 /end CHARACTERISTIC
/begin CHARACTERISTIC fbwSI12SPC "I12  Code fuer Fehlerspeicherung" VALUE 0xF3232 MSA15_FW3 0 DEZ_DW_U 0.000000 65535.000000 /end CHARACTERISTIC
/begin CHARACTERISTIC fbwSI12UB1 "I12 Umweltbedingung 1 fuer Fehlerspeicherung" VALUE 0xF324A MSA15_FW3 0 DEZ_DW_U 0.000000 65535.000000 /end CHARACTERISTIC
/begin CHARACTERISTIC fbwSI12UB2 "I12 Umweltbedingung 2 fuer Fehlerspeicherung" VALUE 0xF324C MSA15_FW3 0 DEZ_DW_U 0.000000 65535.000000 /end CHARACTERISTIC
/begin CHARACTERISTIC fbwSI12UB3 "I12 Umweltbedingung 3 fuer Fehlerspeicherung" VALUE 0xF324E MSA15_FW3 0 DEZ_DW_U 0.000000 65535.000000 /end CHARACTERISTIC
/begin CHARACTERISTIC fbwSI12UB4 "I12 Umweltbedingung 4 fuer Fehlerspeicherung" VALUE 0xF3250 MSA15_FW3 0 DEZ_DW_U 0.000000 65535.000000 /end CHARACTERISTIC
/begin CHARACTERISTIC fbwSI21BCO "I21  Blinkcode" VALUE 0xF318A MSA15_FW3 0 DEZ_DW_U 0.000000 65535.000000 /end CHARACTERISTIC
/begin CHARACTERISTIC fbwSI21CC0 "I21  CARB Speichercode Bit 0" VALUE 0xF318C MSA15_FW3 0 DEZ_DW_U 0.000000 65535.000000 /end CHARACTERISTIC
/begin CHARACTERISTIC fbwSI21CC1 "I21  CARB Speichercode Bit 1" VALUE 0xF318E MSA15_FW3 0 DEZ_DW_U 0.000000 65535.000000 /end CHARACTERISTIC
/begin CHARACTERISTIC fbwSI21CC2 "I21  CARB Speichercode Bit 2" VALUE 0xF3190 MSA15_FW3 0 DEZ_DW_U 0.000000 65535.000000 /end CHARACTERISTIC
/begin CHARACTERISTIC fbwSI21CC3 "I21  CARB Speichercode Bit 3" VALUE 0xF3192 MSA15_FW3 0 DEZ_DW_U 0.000000 65535.000000 /end CHARACTERISTIC
/begin CHARACTERISTIC fbwSI21CC4 "I21  CARB Speichercode Bit 4" VALUE 0xF3194 MSA15_FW3 0 DEZ_DW_U 0.000000 65535.000000 /end CHARACTERISTIC
/begin CHARACTERISTIC fbwSI21CC5 "I21  CARB Speichercode Bit 5" VALUE 0xF3196 MSA15_FW3 0 DEZ_DW_U 0.000000 65535.000000 /end CHARACTERISTIC
/begin CHARACTERISTIC fbwSI21CC6 "I21  CARB Speichercode Bit 6" VALUE 0xF3198 MSA15_FW3 0 DEZ_DW_U 0.000000 65535.000000 /end CHARACTERISTIC
/begin CHARACTERISTIC fbwSI21CC7 "I21  CARB Speichercode Bit 7" VALUE 0xF319A MSA15_FW3 0 DEZ_DW_U 0.000000 65535.000000 /end CHARACTERISTIC
/begin CHARACTERISTIC fbwSI21ENT "I21  Entprellmodus" VALUE 0xF3187 MSA15_FW1 0 DEZ_DB_U 0.000000 255.000000 /end CHARACTERISTIC
/begin CHARACTERISTIC fbwSI21FLC "I21  Startwert Eintragzaehler" VALUE 0xF3188 MSA15_FW1 0 DEZ_DB_U 0.000000 255.000000 /end CHARACTERISTIC
/begin CHARACTERISTIC fbwSI21HLC "I21  Startwert Heilungszaehler" VALUE 0xF3189 MSA15_FW1 0 DEZ_DB_U 0.000000 255.000000 /end CHARACTERISTIC
/begin CHARACTERISTIC fbwSI21PRI "I21  Prioritaet" VALUE 0xF3186 MSA15_FW1 0 DEZ_DB_U 0.000000 3.000000 EXTENDED_LIMITS 0.000000 255.000000 /end CHARACTERISTIC
/begin CHARACTERISTIC fbwSI21SPC "I21  Code fuer Fehlerspeicherung" VALUE 0xF3184 MSA15_FW3 0 DEZ_DW_U 0.000000 65535.000000 /end CHARACTERISTIC
/begin CHARACTERISTIC fbwSI21UB1 "I21 Umweltbedingung 1 fuer Fehlerspeicherung" VALUE 0xF319C MSA15_FW3 0 DEZ_DW_U 0.000000 65535.000000 /end CHARACTERISTIC
/begin CHARACTERISTIC fbwSI21UB2 "I21 Umweltbedingung 2 fuer Fehlerspeicherung" VALUE 0xF319E MSA15_FW3 0 DEZ_DW_U 0.000000 65535.000000 /end CHARACTERISTIC
/begin CHARACTERISTIC fbwSI21UB3 "I21 Umweltbedingung 3 fuer Fehlerspeicherung" VALUE 0xF31A0 MSA15_FW3 0 DEZ_DW_U 0.000000 65535.000000 /end CHARACTERISTIC
/begin CHARACTERISTIC fbwSI21UB4 "I21 Umweltbedingung 4 fuer Fehlerspeicherung" VALUE 0xF31A2 MSA15_FW3 0 DEZ_DW_U 0.000000 65535.000000 /end CHARACTERISTIC
/begin CHARACTERISTIC fbwSI22BCO "I22  Blinkcode" VALUE 0xF3272 MSA15_FW3 0 DEZ_DW_U 0.000000 65535.000000 /end CHARACTERISTIC
/begin CHARACTERISTIC fbwSI22CC0 "I22  CARB Speichercode Bit 0" VALUE 0xF3274 MSA15_FW3 0 DEZ_DW_U 0.000000 65535.000000 /end CHARACTERISTIC
/begin CHARACTERISTIC fbwSI22CC1 "I22  CARB Speichercode Bit 1" VALUE 0xF3276 MSA15_FW3 0 DEZ_DW_U 0.000000 65535.000000 /end CHARACTERISTIC
/begin CHARACTERISTIC fbwSI22CC2 "I22  CARB Speichercode Bit 2" VALUE 0xF3278 MSA15_FW3 0 DEZ_DW_U 0.000000 65535.000000 /end CHARACTERISTIC
/begin CHARACTERISTIC fbwSI22CC3 "I22  CARB Speichercode Bit 3" VALUE 0xF327A MSA15_FW3 0 DEZ_DW_U 0.000000 65535.000000 /end CHARACTERISTIC
/begin CHARACTERISTIC fbwSI22CC4 "I22  CARB Speichercode Bit 4" VALUE 0xF327C MSA15_FW3 0 DEZ_DW_U 0.000000 65535.000000 /end CHARACTERISTIC
/begin CHARACTERISTIC fbwSI22CC5 "I22  CARB Speichercode Bit 5" VALUE 0xF327E MSA15_FW3 0 DEZ_DW_U 0.000000 65535.000000 /end CHARACTERISTIC
/begin CHARACTERISTIC fbwSI22CC6 "I22  CARB Speichercode Bit 6" VALUE 0xF3280 MSA15_FW3 0 DEZ_DW_U 0.000000 65535.000000 /end CHARACTERISTIC
/begin CHARACTERISTIC fbwSI22CC7 "I22  CARB Speichercode Bit 7" VALUE 0xF3282 MSA15_FW3 0 DEZ_DW_U 0.000000 65535.000000 /end CHARACTERISTIC
/begin CHARACTERISTIC fbwSI22ENT "I22  Entprellmodus" VALUE 0xF326F MSA15_FW1 0 DEZ_DB_U 0.000000 255.000000 /end CHARACTERISTIC
/begin CHARACTERISTIC fbwSI22FLC "I22  Startwert Eintragzaehler" VALUE 0xF3270 MSA15_FW1 0 DEZ_DB_U 0.000000 255.000000 /end CHARACTERISTIC
/begin CHARACTERISTIC fbwSI22HLC "I22  Startwert Heilungszaehler" VALUE 0xF3271 MSA15_FW1 0 DEZ_DB_U 0.000000 255.000000 /end CHARACTERISTIC
/begin CHARACTERISTIC fbwSI22PRI "I22  Prioritaet" VALUE 0xF326E MSA15_FW1 0 DEZ_DB_U 0.000000 3.000000 EXTENDED_LIMITS 0.000000 255.000000 /end CHARACTERISTIC
/begin CHARACTERISTIC fbwSI22SPC "I22  Code fuer Fehlerspeicherung" VALUE 0xF326C MSA15_FW3 0 DEZ_DW_U 0.000000 65535.000000 /end CHARACTERISTIC
/begin CHARACTERISTIC fbwSI22UB1 "I22 Umweltbedingung 1 fuer Fehlerspeicherung" VALUE 0xF3284 MSA15_FW3 0 DEZ_DW_U 0.000000 65535.000000 /end CHARACTERISTIC
/begin CHARACTERISTIC fbwSI22UB2 "I22 Umweltbedingung 2 fuer Fehlerspeicherung" VALUE 0xF3286 MSA15_FW3 0 DEZ_DW_U 0.000000 65535.000000 /end CHARACTERISTIC
/begin CHARACTERISTIC fbwSI22UB3 "I22 Umweltbedingung 3 fuer Fehlerspeicherung" VALUE 0xF3288 MSA15_FW3 0 DEZ_DW_U 0.000000 65535.000000 /end CHARACTERISTIC
/begin CHARACTERISTIC fbwSI22UB4 "I22 Umweltbedingung 4 fuer Fehlerspeicherung" VALUE 0xF328A MSA15_FW3 0 DEZ_DW_U 0.000000 65535.000000 /end CHARACTERISTIC
/begin CHARACTERISTIC fbwSI31BCO "I31  Blinkcode" VALUE 0xF31C4 MSA15_FW3 0 DEZ_DW_U 0.000000 65535.000000 /end CHARACTERISTIC
/begin CHARACTERISTIC fbwSI31CC0 "I31  CARB Speichercode Bit 0" VALUE 0xF31C6 MSA15_FW3 0 DEZ_DW_U 0.000000 65535.000000 /end CHARACTERISTIC
/begin CHARACTERISTIC fbwSI31CC1 "I31  CARB Speichercode Bit 1" VALUE 0xF31C8 MSA15_FW3 0 DEZ_DW_U 0.000000 65535.000000 /end CHARACTERISTIC
/begin CHARACTERISTIC fbwSI31CC2 "I31  CARB Speichercode Bit 2" VALUE 0xF31CA MSA15_FW3 0 DEZ_DW_U 0.000000 65535.000000 /end CHARACTERISTIC
/begin CHARACTERISTIC fbwSI31CC3 "I31  CARB Speichercode Bit 3" VALUE 0xF31CC MSA15_FW3 0 DEZ_DW_U 0.000000 65535.000000 /end CHARACTERISTIC
/begin CHARACTERISTIC fbwSI31CC4 "I31  CARB Speichercode Bit 4" VALUE 0xF31CE MSA15_FW3 0 DEZ_DW_U 0.000000 65535.000000 /end CHARACTERISTIC
/begin CHARACTERISTIC fbwSI31CC5 "I31  CARB Speichercode Bit 5" VALUE 0xF31D0 MSA15_FW3 0 DEZ_DW_U 0.000000 65535.000000 /end CHARACTERISTIC
/begin CHARACTERISTIC fbwSI31CC6 "I31  CARB Speichercode Bit 6" VALUE 0xF31D2 MSA15_FW3 0 DEZ_DW_U 0.000000 65535.000000 /end CHARACTERISTIC
/begin CHARACTERISTIC fbwSI31CC7 "I31  CARB Speichercode Bit 7" VALUE 0xF31D4 MSA15_FW3 0 DEZ_DW_U 0.000000 65535.000000 /end CHARACTERISTIC
/begin CHARACTERISTIC fbwSI31ENT "I31  Entprellmodus" VALUE 0xF31C1 MSA15_FW1 0 DEZ_DB_U 0.000000 255.000000 /end CHARACTERISTIC
/begin CHARACTERISTIC fbwSI31FLC "I31  Startwert Eintragzaehler" VALUE 0xF31C2 MSA15_FW1 0 DEZ_DB_U 0.000000 255.000000 /end CHARACTERISTIC
/begin CHARACTERISTIC fbwSI31HLC "I31  Startwert Heilungszaehler" VALUE 0xF31C3 MSA15_FW1 0 DEZ_DB_U 0.000000 255.000000 /end CHARACTERISTIC
/begin CHARACTERISTIC fbwSI31PRI "I31  Prioritaet" VALUE 0xF31C0 MSA15_FW1 0 DEZ_DB_U 0.000000 3.000000 EXTENDED_LIMITS 0.000000 255.000000 /end CHARACTERISTIC
/begin CHARACTERISTIC fbwSI31SPC "I31  Code fuer Fehlerspeicherung" VALUE 0xF31BE MSA15_FW3 0 DEZ_DW_U 0.000000 65535.000000 /end CHARACTERISTIC
/begin CHARACTERISTIC fbwSI31UB1 "I31 Umweltbedingung 1 fuer Fehlerspeicherung" VALUE 0xF31D6 MSA15_FW3 0 DEZ_DW_U 0.000000 65535.000000 /end CHARACTERISTIC
/begin CHARACTERISTIC fbwSI31UB2 "I31 Umweltbedingung 2 fuer Fehlerspeicherung" VALUE 0xF31D8 MSA15_FW3 0 DEZ_DW_U 0.000000 65535.000000 /end CHARACTERISTIC
/begin CHARACTERISTIC fbwSI31UB3 "I31 Umweltbedingung 3 fuer Fehlerspeicherung" VALUE 0xF31DA MSA15_FW3 0 DEZ_DW_U 0.000000 65535.000000 /end CHARACTERISTIC
/begin CHARACTERISTIC fbwSI31UB4 "I31 Umweltbedingung 4 fuer Fehlerspeicherung" VALUE 0xF31DC MSA15_FW3 0 DEZ_DW_U 0.000000 65535.000000 /end CHARACTERISTIC
/begin CHARACTERISTIC fbwSI32BCO "I32  Blinkcode" VALUE 0xF32AC MSA15_FW3 0 DEZ_DW_U 0.000000 65535.000000 /end CHARACTERISTIC
/begin CHARACTERISTIC fbwSI32CC0 "I32  CARB Speichercode Bit 0" VALUE 0xF32AE MSA15_FW3 0 DEZ_DW_U 0.000000 65535.000000 /end CHARACTERISTIC
/begin CHARACTERISTIC fbwSI32CC1 "I32  CARB Speichercode Bit 1" VALUE 0xF32B0 MSA15_FW3 0 DEZ_DW_U 0.000000 65535.000000 /end CHARACTERISTIC
/begin CHARACTERISTIC fbwSI32CC2 "I32  CARB Speichercode Bit 2" VALUE 0xF32B2 MSA15_FW3 0 DEZ_DW_U 0.000000 65535.000000 /end CHARACTERISTIC
/begin CHARACTERISTIC fbwSI32CC3 "I32  CARB Speichercode Bit 3" VALUE 0xF32B4 MSA15_FW3 0 DEZ_DW_U 0.000000 65535.000000 /end CHARACTERISTIC
/begin CHARACTERISTIC fbwSI32CC4 "I32  CARB Speichercode Bit 4" VALUE 0xF32B6 MSA15_FW3 0 DEZ_DW_U 0.000000 65535.000000 /end CHARACTERISTIC
/begin CHARACTERISTIC fbwSI32CC5 "I32  CARB Speichercode Bit 5" VALUE 0xF32B8 MSA15_FW3 0 DEZ_DW_U 0.000000 65535.000000 /end CHARACTERISTIC
/begin CHARACTERISTIC fbwSI32CC6 "I32  CARB Speichercode Bit 6" VALUE 0xF32BA MSA15_FW3 0 DEZ_DW_U 0.000000 65535.000000 /end CHARACTERISTIC
/begin CHARACTERISTIC fbwSI32CC7 "I32  CARB Speichercode Bit 7" VALUE 0xF32BC MSA15_FW3 0 DEZ_DW_U 0.000000 65535.000000 /end CHARACTERISTIC
/begin CHARACTERISTIC fbwSI32ENT "I32  Entprellmodus" VALUE 0xF32A9 MSA15_FW1 0 DEZ_DB_U 0.000000 255.000000 /end CHARACTERISTIC
/begin CHARACTERISTIC fbwSI32FLC "I32  Startwert Eintragzaehler" VALUE 0xF32AA MSA15_FW1 0 DEZ_DB_U 0.000000 255.000000 /end CHARACTERISTIC
/begin CHARACTERISTIC fbwSI32HLC "I32  Startwert Heilungszaehler" VALUE 0xF32AB MSA15_FW1 0 DEZ_DB_U 0.000000 255.000000 /end CHARACTERISTIC
/begin CHARACTERISTIC fbwSI32PRI "I32  Prioritaet" VALUE 0xF32A8 MSA15_FW1 0 DEZ_DB_U 0.000000 3.000000 EXTENDED_LIMITS 0.000000 255.000000 /end CHARACTERISTIC
/begin CHARACTERISTIC fbwSI32SPC "I32  Code fuer Fehlerspeicherung" VALUE 0xF32A6 MSA15_FW3 0 DEZ_DW_U 0.000000 65535.000000 /end CHARACTERISTIC
/begin CHARACTERISTIC fbwSI32UB1 "I32 Umweltbedingung 1 fuer Fehlerspeicherung" VALUE 0xF32BE MSA15_FW3 0 DEZ_DW_U 0.000000 65535.000000 /end CHARACTERISTIC
/begin CHARACTERISTIC fbwSI32UB2 "I32 Umweltbedingung 2 fuer Fehlerspeicherung" VALUE 0xF32C0 MSA15_FW3 0 DEZ_DW_U 0.000000 65535.000000 /end CHARACTERISTIC
/begin CHARACTERISTIC fbwSI32UB3 "I32 Umweltbedingung 3 fuer Fehlerspeicherung" VALUE 0xF32C2 MSA15_FW3 0 DEZ_DW_U 0.000000 65535.000000 /end CHARACTERISTIC
/begin CHARACTERISTIC fbwSI32UB4 "I32 Umweltbedingung 4 fuer Fehlerspeicherung" VALUE 0xF32C4 MSA15_FW3 0 DEZ_DW_U 0.000000 65535.000000 /end CHARACTERISTIC
/begin CHARACTERISTIC fbwSI41BCO "I41  Blinkcode" VALUE 0xF31FE MSA15_FW3 0 DEZ_DW_U 0.000000 65535.000000 /end CHARACTERISTIC
/begin CHARACTERISTIC fbwSI41CC0 "I41  CARB Speichercode Bit 0" VALUE 0xF3200 MSA15_FW3 0 DEZ_DW_U 0.000000 65535.000000 /end CHARACTERISTIC
/begin CHARACTERISTIC fbwSI41CC1 "I41  CARB Speichercode Bit 1" VALUE 0xF3202 MSA15_FW3 0 DEZ_DW_U 0.000000 65535.000000 /end CHARACTERISTIC
/begin CHARACTERISTIC fbwSI41CC2 "I41  CARB Speichercode Bit 2" VALUE 0xF3204 MSA15_FW3 0 DEZ_DW_U 0.000000 65535.000000 /end CHARACTERISTIC
/begin CHARACTERISTIC fbwSI41CC3 "I41  CARB Speichercode Bit 3" VALUE 0xF3206 MSA15_FW3 0 DEZ_DW_U 0.000000 65535.000000 /end CHARACTERISTIC
/begin CHARACTERISTIC fbwSI41CC4 "I41  CARB Speichercode Bit 4" VALUE 0xF3208 MSA15_FW3 0 DEZ_DW_U 0.000000 65535.000000 /end CHARACTERISTIC
/begin CHARACTERISTIC fbwSI41CC5 "I41  CARB Speichercode Bit 5" VALUE 0xF320A MSA15_FW3 0 DEZ_DW_U 0.000000 65535.000000 /end CHARACTERISTIC
/begin CHARACTERISTIC fbwSI41CC6 "I41  CARB Speichercode Bit 6" VALUE 0xF320C MSA15_FW3 0 DEZ_DW_U 0.000000 65535.000000 /end CHARACTERISTIC
/begin CHARACTERISTIC fbwSI41CC7 "I41  CARB Speichercode Bit 7" VALUE 0xF320E MSA15_FW3 0 DEZ_DW_U 0.000000 65535.000000 /end CHARACTERISTIC
/begin CHARACTERISTIC fbwSI41ENT "I41  Entprellmodus" VALUE 0xF31FB MSA15_FW1 0 DEZ_DB_U 0.000000 255.000000 /end CHARACTERISTIC
/begin CHARACTERISTIC fbwSI41FLC "I41  Startwert Eintragzaehler" VALUE 0xF31FC MSA15_FW1 0 DEZ_DB_U 0.000000 255.000000 /end CHARACTERISTIC
/begin CHARACTERISTIC fbwSI41HLC "I41  Startwert Heilungszaehler" VALUE 0xF31FD MSA15_FW1 0 DEZ_DB_U 0.000000 255.000000 /end CHARACTERISTIC
/begin CHARACTERISTIC fbwSI41PRI "I41  Prioritaet" VALUE 0xF31FA MSA15_FW1 0 DEZ_DB_U 0.000000 3.000000 EXTENDED_LIMITS 0.000000 255.000000 /end CHARACTERISTIC
/begin CHARACTERISTIC fbwSI41SPC "I41  Code fuer Fehlerspeicherung" VALUE 0xF31F8 MSA15_FW3 0 DEZ_DW_U 0.000000 65535.000000 /end CHARACTERISTIC
/begin CHARACTERISTIC fbwSI41UB1 "I41 Umweltbedingung 1 fuer Fehlerspeicherung" VALUE 0xF3210 MSA15_FW3 0 DEZ_DW_U 0.000000 65535.000000 /end CHARACTERISTIC
/begin CHARACTERISTIC fbwSI41UB2 "I41 Umweltbedingung 2 fuer Fehlerspeicherung" VALUE 0xF3212 MSA15_FW3 0 DEZ_DW_U 0.000000 65535.000000 /end CHARACTERISTIC
/begin CHARACTERISTIC fbwSI41UB3 "I41 Umweltbedingung 3 fuer Fehlerspeicherung" VALUE 0xF3214 MSA15_FW3 0 DEZ_DW_U 0.000000 65535.000000 /end CHARACTERISTIC
/begin CHARACTERISTIC fbwSI41UB4 "I41 Umweltbedingung 4 fuer Fehlerspeicherung" VALUE 0xF3216 MSA15_FW3 0 DEZ_DW_U 0.000000 65535.000000 /end CHARACTERISTIC
/begin CHARACTERISTIC fbwSI42BCO "I42  Blinkcode" VALUE 0xF32E6 MSA15_FW3 0 DEZ_DW_U 0.000000 65535.000000 /end CHARACTERISTIC
/begin CHARACTERISTIC fbwSI42CC0 "I42  CARB Speichercode Bit 0" VALUE 0xF32E8 MSA15_FW3 0 DEZ_DW_U 0.000000 65535.000000 /end CHARACTERISTIC
/begin CHARACTERISTIC fbwSI42CC1 "I42  CARB Speichercode Bit 1" VALUE 0xF32EA MSA15_FW3 0 DEZ_DW_U 0.000000 65535.000000 /end CHARACTERISTIC
/begin CHARACTERISTIC fbwSI42CC2 "I42  CARB Speichercode Bit 2" VALUE 0xF32EC MSA15_FW3 0 DEZ_DW_U 0.000000 65535.000000 /end CHARACTERISTIC
/begin CHARACTERISTIC fbwSI42CC3 "I42  CARB Speichercode Bit 3" VALUE 0xF32EE MSA15_FW3 0 DEZ_DW_U 0.000000 65535.000000 /end CHARACTERISTIC
/begin CHARACTERISTIC fbwSI42CC4 "I42  CARB Speichercode Bit 4" VALUE 0xF32F0 MSA15_FW3 0 DEZ_DW_U 0.000000 65535.000000 /end CHARACTERISTIC
/begin CHARACTERISTIC fbwSI42CC5 "I42  CARB Speichercode Bit 5" VALUE 0xF32F2 MSA15_FW3 0 DEZ_DW_U 0.000000 65535.000000 /end CHARACTERISTIC
/begin CHARACTERISTIC fbwSI42CC6 "I42  CARB Speichercode Bit 6" VALUE 0xF32F4 MSA15_FW3 0 DEZ_DW_U 0.000000 65535.000000 /end CHARACTERISTIC
/begin CHARACTERISTIC fbwSI42CC7 "I42  CARB Speichercode Bit 7" VALUE 0xF32F6 MSA15_FW3 0 DEZ_DW_U 0.000000 65535.000000 /end CHARACTERISTIC
/begin CHARACTERISTIC fbwSI42ENT "I42  Entprellmodus" VALUE 0xF32E3 MSA15_FW1 0 DEZ_DB_U 0.000000 255.000000 /end CHARACTERISTIC
/begin CHARACTERISTIC fbwSI42FLC "I42  Startwert Eintragzaehler" VALUE 0xF32E4 MSA15_FW1 0 DEZ_DB_U 0.000000 255.000000 /end CHARACTERISTIC
/begin CHARACTERISTIC fbwSI42HLC "I42  Startwert Heilungszaehler" VALUE 0xF32E5 MSA15_FW1 0 DEZ_DB_U 0.000000 255.000000 /end CHARACTERISTIC
/begin CHARACTERISTIC fbwSI42PRI "I42  Prioritaet" VALUE 0xF32E2 MSA15_FW1 0 DEZ_DB_U 0.000000 3.000000 EXTENDED_LIMITS 0.000000 255.000000 /end CHARACTERISTIC
/begin CHARACTERISTIC fbwSI42SPC "I42  Code fuer Fehlerspeicherung" VALUE 0xF32E0 MSA15_FW3 0 DEZ_DW_U 0.000000 65535.000000 /end CHARACTERISTIC
/begin CHARACTERISTIC fbwSI42UB1 "I42 Umweltbedingung 1 fuer Fehlerspeicherung" VALUE 0xF32F8 MSA15_FW3 0 DEZ_DW_U 0.000000 65535.000000 /end CHARACTERISTIC
/begin CHARACTERISTIC fbwSI42UB2 "I42 Umweltbedingung 2 fuer Fehlerspeicherung" VALUE 0xF32FA MSA15_FW3 0 DEZ_DW_U 0.000000 65535.000000 /end CHARACTERISTIC
/begin CHARACTERISTIC fbwSI42UB3 "I42 Umweltbedingung 3 fuer Fehlerspeicherung" VALUE 0xF32FC MSA15_FW3 0 DEZ_DW_U 0.000000 65535.000000 /end CHARACTERISTIC
/begin CHARACTERISTIC fbwSI42UB4 "I42 Umweltbedingung 4 fuer Fehlerspeicherung" VALUE 0xF32FE MSA15_FW3 0 DEZ_DW_U 0.000000 65535.000000 /end CHARACTERISTIC
/begin CHARACTERISTIC fbwSIDVBCO "IDV  Blinkcode" VALUE 0xF2A90 MSA15_FW3 0 DEZ_DW_U 0.000000 65535.000000 /end CHARACTERISTIC
/begin CHARACTERISTIC fbwSIDVCC0 "IDV  CARB Speichercode Bit 0" VALUE 0xF2A92 MSA15_FW3 0 DEZ_DW_U 0.000000 65535.000000 /end CHARACTERISTIC
/begin CHARACTERISTIC fbwSIDVCC1 "IDV  CARB Speichercode Bit 1" VALUE 0xF2A94 MSA15_FW3 0 DEZ_DW_U 0.000000 65535.000000 /end CHARACTERISTIC
/begin CHARACTERISTIC fbwSIDVCC2 "IDV  CARB Speichercode Bit 2" VALUE 0xF2A96 MSA15_FW3 0 DEZ_DW_U 0.000000 65535.000000 /end CHARACTERISTIC
/begin CHARACTERISTIC fbwSIDVCC3 "IDV  CARB Speichercode Bit 3" VALUE 0xF2A98 MSA15_FW3 0 DEZ_DW_U 0.000000 65535.000000 /end CHARACTERISTIC
/begin CHARACTERISTIC fbwSIDVCC4 "IDV  CARB Speichercode Bit 4" VALUE 0xF2A9A MSA15_FW3 0 DEZ_DW_U 0.000000 65535.000000 /end CHARACTERISTIC
/begin CHARACTERISTIC fbwSIDVCC5 "IDV  CARB Speichercode Bit 5" VALUE 0xF2A9C MSA15_FW3 0 DEZ_DW_U 0.000000 65535.000000 /end CHARACTERISTIC
/begin CHARACTERISTIC fbwSIDVCC6 "IDV  CARB Speichercode Bit 6" VALUE 0xF2A9E MSA15_FW3 0 DEZ_DW_U 0.000000 65535.000000 /end CHARACTERISTIC
/begin CHARACTERISTIC fbwSIDVCC7 "IDV  CARB Speichercode Bit 7" VALUE 0xF2AA0 MSA15_FW3 0 DEZ_DW_U 0.000000 65535.000000 /end CHARACTERISTIC
/begin CHARACTERISTIC fbwSIDVENT "IDV Entrprellmodus" VALUE 0xF2A8D MSA15_FW1 0 DEZ_DB_U 0.000000 255.000000 /end CHARACTERISTIC
/begin CHARACTERISTIC fbwSIDVFLC "IDV  Startwert Eintragzaehler" VALUE 0xF2A8E MSA15_FW1 0 DEZ_DB_U 0.000000 255.000000 /end CHARACTERISTIC
/begin CHARACTERISTIC fbwSIDVHLC "IDV  Startwert Heilungszaehler" VALUE 0xF2A8F MSA15_FW1 0 DEZ_DB_U 0.000000 255.000000 /end CHARACTERISTIC
/begin CHARACTERISTIC fbwSIDVPRI "IDV" VALUE 0xF2A8C MSA15_FW1 0 DEZ_DB_U 0.000000 3.000000 EXTENDED_LIMITS 0.000000 255.000000 /end CHARACTERISTIC
/begin CHARACTERISTIC fbwSIDVSPC "IDV Code fuer Fehlerspeicherung" VALUE 0xF2A8A MSA15_FW3 0 DEZ_DW_U 0.000000 65535.000000 /end CHARACTERISTIC
/begin CHARACTERISTIC fbwSIDVUB1 "IDV Umweltbedingung 1 fuer Fehlerspeicherung" VALUE 0xF2AA2 MSA15_FW3 0 DEZ_DW_U 0.000000 65535.000000 /end CHARACTERISTIC
/begin CHARACTERISTIC fbwSIDVUB2 "IDV Umweltbedingung 2 fuer Fehlerspeicherung" VALUE 0xF2AA4 MSA15_FW3 0 DEZ_DW_U 0.000000 65535.000000 /end CHARACTERISTIC
/begin CHARACTERISTIC fbwSIDVUB3 "IDV Umweltbedingung 3 fuer Fehlerspeicherung" VALUE 0xF2AA6 MSA15_FW3 0 DEZ_DW_U 0.000000 65535.000000 /end CHARACTERISTIC
/begin CHARACTERISTIC fbwSIDVUB4 "IDV Umweltbedingung 4 fuer Fehlerspeicherung" VALUE 0xF2AA8 MSA15_FW3 0 DEZ_DW_U 0.000000 65535.000000 /end CHARACTERISTIC
/begin CHARACTERISTIC fbwSIWZBCO "IWZ  Blinkcode" VALUE 0xF2744 MSA15_FW3 0 DEZ_DW_U 0.000000 65535.000000 /end CHARACTERISTIC
/begin CHARACTERISTIC fbwSIWZCC0 "IWZ  CARB Speichercode Bit 0" VALUE 0xF2746 MSA15_FW3 0 DEZ_DW_U 0.000000 65535.000000 /end CHARACTERISTIC
/begin CHARACTERISTIC fbwSIWZCC1 "IWZ  CARB Speichercode Bit 1" VALUE 0xF2748 MSA15_FW3 0 DEZ_DW_U 0.000000 65535.000000 /end CHARACTERISTIC
/begin CHARACTERISTIC fbwSIWZCC2 "IWZ  CARB Speichercode Bit 2" VALUE 0xF274A MSA15_FW3 0 DEZ_DW_U 0.000000 65535.000000 /end CHARACTERISTIC
/begin CHARACTERISTIC fbwSIWZCC3 "IWZ  CARB Speichercode Bit 3" VALUE 0xF274C MSA15_FW3 0 DEZ_DW_U 0.000000 65535.000000 /end CHARACTERISTIC
/begin CHARACTERISTIC fbwSIWZCC4 "IWZ  CARB Speichercode Bit 4" VALUE 0xF274E MSA15_FW3 0 DEZ_DW_U 0.000000 65535.000000 /end CHARACTERISTIC
/begin CHARACTERISTIC fbwSIWZCC5 "IWZ  CARB Speichercode Bit 5" VALUE 0xF2750 MSA15_FW3 0 DEZ_DW_U 0.000000 65535.000000 /end CHARACTERISTIC
/begin CHARACTERISTIC fbwSIWZCC6 "IWZ  CARB Speichercode Bit 6" VALUE 0xF2752 MSA15_FW3 0 DEZ_DW_U 0.000000 65535.000000 /end CHARACTERISTIC
/begin CHARACTERISTIC fbwSIWZCC7 "IWZ  CARB Speichercode Bit 7" VALUE 0xF2754 MSA15_FW3 0 DEZ_DW_U 0.000000 65535.000000 /end CHARACTERISTIC
/begin CHARACTERISTIC fbwSIWZENT "IWZ  Entrprellmodus" VALUE 0xF2741 MSA15_FW1 0 DEZ_DB_U 0.000000 255.000000 /end CHARACTERISTIC
/begin CHARACTERISTIC fbwSIWZFLC "IWZ  Startwert Eintragzaehler" VALUE 0xF2742 MSA15_FW1 0 DEZ_DB_U 0.000000 255.000000 /end CHARACTERISTIC
/begin CHARACTERISTIC fbwSIWZHLC "IWZ  Startwert Heilungszaehler" VALUE 0xF2743 MSA15_FW1 0 DEZ_DB_U 0.000000 255.000000 /end CHARACTERISTIC
/begin CHARACTERISTIC fbwSIWZPRI "IWZ  Prioritaet" VALUE 0xF2740 MSA15_FW1 0 DEZ_DB_U 0.000000 3.000000 EXTENDED_LIMITS 0.000000 255.000000 /end CHARACTERISTIC
/begin CHARACTERISTIC fbwSIWZSPC "IWZ  Code fuer Fehlerspeicherung" VALUE 0xF273E MSA15_FW3 0 DEZ_DW_U 0.000000 65535.000000 /end CHARACTERISTIC
/begin CHARACTERISTIC fbwSIWZUB1 "IWZ Umweltbedingung 1 fuer Fehlerspeicherung" VALUE 0xF2756 MSA15_FW3 0 DEZ_DW_U 0.000000 65535.000000 /end CHARACTERISTIC
/begin CHARACTERISTIC fbwSIWZUB2 "IWZ Umweltbedingung 2 fuer Fehlerspeicherung" VALUE 0xF2758 MSA15_FW3 0 DEZ_DW_U 0.000000 65535.000000 /end CHARACTERISTIC
/begin CHARACTERISTIC fbwSIWZUB3 "IWZ Umweltbedingung 3 fuer Fehlerspeicherung" VALUE 0xF275A MSA15_FW3 0 DEZ_DW_U 0.000000 65535.000000 /end CHARACTERISTIC
/begin CHARACTERISTIC fbwSIWZUB4 "IWZ Umweltbedingung 4 fuer Fehlerspeicherung" VALUE 0xF275C MSA15_FW3 0 DEZ_DW_U 0.000000 65535.000000 /end CHARACTERISTIC
/begin CHARACTERISTIC fbwSK15BCO "K15  Blinkcode" VALUE 0xF2D00 MSA15_FW3 0 DEZ_DW_U 0.000000 65535.000000 /end CHARACTERISTIC
/begin CHARACTERISTIC fbwSK15CC0 "K15  CARB Speichercode Bit 0" VALUE 0xF2D02 MSA15_FW3 0 DEZ_DW_U 0.000000 65535.000000 /end CHARACTERISTIC
/begin CHARACTERISTIC fbwSK15CC1 "K15  CARB Speichercode Bit 1" VALUE 0xF2D04 MSA15_FW3 0 DEZ_DW_U 0.000000 65535.000000 /end CHARACTERISTIC
/begin CHARACTERISTIC fbwSK15CC2 "K15  CARB Speichercode Bit 2" VALUE 0xF2D06 MSA15_FW3 0 DEZ_DW_U 0.000000 65535.000000 /end CHARACTERISTIC
/begin CHARACTERISTIC fbwSK15CC3 "K15  CARB Speichercode Bit 3" VALUE 0xF2D08 MSA15_FW3 0 DEZ_DW_U 0.000000 65535.000000 /end CHARACTERISTIC
/begin CHARACTERISTIC fbwSK15CC4 "K15  CARB Speichercode Bit 4" VALUE 0xF2D0A MSA15_FW3 0 DEZ_DW_U 0.000000 65535.000000 /end CHARACTERISTIC
/begin CHARACTERISTIC fbwSK15CC5 "K15  CARB Speichercode Bit 5" VALUE 0xF2D0C MSA15_FW3 0 DEZ_DW_U 0.000000 65535.000000 /end CHARACTERISTIC
/begin CHARACTERISTIC fbwSK15CC6 "K15  CARB Speichercode Bit 6" VALUE 0xF2D0E MSA15_FW3 0 DEZ_DW_U 0.000000 65535.000000 /end CHARACTERISTIC
/begin CHARACTERISTIC fbwSK15CC7 "K15  CARB Speichercode Bit 7" VALUE 0xF2D10 MSA15_FW3 0 DEZ_DW_U 0.000000 65535.000000 /end CHARACTERISTIC
/begin CHARACTERISTIC fbwSK15ENT "K15  Entrprellmodus" VALUE 0xF2CFD MSA15_FW1 0 DEZ_DB_U 0.000000 255.000000 /end CHARACTERISTIC
/begin CHARACTERISTIC fbwSK15FLC "K15  Startwert Eintragzaehler" VALUE 0xF2CFE MSA15_FW1 0 DEZ_DB_U 0.000000 255.000000 /end CHARACTERISTIC
/begin CHARACTERISTIC fbwSK15HLC "K15  Startwert Heilungszaehler" VALUE 0xF2CFF MSA15_FW1 0 DEZ_DB_U 0.000000 255.000000 /end CHARACTERISTIC
/begin CHARACTERISTIC fbwSK15PRI "K15  Prioritaet" VALUE 0xF2CFC MSA15_FW1 0 DEZ_DB_U 0.000000 3.000000 EXTENDED_LIMITS 0.000000 255.000000 /end CHARACTERISTIC
/begin CHARACTERISTIC fbwSK15SPC "K15  Code fuer Fehlerspeicherung" VALUE 0xF2CFA MSA15_FW3 0 DEZ_DW_U 0.000000 65535.000000 /end CHARACTERISTIC
/begin CHARACTERISTIC fbwSK15UB1 "K15 Umweltbedingung 1 fuer Fehlerspeicherung" VALUE 0xF2D12 MSA15_FW3 0 DEZ_DW_U 0.000000 65535.000000 /end CHARACTERISTIC
/begin CHARACTERISTIC fbwSK15UB2 "K15 Umweltbedingung 2 fuer Fehlerspeicherung" VALUE 0xF2D14 MSA15_FW3 0 DEZ_DW_U 0.000000 65535.000000 /end CHARACTERISTIC
/begin CHARACTERISTIC fbwSK15UB3 "K15 Umweltbedingung 3 fuer Fehlerspeicherung" VALUE 0xF2D16 MSA15_FW3 0 DEZ_DW_U 0.000000 65535.000000 /end CHARACTERISTIC
/begin CHARACTERISTIC fbwSK15UB4 "K15 Umweltbedingung 4 fuer Fehlerspeicherung" VALUE 0xF2D18 MSA15_FW3 0 DEZ_DW_U 0.000000 65535.000000 /end CHARACTERISTIC
/begin CHARACTERISTIC fbwSKATBCO "KAT  Blinkcode" VALUE 0xF363A MSA15_FW3 0 DEZ_DW_U 0.000000 65535.000000 /end CHARACTERISTIC
/begin CHARACTERISTIC fbwSKATCC0 "KAT  CARB Speichercode Bit 0" VALUE 0xF363C MSA15_FW3 0 DEZ_DW_U 0.000000 65535.000000 /end CHARACTERISTIC
/begin CHARACTERISTIC fbwSKATCC1 "KAT  CARB Speichercode Bit 1" VALUE 0xF363E MSA15_FW3 0 DEZ_DW_U 0.000000 65535.000000 /end CHARACTERISTIC
/begin CHARACTERISTIC fbwSKATCC2 "KAT  CARB Speichercode Bit 2" VALUE 0xF3640 MSA15_FW3 0 DEZ_DW_U 0.000000 65535.000000 /end CHARACTERISTIC
/begin CHARACTERISTIC fbwSKATCC3 "KAT  CARB Speichercode Bit 3" VALUE 0xF3642 MSA15_FW3 0 DEZ_DW_U 0.000000 65535.000000 /end CHARACTERISTIC
/begin CHARACTERISTIC fbwSKATCC4 "KAT  CARB Speichercode Bit 4" VALUE 0xF3644 MSA15_FW3 0 DEZ_DW_U 0.000000 65535.000000 /end CHARACTERISTIC
/begin CHARACTERISTIC fbwSKATCC5 "KAT  CARB Speichercode Bit 5" VALUE 0xF3646 MSA15_FW3 0 DEZ_DW_U 0.000000 65535.000000 /end CHARACTERISTIC
/begin CHARACTERISTIC fbwSKATCC6 "KAT  CARB Speichercode Bit 6" VALUE 0xF3648 MSA15_FW3 0 DEZ_DW_U 0.000000 65535.000000 /end CHARACTERISTIC
/begin CHARACTERISTIC fbwSKATCC7 "KAT  CARB Speichercode Bit 7" VALUE 0xF364A MSA15_FW3 0 DEZ_DW_U 0.000000 65535.000000 /end CHARACTERISTIC
/begin CHARACTERISTIC fbwSKATENT "KAT  Entrprellmodus" VALUE 0xF3637 MSA15_FW1 0 DEZ_DB_U 0.000000 255.000000 /end CHARACTERISTIC
/begin CHARACTERISTIC fbwSKATFLC "KAT  Startwert Eintragzaehler" VALUE 0xF3638 MSA15_FW1 0 DEZ_DB_U 0.000000 255.000000 /end CHARACTERISTIC
/begin CHARACTERISTIC fbwSKATHLC "KAT  Startwert Heilungszaehler" VALUE 0xF3639 MSA15_FW1 0 DEZ_DB_U 0.000000 255.000000 /end CHARACTERISTIC
/begin CHARACTERISTIC fbwSKATPRI "KAT  Prioritaet" VALUE 0xF3636 MSA15_FW1 0 DEZ_DB_U 0.000000 3.000000 EXTENDED_LIMITS 0.000000 255.000000 /end CHARACTERISTIC
/begin CHARACTERISTIC fbwSKATSPC "KAT  Code fuer Fehlerspeicherung" VALUE 0xF3634 MSA15_FW3 0 DEZ_DW_U 0.000000 65535.000000 /end CHARACTERISTIC
/begin CHARACTERISTIC fbwSKATUB1 "KAT Umweltbedingung 1 fuer Fehlerspeicherung" VALUE 0xF364C MSA15_FW3 0 DEZ_DW_U 0.000000 65535.000000 /end CHARACTERISTIC
/begin CHARACTERISTIC fbwSKATUB2 "KAT Umweltbedingung 2 fuer Fehlerspeicherung" VALUE 0xF364E MSA15_FW3 0 DEZ_DW_U 0.000000 65535.000000 /end CHARACTERISTIC
/begin CHARACTERISTIC fbwSKATUB3 "KAT Umweltbedingung 3 fuer Fehlerspeicherung" VALUE 0xF3650 MSA15_FW3 0 DEZ_DW_U 0.000000 65535.000000 /end CHARACTERISTIC
/begin CHARACTERISTIC fbwSKATUB4 "KAT Umweltbedingung 4 fuer Fehlerspeicherung" VALUE 0xF3652 MSA15_FW3 0 DEZ_DW_U 0.000000 65535.000000 /end CHARACTERISTIC
/begin CHARACTERISTIC fbwSKDFBCO "KDF  Blinkcode" VALUE 0xF2ABE MSA15_FW3 0 DEZ_DW_U 0.000000 65535.000000 /end CHARACTERISTIC
/begin CHARACTERISTIC fbwSKDFCC0 "KDF  CARB Speichercode Bit 0" VALUE 0xF2AC0 MSA15_FW3 0 DEZ_DW_U 0.000000 65535.000000 /end CHARACTERISTIC
/begin CHARACTERISTIC fbwSKDFCC1 "KDF  CARB Speichercode Bit 1" VALUE 0xF2AC2 MSA15_FW3 0 DEZ_DW_U 0.000000 65535.000000 /end CHARACTERISTIC
/begin CHARACTERISTIC fbwSKDFCC2 "KDF  CARB Speichercode Bit 2" VALUE 0xF2AC4 MSA15_FW3 0 DEZ_DW_U 0.000000 65535.000000 /end CHARACTERISTIC
/begin CHARACTERISTIC fbwSKDFCC3 "KDF  CARB Speichercode Bit 3" VALUE 0xF2AC6 MSA15_FW3 0 DEZ_DW_U 0.000000 65535.000000 /end CHARACTERISTIC
/begin CHARACTERISTIC fbwSKDFCC4 "KDF  CARB Speichercode Bit 4" VALUE 0xF2AC8 MSA15_FW3 0 DEZ_DW_U 0.000000 65535.000000 /end CHARACTERISTIC
/begin CHARACTERISTIC fbwSKDFCC5 "KDF  CARB Speichercode Bit 5" VALUE 0xF2ACA MSA15_FW3 0 DEZ_DW_U 0.000000 65535.000000 /end CHARACTERISTIC
/begin CHARACTERISTIC fbwSKDFCC6 "KDF  CARB Speichercode Bit 6" VALUE 0xF2ACC MSA15_FW3 0 DEZ_DW_U 0.000000 65535.000000 /end CHARACTERISTIC
/begin CHARACTERISTIC fbwSKDFCC7 "KDF  CARB Speichercode Bit 7" VALUE 0xF2ACE MSA15_FW3 0 DEZ_DW_U 0.000000 65535.000000 /end CHARACTERISTIC
/begin CHARACTERISTIC fbwSKDFENT "KDF  Entrprellmodus" VALUE 0xF2ABB MSA15_FW1 0 DEZ_DB_U 0.000000 255.000000 /end CHARACTERISTIC
/begin CHARACTERISTIC fbwSKDFFLC "KDF  Startwert Eintragzaehler" VALUE 0xF2ABC MSA15_FW1 0 DEZ_DB_U 0.000000 255.000000 /end CHARACTERISTIC
/begin CHARACTERISTIC fbwSKDFHLC "KDF  Startwert Heilungszaehler" VALUE 0xF2ABD MSA15_FW1 0 DEZ_DB_U 0.000000 255.000000 /end CHARACTERISTIC
/begin CHARACTERISTIC fbwSKDFPRI "#SSD KDF  Prioritaet" VALUE 0xF2ABA MSA15_FW1 0 DEZ_DB_U 0.000000 3.000000 EXTENDED_LIMITS 0.000000 255.000000 /end CHARACTERISTIC
/begin CHARACTERISTIC fbwSKDFSPC "KDF  Code fuer Fehlerspeicherung" VALUE 0xF2AB8 MSA15_FW3 0 DEZ_DW_U 0.000000 65535.000000 /end CHARACTERISTIC
/begin CHARACTERISTIC fbwSKDFUB1 "KDF Umweltbedingung 1 fuer Fehlerspeicherung" VALUE 0xF2AD0 MSA15_FW3 0 DEZ_DW_U 0.000000 65535.000000 /end CHARACTERISTIC
/begin CHARACTERISTIC fbwSKDFUB2 "KDF Umweltbedingung 2 fuer Fehlerspeicherung" VALUE 0xF2AD2 MSA15_FW3 0 DEZ_DW_U 0.000000 65535.000000 /end CHARACTERISTIC
/begin CHARACTERISTIC fbwSKDFUB3 "KDF Umweltbedingung 3 fuer Fehlerspeicherung" VALUE 0xF2AD4 MSA15_FW3 0 DEZ_DW_U 0.000000 65535.000000 /end CHARACTERISTIC
/begin CHARACTERISTIC fbwSKDFUB4 "KDF Umweltbedingung 4 fuer Fehlerspeicherung" VALUE 0xF2AD6 MSA15_FW3 0 DEZ_DW_U 0.000000 65535.000000 /end CHARACTERISTIC
/begin CHARACTERISTIC fbwSKDPBCO "KDP  Blinkcode" VALUE 0xF356E MSA15_FW3 0 DEZ_DW_U 0.000000 65535.000000 /end CHARACTERISTIC
/begin CHARACTERISTIC fbwSKDPCC0 "KDPANL  CARB Speichercode Bit 0" VALUE 0xF3570 MSA15_FW3 0 DEZ_DW_U 0.000000 65535.000000 /end CHARACTERISTIC
/begin CHARACTERISTIC fbwSKDPCC1 "KDP  CARB Speichercode Bit 1" VALUE 0xF3572 MSA15_FW3 0 DEZ_DW_U 0.000000 65535.000000 /end CHARACTERISTIC
/begin CHARACTERISTIC fbwSKDPCC2 "KDP  CARB Speichercode Bit 2" VALUE 0xF3574 MSA15_FW3 0 DEZ_DW_U 0.000000 65535.000000 /end CHARACTERISTIC
/begin CHARACTERISTIC fbwSKDPCC3 "KDP  CARB Speichercode Bit 3" VALUE 0xF3576 MSA15_FW3 0 DEZ_DW_U 0.000000 65535.000000 /end CHARACTERISTIC
/begin CHARACTERISTIC fbwSKDPCC4 "KDP  CARB Speichercode Bit 4" VALUE 0xF3578 MSA15_FW3 0 DEZ_DW_U 0.000000 65535.000000 /end CHARACTERISTIC
/begin CHARACTERISTIC fbwSKDPCC5 "KDP  CARB Speichercode Bit 5" VALUE 0xF357A MSA15_FW3 0 DEZ_DW_U 0.000000 65535.000000 /end CHARACTERISTIC
/begin CHARACTERISTIC fbwSKDPCC6 "KDP  CARB Speichercode Bit 6" VALUE 0xF357C MSA15_FW3 0 DEZ_DW_U 0.000000 65535.000000 /end CHARACTERISTIC
/begin CHARACTERISTIC fbwSKDPCC7 "KDP  CARB Speichercode Bit 7" VALUE 0xF357E MSA15_FW3 0 DEZ_DW_U 0.000000 65535.000000 /end CHARACTERISTIC
/begin CHARACTERISTIC fbwSKDPENT "KDP  Entrprellmodus" VALUE 0xF356B MSA15_FW1 0 DEZ_DB_U 0.000000 255.000000 /end CHARACTERISTIC
/begin CHARACTERISTIC fbwSKDPFLC "KDP  Startwert Eintragzaehler" VALUE 0xF356C MSA15_FW1 0 DEZ_DB_U 0.000000 255.000000 /end CHARACTERISTIC
/begin CHARACTERISTIC fbwSKDPHLC "KDP  Startwert Heilungszaehler" VALUE 0xF356D MSA15_FW1 0 DEZ_DB_U 0.000000 255.000000 /end CHARACTERISTIC
/begin CHARACTERISTIC fbwSKDPPRI "KDP  Prioritaet" VALUE 0xF356A MSA15_FW1 0 DEZ_DB_U 0.000000 3.000000 EXTENDED_LIMITS 0.000000 255.000000 /end CHARACTERISTIC
/begin CHARACTERISTIC fbwSKDPSPC "KDP  Code fuer Fehlerspeicherung" VALUE 0xF3568 MSA15_FW3 0 DEZ_DW_U 0.000000 65535.000000 /end CHARACTERISTIC
/begin CHARACTERISTIC fbwSKDPUB1 "KDP  Umweltbedingung 1 fuer Fehlerspeicherung" VALUE 0xF3580 MSA15_FW3 0 DEZ_DW_U 0.000000 65535.000000 /end CHARACTERISTIC
/begin CHARACTERISTIC fbwSKDPUB2 "KDP  Umweltbedingung 2 fuer Fehlerspeicherung" VALUE 0xF3582 MSA15_FW3 0 DEZ_DW_U 0.000000 65535.000000 /end CHARACTERISTIC
/begin CHARACTERISTIC fbwSKDPUB3 "KDP  Umweltbedingung 3 fuer Fehlerspeicherung" VALUE 0xF3584 MSA15_FW3 0 DEZ_DW_U 0.000000 65535.000000 /end CHARACTERISTIC
/begin CHARACTERISTIC fbwSKDPUB4 "KDP  Umweltbedingung 4 fuer Fehlerspeicherung" VALUE 0xF3586 MSA15_FW3 0 DEZ_DW_U 0.000000 65535.000000 /end CHARACTERISTIC
/begin CHARACTERISTIC fbwSKDRBCO "KDR  Blinkcode" VALUE 0xF311C MSA15_FW3 0 DEZ_DW_U 0.000000 65535.000000 /end CHARACTERISTIC
/begin CHARACTERISTIC fbwSKDRCC0 "KDR  CARB Speichercode Bit 0" VALUE 0xF311E MSA15_FW3 0 DEZ_DW_U 0.000000 65535.000000 /end CHARACTERISTIC
/begin CHARACTERISTIC fbwSKDRCC1 "KDR  CARB Speichercode Bit 1" VALUE 0xF3120 MSA15_FW3 0 DEZ_DW_U 0.000000 65535.000000 /end CHARACTERISTIC
/begin CHARACTERISTIC fbwSKDRCC2 "KDR  CARB Speichercode Bit 2" VALUE 0xF3122 MSA15_FW3 0 DEZ_DW_U 0.000000 65535.000000 /end CHARACTERISTIC
/begin CHARACTERISTIC fbwSKDRCC3 "KDR  CARB Speichercode Bit 3" VALUE 0xF3124 MSA15_FW3 0 DEZ_DW_U 0.000000 65535.000000 /end CHARACTERISTIC
/begin CHARACTERISTIC fbwSKDRCC4 "KDR  CARB Speichercode Bit 4" VALUE 0xF3126 MSA15_FW3 0 DEZ_DW_U 0.000000 65535.000000 /end CHARACTERISTIC
/begin CHARACTERISTIC fbwSKDRCC5 "KDR  CARB Speichercode Bit 5" VALUE 0xF3128 MSA15_FW3 0 DEZ_DW_U 0.000000 65535.000000 /end CHARACTERISTIC
/begin CHARACTERISTIC fbwSKDRCC6 "KDR  CARB Speichercode Bit 6" VALUE 0xF312A MSA15_FW3 0 DEZ_DW_U 0.000000 65535.000000 /end CHARACTERISTIC
/begin CHARACTERISTIC fbwSKDRCC7 "KDR  CARB Speichercode Bit 7" VALUE 0xF312C MSA15_FW3 0 DEZ_DW_U 0.000000 65535.000000 /end CHARACTERISTIC
/begin CHARACTERISTIC fbwSKDRENT "KDR Entrprellmodus" VALUE 0xF3119 MSA15_FW1 0 DEZ_DB_U 0.000000 255.000000 /end CHARACTERISTIC
/begin CHARACTERISTIC fbwSKDRFLC "KDR  Startwert Eintragzaehler" VALUE 0xF311A MSA15_FW1 0 DEZ_DB_U 0.000000 255.000000 /end CHARACTERISTIC
/begin CHARACTERISTIC fbwSKDRHLC "KDR  Startwert Heilungszaehler" VALUE 0xF311B MSA15_FW1 0 DEZ_DB_U 0.000000 255.000000 /end CHARACTERISTIC
/begin CHARACTERISTIC fbwSKDRPRI "KDR Prioritaet" VALUE 0xF3118 MSA15_FW1 0 DEZ_DB_U 0.000000 3.000000 EXTENDED_LIMITS 0.000000 255.000000 /end CHARACTERISTIC
/begin CHARACTERISTIC fbwSKDRSPC "KDR Code fuer Fehlerspeicherung" VALUE 0xF3116 MSA15_FW3 0 DEZ_DW_U 0.000000 65535.000000 /end CHARACTERISTIC
/begin CHARACTERISTIC fbwSKDRUB1 "KDR Umweltbedingung 1 fuer Fehlerspeicherung" VALUE 0xF312E MSA15_FW3 0 DEZ_DW_U 0.000000 65535.000000 /end CHARACTERISTIC
/begin CHARACTERISTIC fbwSKDRUB2 "KDR Umweltbedingung 2 fuer Fehlerspeicherung" VALUE 0xF3130 MSA15_FW3 0 DEZ_DW_U 0.000000 65535.000000 /end CHARACTERISTIC
/begin CHARACTERISTIC fbwSKDRUB3 "KDR Umweltbedingung 3 fuer Fehlerspeicherung" VALUE 0xF3132 MSA15_FW3 0 DEZ_DW_U 0.000000 65535.000000 /end CHARACTERISTIC
/begin CHARACTERISTIC fbwSKDRUB4 "KDR Umweltbedingung 4 fuer Fehlerspeicherung" VALUE 0xF3134 MSA15_FW3 0 DEZ_DW_U 0.000000 65535.000000 /end CHARACTERISTIC
/begin CHARACTERISTIC fbwSKDSBCO "KDS  Blinkcode" VALUE 0xF2AF8 MSA15_FW3 0 DEZ_DW_U 0.000000 65535.000000 /end CHARACTERISTIC
/begin CHARACTERISTIC fbwSKDSCC0 "KDS  CARB Speichercode Bit 0" VALUE 0xF2AFA MSA15_FW3 0 DEZ_DW_U 0.000000 65535.000000 /end CHARACTERISTIC
/begin CHARACTERISTIC fbwSKDSCC1 "KDS  CARB Speichercode Bit 1" VALUE 0xF2AFC MSA15_FW3 0 DEZ_DW_U 0.000000 65535.000000 /end CHARACTERISTIC
/begin CHARACTERISTIC fbwSKDSCC2 "KDS  CARB Speichercode Bit 2" VALUE 0xF2AFE MSA15_FW3 0 DEZ_DW_U 0.000000 65535.000000 /end CHARACTERISTIC
/begin CHARACTERISTIC fbwSKDSCC3 "KDS  CARB Speichercode Bit 3" VALUE 0xF2B00 MSA15_FW3 0 DEZ_DW_U 0.000000 65535.000000 /end CHARACTERISTIC
/begin CHARACTERISTIC fbwSKDSCC4 "KDS  CARB Speichercode Bit 4" VALUE 0xF2B02 MSA15_FW3 0 DEZ_DW_U 0.000000 65535.000000 /end CHARACTERISTIC
/begin CHARACTERISTIC fbwSKDSCC5 "KDS  CARB Speichercode Bit 5" VALUE 0xF2B04 MSA15_FW3 0 DEZ_DW_U 0.000000 65535.000000 /end CHARACTERISTIC
/begin CHARACTERISTIC fbwSKDSCC6 "KDS  CARB Speichercode Bit 6" VALUE 0xF2B06 MSA15_FW3 0 DEZ_DW_U 0.000000 65535.000000 /end CHARACTERISTIC
/begin CHARACTERISTIC fbwSKDSCC7 "KDS  CARB Speichercode Bit 7" VALUE 0xF2B08 MSA15_FW3 0 DEZ_DW_U 0.000000 65535.000000 /end CHARACTERISTIC
/begin CHARACTERISTIC fbwSKDSENT "KDS  Entprellmodus" VALUE 0xF2AF5 MSA15_FW1 0 DEZ_DB_U 0.000000 255.000000 /end CHARACTERISTIC
/begin CHARACTERISTIC fbwSKDSFLC "KDS  Startwert Eintragzaehler" VALUE 0xF2AF6 MSA15_FW1 0 DEZ_DB_U 0.000000 255.000000 /end CHARACTERISTIC
/begin CHARACTERISTIC fbwSKDSHLC "KDS  Startwert Heilungszaehler" VALUE 0xF2AF7 MSA15_FW1 0 DEZ_DB_U 0.000000 255.000000 /end CHARACTERISTIC
/begin CHARACTERISTIC fbwSKDSPRI "KDS  Prioritaet" VALUE 0xF2AF4 MSA15_FW1 0 DEZ_DB_U 0.000000 3.000000 EXTENDED_LIMITS 0.000000 255.000000 /end CHARACTERISTIC
/begin CHARACTERISTIC fbwSKDSSPC "KDS  Code fuer Fehlerspeicherung" VALUE 0xF2AF2 MSA15_FW3 0 DEZ_DW_U 0.000000 65535.000000 /end CHARACTERISTIC
/begin CHARACTERISTIC fbwSKDSUB1 "KDS Umweltbedingung 1 fuer Fehlerspeicherung" VALUE 0xF2B0A MSA15_FW3 0 DEZ_DW_U 0.000000 65535.000000 /end CHARACTERISTIC
/begin CHARACTERISTIC fbwSKDSUB2 "KDS Umweltbedingung 2 fuer Fehlerspeicherung" VALUE 0xF2B0C MSA15_FW3 0 DEZ_DW_U 0.000000 65535.000000 /end CHARACTERISTIC
/begin CHARACTERISTIC fbwSKDSUB3 "KDS Umweltbedingung 3 fuer Fehlerspeicherung" VALUE 0xF2B0E MSA15_FW3 0 DEZ_DW_U 0.000000 65535.000000 /end CHARACTERISTIC
/begin CHARACTERISTIC fbwSKDSUB4 "KDS Umweltbedingung 4 fuer Fehlerspeicherung" VALUE 0xF2B10 MSA15_FW3 0 DEZ_DW_U 0.000000 65535.000000 /end CHARACTERISTIC
/begin CHARACTERISTIC fbwSKDSUB5 "KDS Umweltbedingung 5 fuer Fehlerspeicherung" VALUE 0xF2B12 MSA15_FW3 0 DEZ_DW_U 0.000000 65535.000000 /end CHARACTERISTIC
/begin CHARACTERISTIC fbwSKHPBCO "KHP  Blinkcode" VALUE 0xF2FB2 MSA15_FW3 0 DEZ_DW_U 0.000000 65535.000000 /end CHARACTERISTIC
/begin CHARACTERISTIC fbwSKHPCC0 "KHP  CARB Speichercode Bit 0" VALUE 0xF2FB4 MSA15_FW3 0 DEZ_DW_U 0.000000 65535.000000 /end CHARACTERISTIC
/begin CHARACTERISTIC fbwSKHPCC1 "KHP  CARB Speichercode Bit 1" VALUE 0xF2FB6 MSA15_FW3 0 DEZ_DW_U 0.000000 65535.000000 /end CHARACTERISTIC
/begin CHARACTERISTIC fbwSKHPCC2 "KHP  CARB Speichercode Bit 2" VALUE 0xF2FB8 MSA15_FW3 0 DEZ_DW_U 0.000000 65535.000000 /end CHARACTERISTIC
/begin CHARACTERISTIC fbwSKHPCC3 "KHP  CARB Speichercode Bit 3" VALUE 0xF2FBA MSA15_FW3 0 DEZ_DW_U 0.000000 65535.000000 /end CHARACTERISTIC
/begin CHARACTERISTIC fbwSKHPCC4 "KHP  CARB Speichercode Bit 4" VALUE 0xF2FBC MSA15_FW3 0 DEZ_DW_U 0.000000 65535.000000 /end CHARACTERISTIC
/begin CHARACTERISTIC fbwSKHPCC5 "KHP  CARB Speichercode Bit 5" VALUE 0xF2FBE MSA15_FW3 0 DEZ_DW_U 0.000000 65535.000000 /end CHARACTERISTIC
/begin CHARACTERISTIC fbwSKHPCC6 "KHP  CARB Speichercode Bit 6" VALUE 0xF2FC0 MSA15_FW3 0 DEZ_DW_U 0.000000 65535.000000 /end CHARACTERISTIC
/begin CHARACTERISTIC fbwSKHPCC7 "KHP  CARB Speichercode Bit 7" VALUE 0xF2FC2 MSA15_FW3 0 DEZ_DW_U 0.000000 65535.000000 /end CHARACTERISTIC
/begin CHARACTERISTIC fbwSKHPENT "KHP  Entrprellmodus" VALUE 0xF2FAF MSA15_FW1 0 DEZ_DB_U 0.000000 255.000000 /end CHARACTERISTIC
/begin CHARACTERISTIC fbwSKHPFLC "KHP  Startwert Eintragzaehler" VALUE 0xF2FB0 MSA15_FW1 0 DEZ_DB_U 0.000000 255.000000 /end CHARACTERISTIC
/begin CHARACTERISTIC fbwSKHPHLC "KHP  Startwert Heilungszaehler" VALUE 0xF2FB1 MSA15_FW1 0 DEZ_DB_U 0.000000 255.000000 /end CHARACTERISTIC
/begin CHARACTERISTIC fbwSKHPPRI "KHP  Prioritaet" VALUE 0xF2FAE MSA15_FW1 0 DEZ_DB_U 0.000000 3.000000 EXTENDED_LIMITS 0.000000 255.000000 /end CHARACTERISTIC
/begin CHARACTERISTIC fbwSKHPSPC "KHP  Code fuer Fehlerspeicherung" VALUE 0xF2FAC MSA15_FW3 0 DEZ_DW_U 0.000000 65535.000000 /end CHARACTERISTIC
/begin CHARACTERISTIC fbwSKHPUB1 "KHP Umweltbedingung 1 fuer Fehlerspeicherung" VALUE 0xF2FC4 MSA15_FW3 0 DEZ_DW_U 0.000000 65535.000000 /end CHARACTERISTIC
/begin CHARACTERISTIC fbwSKHPUB2 "KHP Umweltbedingung 2 fuer Fehlerspeicherung" VALUE 0xF2FC6 MSA15_FW3 0 DEZ_DW_U 0.000000 65535.000000 /end CHARACTERISTIC
/begin CHARACTERISTIC fbwSKHPUB3 "KHP Umweltbedingung 3 fuer Fehlerspeicherung" VALUE 0xF2FC8 MSA15_FW3 0 DEZ_DW_U 0.000000 65535.000000 /end CHARACTERISTIC
/begin CHARACTERISTIC fbwSKHPUB4 "KHP Umweltbedingung 4 fuer Fehlerspeicherung" VALUE 0xF2FCA MSA15_FW3 0 DEZ_DW_U 0.000000 65535.000000 /end CHARACTERISTIC
/begin CHARACTERISTIC fbwSKLIBCO "KLI  Blinkcode" VALUE 0xF34EE MSA15_FW3 0 DEZ_DW_U 0.000000 65535.000000 /end CHARACTERISTIC
/begin CHARACTERISTIC fbwSKLICC0 "KLI  CARB Speichercode Bit 0" VALUE 0xF34F0 MSA15_FW3 0 DEZ_DW_U 0.000000 65535.000000 /end CHARACTERISTIC
/begin CHARACTERISTIC fbwSKLICC1 "KLI  CARB Speichercode Bit 1" VALUE 0xF34F2 MSA15_FW3 0 DEZ_DW_U 0.000000 65535.000000 /end CHARACTERISTIC
/begin CHARACTERISTIC fbwSKLICC2 "KLI  CARB Speichercode Bit 2" VALUE 0xF34F4 MSA15_FW3 0 DEZ_DW_U 0.000000 65535.000000 /end CHARACTERISTIC
/begin CHARACTERISTIC fbwSKLICC3 "KLI  CARB Speichercode Bit 3" VALUE 0xF34F6 MSA15_FW3 0 DEZ_DW_U 0.000000 65535.000000 /end CHARACTERISTIC
/begin CHARACTERISTIC fbwSKLICC4 "KLI  CARB Speichercode Bit 4" VALUE 0xF34F8 MSA15_FW3 0 DEZ_DW_U 0.000000 65535.000000 /end CHARACTERISTIC
/begin CHARACTERISTIC fbwSKLICC5 "KLI  CARB Speichercode Bit 5" VALUE 0xF34FA MSA15_FW3 0 DEZ_DW_U 0.000000 65535.000000 /end CHARACTERISTIC
/begin CHARACTERISTIC fbwSKLICC6 "KLI  CARB Speichercode Bit 6" VALUE 0xF34FC MSA15_FW3 0 DEZ_DW_U 0.000000 65535.000000 /end CHARACTERISTIC
/begin CHARACTERISTIC fbwSKLICC7 "KLI  CARB Speichercode Bit 7" VALUE 0xF34FE MSA15_FW3 0 DEZ_DW_U 0.000000 65535.000000 /end CHARACTERISTIC
/begin CHARACTERISTIC fbwSKLIENT "KLI  Entrprellmodus" VALUE 0xF34EB MSA15_FW1 0 DEZ_DB_U 0.000000 255.000000 /end CHARACTERISTIC
/begin CHARACTERISTIC fbwSKLIFLC "KLI  Startwert Eintragzaehler" VALUE 0xF34EC MSA15_FW1 0 DEZ_DB_U 0.000000 255.000000 /end CHARACTERISTIC
/begin CHARACTERISTIC fbwSKLIHLC "KLI  Startwert Heilungszaehler" VALUE 0xF34ED MSA15_FW1 0 DEZ_DB_U 0.000000 255.000000 /end CHARACTERISTIC
/begin CHARACTERISTIC fbwSKLIPRI "KLI  Prioritaet" VALUE 0xF34EA MSA15_FW1 0 DEZ_DB_U 0.000000 3.000000 EXTENDED_LIMITS 0.000000 255.000000 /end CHARACTERISTIC
/begin CHARACTERISTIC fbwSKLISPC "KLI  Code fuer Fehlerspeicherung" VALUE 0xF34E8 MSA15_FW3 0 DEZ_DW_U 0.000000 65535.000000 /end CHARACTERISTIC
/begin CHARACTERISTIC fbwSKLIUB1 "KLI Umweltbedingung 1 fuer Fehlerspeicherung" VALUE 0xF3500 MSA15_FW3 0 DEZ_DW_U 0.000000 65535.000000 /end CHARACTERISTIC
/begin CHARACTERISTIC fbwSKLIUB2 "KLI Umweltbedingung 2 fuer Fehlerspeicherung" VALUE 0xF3502 MSA15_FW3 0 DEZ_DW_U 0.000000 65535.000000 /end CHARACTERISTIC
/begin CHARACTERISTIC fbwSKLIUB3 "KLI              *!na Umweltbedingung 3 fuer Fehlerspeicherung" VALUE 0xF3504 MSA15_FW3 0 DEZ_DW_U 0.000000 65535.000000 /end CHARACTERISTIC
/begin CHARACTERISTIC fbwSKLIUB4 "KLI              *!na Umweltbedingung 4 fuer Fehlerspeicherung" VALUE 0xF3506 MSA15_FW3 0 DEZ_DW_U 0.000000 65535.000000 /end CHARACTERISTIC
/begin CHARACTERISTIC fbwSKTFBCO "KTF  Blinkcode" VALUE 0xF28CE MSA15_FW3 0 DEZ_DW_U 0.000000 65535.000000 /end CHARACTERISTIC
/begin CHARACTERISTIC fbwSKTFCC0 "KTF  CARB Speichercode Bit 0" VALUE 0xF28D0 MSA15_FW3 0 DEZ_DW_U 0.000000 65535.000000 /end CHARACTERISTIC
/begin CHARACTERISTIC fbwSKTFCC1 "KTF  CARB Speichercode Bit 1" VALUE 0xF28D2 MSA15_FW3 0 DEZ_DW_U 0.000000 65535.000000 /end CHARACTERISTIC
/begin CHARACTERISTIC fbwSKTFCC2 "KTF  CARB Speichercode Bit 2" VALUE 0xF28D4 MSA15_FW3 0 DEZ_DW_U 0.000000 65535.000000 /end CHARACTERISTIC
/begin CHARACTERISTIC fbwSKTFCC3 "KTF  CARB Speichercode Bit 3" VALUE 0xF28D6 MSA15_FW3 0 DEZ_DW_U 0.000000 65535.000000 /end CHARACTERISTIC
/begin CHARACTERISTIC fbwSKTFCC4 "KTF  CARB Speichercode Bit 4" VALUE 0xF28D8 MSA15_FW3 0 DEZ_DW_U 0.000000 65535.000000 /end CHARACTERISTIC
/begin CHARACTERISTIC fbwSKTFCC5 "KTF  CARB Speichercode Bit 5" VALUE 0xF28DA MSA15_FW3 0 DEZ_DW_U 0.000000 65535.000000 /end CHARACTERISTIC
/begin CHARACTERISTIC fbwSKTFCC6 "KTF  CARB Speichercode Bit 6" VALUE 0xF28DC MSA15_FW3 0 DEZ_DW_U 0.000000 65535.000000 /end CHARACTERISTIC
/begin CHARACTERISTIC fbwSKTFCC7 "KTF  CARB Speichercode Bit 7" VALUE 0xF28DE MSA15_FW3 0 DEZ_DW_U 0.000000 65535.000000 /end CHARACTERISTIC
/begin CHARACTERISTIC fbwSKTFENT "KTF  Entrprellmodus" VALUE 0xF28CB MSA15_FW1 0 DEZ_DB_U 0.000000 255.000000 /end CHARACTERISTIC
/begin CHARACTERISTIC fbwSKTFFLC "KTF  Startwert Eintragzaehler" VALUE 0xF28CC MSA15_FW1 0 DEZ_DB_U 0.000000 255.000000 /end CHARACTERISTIC
/begin CHARACTERISTIC fbwSKTFHLC "KTF  Startwert Heilungszaehler" VALUE 0xF28CD MSA15_FW1 0 DEZ_DB_U 0.000000 255.000000 /end CHARACTERISTIC
/begin CHARACTERISTIC fbwSKTFPRI "KTF  Prioritaet" VALUE 0xF28CA MSA15_FW1 0 DEZ_DB_U 0.000000 3.000000 EXTENDED_LIMITS 0.000000 255.000000 /end CHARACTERISTIC
/begin CHARACTERISTIC fbwSKTFSPC "KTF  Code fuer Fehlerspeicherung" VALUE 0xF28C8 MSA15_FW3 0 DEZ_DW_U 0.000000 65535.000000 /end CHARACTERISTIC
/begin CHARACTERISTIC fbwSKTFUB1 "KTF Umweltbedingung 1" VALUE 0xF28E0 MSA15_FW3 0 DEZ_DW_U 0.000000 65535.000000 /end CHARACTERISTIC
/begin CHARACTERISTIC fbwSKTFUB2 "KTF Umweltbedingung 2" VALUE 0xF28E2 MSA15_FW3 0 DEZ_DW_U 0.000000 65535.000000 /end CHARACTERISTIC
/begin CHARACTERISTIC fbwSKTFUB3 "KTF Umweltbedingung 3" VALUE 0xF28E4 MSA15_FW3 0 DEZ_DW_U 0.000000 65535.000000 /end CHARACTERISTIC
/begin CHARACTERISTIC fbwSKTFUB4 "KTF Umweltbedingung 4" VALUE 0xF28E6 MSA15_FW3 0 DEZ_DW_U 0.000000 65535.000000 /end CHARACTERISTIC
/begin CHARACTERISTIC fbwSKUPBCO "KUP  Blinkcode" VALUE 0xF3376 MSA15_FW3 0 DEZ_DW_U 0.000000 65535.000000 /end CHARACTERISTIC
/begin CHARACTERISTIC fbwSKUPCC0 "KUP  CARB Speichercode Bit 0" VALUE 0xF3378 MSA15_FW3 0 DEZ_DW_U 0.000000 65535.000000 /end CHARACTERISTIC
/begin CHARACTERISTIC fbwSKUPCC1 "KUP  CARB Speichercode Bit 1" VALUE 0xF337A MSA15_FW3 0 DEZ_DW_U 0.000000 65535.000000 /end CHARACTERISTIC
/begin CHARACTERISTIC fbwSKUPCC2 "KUP  CARB Speichercode Bit 2" VALUE 0xF337C MSA15_FW3 0 DEZ_DW_U 0.000000 65535.000000 /end CHARACTERISTIC
/begin CHARACTERISTIC fbwSKUPCC3 "KUP  CARB Speichercode Bit 3" VALUE 0xF337E MSA15_FW3 0 DEZ_DW_U 0.000000 65535.000000 /end CHARACTERISTIC
/begin CHARACTERISTIC fbwSKUPCC4 "KUP  CARB Speichercode Bit 4" VALUE 0xF3380 MSA15_FW3 0 DEZ_DW_U 0.000000 65535.000000 /end CHARACTERISTIC
/begin CHARACTERISTIC fbwSKUPCC5 "KUP  CARB Speichercode Bit 5" VALUE 0xF3382 MSA15_FW3 0 DEZ_DW_U 0.000000 65535.000000 /end CHARACTERISTIC
/begin CHARACTERISTIC fbwSKUPCC6 "KUP  CARB Speichercode Bit 6" VALUE 0xF3384 MSA15_FW3 0 DEZ_DW_U 0.000000 65535.000000 /end CHARACTERISTIC
/begin CHARACTERISTIC fbwSKUPCC7 "KUP  CARB Speichercode Bit 7" VALUE 0xF3386 MSA15_FW3 0 DEZ_DW_U 0.000000 65535.000000 /end CHARACTERISTIC
/begin CHARACTERISTIC fbwSKUPENT "KUP  Entrprellmodus" VALUE 0xF3373 MSA15_FW1 0 DEZ_DB_U 0.000000 255.000000 /end CHARACTERISTIC
/begin CHARACTERISTIC fbwSKUPFLC "KUP  Startwert Eintragzaehler" VALUE 0xF3374 MSA15_FW1 0 DEZ_DB_U 0.000000 255.000000 /end CHARACTERISTIC
/begin CHARACTERISTIC fbwSKUPHLC "KUP  Startwert Heilungszaehler" VALUE 0xF3375 MSA15_FW1 0 DEZ_DB_U 0.000000 255.000000 /end CHARACTERISTIC
/begin CHARACTERISTIC fbwSKUPPRI "KUP  Prioritaet" VALUE 0xF3372 MSA15_FW1 0 DEZ_DB_U 0.000000 3.000000 EXTENDED_LIMITS 0.000000 255.000000 /end CHARACTERISTIC
/begin CHARACTERISTIC fbwSKUPSPC "KUP  Code fuer Fehlerspeicherung" VALUE 0xF3370 MSA15_FW3 0 DEZ_DW_U 0.000000 65535.000000 /end CHARACTERISTIC
/begin CHARACTERISTIC fbwSKUPUB1 "KUP Umweltbedingung 1 fuer Fehlerspeicherung" VALUE 0xF3388 MSA15_FW3 0 DEZ_DW_U 0.000000 65535.000000 /end CHARACTERISTIC
/begin CHARACTERISTIC fbwSKUPUB2 "KUP Umweltbedingung 2 fuer Fehlerspeicherung" VALUE 0xF338A MSA15_FW3 0 DEZ_DW_U 0.000000 65535.000000 /end CHARACTERISTIC
/begin CHARACTERISTIC fbwSKUPUB3 "KUP Umweltbedingung 3 fuer Fehlerspeicherung" VALUE 0xF338C MSA15_FW3 0 DEZ_DW_U 0.000000 65535.000000 /end CHARACTERISTIC
/begin CHARACTERISTIC fbwSKUPUB4 "KUP Umweltbedingung 4 fuer Fehlerspeicherung" VALUE 0xF338E MSA15_FW3 0 DEZ_DW_U 0.000000 65535.000000 /end CHARACTERISTIC
/begin CHARACTERISTIC fbwSKW2BCO "KWH Blinkcode" VALUE 0xF3036 MSA15_FW3 0 DEZ_DW_U 0.000000 65535.000000 /end CHARACTERISTIC
/begin CHARACTERISTIC fbwSKW2CC0 "KWH CARB Speichercode Bit 0" VALUE 0xF3038 MSA15_FW3 0 DEZ_DW_U 0.000000 65535.000000 /end CHARACTERISTIC
/begin CHARACTERISTIC fbwSKW2CC1 "KWH CARB Speichercode Bit 1" VALUE 0xF303A MSA15_FW3 0 DEZ_DW_U 0.000000 65535.000000 /end CHARACTERISTIC
/begin CHARACTERISTIC fbwSKW2CC2 "KWH CARB Speichercode Bit 2" VALUE 0xF303C MSA15_FW3 0 DEZ_DW_U 0.000000 65535.000000 /end CHARACTERISTIC
/begin CHARACTERISTIC fbwSKW2CC3 "KWH CARB Speichercode Bit 3" VALUE 0xF303E MSA15_FW3 0 DEZ_DW_U 0.000000 65535.000000 /end CHARACTERISTIC
/begin CHARACTERISTIC fbwSKW2CC4 "KWH CARB Speichercode Bit 4" VALUE 0xF3040 MSA15_FW3 0 DEZ_DW_U 0.000000 65535.000000 /end CHARACTERISTIC
/begin CHARACTERISTIC fbwSKW2CC5 "KWH CARB Speichercode Bit 5" VALUE 0xF3042 MSA15_FW3 0 DEZ_DW_U 0.000000 65535.000000 /end CHARACTERISTIC
/begin CHARACTERISTIC fbwSKW2CC6 "KWH CARB Speichercode Bit 6" VALUE 0xF3044 MSA15_FW3 0 DEZ_DW_U 0.000000 65535.000000 /end CHARACTERISTIC
/begin CHARACTERISTIC fbwSKW2CC7 "KWH CARB Speichercode Bit 7" VALUE 0xF3046 MSA15_FW3 0 DEZ_DW_U 0.000000 65535.000000 /end CHARACTERISTIC
/begin CHARACTERISTIC fbwSKW2ENT "KWH  Entprellmodus" VALUE 0xF3033 MSA15_FW1 0 DEZ_DB_U 0.000000 255.000000 /end CHARACTERISTIC
/begin CHARACTERISTIC fbwSKW2FLC "KWH Startwert Eintragzaehler" VALUE 0xF3034 MSA15_FW1 0 DEZ_DB_U 0.000000 255.000000 /end CHARACTERISTIC
/begin COMPU_METHOD DEZ_DB_U "Uebernahme von Festwerten von 0 bis 255" RAT_FUNC "%8.4" "-" COEFFS 0 1.000000 0.000000 0 0.000000 1.000000 /end COMPU_METHOD
/begin COMPU_METHOD DEZ_DW_U "Uebernahme von Festwerten von 0 bis 65535" RAT_FUNC "%8.2" "-" COEFFS 0 1.000000 0.000000 0 0.000000 1.000000 /end COMPU_METHOD
/begin COMPU_METHOD ZEIT_ST "Umrechnung Zeit Softwaretimer" RAT_FUNC "%9.0" "us" COEFFS 0 1.000000 0.000000 0 0.000000 10000.000000 /end COMPU_METHOD
/end MODULE
/end PROJECT
