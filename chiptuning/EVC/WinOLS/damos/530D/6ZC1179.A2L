ASAP2_VERSION 1 3
/begin PROJECT _ "  P079.VC4.VA02  B07902C4.DAM:  DAMPAR_03"
/begin HEADER "EDC15C" PROJECT_NO VAR02 VERSION "MAX_KLKF" /end HEADER
/begin MODULE DIM " "
/begin MOD_COMMON " " S_REC_LAYOUT MSA15 DEPOSIT ABSOLUTE BYTE_ORDER MSB_LAST /end MOD_COMMON
/begin RECORD_LAYOUT MSA15_FW4 FNC_VALUES 1 SWORD COLUMN_DIR DIRECT /end RECORD_LAYOUT
/begin RECORD_LAYOUT MSA15_FW3 FNC_VALUES 1 UWORD COLUMN_DIR DIRECT /end RECORD_LAYOUT
/begin RECORD_LAYOUT MSA15_KL118 SRC_ADDR_X 1 UWORD NO_AXIS_PTS_X 2 UWORD AXIS_PTS_X 3 SWORD INDEX_INCR DIRECT FNC_VALUES 4 SWORD COLUMN_DIR DIRECT /end RECORD_LAYOUT
/begin RECORD_LAYOUT MSA15_KF358 SRC_ADDR_X 1 UWORD NO_AXIS_PTS_X 2 UWORD AXIS_PTS_X 3 SWORD INDEX_INCR DIRECT SRC_ADDR_Y 4 UWORD NO_AXIS_PTS_Y 5 UWORD AXIS_PTS_Y 6 UWORD INDEX_INCR DIRECT FNC_VALUES 7 SWORD COLUMN_DIR DIRECT /end RECORD_LAYOUT
/begin RECORD_LAYOUT MSA15_KF382 SRC_ADDR_X 1 UWORD NO_AXIS_PTS_X 2 UWORD AXIS_PTS_X 3 SWORD INDEX_INCR DIRECT SRC_ADDR_Y 4 UWORD NO_AXIS_PTS_Y 5 UWORD AXIS_PTS_Y 6 SWORD INDEX_INCR DIRECT FNC_VALUES 7 SWORD COLUMN_DIR DIRECT /end RECORD_LAYOUT
/begin RECORD_LAYOUT MSA15_FW1 FNC_VALUES 1 UBYTE COLUMN_DIR DIRECT /end RECORD_LAYOUT
/begin RECORD_LAYOUT MSA15_FW2 FNC_VALUES 1 SBYTE COLUMN_DIR DIRECT /end RECORD_LAYOUT
/begin RECORD_LAYOUT MSA15_KF381 SRC_ADDR_X 1 UWORD NO_AXIS_PTS_X 2 UWORD AXIS_PTS_X 3 SWORD INDEX_INCR DIRECT SRC_ADDR_Y 4 UWORD NO_AXIS_PTS_Y 5 UWORD AXIS_PTS_Y 6 SWORD INDEX_INCR DIRECT FNC_VALUES 7 UWORD COLUMN_DIR DIRECT /end RECORD_LAYOUT
/begin CHARACTERISTIC mrwLLGWK_a "LLR quadrat. G-Faktor DT1-Glied: Warmer Motor, Kupplung" VALUE 0xF39DE MSA15_FW4 0 DEZ_DW -32768.000000 32767.000000 /end CHARACTERISTIC
/begin CHARACTERISTIC mrwLLGWK_b "LLR linearer G-Faktor DT1-Glied: Warmer Motor, Kupplung" VALUE 0xF39E0 MSA15_FW4 0 DEZ_DW -32768.000000 32767.000000 /end CHARACTERISTIC
/begin CHARACTERISTIC mrwLLGWK_c "LLR konstanter G-Faktor DT1-Glied: Warmer Motor, Kupplung" VALUE 0xF39E2 MSA15_FW4 0 DEZ_DW -32768.000000 32767.000000 /end CHARACTERISTIC
/begin CHARACTERISTIC mrwLLI1G_F "LLR I-Glied Fenster: Warm, 1.Gang" VALUE 0xF399E MSA15_FW4 0 N 0.000000 6000.000000 EXTENDED_LIMITS 0.000000 32767.000000 /end CHARACTERISTIC
/begin CHARACTERISTIC mrwLLI1G_N "LLR I-Verst. neg. Gross-S.: Warm, 1.Gang" VALUE 0xF39A2 MSA15_FW4 0 LLR_KI 0.000000 2.000034 EXTENDED_LIMITS 0.000000 2.441332 /end CHARACTERISTIC
/begin CHARACTERISTIC mrwLLI1G_P "LLR I-Verst. pos. Gross-S.: Warm, 1.Gang" VALUE 0xF39A4 MSA15_FW4 0 LLR_KI 0.000000 2.000034 EXTENDED_LIMITS 0.000000 2.441332 /end CHARACTERISTIC
/begin CHARACTERISTIC mrwLLI1G_S "LLR I-Verst Kleinsignal: Warm, 1.Gang" VALUE 0xF39A0 MSA15_FW4 0 LLR_KI 0.000000 2.000034 EXTENDED_LIMITS 0.000000 2.441332 /end CHARACTERISTIC
/begin CHARACTERISTIC mrwLLI2G_F "LLR I-Glied Fenster: Warm, 2.Gang" VALUE 0xF39AA MSA15_FW4 0 N 0.000000 6000.000000 EXTENDED_LIMITS 0.000000 32767.000000 /end CHARACTERISTIC
/begin CHARACTERISTIC mrwLLI2G_N "LLR I-Verst. neg. Gross-S.: Warm, 2.Gang" VALUE 0xF39AE MSA15_FW4 0 LLR_KI 0.000000 2.000034 EXTENDED_LIMITS 0.000000 2.441332 /end CHARACTERISTIC
/begin CHARACTERISTIC mrwLLI2G_P "LLR I-Verst. pos. Gross-S.: Warm, 2.Gang" VALUE 0xF39B0 MSA15_FW4 0 LLR_KI 0.000000 2.000034 EXTENDED_LIMITS 0.000000 2.441332 /end CHARACTERISTIC
/begin CHARACTERISTIC mrwLLI2G_S "LLR I-Verst Kleinsignal: Warm, 2.Gang" VALUE 0xF39AC MSA15_FW4 0 LLR_KI 0.000000 2.000034 EXTENDED_LIMITS 0.000000 2.441332 /end CHARACTERISTIC
/begin CHARACTERISTIC mrwLLI3G_F "LLR I-Glied Fenster: Warm, 3.Gang" VALUE 0xF39B6 MSA15_FW4 0 N 0.000000 6000.000000 EXTENDED_LIMITS 0.000000 32767.000000 /end CHARACTERISTIC
/begin CHARACTERISTIC mrwLLI3G_N "LLR I-Verst. neg. Gross-S.: Warm, 3.Gang" VALUE 0xF39BA MSA15_FW4 0 LLR_KI 0.000000 2.000034 EXTENDED_LIMITS 0.000000 2.441332 /end CHARACTERISTIC
/begin CHARACTERISTIC mrwLLI3G_P "LLR I-Verst. pos. Gross-S.: Warm, 3.Gang" VALUE 0xF39BC MSA15_FW4 0 LLR_KI 0.000000 2.000034 EXTENDED_LIMITS 0.000000 2.441332 /end CHARACTERISTIC
/begin CHARACTERISTIC mrwLLI3G_S "LLR I-Verst Kleinsignal: Warm, 3.Gang" VALUE 0xF39B8 MSA15_FW4 0 LLR_KI 0.000000 2.000034 EXTENDED_LIMITS 0.000000 2.441332 /end CHARACTERISTIC
/begin CHARACTERISTIC mrwLLI4G_F "LLR I-Glied Fenster: Warm, 4.Gang" VALUE 0xF39C2 MSA15_FW4 0 N 0.000000 6000.000000 EXTENDED_LIMITS 0.000000 32767.000000 /end CHARACTERISTIC
/begin CHARACTERISTIC mrwLLI4G_N "LLR I-Verst. neg. Gross-S.: Warm, 4.Gang" VALUE 0xF39C6 MSA15_FW4 0 LLR_KI 0.000000 2.000034 EXTENDED_LIMITS 0.000000 2.441332 /end CHARACTERISTIC
/begin CHARACTERISTIC mrwLLI4G_P "LLR I-Verst. pos. Gross-S.: Warm, 4.Gang" VALUE 0xF39C8 MSA15_FW4 0 LLR_KI 0.000000 2.000034 EXTENDED_LIMITS 0.000000 2.441332 /end CHARACTERISTIC
/begin CHARACTERISTIC mrwLLI4G_S "LLR I-Verst Kleinsignal: Warm, 4.Gang" VALUE 0xF39C4 MSA15_FW4 0 LLR_KI 0.000000 2.000034 EXTENDED_LIMITS 0.000000 2.441332 /end CHARACTERISTIC
/begin CHARACTERISTIC mrwLLI5G_F "LLR I-Glied Fenster: Warm, 5.Gang" VALUE 0xF39CE MSA15_FW4 0 N 0.000000 6000.000000 EXTENDED_LIMITS 0.000000 32767.000000 /end CHARACTERISTIC
/begin CHARACTERISTIC mrwLLI5G_N "LLR I-Verst. neg. Gross-S.: Warm, 5.Gang" VALUE 0xF39D2 MSA15_FW4 0 LLR_KI 0.000000 2.000034 EXTENDED_LIMITS 0.000000 2.441332 /end CHARACTERISTIC
/begin CHARACTERISTIC mrwLLI5G_P "LLR I-Verst. pos. Gross-S.: Warm, 5.Gang" VALUE 0xF39D4 MSA15_FW4 0 LLR_KI 0.000000 2.000034 EXTENDED_LIMITS 0.000000 2.441332 /end CHARACTERISTIC
/begin CHARACTERISTIC mrwLLI5G_S "LLR I-Verst Kleinsignal: Warm, 5.Gang" VALUE 0xF39D0 MSA15_FW4 0 LLR_KI 0.000000 2.000034 EXTENDED_LIMITS 0.000000 2.441332 /end CHARACTERISTIC
/begin CHARACTERISTIC mrwLLIKG_F "LLR I-Glied Fenster: Kalter Motor, Gang" VALUE 0xF3992 MSA15_FW4 0 N 0.000000 6000.000000 EXTENDED_LIMITS 0.000000 32767.000000 /end CHARACTERISTIC
/begin CHARACTERISTIC mrwLLIKG_N "LLR I-Verst. neg. Gross-S.: Kalter Motor, Gang" VALUE 0xF3996 MSA15_FW4 0 LLR_KI 0.000000 2.000034 EXTENDED_LIMITS 0.000000 2.441332 /end CHARACTERISTIC
/begin CHARACTERISTIC mrwLLIKG_P "LLR I-Verst. pos. Gross-S.: Kalter Motor, Gang" VALUE 0xF3998 MSA15_FW4 0 LLR_KI 0.000000 2.000034 EXTENDED_LIMITS 0.000000 2.441332 /end CHARACTERISTIC
/begin CHARACTERISTIC mrwLLIKG_S "LLR I-Verst Kleinsignal: Kalter Motor, Gang" VALUE 0xF3994 MSA15_FW4 0 LLR_KI 0.000000 2.000034 EXTENDED_LIMITS 0.000000 2.441332 /end CHARACTERISTIC
/begin CHARACTERISTIC mrwLLIKK_F "LLR I-Glied Fenster: Kalter Motor, Kupplung" VALUE 0xF3986 MSA15_FW4 0 N 0.000000 6000.000000 EXTENDED_LIMITS 0.000000 32767.000000 /end CHARACTERISTIC
/begin CHARACTERISTIC mrwLLIKK_N "LLR I-Verst. neg. Gross-S.: Kalter Motor, Kupplung" VALUE 0xF398A MSA15_FW4 0 LLR_KI 0.000000 2.000034 EXTENDED_LIMITS 0.000000 2.441332 /end CHARACTERISTIC
/begin CHARACTERISTIC mrwLLIKK_P "LLR I-Verst. pos. Gross-S.: Kalter Motor, Kupplung" VALUE 0xF398C MSA15_FW4 0 LLR_KI 0.000000 2.000034 EXTENDED_LIMITS 0.000000 2.441332 /end CHARACTERISTIC
/begin CHARACTERISTIC mrwLLIKK_S "LLR I-Verst Kleinsignal: Kalter Motor, Kupplung" VALUE 0xF3988 MSA15_FW4 0 LLR_KI 0.000000 2.000034 EXTENDED_LIMITS 0.000000 2.441332 /end CHARACTERISTIC
/begin CHARACTERISTIC mrwLLIWK_F "LLR I-Glied Fenster: Warmer Motor, Kupplung" VALUE 0xF397A MSA15_FW4 0 N 0.000000 6000.000000 EXTENDED_LIMITS 0.000000 32767.000000 /end CHARACTERISTIC
/begin CHARACTERISTIC mrwLLIWK_N "LLR I-Verst. neg. Gross-S.: Warmer Motor, Kupplung" VALUE 0xF397E MSA15_FW4 0 LLR_KI 0.000000 2.000034 EXTENDED_LIMITS 0.000000 2.441332 /end CHARACTERISTIC
/begin CHARACTERISTIC mrwLLIWK_P "LLR I-Verst. pos. Gross-S.: Warmer Motor, Kupplung" VALUE 0xF3980 MSA15_FW4 0 LLR_KI 0.000000 2.000034 EXTENDED_LIMITS 0.000000 2.441332 /end CHARACTERISTIC
/begin CHARACTERISTIC mrwLLIWK_S "LLR I-Verst Kleinsignal: Warmer Motor, Kupplung" VALUE 0xF397C MSA15_FW4 0 LLR_KI 0.000000 2.000034 EXTENDED_LIMITS 0.000000 2.441332 /end CHARACTERISTIC
/begin CHARACTERISTIC mrwLLKG_ES "LLR Einschrittmenge Vorsteuerung: Kalter Motor, Gang" VALUE 0xF399C MSA15_FW4 0 M_E 0.000000 100.000000 EXTENDED_LIMITS -327.680000 327.670000 /end CHARACTERISTIC
/begin CHARACTERISTIC mrwLLKK_ES "LLR Einschrittmenge Vorsteuerung: Kaltmer Motor, Kupplung" VALUE 0xF3990 MSA15_FW4 0 M_E 0.000000 100.000000 EXTENDED_LIMITS -327.680000 327.670000 /end CHARACTERISTIC
/begin CHARACTERISTIC mrwLLP1G_F "LLR P-Glied Fenster: Warm, 1.Gang" VALUE 0xF3948 MSA15_FW4 0 N 0.000000 6000.000000 EXTENDED_LIMITS 0.000000 32767.000000 /end CHARACTERISTIC
/begin CHARACTERISTIC mrwLLP1G_N "LLR P-Verst. neg Grossignal: Warm, 1.Gang" VALUE 0xF394C MSA15_FW4 0 LLR_KP 0.000000 2.000000 EXTENDED_LIMITS 0.000000 2.559922 /end CHARACTERISTIC
/begin CHARACTERISTIC mrwLLP1G_P "LLR P-Verst. pos Grossignal: Warm, 1.Gang" VALUE 0xF394E MSA15_FW4 0 LLR_KP 0.000000 2.000000 EXTENDED_LIMITS 0.000000 2.559922 /end CHARACTERISTIC
/begin CHARACTERISTIC mrwLLP1G_S "LLR P-Verst. Kleinsignal: Warm, 1.Gang" VALUE 0xF394A MSA15_FW4 0 LLR_KP 0.000000 2.000000 EXTENDED_LIMITS 0.000000 2.559922 /end CHARACTERISTIC
/begin CHARACTERISTIC mrwLLP2G_F "LLR P-Glied Fenster: Warm, 2.Gang" VALUE 0xF3952 MSA15_FW4 0 N 0.000000 6000.000000 EXTENDED_LIMITS 0.000000 32767.000000 /end CHARACTERISTIC
/begin CHARACTERISTIC mrwLLP2G_N "LLR P-Verst. neg Grossignal: Warm, 2.Gang" VALUE 0xF3956 MSA15_FW4 0 LLR_KP 0.000000 2.000000 EXTENDED_LIMITS 0.000000 2.559922 /end CHARACTERISTIC
/begin CHARACTERISTIC mrwLLP2G_P "LLR P-Verst. pos Grossignal: Warm, 2.Gang" VALUE 0xF3958 MSA15_FW4 0 LLR_KP 0.000000 2.000000 EXTENDED_LIMITS 0.000000 2.559922 /end CHARACTERISTIC
/begin CHARACTERISTIC mrwLLP2G_S "LLR P-Verst. Kleinsignal: Warm, 2.Gang" VALUE 0xF3954 MSA15_FW4 0 LLR_KP 0.000000 2.000000 EXTENDED_LIMITS 0.000000 2.559922 /end CHARACTERISTIC
/begin CHARACTERISTIC mrwLLP3G_F "LLR P-Glied Fenster: Warm, 3.Gang" VALUE 0xF395C MSA15_FW4 0 N 0.000000 6000.000000 EXTENDED_LIMITS 0.000000 32767.000000 /end CHARACTERISTIC
/begin CHARACTERISTIC mrwLLP3G_N "LLR P-Verst. neg Grossignal: Warm, 3.Gang" VALUE 0xF3960 MSA15_FW4 0 LLR_KP 0.000000 2.000000 EXTENDED_LIMITS 0.000000 2.559922 /end CHARACTERISTIC
/begin CHARACTERISTIC mrwLLP3G_P "LLR P-Verst. pos Grossignal: Warm, 3.Gang" VALUE 0xF3962 MSA15_FW4 0 LLR_KP 0.000000 2.000000 EXTENDED_LIMITS 0.000000 2.559922 /end CHARACTERISTIC
/begin CHARACTERISTIC mrwLLP3G_S "LLR P-Verst. Kleinsignal: Warm, 3.Gang" VALUE 0xF395E MSA15_FW4 0 LLR_KP 0.000000 2.000000 EXTENDED_LIMITS 0.000000 2.559922 /end CHARACTERISTIC
/begin CHARACTERISTIC mrwLLP4G_F "LLR P-Glied Fenster: Warm, 4.Gang" VALUE 0xF3966 MSA15_FW4 0 N 0.000000 6000.000000 EXTENDED_LIMITS 0.000000 32767.000000 /end CHARACTERISTIC
/begin CHARACTERISTIC mrwLLP4G_N "LLR P-Verst. neg Grossignal: Warm, 4.Gang" VALUE 0xF396A MSA15_FW4 0 LLR_KP 0.000000 2.000000 EXTENDED_LIMITS 0.000000 2.559922 /end CHARACTERISTIC
/begin CHARACTERISTIC mrwLLP4G_P "LLR P-Verst. pos Grossignal: Warm, 4.Gang" VALUE 0xF396C MSA15_FW4 0 LLR_KP 0.000000 2.000000 EXTENDED_LIMITS 0.000000 2.559922 /end CHARACTERISTIC
/begin CHARACTERISTIC mrwLLP4G_S "LLR P-Verst. Kleinsignal: Warm, 4.Gang" VALUE 0xF3968 MSA15_FW4 0 LLR_KP 0.000000 2.000000 EXTENDED_LIMITS 0.000000 2.559922 /end CHARACTERISTIC
/begin CHARACTERISTIC mrwLLP5G_F "LLR P-Glied Fenster: Warm, 5.Gang" VALUE 0xF3970 MSA15_FW4 0 N 0.000000 6000.000000 EXTENDED_LIMITS 0.000000 32767.000000 /end CHARACTERISTIC
/begin CHARACTERISTIC mrwLLP5G_N "LLR P-Verst. neg Grossignal: Warm, 5.Gang" VALUE 0xF3974 MSA15_FW4 0 LLR_KP 0.000000 2.000000 EXTENDED_LIMITS 0.000000 2.559922 /end CHARACTERISTIC
/begin CHARACTERISTIC mrwLLP5G_P "LLR P-Verst. pos Grossignal: Warm, 5.Gang" VALUE 0xF3976 MSA15_FW4 0 LLR_KP 0.000000 2.000000 EXTENDED_LIMITS 0.000000 2.559922 /end CHARACTERISTIC
/begin CHARACTERISTIC mrwLLP5G_S "LLR P-Verst. Kleinsignal: Warm, 5.Gang" VALUE 0xF3972 MSA15_FW4 0 LLR_KP 0.000000 2.000000 EXTENDED_LIMITS 0.000000 2.559922 /end CHARACTERISTIC
/begin CHARACTERISTIC mrwLLPKG_F "LLR P-Glied Fenster: Kalter Motor, Gang" VALUE 0xF393E MSA15_FW4 0 N 0.000000 6000.000000 EXTENDED_LIMITS 0.000000 32767.000000 /end CHARACTERISTIC
/begin CHARACTERISTIC mrwLLPKG_N "LLR P-Verst. neg Grossignal: Kalter Motor, Gang" VALUE 0xF3942 MSA15_FW4 0 LLR_KP 0.000000 2.000000 EXTENDED_LIMITS 0.000000 2.559922 /end CHARACTERISTIC
/begin CHARACTERISTIC mrwLLPKG_P "LLR P-Verst. pos Grossignal: Kalter Motor, Gang" VALUE 0xF3944 MSA15_FW4 0 LLR_KP 0.000000 2.000000 EXTENDED_LIMITS 0.000000 2.559922 /end CHARACTERISTIC
/begin CHARACTERISTIC mrwLLPKG_S "LLR P-Verst. Kleinsignal: Kalter Motor, Gang" VALUE 0xF3940 MSA15_FW4 0 LLR_KP 0.000000 2.000000 EXTENDED_LIMITS 0.000000 2.559922 /end CHARACTERISTIC
/begin CHARACTERISTIC mrwLLPKK_F "LLR P-Glied Fenster: Kalter Motor, Kupplung" VALUE 0xF3934 MSA15_FW4 0 N 0.000000 6000.000000 EXTENDED_LIMITS 0.000000 32767.000000 /end CHARACTERISTIC
/begin CHARACTERISTIC mrwLLPKK_N "LLR P-Verst. neg Grossignal: Kalter Motor, Kupplung" VALUE 0xF3938 MSA15_FW4 0 LLR_KP 0.000000 2.000000 EXTENDED_LIMITS 0.000000 2.559922 /end CHARACTERISTIC
/begin CHARACTERISTIC mrwLLPKK_P "LLR P-Verst. pos Grossignal: Kalter Motor, Kupplung" VALUE 0xF393A MSA15_FW4 0 LLR_KP 0.000000 2.000000 EXTENDED_LIMITS 0.000000 2.559922 /end CHARACTERISTIC
/begin CHARACTERISTIC mrwLLPKK_S "LLR P-Verst. Kleinsignal: Kalter Motor, Kupplung" VALUE 0xF3936 MSA15_FW4 0 LLR_KP 0.000000 2.000000 EXTENDED_LIMITS 0.000000 2.559922 /end CHARACTERISTIC
/begin CHARACTERISTIC mrwLLPUb_F "LLR P-Glied Fenster: Unterbremsen" VALUE 0xF3920 MSA15_FW4 0 N 0.000000 6000.000000 EXTENDED_LIMITS 0.000000 32767.000000 /end CHARACTERISTIC
/begin CHARACTERISTIC mrwLLPUb_N "LLR P-Verst. neg Grossignal: Unterbremsen" VALUE 0xF3924 MSA15_FW4 0 LLR_KP 0.000000 2.000000 EXTENDED_LIMITS 0.000000 2.559922 /end CHARACTERISTIC
/begin CHARACTERISTIC mrwLLPUb_P "LLR P-Verst. pos Grossignal: Unterbremsen" VALUE 0xF3926 MSA15_FW4 0 LLR_KP 0.000000 2.000000 EXTENDED_LIMITS 0.000000 2.559922 /end CHARACTERISTIC
/begin CHARACTERISTIC mrwLLPUb_S "LLR P-Verst. Kleinsignal: Unterbremsen" VALUE 0xF3922 MSA15_FW4 0 LLR_KP 0.000000 2.000000 EXTENDED_LIMITS 0.000000 2.559922 /end CHARACTERISTIC
/begin CHARACTERISTIC mrwLLPWK_F "LLR P-Glied Fenster: Warmer Motor, Kupplung" VALUE 0xF392A MSA15_FW4 0 N 0.000000 6000.000000 EXTENDED_LIMITS 0.000000 32767.000000 /end CHARACTERISTIC
/begin CHARACTERISTIC mrwLLPWK_N "LLR P-Verst. neg Grossignal: Warmer Motor, Kupplung" VALUE 0xF392E MSA15_FW4 0 LLR_KP 0.000000 2.000000 EXTENDED_LIMITS 0.000000 2.559922 /end CHARACTERISTIC
/begin CHARACTERISTIC mrwLLPWK_P "LLR P-Verst. pos Grossignal: Warmer Motor, Kupplung" VALUE 0xF3930 MSA15_FW4 0 LLR_KP 0.000000 2.000000 EXTENDED_LIMITS 0.000000 2.559922 /end CHARACTERISTIC
/begin CHARACTERISTIC mrwLLPWK_S "LLR P-Verst. Kleinsignal: Warmer Motor, Kupplung" VALUE 0xF392C MSA15_FW4 0 LLR_KP 0.000000 2.000000 EXTENDED_LIMITS 0.000000 2.559922 /end CHARACTERISTIC
/begin CHARACTERISTIC mrwLLPWTKL "Kennlinie fuer Ersatzdrehzahl bei Range Status 0" CURVE 0xF38D8 MSA15_KL118 0 N 0.000000 6000.000000 /begin AXIS_DESCR STD_AXIS mrmGANGfil DEZ_DW 8 -32768.000000 32767.000000 /end AXIS_DESCR EXTENDED_LIMITS 0.000000 32767.000000 /end CHARACTERISTIC
/begin CHARACTERISTIC mrwLLPW_KL "Kennlinie fuer Ersatzdrehzahl bei Range Status 0" CURVE 0xF38B4 MSA15_KL118 0 N 0.000000 6000.000000 /begin AXIS_DESCR STD_AXIS mrmGANGfil DEZ_DW 8 -32768.000000 32767.000000 /end AXIS_DESCR EXTENDED_LIMITS 0.000000 32767.000000 /end CHARACTERISTIC
/begin CHARACTERISTIC mrwLLRGRmp "LLR Rampe fuer Gangabhaengige Drehzahlanhebung" VALUE 0xF3860 MSA15_FW4 0 dNdZ 0.000000 6000.000000 EXTENDED_LIMITS 0.000000 102396.900000 /end CHARACTERISTIC
/begin CHARACTERISTIC mrwLLRNGKF "LLR - Solldrehzahlanhebung = f ( Vist, Gang )" MAP 0xF3D78 MSA15_KF381 0 N 0.000000 6000.000000
 /begin AXIS_DESCR STD_AXIS fgmFGAKT V 7 0.000000 300.000000 EXTENDED_LIMITS 0.000000 327.670000 /end AXIS_DESCR
 /begin AXIS_DESCR STD_AXIS camGANG DEZ_DB_U 7 0.000000 8.000000 EXTENDED_LIMITS 0.000000 255.000000 /end AXIS_DESCR
 EXTENDED_LIMITS 0.000000 32767.000000 /end CHARACTERISTIC
/begin CHARACTERISTIC mrwLLRSDel "LLR Zeit nach Startabwurf fuer Rampenabsenkung" VALUE 0xF385E MSA15_FW3 0 ZEIT_ST 0.000000 655350000.000000 /end CHARACTERISTIC
/begin CHARACTERISTIC mrwLLRSRmp "LLR Rampe bei Absenkung der Startabwurfdrehzahl auf LL-Drehzahl" VALUE 0xF385C MSA15_FW4 0 dNdZ 0.000000 6000.000000 EXTENDED_LIMITS 0.000000 102396.900000 /end CHARACTERISTIC
/begin CHARACTERISTIC mrwLLR_ABP "#SSD LLR Rampe bei Absenkung der LL-Solldrehzahl PWG Error und betaetigter Brems" VALUE 0xF383C MSA15_FW4 0 dNdZ 0.000000 6000.000000 EXTENDED_LIMITS 0.000000 102396.900000 /end CHARACTERISTIC
/begin CHARACTERISTIC mrwLLR_ABS "LLR Rampe bei Absenkung der LL-Solldrehzahl" VALUE 0xF3838 MSA15_FW4 0 dNdZ 0.000000 6000.000000 EXTENDED_LIMITS 0.000000 102396.900000 /end CHARACTERISTIC
/begin CHARACTERISTIC mrwLLR_ANH "LLR Rampe bei Anhebung der LL-Solldrehzahl" VALUE 0xF3836 MSA15_FW4 0 dNdZ 0.000000 6000.000000 EXTENDED_LIMITS 0.000000 102396.900000 /end CHARACTERISTIC
/begin CHARACTERISTIC mrwLLR_ANP "#SSD LLR Rampe bei Anhebung der LL-Solldrehzahl PWG Error und betaetigter Bremse" VALUE 0xF383A MSA15_FW4 0 dNdZ 0.000000 6000.000000 EXTENDED_LIMITS 0.000000 102396.900000 /end CHARACTERISTIC
/begin CHARACTERISTIC mrwLLR_AUS "#SSD LLR obere N-Grenze fuer LL-Regelung" VALUE 0xF3842 MSA15_FW4 0 N 0.000000 6000.000000 EXTENDED_LIMITS 0.000000 32767.000000 /end CHARACTERISTIC
/begin CHARACTERISTIC mrwLLR_DNE "LLR Einschrittmenge aktiv n-Offset auf Basisdrehzahl" VALUE 0xF3858 MSA15_FW4 0 N 0.000000 6000.000000 EXTENDED_LIMITS 0.000000 32767.000000 /end CHARACTERISTIC
/begin CHARACTERISTIC mrwLLR_DNV "LLR Vorsteuerung aktiv n-Offset auf N-Basis bei Mengenwunsch" VALUE 0xF3856 MSA15_FW4 0 N 0.000000 6000.000000 EXTENDED_LIMITS 0.000000 32767.000000 /end CHARACTERISTIC
/begin CHARACTERISTIC mrwLLR_EIN "LLR untere N-Grenze fuer LL-Regelung" VALUE 0xF3840 MSA15_FW4 0 N 0.000000 6000.000000 EXTENDED_LIMITS 0.000000 32767.000000 /end CHARACTERISTIC
/begin CHARACTERISTIC mrwLLR_FAR "LLR LL-Solldrehzahl Fahrzeug faehrt  (V > 0)" VALUE 0xF3832 MSA15_FW4 0 N 0.000000 6000.000000 EXTENDED_LIMITS 0.000000 32767.000000 /end CHARACTERISTIC
/begin CHARACTERISTIC mrwLLR_FRL "LLR LL-Solldrehzahl Fahrzeug faehrt im Low Range  (V > 0)" VALUE 0xF3864 MSA15_FW4 0 N 0.000000 6000.000000 EXTENDED_LIMITS 0.000000 32767.000000 /end CHARACTERISTIC
/begin CHARACTERISTIC mrwLLR_ITS "LLR Mengenschwelle (I+P-Anteil) fuer Integrator auftauen" VALUE 0xF385A MSA15_FW4 0 M_E -327.680000 327.670000 /end CHARACTERISTIC
/begin CHARACTERISTIC mrwLLR_MAX "LLR maximale Menge aus LL-Regelung" VALUE 0xF3844 MSA15_FW4 0 MM3 0.000000 100.000000 EXTENDED_LIMITS -327.680000 327.670000 /end CHARACTERISTIC
/begin CHARACTERISTIC mrwLLR_NSF "#SSD LLR LL-Solldrehzahl PWG/Bremse nicht plausibel" VALUE 0xF3830 MSA15_FW4 0 N 0.000000 6000.000000 EXTENDED_LIMITS 0.000000 32767.000000 /end CHARACTERISTIC
/begin CHARACTERISTIC mrwLLR_PWB "#SSD Leerlaufdrehzahl bei PWG defekt und betaetigter Bremse" VALUE 0xF384C MSA15_FW4 0 N 0.000000 6000.000000 EXTENDED_LIMITS 0.000000 32767.000000 /end CHARACTERISTIC
/begin CHARACTERISTIC mrwLLR_SLL "LLR LL-Solldrehzahl Fahrzeug steht/warmer Motor im Low Range" VALUE 0xF3862 MSA15_FW4 0 N 0.000000 6000.000000 EXTENDED_LIMITS 0.000000 32767.000000 /end CHARACTERISTIC
/begin CHARACTERISTIC mrwLLR_SOL "LLR LL-Solldrehzahl Fahrzeug steht/warmer Motor" VALUE 0xF382E MSA15_FW4 0 N 0.000000 6000.000000 EXTENDED_LIMITS 0.000000 32767.000000 /end CHARACTERISTIC
/begin CHARACTERISTIC mrwLLR_UBR "LLR untere V-Schwelle bei Unterbremsen" VALUE 0xF383E MSA15_FW4 0 V 0.000000 300.000000 EXTENDED_LIMITS 0.000000 327.670000 /end CHARACTERISTIC
/begin CHARACTERISTIC mrwLLR_VD "LLR Vorsteuerung aktiv n-Offset auf Basisdrehzahl" VALUE 0xF3854 MSA15_FW4 0 N 0.000000 6000.000000 EXTENDED_LIMITS 0.000000 32767.000000 /end CHARACTERISTIC
/begin CHARACTERISTIC mrwLLR_VLG "LLR V-Schwelle fuer Leergangerkennung" VALUE 0xF3852 MSA15_FW4 0 V 0.000000 300.000000 EXTENDED_LIMITS 0.000000 327.670000 /end CHARACTERISTIC
/begin CHARACTERISTIC mrwLLR_tTW "LLR Zeit nach Start fuer T_W-abh. LL-Solldrehzahl" VALUE 0xF3834 MSA15_FW3 0 ZEIT_ST 0.000000 655350000.000000 /end CHARACTERISTIC
/begin CHARACTERISTIC mrwLLSnkG1 "Untere V/N Schwelle fuer Drehzahlabsenkung" VALUE 0xF3828 MSA15_FW4 0 V_N 0.000000 0.100000 EXTENDED_LIMITS -1.280000 1.279961 /end CHARACTERISTIC
/begin CHARACTERISTIC mrwLLSnkG2 "Obere V/N Schwelle fuer Drehzahlabsenkung" VALUE 0xF382A MSA15_FW4 0 V_N 0.000000 0.100000 EXTENDED_LIMITS -1.280000 1.279961 /end CHARACTERISTIC
/begin CHARACTERISTIC mrwLLSnkN "Solldrehzahl fuer Drehzahlabsenkung" VALUE 0xF382C MSA15_FW4 0 N 0.000000 2000.000000 EXTENDED_LIMITS 0.000000 32767.000000 /end CHARACTERISTIC
/begin CHARACTERISTIC mrwLLSnkWT "Wassertemperatur Schwelle fuer Drehzahlabsenkung" VALUE 0xF3826 MSA15_FW4 0 T -50.040010 149.960000 EXTENDED_LIMITS -273.140000 3003.560000 /end CHARACTERISTIC
/begin CHARACTERISTIC mrwLLWK_ES "LLR Einschrittmenge Vorsteuerung: Warmer Motor, Kupplung" VALUE 0xF3984 MSA15_FW4 0 M_E 0.000000 100.000000 EXTENDED_LIMITS -327.680000 327.670000 /end CHARACTERISTIC
/begin CHARACTERISTIC mrwLMKSTEI "LMK Schrittweite der Rampe" VALUE 0xF1FB2 MSA15_FW3 0 dMOM16_dZ 0.000000 499.618500 EXTENDED_LIMITS 0.000000 25500.000000 /end CHARACTERISTIC
/begin CHARACTERISTIC mrwLMK_ABt "LMK Verzugsdauer bei der Abschaltung" VALUE 0xF1FB4 MSA15_FW3 0 ZEIT_ST 0.000000 655350000.000000 /end CHARACTERISTIC
/begin CHARACTERISTIC mrwLMK_BI "#SSD LMK mittlerer spezifischer Verbrauch bi_REIB" VALUE 0xF1FAC MSA15_FW4 0 m_BI_ 0.000000 0.999972 EXTENDED_LIMITS -2.105312 2.105248 /end CHARACTERISTIC
/begin CHARACTERISTIC mrwLMK_KLF "LMK Faktor Klimastoergroessenkompensation" VALUE 0xF1FB6 MSA15_FW3 0 FAKT_E 0.000000 32.000000 EXTENDED_LIMITS -32.768000 32.767000 /end CHARACTERISTIC
/begin CHARACTERISTIC mrwLMK_SPR "LMK Sprung in Prozent von camLM_KK nach dem Verzug" VALUE 0xF1FB0 MSA15_FW3 0 PROZ_S 0.000000 100.000000 EXTENDED_LIMITS -327.680000 327.670000 /end CHARACTERISTIC
/begin CHARACTERISTIC mrwLMK_VER "LMK Verzugsdauer der Klimastoergroessenaufschaltung" VALUE 0xF1FAE MSA15_FW3 0 ZEIT_ST 0.000000 655350000.000000 /end CHARACTERISTIC
/begin CHARACTERISTIC mrwLMKnMin "LMK Mindestdrehzahl Schwelle" VALUE 0xF1FB8 MSA15_FW3 0 N 0.000000 6000.000000 EXTENDED_LIMITS 0.000000 32767.000000 /end CHARACTERISTIC
/begin CHARACTERISTIC mrwLMKnRef "LMK Referenzdrehzahl" VALUE 0xF1FBA MSA15_FW3 0 N 0.000000 6000.000000 EXTENDED_LIMITS 0.000000 32767.000000 /end CHARACTERISTIC
/begin CHARACTERISTIC mrwLRI_FEN "LRR Fenster Kleinsignal I-Regler" VALUE 0xF3B66 MSA15_FW4 0 N 0.000000 6000.000000 EXTENDED_LIMITS 0.000000 32767.000000 /end CHARACTERISTIC
/begin CHARACTERISTIC mrwLRI_NEG "LRR I-Verstaerkung negatives Grossignal" VALUE 0xF3B6A MSA15_FW4 0 LRR_KI 0.000000 0.062501 EXTENDED_LIMITS 0.000000 0.101722 /end CHARACTERISTIC
/begin CHARACTERISTIC mrwLRI_POS "LRR I-Verstaerkung positives Grossignal" VALUE 0xF3B6C MSA15_FW4 0 LRR_KI 0.000000 0.062501 EXTENDED_LIMITS 0.000000 0.101722 /end CHARACTERISTIC
/begin CHARACTERISTIC mrwLRI_SIG "LRR I-Verstaerkung Kleinsignal" VALUE 0xF3B68 MSA15_FW4 0 LRR_KI 0.000000 0.062501 EXTENDED_LIMITS 0.000000 0.101722 /end CHARACTERISTIC
/begin CHARACTERISTIC mrwLRMRMAX "LRR Obere Mengen-Grenze fuer Regeln" VALUE 0xF3B52 MSA15_FW4 0 M_E 0.000000 100.000000 EXTENDED_LIMITS -327.680000 327.670000 /end CHARACTERISTIC
/begin CHARACTERISTIC mrwLRMRMIN "LRR Untere Mengen-Grenze fuer Regeln" VALUE 0xF3B50 MSA15_FW4 0 M_E 0.000000 100.000000 EXTENDED_LIMITS -327.680000 327.670000 /end CHARACTERISTIC
/begin CHARACTERISTIC mrwLRMSMAX "LRR Obere Mengen-Grenze fuer Steuern" VALUE 0xF3B54 MSA15_FW4 0 M_E 0.000000 100.000000 EXTENDED_LIMITS -327.680000 327.670000 /end CHARACTERISTIC
/begin CHARACTERISTIC mrwLRMSMIN "LRR Untere Mengen-Grenze fuer Steuern" VALUE 0xF3B4E MSA15_FW4 0 M_E 0.000000 100.000000 EXTENDED_LIMITS -327.680000 327.670000 /end CHARACTERISTIC
/begin CHARACTERISTIC mrwLRNRMAX "LRR Obere Drehzahl-Grenze fuer Regeln" VALUE 0xF3B4A MSA15_FW4 0 N 0.000000 6000.000000 EXTENDED_LIMITS 0.000000 32767.000000 /end CHARACTERISTIC
/begin CHARACTERISTIC mrwLRNRMIN "LRR Untere Drehzahl-Grenze fuer Steuern  ! ***BC229 FAC2WI" VALUE 0xF3B48 MSA15_FW4 0 N 0.000000 6000.000000 EXTENDED_LIMITS 0.000000 32767.000000 /end CHARACTERISTIC
/begin CHARACTERISTIC mrwLRNRdN "LRR - N-Offset zur Leerlaufdrehzahl für Steuerbereich" VALUE 0xF3B5A MSA15_FW4 0 N 0.000000 600.000000 EXTENDED_LIMITS 0.000000 32767.000000 /end CHARACTERISTIC
/begin CHARACTERISTIC mrwLRNSMAX "#SSD LRR Obere Drehzahl-Grenze fuer Steuern" VALUE 0xF3B4C MSA15_FW4 0 N 0.000000 6000.000000 EXTENDED_LIMITS 0.000000 32767.000000 /end CHARACTERISTIC
/begin CHARACTERISTIC mrwLRP_FEN "LRR Fenster Kleinsignal P-Regler" VALUE 0xF3B5C MSA15_FW4 0 N 0.000000 6000.000000 EXTENDED_LIMITS 0.000000 32767.000000 /end CHARACTERISTIC
/begin CHARACTERISTIC mrwLRP_NEG "LRR P-Verstaerkung negatives Grossignal" VALUE 0xF3B60 MSA15_FW4 0 LRR_KP 0.000000 0.025000 EXTENDED_LIMITS 0.000000 0.039999 /end CHARACTERISTIC
/begin CHARACTERISTIC mrwLRP_POS "LRR P-Verstaerkung positives Grossignal" VALUE 0xF3B62 MSA15_FW4 0 LRR_KP 0.000000 0.025000 EXTENDED_LIMITS 0.000000 0.039999 /end CHARACTERISTIC
/begin CHARACTERISTIC mrwLRP_SIG "LRR P-Verstaerkung Kleinsignal" VALUE 0xF3B5E MSA15_FW4 0 LRR_KP 0.000000 0.025000 EXTENDED_LIMITS 0.000000 0.039999 /end CHARACTERISTIC
/begin CHARACTERISTIC mrwLRR1NSW "Segmentzahl und Wichtung 1-fache Nockenfrequenz" VALUE 0xF3B70 MSA15_FW4 0 SEG_W 0.000000 12.000000 EXTENDED_LIMITS 0.000000 127.996100 /end CHARACTERISTIC
/begin CHARACTERISTIC mrwLRR2NSW "Segmentzahl und Wichtung 2-fache Nockenfrequenz" VALUE 0xF3B72 MSA15_FW4 0 SEG_W 0.000000 12.000000 EXTENDED_LIMITS 0.000000 127.996100 /end CHARACTERISTIC
/begin CHARACTERISTIC mrwLRR3NSW "Segmentzahl und Wichtung 3-fache Nockenfrequenz" VALUE 0xF3B74 MSA15_FW4 0 SEG_W 0.000000 12.000000 EXTENDED_LIMITS 0.000000 127.996100 /end CHARACTERISTIC
/begin CHARACTERISTIC mrwLRR4NSW "Segmentzahl und Wichtung 4-fache Nockenfrequenz" VALUE 0xF3B76 MSA15_FW4 0 SEG_W 0.000000 12.000000 EXTENDED_LIMITS 0.000000 127.996100 /end CHARACTERISTIC
/begin CHARACTERISTIC mrwLRRMNKL "LRR Untere Schwelle f. n-Ungleichf.Erk. =f(mrmM_EMTS)" CURVE 0xF3E1A MSA15_KL118 0 M_E 0.000000 100.000000
 /begin AXIS_DESCR STD_AXIS mrmM_EMTS MM3 4 0.000000 100.000000 EXTENDED_LIMITS -327.680000 327.670000 /end AXIS_DESCR
 EXTENDED_LIMITS -327.680000 327.670000 /end CHARACTERISTIC
/begin CHARACTERISTIC mrwLRRMXKL "LRR Obere Schwelle f. n-Ungleichf.Erk. =f(mrmM_EMTS)" CURVE 0xF3E2E MSA15_KL118 0 M_E 0.000000 100.000000
 /begin AXIS_DESCR STD_AXIS mrmM_EMTS MM3 4 0.000000 100.000000 EXTENDED_LIMITS -327.680000 327.670000 /end AXIS_DESCR
 EXTENDED_LIMITS -327.680000 327.670000 /end CHARACTERISTIC
/begin CHARACTERISTIC mrwLRRN1A1 "Filterparameter ALPHA1 f°r 1-fache Nockenfrequenz" VALUE 0xF3B78 MSA15_FW4 0 LRR_A 0.000000 1.989990 EXTENDED_LIMITS -2.000000 1.999939 /end CHARACTERISTIC
/begin CHARACTERISTIC mrwLRRN1A2 "Filterparameter ALPHA2 f°r 1-fache Nockenfrequenz" VALUE 0xF3B7A MSA15_FW4 0 LRR_A 0.000000 1.989990 EXTENDED_LIMITS -2.000000 1.999939 /end CHARACTERISTIC
/begin CHARACTERISTIC mrwLRRN1B "Verstaerkung BETA f°r 1-fache Nockenwellenfrequenz" VALUE 0xF3B7E MSA15_FW4 0 LRR_B 0.000000 31.990230 EXTENDED_LIMITS -32.000000 31.999020 /end CHARACTERISTIC
/begin CHARACTERISTIC mrwLRRN2A1 "Filterparameter ALPHA1 f°r 2-fache Nockenfrequenz" VALUE 0xF3B82 MSA15_FW4 0 LRR_A 0.000000 1.989990 EXTENDED_LIMITS -2.000000 1.999939 /end CHARACTERISTIC
/begin CHARACTERISTIC mrwLRRN2A2 "Filterparameter ALPHA2 f°r 2-fache Nockenfrequenz" VALUE 0xF3B84 MSA15_FW4 0 LRR_A 0.000000 1.989990 EXTENDED_LIMITS -2.000000 1.999939 /end CHARACTERISTIC
/begin CHARACTERISTIC mrwLRRN2B "Verstaerkung BETA f°r 2-fache Nockenfrequenz" VALUE 0xF3B88 MSA15_FW4 0 LRR_B 0.000000 31.990230 EXTENDED_LIMITS -32.000000 31.999020 /end CHARACTERISTIC
/begin CHARACTERISTIC mrwLRRN3A1 "Filterparameter ALPHA1 f°r 3-fache Nockenfrequenz" VALUE 0xF3B8C MSA15_FW4 0 LRR_A 0.000000 1.989990 EXTENDED_LIMITS -2.000000 1.999939 /end CHARACTERISTIC
/begin CHARACTERISTIC mrwLRRN3A2 "Filterparameter ALPHA2 f°r 3-fache Nockenfrequenz" VALUE 0xF3B8E MSA15_FW4 0 LRR_A 0.000000 1.989990 EXTENDED_LIMITS -2.000000 1.999939 /end CHARACTERISTIC
/begin CHARACTERISTIC mrwLRRN3B "Verstaerkung BETA f°r 3-fache Nockenfrequenz" VALUE 0xF3B92 MSA15_FW4 0 LRR_B 0.000000 31.990230 EXTENDED_LIMITS -32.000000 31.999020 /end CHARACTERISTIC
/begin CHARACTERISTIC mrwLRRN4A1 "Filterparameter ALPHA1 f°r 4-fache Nockenfrequenz" VALUE 0xF3B96 MSA15_FW4 0 LRR_A 0.000000 1.989990 EXTENDED_LIMITS -2.000000 1.999939 /end CHARACTERISTIC
/begin CHARACTERISTIC mrwLRRN4A2 "Filterparameter ALPHA2 f°r 4-fache Nockenfrequenz" VALUE 0xF3B98 MSA15_FW4 0 LRR_A 0.000000 1.989990 EXTENDED_LIMITS -2.000000 1.999939 /end CHARACTERISTIC
/begin CHARACTERISTIC mrwLRRN4B "Verstaerkung BETA f°r 4-fache Nockenfrequenz" VALUE 0xF3B9C MSA15_FW4 0 LRR_B 0.000000 31.990230 EXTENDED_LIMITS -32.000000 31.999020 /end CHARACTERISTIC
/begin CHARACTERISTIC mrwLRR_BKL "Begrenzungsmenge f. LRR-Eingriff = f(mrmM_EMTS)" CURVE 0xF3E06 MSA15_KL118 0 M_E 0.000000 100.000000
 /begin AXIS_DESCR STD_AXIS mrmM_EMTS MM3 4 0.000000 100.000000 EXTENDED_LIMITS -327.680000 327.670000 /end AXIS_DESCR
 EXTENDED_LIMITS -327.680000 327.670000 /end CHARACTERISTIC
/begin CHARACTERISTIC mrwLRR_SEG "LRR Segmentanz. fuer Sync.-Fehlererkennung" VALUE 0xF3B58 MSA15_FW4 0 DEZ_DW 0.000000 32767.000000 EXTENDED_LIMITS -32768.000000 32767.000000 /end CHARACTERISTIC
/begin CHARACTERISTIC mrwLRR_SYN "LRR Sync.Art: 0 = intern, 1 = ext. ung., 2 = ext. ger Zuend" VALUE 0xF3B56 MSA15_FW4 0 DEZ_DW 0.000000 2.000000 EXTENDED_LIMITS -32768.000000 32767.000000 /end CHARACTERISTIC
/begin CHARACTERISTIC mrwLTW2_KL "LLR - Drehzahlanhebung bei Automatik P/N Stellung Grundwert" CURVE 0xF3D40 MSA15_KL118 0 N 0.000000 6000.000000
 /begin AXIS_DESCR STD_AXIS anmWTF T 6 -50.040010 149.960000 EXTENDED_LIMITS -273.140000 3003.560000 /end AXIS_DESCR
 EXTENDED_LIMITS 0.000000 32767.000000 /end CHARACTERISTIC
/begin CHARACTERISTIC mrwLTW_KL "LLR T_W-abhaenige Leerlaufdrehzahl   N = f(T_W)" CURVE 0xF3898 MSA15_KL118 0 N 0.000000 6000.000000
 /begin AXIS_DESCR STD_AXIS anmWTF T 6 -50.040010 149.960000 EXTENDED_LIMITS -273.140000 3003.560000 /end AXIS_DESCR
 EXTENDED_LIMITS 0.000000 32767.000000 /end CHARACTERISTIC
/begin CHARACTERISTIC mrwMEAGLMI "AGL min. Abgleichwert fuer Mengenkorrektur" VALUE 0xF3C50 MSA15_FW4 0 M_E -5.000000 5.000000 EXTENDED_LIMITS -327.680000 327.670000 /end CHARACTERISTIC
/begin CHARACTERISTIC mrwMEAGLMX "AGL max. Abgleichwert fuer Mengenkorrektur" VALUE 0xF3C52 MSA15_FW4 0 M_E -5.000000 5.000000 EXTENDED_LIMITS -327.680000 327.670000 /end CHARACTERISTIC
/begin CHARACTERISTIC mrwMEAGLNK "AGL Abgleichmengen-Neutralkennfeld    M_E = f(N, M_EFAHR)" MAP 0xF3C54 MSA15_KF382 0 M_E -5.000000 5.000000
 /begin AXIS_DESCR STD_AXIS dzmNmit N 8 0.000000 6000.000000 EXTENDED_LIMITS 0.000000 32767.000000 /end AXIS_DESCR
 /begin AXIS_DESCR STD_AXIS mrmM_EFAHR MM3 6 0.000000 100.000000 EXTENDED_LIMITS -327.680000 327.670000 /end AXIS_DESCR
 EXTENDED_LIMITS -327.680000 327.670000 /end CHARACTERISTIC
/begin CHARACTERISTIC mrwMEDRFKF "Mengendriftkompensationkennfeld M_E = f(mrmM_EMTS, fbmBSTZ_UB)   ! ***BC081 bar2" MAP 0xF3CDE MSA15_KF358 0 M_E -100.000000 100.000000
 /begin AXIS_DESCR STD_AXIS mrmM_EMTS MM3 8 0.000000 100.000000 EXTENDED_LIMITS -327.680000 327.670000 /end AXIS_DESCR
 /begin AXIS_DESCR STD_AXIS fbmBSTZ_UB BSTZ_TIC_h 4 0.000000 6553.500000 /end AXIS_DESCR
 EXTENDED_LIMITS -327.680000 327.670000 /end CHARACTERISTIC
/begin CHARACTERISTIC mrwMSRRAMP "#SSD Rampenschrittweite MSR Mengeneingriff" VALUE 0xF2028 MSA15_FW4 0 dM_E_dZ 0.000000 3000.000000 EXTENDED_LIMITS -16384.000000 16383.500000 /end CHARACTERISTIC
/begin CHARACTERISTIC mrwMULINF0 "CAN Multiplexinformation 0" VALUE 0xF2018 MSA15_FW1 0 DEZ_DB_U 17.000000 17.000000 EXTENDED_LIMITS 0.000000 255.000000 /end CHARACTERISTIC
/begin CHARACTERISTIC mrwMULINF1 "CAN Multiplexinformation 1" VALUE 0xF2019 MSA15_FW1 0 DEZ_DB_U 0.000000 63.000000 EXTENDED_LIMITS 0.000000 255.000000 /end CHARACTERISTIC
/begin CHARACTERISTIC mrwMULINF2 "CAN Multiplexinformation 2" VALUE 0xF201A MSA15_FW1 0 DEZ_DB_U 0.000000 63.000000 EXTENDED_LIMITS 0.000000 255.000000 /end CHARACTERISTIC
/begin CHARACTERISTIC mrwMULINF3 "CAN Multiplexinformation 3" VALUE 0xF201B MSA15_FW1 0 DEZ_DB_U 32.000000 32.000000 EXTENDED_LIMITS 0.000000 255.000000 /end CHARACTERISTIC
/begin CHARACTERISTIC mrwM_ASRMX "#SSD ASR Maximaler Ersatzmengeneingriff, Rampenendwert" VALUE 0xF2026 MSA15_FW3 0 MM3 100.000000 100.000000 EXTENDED_LIMITS -327.680000 327.670000 /end CHARACTERISTIC
/begin CHARACTERISTIC mrwM_EGSMX "#SSD EGS Maximaler Ersatzmengeneingriff, Rampenendwert" VALUE 0xF2022 MSA15_FW3 0 MM3 100.000000 100.000000 EXTENDED_LIMITS -327.680000 327.670000 /end CHARACTERISTIC
/begin CHARACTERISTIC mrwM_TXUMX "#SSD Maximalwert der Ersatzmenge bei Botschaftsausfall" VALUE 0xF201C MSA15_FW3 0 MM3 100.000000 100.000000 EXTENDED_LIMITS -327.680000 327.670000 /end CHARACTERISTIC
/begin CHARACTERISTIC mrwNBATEIN "Drehzahlschwelle ein" VALUE 0xF386E MSA15_FW3 0 N 0.000000 6000.000000 EXTENDED_LIMITS 0.000000 32767.000000 /end CHARACTERISTIC
/begin CHARACTERISTIC mrwNLEABdP "#SSD EAB_Test im Nachlauf, dP_Rail" VALUE 0xF97B4 MSA15_FW4 0 RP 0.000000 1500000.000000 EXTENDED_LIMITS -3276800.000000 3276700.000000 /end CHARACTERISTIC
/begin CHARACTERISTIC mrwNLEABt1 "#SSD EAB_Test im Nachlauf, Zeit t1" VALUE 0xF97B2 MSA15_FW3 0 ZEIT_ST 0.000000 655350000.000000 /end CHARACTERISTIC
/begin CHARACTERISTIC mrwNLEABt2 "#SSD EAB_Test im Nachlauf, Zeit t2" VALUE 0xF97C2 MSA15_FW3 0 ZEIT_ST 0.000000 655350000.000000 /end CHARACTERISTIC
/begin CHARACTERISTIC mrwNLT1min "Verlängerte minimale Nachlaufzeit" VALUE 0xF97CE MSA15_FW3 0 ZEIT_ST 0.000000 60000000.000000 EXTENDED_LIMITS 0.000000 655350000.000000 /end CHARACTERISTIC
/begin CHARACTERISTIC mrwNLT_min "min. Zeit zwischen Kl15=aus und HRL-Abwurf" VALUE 0xF97CA MSA15_FW3 0 ZEIT_ST 0.000000 60000000.000000 EXTENDED_LIMITS 0.000000 655350000.000000 /end CHARACTERISTIC
/begin CHARACTERISTIC mrwNLTvmin "Schwelle fuer Fahrgeschwindigkeit" VALUE 0xF97CC MSA15_FW3 0 V 0.000000 255.000000 EXTENDED_LIMITS 0.000000 327.670000 /end CHARACTERISTIC
/begin CHARACTERISTIC mrwNL_DTS "#SSD NL-Test Wartezeit zur N-Abfall-Kontrolle bei DBE-Test" VALUE 0xF978C MSA15_FW3 0 ZEIT_ST 0.000000 655350000.000000 /end CHARACTERISTIC
/begin CHARACTERISTIC mrwNL_ITS "#SSD NL-Test Wartezeit zur N-Abfall-Kontrolle bei Injektorabschaltung" VALUE 0xF9790 MSA15_FW3 0 ZEIT_ST 0.000000 655350000.000000 /end CHARACTERISTIC
/begin CHARACTERISTIC mrwNL_NS "#SSD NL-Test obere N-Begrenzung" VALUE 0xF9788 MSA15_FW4 0 N 0.000000 6000.000000 EXTENDED_LIMITS 0.000000 32767.000000 /end CHARACTERISTIC
/begin CHARACTERISTIC mrwNL_NTS "#SSD NL-Test Wartezeit zur N-Abfall-Kontrolle bei Nullmengentest" VALUE 0xF978E MSA15_FW3 0 ZEIT_ST 0.000000 655350000.000000 /end CHARACTERISTIC
/begin CHARACTERISTIC mrwNL_N_OB "#SSD NL-T obere N-Schwelle z. N-Anstieg-Kontr." VALUE 0xF9798 MSA15_FW4 0 N 0.000000 6000.000000 EXTENDED_LIMITS 0.000000 32767.000000 /end CHARACTERISTIC
/begin CHARACTERISTIC mrwNL_N_OK "#SSD NL-T untere N-Schwelle z. N-Anstieg-Kontr." VALUE 0xF9796 MSA15_FW4 0 N 0.000000 6000.000000 EXTENDED_LIMITS 0.000000 32767.000000 /end CHARACTERISTIC
/begin CHARACTERISTIC mrwNL_STS "#SSD NL-Test Wartezeit zur N-Abfall-Kontrolle bei Stabi Test" VALUE 0xF9794 MSA15_FW3 0 ZEIT_ST 0.000000 655350000.000000 /end CHARACTERISTIC
/begin CHARACTERISTIC mrwNL_THRT "#SSD NL-T Ueberwachungzeit fuer Hauptrelais-Test" VALUE 0xF97B8 MSA15_FW3 0 ZEIT_ST 0.000000 655350000.000000 /end CHARACTERISTIC
/begin CHARACTERISTIC mrwNL_T_ZZ "NL Zyklusdelay" VALUE 0xF97BC MSA15_FW3 0 ZEIT_ST 0.000000 655350000.000000 /end CHARACTERISTIC
/begin CHARACTERISTIC mrwNL_T_wa "#SSD NL-T Fehlerabspeicherung Zeitschwelle" VALUE 0xF97B6 MSA15_FW3 0 ZEIT_ST 0.000000 655350000.000000 /end CHARACTERISTIC
/begin CHARACTERISTIC mrwNL_UTS "#SSD NL-Test Wartezeit zur N-Abfall-Kontrolle bei UM-Test" VALUE 0xF9792 MSA15_FW3 0 ZEIT_ST 0.000000 655350000.000000 /end CHARACTERISTIC
/begin CHARACTERISTIC mrwNL_VS "#SSD NL-Test obere V-Begrenzung" VALUE 0xF978A MSA15_FW4 0 V 0.000000 300.000000 EXTENDED_LIMITS 0.000000 327.670000 /end CHARACTERISTIC
/begin CHARACTERISTIC mrwN_LLBAT "Erhoehte Leerlaufdrehzahl" VALUE 0xF3866 MSA15_FW3 0 N 0.000000 6000.000000 EXTENDED_LIMITS 0.000000 32767.000000 /end CHARACTERISTIC
/begin CHARACTERISTIC mrwODS_N0 "Drehzahlschwelle fuer Startausblendung" VALUE 0xF97DA MSA15_FW3 0 N 0.000000 5000.000000 EXTENDED_LIMITS 0.000000 32767.000000 /end CHARACTERISTIC
/begin CHARACTERISTIC mrwODS_NSt "Startdrehzahl für Zeitausblendung nach Start" VALUE 0xF97E2 MSA15_FW3 0 N 0.000000 5000.000000 EXTENDED_LIMITS 0.000000 32767.000000 /end CHARACTERISTIC
/begin CHARACTERISTIC mrwODS_T0 "Zeitschwelle fuer Startausblendung" VALUE 0xF97DC MSA15_FW3 0 ZEIT_ST 0.000000 60000000.000000 EXTENDED_LIMITS 0.000000 655350000.000000 /end CHARACTERISTIC
/begin CHARACTERISTIC mrwODSkr_B "Beschleunigung fuer Beschleunigungsausblendung" VALUE 0xF97D8 MSA15_FW4 0 B -10.511610 0.000000 EXTENDED_LIMITS -10.850690 10.765920 /end CHARACTERISTIC
/begin CHARACTERISTIC mrwODSkr_t "Zeitschwelle fuer Beschleunigungsausblendung" VALUE 0xF97D4 MSA15_FW3 0 ZEIT_ST 0.000000 60000000.000000 EXTENDED_LIMITS 0.000000 655350000.000000 /end CHARACTERISTIC
/begin CHARACTERISTIC mrwODSkr_v "Geschwindigkeit fuer Beschleunigungsausblendung" VALUE 0xF97D6 MSA15_FW3 0 V 0.000000 300.000000 EXTENDED_LIMITS 0.000000 327.670000 /end CHARACTERISTIC
/begin CHARACTERISTIC mrwODSt_u "Monoflopzeit - Beschleunigungsausblendung" VALUE 0xF97DE MSA15_FW3 0 ZEIT_ST 0.000000 60000000.000000 EXTENDED_LIMITS 0.000000 655350000.000000 /end CHARACTERISTIC
/begin CHARACTERISTIC mrwODStaus "Monoflopzeit - Startausblendung" VALUE 0xF97E0 MSA15_FW3 0 ZEIT_ST 0.000000 60000000.000000 EXTENDED_LIMITS 0.000000 655350000.000000 /end CHARACTERISTIC
/begin CHARACTERISTIC mrwOVFLN_O "BEG obere Schwelle der Drehzahl-Hysterese" VALUE 0xFA538 MSA15_FW4 0 N 0.000000 6000.000000 EXTENDED_LIMITS 0.000000 32767.000000 /end CHARACTERISTIC
/begin CHARACTERISTIC mrwOVFLN_U "BEG untere Schwelle der Drehzahl-Hysterese" VALUE 0xFA536 MSA15_FW4 0 N 0.000000 6000.000000 EXTENDED_LIMITS 0.000000 32767.000000 /end CHARACTERISTIC
/begin CHARACTERISTIC mrwOVFLP_O "BEG obere Schwelle der PWG-Hysterese" VALUE 0xFA534 MSA15_FW4 0 PROZ_S 0.000000 100.000000 EXTENDED_LIMITS -327.680000 327.670000 /end CHARACTERISTIC
/begin CHARACTERISTIC mrwOVFLP_U "BEG untere Schwelle der PWG-Hysterese" VALUE 0xFA532 MSA15_FW4 0 PROZ_S 0.000000 100.000000 EXTENDED_LIMITS -327.680000 327.670000 /end CHARACTERISTIC
/begin CHARACTERISTIC mrwOVFLV_O "BEG obere Schwelle der Geschwindigkeits-Hysterese" VALUE 0xFA53C MSA15_FW4 0 V 0.000000 300.000000 EXTENDED_LIMITS 0.000000 327.670000 /end CHARACTERISTIC
/begin CHARACTERISTIC mrwOVFLV_U "BEG untere Schwelle der Geschwindigkeits-Hysterese" VALUE 0xFA53A MSA15_FW4 0 V 0.000000 300.000000 EXTENDED_LIMITS 0.000000 327.670000 /end CHARACTERISTIC
/begin CHARACTERISTIC mrwOVFL_AB "BEG Schrittweite bei Absenkung der Overfuelingmenge" VALUE 0xFA52C MSA15_FW4 0 dM_E_dZ 0.000000 3000.000000 EXTENDED_LIMITS -16384.000000 16383.500000 /end CHARACTERISTIC
/begin CHARACTERISTIC mrwOVFL_AN "BEG Schrittweite bei Anhebung der Overfuelingmenge" VALUE 0xFA52A MSA15_FW4 0 dM_E_dZ 0.000000 3000.000000 EXTENDED_LIMITS -16384.000000 16383.500000 /end CHARACTERISTIC
/begin CHARACTERISTIC mrwOVFL_MX "BEG maximale Overfuelingmenge" VALUE 0xFA52E MSA15_FW4 0 MM3 0.000000 100.000000 EXTENDED_LIMITS -327.680000 327.670000 /end CHARACTERISTIC
/begin CHARACTERISTIC mrwOVFL_SP "BEG Sperrzeit nach Overfueling-aktiv" VALUE 0xFA530 MSA15_FW3 0 ZEIT_ST 0.000000 655350000.000000 /end CHARACTERISTIC
/begin CHARACTERISTIC mrwOVFLdNO "BEG obere Schwelle der Drehzahl-Hysterese" VALUE 0xFA540 MSA15_FW4 0 dN_dZ 0.000000 10000.000000 EXTENDED_LIMITS 0.000000 1638350.000000 /end CHARACTERISTIC
/begin CHARACTERISTIC mrwOVFLdNU "BEG untere Schwelle der Drehzahl-Hysterese" VALUE 0xFA53E MSA15_FW4 0 dN_dZ 0.000000 10000.000000 EXTENDED_LIMITS 0.000000 1638350.000000 /end CHARACTERISTIC
/begin CHARACTERISTIC mrwPATMdy0 "BEG dyn. Rauch-ADF-Schwelle 0" VALUE 0xFA2CA MSA15_FW4 0 P 0.000000 3500.000000 EXTENDED_LIMITS -32768.000000 32767.000000 /end CHARACTERISTIC
/begin CHARACTERISTIC mrwPATMdy1 "BEG dyn. Rauch-ADF-Schwelle 1" VALUE 0xFA2CC MSA15_FW4 0 P 0.000000 3500.000000 EXTENDED_LIMITS -32768.000000 32767.000000 /end CHARACTERISTIC
/begin CHARACTERISTIC mrwPATMdy2 "BEG dyn. Rauch-ADF-Schwelle 2" VALUE 0xFA2CE MSA15_FW4 0 P 0.000000 3500.000000 EXTENDED_LIMITS -32768.000000 32767.000000 /end CHARACTERISTIC
/begin CHARACTERISTIC mrwPBRALKF "#SSD BEG Rauchbegrenzungs-KF bei abfallenem Ladeluftschlauch   M_E = f(N, P_Lkor" MAP 0xFAF82 MSA15_KF382 0 MM3 0.000000 100.000000
 /begin AXIS_DESCR STD_AXIS dzmNmit N 6 0.000000 6000.000000 EXTENDED_LIMITS 0.000000 32767.000000 /end AXIS_DESCR
 /begin AXIS_DESCR STD_AXIS armPkorr P 6 0.000000 3500.000000 EXTENDED_LIMITS -32768.000000 32767.000000 /end AXIS_DESCR
 EXTENDED_LIMITS -327.680000 327.670000 /end CHARACTERISTIC
/begin CHARACTERISTIC mrwPBRAL_t "BEG Zeitschwelle zur Erkennung abgefallener Ladeluftschlauch" VALUE 0xFA2E0 MSA15_FW3 0 ZEIT_ST 0.000000 655350000.000000 /end CHARACTERISTIC
/begin CHARACTERISTIC mrwPBRALof "BEG Offset zur Erkennung abgefallener Ladeluftschlauch" VALUE 0xFA2DE MSA15_FW4 0 MM3 -100.000000 100.000000 EXTENDED_LIMITS -327.680000 327.670000 /end CHARACTERISTIC
/begin CHARACTERISTIC mrwPBRA_KF "#SSD BEG Rauchbegrenzungs - KF    M_E = f(N, P_Lkorr)" MAP 0xFAF6A MSA15_KF382 0 MM3 0.000000 100.000000
 /begin AXIS_DESCR STD_AXIS dzmNmit N 2 0.000000 6000.000000 EXTENDED_LIMITS 0.000000 32767.000000 /end AXIS_DESCR
 /begin AXIS_DESCR STD_AXIS armPkorr P 2 0.000000 3500.000000 EXTENDED_LIMITS -32768.000000 32767.000000 /end AXIS_DESCR
 EXTENDED_LIMITS -327.680000 327.670000 /end CHARACTERISTIC
/begin CHARACTERISTIC mrwPFILNEG "PWG Abfallschwelle z. Umschaltung PT1-Zeitkonst. bei Low Range" VALUE 0xF9F44 MSA15_FW4 0 PROZ_S 0.000000 100.000000 EXTENDED_LIMITS -327.680000 327.670000 /end CHARACTERISTIC
/begin CHARACTERISTIC mrwPFILPOS "PWG Anstiegsschwelle z. Umschaltung PT1-Zeitkonst. bei Low Range" VALUE 0xF9F42 MSA15_FW4 0 PROZ_S 0.000000 100.000000 EXTENDED_LIMITS -327.680000 327.670000 /end CHARACTERISTIC
/begin CHARACTERISTIC mrwPFI_AKT "PWG Schalter: PWG-Filterung b. Kupplung betaetigt" VALUE 0xF9F3C MSA15_FW4 0 DEZ_DW 0.000000 1.000000 EXTENDED_LIMITS -32768.000000 32767.000000 /end CHARACTERISTIC
/begin CHARACTERISTIC mrwPFI_NEG "PWG Abfallschwelle z. Umschaltung PT1-Zeitkonst." VALUE 0xF9F40 MSA15_FW4 0 PROZ_S 0.000000 100.000000 EXTENDED_LIMITS -327.680000 327.670000 /end CHARACTERISTIC
/begin CHARACTERISTIC mrwPFI_POS "PWG Anstiegsschwelle z. Umschaltung PT1-Zeitkonst." VALUE 0xF9F3E MSA15_FW4 0 PROZ_S 0.000000 100.000000 EXTENDED_LIMITS -327.680000 327.670000 /end CHARACTERISTIC
/begin CHARACTERISTIC mrwPGS_UPL "#SSD PGS  Spannungs-Schwelle keine PWG/PGS-Plausibilisierung" VALUE 0xF9F3A MSA15_FW4 0 U 0.000000 5601.173000 EXTENDED_LIMITS 0.000000 160151.500000 /end CHARACTERISTIC
/begin CHARACTERISTIC mrwPSCAN_a "ARD-SR quadrat. G-Faktor: Ext. Mengeneingriff" VALUE 0xF3B42 MSA15_FW4 0 DEZ_DW -32768.000000 32767.000000 /end CHARACTERISTIC
/begin CHARACTERISTIC mrwPSCAN_b "ARD-SR linearer G-Faktor: Ext. Mengeneingriff" VALUE 0xF3B44 MSA15_FW4 0 DEZ_DW -32768.000000 32767.000000 /end CHARACTERISTIC
/begin CHARACTERISTIC mrwPSCAN_c "ARD-SR  konst.  G-Faktor: Ext. Mengeneingriff" VALUE 0xF3B46 MSA15_FW4 0 DEZ_DW -32768.000000 32767.000000 /end CHARACTERISTIC
/begin CHARACTERISTIC mrwPSKUP_a "ARD-SR quadrat. G-Faktor: Kupplung betaetigt" VALUE 0xF3AD4 MSA15_FW4 0 DEZ_DW -32768.000000 32767.000000 /end CHARACTERISTIC
/begin CHARACTERISTIC mrwPSKUP_b "ARD-SR linearer G-Faktor: Kupplung betaetigt" VALUE 0xF3AD6 MSA15_FW4 0 DEZ_DW -32768.000000 32767.000000 /end CHARACTERISTIC
/begin CHARACTERISTIC mrwPSKUP_c "ARD-SR  konst.  G-Faktor: Kupplung betaetigt" VALUE 0xF3AD8 MSA15_FW4 0 DEZ_DW -32768.000000 32767.000000 /end CHARACTERISTIC
/begin CHARACTERISTIC mrwPSL1G_a "ARD-SR quadrat. G-Faktor: Leerlauf, 1.Gang" VALUE 0xF3B38 MSA15_FW4 0 DEZ_DW -32768.000000 32767.000000 /end CHARACTERISTIC
/begin CHARACTERISTIC mrwPSL1G_b "ARD-SR linearer G-Faktor: Leerlauf, 1.Gang" VALUE 0xF3B3A MSA15_FW4 0 DEZ_DW -32768.000000 32767.000000 /end CHARACTERISTIC
/begin CHARACTERISTIC mrwPSL1G_c "ARD-SR  konst.  G-Faktor: Leerlauf, 1.Gang" VALUE 0xF3B3C MSA15_FW4 0 DEZ_DW -32768.000000 32767.000000 /end CHARACTERISTIC
/begin CHARACTERISTIC mrwPSL2G_a "ARD-SR quadrat. G-Faktor: Leerlauf, 2.Gang" VALUE 0xF3B2E MSA15_FW4 0 DEZ_DW -32768.000000 32767.000000 /end CHARACTERISTIC
/begin CHARACTERISTIC mrwPSL2G_b "ARD-SR linearer G-Faktor: Leerlauf, 2.Gang" VALUE 0xF3B30 MSA15_FW4 0 DEZ_DW -32768.000000 32767.000000 /end CHARACTERISTIC
/begin CHARACTERISTIC mrwPSL2G_c "ARD-SR  konst.  G-Faktor: Leerlauf, 2.Gang" VALUE 0xF3B32 MSA15_FW4 0 DEZ_DW -32768.000000 32767.000000 /end CHARACTERISTIC
/begin CHARACTERISTIC mrwPSL3G_a "ARD-SR quadrat. G-Faktor: Leerlauf, 3.Gang" VALUE 0xF3B24 MSA15_FW4 0 DEZ_DW -32768.000000 32767.000000 /end CHARACTERISTIC
/begin CHARACTERISTIC mrwPSL3G_b "ARD-SR linearer G-Faktor: Leerlauf, 3.Gang" VALUE 0xF3B26 MSA15_FW4 0 DEZ_DW -32768.000000 32767.000000 /end CHARACTERISTIC
/begin CHARACTERISTIC mrwPSL3G_c "ARD-SR  konst.  G-Faktor: Leerlauf, 3.Gang" VALUE 0xF3B28 MSA15_FW4 0 DEZ_DW -32768.000000 32767.000000 /end CHARACTERISTIC
/begin CHARACTERISTIC mrwPSL4G_a "ARD-SR quadrat. G-Faktor: Leerlauf, 4.Gang" VALUE 0xF3B1A MSA15_FW4 0 DEZ_DW -32768.000000 32767.000000 /end CHARACTERISTIC
/begin CHARACTERISTIC mrwPSL4G_b "ARD-SR linearer G-Faktor: Leerlauf, 4.Gang" VALUE 0xF3B1C MSA15_FW4 0 DEZ_DW -32768.000000 32767.000000 /end CHARACTERISTIC
/begin CHARACTERISTIC mrwPSL4G_c "ARD-SR  konst.  G-Faktor: Leerlauf, 4.Gang" VALUE 0xF3B1E MSA15_FW4 0 DEZ_DW -32768.000000 32767.000000 /end CHARACTERISTIC
/begin CHARACTERISTIC mrwPSL5G_a "ARD-SR quadrat. G-Faktor: Leerlauf, 5.Gang" VALUE 0xF3B10 MSA15_FW4 0 DEZ_DW -32768.000000 32767.000000 /end CHARACTERISTIC
/begin CHARACTERISTIC mrwPSL5G_b "ARD-SR linearer G-Faktor: Leerlauf, 5.Gang" VALUE 0xF3B12 MSA15_FW4 0 DEZ_DW -32768.000000 32767.000000 /end CHARACTERISTIC
/begin CHARACTERISTIC mrwPSL5G_c "ARD-SR  konst.  G-Faktor: Leerlauf, 5.Gang" VALUE 0xF3B14 MSA15_FW4 0 DEZ_DW -32768.000000 32767.000000 /end CHARACTERISTIC
/begin CHARACTERISTIC mrwPSR1G_a "ARD-SR quadrat. G-Faktor: Ruckeln, 1.Gang" VALUE 0xF3B06 MSA15_FW4 0 DEZ_DW -32768.000000 32767.000000 /end CHARACTERISTIC
/begin CHARACTERISTIC mrwPSR1G_b "ARD-SR linearer G-Faktor: Ruckeln, 1.Gang" VALUE 0xF3B08 MSA15_FW4 0 DEZ_DW -32768.000000 32767.000000 /end CHARACTERISTIC
/begin CHARACTERISTIC mrwPSR1G_c "ARD-SR  konst.  G-Faktor: Ruckeln, 1.Gang" VALUE 0xF3B0A MSA15_FW4 0 DEZ_DW -32768.000000 32767.000000 /end CHARACTERISTIC
/begin CHARACTERISTIC mrwPSR2G_a "ARD-SR quadrat. G-Faktor: Ruckeln, 2.Gang" VALUE 0xF3AFC MSA15_FW4 0 DEZ_DW -32768.000000 32767.000000 /end CHARACTERISTIC
/begin CHARACTERISTIC mrwPSR2G_b "ARD-SR linearer G-Faktor: Ruckeln, 2.Gang" VALUE 0xF3AFE MSA15_FW4 0 DEZ_DW -32768.000000 32767.000000 /end CHARACTERISTIC
/begin CHARACTERISTIC mrwPSR2G_c "ARD-SR  konst.  G-Faktor: Ruckeln, 2.Gang" VALUE 0xF3B00 MSA15_FW4 0 DEZ_DW -32768.000000 32767.000000 /end CHARACTERISTIC
/begin CHARACTERISTIC mrwPSR3G_a "ARD-SR quadrat. G-Faktor: Ruckeln, 3.Gang" VALUE 0xF3AF2 MSA15_FW4 0 DEZ_DW -32768.000000 32767.000000 /end CHARACTERISTIC
/begin CHARACTERISTIC mrwPSR3G_b "ARD-SR linearer G-Faktor: Ruckeln, 3.Gang" VALUE 0xF3AF4 MSA15_FW4 0 DEZ_DW -32768.000000 32767.000000 /end CHARACTERISTIC
/begin CHARACTERISTIC mrwPSR3G_c "ARD-SR  konst.  G-Faktor: Ruckeln, 3.Gang" VALUE 0xF3AF6 MSA15_FW4 0 DEZ_DW -32768.000000 32767.000000 /end CHARACTERISTIC
/begin CHARACTERISTIC mrwPSR4G_a "ARD-SR quadrat. G-Faktor: Ruckeln, 4.Gang" VALUE 0xF3AE8 MSA15_FW4 0 DEZ_DW -32768.000000 32767.000000 /end CHARACTERISTIC
/begin CHARACTERISTIC mrwPSR4G_b "ARD-SR linearer G-Faktor: Ruckeln, 4.Gang" VALUE 0xF3AEA MSA15_FW4 0 DEZ_DW -32768.000000 32767.000000 /end CHARACTERISTIC
/begin CHARACTERISTIC mrwPSR4G_c "ARD-SR  konst.  G-Faktor: Ruckeln, 4.Gang" VALUE 0xF3AEC MSA15_FW4 0 DEZ_DW -32768.000000 32767.000000 /end CHARACTERISTIC
/begin CHARACTERISTIC mrwPSR5G_a "ARD-SR quadrat. G-Faktor: Ruckeln, 5.Gang" VALUE 0xF3ADE MSA15_FW4 0 DEZ_DW -32768.000000 32767.000000 /end CHARACTERISTIC
/begin CHARACTERISTIC mrwPSR5G_b "ARD-SR linearer G-Faktor: Ruckeln, 5.Gang" VALUE 0xF3AE0 MSA15_FW4 0 DEZ_DW -32768.000000 32767.000000 /end CHARACTERISTIC
/begin CHARACTERISTIC mrwPSR5G_c "ARD-SR  konst.  G-Faktor: Ruckeln, 5.Gang" VALUE 0xF3AE2 MSA15_FW4 0 DEZ_DW -32768.000000 32767.000000 /end CHARACTERISTIC
/begin CHARACTERISTIC mrwPT1LZPO "PWG Filter-Zeitkonstante bei PWG-Anstieg oben und Low Range" VALUE 0xF37CC MSA15_FW4 0 GF 0.000031 0.999969 /end CHARACTERISTIC
/begin CHARACTERISTIC mrwPT1_ZNO "#SSD PWG Filter-Zeitkonstante bei PWG-Abfall oben" VALUE 0xF9F46 MSA15_FW4 0 GF 0.000031 0.999969 /end CHARACTERISTIC
/begin CHARACTERISTIC mrwPT1_ZNU "#SSD PWG Filter-Zeitkonstante bei PWG-Abfall unten" VALUE 0xF9F48 MSA15_FW4 0 GF 0.000031 0.999969 /end CHARACTERISTIC
/begin CHARACTERISTIC mrwPT1_ZPO "PWG Filter-Zeitkonstante bei PWG-Anstieg oben" VALUE 0xF37C8 MSA15_FW4 0 GF 0.000031 0.999969 /end CHARACTERISTIC
/begin CHARACTERISTIC mrwPT1_ZPU "PWG Filter-Zeitkonstante bei PWG-Anstieg unten" VALUE 0xF37CA MSA15_FW4 0 GF 0.000031 0.999969 /end CHARACTERISTIC
/begin CHARACTERISTIC mrwPUFI_LE "#SSD M_E Abstand Lese - Schreibeindex dM_E-LRR-HE  Puffer" VALUE 0xF3D3E MSA15_FW2 0 DEZ_DB_U 0.000000 5.000000 EXTENDED_LIMITS 0.000000 255.000000 /end CHARACTERISTIC
/begin CHARACTERISTIC mrwPVS_min "VDF  Mindestwert P-VDF fuer Motorstart" VALUE 0xFB162 MSA15_FW4 0 VDF 0.000000 5000.000000 EXTENDED_LIMITS -32768.000000 32767.000000 /end CHARACTERISTIC
/begin CHARACTERISTIC mrwPVsolKL "VDF  Ermittlung Sollwert Kraftstoffvorfoerderdruck P-VDF-Soll" CURVE 0xFB12A MSA15_KL118 0 VDF 0.000000 5000.000000
 /begin AXIS_DESCR STD_AXIS dzmNmit N 12 0.000000 6000.000000 EXTENDED_LIMITS 0.000000 32767.000000 /end AXIS_DESCR
 EXTENDED_LIMITS -32768.000000 32767.000000 /end CHARACTERISTIC
/begin CHARACTERISTIC mrwPWG_BPA "#SSD PWG 1: Test PWG/BRE-Plausibilitaet; 0: kein Test" VALUE 0xF9F1C MSA15_FW4 0 DEZ_DW 0.000000 1.000000 EXTENDED_LIMITS -32768.000000 32767.000000 /end CHARACTERISTIC
/begin CHARACTERISTIC mrwPWG_BPN "#SSD PWG untere N-Schwelle fuer PWG/BRE-Plausibilitaet" VALUE 0xF9F1E MSA15_FW4 0 N 0.000000 6000.000000 EXTENDED_LIMITS 0.000000 32767.000000 /end CHARACTERISTIC
/begin CHARACTERISTIC mrwPWG_BPP "#SSD PWG obere PWG-Schwelle fuer PWG/BRE-Plausibilitaet" VALUE 0xF9F22 MSA15_FW4 0 PROZ_S 0.000000 100.000000 EXTENDED_LIMITS -327.680000 327.670000 /end CHARACTERISTIC
/begin CHARACTERISTIC mrwPWG_BPV "#SSD PWG untere V-Schwelle fuer PWG/BRE-Plausibilitaet" VALUE 0xF9F20 MSA15_FW4 0 V 0.000000 300.000000 EXTENDED_LIMITS 0.000000 327.670000 /end CHARACTERISTIC
/begin CHARACTERISTIC mrwPWG_HRP "PWG  Heilungsrampe nach Fehler PWG/PGS-Plausibilitaet" VALUE 0xF9F36 MSA15_FW4 0 PROZDT 0.000000 10000.000000 EXTENDED_LIMITS 0.000000 16383.500000 /end CHARACTERISTIC
/begin CHARACTERISTIC mrwPWG_KD "PWG-Rohwertschwelle fuer Kickdownauswertung" VALUE 0xF202A MSA15_FW4 0 U 0.000000 5601.173000 EXTENDED_LIMITS 0.000000 160151.500000 /end CHARACTERISTIC
/begin CHARACTERISTIC mrwPWG_LLS "#SSD PWG  LL-Schwelle fuer PWG/PGS-Plausibilitaet" VALUE 0xF9F2C MSA15_FW4 0 PROZ_S 0.000000 100.000000 EXTENDED_LIMITS -327.680000 327.670000 /end CHARACTERISTIC
/begin CHARACTERISTIC mrwPWG_PLL "#SSD PWG  Plausibilitaets-Fenster fuer PWG & PGS = LL" VALUE 0xF9F30 MSA15_FW4 0 U 0.000000 5601.173000 EXTENDED_LIMITS 0.000000 160151.500000 /end CHARACTERISTIC
/begin CHARACTERISTIC mrwPWG_PTL "#SSD PWG  Plausibilitaets-Fenster fuer PWG & PGS = TL" VALUE 0xF9F32 MSA15_FW4 0 U 0.000000 5601.173000 EXTENDED_LIMITS 0.000000 160151.500000 /end CHARACTERISTIC
/begin CHARACTERISTIC mrwPWG_PVL "#SSD PWG  Plausibilitaets-Fenster fuer PWG & PGS = VL" VALUE 0xF9F34 MSA15_FW4 0 U 0.000000 5601.173000 EXTENDED_LIMITS 0.000000 160151.500000 /end CHARACTERISTIC
/begin CHARACTERISTIC mrwPWG_Pbr "#SSD PWG Vorgabewert bei Defekt aus Plausibil. PWG/BRE" VALUE 0xF9F26 MSA15_FW4 0 PROZ_S 0.000000 100.000000 EXTENDED_LIMITS -327.680000 327.670000 /end CHARACTERISTIC
/begin CHARACTERISTIC mrwPWG_SfB "#SSD PWG Pedalwert-Rampe bei Eintritt Sicherheitsfall PWG/BRE" VALUE 0xF9F28 MSA15_FW4 0 PROZDT 0.000000 10000.000000 EXTENDED_LIMITS 0.000000 16383.500000 /end CHARACTERISTIC
/begin CHARACTERISTIC mrwPWG_SfE "#SSD PWG Pedalwert-Rampe bei Aufhebung Sicherheitsfall PWG/BRE" VALUE 0xF9F2A MSA15_FW4 0 PROZDT 0.000000 10000.000000 EXTENDED_LIMITS 0.000000 16383.500000 /end CHARACTERISTIC
/begin CHARACTERISTIC mrwPWG_UPL "#SSD PWG  Spannungs-Schwelle keine PWG/PGS-Plausibilisierung" VALUE 0xF9F38 MSA15_FW4 0 U 0.000000 5601.173000 EXTENDED_LIMITS 0.000000 160151.500000 /end CHARACTERISTIC
/begin CHARACTERISTIC mrwPWG_VLS "#SSD PWG  VL-Schwelle fuer PWG/PGS-Plausibilitaet" VALUE 0xF9F2E MSA15_FW4 0 PROZ_S 0.000000 100.000000 EXTENDED_LIMITS -327.680000 327.670000 /end CHARACTERISTIC
/begin CHARACTERISTIC mrwPWG_dPS "#SSD PWG dPWG/dt-Schwelle zur PWG/BRE-Intakterkennung" VALUE 0xF9F24 MSA15_FW4 0 PROZDT 0.000000 10000.000000 EXTENDED_LIMITS 0.000000 16383.500000 /end CHARACTERISTIC
/begin CHARACTERISTIC mrwPZ1LZNO "#SSD PWG Filter-Zeitkonstante bei PWG-Abfall oben bei Low Range" VALUE 0xF9F4A MSA15_FW4 0 GF 0.000031 0.999969 /end CHARACTERISTIC
/begin CHARACTERISTIC mrwPZ1LZNU "#SSD PWG Filter-Zeitkonstante bei PWG-Abfall unten bei Low Range" VALUE 0xF9F4C MSA15_FW4 0 GF 0.000031 0.999969 /end CHARACTERISTIC
/begin CHARACTERISTIC mrwPZ1LZPU "PWG Filter-Zeitkonstante bei PWG-Anstieg unten und Low Range" VALUE 0xF37CE MSA15_FW4 0 GF 0.000031 0.999969 /end CHARACTERISTIC
/begin CHARACTERISTIC mrwRAU_LAD "BEG Rauchb. Schrittweite bei abgefallenem Ladeluftschlauch" VALUE 0xFA2DA MSA15_FW4 0 dM_E_dZ 0.000000 3000.000000 EXTENDED_LIMITS -16384.000000 16383.500000 /end CHARACTERISTIC
/begin CHARACTERISTIC mrwRAU_LAH "BEG Rauchb. Schrittweite bei abgefallenem Ladeluftschlauch" VALUE 0xFA2DC MSA15_FW4 0 dM_E_dZ 0.000000 3000.000000 EXTENDED_LIMITS -16384.000000 16383.500000 /end CHARACTERISTIC
/begin CHARACTERISTIC mrwRAU_RDS "BEG dyn. Rauchb. Schrittweite bei D-S" VALUE 0xFA2D6 MSA15_FW4 0 dM_E_dZ 0.000000 3000.000000 EXTENDED_LIMITS -16384.000000 16383.500000 /end CHARACTERISTIC
/begin CHARACTERISTIC mrwRAU_RSD "BEG dyn. Rauchb. Schrittweite bei S-D" VALUE 0xFA2D8 MSA15_FW4 0 dM_E_dZ 0.000000 3000.000000 EXTENDED_LIMITS -16384.000000 16383.500000 /end CHARACTERISTIC
/begin CHARACTERISTIC mrwREI_KF "EXT Reibmengen-KF M_E = f(N, T_W)" MAP 0xF236C MSA15_KF382 0 MM3 0.000000 100.000000
 /begin AXIS_DESCR STD_AXIS dzmNmit N 8 0.000000 6000.000000 EXTENDED_LIMITS 0.000000 32767.000000 /end AXIS_DESCR
 /begin AXIS_DESCR STD_AXIS anmWTF T 8 -50.040010 149.960000 EXTENDED_LIMITS -273.140000 3003.560000 /end AXIS_DESCR
 EXTENDED_LIMITS -327.680000 327.670000 /end CHARACTERISTIC
/begin CHARACTERISTIC mrwSA_RAMP "Rampensteigung M_EPUMP Absenkung im Schub" VALUE 0xF3A4E MSA15_FW4 0 RAMP_SA 0.000000 16666.870000 EXTENDED_LIMITS 0.000000 19999.390000 /end CHARACTERISTIC
/begin CHARACTERISTIC mrwSCHU_KL "#SSD Schubkennlinie" CURVE 0xF97E4 MSA15_KL118 0 AD_uS 0.000000 3000.000000
 /begin AXIS_DESCR STD_AXIS dzmNmit N 8 0.000000 6000.000000 EXTENDED_LIMITS 0.000000 32767.000000 /end AXIS_DESCR
 EXTENDED_LIMITS -32768.000000 32767.000000 /end CHARACTERISTIC
/begin CHARACTERISTIC mrwSTANmax "Drehzahlfenster fuer Freigabe - Wiederstart" VALUE 0xFA058 MSA15_FW4 0 N 0.000000 6000.000000 EXTENDED_LIMITS 0.000000 32767.000000 /end CHARACTERISTIC
/begin CHARACTERISTIC mrwSTANmin "Drehzahlfenster fuer Freigabe - Wiederstart" VALUE 0xFA056 MSA15_FW4 0 N 0.000000 6000.000000 EXTENDED_LIMITS 0.000000 32767.000000 /end CHARACTERISTIC
/begin CHARACTERISTIC mrwSTA_END "STA obere N-Schwelle fuer Startmengen-Abgleich" VALUE 0xFA048 MSA15_FW4 0 N 0.000000 6000.000000 EXTENDED_LIMITS 0.000000 32767.000000 /end CHARACTERISTIC
/begin CHARACTERISTIC mrwSTA_MAX "STA max. Abgleichwert fuer Startmengenkorrektur" VALUE 0xFA04A MSA15_FW4 0 MM3 0.000000 100.000000 EXTENDED_LIMITS -327.680000 327.670000 /end CHARACTERISTIC
/begin CHARACTERISTIC mrwSTA_T "Dauer der Bedingungen fuer Wiederstart ohne K15 ein/aus" VALUE 0xFA054 MSA15_FW3 0 ZEIT_ST 0.000000 655350000.000000 /end CHARACTERISTIC
/begin CHARACTERISTIC mrwSTINILL "LLR Initialisierung des I-Anteils  M_E = f(T_W)" CURVE 0xF38FC MSA15_KL118 0 MM3 0.000000 100.000000
 /begin AXIS_DESCR STD_AXIS anmWTF T 8 -50.040010 149.960000 EXTENDED_LIMITS -273.140000 3003.560000 /end AXIS_DESCR
 EXTENDED_LIMITS -327.680000 327.670000 /end CHARACTERISTIC
/begin CHARACTERISTIC mrwSTK_GM "STA Grenzmenge fuer Startmengenerhoehung kalt" VALUE 0xF9F52 MSA15_FW4 0 MM3 0.000000 100.000000 EXTENDED_LIMITS -327.680000 327.670000 /end CHARACTERISTIC
/begin CHARACTERISTIC mrwSTK_MI "STA Mengeninkrement der Startmengenerhoehung kalt" VALUE 0xF9F50 MSA15_FW4 0 dVE_dZ 0.000000 3000.000000 EXTENDED_LIMITS -16384.000000 16383.500000 /end CHARACTERISTIC
/begin CHARACTERISTIC mrwSTK_WZ "STA Wartezeit vor Startmengenerhoehung kalt" VALUE 0xF9F4E MSA15_FW3 0 ZEIT_ST 0.000000 655350000.000000 /end CHARACTERISTIC
/begin CHARACTERISTIC mrwSTMGRKF "STA Startmengen-Grundkennfeld    M_E = f(N, T_W)" MAP 0xF9F5A MSA15_KF382 0 MM3 0.000000 100.000000
 /begin AXIS_DESCR STD_AXIS dzmNmit N 8 0.000000 6000.000000 EXTENDED_LIMITS 0.000000 32767.000000 /end AXIS_DESCR
 /begin AXIS_DESCR STD_AXIS anmWTF T 10 -50.040010 149.960000 EXTENDED_LIMITS -273.140000 3003.560000 /end AXIS_DESCR
 EXTENDED_LIMITS -327.680000 327.670000 /end CHARACTERISTIC
/begin CHARACTERISTIC mrwSTNABKL "STA Startabwurfdrehzahl-KL       N = f(T_W)" CURVE 0xFA026 MSA15_KL118 0 N 0.000000 6000.000000
 /begin AXIS_DESCR STD_AXIS anmWTF T 6 -50.040010 149.960000 EXTENDED_LIMITS -273.140000 3003.560000 /end AXIS_DESCR
 EXTENDED_LIMITS 0.000000 32767.000000 /end CHARACTERISTIC
/begin CHARACTERISTIC mrwSTNMIN1 "STA untere N-Schwelle fuer Startmengenfreigabe" VALUE 0xFA044 MSA15_FW4 0 N 0.000000 6000.000000 EXTENDED_LIMITS 0.000000 32767.000000 /end CHARACTERISTIC
/begin CHARACTERISTIC mrwSTNMIN2 "STA obere N-Schwelle fuer Startmengenerhoehung" VALUE 0xFA046 MSA15_FW4 0 N 0.000000 6000.000000 EXTENDED_LIMITS 0.000000 32767.000000 /end CHARACTERISTIC
/begin CHARACTERISTIC mrwSTW_GM "STA Grenzmenge fuer Startmengenerhoehung warm" VALUE 0xF9F58 MSA15_FW4 0 MM3 0.000000 100.000000 EXTENDED_LIMITS -327.680000 327.670000 /end CHARACTERISTIC
/begin CHARACTERISTIC mrwSTW_MI "STA Mengeninkrement der Startmengenerhoehung warm" VALUE 0xF9F56 MSA15_FW4 0 dVE_dZ 0.000000 3000.000000 EXTENDED_LIMITS -16384.000000 16383.500000 /end CHARACTERISTIC
/begin CHARACTERISTIC mrwSTW_WZ "STA Wartezeit vor Startmengenerhoehung warm" VALUE 0xF9F54 MSA15_FW3 0 ZEIT_ST 0.000000 655350000.000000 /end CHARACTERISTIC
/begin CHARACTERISTIC mrwST_NL_N "Drehzahlschwelle zu Unterschreiten bei Start aus NL" VALUE 0xFA050 MSA15_FW4 0 N 0.000000 6000.000000 EXTENDED_LIMITS 0.000000 32767.000000 /end CHARACTERISTIC
/begin CHARACTERISTIC mrwST_NL_T "Wartezeit nach N Unterschreitung bei Start aus NL" VALUE 0xFA052 MSA15_FW3 0 ZEIT_ST 0.000000 655350000.000000 /end CHARACTERISTIC
/begin CHARACTERISTIC mrwST_SPZ "STA Sperrzeit fuer Startmengenabwurf nach Start" VALUE 0xFA042 MSA15_FW3 0 ZEIT_ST 0.000000 500000.000000 EXTENDED_LIMITS 0.000000 655350000.000000 /end CHARACTERISTIC
/begin CHARACTERISTIC mrwST_TKsw "STA T_K-Schwelle f. Parameter der Startmengenerh." VALUE 0xFA04C MSA15_FW4 0 T -50.040010 149.960000 EXTENDED_LIMITS -273.140000 3003.560000 /end CHARACTERISTIC
/begin CHARACTERISTIC mrwS_MDASC "Drehmo. Eingriff Plausibilisierung 0 = Ohne ASC_ALIVE / 1 = Mit ASC_ALIVE" VALUE 0xF202F MSA15_FW1 0 DEZ_DB_U 0.000000 1.000000 EXTENDED_LIMITS 0.000000 255.000000 /end CHARACTERISTIC
/begin CHARACTERISTIC mrwTBATAUS "Zeit bis ausschalten" VALUE 0xF3872 MSA15_FW3 0 ZEIT_ST 0.000000 655350000.000000 /end CHARACTERISTIC
/begin CHARACTERISTIC mrwTBATEIN "Zeit bis einschalten" VALUE 0xF3870 MSA15_FW3 0 ZEIT_ST 0.000000 655350000.000000 /end CHARACTERISTIC
/begin CHARACTERISTIC mrwTWH_S1 "LLR Parametersatzwahl untere T_W-Schwelle kalt/warm" VALUE 0xF3890 MSA15_FW4 0 T -50.040010 149.960000 EXTENDED_LIMITS -273.140000 3003.560000 /end CHARACTERISTIC
/begin CHARACTERISTIC mrwTWH_S2 "LLR Parametersatzwahl obere T_W-Schwelle kalt/warm" VALUE 0xF3892 MSA15_FW4 0 T -50.040010 149.960000 EXTENDED_LIMITS -273.140000 3003.560000 /end CHARACTERISTIC
/begin CHARACTERISTIC mrwTXUGH_R "Gangstufe - Retourgang bei High Range" VALUE 0xF2021 MSA15_FW1 0 DEZ_DB_U 0.000000 7.000000 EXTENDED_LIMITS 0.000000 255.000000 /end CHARACTERISTIC
/begin CHARACTERISTIC mrwTXUGHmx "Maximale Gangstufe -Vorwärtsgang bei High Range" VALUE 0xF201F MSA15_FW1 0 DEZ_DB_U 0.000000 7.000000 EXTENDED_LIMITS 0.000000 255.000000 /end CHARACTERISTIC
/begin CHARACTERISTIC mrwTXUGL_R "Gangstufe - Retourgang bei Low Range" VALUE 0xF2020 MSA15_FW1 0 DEZ_DB_U 0.000000 7.000000 EXTENDED_LIMITS 0.000000 255.000000 /end CHARACTERISTIC
/begin CHARACTERISTIC mrwTXUGLmx "Maximale Gangstufe -Vorwärtsgang bei Low Range" VALUE 0xF201E MSA15_FW1 0 DEZ_DB_U 0.000000 7.000000 EXTENDED_LIMITS 0.000000 255.000000 /end CHARACTERISTIC
/begin CHARACTERISTIC mrwTXURAMP "#SSD TXU Schrittweite Mengenrampe" VALUE 0xF200E MSA15_FW3 0 dM_E_dZ 0.000000 3000.000000 EXTENDED_LIMITS -16384.000000 16383.500000 /end CHARACTERISTIC
/begin CHARACTERISTIC mrwTXURMP1 "#SSD TXU Schrittweite Bremse aktiv" VALUE 0xF2010 MSA15_FW3 0 dM_E_dZ 0.000000 3000.000000 EXTENDED_LIMITS -16384.000000 16383.500000 /end CHARACTERISTIC
/begin CHARACTERISTIC mrwTXURMP2 "#SSD TXU Schrittweite Bremse inaktiv" VALUE 0xF2012 MSA15_FW3 0 dM_E_dZ 0.000000 3000.000000 EXTENDED_LIMITS -16384.000000 16383.500000 /end CHARACTERISTIC
/begin CHARACTERISTIC mrwT_EKPKL "#SSD EKP-Ansteuerzeit vor Start als f(WTF)" CURVE 0xF9808 MSA15_KL118 0 ZEIT_ST 0.000000 30000000.000000
 /begin AXIS_DESCR STD_AXIS anmWTF T 4 -50.040010 149.960000 EXTENDED_LIMITS -273.140000 3003.560000 /end AXIS_DESCR
 EXTENDED_LIMITS 0.000000 655350000.000000 /end CHARACTERISTIC
/begin CHARACTERISTIC mrwT_Wdyo "BEG dyn. Rauch-WTF-Schwelle oben" VALUE 0xFA2D2 MSA15_FW4 0 T -50.040010 149.960000 EXTENDED_LIMITS -273.140000 3003.560000 /end CHARACTERISTIC
/begin CHARACTERISTIC mrwT_Wdyu "BEG dyn. Rauch-WTF-Schwelle unten" VALUE 0xFA2D0 MSA15_FW4 0 T -50.040010 149.960000 EXTENDED_LIMITS -273.140000 3003.560000 /end CHARACTERISTIC
/begin CHARACTERISTIC mrwUBATAUS "Batterieschwelle aus" VALUE 0xF386C MSA15_FW3 0 U_B 0.000000 24163.000000 EXTENDED_LIMITS 0.000000 773948.100000 /end CHARACTERISTIC
/begin CHARACTERISTIC mrwUBATEIN "Batterieschwelle ein" VALUE 0xF386A MSA15_FW3 0 U_B 0.000000 24163.000000 EXTENDED_LIMITS 0.000000 773948.100000 /end CHARACTERISTIC
/begin CHARACTERISTIC mrwUEB_CNM "FGG untere M_E-Schwelle fuer FGG-Plausibilitaet" VALUE 0xF37D0 MSA15_FW3 0 MM3 0.000000 100.000000 EXTENDED_LIMITS -327.680000 327.670000 /end CHARACTERISTIC
/begin CHARACTERISTIC mrwUEB_CNN "FGG untere N-Schwelle fuer FGG-Plausibilitaet" VALUE 0xF37D2 MSA15_FW3 0 N 0.000000 6000.000000 EXTENDED_LIMITS 0.000000 32767.000000 /end CHARACTERISTIC
/begin CHARACTERISTIC mrwUEB_CNV "FGG untere V-Schwelle fuer FGG-Plausibilitaet" VALUE 0xF37D4 MSA15_FW3 0 V 0.000000 300.000000 EXTENDED_LIMITS 0.000000 327.670000 /end CHARACTERISTIC
/begin CHARACTERISTIC mrwVDF_max "#SSD VDF  Maximales P-VDF im Leerlauf" VALUE 0xFB168 MSA15_FW4 0 VDF 0.000000 5000.000000 EXTENDED_LIMITS -32768.000000 32767.000000 /end CHARACTERISTIC
/begin CHARACTERISTIC mrwVDF_min "#SSD VDF  Minimales P-VDF im Leerlauf" VALUE 0xFB166 MSA15_FW4 0 VDF 0.000000 5000.000000 EXTENDED_LIMITS -32768.000000 32767.000000 /end CHARACTERISTIC
/begin CHARACTERISTIC mrwVD_Nmax "#SSD VDF  N-Schwelle fuer P-VDF-Pruefung im Leerlauf" VALUE 0xFB164 MSA15_FW4 0 N 0.000000 6000.000000 EXTENDED_LIMITS 0.000000 32767.000000 /end CHARACTERISTIC
/begin CHARACTERISTIC mrwVNF_GF "Gangerkennung Gedaechnisfaktor fuer V/N-Filter" VALUE 0xF37C4 MSA15_FW4 0 GF 0.000031 0.999969 /end CHARACTERISTIC
/begin CHARACTERISTIC mrwV_ANFAH "#SSD EGS V-Schwelle fuer Anfahrdrehmomentenkennlinie" VALUE 0xF2016 MSA15_FW3 0 V 0.000000 300.000000 EXTENDED_LIMITS 0.000000 327.670000 /end CHARACTERISTIC
/begin CHARACTERISTIC mrwV_ANFXU "#SSD Anfahr Geschwindigkeitsschwelle" VALUE 0xF2014 MSA15_FW3 0 V 0.000000 300.000000 EXTENDED_LIMITS 0.000000 327.670000 /end CHARACTERISTIC
/begin CHARACTERISTIC mrwVxN_O "V/N - Obere Schwelle zur Umschaltung" VALUE 0xFA8B0 MSA15_FW4 0 V_N 0.000000 0.100000 EXTENDED_LIMITS -1.280000 1.279961 /end CHARACTERISTIC
/begin CHARACTERISTIC mrwVxN_O2 "V/N - Obere Schwelle 2 zur Umschaltung" VALUE 0xFA8B4 MSA15_FW4 0 V_N 0.000000 0.100000 EXTENDED_LIMITS -1.280000 1.279961 /end CHARACTERISTIC
/begin CHARACTERISTIC mrwVxN_U "V/N - Untere Schwelle zur Umschaltung" VALUE 0xFA8B2 MSA15_FW4 0 V_N 0.000000 0.100000 EXTENDED_LIMITS -1.280000 1.279961 /end CHARACTERISTIC
/begin CHARACTERISTIC mrwVxN_U2 "V/N - Untere Schwelle 2 zur Umschaltung" VALUE 0xFA8B6 MSA15_FW4 0 V_N 0.000000 0.100000 EXTENDED_LIMITS -1.280000 1.279961 /end CHARACTERISTIC
/begin CHARACTERISTIC mrwWTF_FZY "Fahrzyklusschalter Wassertemperatur" VALUE 0xFB20C MSA15_FW2 0 DEZ_DB_U 0.000000 1.000000 EXTENDED_LIMITS 0.000000 255.000000 /end CHARACTERISTIC
/begin CHARACTERISTIC mrwWTF_S1 "Wassertemperatur obere  Hysteresenschwelle" VALUE 0xFB208 MSA15_FW4 0 T -50.040010 149.960000 EXTENDED_LIMITS -273.140000 3003.560000 /end CHARACTERISTIC
/begin CHARACTERISTIC mrwWTF_S2 "Wassertemperatur untere Hysteresenschwelle" VALUE 0xFB20A MSA15_FW4 0 T -50.040010 149.960000 EXTENDED_LIMITS -273.140000 3003.560000 /end CHARACTERISTIC
/begin CHARACTERISTIC mrwZKL_DBE "#SSD Anzahl Zyklen bis zu einem DBE Test im NL" VALUE 0xF979A MSA15_FW4 0 DEZ_DW_U 0.000000 65535.000000 /end CHARACTERISTIC
/begin CHARACTERISTIC mrwZKL_EAB "#SSD Anzahl Zyklen bis zu einem EAB Test im NL" VALUE 0xF979C MSA15_FW4 0 DEZ_DW_U 0.000000 65535.000000 /end CHARACTERISTIC
/begin CHARACTERISTIC mrwZKL_INJ "#SSD Anzahl Zyklen bis zu einem INJ Test im NL" VALUE 0xF97A2 MSA15_FW4 0 DEZ_DW_U 0.000000 65535.000000 /end CHARACTERISTIC
/begin CHARACTERISTIC mrwZKL_NUL "#SSD Anzahl Zyklen bis zu einem NUL Test im NL" VALUE 0xF97A0 MSA15_FW4 0 DEZ_DW_U 0.000000 65535.000000 /end CHARACTERISTIC
/begin CHARACTERISTIC mrwZKL_STO "#SSD Anzahl Zyklen bis zu einem STB Test obere Grenze im NL" VALUE 0xF97A4 MSA15_FW4 0 DEZ_DW_U 0.000000 65535.000000 /end CHARACTERISTIC
/begin CHARACTERISTIC mrwZKL_STU "#SSD Anzahl Zyklen bis zu einem STB Test untere Grenze im NL" VALUE 0xF97A6 MSA15_FW4 0 DEZ_DW_U 0.000000 65535.000000 /end CHARACTERISTIC
/begin CHARACTERISTIC mrwZKL_UM "#SSD Anzahl Zyklen bis zu einem UM Test im NL" VALUE 0xF979E MSA15_FW4 0 DEZ_DW_U 0.000000 65535.000000 /end CHARACTERISTIC
/begin CHARACTERISTIC mrwdNdt_GF "PT1-Filter Drehzahlgradient für Overfueling" VALUE 0xFA542 MSA15_FW4 0 GF 0.000031 0.999969 /end CHARACTERISTIC
/begin CHARACTERISTIC mrwdPV_max "VDF  Maximale Differenz P-VDF-Soll / P-VDF-Ist" VALUE 0xFB15E MSA15_FW3 0 VDF 0.000000 5000.000000 EXTENDED_LIMITS -32768.000000 32767.000000 /end CHARACTERISTIC
/begin CHARACTERISTIC mrwtVFP_ON "VDF  Delaytimer P-VDF-Ueberwachung nach EKP=ein" VALUE 0xFB160 MSA15_FW3 0 ZEIT_ST 0.000000 655350000.000000 /end CHARACTERISTIC
/begin CHARACTERISTIC mrwt_ASK1 "Zeit1 Abstellklappe" VALUE 0xF97D0 MSA15_FW3 0 ZEIT_ST 0.000000 60000000.000000 EXTENDED_LIMITS 0.000000 655350000.000000 /end CHARACTERISTIC
/begin CHARACTERISTIC mrwt_ASK2 "Zeit2 Abstellklappe" VALUE 0xF97D2 MSA15_FW3 0 ZEIT_ST 0.000000 60000000.000000 EXTENDED_LIMITS 0.000000 655350000.000000 /end CHARACTERISTIC
/begin CHARACTERISTIC mrwt_rady "BEG dyn. Rauchbegrenzung-Zeitschwelle" VALUE 0xFA2D4 MSA15_FW3 0 ZEIT_ST 0.000000 655350000.000000 /end CHARACTERISTIC
/begin CHARACTERISTIC phwK_PBM3e "KWH Diagnose ueber phmPBM3 aus/ein (0/1) ! ***BC264 FAC2WI" VALUE 0xF1B2E MSA15_FW2 0 DEZ_DB_U 0.000000 1.000000 EXTENDED_LIMITS 0.000000 255.000000 /end CHARACTERISTIC
/begin CHARACTERISTIC phwK_PBM4e "Generatorlast ueber phmPBM4 aus/ein (0/1)" VALUE 0xF1B2F MSA15_FW2 0 DEZ_DB_U 0.000000 1.000000 EXTENDED_LIMITS 0.000000 255.000000 /end CHARACTERISTIC
/begin CHARACTERISTIC phwK_PBM4n "Generatorlast aktiv high/low  (0/1)" VALUE 0xF1B30 MSA15_FW2 0 DEZ_DB_U 0.000000 1.000000 EXTENDED_LIMITS 0.000000 255.000000 /end CHARACTERISTIC
/begin CHARACTERISTIC xccADFCanD "Teilungsfaktor fuer anmADF -> CAN p_Luft" VALUE 0xF8F62 MSA15_FW3 0 DEZ_DW_U 0.000000 32767.000000 EXTENDED_LIMITS 0.000000 65535.000000 /end CHARACTERISTIC
/begin CHARACTERISTIC xccADFCanH "Maximalwert CAN p_Luft" VALUE 0xF8F68 MSA15_FW3 0 DEZ_DW_U 0.000000 32767.000000 EXTENDED_LIMITS 0.000000 65535.000000 /end CHARACTERISTIC
/begin CHARACTERISTIC xccADFCanL "Minimalwert CAN p_Luft" VALUE 0xF8F66 MSA15_FW3 0 DEZ_DW_U 0.000000 32767.000000 EXTENDED_LIMITS 0.000000 65535.000000 /end CHARACTERISTIC
/begin CHARACTERISTIC xccADFCanO "negativer Offset fuer anmADF -> CAN p_Luft" VALUE 0xF8F64 MSA15_FW3 0 DEZ_DW_U 0.000000 32767.000000 EXTENDED_LIMITS 0.000000 65535.000000 /end CHARACTERISTIC
/begin CHARACTERISTIC xccAndInd1 "2-Bytes Aenderung Index, Byte 1" VALUE 0xF8F61 MSA15_FW1 0 DEZ_DB_U 0.000000 255.000000 /end CHARACTERISTIC
/begin CHARACTERISTIC xccAndInd2 "2-Bytes Aenderung Index, Byte 2" VALUE 0xF8F60 MSA15_FW1 0 DEZ_DB_U 0.000000 255.000000 /end CHARACTERISTIC
/begin CHARACTERISTIC xccBusInd1 "2-Bytes Bus Index, Byte 1" VALUE 0xF8F59 MSA15_FW1 0 DEZ_DB_U 0.000000 255.000000 /end CHARACTERISTIC
/begin CHARACTERISTIC xccBusInd2 "2-Bytes Bus Index, Byte 2" VALUE 0xF8F58 MSA15_FW1 0 DEZ_DB_U 0.000000 255.000000 /end CHARACTERISTIC
/begin CHARACTERISTIC xccCodInd1 "2-Bytes Codier Index, Byte 1" VALUE 0xF8F55 MSA15_FW1 0 DEZ_DB_U 0.000000 255.000000 /end CHARACTERISTIC
/begin CHARACTERISTIC xccCodInd2 "2-Bytes Codier Index, Byte 2" VALUE 0xF8F54 MSA15_FW1 0 DEZ_DB_U 0.000000 255.000000 /end CHARACTERISTIC
/begin CHARACTERISTIC xccDiaInd1 "2-Bytes Diagnose Index, Byte 1" VALUE 0xF8F57 MSA15_FW1 0 DEZ_DB_U 0.000000 255.000000 /end CHARACTERISTIC
/begin CHARACTERISTIC xccDiaInd2 "2-Bytes Diagnose Index, Byte 2" VALUE 0xF8F56 MSA15_FW1 0 DEZ_DB_U 0.000000 255.000000 /end CHARACTERISTIC
/begin CHARACTERISTIC xccPrJahr1 "2-Bytes Herstellerdatum Jahr, Byte 1" VALUE 0xF8F5D MSA15_FW1 0 DEZ_DB_U 0.000000 255.000000 /end CHARACTERISTIC
/begin CHARACTERISTIC xccPrJahr2 "2-Bytes Herstellerdatum Jahr, Byte 2" VALUE 0xF8F5C MSA15_FW1 0 DEZ_DB_U 0.000000 255.000000 /end CHARACTERISTIC
/begin CHARACTERISTIC xccPrKW1 "2-Bytes Herstellerdatum Woche, Byte 1" VALUE 0xF8F5B MSA15_FW1 0 DEZ_DB_U 0.000000 255.000000 /end CHARACTERISTIC
/begin CHARACTERISTIC xccPrKW2 "2-Bytes Herstellerdatum Woche, Byte 2" VALUE 0xF8F5A MSA15_FW1 0 DEZ_DB_U 0.000000 255.000000 /end CHARACTERISTIC
/begin CHARACTERISTIC xccSWNr1 "2-Bytes SW-Nummer, Byte 1" VALUE 0xF8F5F MSA15_FW1 0 DEZ_DB_U 0.000000 255.000000 /end CHARACTERISTIC
/begin CHARACTERISTIC xccSWNr2 "2-Bytes SW-Nummer, Byte 2" VALUE 0xF8F5E MSA15_FW1 0 DEZ_DB_U 0.000000 255.000000 /end CHARACTERISTIC
/begin CHARACTERISTIC xccZSMode "DIAG Injektorfehlerstest Modusregister" VALUE 0xF8F7E MSA15_FW1 0 DEZ_DB_U 0.000000 255.000000 /end CHARACTERISTIC
/begin CHARACTERISTIC xcwBYP_COS "Ueberwachung fuer Bypassfunktion(en) n-sync" VALUE 0xF8F94 MSA15_FW3 0 DEZ_DW_U 0.000000 65535.000000 /end CHARACTERISTIC
/begin CHARACTERISTIC xcwBYP_COX "Ueberwachung fuer Bypassfunktion(en) t-sync" VALUE 0xF8F96 MSA15_FW3 0 DEZ_DW_U 0.000000 65535.000000 /end CHARACTERISTIC
/begin CHARACTERISTIC xcwBYP_EIS "Auswahlschalter fuer Bypassfunktion(en) n-sync" VALUE 0xF8F90 MSA15_FW3 0 DEZ_DW_U 0.000000 65535.000000 /end CHARACTERISTIC
/begin CHARACTERISTIC xcwBYP_EIX "Auswahlschalter fuer Bypassfunktion(en) t-sync" VALUE 0xF8F92 MSA15_FW3 0 DEZ_DW_U 0.000000 65535.000000 /end CHARACTERISTIC
/begin CHARACTERISTIC xcwCARCO_D "DIAG Offset   CAN - CARB-Druck-Umrechnung" VALUE 0xF8DCC MSA15_FW4 0 DEZ_DW -32768.000000 32767.000000 /end CHARACTERISTIC
/begin CHARACTERISTIC xcwCARCO_L "DIAG Offset   CAN - CARB-Luftmassen-Umrechnung" VALUE 0xF8DF0 MSA15_FW4 0 DEZ_DW -32768.000000 32767.000000 /end CHARACTERISTIC
/begin CHARACTERISTIC xcwCARCO_N "DIAG Offset   CAN - CARB-Drehzahl-Umrechnung" VALUE 0xF8DD8 MSA15_FW4 0 DEZ_DW -32768.000000 32767.000000 /end CHARACTERISTIC
/begin CHARACTERISTIC xcwCARCO_P "DIAG Offset   CAN - CARB-Pedalwert-Umrechnung" VALUE 0xF8DFC MSA15_FW4 0 DEZ_DW -32768.000000 32767.000000 /end CHARACTERISTIC
/begin CHARACTERISTIC xcwCARCO_T "DIAG Offset   CAN - CARB-Temperatur-Umrechnung" VALUE 0xF8DC0 MSA15_FW4 0 DEZ_DW -32768.000000 32767.000000 /end CHARACTERISTIC
/begin CHARACTERISTIC xcwCARCO_V "DIAG Offset   CAN - CARB-Geschwindigkeit-Umrechnung" VALUE 0xF8DE4 MSA15_FW4 0 DEZ_DW -32768.000000 32767.000000 /end CHARACTERISTIC
/begin CHARACTERISTIC xcwCARCO_Z "DIAG Offset   CAN - 100ms Ticks-Umrechnung" VALUE 0xF8DA8 MSA15_FW4 0 DEZ_DW -32768.000000 32767.000000 /end CHARACTERISTIC
/begin CHARACTERISTIC xcwCARCOdT "DIAG Offset   CAN - Temperaturdifferenz" VALUE 0xF8DB4 MSA15_FW4 0 DEZ_DW -32768.000000 32767.000000 /end CHARACTERISTIC
/begin CHARACTERISTIC xcwCARCS_D "DIAG Steigung CAN - CARB-Druck-Umrechnung" VALUE 0xF8DCA MSA15_FW4 0 UMR_FAKT -32.000000 31.999020 /end CHARACTERISTIC
/begin CHARACTERISTIC xcwCARCS_L "DIAG Steigung CAN - CARB-Luftmassen-Umrechnung" VALUE 0xF8DEE MSA15_FW4 0 UMR_FAKT -32.000000 31.999020 /end CHARACTERISTIC
/begin CHARACTERISTIC xcwCARCS_N "DIAG Steigung CAN - CARB-Drehzahl-Umrechnung" VALUE 0xF8DD6 MSA15_FW4 0 UMR_FAKT -32.000000 31.999020 /end CHARACTERISTIC
/begin CHARACTERISTIC xcwCARCS_P "DIAG Steigung CAN - CARB-Pedalwert-Umrechnung" VALUE 0xF8DFA MSA15_FW4 0 UMR_FAKT -32.000000 31.999020 /end CHARACTERISTIC
/begin CHARACTERISTIC xcwCARCS_T "DIAG Steigung CAN - CARB-Temperatur-Umrechnung" VALUE 0xF8DBE MSA15_FW4 0 UMR_FAKT -32.000000 31.999020 /end CHARACTERISTIC
/begin CHARACTERISTIC xcwCARCS_V "DIAG Steigung CAN - CARB-Geschwindigkeit-Umrechnung" VALUE 0xF8DE2 MSA15_FW4 0 UMR_FAKT -32.000000 31.999020 /end CHARACTERISTIC
/begin CHARACTERISTIC xcwCARCS_Z "DIAG Steigung CAN - 100ms Ticks-Umrechnung" VALUE 0xF8DA6 MSA15_FW4 0 UMR_FAKT -32.000000 31.999020 /end CHARACTERISTIC
/begin CHARACTERISTIC xcwCARCSdT "DIAG Steigung CAN - Temperaturdifferenz" VALUE 0xF8DB2 MSA15_FW4 0 UMR_FAKT -32.000000 31.999020 /end CHARACTERISTIC
/begin CHARACTERISTIC xcwCARDO_D "DIAG Offset   DIA - CARB-Druck-Umrechnung" VALUE 0xF8DC8 MSA15_FW4 0 DEZ_DW -32768.000000 32767.000000 /end CHARACTERISTIC
/begin CHARACTERISTIC xcwCARDO_L "DIAG Offset   DIA - CARB-Luftmassen-Umrechnung" VALUE 0xF8DEC MSA15_FW4 0 DEZ_DW -32768.000000 32767.000000 /end CHARACTERISTIC
/begin CHARACTERISTIC xcwCARDO_N "DIAG Offset   DIA - CARB-Drehzahl-Umrechnung" VALUE 0xF8DD4 MSA15_FW4 0 DEZ_DW -32768.000000 32767.000000 /end CHARACTERISTIC
/begin CHARACTERISTIC xcwCARDO_P "DIAG Offset   DIA - CARB-Pedalwert-Umrechnung" VALUE 0xF8DF8 MSA15_FW4 0 DEZ_DW -32768.000000 32767.000000 /end CHARACTERISTIC
/begin CHARACTERISTIC xcwCARDO_T "DIAG Offset   DIA - CARB-Temperatur-Umrechnung" VALUE 0xF8DBC MSA15_FW4 0 DEZ_DW -32768.000000 32767.000000 /end CHARACTERISTIC
/begin CHARACTERISTIC xcwCARDO_V "DIAG Offset   DIA - CARB-Geschwindigkeit-Umrechnung" VALUE 0xF8DE0 MSA15_FW4 0 DEZ_DW -32768.000000 32767.000000 /end CHARACTERISTIC
/begin CHARACTERISTIC xcwCARDO_Z "DIAG Offset   DIA - 100ms Ticks-Umrechnung" VALUE 0xF8DA4 MSA15_FW4 0 DEZ_DW -32768.000000 32767.000000 /end CHARACTERISTIC
/begin CHARACTERISTIC xcwCARDOdT "DIAG Offset   DIA - Temperaturdifferenz" VALUE 0xF8DB0 MSA15_FW4 0 DEZ_DW -32768.000000 32767.000000 /end CHARACTERISTIC
/begin CHARACTERISTIC xcwCARDS_D "DIAG Steigung DIA - CARB-Druck-Umrechnung" VALUE 0xF8DC6 MSA15_FW4 0 UMR_FAKT -32.000000 31.999020 /end CHARACTERISTIC
/begin CHARACTERISTIC xcwCARDS_L "DIAG Steigung DIA - CARB-Luftmassen-Umrechnung" VALUE 0xF8DEA MSA15_FW4 0 UMR_FAKT -32.000000 31.999020 /end CHARACTERISTIC
/begin CHARACTERISTIC xcwCARDS_N "DIAG Steigung DIA - CARB-Drehzahl-Umrechnung" VALUE 0xF8DD2 MSA15_FW4 0 UMR_FAKT -32.000000 31.999020 /end CHARACTERISTIC
/begin CHARACTERISTIC xcwCARDS_P "DIAG Steigung DIA - CARB-Pedalwert-Umrechnung" VALUE 0xF8DF6 MSA15_FW4 0 UMR_FAKT -32.000000 31.999020 /end CHARACTERISTIC
/begin CHARACTERISTIC xcwCARDS_T "DIAG Steigung DIA - CARB-Temperatur-Umrechnung" VALUE 0xF8DBA MSA15_FW4 0 UMR_FAKT -32.000000 31.999020 /end CHARACTERISTIC
/begin CHARACTERISTIC xcwCARDS_V "DIAG Steigung DIA - CARB-Geschwindigkeit-Umrechnung" VALUE 0xF8DDE MSA15_FW4 0 UMR_FAKT -32.000000 31.999020 /end CHARACTERISTIC
/begin CHARACTERISTIC xcwCARDS_Z "DIAG Steigung DIA - 100ms Ticks-Umrechnung" VALUE 0xF8DA2 MSA15_FW4 0 UMR_FAKT -32.000000 31.999020 /end CHARACTERISTIC
/begin CHARACTERISTIC xcwCARDSdT "DIAG Steigung DIA - Temperaturdifferenz" VALUE 0xF8DAE MSA15_FW4 0 UMR_FAKT -32.000000 31.999020 /end CHARACTERISTIC
/begin CHARACTERISTIC xcwCARFO_D "DIAG Offset   FSP - CARB-Druck-Umrechnung" VALUE 0xF8DC4 MSA15_FW4 0 DEZ_DW -32768.000000 32767.000000 /end CHARACTERISTIC
/begin CHARACTERISTIC xcwCARFO_L "DIAG Offset   FSP - CARB-Luftmassen-Umrechnung" VALUE 0xF8DE8 MSA15_FW4 0 DEZ_DW -32768.000000 32767.000000 /end CHARACTERISTIC
/begin CHARACTERISTIC xcwCARFO_N "DIAG Offset   FSP - CARB-Drehzahl-Umrechnung" VALUE 0xF8DD0 MSA15_FW4 0 DEZ_DW -32768.000000 32767.000000 /end CHARACTERISTIC
/begin CHARACTERISTIC xcwCARFO_P "DIAG Offset   FSP - CARB-Pedalwert-Umrechnung" VALUE 0xF8DF4 MSA15_FW4 0 DEZ_DW -32768.000000 32767.000000 /end CHARACTERISTIC
/begin CHARACTERISTIC xcwCARFO_T "DIAG Offset   FSP - CARB-Temperatur-Umrechnung" VALUE 0xF8DB8 MSA15_FW4 0 DEZ_DW -32768.000000 32767.000000 /end CHARACTERISTIC
/begin CHARACTERISTIC xcwCARFO_V "DIAG Offset   FSP - CARB-Geschwindigkeits-Umrechnung" VALUE 0xF8DDC MSA15_FW4 0 DEZ_DW -32768.000000 32767.000000 /end CHARACTERISTIC
/begin CHARACTERISTIC xcwCARFO_Z "DIAG Offset   FSP - 100ms Ticks-Umrechnung" VALUE 0xF8DA0 MSA15_FW4 0 DEZ_DW -32768.000000 32767.000000 /end CHARACTERISTIC
/begin CHARACTERISTIC xcwCARFOdT "DIAG Offset   FSP - Temperaturdifferenz" VALUE 0xF8DAC MSA15_FW4 0 DEZ_DW -32768.000000 32767.000000 /end CHARACTERISTIC
/begin CHARACTERISTIC xcwCARFS_D "DIAG Steigung FSP - CARB-Druck-Umrechnung" VALUE 0xF8DC2 MSA15_FW4 0 UMR_FAKT -32.000000 31.999020 /end CHARACTERISTIC
/begin CHARACTERISTIC xcwCARFS_L "DIAG Steigung FSP - CARB-Luftmassen-Umrechnung" VALUE 0xF8DE6 MSA15_FW4 0 UMR_FAKT -32.000000 31.999020 /end CHARACTERISTIC
/begin CHARACTERISTIC xcwCARFS_N "DIAG Steigung FSP - CARB-Drehzahl-Umrechnung" VALUE 0xF8DCE MSA15_FW4 0 UMR_FAKT -32.000000 31.999020 /end CHARACTERISTIC
/begin CHARACTERISTIC xcwCARFS_P "DIAG Steigung FSP - CARB-Pedalwert-Umrechnung" VALUE 0xF8DF2 MSA15_FW4 0 UMR_FAKT -32.000000 31.999020 /end CHARACTERISTIC
/begin CHARACTERISTIC xcwCARFS_T "DIAG Steigung FSP - CARB-Temperatur-Umrechnung" VALUE 0xF8DB6 MSA15_FW4 0 UMR_FAKT -32.000000 31.999020 /end CHARACTERISTIC
/begin CHARACTERISTIC xcwCARFS_V "DIAG Steigung FSP - CARB-Geschwindigkeits-Umrechnung" VALUE 0xF8DDA MSA15_FW4 0 UMR_FAKT -32.000000 31.999020 /end CHARACTERISTIC
/begin CHARACTERISTIC xcwCARFS_Z "DIAG Steigung FSP - 100ms Ticks-Umrechnung" VALUE 0xF8D9E MSA15_FW4 0 UMR_FAKT -32.000000 31.999020 /end CHARACTERISTIC
/begin CHARACTERISTIC xcwCARFSdT "DIAG Steigung FSP - Temperaturdifferenz" VALUE 0xF8DAA MSA15_FW4 0 UMR_FAKT -32.000000 31.999020 /end CHARACTERISTIC
/begin CHARACTERISTIC xcwD20_E1 "DIAG Datenpaket 20 - 1. Message fuer SID 21" VALUE 0xF8E0A MSA15_FW3 0 DEZ_DW_U 0.000000 65535.000000 /end CHARACTERISTIC
/begin CHARACTERISTIC xcwD20_E10 "DIAG Datenpaket 20 - 10.Message fuer SID 21" VALUE 0xF8E1C MSA15_FW3 0 DEZ_DW_U 0.000000 65535.000000 /end CHARACTERISTIC
/begin CHARACTERISTIC xcwD20_E2 "DIAG Datenpaket 20 - 2. Message fuer SID 21" VALUE 0xF8E0C MSA15_FW3 0 DEZ_DW_U 0.000000 65535.000000 /end CHARACTERISTIC
/begin CHARACTERISTIC xcwD20_E3 "DIAG Datenpaket 20 - 3. Message fuer SID 21" VALUE 0xF8E0E MSA15_FW3 0 DEZ_DW_U 0.000000 65535.000000 /end CHARACTERISTIC
/begin CHARACTERISTIC xcwD20_E4 "DIAG Datenpaket 20 - 4. Message fuer SID 21" VALUE 0xF8E10 MSA15_FW3 0 DEZ_DW_U 0.000000 65535.000000 /end CHARACTERISTIC
/begin CHARACTERISTIC xcwD20_E5 "DIAG Datenpaket 20 - 5. Message fuer SID 21" VALUE 0xF8E12 MSA15_FW3 0 DEZ_DW_U 0.000000 65535.000000 /end CHARACTERISTIC
/begin CHARACTERISTIC xcwD20_E6 "DIAG Datenpaket 20 - 6. Message fuer SID 21" VALUE 0xF8E14 MSA15_FW3 0 DEZ_DW_U 0.000000 65535.000000 /end CHARACTERISTIC
/begin CHARACTERISTIC xcwD20_E7 "DIAG Datenpaket 20 - 7. Message fuer SID 21" VALUE 0xF8E16 MSA15_FW3 0 DEZ_DW_U 0.000000 65535.000000 /end CHARACTERISTIC
/begin CHARACTERISTIC xcwD20_E8 "DIAG Datenpaket 20 - 8. Message fuer SID 21" VALUE 0xF8E18 MSA15_FW3 0 DEZ_DW_U 0.000000 65535.000000 /end CHARACTERISTIC
/begin CHARACTERISTIC xcwD20_E9 "DIAG Datenpaket 20 - 9. Message fuer SID 21" VALUE 0xF8E1A MSA15_FW3 0 DEZ_DW_U 0.000000 65535.000000 /end CHARACTERISTIC
/begin CHARACTERISTIC xcwD21_E1 "DIAG Datenpaket 21 - 1. Message fuer SID 21" VALUE 0xF8E1E MSA15_FW3 0 DEZ_DW_U 0.000000 65535.000000 /end CHARACTERISTIC
/begin CHARACTERISTIC xcwD21_E10 "DIAG Datenpaket 21 - 10.Message fuer SID 21" VALUE 0xF8E30 MSA15_FW3 0 DEZ_DW_U 0.000000 65535.000000 /end CHARACTERISTIC
/begin CHARACTERISTIC xcwD21_E2 "DIAG Datenpaket 21 - 2. Message fuer SID 21" VALUE 0xF8E20 MSA15_FW3 0 DEZ_DW_U 0.000000 65535.000000 /end CHARACTERISTIC
/begin CHARACTERISTIC xcwD21_E3 "DIAG Datenpaket 21 - 3. Message fuer SID 21" VALUE 0xF8E22 MSA15_FW3 0 DEZ_DW_U 0.000000 65535.000000 /end CHARACTERISTIC
/begin CHARACTERISTIC xcwD21_E4 "DIAG Datenpaket 21 - 4. Message fuer SID 21" VALUE 0xF8E24 MSA15_FW3 0 DEZ_DW_U 0.000000 65535.000000 /end CHARACTERISTIC
/begin CHARACTERISTIC xcwD21_E5 "DIAG Datenpaket 21 - 5. Message fuer SID 21" VALUE 0xF8E26 MSA15_FW3 0 DEZ_DW_U 0.000000 65535.000000 /end CHARACTERISTIC
/begin CHARACTERISTIC xcwD21_E6 "DIAG Datenpaket 21 - 6. Message fuer SID 21" VALUE 0xF8E28 MSA15_FW3 0 DEZ_DW_U 0.000000 65535.000000 /end CHARACTERISTIC
/begin CHARACTERISTIC xcwD21_E7 "DIAG Datenpaket 21 - 7. Message fuer SID 21" VALUE 0xF8E2A MSA15_FW3 0 DEZ_DW_U 0.000000 65535.000000 /end CHARACTERISTIC
/begin CHARACTERISTIC xcwD21_E8 "DIAG Datenpaket 21 - 8. Message fuer SID 21" VALUE 0xF8E2C MSA15_FW3 0 DEZ_DW_U 0.000000 65535.000000 /end CHARACTERISTIC
/begin CHARACTERISTIC xcwD21_E9 "DIAG Datenpaket 21 - 9. Message fuer SID 21" VALUE 0xF8E2E MSA15_FW3 0 DEZ_DW_U 0.000000 65535.000000 /end CHARACTERISTIC
/begin CHARACTERISTIC xcwD22_E1 "DIAG Datenpaket 22 - 1. Message fuer SID 21" VALUE 0xF8E32 MSA15_FW3 0 DEZ_DW_U 0.000000 65535.000000 /end CHARACTERISTIC
/begin CHARACTERISTIC xcwD22_E10 "DIAG Datenpaket 22 - 10.Message fuer SID 21" VALUE 0xF8E44 MSA15_FW3 0 DEZ_DW_U 0.000000 65535.000000 /end CHARACTERISTIC
/begin CHARACTERISTIC xcwD22_E2 "DIAG Datenpaket 22 - 2. Message fuer SID 21" VALUE 0xF8E34 MSA15_FW3 0 DEZ_DW_U 0.000000 65535.000000 /end CHARACTERISTIC
/begin CHARACTERISTIC xcwD22_E3 "DIAG Datenpaket 22 - 3. Message fuer SID 21" VALUE 0xF8E36 MSA15_FW3 0 DEZ_DW_U 0.000000 65535.000000 /end CHARACTERISTIC
/begin CHARACTERISTIC xcwD22_E4 "DIAG Datenpaket 22 - 4. Message fuer SID 21" VALUE 0xF8E38 MSA15_FW3 0 DEZ_DW_U 0.000000 65535.000000 /end CHARACTERISTIC
/begin CHARACTERISTIC xcwD22_E5 "DIAG Datenpaket 22 - 5. Message fuer SID 21" VALUE 0xF8E3A MSA15_FW3 0 DEZ_DW_U 0.000000 65535.000000 /end CHARACTERISTIC
/begin CHARACTERISTIC xcwD22_E6 "DIAG Datenpaket 22 - 6. Message fuer SID 21" VALUE 0xF8E3C MSA15_FW3 0 DEZ_DW_U 0.000000 65535.000000 /end CHARACTERISTIC
/begin CHARACTERISTIC xcwD22_E7 "DIAG Datenpaket 22 - 7. Message fuer SID 21" VALUE 0xF8E3E MSA15_FW3 0 DEZ_DW_U 0.000000 65535.000000 /end CHARACTERISTIC
/begin CHARACTERISTIC xcwD22_E8 "DIAG Datenpaket 22 - 8. Message fuer SID 21" VALUE 0xF8E40 MSA15_FW3 0 DEZ_DW_U 0.000000 65535.000000 /end CHARACTERISTIC
/begin CHARACTERISTIC xcwD22_E9 "DIAG Datenpaket 22 - 9. Message fuer SID 21" VALUE 0xF8E42 MSA15_FW3 0 DEZ_DW_U 0.000000 65535.000000 /end CHARACTERISTIC
/begin CHARACTERISTIC xcwD23_E1 "DIAG Datenpaket 23 - 1. Message fuer SID 21" VALUE 0xF8E46 MSA15_FW3 0 DEZ_DW_U 0.000000 65535.000000 /end CHARACTERISTIC
/begin CHARACTERISTIC xcwD23_E10 "DIAG Datenpaket 23 - 10.Message fuer SID 21" VALUE 0xF8E58 MSA15_FW3 0 DEZ_DW_U 0.000000 65535.000000 /end CHARACTERISTIC
/begin CHARACTERISTIC xcwD23_E2 "DIAG Datenpaket 23 - 2. Message fuer SID 21" VALUE 0xF8E48 MSA15_FW3 0 DEZ_DW_U 0.000000 65535.000000 /end CHARACTERISTIC
/begin CHARACTERISTIC xcwD23_E3 "DIAG Datenpaket 23 - 3. Message fuer SID 21" VALUE 0xF8E4A MSA15_FW3 0 DEZ_DW_U 0.000000 65535.000000 /end CHARACTERISTIC
/begin CHARACTERISTIC xcwD23_E4 "DIAG Datenpaket 23 - 4. Message fuer SID 21" VALUE 0xF8E4C MSA15_FW3 0 DEZ_DW_U 0.000000 65535.000000 /end CHARACTERISTIC
/begin CHARACTERISTIC xcwD23_E5 "DIAG Datenpaket 23 - 5. Message fuer SID 21" VALUE 0xF8E4E MSA15_FW3 0 DEZ_DW_U 0.000000 65535.000000 /end CHARACTERISTIC
/begin CHARACTERISTIC xcwD23_E6 "DIAG Datenpaket 23 - 6. Message fuer SID 21" VALUE 0xF8E50 MSA15_FW3 0 DEZ_DW_U 0.000000 65535.000000 /end CHARACTERISTIC
/begin CHARACTERISTIC xcwD23_E7 "DIAG Datenpaket 23 - 7. Message fuer SID 21" VALUE 0xF8E52 MSA15_FW3 0 DEZ_DW_U 0.000000 65535.000000 /end CHARACTERISTIC
/begin CHARACTERISTIC xcwD23_E8 "DIAG Datenpaket 23 - 8. Message fuer SID 21" VALUE 0xF8E54 MSA15_FW3 0 DEZ_DW_U 0.000000 65535.000000 /end CHARACTERISTIC
/begin CHARACTERISTIC xcwD23_E9 "DIAG Datenpaket 23 - 9. Message fuer SID 21" VALUE 0xF8E56 MSA15_FW3 0 DEZ_DW_U 0.000000 65535.000000 /end CHARACTERISTIC
/begin CHARACTERISTIC xcwD24_E1 "DIAG Datenpaket 24 - 1. Message fuer SID 21" VALUE 0xF8E5A MSA15_FW3 0 DEZ_DW_U 0.000000 65535.000000 /end CHARACTERISTIC
/begin CHARACTERISTIC xcwD24_E10 "DIAG Datenpaket 24 - 10.Message fuer SID 21" VALUE 0xF8E6C MSA15_FW3 0 DEZ_DW_U 0.000000 65535.000000 /end CHARACTERISTIC
/begin CHARACTERISTIC xcwD24_E2 "DIAG Datenpaket 24 - 2. Message fuer SID 21" VALUE 0xF8E5C MSA15_FW3 0 DEZ_DW_U 0.000000 65535.000000 /end CHARACTERISTIC
/begin CHARACTERISTIC xcwD24_E3 "DIAG Datenpaket 24 - 3. Message fuer SID 21" VALUE 0xF8E5E MSA15_FW3 0 DEZ_DW_U 0.000000 65535.000000 /end CHARACTERISTIC
/begin CHARACTERISTIC xcwD24_E4 "DIAG Datenpaket 24 - 4. Message fuer SID 21" VALUE 0xF8E60 MSA15_FW3 0 DEZ_DW_U 0.000000 65535.000000 /end CHARACTERISTIC
/begin CHARACTERISTIC xcwD24_E5 "DIAG Datenpaket 24 - 5. Message fuer SID 21" VALUE 0xF8E62 MSA15_FW3 0 DEZ_DW_U 0.000000 65535.000000 /end CHARACTERISTIC
/begin CHARACTERISTIC xcwD24_E6 "DIAG Datenpaket 24 - 6. Message fuer SID 21" VALUE 0xF8E64 MSA15_FW3 0 DEZ_DW_U 0.000000 65535.000000 /end CHARACTERISTIC
/begin CHARACTERISTIC xcwD24_E7 "DIAG Datenpaket 24 - 7. Message fuer SID 21" VALUE 0xF8E66 MSA15_FW3 0 DEZ_DW_U 0.000000 65535.000000 /end CHARACTERISTIC
/begin CHARACTERISTIC xcwD24_E8 "DIAG Datenpaket 24 - 8. Message fuer SID 21" VALUE 0xF8E68 MSA15_FW3 0 DEZ_DW_U 0.000000 65535.000000 /end CHARACTERISTIC
/begin CHARACTERISTIC xcwD24_E9 "DIAG Datenpaket 24 - 9. Message fuer SID 21" VALUE 0xF8E6A MSA15_FW3 0 DEZ_DW_U 0.000000 65535.000000 /end CHARACTERISTIC
/begin CHARACTERISTIC xcwD25_E1 "DIAG Datenpaket 25 - 1. Message fuer SID 21" VALUE 0xF8E6E MSA15_FW3 0 DEZ_DW_U 0.000000 65535.000000 /end CHARACTERISTIC
/begin CHARACTERISTIC xcwD25_E10 "DIAG Datenpaket 25 - 10.Message fuer SID 21" VALUE 0xF8E80 MSA15_FW3 0 DEZ_DW_U 0.000000 65535.000000 /end CHARACTERISTIC
/begin CHARACTERISTIC xcwD25_E2 "DIAG Datenpaket 25 - 2. Message fuer SID 21" VALUE 0xF8E70 MSA15_FW3 0 DEZ_DW_U 0.000000 65535.000000 /end CHARACTERISTIC
/begin CHARACTERISTIC xcwD25_E3 "DIAG Datenpaket 25 - 3. Message fuer SID 21" VALUE 0xF8E72 MSA15_FW3 0 DEZ_DW_U 0.000000 65535.000000 /end CHARACTERISTIC
/begin CHARACTERISTIC xcwD25_E4 "DIAG Datenpaket 25 - 4. Message fuer SID 21" VALUE 0xF8E74 MSA15_FW3 0 DEZ_DW_U 0.000000 65535.000000 /end CHARACTERISTIC
/begin CHARACTERISTIC xcwD25_E5 "DIAG Datenpaket 25 - 5. Message fuer SID 21" VALUE 0xF8E76 MSA15_FW3 0 DEZ_DW_U 0.000000 65535.000000 /end CHARACTERISTIC
/begin CHARACTERISTIC xcwD25_E6 "DIAG Datenpaket 25 - 6. Message fuer SID 21" VALUE 0xF8E78 MSA15_FW3 0 DEZ_DW_U 0.000000 65535.000000 /end CHARACTERISTIC
/begin CHARACTERISTIC xcwD25_E7 "DIAG Datenpaket 25 - 7. Message fuer SID 21" VALUE 0xF8E7A MSA15_FW3 0 DEZ_DW_U 0.000000 65535.000000 /end CHARACTERISTIC
/begin CHARACTERISTIC xcwD25_E8 "DIAG Datenpaket 25 - 8. Message fuer SID 21" VALUE 0xF8E7C MSA15_FW3 0 DEZ_DW_U 0.000000 65535.000000 /end CHARACTERISTIC
/begin CHARACTERISTIC xcwD25_E9 "DIAG Datenpaket 25 - 9. Message fuer SID 21" VALUE 0xF8E7E MSA15_FW3 0 DEZ_DW_U 0.000000 65535.000000 /end CHARACTERISTIC
/begin CHARACTERISTIC xcwD26_E1 "DIAG Datenpaket 26 - 1. Message fuer SID 21" VALUE 0xF8E82 MSA15_FW3 0 DEZ_DW_U 0.000000 65535.000000 /end CHARACTERISTIC
/begin CHARACTERISTIC xcwD26_E10 "DIAG Datenpaket 26 - 10.Message fuer SID 21" VALUE 0xF8E94 MSA15_FW3 0 DEZ_DW_U 0.000000 65535.000000 /end CHARACTERISTIC
/begin CHARACTERISTIC xcwD26_E2 "DIAG Datenpaket 26 - 2. Message fuer SID 21" VALUE 0xF8E84 MSA15_FW3 0 DEZ_DW_U 0.000000 65535.000000 /end CHARACTERISTIC
/begin CHARACTERISTIC xcwD26_E3 "DIAG Datenpaket 26 - 3. Message fuer SID 21" VALUE 0xF8E86 MSA15_FW3 0 DEZ_DW_U 0.000000 65535.000000 /end CHARACTERISTIC
/begin CHARACTERISTIC xcwD26_E4 "DIAG Datenpaket 26 - 4. Message fuer SID 21" VALUE 0xF8E88 MSA15_FW3 0 DEZ_DW_U 0.000000 65535.000000 /end CHARACTERISTIC
/begin CHARACTERISTIC xcwD26_E5 "DIAG Datenpaket 26 - 5. Message fuer SID 21" VALUE 0xF8E8A MSA15_FW3 0 DEZ_DW_U 0.000000 65535.000000 /end CHARACTERISTIC
/begin CHARACTERISTIC xcwD26_E6 "DIAG Datenpaket 26 - 6. Message fuer SID 21" VALUE 0xF8E8C MSA15_FW3 0 DEZ_DW_U 0.000000 65535.000000 /end CHARACTERISTIC
/begin CHARACTERISTIC xcwD26_E7 "DIAG Datenpaket 26 - 7. Message fuer SID 21" VALUE 0xF8E8E MSA15_FW3 0 DEZ_DW_U 0.000000 65535.000000 /end CHARACTERISTIC
/begin CHARACTERISTIC xcwD26_E8 "DIAG Datenpaket 26 - 8. Message fuer SID 21" VALUE 0xF8E90 MSA15_FW3 0 DEZ_DW_U 0.000000 65535.000000 /end CHARACTERISTIC
/begin CHARACTERISTIC xcwD26_E9 "DIAG Datenpaket 26 - 9. Message fuer SID 21" VALUE 0xF8E92 MSA15_FW3 0 DEZ_DW_U 0.000000 65535.000000 /end CHARACTERISTIC
/begin CHARACTERISTIC xcwD27_E1 "DIAG Datenpaket 27 - 1. Message fuer SID 21" VALUE 0xF8E96 MSA15_FW3 0 DEZ_DW_U 0.000000 65535.000000 /end CHARACTERISTIC
/begin CHARACTERISTIC xcwD27_E10 "DIAG Datenpaket 27 - 10.Message fuer SID 21" VALUE 0xF8EA8 MSA15_FW3 0 DEZ_DW_U 0.000000 65535.000000 /end CHARACTERISTIC
/begin CHARACTERISTIC xcwD27_E2 "DIAG Datenpaket 27 - 2. Message fuer SID 21" VALUE 0xF8E98 MSA15_FW3 0 DEZ_DW_U 0.000000 65535.000000 /end CHARACTERISTIC
/begin CHARACTERISTIC xcwD27_E3 "DIAG Datenpaket 27 - 3. Message fuer SID 21" VALUE 0xF8E9A MSA15_FW3 0 DEZ_DW_U 0.000000 65535.000000 /end CHARACTERISTIC
/begin CHARACTERISTIC xcwD27_E4 "DIAG Datenpaket 27 - 4. Message fuer SID 21" VALUE 0xF8E9C MSA15_FW3 0 DEZ_DW_U 0.000000 65535.000000 /end CHARACTERISTIC
/begin CHARACTERISTIC xcwD27_E5 "DIAG Datenpaket 27 - 5. Message fuer SID 21" VALUE 0xF8E9E MSA15_FW3 0 DEZ_DW_U 0.000000 65535.000000 /end CHARACTERISTIC
/begin CHARACTERISTIC xcwD27_E6 "DIAG Datenpaket 27 - 6. Message fuer SID 21" VALUE 0xF8EA0 MSA15_FW3 0 DEZ_DW_U 0.000000 65535.000000 /end CHARACTERISTIC
/begin CHARACTERISTIC xcwD27_E7 "DIAG Datenpaket 27 - 7. Message fuer SID 21" VALUE 0xF8EA2 MSA15_FW3 0 DEZ_DW_U 0.000000 65535.000000 /end CHARACTERISTIC
/begin CHARACTERISTIC xcwD27_E8 "DIAG Datenpaket 27 - 8. Message fuer SID 21" VALUE 0xF8EA4 MSA15_FW3 0 DEZ_DW_U 0.000000 65535.000000 /end CHARACTERISTIC
/begin CHARACTERISTIC xcwD27_E9 "DIAG Datenpaket 27 - 9. Message fuer SID 21" VALUE 0xF8EA6 MSA15_FW3 0 DEZ_DW_U 0.000000 65535.000000 /end CHARACTERISTIC
/begin CHARACTERISTIC xcwD28_E1 "DIAG Datenpaket 28 - 1. Message fuer SID 21" VALUE 0xF8EAA MSA15_FW3 0 DEZ_DW_U 0.000000 65535.000000 /end CHARACTERISTIC
/begin CHARACTERISTIC xcwD28_E10 "DIAG Datenpaket 28 - 10.Message fuer SID 21" VALUE 0xF8EBC MSA15_FW3 0 DEZ_DW_U 0.000000 65535.000000 /end CHARACTERISTIC
/begin CHARACTERISTIC xcwD28_E2 "DIAG Datenpaket 28 - 2. Message fuer SID 21" VALUE 0xF8EAC MSA15_FW3 0 DEZ_DW_U 0.000000 65535.000000 /end CHARACTERISTIC
/begin CHARACTERISTIC xcwD28_E3 "DIAG Datenpaket 28 - 3. Message fuer SID 21" VALUE 0xF8EAE MSA15_FW3 0 DEZ_DW_U 0.000000 65535.000000 /end CHARACTERISTIC
/begin CHARACTERISTIC xcwD28_E4 "DIAG Datenpaket 28 - 4. Message fuer SID 21" VALUE 0xF8EB0 MSA15_FW3 0 DEZ_DW_U 0.000000 65535.000000 /end CHARACTERISTIC
/begin CHARACTERISTIC xcwD28_E5 "DIAG Datenpaket 28 - 5. Message fuer SID 21" VALUE 0xF8EB2 MSA15_FW3 0 DEZ_DW_U 0.000000 65535.000000 /end CHARACTERISTIC
/begin CHARACTERISTIC xcwD28_E6 "DIAG Datenpaket 28 - 6. Message fuer SID 21" VALUE 0xF8EB4 MSA15_FW3 0 DEZ_DW_U 0.000000 65535.000000 /end CHARACTERISTIC
/begin CHARACTERISTIC xcwD28_E7 "DIAG Datenpaket 28 - 7. Message fuer SID 21" VALUE 0xF8EB6 MSA15_FW3 0 DEZ_DW_U 0.000000 65535.000000 /end CHARACTERISTIC
/begin CHARACTERISTIC xcwD28_E8 "DIAG Datenpaket 28 - 8. Message fuer SID 21" VALUE 0xF8EB8 MSA15_FW3 0 DEZ_DW_U 0.000000 65535.000000 /end CHARACTERISTIC
/begin CHARACTERISTIC xcwD28_E9 "DIAG Datenpaket 28 - 9. Message fuer SID 21" VALUE 0xF8EBA MSA15_FW3 0 DEZ_DW_U 0.000000 65535.000000 /end CHARACTERISTIC
/begin CHARACTERISTIC xcwD29_E1 "DIAG Datenpaket 29 - 1. Message fuer SID 21" VALUE 0xF8EBE MSA15_FW3 0 DEZ_DW_U 0.000000 65535.000000 /end CHARACTERISTIC
/begin CHARACTERISTIC xcwD29_E10 "DIAG Datenpaket 29 - 10.Message fuer SID 21" VALUE 0xF8ED0 MSA15_FW3 0 DEZ_DW_U 0.000000 65535.000000 /end CHARACTERISTIC
/begin CHARACTERISTIC xcwD29_E2 "DIAG Datenpaket 29 - 2. Message fuer SID 21" VALUE 0xF8EC0 MSA15_FW3 0 DEZ_DW_U 0.000000 65535.000000 /end CHARACTERISTIC
/begin CHARACTERISTIC xcwD29_E3 "DIAG Datenpaket 29 - 3. Message fuer SID 21" VALUE 0xF8EC2 MSA15_FW3 0 DEZ_DW_U 0.000000 65535.000000 /end CHARACTERISTIC
/begin CHARACTERISTIC xcwD29_E4 "DIAG Datenpaket 29 - 4. Message fuer SID 21" VALUE 0xF8EC4 MSA15_FW3 0 DEZ_DW_U 0.000000 65535.000000 /end CHARACTERISTIC
/begin CHARACTERISTIC xcwD29_E5 "DIAG Datenpaket 29 - 5. Message fuer SID 21" VALUE 0xF8EC6 MSA15_FW3 0 DEZ_DW_U 0.000000 65535.000000 /end CHARACTERISTIC
/begin CHARACTERISTIC xcwD29_E6 "DIAG Datenpaket 29 - 6. Message fuer SID 21" VALUE 0xF8EC8 MSA15_FW3 0 DEZ_DW_U 0.000000 65535.000000 /end CHARACTERISTIC
/begin CHARACTERISTIC xcwD29_E7 "DIAG Datenpaket 29 - 7. Message fuer SID 21" VALUE 0xF8ECA MSA15_FW3 0 DEZ_DW_U 0.000000 65535.000000 /end CHARACTERISTIC
/begin CHARACTERISTIC xcwD29_E8 "DIAG Datenpaket 29 - 8. Message fuer SID 21" VALUE 0xF8ECC MSA15_FW3 0 DEZ_DW_U 0.000000 65535.000000 /end CHARACTERISTIC
/begin CHARACTERISTIC xcwD29_E9 "DIAG Datenpaket 29 - 9. Message fuer SID 21" VALUE 0xF8ECE MSA15_FW3 0 DEZ_DW_U 0.000000 65535.000000 /end CHARACTERISTIC
/begin CHARACTERISTIC xcwD2A_E1 "DIAG Datenpaket 2A - 1. Message fuer SID 21" VALUE 0xF8ED2 MSA15_FW3 0 DEZ_DW_U 0.000000 65535.000000 /end CHARACTERISTIC
/begin CHARACTERISTIC xcwD2A_E10 "DIAG Datenpaket 2A - 10.Message fuer SID 21" VALUE 0xF8EE4 MSA15_FW3 0 DEZ_DW_U 0.000000 65535.000000 /end CHARACTERISTIC
/begin CHARACTERISTIC xcwD2A_E2 "DIAG Datenpaket 2A - 2. Message fuer SID 21" VALUE 0xF8ED4 MSA15_FW3 0 DEZ_DW_U 0.000000 65535.000000 /end CHARACTERISTIC
/begin CHARACTERISTIC xcwD2A_E3 "DIAG Datenpaket 2A - 3. Message fuer SID 21" VALUE 0xF8ED6 MSA15_FW3 0 DEZ_DW_U 0.000000 65535.000000 /end CHARACTERISTIC
/begin CHARACTERISTIC xcwD2A_E4 "DIAG Datenpaket 2A - 4. Message fuer SID 21" VALUE 0xF8ED8 MSA15_FW3 0 DEZ_DW_U 0.000000 65535.000000 /end CHARACTERISTIC
/begin CHARACTERISTIC xcwD2A_E5 "DIAG Datenpaket 2A - 5. Message fuer SID 21" VALUE 0xF8EDA MSA15_FW3 0 DEZ_DW_U 0.000000 65535.000000 /end CHARACTERISTIC
/begin CHARACTERISTIC xcwD2A_E6 "DIAG Datenpaket 2A - 6. Message fuer SID 21" VALUE 0xF8EDC MSA15_FW3 0 DEZ_DW_U 0.000000 65535.000000 /end CHARACTERISTIC
/begin CHARACTERISTIC xcwD2A_E7 "DIAG Datenpaket 2A - 7. Message fuer SID 21" VALUE 0xF8EDE MSA15_FW3 0 DEZ_DW_U 0.000000 65535.000000 /end CHARACTERISTIC
/begin CHARACTERISTIC xcwD2A_E8 "DIAG Datenpaket 2A - 8. Message fuer SID 21" VALUE 0xF8EE0 MSA15_FW3 0 DEZ_DW_U 0.000000 65535.000000 /end CHARACTERISTIC
/begin CHARACTERISTIC xcwD2A_E9 "DIAG Datenpaket 2A - 9. Message fuer SID 21" VALUE 0xF8EE2 MSA15_FW3 0 DEZ_DW_U 0.000000 65535.000000 /end CHARACTERISTIC
/begin CHARACTERISTIC xcwD2B_E1 "DIAG Datenpaket 2B - 1. Message fuer SID 21" VALUE 0xF8EE6 MSA15_FW3 0 DEZ_DW_U 0.000000 65535.000000 /end CHARACTERISTIC
/begin CHARACTERISTIC xcwD2B_E10 "DIAG Datenpaket 2B - 10.Message fuer SID 21" VALUE 0xF8EF8 MSA15_FW3 0 DEZ_DW_U 0.000000 65535.000000 /end CHARACTERISTIC
/begin CHARACTERISTIC xcwD2B_E2 "DIAG Datenpaket 2B - 2. Message fuer SID 21" VALUE 0xF8EE8 MSA15_FW3 0 DEZ_DW_U 0.000000 65535.000000 /end CHARACTERISTIC
/begin CHARACTERISTIC xcwD2B_E3 "DIAG Datenpaket 2B - 3. Message fuer SID 21" VALUE 0xF8EEA MSA15_FW3 0 DEZ_DW_U 0.000000 65535.000000 /end CHARACTERISTIC
/begin CHARACTERISTIC xcwD2B_E4 "DIAG Datenpaket 2B - 4. Message fuer SID 21" VALUE 0xF8EEC MSA15_FW3 0 DEZ_DW_U 0.000000 65535.000000 /end CHARACTERISTIC
/begin CHARACTERISTIC xcwD2B_E5 "DIAG Datenpaket 2B - 5. Message fuer SID 21" VALUE 0xF8EEE MSA15_FW3 0 DEZ_DW_U 0.000000 65535.000000 /end CHARACTERISTIC
/begin CHARACTERISTIC xcwD2B_E6 "DIAG Datenpaket 2B - 6. Message fuer SID 21" VALUE 0xF8EF0 MSA15_FW3 0 DEZ_DW_U 0.000000 65535.000000 /end CHARACTERISTIC
/begin CHARACTERISTIC xcwD2B_E7 "DIAG Datenpaket 2B - 7. Message fuer SID 21" VALUE 0xF8EF2 MSA15_FW3 0 DEZ_DW_U 0.000000 65535.000000 /end CHARACTERISTIC
/begin CHARACTERISTIC xcwD2B_E8 "DIAG Datenpaket 2B - 8. Message fuer SID 21" VALUE 0xF8EF4 MSA15_FW3 0 DEZ_DW_U 0.000000 65535.000000 /end CHARACTERISTIC
/begin CHARACTERISTIC xcwD2B_E9 "DIAG Datenpaket 2B - 9. Message fuer SID 21" VALUE 0xF8EF6 MSA15_FW3 0 DEZ_DW_U 0.000000 65535.000000 /end CHARACTERISTIC
/begin CHARACTERISTIC xcwD2C_E1 "DIAG Datenpaket 2C - 1. Message fuer SID 21" VALUE 0xF8EFA MSA15_FW3 0 DEZ_DW_U 0.000000 65535.000000 /end CHARACTERISTIC
/begin CHARACTERISTIC xcwD2C_E10 "DIAG Datenpaket 2C - 10.Message fuer SID 21" VALUE 0xF8F0C MSA15_FW3 0 DEZ_DW_U 0.000000 65535.000000 /end CHARACTERISTIC
/begin CHARACTERISTIC xcwD2C_E2 "DIAG Datenpaket 2C - 2. Message fuer SID 21" VALUE 0xF8EFC MSA15_FW3 0 DEZ_DW_U 0.000000 65535.000000 /end CHARACTERISTIC
/begin CHARACTERISTIC xcwD2C_E3 "DIAG Datenpaket 2C - 3. Message fuer SID 21" VALUE 0xF8EFE MSA15_FW3 0 DEZ_DW_U 0.000000 65535.000000 /end CHARACTERISTIC
/begin CHARACTERISTIC xcwD2C_E4 "DIAG Datenpaket 2C - 4. Message fuer SID 21" VALUE 0xF8F00 MSA15_FW3 0 DEZ_DW_U 0.000000 65535.000000 /end CHARACTERISTIC
/begin CHARACTERISTIC xcwD2C_E5 "DIAG Datenpaket 2C - 5. Message fuer SID 21" VALUE 0xF8F02 MSA15_FW3 0 DEZ_DW_U 0.000000 65535.000000 /end CHARACTERISTIC
/begin CHARACTERISTIC xcwD2C_E6 "DIAG Datenpaket 2C - 6. Message fuer SID 21" VALUE 0xF8F04 MSA15_FW3 0 DEZ_DW_U 0.000000 65535.000000 /end CHARACTERISTIC
/begin CHARACTERISTIC xcwD2C_E7 "DIAG Datenpaket 2C - 7. Message fuer SID 21" VALUE 0xF8F06 MSA15_FW3 0 DEZ_DW_U 0.000000 65535.000000 /end CHARACTERISTIC
/begin CHARACTERISTIC xcwD2C_E8 "DIAG Datenpaket 2C - 8. Message fuer SID 21" VALUE 0xF8F08 MSA15_FW3 0 DEZ_DW_U 0.000000 65535.000000 /end CHARACTERISTIC
/begin CHARACTERISTIC xcwD2C_E9 "DIAG Datenpaket 2C - 9. Message fuer SID 21" VALUE 0xF8F0A MSA15_FW3 0 DEZ_DW_U 0.000000 65535.000000 /end CHARACTERISTIC
/begin CHARACTERISTIC xcwD2D_E1 "DIAG Datenpaket 2D - 1. Message fuer SID 21" VALUE 0xF8F0E MSA15_FW3 0 DEZ_DW_U 0.000000 65535.000000 /end CHARACTERISTIC
/begin CHARACTERISTIC xcwD2D_E10 "DIAG Datenpaket 2D - 10.Message fuer SID 21" VALUE 0xF8F20 MSA15_FW3 0 DEZ_DW_U 0.000000 65535.000000 /end CHARACTERISTIC
/begin CHARACTERISTIC xcwD2D_E2 "DIAG Datenpaket 2D - 2. Message fuer SID 21" VALUE 0xF8F10 MSA15_FW3 0 DEZ_DW_U 0.000000 65535.000000 /end CHARACTERISTIC
/begin CHARACTERISTIC xcwD2D_E3 "DIAG Datenpaket 2D - 3. Message fuer SID 21" VALUE 0xF8F12 MSA15_FW3 0 DEZ_DW_U 0.000000 65535.000000 /end CHARACTERISTIC
/begin CHARACTERISTIC xcwD2D_E4 "DIAG Datenpaket 2D - 4. Message fuer SID 21" VALUE 0xF8F14 MSA15_FW3 0 DEZ_DW_U 0.000000 65535.000000 /end CHARACTERISTIC
/begin CHARACTERISTIC xcwD2D_E5 "DIAG Datenpaket 2D - 5. Message fuer SID 21" VALUE 0xF8F16 MSA15_FW3 0 DEZ_DW_U 0.000000 65535.000000 /end CHARACTERISTIC
/begin CHARACTERISTIC xcwD2D_E6 "DIAG Datenpaket 2D - 6. Message fuer SID 21" VALUE 0xF8F18 MSA15_FW3 0 DEZ_DW_U 0.000000 65535.000000 /end CHARACTERISTIC
/begin CHARACTERISTIC xcwD2D_E7 "DIAG Datenpaket 2D - 7. Message fuer SID 21" VALUE 0xF8F1A MSA15_FW3 0 DEZ_DW_U 0.000000 65535.000000 /end CHARACTERISTIC
/begin CHARACTERISTIC xcwD2D_E8 "DIAG Datenpaket 2D - 8. Message fuer SID 21" VALUE 0xF8F1C MSA15_FW3 0 DEZ_DW_U 0.000000 65535.000000 /end CHARACTERISTIC
/begin CHARACTERISTIC xcwD2D_E9 "DIAG Datenpaket 2D - 9. Message fuer SID 21" VALUE 0xF8F1E MSA15_FW3 0 DEZ_DW_U 0.000000 65535.000000 /end CHARACTERISTIC
/begin CHARACTERISTIC xcwD2E_E1 "DIAG Datenpaket 2E - 1. Message fuer SID 21" VALUE 0xF8F22 MSA15_FW3 0 DEZ_DW_U 0.000000 65535.000000 /end CHARACTERISTIC
/begin CHARACTERISTIC xcwD2E_E10 "DIAG Datenpaket 2E - 10.Message fuer SID 21" VALUE 0xF8F34 MSA15_FW3 0 DEZ_DW_U 0.000000 65535.000000 /end CHARACTERISTIC
/begin CHARACTERISTIC xcwD2E_E2 "DIAG Datenpaket 2E - 2. Message fuer SID 21" VALUE 0xF8F24 MSA15_FW3 0 DEZ_DW_U 0.000000 65535.000000 /end CHARACTERISTIC
/begin CHARACTERISTIC xcwD2E_E3 "DIAG Datenpaket 2E - 3. Message fuer SID 21" VALUE 0xF8F26 MSA15_FW3 0 DEZ_DW_U 0.000000 65535.000000 /end CHARACTERISTIC
/begin CHARACTERISTIC xcwD2E_E4 "DIAG Datenpaket 2E - 4. Message fuer SID 21" VALUE 0xF8F28 MSA15_FW3 0 DEZ_DW_U 0.000000 65535.000000 /end CHARACTERISTIC
/begin CHARACTERISTIC xcwD2E_E5 "DIAG Datenpaket 2E - 5. Message fuer SID 21" VALUE 0xF8F2A MSA15_FW3 0 DEZ_DW_U 0.000000 65535.000000 /end CHARACTERISTIC
/begin CHARACTERISTIC xcwD2E_E6 "DIAG Datenpaket 2E - 6. Message fuer SID 21" VALUE 0xF8F2C MSA15_FW3 0 DEZ_DW_U 0.000000 65535.000000 /end CHARACTERISTIC
/begin CHARACTERISTIC xcwD2E_E7 "DIAG Datenpaket 2E - 7. Message fuer SID 21" VALUE 0xF8F2E MSA15_FW3 0 DEZ_DW_U 0.000000 65535.000000 /end CHARACTERISTIC
/begin CHARACTERISTIC xcwD2E_E8 "DIAG Datenpaket 2E - 8. Message fuer SID 21" VALUE 0xF8F30 MSA15_FW3 0 DEZ_DW_U 0.000000 65535.000000 /end CHARACTERISTIC
/begin CHARACTERISTIC xcwD2E_E9 "DIAG Datenpaket 2E - 9. Message fuer SID 21" VALUE 0xF8F32 MSA15_FW3 0 DEZ_DW_U 0.000000 65535.000000 /end CHARACTERISTIC
/begin CHARACTERISTIC xcwD2F_E1 "DIAG Datenpaket 2F - 1. Message fuer SID 21" VALUE 0xF8F36 MSA15_FW3 0 DEZ_DW_U 0.000000 65535.000000 /end CHARACTERISTIC
/begin CHARACTERISTIC xcwD2F_E10 "DIAG Datenpaket 2F - 10.Message fuer SID 21" VALUE 0xF8F48 MSA15_FW3 0 DEZ_DW_U 0.000000 65535.000000 /end CHARACTERISTIC
/begin CHARACTERISTIC xcwD2F_E2 "DIAG Datenpaket 2F - 2. Message fuer SID 21" VALUE 0xF8F38 MSA15_FW3 0 DEZ_DW_U 0.000000 65535.000000 /end CHARACTERISTIC
/begin CHARACTERISTIC xcwD2F_E3 "DIAG Datenpaket 2F - 3. Message fuer SID 21" VALUE 0xF8F3A MSA15_FW3 0 DEZ_DW_U 0.000000 65535.000000 /end CHARACTERISTIC
/begin CHARACTERISTIC xcwD2F_E4 "DIAG Datenpaket 2F - 4. Message fuer SID 21" VALUE 0xF8F3C MSA15_FW3 0 DEZ_DW_U 0.000000 65535.000000 /end CHARACTERISTIC
/begin CHARACTERISTIC xcwD2F_E5 "DIAG Datenpaket 2F - 5. Message fuer SID 21" VALUE 0xF8F3E MSA15_FW3 0 DEZ_DW_U 0.000000 65535.000000 /end CHARACTERISTIC
/begin CHARACTERISTIC xcwD2F_E6 "DIAG Datenpaket 2F - 6. Message fuer SID 21" VALUE 0xF8F40 MSA15_FW3 0 DEZ_DW_U 0.000000 65535.000000 /end CHARACTERISTIC
/begin CHARACTERISTIC xcwD2F_E7 "DIAG Datenpaket 2F - 7. Message fuer SID 21" VALUE 0xF8F42 MSA15_FW3 0 DEZ_DW_U 0.000000 65535.000000 /end CHARACTERISTIC
/begin CHARACTERISTIC xcwD2F_E8 "DIAG Datenpaket 2F - 8. Message fuer SID 21" VALUE 0xF8F44 MSA15_FW3 0 DEZ_DW_U 0.000000 65535.000000 /end CHARACTERISTIC
/begin CHARACTERISTIC xcwD2F_E9 "DIAG Datenpaket 2F - 9. Message fuer SID 21" VALUE 0xF8F46 MSA15_FW3 0 DEZ_DW_U 0.000000 65535.000000 /end CHARACTERISTIC
/begin CHARACTERISTIC xcwIO_Nmax "Obere Drehzahlschwelle fuer Endstufen Ansteuerung durch Diagnose" VALUE 0xF8F78 MSA15_FW4 0 N 0.000000 6000.000000 EXTENDED_LIMITS 0.000000 32767.000000 /end CHARACTERISTIC
/begin CHARACTERISTIC xcwIO_Tmax "Stellglied Ansteuerung Timeoutzeit bei KWP2000(*) Botschaftenausfall" VALUE 0xF8F76 MSA15_FW3 0 ZEIT_ST 0.000000 655350000.000000 /end CHARACTERISTIC
/begin CHARACTERISTIC xcwIO_Vmax "Obere Fahrgeschwindigkeitsschwelle fuer Endstufen Ansteuerung durch Diagnose" VALUE 0xF8F7A MSA15_FW3 0 V 0.000000 300.000000 EXTENDED_LIMITS 0.000000 327.670000 /end CHARACTERISTIC
/begin CHARACTERISTIC xcwMcM_BL "McMess Blocklaenge in Bytes" VALUE 0xF8F4C MSA15_FW3 0 DEZ_DW 0.000000 40.000000 EXTENDED_LIMITS -32768.000000 32767.000000 /end CHARACTERISTIC
/begin CHARACTERISTIC xcwMcM_ToB "McMess Timeout Messmodus" VALUE 0xF8F50 MSA15_FW3 0 ZEIT_ST 0.000000 655350000.000000 /end CHARACTERISTIC
/begin CHARACTERISTIC xcwMcM_ToM "McMess Timeout Messmodus" VALUE 0xF8F4E MSA15_FW3 0 ZEIT_T_2ms 0.000000 131070000.000000 /end CHARACTERISTIC
/begin CHARACTERISTIC xcwT_Komp "DIAG Max. moegl. Zeit fuer Injektorfehlerstest" VALUE 0xF8F7C MSA15_FW3 0 ZEIT_ST 0.000000 655350000.000000 /end CHARACTERISTIC
/begin CHARACTERISTIC xcwUMCO_BS "DIAG Offset   CAN - Betreibstundenzaehler-Umrechnung" VALUE 0xF8D60 MSA15_FW4 0 DEZ_DW -32768.000000 32767.000000 /end CHARACTERISTIC
/begin CHARACTERISTIC xcwUMCS_BS "DIAG Steigung CAN - Betreibstundenzaehler-Umrechnung" VALUE 0xF8D5E MSA15_FW4 0 UMR_FAKT -32.000000 31.999020 /end CHARACTERISTIC
/begin CHARACTERISTIC xcwUMDO_BS "DIAG Offset   DIA - Betreibstundenzaehler-Umrechnung" VALUE 0xF8D5C MSA15_FW4 0 DEZ_DW -32768.000000 32767.000000 /end CHARACTERISTIC
/begin CHARACTERISTIC xcwUMDS_BS "DIAG Steigung DIA - Betreibstundenzaehler-Umrechnung" VALUE 0xF8D5A MSA15_FW4 0 UMR_FAKT -32.000000 31.999020 /end CHARACTERISTIC
/begin CHARACTERISTIC xcwUMFO_BS "DIAG Offset   FSP - Betreibstundenzaehler Umrechnung" VALUE 0xF8D58 MSA15_FW4 0 DEZ_DW -32768.000000 32767.000000 /end CHARACTERISTIC
/begin CHARACTERISTIC xcwUMFS_BS "DIAG Steigung FSP - Betreibstundenzaehler-Umrechnung" VALUE 0xF8D56 MSA15_FW4 0 UMR_FAKT -32.000000 31.999020 /end CHARACTERISTIC
/begin CHARACTERISTIC xcwUMRCOSG "DIAG Offset   CAN - Stellglied Ansteuerung" VALUE 0xF8F74 MSA15_FW4 0 DEZ_DW -32768.000000 32767.000000 /end CHARACTERISTIC
/begin CHARACTERISTIC xcwUMRCO_1 "DIAG Offset   CAN - 1:1-Umrechnung" VALUE 0xF8CA0 MSA15_FW4 0 DEZ_DW -32768.000000 32767.000000 /end CHARACTERISTIC
/begin CHARACTERISTIC xcwUMRCO_2 "DIAG Offset   CAN - Speisespannungs-Umrechnung" VALUE 0xF8D84 MSA15_FW4 0 DEZ_DW -32768.000000 32767.000000 /end CHARACTERISTIC
/begin CHARACTERISTIC xcwUMRCO_A "DIAG Offset   CAN - Mengenabgleich-Umrechnung" VALUE 0xF8E08 MSA15_FW4 0 DEZ_DW -32768.000000 32767.000000 /end CHARACTERISTIC
/begin CHARACTERISTIC xcwUMRCO_B "DIAG Offset   CAN - Beschleunigungs-Umrechnung" VALUE 0xF8D18 MSA15_FW4 0 DEZ_DW -32768.000000 32767.000000 /end CHARACTERISTIC
/begin CHARACTERISTIC xcwUMRCO_C "DIAG Offset   CAN - Kondensatorspannung-Umrechnung" VALUE 0xF8D54 MSA15_FW4 0 DEZ_DW -32768.000000 32767.000000 /end CHARACTERISTIC
/begin CHARACTERISTIC xcwUMRCO_D "DIAG Offset   CAN - Druck-Umrechnung" VALUE 0xF8CD0 MSA15_FW4 0 DEZ_DW -32768.000000 32767.000000 /end CHARACTERISTIC
/begin CHARACTERISTIC xcwUMRCO_E "DIAG Offset   CAN - TV-Umrechnung" VALUE 0xF8CF4 MSA15_FW4 0 DEZ_DW -32768.000000 32767.000000 /end CHARACTERISTIC
/begin CHARACTERISTIC xcwUMRCO_G "DIAG Offset   CAN - Raildruck-Umrechnung" VALUE 0xF8D6C MSA15_FW4 0 DEZ_DW -32768.000000 32767.000000 /end CHARACTERISTIC
/begin CHARACTERISTIC xcwUMRCO_I "DIAG Offset   CAN - Strom-Umrechnung" VALUE 0xF8D78 MSA15_FW4 0 DEZ_DW -32768.000000 32767.000000 /end CHARACTERISTIC
/begin CHARACTERISTIC xcwUMRCO_K "DIAG Offset   CAN - KM_akt-Umrechnung" VALUE 0xF8D48 MSA15_FW4 0 DEZ_DW -32768.000000 32767.000000 /end CHARACTERISTIC
/begin CHARACTERISTIC xcwUMRCO_L "DIAG Offset   CAN - Luftmassen-Umrechnung" VALUE 0xF8D0C MSA15_FW4 0 DEZ_DW -32768.000000 32767.000000 /end CHARACTERISTIC
/begin CHARACTERISTIC xcwUMRCO_M "DIAG Offset   CAN - Mengen-Umrechnung" VALUE 0xF8CDC MSA15_FW4 0 DEZ_DW -32768.000000 32767.000000 /end CHARACTERISTIC
/begin CHARACTERISTIC xcwUMRCO_N "DIAG Offset   CAN - Drehzahl-Umrechnung" VALUE 0xF8CB8 MSA15_FW4 0 DEZ_DW -32768.000000 32767.000000 /end CHARACTERISTIC
/begin CHARACTERISTIC xcwUMRCO_O "DIAG Offset   CAN - Moment-Umrechnung" VALUE 0xF8F8E MSA15_FW4 0 DEZ_DW -32768.000000 32767.000000 /end CHARACTERISTIC
/begin CHARACTERISTIC xcwUMRCO_P "DIAG Offset   CAN - Pedalwert-Umrechnung" VALUE 0xF8D00 MSA15_FW4 0 DEZ_DW -32768.000000 32767.000000 /end CHARACTERISTIC
/begin CHARACTERISTIC xcwUMRCO_Q "DIAG Offset   CAN - Speisespannungskompensierte Schleiferspannungen" VALUE 0xF8D3C MSA15_FW4 0 DEZ_DW -32768.000000 32767.000000 /end CHARACTERISTIC
/begin CHARACTERISTIC xcwUMRCO_S "DIAG Offset   CAN - Spannungs-Umrechnung 20V" VALUE 0xF8D30 MSA15_FW4 0 DEZ_DW -32768.000000 32767.000000 /end CHARACTERISTIC
/begin CHARACTERISTIC xcwUMRCO_T "DIAG Offset   CAN - Temperatur-Umrechnung" VALUE 0xF8CC4 MSA15_FW4 0 DEZ_DW -32768.000000 32767.000000 /end CHARACTERISTIC
/begin CHARACTERISTIC xcwUMRCO_U "DIAG Offset   CAN - Spannungs-Umrechnung 5V" VALUE 0xF8D24 MSA15_FW4 0 DEZ_DW -32768.000000 32767.000000 /end CHARACTERISTIC
/begin CHARACTERISTIC xcwUMRCO_V "DIAG Offset   CAN - Geschwindigkeit-Umrechnung" VALUE 0xF8CE8 MSA15_FW4 0 DEZ_DW -32768.000000 32767.000000 /end CHARACTERISTIC
/begin CHARACTERISTIC xcwUMRCO_W "DIAG Offset   CAN - KW-Winkel-Umrechnung" VALUE 0xF8D90 MSA15_FW4 0 DEZ_DW -32768.000000 32767.000000 /end CHARACTERISTIC
/begin CHARACTERISTIC xcwUMRCO_Z "DIAG Offset   CAN - Zeit-Umrechnung" VALUE 0xF8D9C MSA15_FW4 0 DEZ_DW -32768.000000 32767.000000 /end CHARACTERISTIC
/begin CHARACTERISTIC xcwUMRCOhB "DIAG Offset   CAN - High-Byte-Umrech. 16 Bit-Message" VALUE 0xF8CAC MSA15_FW4 0 DEZ_DW -32768.000000 32767.000000 /end CHARACTERISTIC
/begin CHARACTERISTIC xcwUMRCSSG "DIAG Steigung CAN - Stellglied Ansteuerung" VALUE 0xF8F72 MSA15_FW4 0 UMR_FAKT -32.000000 31.999020 /end CHARACTERISTIC
/begin CHARACTERISTIC xcwUMRCS_1 "DIAG Steigung CAN - 1:1-Umrechnung" VALUE 0xF8C9E MSA15_FW4 0 UMR_FAKT -32.000000 31.999020 /end CHARACTERISTIC
/begin CHARACTERISTIC xcwUMRCS_2 "DIAG Steigung CAN - Speisespannungs-Umrechnung" VALUE 0xF8D82 MSA15_FW4 0 UMR_FAKT -32.000000 31.999020 /end CHARACTERISTIC
/begin CHARACTERISTIC xcwUMRCS_A "DIAG Steigung CAN - Mengenabgleich-Umrechnung" VALUE 0xF8E06 MSA15_FW4 0 UMR_FAKT -32.000000 31.999020 /end CHARACTERISTIC
/begin CHARACTERISTIC xcwUMRCS_B "DIAG Steigung CAN - Beschleunigungs-Umrechnung" VALUE 0xF8D16 MSA15_FW4 0 UMR_FAKT -32.000000 31.999020 /end CHARACTERISTIC
/begin CHARACTERISTIC xcwUMRCS_C "DIAG Steigung CAN - Kondensatorspannung-Umrechnung" VALUE 0xF8D52 MSA15_FW4 0 UMR_FAKT -32.000000 31.999020 /end CHARACTERISTIC
/begin CHARACTERISTIC xcwUMRCS_D "DIAG Steigung CAN - Druck-Umrechnung" VALUE 0xF8CCE MSA15_FW4 0 UMR_FAKT -32.000000 31.999020 /end CHARACTERISTIC
/begin CHARACTERISTIC xcwUMRCS_E "DIAG Steigung CAN - TV-Umrechnung" VALUE 0xF8CF2 MSA15_FW4 0 UMR_FAKT -32.000000 31.999020 /end CHARACTERISTIC
/begin CHARACTERISTIC xcwUMRCS_G "DIAG Steigung CAN - Raildruck-Umrechnung" VALUE 0xF8D6A MSA15_FW4 0 UMR_FAKT -32.000000 31.999020 /end CHARACTERISTIC
/begin CHARACTERISTIC xcwUMRCS_I "DIAG Steigung CAN - Strom-Umrechnung" VALUE 0xF8D76 MSA15_FW4 0 UMR_FAKT -32.000000 31.999020 /end CHARACTERISTIC
/begin CHARACTERISTIC xcwUMRCS_K "DIAG Steigung CAN - KM_akt-Umrechnung" VALUE 0xF8D46 MSA15_FW4 0 UMR_FAKT -32.000000 31.999020 /end CHARACTERISTIC
/begin CHARACTERISTIC xcwUMRCS_L "DIAG Steigung CAN - Luftmassen-Umrechnung" VALUE 0xF8D0A MSA15_FW4 0 UMR_FAKT -32.000000 31.999020 /end CHARACTERISTIC
/begin CHARACTERISTIC xcwUMRCS_M "DIAG Steigung CAN - Mengen-Umrechnung" VALUE 0xF8CDA MSA15_FW4 0 UMR_FAKT -32.000000 31.999020 /end CHARACTERISTIC
/begin CHARACTERISTIC xcwUMRCS_N "DIAG Steigung CAN - Drehzahl-Umrechnung" VALUE 0xF8CB6 MSA15_FW4 0 UMR_FAKT -32.000000 31.999020 /end CHARACTERISTIC
/begin CHARACTERISTIC xcwUMRCS_O "DIAG Steigung CAN - Moment-Umrechnung" VALUE 0xF8F8C MSA15_FW4 0 UMR_FAKT -32.000000 31.999020 /end CHARACTERISTIC
/begin CHARACTERISTIC xcwUMRCS_P "DIAG Steigung CAN - Pedalwert-Umrechnung" VALUE 0xF8CFE MSA15_FW4 0 UMR_FAKT -32.000000 31.999020 /end CHARACTERISTIC
/begin CHARACTERISTIC xcwUMRCS_Q "DIAG Steigung CAN - Speisespannungskompensierte Schleiferspannungen" VALUE 0xF8D3A MSA15_FW4 0 UMR_FAKT -32.000000 31.999020 /end CHARACTERISTIC
/begin CHARACTERISTIC xcwUMRCS_S "DIAG Steigung CAN - Spannungs-Umrechnung 20V" VALUE 0xF8D2E MSA15_FW4 0 UMR_FAKT -32.000000 31.999020 /end CHARACTERISTIC
/begin CHARACTERISTIC xcwUMRCS_T "DIAG Steigung CAN - Temperatur-Umrechnung" VALUE 0xF8CC2 MSA15_FW4 0 UMR_FAKT -32.000000 31.999020 /end CHARACTERISTIC
/begin CHARACTERISTIC xcwUMRCS_U "DIAG Steigung CAN - Spannungs-Umrechnung 5V" VALUE 0xF8D22 MSA15_FW4 0 UMR_FAKT -32.000000 31.999020 /end CHARACTERISTIC
/begin CHARACTERISTIC xcwUMRCS_V "DIAG Steigung CAN - Geschwindigkeit-Umrechnung" VALUE 0xF8CE6 MSA15_FW4 0 UMR_FAKT -32.000000 31.999020 /end CHARACTERISTIC
/begin CHARACTERISTIC xcwUMRCS_W "DIAG Steigung CAN - KW-Winkel-Umrechnung" VALUE 0xF8D8E MSA15_FW4 0 UMR_FAKT -32.000000 31.999020 /end CHARACTERISTIC
/begin CHARACTERISTIC xcwUMRCS_Z "DIAG Steigung CAN - Zeit-Umrechnung" VALUE 0xF8D9A MSA15_FW4 0 UMR_FAKT -32.000000 31.999020 /end CHARACTERISTIC
/begin CHARACTERISTIC xcwUMRCShB "DIAG Steigung CAN - High-Byte-Umrech. 16 Bit-Message" VALUE 0xF8CAA MSA15_FW4 0 UMR_FAKT -32.000000 31.999020 /end CHARACTERISTIC
/begin CHARACTERISTIC xcwUMRDOSG "DIAG Offset   DIA - Stellglied Ansteuerung" VALUE 0xF8F70 MSA15_FW4 0 DEZ_DW -32768.000000 32767.000000 /end CHARACTERISTIC
/begin CHARACTERISTIC xcwUMRDO_1 "DIAG Offset   DIA - 1:1-Umrechnung" VALUE 0xF8C9C MSA15_FW4 0 DEZ_DW -32768.000000 32767.000000 /end CHARACTERISTIC
/begin CHARACTERISTIC xcwUMRDO_2 "DIAG Offset   DIA - Speisespannungs-Umrechnung" VALUE 0xF8D80 MSA15_FW4 0 DEZ_DW -32768.000000 32767.000000 /end CHARACTERISTIC
/begin CHARACTERISTIC xcwUMRDO_A "DIAG Offset   DIA - Mengenabgleich-Umrechnung" VALUE 0xF8E04 MSA15_FW4 0 DEZ_DW -32768.000000 32767.000000 /end CHARACTERISTIC
/begin CHARACTERISTIC xcwUMRDO_B "DIAG Offset   DIA - Beschleunigungs-Umrechnung" VALUE 0xF8D14 MSA15_FW4 0 DEZ_DW -32768.000000 32767.000000 /end CHARACTERISTIC
/begin CHARACTERISTIC xcwUMRDO_C "DIAG Offset   DIA - Kondensatorspannung-Umrechnung" VALUE 0xF8D50 MSA15_FW4 0 DEZ_DW -32768.000000 32767.000000 /end CHARACTERISTIC
/begin CHARACTERISTIC xcwUMRDO_D "DIAG Offset   DIA - Druck-Umrechnung" VALUE 0xF8CCC MSA15_FW4 0 DEZ_DW -32768.000000 32767.000000 /end CHARACTERISTIC
/begin CHARACTERISTIC xcwUMRDO_E "DIAG Offset   DIA - TV-Umrechnung" VALUE 0xF8CF0 MSA15_FW4 0 DEZ_DW -32768.000000 32767.000000 /end CHARACTERISTIC
/begin CHARACTERISTIC xcwUMRDO_G "DIAG Offset   DIA - Raildruck-Umrechnung" VALUE 0xF8D68 MSA15_FW4 0 DEZ_DW -32768.000000 32767.000000 /end CHARACTERISTIC
/begin CHARACTERISTIC xcwUMRDO_I "DIAG Offset   DIA - Strom-Umrechnung" VALUE 0xF8D74 MSA15_FW4 0 DEZ_DW -32768.000000 32767.000000 /end CHARACTERISTIC
/begin CHARACTERISTIC xcwUMRDO_K "DIAG Offset   DIA - KM_akt-Umrechnung" VALUE 0xF8D44 MSA15_FW4 0 DEZ_DW -32768.000000 32767.000000 /end CHARACTERISTIC
/begin CHARACTERISTIC xcwUMRDO_L "DIAG Offset   DIA - Luftmassen-Umrechnung" VALUE 0xF8D08 MSA15_FW4 0 DEZ_DW -32768.000000 32767.000000 /end CHARACTERISTIC
/begin CHARACTERISTIC xcwUMRDO_M "DIAG Offset   DIA - Mengen-Umrechnung" VALUE 0xF8CD8 MSA15_FW4 0 DEZ_DW -32768.000000 32767.000000 /end CHARACTERISTIC
/begin CHARACTERISTIC xcwUMRDO_N "DIAG Offset   DIA - Drehzahl-Umrechnung" VALUE 0xF8CB4 MSA15_FW4 0 DEZ_DW -32768.000000 32767.000000 /end CHARACTERISTIC
/begin CHARACTERISTIC xcwUMRDO_O "DIAG Offset   DIA - Moment-Umrechnung" VALUE 0xF8F8A MSA15_FW4 0 DEZ_DW -32768.000000 32767.000000 /end CHARACTERISTIC
/begin CHARACTERISTIC xcwUMRDO_P "DIAG Offset   DIA - Pedalwert-Umrechnung" VALUE 0xF8CFC MSA15_FW4 0 DEZ_DW -32768.000000 32767.000000 /end CHARACTERISTIC
/begin CHARACTERISTIC xcwUMRDO_Q "DIAG Offset   DIA - Speisespannungskompensierte Schleiferspannungen" VALUE 0xF8D38 MSA15_FW4 0 DEZ_DW -32768.000000 32767.000000 /end CHARACTERISTIC
/begin CHARACTERISTIC xcwUMRDO_S "DIAG Offset   DIA - Spannungs-Umrechnung 20V" VALUE 0xF8D2C MSA15_FW4 0 DEZ_DW -32768.000000 32767.000000 /end CHARACTERISTIC
/begin CHARACTERISTIC xcwUMRDO_T "DIAG Offset   DIA - Temperatur-Umrechnung" VALUE 0xF8CC0 MSA15_FW4 0 DEZ_DW -32768.000000 32767.000000 /end CHARACTERISTIC
/begin CHARACTERISTIC xcwUMRDO_U "DIAG Offset   DIA - Spannungs-Umrechnung 5V" VALUE 0xF8D20 MSA15_FW4 0 DEZ_DW -32768.000000 32767.000000 /end CHARACTERISTIC
/begin CHARACTERISTIC xcwUMRDO_V "DIAG Offset   DIA - Geschwindigkeit-Umrechnung" VALUE 0xF8CE4 MSA15_FW4 0 DEZ_DW -32768.000000 32767.000000 /end CHARACTERISTIC
/begin CHARACTERISTIC xcwUMRDO_W "DIAG Offset   DIA - KW-Winkel-Umrechnung" VALUE 0xF8D8C MSA15_FW4 0 DEZ_DW -32768.000000 32767.000000 /end CHARACTERISTIC
/begin CHARACTERISTIC xcwUMRDO_Z "DIAG Offset   DIA - Zeit-Umrechnung" VALUE 0xF8D98 MSA15_FW4 0 DEZ_DW -32768.000000 32767.000000 /end CHARACTERISTIC
/begin CHARACTERISTIC xcwUMRDOhB "DIAG Offset   DIA - High-Byte-Umrech. 16 Bit-Message" VALUE 0xF8CA8 MSA15_FW4 0 DEZ_DW -32768.000000 32767.000000 /end CHARACTERISTIC
/begin CHARACTERISTIC xcwUMRDSSG "DIAG Steigung DIA - Stellglied Ansteuerung" VALUE 0xF8F6E MSA15_FW4 0 UMR_FAKT -32.000000 31.999020 /end CHARACTERISTIC
/begin CHARACTERISTIC xcwUMRDS_1 "DIAG Steigung DIA - 1:1-Umrechnung" VALUE 0xF8C9A MSA15_FW4 0 UMR_FAKT -32.000000 31.999020 /end CHARACTERISTIC
/begin CHARACTERISTIC xcwUMRDS_2 "DIAG Steigung DIA - Speisespannungs-Umrechnung" VALUE 0xF8D7E MSA15_FW4 0 UMR_FAKT -32.000000 31.999020 /end CHARACTERISTIC
/begin CHARACTERISTIC xcwUMRDS_A "DIAG Steigung DIA - Mengenabgleich-Umrechnung" VALUE 0xF8E02 MSA15_FW4 0 UMR_FAKT -32.000000 31.999020 /end CHARACTERISTIC
/begin CHARACTERISTIC xcwUMRDS_B "DIAG Steigung DIA - Beschleunigungs-Umrechnung" VALUE 0xF8D12 MSA15_FW4 0 UMR_FAKT -32.000000 31.999020 /end CHARACTERISTIC
/begin CHARACTERISTIC xcwUMRDS_C "DIAG Steigung DIA - Kondensatorspannung-Umrechnung" VALUE 0xF8D4E MSA15_FW4 0 UMR_FAKT -32.000000 31.999020 /end CHARACTERISTIC
/begin CHARACTERISTIC xcwUMRDS_D "DIAG Steigung DIA - Druck-Umrechnung" VALUE 0xF8CCA MSA15_FW4 0 UMR_FAKT -32.000000 31.999020 /end CHARACTERISTIC
/begin CHARACTERISTIC xcwUMRDS_E "DIAG Steigung DIA - TV-Umrechnung" VALUE 0xF8CEE MSA15_FW4 0 UMR_FAKT -32.000000 31.999020 /end CHARACTERISTIC
/begin CHARACTERISTIC xcwUMRDS_G "DIAG Steigung DIA - Raildruck-Umrechnung" VALUE 0xF8D66 MSA15_FW4 0 UMR_FAKT -32.000000 31.999020 /end CHARACTERISTIC
/begin CHARACTERISTIC xcwUMRDS_I "DIAG Steigung DIA - Strom-Umrechnung" VALUE 0xF8D72 MSA15_FW4 0 UMR_FAKT -32.000000 31.999020 /end CHARACTERISTIC
/begin CHARACTERISTIC xcwUMRDS_K "DIAG Steigung DIA - KM_akt-Umrechnung" VALUE 0xF8D42 MSA15_FW4 0 UMR_FAKT -32.000000 31.999020 /end CHARACTERISTIC
/begin CHARACTERISTIC xcwUMRDS_L "DIAG Steigung DIA - Luftmassen-Umrechnung" VALUE 0xF8D06 MSA15_FW4 0 UMR_FAKT -32.000000 31.999020 /end CHARACTERISTIC
/begin CHARACTERISTIC xcwUMRDS_M "DIAG Steigung DIA - Mengen-Umrechnung" VALUE 0xF8CD6 MSA15_FW4 0 UMR_FAKT -32.000000 31.999020 /end CHARACTERISTIC
/begin CHARACTERISTIC xcwUMRDS_N "DIAG Steigung DIA - Drehzahl-Umrechnung" VALUE 0xF8CB2 MSA15_FW4 0 UMR_FAKT -32.000000 31.999020 /end CHARACTERISTIC
/begin CHARACTERISTIC xcwUMRDS_O "DIAG Steigung DIA - Moment-Umrechnung" VALUE 0xF8F88 MSA15_FW4 0 UMR_FAKT -32.000000 31.999020 /end CHARACTERISTIC
/begin CHARACTERISTIC xcwUMRDS_P "DIAG Steigung DIA - Pedalwert-Umrechnung" VALUE 0xF8CFA MSA15_FW4 0 UMR_FAKT -32.000000 31.999020 /end CHARACTERISTIC
/begin CHARACTERISTIC xcwUMRDS_Q "DIAG Steigung DIA - Speisespannungskompensierte Schleiferspannungen" VALUE 0xF8D36 MSA15_FW4 0 UMR_FAKT -32.000000 31.999020 /end CHARACTERISTIC
/begin CHARACTERISTIC xcwUMRDS_S "DIAG Steigung DIA - Spannungs-Umrechnung 20V" VALUE 0xF8D2A MSA15_FW4 0 UMR_FAKT -32.000000 31.999020 /end CHARACTERISTIC
/begin CHARACTERISTIC xcwUMRDS_T "DIAG Steigung DIA - Temperatur-Umrechnung" VALUE 0xF8CBE MSA15_FW4 0 UMR_FAKT -32.000000 31.999020 /end CHARACTERISTIC
/begin CHARACTERISTIC xcwUMRDS_U "DIAG Steigung DIA - Spannungs-Umrechnung 5V" VALUE 0xF8D1E MSA15_FW4 0 UMR_FAKT -32.000000 31.999020 /end CHARACTERISTIC
/begin CHARACTERISTIC xcwUMRDS_V "DIAG Steigung DIA - Geschwindigkeit-Umrechnung" VALUE 0xF8CE2 MSA15_FW4 0 UMR_FAKT -32.000000 31.999020 /end CHARACTERISTIC
/begin CHARACTERISTIC xcwUMRDS_W "DIAG Steigung DIA - KW-Winkel-Umrechnung" VALUE 0xF8D8A MSA15_FW4 0 UMR_FAKT -32.000000 31.999020 /end CHARACTERISTIC
/begin CHARACTERISTIC xcwUMRDS_Z "DIAG Steigung DIA - Zeit-Umrechnung" VALUE 0xF8D96 MSA15_FW4 0 UMR_FAKT -32.000000 31.999020 /end CHARACTERISTIC
/begin CHARACTERISTIC xcwUMRDShB "DIAG Steigung DIA - High-Byte-Umrech. 16 Bit-Message" VALUE 0xF8CA6 MSA15_FW4 0 UMR_FAKT -32.000000 31.999020 /end CHARACTERISTIC
/begin CHARACTERISTIC xcwUMRFOSG "DIAG Offset   FSP - Stellglied Ansteuerung" VALUE 0xF8F6C MSA15_FW4 0 DEZ_DW -32768.000000 32767.000000 /end CHARACTERISTIC
/begin CHARACTERISTIC xcwUMRFO_1 "DIAG Offset   FSP - 1:1-Umrechnung" VALUE 0xF8C98 MSA15_FW4 0 DEZ_DW -32768.000000 32767.000000 /end CHARACTERISTIC
/begin CHARACTERISTIC xcwUMRFO_2 "DIAG Offset   FSP - Speisespannungs-Umrechnung" VALUE 0xF8D7C MSA15_FW4 0 DEZ_DW -32768.000000 32767.000000 /end CHARACTERISTIC
/begin CHARACTERISTIC xcwUMRFO_A "DIAG Offset   FSP - Mengenabgleich-Umrechnung" VALUE 0xF8E00 MSA15_FW4 0 DEZ_DW -32768.000000 32767.000000 /end CHARACTERISTIC
/begin CHARACTERISTIC xcwUMRFO_B "DIAG Offset   FSP - Beschleunigungs-Umrechnung" VALUE 0xF8D10 MSA15_FW4 0 DEZ_DW -32768.000000 32767.000000 /end CHARACTERISTIC
/begin CHARACTERISTIC xcwUMRFO_C "DIAG Offset   FSP - Kondensatorspannung-Umrechnung" VALUE 0xF8D4C MSA15_FW4 0 DEZ_DW -32768.000000 32767.000000 /end CHARACTERISTIC
/begin CHARACTERISTIC xcwUMRFO_D "DIAG Offset   FSP - Druck-Umrechnung" VALUE 0xF8CC8 MSA15_FW4 0 DEZ_DW -32768.000000 32767.000000 /end CHARACTERISTIC
/begin CHARACTERISTIC xcwUMRFO_E "DIAG Offset   FSP - TV-Umrechnung" VALUE 0xF8CEC MSA15_FW4 0 DEZ_DW -32768.000000 32767.000000 /end CHARACTERISTIC
/begin CHARACTERISTIC xcwUMRFO_G "DIAG Offset   FSP - Raildruck-Umrechnung" VALUE 0xF8D64 MSA15_FW4 0 DEZ_DW -32768.000000 32767.000000 /end CHARACTERISTIC
/begin CHARACTERISTIC xcwUMRFO_I "DIAG Offset   FSP - Strom-Umrechnung" VALUE 0xF8D70 MSA15_FW4 0 DEZ_DW -32768.000000 32767.000000 /end CHARACTERISTIC
/begin CHARACTERISTIC xcwUMRFO_K "DIAG Offset   FSP - KM_aktUmrechnung" VALUE 0xF8D40 MSA15_FW4 0 DEZ_DW -32768.000000 32767.000000 /end CHARACTERISTIC
/begin CHARACTERISTIC xcwUMRFO_L "DIAG Offset   FSP - Luftmassen-Umrechnung" VALUE 0xF8D04 MSA15_FW4 0 DEZ_DW -32768.000000 32767.000000 /end CHARACTERISTIC
/begin CHARACTERISTIC xcwUMRFO_M "DIAG Offset   FSP - Mengen-Umrechnung" VALUE 0xF8CD4 MSA15_FW4 0 DEZ_DW -32768.000000 32767.000000 /end CHARACTERISTIC
/begin CHARACTERISTIC xcwUMRFO_N "DIAG Offset   FSP - Drehzahl-Umrechnung" VALUE 0xF8CB0 MSA15_FW4 0 DEZ_DW -32768.000000 32767.000000 /end CHARACTERISTIC
/begin CHARACTERISTIC xcwUMRFO_O "DIAG Offset   FSP - Moment-Umrechnung" VALUE 0xF8F86 MSA15_FW4 0 DEZ_DW -32768.000000 32767.000000 /end CHARACTERISTIC
/begin CHARACTERISTIC xcwUMRFO_P "DIAG Offset   FSP - Pedalwert-Umrechnung" VALUE 0xF8CF8 MSA15_FW4 0 DEZ_DW -32768.000000 32767.000000 /end CHARACTERISTIC
/begin CHARACTERISTIC xcwUMRFO_Q "DIAG Offset   FSP - Speisespannungskompensierte Schleiferspannungen" VALUE 0xF8D34 MSA15_FW4 0 DEZ_DW -32768.000000 32767.000000 /end CHARACTERISTIC
/begin CHARACTERISTIC xcwUMRFO_S "DIAG Offset   FSP - Spannungs-Umrechnung 20V" VALUE 0xF8D28 MSA15_FW4 0 DEZ_DW -32768.000000 32767.000000 /end CHARACTERISTIC
/begin CHARACTERISTIC xcwUMRFO_T "DIAG Offset   FSP - Temperatur-Umrechnung" VALUE 0xF8CBC MSA15_FW4 0 DEZ_DW -32768.000000 32767.000000 /end CHARACTERISTIC
/begin CHARACTERISTIC xcwUMRFO_U "DIAG Offset   FSP - Spannungs-Umrechnung 5V" VALUE 0xF8D1C MSA15_FW4 0 DEZ_DW -32768.000000 32767.000000 /end CHARACTERISTIC
/begin CHARACTERISTIC xcwUMRFO_V "DIAG Offset   FSP - Geschwindigkeits-Umrechnung" VALUE 0xF8CE0 MSA15_FW4 0 DEZ_DW -32768.000000 32767.000000 /end CHARACTERISTIC
/begin CHARACTERISTIC xcwUMRFO_W "DIAG Offset   FSP - KW-Winkel-Umrechnung" VALUE 0xF8D88 MSA15_FW4 0 DEZ_DW -32768.000000 32767.000000 /end CHARACTERISTIC
/begin CHARACTERISTIC xcwUMRFO_Z "DIAG Offset   FSP - Zeit-Umrechnung" VALUE 0xF8D94 MSA15_FW4 0 DEZ_DW -32768.000000 32767.000000 /end CHARACTERISTIC
/begin CHARACTERISTIC xcwUMRFOhB "DIAG Offset   FSP - High-Byte-Umr. 16 Bit-Message" VALUE 0xF8CA4 MSA15_FW4 0 DEZ_DW -32768.000000 32767.000000 /end CHARACTERISTIC
/begin CHARACTERISTIC xcwUMRFSSG "DIAG Steigung FSP - Stellglied Ansteuerung" VALUE 0xF8F6A MSA15_FW4 0 UMR_FAKT -32.000000 31.999020 /end CHARACTERISTIC
/begin CHARACTERISTIC xcwUMRFS_1 "DIAG Steigung FSP - 1:1-Umrechnung" VALUE 0xF8C96 MSA15_FW4 0 UMR_FAKT -32.000000 31.999020 /end CHARACTERISTIC
/begin CHARACTERISTIC xcwUMRFS_2 "DIAG Steigung FSP - Speisespannungs-Umrechnung" VALUE 0xF8D7A MSA15_FW4 0 UMR_FAKT -32.000000 31.999020 /end CHARACTERISTIC
/begin CHARACTERISTIC xcwUMRFS_A "DIAG Steigung FSP - Mengenabgleich-Umrechnung" VALUE 0xF8DFE MSA15_FW4 0 UMR_FAKT -32.000000 31.999020 /end CHARACTERISTIC
/begin CHARACTERISTIC xcwUMRFS_B "DIAG Steigung FSP - Beschleunigungs-Umrechnung" VALUE 0xF8D0E MSA15_FW4 0 UMR_FAKT -32.000000 31.999020 /end CHARACTERISTIC
/begin CHARACTERISTIC xcwUMRFS_C "DIAG Steigung FSP - Kondensatorspannung-Umrechnung" VALUE 0xF8D4A MSA15_FW4 0 UMR_FAKT -32.000000 31.999020 /end CHARACTERISTIC
/begin CHARACTERISTIC xcwUMRFS_D "DIAG Steigung FSP - Druck-Umrechnung" VALUE 0xF8CC6 MSA15_FW4 0 UMR_FAKT -32.000000 31.999020 /end CHARACTERISTIC
/begin CHARACTERISTIC xcwUMRFS_E "DIAG Steigung FSP - TV-Umrechnung" VALUE 0xF8CEA MSA15_FW4 0 UMR_FAKT -32.000000 31.999020 /end CHARACTERISTIC
/begin CHARACTERISTIC xcwUMRFS_G "DIAG Steigung FSP - Raildruck-Umrechnung" VALUE 0xF8D62 MSA15_FW4 0 UMR_FAKT -32.000000 31.999020 /end CHARACTERISTIC
/begin CHARACTERISTIC xcwUMRFS_I "DIAG Steigung FSP - Strom-Umrechnung" VALUE 0xF8D6E MSA15_FW4 0 UMR_FAKT -32.000000 31.999020 /end CHARACTERISTIC
/begin CHARACTERISTIC xcwUMRFS_K "DIAG Steigung FSP - KM_akt-Umrechnung" VALUE 0xF8D3E MSA15_FW4 0 UMR_FAKT -32.000000 31.999020 /end CHARACTERISTIC
/begin CHARACTERISTIC xcwUMRFS_L "DIAG Steigung FSP - Luftmassen-Umrechnung" VALUE 0xF8D02 MSA15_FW4 0 UMR_FAKT -32.000000 31.999020 /end CHARACTERISTIC
/begin CHARACTERISTIC xcwUMRFS_M "DIAG Steigung FSP - Mengen-Umrechnung" VALUE 0xF8CD2 MSA15_FW4 0 UMR_FAKT -32.000000 31.999020 /end CHARACTERISTIC
/begin CHARACTERISTIC xcwUMRFS_N "DIAG Steigung FSP - Drehzahl-Umrechnung" VALUE 0xF8CAE MSA15_FW4 0 UMR_FAKT -32.000000 31.999020 /end CHARACTERISTIC
/begin CHARACTERISTIC xcwUMRFS_O "DIAG Steigung FSP - Moment-Umrechnung" VALUE 0xF8F84 MSA15_FW4 0 UMR_FAKT -32.000000 31.999020 /end CHARACTERISTIC
/begin CHARACTERISTIC xcwUMRFS_P "DIAG Steigung FSP - Pedalwert-Umrechnung" VALUE 0xF8CF6 MSA15_FW4 0 UMR_FAKT -32.000000 31.999020 /end CHARACTERISTIC
/begin CHARACTERISTIC xcwUMRFS_Q "DIAG Steigung FSP - Speisespannungskompensierte Schleiferspannungen" VALUE 0xF8D32 MSA15_FW4 0 UMR_FAKT -32.000000 31.999020 /end CHARACTERISTIC
/begin CHARACTERISTIC xcwUMRFS_S "DIAG Steigung FSP - Spannungs-Umrechnung 20V" VALUE 0xF8D26 MSA15_FW4 0 UMR_FAKT -32.000000 31.999020 /end CHARACTERISTIC
/begin CHARACTERISTIC xcwUMRFS_T "DIAG Steigung FSP - Temperatur-Umrechnung" VALUE 0xF8CBA MSA15_FW4 0 UMR_FAKT -32.000000 31.999020 /end CHARACTERISTIC
/begin CHARACTERISTIC xcwUMRFS_U "DIAG Steigung FSP - Spannungs-Umrechnung 5V" VALUE 0xF8D1A MSA15_FW4 0 UMR_FAKT -32.000000 31.999020 /end CHARACTERISTIC
/begin CHARACTERISTIC xcwUMRFS_V "DIAG Steigung FSP - Geschwindigkeits-Umrechnung" VALUE 0xF8CDE MSA15_FW4 0 UMR_FAKT -32.000000 31.999020 /end CHARACTERISTIC
/begin CHARACTERISTIC xcwUMRFS_W "DIAG Steigung FSP - KW-Winkel-Umrechnung" VALUE 0xF8D86 MSA15_FW4 0 UMR_FAKT -32.000000 31.999020 /end CHARACTERISTIC
/begin CHARACTERISTIC xcwUMRFS_Z "DIAG Steigung FSP - Zeit-Umrechnung" VALUE 0xF8D92 MSA15_FW4 0 UMR_FAKT -32.000000 31.999020 /end CHARACTERISTIC
/begin CHARACTERISTIC xcwUMRFShB "DIAG Steigung FSP - High-Byte-Umr. 16 Bit-Message" VALUE 0xF8CA2 MSA15_FW4 0 UMR_FAKT -32.000000 31.999020 /end CHARACTERISTIC
/begin CHARACTERISTIC xcwZSRF1 "DIAG Zuordnung: Segment <==> phys. Zylinder 1-4" VALUE 0xF8F80 MSA15_FW3 0 DEZ_DW_U 0.000000 65535.000000 /end CHARACTERISTIC
/begin CHARACTERISTIC xcwZSRF2 "DIAG Zuordnung: Segment <==> phys. Zylinder 5,6" VALUE 0xF8F82 MSA15_FW3 0 DEZ_DW_U 0.000000 65535.000000 /end CHARACTERISTIC
/begin CHARACTERISTIC zhwBA_SOLL "#SSD Bankauswahl" VALUE 0xF8C76 MSA15_FW3 0 DEZ_DW_U 0.000000 65535.000000 /end CHARACTERISTIC
/begin CHARACTERISTIC zhwBOB_Seg "Segment bei BOB(0)" VALUE 0xF8C82 MSA15_FW1 0 DEZ_DB_U 0.000000 255.000000 /end CHARACTERISTIC
/begin CHARACTERISTIC zhwBOB_x "#SSD Fruehest moeglicher Voereinspritzwinkel (vOT ist pos.)" VALUE 0xF8C6A MSA15_FW4 0 INKvOT 0.000000 720.000000 EXTENDED_LIMITS -720.000000 720.000000 /end CHARACTERISTIC
/begin CHARACTERISTIC zhwC720INK "#SSD Anz.d.Ink.,nach dem d.Wklu. rueckges. wird -1" VALUE 0xF8C2C MSA15_FW1 0 DEZ_DB_U 0.000000 255.000000 /end CHARACTERISTIC
/begin CHARACTERISTIC zhwDZG_0 "#SSD Winkel zwischen  BOB(0) und DZG(0) -1" VALUE 0xF8C68 MSA15_FW3 0 KW2T3 3.000000 720.000000 EXTENDED_LIMITS 3.000000 723.000000 /end CHARACTERISTIC
/begin CHARACTERISTIC zhwDZG_F "#SSD Absoluter Winkel DZG_First" VALUE 0xF8C66 MSA15_FW3 0 GradKW 0.000000 720.000000 EXTENDED_LIMITS -768.000000 767.976600 /end CHARACTERISTIC
/begin CHARACTERISTIC zhwDZG_GF "DZG Gedaechtnisfaktor" VALUE 0xF8C52 MSA15_FW4 0 GF 0.000031 0.999969 /end CHARACTERISTIC
/begin CHARACTERISTIC zhwDZ_SOLL "#SSD Reloadwerte fuer DZG_int" VALUE 0xF8C7C MSA15_FW3 0 KW2T3 3.000000 720.000000 EXTENDED_LIMITS 3.000000 723.000000 /end CHARACTERISTIC
/begin CHARACTERISTIC zhwERR_PRE "#SSD Entprellzaehler der IWZ Fehler" VALUE 0xF8C6F MSA15_FW1 0 DEZ_DB_U 0.000000 255.000000 /end CHARACTERISTIC
/begin CHARACTERISTIC zhwHECUR "#SSD Zeit Umschalten Anzug-/Haltestrom" VALUE 0xF8C32 MSA15_FW3 0 GA_uS 0.000000 65535.000000 /end CHARACTERISTIC
/begin CHARACTERISTIC zhwHECURKL "#SSD ZH Anzugstromzeit = f(anmWTF) !###crq442 St" CURVE 0xF9BBA MSA15_KL118 0 AD_uS 100.000000 500.000000
 /begin AXIS_DESCR STD_AXIS anmWTF T 8 -50.040010 149.960000 EXTENDED_LIMITS -273.140000 3003.560000 /end AXIS_DESCR
 EXTENDED_LIMITS -32768.000000 32767.000000 /end CHARACTERISTIC
/begin CHARACTERISTIC zhwHEDELAY "#SSD Zeit bis Beginn Rechargefenster" VALUE 0xF8C3A MSA15_FW3 0 GA_uS 0.000000 65535.000000 /end CHARACTERISTIC
/begin CHARACTERISTIC zhwHELOESC "#SSD Zeit Ende Schnelloeschung" VALUE 0xF8C36 MSA15_FW3 0 GA_uS 0.000000 65535.000000 /end CHARACTERISTIC
/begin CHARACTERISTIC zhwHERCHG "#SSD Zeit bis Ende Rechargefenster" VALUE 0xF8C3C MSA15_FW3 0 GA_uS 0.000000 65535.000000 /end CHARACTERISTIC
/begin CHARACTERISTIC zhwHESELOF "#SSD Zeit bis Ruecksch. Zylinderauswahl" VALUE 0xF8C3E MSA15_FW3 0 GA_uS 0.000000 65535.000000 /end CHARACTERISTIC
/begin CHARACTERISTIC zhwHESELON "#SSD Zeit Ende Schnelloeschung bis Umsch." VALUE 0xF8C38 MSA15_FW3 0 GA_uS 0.000000 65535.000000 /end CHARACTERISTIC
/begin CHARACTERISTIC zhwIRCHGKL "#SSD ZH Rechargestrom = f(Ubatt)" CURVE 0xF9BDE MSA15_KL118 0 IRc2PZM10 0.000000 15001.500000
 /begin AXIS_DESCR STD_AXIS anmUBT U_B 8 5007.385000 20005.920000 EXTENDED_LIMITS 0.000000 773948.100000 /end AXIS_DESCR
 EXTENDED_LIMITS 0.000000 55005.500000 /end CHARACTERISTIC
/begin CHARACTERISTIC zhwIWZCTRW "#SSD Control-Register IWZ" VALUE 0xF8C28 MSA15_FW3 0 DEZ_DW_U 0.000000 65535.000000 /end CHARACTERISTIC
/begin CHARACTERISTIC zhwI_RCHG "#SSD Sollwert fuer Recharge-Strom" VALUE 0xF8C26 MSA15_FW3 0 IRc2PZM10 0.000000 55005.500000 /end CHARACTERISTIC
/begin CHARACTERISTIC zhwNECUR "#SSD Zeit Umschalten Anzug-/Haltestrom" VALUE 0xF8C34 MSA15_FW3 0 GA_uS 0.000000 65535.000000 /end CHARACTERISTIC
/begin CHARACTERISTIC zhwNE_SOLL "#SSD Nachspritzmoeglichkeiten" VALUE 0xF8C74 MSA15_FW3 0 DEZ_DW_U 0.000000 65535.000000 /end CHARACTERISTIC
/begin CHARACTERISTIC zhwNWG_Peg "#SSD Pegel des NWG bei 1.Zahn nach Luecke vor OT(0)" VALUE 0xF8C6E MSA15_FW1 0 DEZ_DB_U 0.000000 255.000000 /end CHARACTERISTIC
/begin CHARACTERISTIC zhwNW_CNT "Maximale Anzahl von NW-Umdrehungen innerhalb der NW-Ueberwachung" VALUE 0xF8C71 MSA15_FW1 0 DEZ_DB_U 0.000000 255.000000 /end CHARACTERISTIC
/begin CHARACTERISTIC zhwN_PLAU "#SSD Drehzahlschwelle fuer Plaus.umschaltung" VALUE 0xF8C4C MSA15_FW3 0 N 0.000000 6000.000000 EXTENDED_LIMITS 0.000000 32767.000000 /end CHARACTERISTIC
/begin CHARACTERISTIC zhwN_UPL "#SSD Drehzahlschwelle fuer Fehlerspeicherung IWZ dynamisch defekt" VALUE 0xF8C4E MSA15_FW3 0 N 0.000000 6000.000000 EXTENDED_LIMITS 0.000000 32767.000000 /end CHARACTERISTIC
/begin CHARACTERISTIC zhwN_UPLNW "Drehzahlschwelle fuer Fehlerspeicherung Nockenwelle statisch defekt" VALUE 0xF8C50 MSA15_FW3 0 N 0.000000 6000.000000 EXTENDED_LIMITS 0.000000 32767.000000 /end CHARACTERISTIC
/begin CHARACTERISTIC zhwNsync "#SSD Drehzahlschwelle fuer Umschaltung Schnell-Sync./Sync" VALUE 0xF8C6C MSA15_FW4 0 N 0.000000 6000.000000 EXTENDED_LIMITS 0.000000 32767.000000 /end CHARACTERISTIC
/begin CHARACTERISTIC zhwOFF1 "#SSD Fruehster Winkel fuer fallende Flanke" VALUE 0xF8C22 MSA15_FW4 0 GradKW 0.000000 720.000000 EXTENDED_LIMITS -768.000000 767.976600 /end CHARACTERISTIC
/begin CHARACTERISTIC zhwOFF2 "#SSD spaetester Winkel fuer fallende Flanke" VALUE 0xF8C24 MSA15_FW4 0 GradKW 0.000000 720.000000 EXTENDED_LIMITS -768.000000 767.976600 /end CHARACTERISTIC
/begin CHARACTERISTIC zhwON1 "#SSD Fruehster Winkel fuer steigende Flanke" VALUE 0xF8C1E MSA15_FW4 0 GradKW 0.000000 720.000000 EXTENDED_LIMITS -768.000000 767.976600 /end CHARACTERISTIC
/begin CHARACTERISTIC zhwON2 "#SSD spaetester Winkel fuer steigende Flanke" VALUE 0xF8C20 MSA15_FW4 0 GradKW 0.000000 720.000000 EXTENDED_LIMITS -768.000000 767.976600 /end CHARACTERISTIC
/begin CHARACTERISTIC zhwOT_0 "#SSD Winkeluhrstand beim 1. Oberen Totpunkt" VALUE 0xF8C64 MSA15_FW3 0 GradKW 0.000000 720.000000 EXTENDED_LIMITS -768.000000 767.976600 /end CHARACTERISTIC
/begin CHARACTERISTIC zhwOTgSOLL "#SSD Winkel  zw. OT eines geraden und eines ungeraden Zylinders" VALUE 0xF8C7E MSA15_FW3 0 Grad2INK 0.000000 720.000000 /end CHARACTERISTIC
/begin CHARACTERISTIC zhwOTuSOLL "#SSD Winkel zw. OT eines ungeraden und eines geraden Zylinders" VALUE 0xF8C80 MSA15_FW3 0 Grad2INK 0.000000 720.000000 /end CHARACTERISTIC
/begin CHARACTERISTIC zhwOb_N_OI "#SSD grosse Drehzahln Oberes Plaus.fenster fuer Inkrement" VALUE 0xF8C5E MSA15_FW3 0 DEZ_DW_U 0.000000 65535.000000 /end CHARACTERISTIC
/begin CHARACTERISTIC zhwOb_N_OL "#SSD grosse Drehzahln Oberes Plaus.fenster fuer Luecke" VALUE 0xF8C62 MSA15_FW3 0 DEZ_DW_U 0.000000 65535.000000 /end CHARACTERISTIC
/begin CHARACTERISTIC zhwOb_N_UI "#SSD grosse Drehzahln Unteres Plaus.fenster fuer Inkrement" VALUE 0xF8C5C MSA15_FW3 0 DEZ_DW_U 0.000000 65535.000000 /end CHARACTERISTIC
/begin CHARACTERISTIC zhwOb_N_UL "#SSD grosse Drehzahln Unteres Plaus.fenster fuer Luecke" VALUE 0xF8C60 MSA15_FW3 0 DEZ_DW_U 0.000000 65535.000000 /end CHARACTERISTIC
/begin CHARACTERISTIC zhwSGZLOPL "#SSD log.Plaus.: Anzahl der Ink. zw.den Luecken, Highbyte: Anzahl Z. in Luecke" VALUE 0xF8C2A MSA15_FW3 0 DEZ_DW_U 0.000000 65535.000000 /end CHARACTERISTIC
/begin CHARACTERISTIC zhwSSC_PRE "Entprellzaehler der IWZ Fehler bei Schnellsynchr., dzmNmit < zhwNsync" VALUE 0xF8C72 MSA15_FW1 0 DEZ_DB_U 0.000000 255.000000 /end CHARACTERISTIC
/begin CHARACTERISTIC zhwSTA_PRE "#SSD Ausblendung des Entprellz. im Startfall (Z/2 pro Umdr.)" VALUE 0xF8C70 MSA15_FW1 0 DEZ_DB_U 0.000000 255.000000 /end CHARACTERISTIC
/begin CHARACTERISTIC zhwTD_TEIL "#SSD Teiler fuer INK-Signal an TDS" VALUE 0xF8C2E MSA15_FW3 0 DEZ_DW_U 0.000000 65535.000000 /end CHARACTERISTIC
/begin CHARACTERISTIC zhwUn_N_OI "#SSD kleine Drehzahln Oberes Plaus.fenster fuer Inkrement" VALUE 0xF8C56 MSA15_FW3 0 DEZ_DW_U 0.000000 65535.000000 /end CHARACTERISTIC
/begin CHARACTERISTIC zhwUn_N_OL "#SSD kleines Drehzahl Oberes Plaus.fenster fuer Luecke" VALUE 0xF8C5A MSA15_FW3 0 DEZ_DW_U 0.000000 65535.000000 /end CHARACTERISTIC
/begin CHARACTERISTIC zhwUn_N_UI "#SSD kleine Drehzahln Unteres Plaus.fenster fuer Inkrement" VALUE 0xF8C54 MSA15_FW3 0 DEZ_DW_U 0.000000 65535.000000 /end CHARACTERISTIC
/begin CHARACTERISTIC zhwUn_N_UL "#SSD kleine Drehzahln Unteres Plaus.fenster fuer Luecke" VALUE 0xF8C58 MSA15_FW3 0 DEZ_DW_U 0.000000 65535.000000 /end CHARACTERISTIC
/begin CHARACTERISTIC zhwVECUR "#SSD Zeit Umschalten Anzug-/Haltestrom" VALUE 0xF8C30 MSA15_FW3 0 GA_uS 0.000000 65535.000000 /end CHARACTERISTIC
/begin CHARACTERISTIC zhwVEDELAY "#SSD Zeit bis Beginn Rechargefenster" VALUE 0xF8C44 MSA15_FW3 0 GA_uS 0.000000 65535.000000 /end CHARACTERISTIC
/begin CHARACTERISTIC zhwVELOESC "#SSD Zeit Ende Schnelloeschung" VALUE 0xF8C40 MSA15_FW3 0 GA_uS 0.000000 65535.000000 /end CHARACTERISTIC
/begin CHARACTERISTIC zhwVERCHG "#SSD Zeit bis Ende Rechargefenster" VALUE 0xF8C46 MSA15_FW3 0 GA_uS 0.000000 65535.000000 /end CHARACTERISTIC
/begin CHARACTERISTIC zhwVESELOF "#SSD Zeit bis Ruecksch. Zylinderauswahl" VALUE 0xF8C48 MSA15_FW3 0 GA_uS 0.000000 65535.000000 /end CHARACTERISTIC
/begin CHARACTERISTIC zhwVESELON "#SSD Zeit Ende Schnelloeschung bis Umsch." VALUE 0xF8C42 MSA15_FW3 0 GA_uS 0.000000 65535.000000 /end CHARACTERISTIC
/begin CHARACTERISTIC zhwZR_SOLL "#SSD Zylindernummer fuer Recharge" VALUE 0xF8C7A MSA15_FW3 0 DEZ_DW_U 0.000000 65535.000000 /end CHARACTERISTIC
/begin CHARACTERISTIC zhwZY_SOLL "#SSD Zylindernummer" VALUE 0xF8C78 MSA15_FW3 0 DEZ_DW_U 0.000000 65535.000000 /end CHARACTERISTIC
/begin CHARACTERISTIC zucCP3 "RP Schalter, ob CP3 verbaut" VALUE 0xFA04E MSA15_FW1 0 DEZ_DB_U 0.000000 1.000000 EXTENDED_LIMITS 0.000000 255.000000 /end CHARACTERISTIC
/begin CHARACTERISTIC zuwABHEmin "INJ spaetester Ansteuerbeginn HE" VALUE 0xF7472 MSA15_FW4 0 GradKW -10.007810 49.992190 EXTENDED_LIMITS -768.000000 767.976600 /end CHARACTERISTIC
/begin CHARACTERISTIC zuwABHG1KF "INJ GW KF AB HE mit VE, AB = f(N, M_EMOT)" MAP 0xF7EA2 MSA15_GKF4 0 GradKW -10.007810 49.992190
 /begin AXIS_DESCR COM_AXIS dzmNmit N 16 0.000000 6000.000000 AXIS_PTS_REF zuwXstzv EXTENDED_LIMITS 0.000000 32767.000000 /end AXIS_DESCR
 /begin AXIS_DESCR COM_AXIS mrmM_EMTS MM3 16 0.000000 325.000000 AXIS_PTS_REF zuwYstzv16 EXTENDED_LIMITS -327.680000 327.670000 /end AXIS_DESCR
 EXTENDED_LIMITS -768.000000 767.976600 /end CHARACTERISTIC
/begin RECORD_LAYOUT MSA15_GKF4 FNC_VALUES 1 SWORD COLUMN_DIR DIRECT /end RECORD_LAYOUT
/begin CHARACTERISTIC zuwABHG2KF "INJ GW KF AB HE ohne VE, AB = f(N, M_EMOT)" MAP 0xF80A2 MSA15_GKF4 0 GradKW -10.007810 49.992190
 /begin AXIS_DESCR COM_AXIS dzmNmit N 16 0.000000 6000.000000 AXIS_PTS_REF zuwXstzv EXTENDED_LIMITS 0.000000 32767.000000 /end AXIS_DESCR
 /begin AXIS_DESCR COM_AXIS mrmM_EMTS MM3 16 0.000000 325.000000 AXIS_PTS_REF zuwYstzv16 EXTENDED_LIMITS -327.680000 327.670000 /end AXIS_DESCR
 EXTENDED_LIMITS -768.000000 767.976600 /end CHARACTERISTIC
/begin CHARACTERISTIC zuwABHLkKF "INJ KorrekturKF AB HE; Winkel = f(N, M_EMOT)" MAP 0xF8786 MSA15_GKF4 0 GradKW -25.007810 25.007810
 /begin AXIS_DESCR COM_AXIS dzmNmit N 16 0.000000 6000.000000 AXIS_PTS_REF zuwXstzv EXTENDED_LIMITS 0.000000 32767.000000 /end AXIS_DESCR
 /begin AXIS_DESCR COM_AXIS mrmM_EMTS MM3 8 0.000000 325.000000 AXIS_PTS_REF zuwYstzv8 EXTENDED_LIMITS -327.680000 327.670000 /end AXIS_DESCR
 EXTENDED_LIMITS -768.000000 767.976600 /end CHARACTERISTIC
/begin CHARACTERISTIC zuwABHLkKL "INJ GewichtungsKL AB HE; Faktor = f(LTF)" CURVE 0xF9B96 MSA15_KL118 0 FAKT 0.000000 1.000000
 /begin AXIS_DESCR STD_AXIS anmLTF T 8 -50.040010 199.960000 EXTENDED_LIMITS -273.140000 3003.560000 /end AXIS_DESCR
 EXTENDED_LIMITS -3.276800 3.276700 /end CHARACTERISTIC
/begin CHARACTERISTIC zuwABHPLKF "HE-Ansteuerkorrektur als f(dLDF/dt, n)" MAP 0xF8ADC MSA15_KF382 0 GradKW -25.007810 25.007810
 /begin AXIS_DESCR STD_AXIS dzmNmit N 4 0.000000 6000.000000 EXTENDED_LIMITS 0.000000 32767.000000 /end AXIS_DESCR
 /begin AXIS_DESCR STD_AXIS zuoLDF_dt1 dP_dZ 4 -1000.000000 1000.000000 EXTENDED_LIMITS -1638400.000000 1638350.000000 /end AXIS_DESCR
 EXTENDED_LIMITS -768.000000 767.976600 /end CHARACTERISTIC
/begin CHARACTERISTIC zuwABHPkKF "INJ KorrekturKF AB HE; Winkel = f(N, M_EMOT)" MAP 0xF8686 MSA15_GKF4 0 GradKW -25.007810 25.007810
 /begin AXIS_DESCR COM_AXIS dzmNmit N 16 0.000000 6000.000000 AXIS_PTS_REF zuwXstzv EXTENDED_LIMITS 0.000000 32767.000000 /end AXIS_DESCR
 /begin AXIS_DESCR COM_AXIS mrmM_EMTS MM3 8 0.000000 325.000000 AXIS_PTS_REF zuwYstzv8 EXTENDED_LIMITS -327.680000 327.670000 /end AXIS_DESCR
 EXTENDED_LIMITS -768.000000 767.976600 /end CHARACTERISTIC
/begin CHARACTERISTIC zuwABHPkKL "INJ GewichtungsKL AB HE; Faktor = f(ADF)" CURVE 0xF9B5A MSA15_KL118 0 FAKT 0.000000 1.000000
 /begin AXIS_DESCR STD_AXIS ldmADF P 8 0.000000 3500.000000 EXTENDED_LIMITS -32768.000000 32767.000000 /end AXIS_DESCR
 EXTENDED_LIMITS -3.276800 3.276700 /end CHARACTERISTIC
/begin CHARACTERISTIC zuwABHSGKF "INJ GW KF AB HE ohne VE, AB = f(N, M_EMOT) fuer Startfall" MAP 0xF82A2 MSA15_GKF4 0 GradKW -10.007810 49.992190
 /begin AXIS_DESCR COM_AXIS dzmNmit N 6 0.000000 6000.000000 AXIS_PTS_REF zuwXstzv6 EXTENDED_LIMITS 0.000000 32767.000000 /end AXIS_DESCR
 /begin AXIS_DESCR COM_AXIS mrmM_EMTS MM3 8 0.000000 325.000000 AXIS_PTS_REF zuwYstzv8 EXTENDED_LIMITS -327.680000 327.670000 /end AXIS_DESCR
 EXTENDED_LIMITS -768.000000 767.976600 /end CHARACTERISTIC
/begin CHARACTERISTIC zuwABHSLKF "INJ AB HE = f(N, M_EMTS) fuer Startfall" MAP 0xF96F8 MSA15_GKF4 0 GradKW -25.007810 25.007810
 /begin AXIS_DESCR COM_AXIS dzmNmit N 4 0.000000 6000.000000 AXIS_PTS_REF zuwXstzv4 EXTENDED_LIMITS 0.000000 32767.000000 /end AXIS_DESCR
 /begin AXIS_DESCR COM_AXIS mrmM_EMTS MM3 6 0.000000 325.000000 AXIS_PTS_REF zuwYstzv6 EXTENDED_LIMITS -327.680000 327.670000 /end AXIS_DESCR
 EXTENDED_LIMITS -768.000000 767.976600 /end CHARACTERISTIC
/begin CHARACTERISTIC zuwABHSLKL "INJ AB HE = f(LTF) fuer Startfall" CURVE 0xF9728 MSA15_KL118 0 FAKT 0.000000 1.000000
 /begin AXIS_DESCR STD_AXIS anmLTF T 5 -50.040010 199.960000 EXTENDED_LIMITS -273.140000 3003.560000 /end AXIS_DESCR
 EXTENDED_LIMITS -3.276800 3.276700 /end CHARACTERISTIC
/begin CHARACTERISTIC zuwABHSPKF "INJ AB HE = f(N, M_EMTS) fuer Startfall" MAP 0xF9740 MSA15_GKF4 0 GradKW -25.007810 25.007810
 /begin AXIS_DESCR COM_AXIS dzmNmit N 4 0.000000 6000.000000 AXIS_PTS_REF zuwXstzv4 EXTENDED_LIMITS 0.000000 32767.000000 /end AXIS_DESCR
 /begin AXIS_DESCR COM_AXIS mrmM_EMTS MM3 6 0.000000 325.000000 AXIS_PTS_REF zuwYstzv6 EXTENDED_LIMITS -327.680000 327.670000 /end AXIS_DESCR
 EXTENDED_LIMITS -768.000000 767.976600 /end CHARACTERISTIC
/begin CHARACTERISTIC zuwABHSPKL "INJ GewichtungsKL AB HE = f(ADF)" CURVE 0xF9770 MSA15_KL118 0 FAKT 0.000000 1.000000
 /begin AXIS_DESCR STD_AXIS ldmADF P 5 0.000000 3500.000000 EXTENDED_LIMITS -32768.000000 32767.000000 /end AXIS_DESCR
 EXTENDED_LIMITS -3.276800 3.276700 /end CHARACTERISTIC
/begin CHARACTERISTIC zuwABHSWKL "INJ GewichtungsKL AB HE; Faktor = f(WTF)" CURVE 0xF8362 MSA15_KL118 0 FAKT 0.000000 1.000000
 /begin AXIS_DESCR STD_AXIS anmWTF T 8 -50.040010 149.960000 EXTENDED_LIMITS -273.140000 3003.560000 /end AXIS_DESCR
 EXTENDED_LIMITS -3.276800 3.276700 /end CHARACTERISTIC
/begin CHARACTERISTIC zuwABHS_KF "INJ KorrekturKF AB HE; Winkel = f(N, M_EMOT) fuer Startfall" MAP 0xF8302 MSA15_GKF4 0 GradKW -25.007810 25.007810
 /begin AXIS_DESCR COM_AXIS dzmNmit N 6 0.000000 6000.000000 AXIS_PTS_REF zuwXstzv6 EXTENDED_LIMITS 0.000000 32767.000000 /end AXIS_DESCR
 /begin AXIS_DESCR COM_AXIS mrmM_EMTS MM3 8 0.000000 325.000000 AXIS_PTS_REF zuwYstzv8 EXTENDED_LIMITS -327.680000 327.670000 /end AXIS_DESCR
 EXTENDED_LIMITS -768.000000 767.976600 /end CHARACTERISTIC
/begin CHARACTERISTIC zuwABHSfKF "INJ KorrekturKF AB HE; Winkel = f(anmWTF, mrmST_ABWF)" MAP 0xF9B7E MSA15_KF358 0 FAKT 0.000000 1.000000
 /begin AXIS_DESCR STD_AXIS anmWTF T 2 -50.040010 149.960000 EXTENDED_LIMITS -273.140000 3003.560000 /end AXIS_DESCR
 /begin AXIS_DESCR STD_AXIS mrmST_ABWF ZEIT_ST_S 2 0.000000 650.000000 EXTENDED_LIMITS 0.000000 655.350000 /end AXIS_DESCR
 EXTENDED_LIMITS -3.276800 3.276700 /end CHARACTERISTIC
/begin CHARACTERISTIC zuwABHSkKF "INJ KorrekturKF AB HE; Winkel = f(N, M_EMOT)" MAP 0xF8586 MSA15_GKF4 0 GradKW -25.007810 25.007810
 /begin AXIS_DESCR COM_AXIS dzmNmit N 16 0.000000 6000.000000 AXIS_PTS_REF zuwXstzv EXTENDED_LIMITS 0.000000 32767.000000 /end AXIS_DESCR
 /begin AXIS_DESCR COM_AXIS mrmM_EMTS MM3 8 0.000000 325.000000 AXIS_PTS_REF zuwYstzv8 EXTENDED_LIMITS -327.680000 327.670000 /end AXIS_DESCR
 EXTENDED_LIMITS -768.000000 767.976600 /end CHARACTERISTIC
/begin CHARACTERISTIC zuwABHW2KF "INJ KorrekturKF AB HE; Winkel = f(N, M_EMOT)" MAP 0xF8486 MSA15_GKF4 0 GradKW -25.007810 25.007810
 /begin AXIS_DESCR COM_AXIS dzmNmit N 16 0.000000 6000.000000 AXIS_PTS_REF zuwXstzv EXTENDED_LIMITS 0.000000 32767.000000 /end AXIS_DESCR
 /begin AXIS_DESCR COM_AXIS mrmM_EMTS MM3 8 0.000000 325.000000 AXIS_PTS_REF zuwYstzv8 EXTENDED_LIMITS -327.680000 327.670000 /end AXIS_DESCR
 EXTENDED_LIMITS -768.000000 767.976600 /end CHARACTERISTIC
/begin CHARACTERISTIC zuwABHW2KL "INJ GewichtungsKL (2.ter Freiheitsgrad) AB HE; Faktor = f(WTF)" CURVE 0xF9B36 MSA15_KL118 0 FAKT 0.000000 1.000000
 /begin AXIS_DESCR STD_AXIS anmWTF T 8 -50.040010 149.960000 EXTENDED_LIMITS -273.140000 3003.560000 /end AXIS_DESCR
 EXTENDED_LIMITS -3.276800 3.276700 /end CHARACTERISTIC
/begin CHARACTERISTIC zuwABHWkKF "INJ KorrekturKF AB HE; Winkel = f(N, M_EMOT)" MAP 0xF8386 MSA15_GKF4 0 GradKW -25.007810 25.007810
 /begin AXIS_DESCR COM_AXIS dzmNmit N 16 0.000000 6000.000000 AXIS_PTS_REF zuwXstzv EXTENDED_LIMITS 0.000000 32767.000000 /end AXIS_DESCR
 /begin AXIS_DESCR COM_AXIS mrmM_EMTS MM3 8 0.000000 325.000000 AXIS_PTS_REF zuwYstzv8 EXTENDED_LIMITS -327.680000 327.670000 /end AXIS_DESCR
 EXTENDED_LIMITS -768.000000 767.976600 /end CHARACTERISTIC
/begin CHARACTERISTIC zuwABHWkKL "INJ GewichtungsKL AB HE; Faktor = f(WTF)" CURVE 0xF9B12 MSA15_KL118 0 FAKT 0.000000 1.000000
 /begin AXIS_DESCR STD_AXIS anmWTF T 8 -50.040010 149.960000 EXTENDED_LIMITS -273.140000 3003.560000 /end AXIS_DESCR
 EXTENDED_LIMITS -3.276800 3.276700 /end CHARACTERISTIC
/begin CHARACTERISTIC zuwABHmxKF "INJ fruehester Anteuerbeginn HE, Winkel = f(N, M_EMOT)" MAP 0xF7DA2 MSA15_GKF4 0 GradKW -10.007810 49.992190
 /begin AXIS_DESCR COM_AXIS dzmNmit N 16 0.000000 6000.000000 AXIS_PTS_REF zuwXstzv EXTENDED_LIMITS 0.000000 32767.000000 /end AXIS_DESCR
 /begin AXIS_DESCR COM_AXIS mrmM_EMTS MM3 8 0.000000 325.000000 AXIS_PTS_REF zuwYstzv8 EXTENDED_LIMITS -327.680000 327.670000 /end AXIS_DESCR
 EXTENDED_LIMITS -768.000000 767.976600 /end CHARACTERISTIC
/begin CHARACTERISTIC zuwABNEmax "INJ spaetester Ansteuerbeginn NE" VALUE 0xF7474 MSA15_FW4 0 GradKW -210.000000 0.000000 EXTENDED_LIMITS -768.000000 767.976600 /end CHARACTERISTIC
/begin CHARACTERISTIC zuwABNEmin "INJ fruehester Ansteuerbeginn NE" VALUE 0xF7476 MSA15_FW4 0 GradKW -210.000000 0.000000 EXTENDED_LIMITS -768.000000 767.976600 /end CHARACTERISTIC
/begin CHARACTERISTIC zuwABNGWKF "INJ GrundwerteKF Ansteuerbeginn" MAP 0xF8FC0 MSA15_GKF4 0 GradKW -210.000000 0.000000
 /begin AXIS_DESCR COM_AXIS dzmNmit N 8 0.000000 6000.000000 AXIS_PTS_REF zuwDZstzv EXTENDED_LIMITS 0.000000 32767.000000 /end AXIS_DESCR
 /begin AXIS_DESCR COM_AXIS mrmM_EAKT MM3 8 0.000000 325.000000 AXIS_PTS_REF zuwMEstzv EXTENDED_LIMITS -327.680000 327.670000 /end AXIS_DESCR
 EXTENDED_LIMITS -768.000000 767.976600 /end CHARACTERISTIC
/begin CHARACTERISTIC zuwABNWTKF "Korrekturgrundkennfeld  Motormenge fuer Nacheinspritzung" MAP 0xF9040 MSA15_GKF4 0 GradKW -210.000000 210.000000
 /begin AXIS_DESCR COM_AXIS dzmNmit N 8 0.000000 6000.000000 AXIS_PTS_REF zuwDZstzv EXTENDED_LIMITS 0.000000 32767.000000 /end AXIS_DESCR
 /begin AXIS_DESCR COM_AXIS mrmM_EAKT MM3 8 0.000000 325.000000 AXIS_PTS_REF zuwMEstzv EXTENDED_LIMITS -327.680000 327.670000 /end AXIS_DESCR
 EXTENDED_LIMITS -768.000000 767.976600 /end CHARACTERISTIC
/begin CHARACTERISTIC zuwABNWTKL "AB_NE Temperaturkorrekturkennlinie." CURVE 0xF9198 MSA15_KL118 0 FAKT 0.000000 2.000000
 /begin AXIS_DESCR STD_AXIS anmWTF T 6 -50.040010 149.960000 EXTENDED_LIMITS -273.140000 3003.560000 /end AXIS_DESCR
 EXTENDED_LIMITS -3.276800 3.276700 /end CHARACTERISTIC
/begin CHARACTERISTIC zuwABRVEmx "#SSD INJ fruehester Ansteuerbeginn VE (relativ zur HE)" VALUE 0xF746E MSA15_FW4 0 GradKW 0.000000 90.000000 EXTENDED_LIMITS -768.000000 767.976600 /end CHARACTERISTIC
/begin CHARACTERISTIC zuwABVEmax "#SSD INJ fruehester Ansteuerbeginn VE (absolut)" VALUE 0xF746C MSA15_FW4 0 GradKW 0.000000 90.000000 EXTENDED_LIMITS -768.000000 767.976600 /end CHARACTERISTIC
/begin CHARACTERISTIC zuwABVGWKF "INJ GrundwerteKF Ansteuerbeginn VE rel. = f(N, M_EMOT)" MAP 0xF747E MSA15_GKF4 0 GradKW 0.000000 90.000000
 /begin AXIS_DESCR COM_AXIS dzmNmit N 16 0.000000 6000.000000 AXIS_PTS_REF zuwXstzv EXTENDED_LIMITS 0.000000 32767.000000 /end AXIS_DESCR
 /begin AXIS_DESCR COM_AXIS mrmM_EMTS MM3 16 0.000000 325.000000 AXIS_PTS_REF zuwYstzv16 EXTENDED_LIMITS -327.680000 327.670000 /end AXIS_DESCR
 EXTENDED_LIMITS -768.000000 767.976600 /end CHARACTERISTIC
/begin CHARACTERISTIC zuwABVLkKL "INJ GewichtungsKL AB VE; Faktor = f(LTF)" CURVE 0xF9A22 MSA15_KL118 0 FAKT 0.000000 1.000000
 /begin AXIS_DESCR STD_AXIS anmLTF T 8 -50.040010 199.960000 EXTENDED_LIMITS -273.140000 3003.560000 /end AXIS_DESCR
 EXTENDED_LIMITS -3.276800 3.276700 /end CHARACTERISTIC
/begin CHARACTERISTIC zuwABVSGKF "INJ GrundwerteKF Ansteuerbeginn VE rel. = f(N, M_EMOT)fuer Startfall" MAP 0xF777E MSA15_GKF4 0 GradKW 0.000000 90.000000
 /begin AXIS_DESCR COM_AXIS dzmNmit N 6 0.000000 6000.000000 AXIS_PTS_REF zuwXstzv6 EXTENDED_LIMITS 0.000000 32767.000000 /end AXIS_DESCR
 /begin AXIS_DESCR COM_AXIS mrmM_EMTS MM3 8 0.000000 325.000000 AXIS_PTS_REF zuwYstzv8 EXTENDED_LIMITS -327.680000 327.670000 /end AXIS_DESCR
 EXTENDED_LIMITS -768.000000 767.976600 /end CHARACTERISTIC
/begin CHARACTERISTIC zuwABVSWKL "INJ GewichtungsKL AB VE; Faktor = f(WTF)" CURVE 0xF783E MSA15_KL118 0 FAKT 0.000000 1.000000
 /begin AXIS_DESCR STD_AXIS anmWTF T 8 -50.040010 149.960000 EXTENDED_LIMITS -273.140000 3003.560000 /end AXIS_DESCR
 EXTENDED_LIMITS -3.276800 3.276700 /end CHARACTERISTIC
/begin CHARACTERISTIC zuwABVSkKF "INJ KorrekturKF AB VE; Winkel = f(N, M_EMOT) fuer Startfall" MAP 0xF77DE MSA15_GKF4 0 GradKW -25.007810 25.007810
 /begin AXIS_DESCR COM_AXIS dzmNmit N 6 0.000000 6000.000000 AXIS_PTS_REF zuwXstzv6 EXTENDED_LIMITS 0.000000 32767.000000 /end AXIS_DESCR
 /begin AXIS_DESCR COM_AXIS mrmM_EMTS MM3 8 0.000000 325.000000 AXIS_PTS_REF zuwYstzv8 EXTENDED_LIMITS -327.680000 327.670000 /end AXIS_DESCR
 EXTENDED_LIMITS -768.000000 767.976600 /end CHARACTERISTIC
/begin CHARACTERISTIC zuwABVWkKL "INJ GewichtungsKL AB VE; Faktor = f(WTF)" CURVE 0xF99FE MSA15_KL118 0 FAKT 0.000000 1.000000
 /begin AXIS_DESCR STD_AXIS anmWTF T 8 -50.040010 149.960000 EXTENDED_LIMITS -273.140000 3003.560000 /end AXIS_DESCR
 EXTENDED_LIMITS -3.276800 3.276700 /end CHARACTERISTIC
/begin CHARACTERISTIC zuwABVdWKF "INJ KorrekturKF AB VE; Winkel = f(N, M_EMOT)" MAP 0xF767E MSA15_GKF4 0 GradKW -25.007810 25.007810
 /begin AXIS_DESCR COM_AXIS dzmNmit N 16 0.000000 6000.000000 AXIS_PTS_REF zuwXstzv EXTENDED_LIMITS 0.000000 32767.000000 /end AXIS_DESCR
 /begin AXIS_DESCR COM_AXIS mrmM_EMTS MM3 8 0.000000 325.000000 AXIS_PTS_REF zuwYstzv8 EXTENDED_LIMITS -327.680000 327.670000 /end AXIS_DESCR
 EXTENDED_LIMITS -768.000000 767.976600 /end CHARACTERISTIC
/begin CHARACTERISTIC zuwABdHEmx "INJ max. dyn. AB-Verlagerung" VALUE 0xF747C MSA15_FW4 0 GradKW -10.007810 10.007810 EXTENDED_LIMITS -768.000000 767.976600 /end CHARACTERISTIC
/begin CHARACTERISTIC zuwABkRMP "Rampenschrittweite Ansteuerbeginnkorrektur" VALUE 0xF9366 MSA15_FW4 0 dt_KW 0.000000 19.995120 EXTENDED_LIMITS 0.000000 2399.927000 /end CHARACTERISTIC
/begin CHARACTERISTIC zuwAD_KF10 "INJ AD ohne VE [us] = f(P_RAIL, ME)" MAP 0xF5B88 MSA15_KF382 0 AD_uS 0.000000 5000.000000
 /begin AXIS_DESCR STD_AXIS zumP_RAIL RP 15 0.000000 1500000.000000 EXTENDED_LIMITS -3276800.000000 3276700.000000 /end AXIS_DESCR
 /begin AXIS_DESCR STD_AXIS zuoME_KORR MM3 32 0.000000 325.000000 EXTENDED_LIMITS -327.680000 327.670000 /end AXIS_DESCR
 EXTENDED_LIMITS -32768.000000 32767.000000 /end CHARACTERISTIC
/begin CHARACTERISTIC zuwAD_KF11 "INJ AD ohne VE [us] = f(P_RAIL, ME)" MAP 0xF5FAE MSA15_KF382 0 AD_uS 0.000000 5000.000000
 /begin AXIS_DESCR STD_AXIS zumP_RAIL RP 15 0.000000 1500000.000000 EXTENDED_LIMITS -3276800.000000 3276700.000000 /end AXIS_DESCR
 /begin AXIS_DESCR STD_AXIS zuoME_KORR MM3 32 0.000000 325.000000 EXTENDED_LIMITS -327.680000 327.670000 /end AXIS_DESCR
 EXTENDED_LIMITS -32768.000000 32767.000000 /end CHARACTERISTIC
/begin CHARACTERISTIC zuwAD_KF12 "INJ AD ohne VE [us] = f(P_RAIL, ME)" MAP 0xF63D4 MSA15_KF382 0 AD_uS 0.000000 5000.000000
 /begin AXIS_DESCR STD_AXIS zumP_RAIL RP 15 0.000000 1500000.000000 EXTENDED_LIMITS -3276800.000000 3276700.000000 /end AXIS_DESCR
 /begin AXIS_DESCR STD_AXIS zuoME_KORR MM3 32 0.000000 325.000000 EXTENDED_LIMITS -327.680000 327.670000 /end AXIS_DESCR
 EXTENDED_LIMITS -32768.000000 32767.000000 /end CHARACTERISTIC
/begin CHARACTERISTIC zuwAD_KF20 "INJ AD mit VE [us] = f(P_RAIL, ME)" MAP 0xF67FA MSA15_KF382 0 AD_uS 0.000000 5000.000000
 /begin AXIS_DESCR STD_AXIS zumP_RAIL RP 15 0.000000 1500000.000000 EXTENDED_LIMITS -3276800.000000 3276700.000000 /end AXIS_DESCR
 /begin AXIS_DESCR STD_AXIS zuoME_KORR MM3 32 0.000000 325.000000 EXTENDED_LIMITS -327.680000 327.670000 /end AXIS_DESCR
 EXTENDED_LIMITS -32768.000000 32767.000000 /end CHARACTERISTIC
/begin CHARACTERISTIC zuwAD_KF21 "INJ AD mit VE [us] = f(P_RAIL, ME)" MAP 0xF6C20 MSA15_KF382 0 AD_uS 0.000000 5000.000000
 /begin AXIS_DESCR STD_AXIS zumP_RAIL RP 15 0.000000 1500000.000000 EXTENDED_LIMITS -3276800.000000 3276700.000000 /end AXIS_DESCR
 /begin AXIS_DESCR STD_AXIS zuoME_KORR MM3 32 0.000000 325.000000 EXTENDED_LIMITS -327.680000 327.670000 /end AXIS_DESCR
 EXTENDED_LIMITS -32768.000000 32767.000000 /end CHARACTERISTIC
/begin CHARACTERISTIC zuwAD_KF22 "INJ AD mit VE [us] = f(P_RAIL, ME)" MAP 0xF7046 MSA15_KF382 0 AD_uS 0.000000 5000.000000
 /begin AXIS_DESCR STD_AXIS zumP_RAIL RP 15 0.000000 1500000.000000 EXTENDED_LIMITS -3276800.000000 3276700.000000 /end AXIS_DESCR
 /begin AXIS_DESCR STD_AXIS zuoME_KORR MM3 32 0.000000 325.000000 EXTENDED_LIMITS -327.680000 327.670000 /end AXIS_DESCR
 EXTENDED_LIMITS -32768.000000 32767.000000 /end CHARACTERISTIC
/begin CHARACTERISTIC zuwAD_KOR "Korrektur fuer Injektorkennfeld" MAP 0xF4E0C MSA15_KF382 0 MM3 0.000000 100.000000
 /begin AXIS_DESCR STD_AXIS mrmM_EKORR MM3 10 0.000000 100.000000 EXTENDED_LIMITS -327.680000 327.670000 /end AXIS_DESCR
 /begin AXIS_DESCR STD_AXIS dzmNmit N 10 0.000000 6000.000000 EXTENDED_LIMITS 0.000000 32767.000000 /end AXIS_DESCR
 EXTENDED_LIMITS -327.680000 327.670000 /end CHARACTERISTIC
/begin CHARACTERISTIC zuwANEGKF "NE Ansteuerdauergrundkennfeld M_E = f(N, M_EAKT)" MAP 0xF91B4 MSA15_KF382 0 MM3 0.000000 100.000000
 /begin AXIS_DESCR STD_AXIS dzmNmit N 8 0.000000 6000.000000 EXTENDED_LIMITS 0.000000 32767.000000 /end AXIS_DESCR
 /begin AXIS_DESCR STD_AXIS mrmM_EAKT MM3 8 0.000000 100.000000 EXTENDED_LIMITS -327.680000 327.670000 /end AXIS_DESCR
 EXTENDED_LIMITS -327.680000 327.670000 /end CHARACTERISTIC
/begin CHARACTERISTIC zuwANEKF "Grundkennfeld Motormenge Abschaltung NE" MAP 0xF90C0 MSA15_GKF4 0 PROZ 0.000000 100.000000
 /begin AXIS_DESCR COM_AXIS dzmNmit N 8 0.000000 6000.000000 AXIS_PTS_REF zuwDZstzv EXTENDED_LIMITS 0.000000 32767.000000 /end AXIS_DESCR
 /begin AXIS_DESCR COM_AXIS mrmM_EAKT MM3 8 0.000000 325.000000 AXIS_PTS_REF zuwMEstzv EXTENDED_LIMITS -327.680000 327.670000 /end AXIS_DESCR
 EXTENDED_LIMITS -327.680000 327.670000 /end CHARACTERISTIC
/begin CHARACTERISTIC zuwANELKKL "Abschaltung NE Lufttemperaturkorrekturkennlinie." CURVE 0xF914C MSA15_KL118 0 PROZ -100.000000 100.000000
 /begin AXIS_DESCR STD_AXIS anmLTF T 6 -50.040010 199.960000 EXTENDED_LIMITS -273.140000 3003.560000 /end AXIS_DESCR
 EXTENDED_LIMITS -327.680000 327.670000 /end CHARACTERISTIC
/begin CHARACTERISTIC zuwANEWKKL "Abschaltung NE Temperaturkorrekturkennlinie." CURVE 0xF9140 MSA15_KL118 0 PROZ 0.000000 100.000000
 /begin AXIS_DESCR STD_AXIS anmWTF T 2 -50.040010 149.960000 EXTENDED_LIMITS -273.140000 3003.560000 /end AXIS_DESCR
 EXTENDED_LIMITS -327.680000 327.670000 /end CHARACTERISTIC
/begin CHARACTERISTIC zuwANEWTKF "NE Ansteuerdauergrundkennfeld M_E = f(N, M_EAKT)" MAP 0xF925C MSA15_KF382 0 MM3 -100.000000 100.000000
 /begin AXIS_DESCR STD_AXIS dzmNmit N 6 0.000000 6000.000000 EXTENDED_LIMITS 0.000000 32767.000000 /end AXIS_DESCR
 /begin AXIS_DESCR STD_AXIS mrmM_EAKT MM3 6 0.000000 100.000000 EXTENDED_LIMITS -327.680000 327.670000 /end AXIS_DESCR
 EXTENDED_LIMITS -327.680000 327.670000 /end CHARACTERISTIC
/begin CHARACTERISTIC zuwANEWTKL "AD_NE Temperaturkorrekturkennlinie." CURVE 0xF92C4 MSA15_KL118 0 FAKT -3.200000 3.200000
 /begin AXIS_DESCR STD_AXIS anmWTF T 6 -50.040010 149.960000 EXTENDED_LIMITS -273.140000 3003.560000 /end AXIS_DESCR
 EXTENDED_LIMITS -3.276800 3.276700 /end CHARACTERISTIC
/begin CHARACTERISTIC zuwANEaus "INJ obere Schwelle fuer NE 'aus'" VALUE 0xF935E MSA15_FW4 0 PROZ 0.000000 100.000000 EXTENDED_LIMITS -327.680000 327.670000 /end CHARACTERISTIC
/begin CHARACTERISTIC zuwANEein "INJ untere Schwelle fuer NE 'ein'" VALUE 0xF9360 MSA15_FW4 0 PROZ 0.000000 100.000000 EXTENDED_LIMITS -327.680000 327.670000 /end CHARACTERISTIC
/begin CHARACTERISTIC zuwANTaus "Abgastemperatur obere Schwelle fuer NE 'aus'" VALUE 0xF9362 MSA15_FW4 0 T -50.040010 899.960000 EXTENDED_LIMITS -273.140000 3003.560000 /end CHARACTERISTIC
/begin CHARACTERISTIC zuwANTein "Abgastemperatur untere Schwelle fuer NE 'ein'" VALUE 0xF9364 MSA15_FW4 0 T -50.040010 899.960000 EXTENDED_LIMITS -273.140000 3003.560000 /end CHARACTERISTIC
/begin CHARACTERISTIC zuwA_VEaus "INJ untere Schwelle bei ARG fuer VE ausschalten" VALUE 0xF5A80 MSA15_FW4 0 VEon_off 0.000000 100.000000 EXTENDED_LIMITS -3276.800000 3276.700000 /end CHARACTERISTIC
/begin CHARACTERISTIC zuwA_VEein "INJ obere Schwelle bei AGR fuer VE einschalten" VALUE 0xF5A82 MSA15_FW4 0 VEon_off 0.000000 100.000000 EXTENDED_LIMITS -3276.800000 3276.700000 /end CHARACTERISTIC
/begin CHARACTERISTIC zuwDRPmax "RPC maximale Differenz begr.Psoll - korr.Psoll" VALUE 0xF501A MSA15_FW4 0 RP 0.000000 1350000.000000 EXTENDED_LIMITS -3276800.000000 3276700.000000 /end CHARACTERISTIC
/begin AXIS_PTS zuwDZstzv "Stuetzstellen fuer die Eingangsgroesse dzmNmit" 0xF8F98 dzmNmit MSA15_SST115 0 N 8 0.000000 6000.000000 EXTENDED_LIMITS 0.000000 32767.000000 /end AXIS_PTS
/begin RECORD_LAYOUT MSA15_SST115 SRC_ADDR_X 1 UWORD NO_AXIS_PTS_X 2 UWORD AXIS_PTS_X 3 SWORD INDEX_INCR DIRECT /end RECORD_LAYOUT
/begin CHARACTERISTIC zuwEL_KF "RPC BetriebspunkteKF Elementschaltung" MAP 0xF5A88 MSA15_GKF4 0 ELon_off 0.000000 100.000000
 /begin AXIS_DESCR COM_AXIS dzmNmit N 16 0.000000 6000.000000 AXIS_PTS_REF zuwXstzv EXTENDED_LIMITS 0.000000 32767.000000 /end AXIS_DESCR
 /begin AXIS_DESCR COM_AXIS mrmM_EAKT MM3 8 0.000000 325.000000 AXIS_PTS_REF zuwYEakt8 EXTENDED_LIMITS -327.680000 327.670000 /end AXIS_DESCR
 EXTENDED_LIMITS -3276.800000 3276.700000 /end CHARACTERISTIC
/begin CHARACTERISTIC zuwEL_KTof "RPC Abschalttemp. fuer 3. Pumpenlement" VALUE 0xF8A88 MSA15_FW4 0 T -0.040009 199.960000 EXTENDED_LIMITS -273.140000 3003.560000 /end CHARACTERISTIC
/begin CHARACTERISTIC zuwEL_KTon "RPC Einschalttemp. fuer 3. Pumpenelement" VALUE 0xF8A86 MSA15_FW4 0 T -0.040009 199.960000 EXTENDED_LIMITS -273.140000 3003.560000 /end CHARACTERISTIC
/begin CHARACTERISTIC zuwEL_Noff "RPC Drehzahlschwelle bei heissem Kraftstoff" VALUE 0xF8A78 MSA15_FW4 0 N 0.000000 6000.000000 EXTENDED_LIMITS 0.000000 32767.000000 /end CHARACTERISTIC
/begin CHARACTERISTIC zuwEL_PBof "RPC untere TV-Schwelle 3.Pumpenelement" VALUE 0xF5A60 MSA15_FW4 0 PROZ 0.000000 100.000000 EXTENDED_LIMITS -327.680000 327.670000 /end CHARACTERISTIC
/begin CHARACTERISTIC zuwEL_PBon "RPC obere TV-Schwelle 3.Pumpenelement" VALUE 0xF5A62 MSA15_FW4 0 PROZ 0.000000 100.000000 EXTENDED_LIMITS -327.680000 327.670000 /end CHARACTERISTIC
/begin CHARACTERISTIC zuwEL_dPof "RPC untere Diff.-Druckschwelle (Soll-Ist) 3. Pumpenelement" VALUE 0xF8A8E MSA15_FW4 0 RP -1350000.000000 1350000.000000 EXTENDED_LIMITS -3276800.000000 3276700.000000 /end CHARACTERISTIC
/begin CHARACTERISTIC zuwEL_dPon "RPC obere Diff.-Druckschwelle (Soll-Ist) 3. Pumpenelement" VALUE 0xF8A90 MSA15_FW4 0 RP -1350000.000000 1350000.000000 EXTENDED_LIMITS -3276800.000000 3276700.000000 /end CHARACTERISTIC
/begin CHARACTERISTIC zuwEL_off "RPC untere Schaltschwelle 3.Pumpenelement" VALUE 0xF5A58 MSA15_FW4 0 ELon_off 0.000000 100.000000 EXTENDED_LIMITS -3276.800000 3276.700000 /end CHARACTERISTIC
/begin CHARACTERISTIC zuwEL_on "RPC obere Schaltschwelle 3.Pumpenelement" VALUE 0xF5A5A MSA15_FW4 0 ELon_off 0.000000 100.000000 EXTENDED_LIMITS -3276.800000 3276.700000 /end CHARACTERISTIC
/begin CHARACTERISTIC zuwELtdPof "RPC Abfallzeit Druckhyst. Elementabschaltung" VALUE 0xF8A7A MSA15_FW3 0 ZEIT_ST 0.000000 655350000.000000 /end CHARACTERISTIC
/begin CHARACTERISTIC zuwFRP_KL "INJ Korr-Fakt dyn. AB-Verlagerung" CURVE 0xF89FE MSA15_KL118 0 FAKT 0.000000 1.000000
 /begin AXIS_DESCR STD_AXIS zuoRPbeg RP 8 -1350000.000000 1350000.000000 EXTENDED_LIMITS -3276800.000000 3276700.000000 /end AXIS_DESCR
 EXTENDED_LIMITS -3.276800 3.276700 /end CHARACTERISTIC
/begin CHARACTERISTIC zuwGR_MAX "#SSD RPC obere Begrenzung PI-Regler Ausgang" VALUE 0xF59D8 MSA15_FW4 0 PROZ 0.000000 100.000000 EXTENDED_LIMITS -327.680000 327.670000 /end CHARACTERISTIC
/begin CHARACTERISTIC zuwGR_MIN "#SSD RPC untere Begrenzung PI-Regler Ausgang" VALUE 0xF59DA MSA15_FW4 0 PROZ 0.000000 100.000000 EXTENDED_LIMITS -327.680000 327.670000 /end CHARACTERISTIC
/begin CHARACTERISTIC zuwGRmaxST "RPC ob. Begr. PI-Regler Ausgang bei Start" VALUE 0xF59DC MSA15_FW4 0 PROZ 0.000000 100.000000 EXTENDED_LIMITS -327.680000 327.670000 /end CHARACTERISTIC
/begin CHARACTERISTIC zuwGRminST "RPC unt. Begr. PI-Regler Ausgang bei Start" VALUE 0xF59DE MSA15_FW4 0 PROZ 0.000000 100.000000 EXTENDED_LIMITS -327.680000 327.670000 /end CHARACTERISTIC
/begin CHARACTERISTIC zuwIRNEGKL "RPC I-Verstaerkung neg. Grossignal" CURVE 0xF598C MSA15_GKL4 0 RPC_KI 0.000000 0.010000
 /begin AXIS_DESCR COM_AXIS dzmNmit N 16 0.000000 6000.000000 AXIS_PTS_REF zuwXstzv EXTENDED_LIMITS 0.000000 32767.000000 /end AXIS_DESCR
 EXTENDED_LIMITS -0.020000 0.019999 /end CHARACTERISTIC
/begin RECORD_LAYOUT MSA15_GKL4 FNC_VALUES 1 SWORD COLUMN_DIR DIRECT /end RECORD_LAYOUT
/begin CHARACTERISTIC zuwIRPOSKL "RPC I-Verstaerkung pos. Grossignal" CURVE 0xF596C MSA15_GKL4 0 RPC_KI 0.000000 0.010000
 /begin AXIS_DESCR COM_AXIS dzmNmit N 16 0.000000 6000.000000 AXIS_PTS_REF zuwXstzv EXTENDED_LIMITS 0.000000 32767.000000 /end AXIS_DESCR
 EXTENDED_LIMITS -0.020000 0.019999 /end CHARACTERISTIC
/begin CHARACTERISTIC zuwIRSIGKL "RPC I-Verstaerkung Kleinsignal" CURVE 0xF594C MSA15_GKL4 0 RPC_KI 0.000000 0.010000
 /begin AXIS_DESCR COM_AXIS dzmNmit N 16 0.000000 6000.000000 AXIS_PTS_REF zuwXstzv EXTENDED_LIMITS 0.000000 32767.000000 /end AXIS_DESCR
 EXTENDED_LIMITS -0.020000 0.019999 /end CHARACTERISTIC
/begin CHARACTERISTIC zuwIR_FEN "RPC Fenster Kleinsignal I-Anteil" VALUE 0xF59CE MSA15_FW4 0 RP 0.000000 1350000.000000 EXTENDED_LIMITS -3276800.000000 3276700.000000 /end CHARACTERISTIC
/begin CHARACTERISTIC zuwKAT_ME1 "Mengen-Fenster (Max-Grenze) Katueberwachung" VALUE 0xF9352 MSA15_FW4 0 MM3 0.000000 325.000000 EXTENDED_LIMITS -327.680000 327.670000 /end CHARACTERISTIC
/begin CHARACTERISTIC zuwKAT_ME2 "Mengen-Fenster (Min-Grenze) Katueberwachung" VALUE 0xF9354 MSA15_FW4 0 MM3 0.000000 325.000000 EXTENDED_LIMITS -327.680000 327.670000 /end CHARACTERISTIC
/begin CHARACTERISTIC zuwKAT_N1 "N-Fenster (Max-Grenze) Kat-Ueberwachung" VALUE 0xF9356 MSA15_FW4 0 N 0.000000 6000.000000 EXTENDED_LIMITS 0.000000 32767.000000 /end CHARACTERISTIC
/begin CHARACTERISTIC zuwKAT_N2 "N-Fenster (Min-Grenze) Kat-Ueberwachung" VALUE 0xF9358 MSA15_FW4 0 N 0.000000 6000.000000 EXTENDED_LIMITS 0.000000 32767.000000 /end CHARACTERISTIC
/begin CHARACTERISTIC zuwKAT_T1 "Maximalwert Abgastemperatur T1" VALUE 0xF935A MSA15_FW4 0 T -0.040009 599.960000 EXTENDED_LIMITS -273.140000 3003.560000 /end CHARACTERISTIC
/begin CHARACTERISTIC zuwKAT_dT "Maximalwert Abgastemperaturdifferenz |AT2 - AT1|" VALUE 0xF935C MSA15_FW4 0 dT 0.000000 200.000000 EXTENDED_LIMITS 0.000000 3276.700000 /end CHARACTERISTIC
/begin CHARACTERISTIC zuwKDPSmax "KDP maximal zul. P_Rail-Regelabweichung fuer Plaus.-Pruefung" VALUE 0xF8A96 MSA15_FW4 0 RP 0.000000 1350000.000000 EXTENDED_LIMITS -3276800.000000 3276700.000000 /end CHARACTERISTIC
/begin CHARACTERISTIC zuwKDP_Mo "KDP Obere M-Schwelle fuer Plaus.-Pruefung" VALUE 0xF8A9A MSA15_FW4 0 MM3 0.000000 100.000000 EXTENDED_LIMITS -327.680000 327.670000 /end CHARACTERISTIC
/begin CHARACTERISTIC zuwKDP_No "KDP Obere N-Schwelle fuer Plaus.-Pruefung" VALUE 0xF8A9C MSA15_FW4 0 N 0.000000 6000.000000 EXTENDED_LIMITS 0.000000 32767.000000 /end CHARACTERISTIC
/begin CHARACTERISTIC zuwKDP_Nu "KDP Untere N-Schwelle fuer Plaus.-Pruefung" VALUE 0xF8A9E MSA15_FW4 0 N 0.000000 6000.000000 EXTENDED_LIMITS 0.000000 32767.000000 /end CHARACTERISTIC
/begin CHARACTERISTIC zuwKDP_T "KDP Wartezeit nach Unterschreitung delta - R_Rail max" VALUE 0xF8A98 MSA15_FW3 0 ZEIT_ST 0.000000 655350000.000000 /end CHARACTERISTIC
/begin CHARACTERISTIC zuwLDF_GF "HE-Korr. LDF Filterzeitkonstante dLDF/dt-Differenzierer" VALUE 0xF8B18 MSA15_FW4 0 GF 0.000031 0.999969 /end CHARACTERISTIC
/begin CHARACTERISTIC zuwLDF_KOF "HE-Korr. LDF-Verstaerkungskoeffizient LDF-Differenzierer" VALUE 0xF8B14 MSA15_FW4 0 zuDT1_dLDF 0.000000 2.857208 EXTENDED_LIMITS -6.250000 6.249809 /end CHARACTERISTIC
/begin CHARACTERISTIC zuwLFT_AD "#SSD INJ Rail-Entlueftung Ansteuerdauer" VALUE 0xF502A MSA15_FW4 0 AD_uS 0.000000 5000.000000 EXTENDED_LIMITS -32768.000000 32767.000000 /end CHARACTERISTIC
/begin CHARACTERISTIC zuwLFT_N1 "#SSD INJ Rail-Entlueftung untere n-Schwelle" VALUE 0xF5024 MSA15_FW4 0 N 0.000000 600.000000 EXTENDED_LIMITS 0.000000 32767.000000 /end CHARACTERISTIC
/begin CHARACTERISTIC zuwLFT_N2 "#SSD INJ Rail-Entlueftung obere n-Schwelle" VALUE 0xF5026 MSA15_FW4 0 N 0.000000 600.000000 EXTENDED_LIMITS 0.000000 32767.000000 /end CHARACTERISTIC
/begin CHARACTERISTIC zuwLFT_P "#SSD INJ Rail-Entlueftung Druckschwelle" VALUE 0xF5022 MSA15_FW4 0 RP 0.000000 200000.000000 EXTENDED_LIMITS -3276800.000000 3276700.000000 /end CHARACTERISTIC
/begin CHARACTERISTIC zuwLFT_t "#SSD INJ Rail-Entlueftung Verzoegerungszeit" VALUE 0xF5028 MSA15_FW3 0 ZEIT_ST 0.000000 655350000.000000 /end CHARACTERISTIC
/begin CHARACTERISTIC zuwLRRF_KF "INJ LRR-VE-Faktor = f(M_EMOT,P_RAIL)" MAP 0xF8B1A MSA15_KF382 0 FAKT 0.000000 1.000000
 /begin AXIS_DESCR STD_AXIS mrmM_EMTS MM3 4 0.000000 100.000000 EXTENDED_LIMITS -327.680000 327.670000 /end AXIS_DESCR
 /begin AXIS_DESCR STD_AXIS zumP_RAIL RP 4 0.000000 1500000.000000 EXTENDED_LIMITS -3276800.000000 3276700.000000 /end AXIS_DESCR
 EXTENDED_LIMITS -3.276800 3.276700 /end CHARACTERISTIC
/begin CHARACTERISTIC zuwMEVGWKF "INJ Menge VE, ME = f(N, M_EMOT)" MAP 0xF797A MSA15_GKF4 0 MM3 0.000000 20.000000
 /begin AXIS_DESCR COM_AXIS dzmNmit N 16 0.000000 6000.000000 AXIS_PTS_REF zuwXstzv EXTENDED_LIMITS 0.000000 32767.000000 /end AXIS_DESCR
 /begin AXIS_DESCR COM_AXIS mrmM_EMTS MM3 16 0.000000 325.000000 AXIS_PTS_REF zuwYstzv16 EXTENDED_LIMITS -327.680000 327.670000 /end AXIS_DESCR
 EXTENDED_LIMITS -327.680000 327.670000 /end CHARACTERISTIC
/begin CHARACTERISTIC zuwMEVLkKL "INJ GewichtungsKL VE-Menge = f(LTF)" CURVE 0xF9ACA MSA15_KL118 0 FAKT 0.000000 1.000000
 /begin AXIS_DESCR STD_AXIS anmLTF T 8 -50.040010 199.960000 EXTENDED_LIMITS -273.140000 3003.560000 /end AXIS_DESCR
 EXTENDED_LIMITS -3.276800 3.276700 /end CHARACTERISTIC
/begin CHARACTERISTIC zuwMEVPkKL "INJ GewichtungsKL VE-Menge = f(ADF)" CURVE 0xF9AA6 MSA15_KL118 0 FAKT 0.000000 1.000000
 /begin AXIS_DESCR STD_AXIS anmADF P 8 500.000000 1500.000000 EXTENDED_LIMITS -32768.000000 32767.000000 /end AXIS_DESCR
 EXTENDED_LIMITS -3.276800 3.276700 /end CHARACTERISTIC
/begin CHARACTERISTIC zuwMEVSGKF "INJ Menge VE, ME = f(N, M_EMOT) fuer Startfall" MAP 0xF7B7A MSA15_GKF4 0 MM3 0.000000 20.000000
 /begin AXIS_DESCR COM_AXIS dzmNmit N 6 0.000000 6000.000000 AXIS_PTS_REF zuwXstzv6 EXTENDED_LIMITS 0.000000 32767.000000 /end AXIS_DESCR
 /begin AXIS_DESCR COM_AXIS mrmM_EMTS MM3 8 0.000000 325.000000 AXIS_PTS_REF zuwYstzv8 EXTENDED_LIMITS -327.680000 327.670000 /end AXIS_DESCR
 EXTENDED_LIMITS -327.680000 327.670000 /end CHARACTERISTIC
/begin CHARACTERISTIC zuwMEVSLKF "INJ Korr-Menge VE = f(N, M_EMTS) fuer Startfall" MAP 0xF9668 MSA15_GKF4 0 MM3 0.000000 20.000000
 /begin AXIS_DESCR COM_AXIS dzmNmit N 4 0.000000 6000.000000 AXIS_PTS_REF zuwXstzv4 EXTENDED_LIMITS 0.000000 32767.000000 /end AXIS_DESCR
 /begin AXIS_DESCR COM_AXIS mrmM_EMTS MM3 6 0.000000 325.000000 AXIS_PTS_REF zuwYstzv6 EXTENDED_LIMITS -327.680000 327.670000 /end AXIS_DESCR
 EXTENDED_LIMITS -327.680000 327.670000 /end CHARACTERISTIC
/begin CHARACTERISTIC zuwMEVSLKL "INJ GewichtungsKL VE-Menge = f(LTF)" CURVE 0xF9698 MSA15_KL118 0 FAKT 0.000000 1.000000
 /begin AXIS_DESCR STD_AXIS anmLTF T 5 -50.040010 199.960000 EXTENDED_LIMITS -273.140000 3003.560000 /end AXIS_DESCR
 EXTENDED_LIMITS -3.276800 3.276700 /end CHARACTERISTIC
/begin CHARACTERISTIC zuwMEVSPKF "INJ Korr-Menge VE = f(N, M_EMTS) fuer Startfall" MAP 0xF96B0 MSA15_GKF4 0 MM3 0.000000 20.000000
 /begin AXIS_DESCR COM_AXIS dzmNmit N 4 0.000000 6000.000000 AXIS_PTS_REF zuwXstzv4 EXTENDED_LIMITS 0.000000 32767.000000 /end AXIS_DESCR
 /begin AXIS_DESCR COM_AXIS mrmM_EMTS MM3 6 0.000000 325.000000 AXIS_PTS_REF zuwYstzv6 EXTENDED_LIMITS -327.680000 327.670000 /end AXIS_DESCR
 EXTENDED_LIMITS -327.680000 327.670000 /end CHARACTERISTIC
/begin CHARACTERISTIC zuwMEVSPKL "INJ GewichtungsKL VE-Menge = f(ADF)" CURVE 0xF96E0 MSA15_KL118 0 FAKT 0.000000 1.000000
 /begin AXIS_DESCR STD_AXIS ldmADF P 5 0.000000 3500.000000 EXTENDED_LIMITS -32768.000000 32767.000000 /end AXIS_DESCR
 EXTENDED_LIMITS -3.276800 3.276700 /end CHARACTERISTIC
/begin CHARACTERISTIC zuwMEVSWKL "INJ GewichtungsKL VE-Menge = f(WTF)" CURVE 0xF7C3A MSA15_KL118 0 FAKT 0.000000 1.000000
 /begin AXIS_DESCR STD_AXIS anmWTF T 8 -50.040010 149.960000 EXTENDED_LIMITS -273.140000 3003.560000 /end AXIS_DESCR
 EXTENDED_LIMITS -3.276800 3.276700 /end CHARACTERISTIC
/begin CHARACTERISTIC zuwMEVSkKF "INJ Korr-Menge VE = f(N, M_EMOT) fuer Startfall" MAP 0xF7BDA MSA15_GKF4 0 MM3 0.000000 20.000000
 /begin AXIS_DESCR COM_AXIS dzmNmit N 6 0.000000 6000.000000 AXIS_PTS_REF zuwXstzv6 EXTENDED_LIMITS 0.000000 32767.000000 /end AXIS_DESCR
 /begin AXIS_DESCR COM_AXIS mrmM_EMTS MM3 8 0.000000 325.000000 AXIS_PTS_REF zuwYstzv8 EXTENDED_LIMITS -327.680000 327.670000 /end AXIS_DESCR
 EXTENDED_LIMITS -327.680000 327.670000 /end CHARACTERISTIC
/begin CHARACTERISTIC zuwMEVWkKL "INJ GewichtungsKL VE-Menge = f(WTF)" CURVE 0xF9A82 MSA15_KL118 0 FAKT 0.000000 1.000000
 /begin AXIS_DESCR STD_AXIS anmWTF T 8 -50.040010 149.960000 EXTENDED_LIMITS -273.140000 3003.560000 /end AXIS_DESCR
 EXTENDED_LIMITS -3.276800 3.276700 /end CHARACTERISTIC
/begin AXIS_PTS zuwMEstzv "Stuetzstellen fuer die Eingangsgroesse mrmM_EAKT" 0xF8FAC mrmM_EAKT MSA15_SST115 0 MM3 8 0.000000 325.000000 EXTENDED_LIMITS -327.680000 327.670000 /end AXIS_PTS
/begin CHARACTERISTIC zuwMHNEkKF "Korrektur fuer Injektorkennfeld" MAP 0xF4F04 MSA15_KF382 0 FAKT 0.000000 3.200000
 /begin AXIS_DESCR STD_AXIS zumME_NE2 MM3 4 0.000000 100.000000 EXTENDED_LIMITS -327.680000 327.670000 /end AXIS_DESCR
 /begin AXIS_DESCR STD_AXIS zumABR_NE GradKW 4 -210.000000 0.000000 EXTENDED_LIMITS -768.000000 767.976600 /end AXIS_DESCR
 EXTENDED_LIMITS -3.276800 3.276700 /end CHARACTERISTIC
/begin CHARACTERISTIC zuwMHminKL "#SSD INJ min ME HE = f(P_RAIL)" CURVE 0xF8886 MSA15_KL118 0 MM3 0.000000 20.000000
 /begin AXIS_DESCR STD_AXIS zumP_RAIL RP 16 0.000000 1500000.000000 EXTENDED_LIMITS -3276800.000000 3276700.000000 /end AXIS_DESCR
 EXTENDED_LIMITS -327.680000 327.670000 /end CHARACTERISTIC
/begin CHARACTERISTIC zuwMLkKL "INJ Korr.faktor Luft" CURVE 0xF92E0 MSA15_KL118 0 FAKT 0.000000 2.000000
 /begin AXIS_DESCR STD_AXIS zuoM_List M_L 8 0.000000 1500.000000 EXTENDED_LIMITS -3276.800000 3276.700000 /end AXIS_DESCR
 EXTENDED_LIMITS -3.276800 3.276700 /end CHARACTERISTIC
/begin CHARACTERISTIC zuwMVELkKF "INJ Korr-Menge VE = f(N, M_EMTS)" MAP 0xF9368 MSA15_GKF4 0 MM3 0.000000 20.000000
 /begin AXIS_DESCR COM_AXIS dzmNmit N 16 0.000000 6000.000000 AXIS_PTS_REF zuwXstzv EXTENDED_LIMITS 0.000000 32767.000000 /end AXIS_DESCR
 /begin AXIS_DESCR COM_AXIS mrmM_EMTS MM3 8 0.000000 325.000000 AXIS_PTS_REF zuwYstzv8 EXTENDED_LIMITS -327.680000 327.670000 /end AXIS_DESCR
 EXTENDED_LIMITS -327.680000 327.670000 /end CHARACTERISTIC
/begin CHARACTERISTIC zuwMVEPkKF "INJ Korr-Menge VE = f(N, M_EMTS)" MAP 0xF9568 MSA15_GKF4 0 MM3 0.000000 20.000000
 /begin AXIS_DESCR COM_AXIS dzmNmit N 16 0.000000 6000.000000 AXIS_PTS_REF zuwXstzv EXTENDED_LIMITS 0.000000 32767.000000 /end AXIS_DESCR
 /begin AXIS_DESCR COM_AXIS mrmM_EMTS MM3 8 0.000000 325.000000 AXIS_PTS_REF zuwYstzv8 EXTENDED_LIMITS -327.680000 327.670000 /end AXIS_DESCR
 EXTENDED_LIMITS -327.680000 327.670000 /end CHARACTERISTIC
/begin CHARACTERISTIC zuwMVEWkKF "INJ Korr-Menge VE = f(N, M_EMTS)" MAP 0xF9468 MSA15_GKF4 0 MM3 0.000000 20.000000
 /begin AXIS_DESCR COM_AXIS dzmNmit N 16 0.000000 6000.000000 AXIS_PTS_REF zuwXstzv EXTENDED_LIMITS 0.000000 32767.000000 /end AXIS_DESCR
 /begin AXIS_DESCR COM_AXIS mrmM_EMTS MM3 8 0.000000 325.000000 AXIS_PTS_REF zuwYstzv8 EXTENDED_LIMITS -327.680000 327.670000 /end AXIS_DESCR
 EXTENDED_LIMITS -327.680000 327.670000 /end CHARACTERISTIC
/begin CHARACTERISTIC zuwMVEmxKF "INJ max. Menge VE = f(N, M_EMOT)" MAP 0xF7C5E MSA15_GKF4 0 MM3 0.000000 20.000000
 /begin AXIS_DESCR COM_AXIS dzmNmit N 16 0.000000 6000.000000 AXIS_PTS_REF zuwXstzv EXTENDED_LIMITS 0.000000 32767.000000 /end AXIS_DESCR
 /begin AXIS_DESCR COM_AXIS mrmM_EMTS MM3 8 0.000000 325.000000 AXIS_PTS_REF zuwYstzv8 EXTENDED_LIMITS -327.680000 327.670000 /end AXIS_DESCR
 EXTENDED_LIMITS -327.680000 327.670000 /end CHARACTERISTIC
/begin CHARACTERISTIC zuwMVminKL "#SSD INJ min ME VE = f(P_RAIL)" CURVE 0xF7D5E MSA15_KL118 0 MM3 0.000000 20.000000
 /begin AXIS_DESCR STD_AXIS zumP_RAIL RP 16 0.000000 1500000.000000 EXTENDED_LIMITS -3276800.000000 3276700.000000 /end AXIS_DESCR
 EXTENDED_LIMITS -327.680000 327.670000 /end CHARACTERISTIC
/begin CHARACTERISTIC zuwM_E_KOF "Raildruckgradient Verstaerkungskoeffizient mrmM_EMTS Differenzierer      ! ***BC" VALUE 0xF59B8 MSA15_FW4 0 ARD_dPWG 0.000000 30.000310 EXTENDED_LIMITS -50.000000 49.998470 /end CHARACTERISTIC
/begin CHARACTERISTIC zuwNLEABT1 "#SSD RPC TV fuer DRV im NL bis Ablauf T1" VALUE 0xF8A80 MSA15_FW3 0 PROZ 0.000000 100.000000 EXTENDED_LIMITS -327.680000 327.670000 /end CHARACTERISTIC
/begin CHARACTERISTIC zuwNLEABT2 "#SSD RPC TV fuer DRV im NL nach Ablauf T1" VALUE 0xF8A82 MSA15_FW3 0 PROZ 0.000000 100.000000 EXTENDED_LIMITS -327.680000 327.670000 /end CHARACTERISTIC
/begin CHARACTERISTIC zuwN_VEaus "INJ obere n-Schwelle fuer VE 'aus'" VALUE 0xF5A6A MSA15_FW4 0 N 0.000000 6000.000000 EXTENDED_LIMITS 0.000000 32767.000000 /end CHARACTERISTIC
/begin CHARACTERISTIC zuwN_VEein "INJ untere n-Schwelle fuer VE 'ein'" VALUE 0xF5A68 MSA15_FW4 0 N 0.000000 6000.000000 EXTENDED_LIMITS 0.000000 32767.000000 /end CHARACTERISTIC
/begin CHARACTERISTIC zuwN_plaus "#SSD RPC Anzahl NW Umdrehungen nach EAB Test" VALUE 0xF8A7E MSA15_FW3 0 DEZ_DW_U 0.000000 255.000000 EXTENDED_LIMITS 0.000000 65535.000000 /end CHARACTERISTIC
/begin CHARACTERISTIC zuwN_reg "#SSD RPC Drehzahlschwelle fuer Raildruckregelung" VALUE 0xF8A84 MSA15_FW4 0 N 0.000000 1000.000000 EXTENDED_LIMITS 0.000000 32767.000000 /end CHARACTERISTIC
/begin CHARACTERISTIC zuwN_wait "#SSD RPC Anzahl NW-Umdrehungen nach n > mrwSTNMIN1" VALUE 0xF5014 MSA15_FW4 0 DEZ_DW_U 0.000000 255.000000 EXTENDED_LIMITS 0.000000 65535.000000 /end CHARACTERISTIC
/begin CHARACTERISTIC zuwNchk "#SSD RPC min. Drehzahl fuer Plausiblitaetstest" VALUE 0xF5000 MSA15_FW4 0 N 0.000000 6000.000000 EXTENDED_LIMITS 0.000000 32767.000000 /end CHARACTERISTIC
/begin CHARACTERISTIC zuwNdABmax "INJ max. Drehzahl dyn. AB-Verlagerung" VALUE 0xF747A MSA15_FW4 0 N 0.000000 6000.000000 EXTENDED_LIMITS 0.000000 32767.000000 /end CHARACTERISTIC
/begin CHARACTERISTIC zuwPBmax "#SSD RPC max.TV DBE-Ventil: allg. Fehler" VALUE 0xF500A MSA15_FW4 0 PROZ 0.000000 100.000000 EXTENDED_LIMITS -327.680000 327.670000 /end CHARACTERISTIC
/begin CHARACTERISTIC zuwPBmin "#SSD RPC min. TV des DBE: DBE klemmt" VALUE 0xF5008 MSA15_FW4 0 PROZ 0.000000 100.000000 EXTENDED_LIMITS -327.680000 327.670000 /end CHARACTERISTIC
/begin CHARACTERISTIC zuwPHIkorr "INJ Phasenkorr. = f(dzmNmit)" CURVE 0xF88CA MSA15_KL118 0 GradKW -25.007810 25.007810
 /begin AXIS_DESCR STD_AXIS dzmNmit N 12 0.000000 6000.000000 EXTENDED_LIMITS 0.000000 32767.000000 /end AXIS_DESCR
 EXTENDED_LIMITS -768.000000 767.976600 /end CHARACTERISTIC
/begin CHARACTERISTIC zuwPImax "#SSD RPC P+I-Anteil unbegrenzt" VALUE 0xF5012 MSA15_FW4 0 PROZ 0.000000 100.000000 EXTENDED_LIMITS -327.680000 327.670000 /end CHARACTERISTIC
/begin CHARACTERISTIC zuwPKmax "#SSD RPC maximaler Systemdruck" VALUE 0xF500E MSA15_FW4 0 RP 0.000000 1500000.000000 EXTENDED_LIMITS -3276800.000000 3276700.000000 /end CHARACTERISTIC
/begin CHARACTERISTIC zuwPLIMKF "RPC Raildruckbeg. bei hoher Kraftstofftemp." MAP 0xF8A22 MSA15_KF382 0 RP 0.000000 1350000.000000
 /begin AXIS_DESCR STD_AXIS dzmNmit N 7 0.000000 6000.000000 EXTENDED_LIMITS 0.000000 32767.000000 /end AXIS_DESCR
 /begin AXIS_DESCR STD_AXIS anmKTF T 4 -50.040010 199.960000 EXTENDED_LIMITS -273.140000 3003.560000 /end AXIS_DESCR
 EXTENDED_LIMITS -3276800.000000 3276700.000000 /end CHARACTERISTIC
/begin CHARACTERISTIC zuwPPL_KOF "Raildruckgradient Verstaerkungskoeffizient Ladedruckregelabweichung -Differenzie" VALUE 0xF59BE MSA15_FW4 0 zuDT1_dLDF 0.000000 2.857208 EXTENDED_LIMITS -6.250000 6.249809 /end CHARACTERISTIC
/begin CHARACTERISTIC zuwPQABKF "INJ KorrekturKF dyn. AB-Verlagerung" MAP 0xF88FE MSA15_GKF4 0 GradKW -25.007810 25.007810
 /begin AXIS_DESCR COM_AXIS dzmNmit N 16 0.000000 6000.000000 AXIS_PTS_REF zuwXstzv EXTENDED_LIMITS 0.000000 32767.000000 /end AXIS_DESCR
 /begin AXIS_DESCR COM_AXIS mrmM_EMTS MM3 8 0.000000 325.000000 AXIS_PTS_REF zuwYstzv8 EXTENDED_LIMITS -327.680000 327.670000 /end AXIS_DESCR
 EXTENDED_LIMITS -768.000000 767.976600 /end CHARACTERISTIC
/begin CHARACTERISTIC zuwPQALkKL "Dyn. Korrektur Ansteuerbeginn als Funktion von LTF" CURVE 0xF932C MSA15_KL118 0 FAKT 0.000000 2.000000
 /begin AXIS_DESCR STD_AXIS anmLTF T 6 -50.040010 149.960000 EXTENDED_LIMITS -273.140000 3003.560000 /end AXIS_DESCR
 EXTENDED_LIMITS -3.276800 3.276700 /end CHARACTERISTIC
/begin CHARACTERISTIC zuwPQAWkKL "Dyn. Korrektur Ansteuerbeginn als Funktion von WTF" CURVE 0xF9310 MSA15_KL118 0 FAKT 0.000000 2.000000
 /begin AXIS_DESCR STD_AXIS anmWTF T 6 -50.040010 149.960000 EXTENDED_LIMITS -273.140000 3003.560000 /end AXIS_DESCR
 EXTENDED_LIMITS -3.276800 3.276700 /end CHARACTERISTIC
/begin CHARACTERISTIC zuwPQBM_GF "Raildruckgradient mrmM_EMTS Filterzeitkonstante  ! ***BC081 bar2wi" VALUE 0xF59BC MSA15_FW4 0 GF 0.000031 0.999969 /end CHARACTERISTIC
/begin CHARACTERISTIC zuwPQBNmax "Obere Drehzahlschwelle fuer Normalgradientenkennfeld-Fenster" VALUE 0xF59B2 MSA15_FW4 0 N 0.000000 6000.000000 EXTENDED_LIMITS 0.000000 32767.000000 /end CHARACTERISTIC
/begin CHARACTERISTIC zuwPQBNmin "Untere Drehzahlschwelle fuer Normalgradientenkennfeld-Fenster" VALUE 0xF59B0 MSA15_FW4 0 N 0.000000 6000.000000 EXTENDED_LIMITS 0.000000 32767.000000 /end CHARACTERISTIC
/begin CHARACTERISTIC zuwPQBP_GF "Raildruckgradient Ladedruckregelabweichung Filterzeitkonstante" VALUE 0xF59C2 MSA15_FW4 0 GF 0.000031 0.999969 /end CHARACTERISTIC
/begin CHARACTERISTIC zuwPQB_M_E "Triggerschwelle fuer zuwPQBdpKF-Gradientenkennfeld bei mrmM_EMTS -Aenderung     " VALUE 0xF59AC MSA15_FW4 0 dM_E_dZ 0.000000 3000.000000 EXTENDED_LIMITS -16384.000000 16383.500000 /end CHARACTERISTIC
/begin CHARACTERISTIC zuwPQB_dPL "Triggerschwelle fuer zuwPQBdpKF-Gradientenkennfeld bei ldoE -Aenderung" VALUE 0xF59AE MSA15_FW4 0 dP_dZ 0.000000 10000.000000 EXTENDED_LIMITS -1638400.000000 1638350.000000 /end CHARACTERISTIC
/begin CHARACTERISTIC zuwPQBdpKF "RPC BegrenzungsKF Solldruckspruenge ( Akustik )" MAP 0xF582C MSA15_KF382 0 dRP 0.000000 67500000.000000
 /begin AXIS_DESCR STD_AXIS mrmM_EMTS MM3 2 0.000000 325.000000 EXTENDED_LIMITS -327.680000 327.670000 /end AXIS_DESCR
 /begin AXIS_DESCR STD_AXIS dzmNmit N 2 0.000000 6000.000000 EXTENDED_LIMITS 0.000000 32767.000000 /end AXIS_DESCR
 EXTENDED_LIMITS -163840000.000000 163835000.000000 /end CHARACTERISTIC
/begin CHARACTERISTIC zuwPQGWKF "RPC Solldruck GW KF, Psoll = f(N, M_EMOT)" MAP 0xF502C MSA15_GKF4 0 RP 200000.000000 1350000.000000
 /begin AXIS_DESCR COM_AXIS dzmNmit N 16 0.000000 6000.000000 AXIS_PTS_REF zuwXstzv EXTENDED_LIMITS 0.000000 32767.000000 /end AXIS_DESCR
 /begin AXIS_DESCR COM_AXIS mrmM_EAKT MM3 16 0.000000 325.000000 AXIS_PTS_REF zuwYEakt16 EXTENDED_LIMITS -327.680000 327.670000 /end AXIS_DESCR
 EXTENDED_LIMITS -3276800.000000 3276700.000000 /end CHARACTERISTIC
/begin CHARACTERISTIC zuwPQLkKF "RPC Solldruckkorr-KF; K-Druck = f(N, M_EMOT)" MAP 0xF542C MSA15_GKF4 0 RP -500000.000000 500000.000000
 /begin AXIS_DESCR COM_AXIS dzmNmit N 16 0.000000 6000.000000 AXIS_PTS_REF zuwXstzv EXTENDED_LIMITS 0.000000 32767.000000 /end AXIS_DESCR
 /begin AXIS_DESCR COM_AXIS mrmM_EAKT MM3 8 0.000000 325.000000 AXIS_PTS_REF zuwYEakt8 EXTENDED_LIMITS -327.680000 327.670000 /end AXIS_DESCR
 EXTENDED_LIMITS -3276800.000000 3276700.000000 /end CHARACTERISTIC
/begin CHARACTERISTIC zuwPQLkKL "RPC Solldruckkorr-KL; K-Fakt = f(anmLTF)" CURVE 0xF99DA MSA15_KL118 0 FAKT 0.000000 1.000000
 /begin AXIS_DESCR STD_AXIS anmLTF T 8 -50.040010 149.960000 EXTENDED_LIMITS -273.140000 3003.560000 /end AXIS_DESCR
 EXTENDED_LIMITS -3.276800 3.276700 /end CHARACTERISTIC
/begin CHARACTERISTIC zuwPQPkKF "RPC Solldruckkorr-KF; K-Druck = f(N, M_EMOT)" MAP 0xF522C MSA15_GKF4 0 RP -500000.000000 500000.000000
 /begin AXIS_DESCR COM_AXIS dzmNmit N 16 0.000000 6000.000000 AXIS_PTS_REF zuwXstzv EXTENDED_LIMITS 0.000000 32767.000000 /end AXIS_DESCR
 /begin AXIS_DESCR COM_AXIS mrmM_EAKT MM3 8 0.000000 325.000000 AXIS_PTS_REF zuwYEakt8 EXTENDED_LIMITS -327.680000 327.670000 /end AXIS_DESCR
 EXTENDED_LIMITS -3276800.000000 3276700.000000 /end CHARACTERISTIC
/begin CHARACTERISTIC zuwPQPkKL "RPC Solldruckkorr-KL; K-Fakt = f(ldmADF)" CURVE 0xF9992 MSA15_KL118 0 FAKT 0.000000 1.000000
 /begin AXIS_DESCR STD_AXIS ldmADF P 8 0.000000 3500.000000 EXTENDED_LIMITS -32768.000000 32767.000000 /end AXIS_DESCR
 EXTENDED_LIMITS -3.276800 3.276700 /end CHARACTERISTIC
/begin CHARACTERISTIC zuwPQSGKF "RPC Solldruck GW KF, Psoll = f(N, M_EMOT) Startfall" MAP 0xF552C MSA15_GKF4 0 RP 200000.000000 1350000.000000
 /begin AXIS_DESCR COM_AXIS dzmNmit N 6 0.000000 6000.000000 AXIS_PTS_REF zuwXstzv6 EXTENDED_LIMITS 0.000000 32767.000000 /end AXIS_DESCR
 /begin AXIS_DESCR COM_AXIS mrmM_EAKT MM3 8 0.000000 325.000000 AXIS_PTS_REF zuwYEakt8 EXTENDED_LIMITS -327.680000 327.670000 /end AXIS_DESCR
 EXTENDED_LIMITS -3276800.000000 3276700.000000 /end CHARACTERISTIC
/begin CHARACTERISTIC zuwPQSLKF "RPC Solldruckkorr-KF; K-Druck = f(N, M_EAKT) Startfall" MAP 0xF8B52 MSA15_KF382 0 RP -500000.000000 500000.000000
 /begin AXIS_DESCR STD_AXIS dzmNmit N 4 0.000000 6000.000000 EXTENDED_LIMITS 0.000000 32767.000000 /end AXIS_DESCR
 /begin AXIS_DESCR STD_AXIS mrmM_EAKT MM3 6 0.000000 100.000000 EXTENDED_LIMITS -327.680000 327.670000 /end AXIS_DESCR
 EXTENDED_LIMITS -3276800.000000 3276700.000000 /end CHARACTERISTIC
/begin CHARACTERISTIC zuwPQSLKL "INJ GewichtungsKL Raildrucksollwert = f(LTF)" CURVE 0xF8B9E MSA15_KL118 0 FAKT 0.000000 1.000000
 /begin AXIS_DESCR STD_AXIS anmLTF T 5 -50.040010 199.960000 EXTENDED_LIMITS -273.140000 3003.560000 /end AXIS_DESCR
 EXTENDED_LIMITS -3.276800 3.276700 /end CHARACTERISTIC
/begin CHARACTERISTIC zuwPQSPKF "RPC Solldruckkorr-KF; K-Druck = f(N, M_EAKT) Startfall" MAP 0xF8BB6 MSA15_KF382 0 RP -500000.000000 500000.000000
 /begin AXIS_DESCR STD_AXIS dzmNmit N 4 0.000000 6000.000000 EXTENDED_LIMITS 0.000000 32767.000000 /end AXIS_DESCR
 /begin AXIS_DESCR STD_AXIS mrmM_EAKT MM3 6 0.000000 100.000000 EXTENDED_LIMITS -327.680000 327.670000 /end AXIS_DESCR
 EXTENDED_LIMITS -3276800.000000 3276700.000000 /end CHARACTERISTIC
/begin CHARACTERISTIC zuwPQSPKL "INJ GewichtungsKL Raildrucksollwert = f(ADF)" CURVE 0xF8C02 MSA15_KL118 0 FAKT 0.000000 1.000000
 /begin AXIS_DESCR STD_AXIS ldmADF P 5 0.000000 3500.000000 EXTENDED_LIMITS -32768.000000 32767.000000 /end AXIS_DESCR
 EXTENDED_LIMITS -3.276800 3.276700 /end CHARACTERISTIC
/begin CHARACTERISTIC zuwPQSWKL "RPC Solldruckkorr-KL; K-Fakt = f(anmWTF)" CURVE 0xF55EC MSA15_KL118 0 FAKT 0.000000 1.000000
 /begin AXIS_DESCR STD_AXIS anmWTF T 8 -50.040010 149.960000 EXTENDED_LIMITS -273.140000 3003.560000 /end AXIS_DESCR
 EXTENDED_LIMITS -3.276800 3.276700 /end CHARACTERISTIC
/begin CHARACTERISTIC zuwPQSkKF "RPC Solldruckkorr-KF; K-Druck = f(N, M_EMOT) Startfall" MAP 0xF558C MSA15_GKF4 0 RP -500000.000000 500000.000000
 /begin AXIS_DESCR COM_AXIS dzmNmit N 6 0.000000 6000.000000 AXIS_PTS_REF zuwXstzv6 EXTENDED_LIMITS 0.000000 32767.000000 /end AXIS_DESCR
 /begin AXIS_DESCR COM_AXIS mrmM_EAKT MM3 8 0.000000 325.000000 AXIS_PTS_REF zuwYEakt8 EXTENDED_LIMITS -327.680000 327.670000 /end AXIS_DESCR
 EXTENDED_LIMITS -3276800.000000 3276700.000000 /end CHARACTERISTIC
/begin CHARACTERISTIC zuwPQSta_C "#SSD RPC Counter fuer Raildruckueberwachung im Start" VALUE 0xF8AAA MSA15_FW3 0 DEZ_DW_U 0.000000 65535.000000 /end CHARACTERISTIC
/begin CHARACTERISTIC zuwPQSta_N "Drehzahlschwelle fuer Raildruckueberwachung im Start" VALUE 0xF8AA6 MSA15_FW4 0 N 0.000000 6000.000000 EXTENDED_LIMITS 0.000000 32767.000000 /end CHARACTERISTIC
/begin CHARACTERISTIC zuwPQSta_P "Schwelle fuer Raildruckaufbau im Start" VALUE 0xF8AA8 MSA15_FW4 0 RP 0.000000 1350000.000000 EXTENDED_LIMITS -3276800.000000 3276700.000000 /end CHARACTERISTIC
/begin CHARACTERISTIC zuwPQTum "#SSD Raildruckueberwachung Totzeit       ! ***BC266 BEW2WI" VALUE 0xF8AA2 MSA15_FW4 0 ZEIT_ST 0.000000 655350000.000000 /end CHARACTERISTIC
/begin CHARACTERISTIC zuwPQWkKF "RPC Solldruckkorr-KF; K-Druck = f(N, M_EMOT)" MAP 0xF532C MSA15_GKF4 0 RP -500000.000000 500000.000000
 /begin AXIS_DESCR COM_AXIS dzmNmit N 16 0.000000 6000.000000 AXIS_PTS_REF zuwXstzv EXTENDED_LIMITS 0.000000 32767.000000 /end AXIS_DESCR
 /begin AXIS_DESCR COM_AXIS mrmM_EAKT MM3 8 0.000000 325.000000 AXIS_PTS_REF zuwYEakt8 EXTENDED_LIMITS -327.680000 327.670000 /end AXIS_DESCR
 EXTENDED_LIMITS -3276800.000000 3276700.000000 /end CHARACTERISTIC
/begin CHARACTERISTIC zuwPQWkKL "RPC Solldruckkorr-KL; K-Fakt = f(anmWTF)" CURVE 0xF99B6 MSA15_KL118 0 FAKT 0.000000 1.000000
 /begin AXIS_DESCR STD_AXIS anmWTF T 8 -50.040010 149.960000 EXTENDED_LIMITS -273.140000 3003.560000 /end AXIS_DESCR
 EXTENDED_LIMITS -3.276800 3.276700 /end CHARACTERISTIC
/begin AXIS_PTS zuwXstzv "X-Stuetzstellenverteilung fuer dzmNmit" 0xF4F3C dzmNmit MSA15_SST115 0 N 16 0.000000 6000.000000 EXTENDED_LIMITS 0.000000 32767.000000 /end AXIS_PTS
/begin AXIS_PTS zuwXstzv4 "X-Stuetzstellenverteilung fuer dzmNmit (Startfall)" 0xF4F70 dzmNmit MSA15_SST115 0 N 4 0.000000 6000.000000 EXTENDED_LIMITS 0.000000 32767.000000 /end AXIS_PTS
/begin AXIS_PTS zuwXstzv6 "X-Stuetzstellenverteilung fuer dzmNmit (Startfall)" 0xF4F60 dzmNmit MSA15_SST115 0 N 6 0.000000 6000.000000 EXTENDED_LIMITS 0.000000 32767.000000 /end AXIS_PTS
/begin AXIS_PTS zuwYEakt16 "Y-Stuetzstellenverteilung fuer Eingangswert mrmM_EAKT" 0xF4FD8 mrmM_EAKT MSA15_SST115 0 MM3 16 0.000000 325.000000 EXTENDED_LIMITS -327.680000 327.670000 /end AXIS_PTS
/begin AXIS_PTS zuwYEakt8 "Y-Stuetzstellenverteilung fuer mrmM_EAKT" 0xF4FC4 mrmM_EAKT MSA15_SST115 0 MM3 8 0.000000 325.000000 EXTENDED_LIMITS -327.680000 327.670000 /end AXIS_PTS
/begin AXIS_PTS zuwYstzv16 "Y-Stuetzstellenverteilung fuer Eingangswert mrmM_EMTS        ! ***BC081 bar2wi" 0xF4FA0 mrmM_EMTS MSA15_SST115 0 MM3 16 0.000000 325.000000 EXTENDED_LIMITS -327.680000 327.670000 /end AXIS_PTS
/begin AXIS_PTS zuwYstzv6 "Y-Stuetzstellenverteilung fuer mrmM_EMTS" 0xF4F7C mrmM_EMTS MSA15_SST115 0 MM3 6 0.000000 325.000000 EXTENDED_LIMITS -327.680000 327.670000 /end AXIS_PTS
/begin AXIS_PTS zuwYstzv8 "Y-Stuetzstellenverteilung fuer mrmM_EMTS     ! ***BC081 bar2wi" 0xF4F8C mrmM_EMTS MSA15_SST115 0 MM3 8 0.000000 325.000000 EXTENDED_LIMITS -327.680000 327.670000 /end AXIS_PTS
/begin COMPU_METHOD AD_uS "Ansteuerdauer" RAT_FUNC "%8.2" "uS" COEFFS 0 1.000000 0.000000 0 0.000000 1.000000 /end COMPU_METHOD
/begin COMPU_METHOD ARD_dPWG "Uebernahme ARF Verstaerkungskoeffizient PWG-Differenzierer" RAT_FUNC "%8.5" "1/s" COEFFS 0 1.310720e+09 0.000000 0 0.000000 2000000.000000 /end COMPU_METHOD
/begin COMPU_METHOD B "Umrechnung Beschleunigung" RAT_FUNC "%8.5" "m/s^2" COEFFS 0 3.276800e-02 0.000000 0 0.000000 2.777780e-03 /end COMPU_METHOD
/begin COMPU_METHOD BSTZ_TIC_h "Umrechnung von Betriebstundentics in h" RAT_FUNC "%8.3" "Std" COEFFS 0 10.000000 0.000000 0 0.000000 1.000000 /end COMPU_METHOD
/begin COMPU_METHOD DEZ_DB_U "Uebernahme von Festwerten von 0 bis 255" RAT_FUNC "%8.4" "-" COEFFS 0 1.000000 0.000000 0 0.000000 1.000000 /end COMPU_METHOD
/begin COMPU_METHOD DEZ_DW "Uebernahme von Festwerten von -32768 bis 32767" RAT_FUNC "%8.2" "-" COEFFS 0 1.000000 0.000000 0 0.000000 1.000000 /end COMPU_METHOD
/begin COMPU_METHOD DEZ_DW_U "Uebernahme von Festwerten von 0 bis 65535" RAT_FUNC "%8.2" "-" COEFFS 0 1.000000 0.000000 0 0.000000 1.000000 /end COMPU_METHOD
/begin COMPU_METHOD ELon_off "Quantisierung 3.EL-Schaltung" RAT_FUNC "%8.3" "-" COEFFS 0 10.000000 0.000000 0 0.000000 1.000000 /end COMPU_METHOD
/begin COMPU_METHOD FAKT "Umrechnung fuer multiplikative Faktoren" RAT_FUNC "%8.6" "-" COEFFS 0 1.000000 0.000000 0 0.000000 1.000000e-04 /end COMPU_METHOD
/begin COMPU_METHOD FAKT_E "Umrechnung Faktor mit erweitertem Wertebereich" RAT_FUNC "%8.5" "-" COEFFS 0 1.000000 0.000000 0 0.000000 1.000000e-03 /end COMPU_METHOD
/begin COMPU_METHOD GA_uS "GateArrayZeit" RAT_FUNC "%8.2" "us" COEFFS 0 1.000000 0.000000 0 0.000000 1.000000 /end COMPU_METHOD
/begin COMPU_METHOD GF "zeitsynchroner Gedaechtnisfaktor fuer PT1" RAT_FUNC "%8.6" "-" COEFFS 0 3.276800e+04 0.000000 0 0.000000 1.000000 /end COMPU_METHOD
/begin COMPU_METHOD Grad2INK "Umrechnung GradKW in Inkremente" RAT_FUNC "%8.4" "Grad vOT" COEFFS 0 1.000000 0.000000 0 0.000000 6.000000 /end COMPU_METHOD
/begin COMPU_METHOD GradKW "GradKW fuer Gatearray" RAT_FUNC "%8.4" "Grad KW" COEFFS 0 1.000000 0.000000 0 0.000000 2.343750e-02 /end COMPU_METHOD
/begin COMPU_METHOD INKvOT "Umrechnung GradKWvOT in Inkremente" RAT_FUNC "%8.4" "Grad vOT" COEFFS 0 -1.000000 0.000000 0 0.000000 6.000000 /end COMPU_METHOD
/begin COMPU_METHOD IRc2PZM10 "Umrechnung 10-Bit PZM in Strom" RAT_FUNC "%8.2" "mA" COEFFS 0 1.859810e-02 0.000000 0 0.000000 1.000000 /end COMPU_METHOD
/begin COMPU_METHOD KW2T3 "Umrechnung GradKW in T3 Ticks" RAT_FUNC "%8.4" "Grad KW" COEFFS 0 1.000000 -3.000000 0 0.000000 3.000000 /end COMPU_METHOD
/begin COMPU_METHOD LLR_KI "I-Verstaerkung KI (LLR)" RAT_FUNC "%8.6" "(mm^3)/((1/min)*s)" COEFFS 0 4294967000.000000 0.000000 0 0.000000 320000.000000 /end COMPU_METHOD
/begin COMPU_METHOD LLR_KP "P-Verstaerkung KP (LLR)" RAT_FUNC "%8.6" "(mm^3)/(1/min)" COEFFS 0 6.553600e+04 0.000000 0 0.000000 5.120000 /end COMPU_METHOD
/begin COMPU_METHOD LRR_A "Bandpass-Parameter ALPHA fuer LRR" RAT_FUNC "%8.6" "[-]" COEFFS 0 6.553600e+04 0.000000 0 0.000000 4.000000 /end COMPU_METHOD
/begin COMPU_METHOD LRR_B "Bandpass-Parameter BETA fuer LRR" RAT_FUNC "%8.5" "[-]" COEFFS 0 6.553600e+04 0.000000 0 0.000000 64.000000 /end COMPU_METHOD
/begin COMPU_METHOD LRR_KI "I-Verstaerkung KI (LRR)" RAT_FUNC "%8.6" "(mm^3)/((1/min)*s)" COEFFS 0 51539610000.000000 0.000000 0 0.000000 160000.000000 /end COMPU_METHOD
/begin COMPU_METHOD LRR_KP "P-Verstaerkung KP (LRR)" RAT_FUNC "%8.7" "(mm^3)/(1/min)" COEFFS 0 6.553600e+04 0.000000 0 0.000000 8.000000e-02 /end COMPU_METHOD
/begin COMPU_METHOD MM3 "1 * 10E-2" RAT_FUNC "%8.4" "mm^3" COEFFS 0 1.000000 0.000000 0 0.000000 1.000000e-02 /end COMPU_METHOD
/begin COMPU_METHOD M_E "Umrechnung Menge" RAT_FUNC "%8.4" "mm^3" COEFFS 0 1.000000 0.000000 0 0.000000 1.000000e-02 /end COMPU_METHOD
/begin COMPU_METHOD M_L "Umrechnung Luftmasse" RAT_FUNC "%8.3" "mg/Hub Luft" COEFFS 0 1.000000 0.000000 0 0.000000 1.000000e-01 /end COMPU_METHOD
/begin COMPU_METHOD N "Umrechnung Drehzahl" RAT_FUNC "%8.2" "1/min" COEFFS 0 1.000000 0.000000 0 0.000000 1.000000 /end COMPU_METHOD
/begin COMPU_METHOD P "Umrechnung Ladedruck" RAT_FUNC "%8.2" "hPa" COEFFS 0 1.000000 0.000000 0 0.000000 1.000000 /end COMPU_METHOD
/begin COMPU_METHOD PROZ "Umrechnung Tastverhaeltnis" RAT_FUNC "%8.4" "%" COEFFS 0 1.000000 0.000000 0 0.000000 1.000000e-02 /end COMPU_METHOD
/begin COMPU_METHOD PROZDT "Differenzquotient dPROZ_S/dt" RAT_FUNC "%8.2" "%/s" COEFFS 0 2.000000e-02 0.000000 0 0.000000 1.000000e-02 /end COMPU_METHOD
/begin COMPU_METHOD PROZ_S "Umrechnung Schleiferspannung in Prozent" RAT_FUNC "%8.4" "%" COEFFS 0 1.000000 0.000000 0 0.000000 1.000000e-02 /end COMPU_METHOD
/begin COMPU_METHOD RAMP_SA "Rampensteigung Pumpenmenge Absenkung im Schub" RAT_FUNC "%8.2" "mm^3/s" COEFFS 0 6.553600e+04 0.000000 0 0.000000 40000.000000 /end COMPU_METHOD
/begin COMPU_METHOD RP "Railpressure" RAT_FUNC "%7.0" "hPa" COEFFS 0 1.000000 0.000000 0 0.000000 100.000000 /end COMPU_METHOD
/begin COMPU_METHOD RPC_KI "I-Verstaerkung KI (RPC)" RAT_FUNC "%8.7" " % / ( hPa * s )" COEFFS 0 1.310720e+11 0.000000 0 0.000000 80000.000000 /end COMPU_METHOD
/begin COMPU_METHOD SEG_W "Segmentwichtung und Auswahl fuer den LRR" RAT_FUNC "%8.4" "[-]" COEFFS 0 256.000000 0.000000 0 0.000000 1.000000 /end COMPU_METHOD
/begin COMPU_METHOD T "Umrechnung Temperatur" RAT_FUNC "%8.3" "Grad C" COEFFS 0 1.000000 273.140000 0 0.000000 1.000000e-01 /end COMPU_METHOD
/begin COMPU_METHOD U "Umrechnung fuer Spannungen" RAT_FUNC "%8.1" "mV" COEFFS 0 1023.000000 0.000000 0 0.000000 5000.000000 /end COMPU_METHOD
/begin COMPU_METHOD UMR_FAKT "Umrechnung fuer multiplikative Faktoren (DIAGNOSE)" RAT_FUNC "%8.5" "-" COEFFS 0 1.000000 0.000000 0 0.000000 9.765620e-04 /end COMPU_METHOD
/begin COMPU_METHOD U_B "Umrechnung fuer Spannungen bis zu 12V" RAT_FUNC "%8.1" "mV" COEFFS 0 1023.000000 0.000000 0 0.000000 24163.000000 /end COMPU_METHOD
/begin COMPU_METHOD V "Umrechnung Geschwindigkeit" RAT_FUNC "%8.4" "km/h" COEFFS 0 1.000000 0.000000 0 0.000000 1.000000e-02 /end COMPU_METHOD
/begin COMPU_METHOD VDF "Umrechnung Kraftstoffvorfoerderdruck" RAT_FUNC "%8.2" "hPa" COEFFS 0 1.000000 0.000000 0 0.000000 1.000000 /end COMPU_METHOD
/begin COMPU_METHOD VEon_off "Quantisierung VE-Aktivierung" RAT_FUNC "%8.3" "-" COEFFS 0 10.000000 0.000000 0 0.000000 1.000000 /end COMPU_METHOD
/begin COMPU_METHOD V_N "Umrechnung V/N" RAT_FUNC "%8.6" "(km/h)/(1/min)" COEFFS 0 256.000000 0.000000 0 0.000000 1.000000e-02 /end COMPU_METHOD
/begin COMPU_METHOD ZEIT_ST "Umrechnung Zeit Softwaretimer" RAT_FUNC "%9.0" "us" COEFFS 0 1.000000 0.000000 0 0.000000 10000.000000 /end COMPU_METHOD
/begin COMPU_METHOD ZEIT_ST_S "Umrechnung Zeit Softwaretimer (Sec)" RAT_FUNC "%8.4" "s" COEFFS 0 1000000.000000 0.000000 0 0.000000 10000.000000 /end COMPU_METHOD
/begin COMPU_METHOD ZEIT_T_2ms "Umrechnung Zaehler im 2ms Task" RAT_FUNC "%9.0" "us" COEFFS 0 1.000000 0.000000 0 0.000000 2000.000000 /end COMPU_METHOD
/begin COMPU_METHOD dMOM16_dZ "Moment_16-Aenderung pro Hauptprogrammdurchlauf" RAT_FUNC "%8.2" "Nm/s" COEFFS 0 2.000000e-02 0.000000 0 0.000000 1.556440e-02 /end COMPU_METHOD
/begin COMPU_METHOD dM_E_dZ "Mengenaenderung pro Hauptprogrammdurchlauf" RAT_FUNC "%8.2" "mm^3/s" COEFFS 0 2.000000e-02 0.000000 0 0.000000 1.000000e-02 /end COMPU_METHOD
/begin COMPU_METHOD dN_dZ "Drehzahlaenderung pro Hauptprogrammdurchlauf" RAT_FUNC "%7.0" "(U/min)/s" COEFFS 0 2.000000e-02 0.000000 0 0.000000 1.000000 /end COMPU_METHOD
/begin COMPU_METHOD dNdZ "Drehzahlaenderung pro Hauptprogrammdurchlauf" RAT_FUNC "%8.1" "(U/min)/s" COEFFS 0 2.000000e-02 0.000000 0 0.000000 6.250000e-02 /end COMPU_METHOD
/begin COMPU_METHOD dP_dZ "Ladedruckaenderung pro Hauptprogrammdurchlauf" RAT_FUNC "%7.0" "hPa/s" COEFFS 0 2.000000e-02 0.000000 0 0.000000 1.000000 /end COMPU_METHOD
/begin COMPU_METHOD dRP "Raildrucksprung" RAT_FUNC "%9.0" "hPa/sec" COEFFS 0 20000.000000 0.000000 0 0.000000 100000000.000000 /end COMPU_METHOD
/begin COMPU_METHOD dT "Umrechnung Temperaturdifferenz" RAT_FUNC "%8.3" "Grad C" COEFFS 0 1.000000 0.000000 0 0.000000 1.000000e-01 /end COMPU_METHOD
/begin COMPU_METHOD dVE_dZ "Einspritzvolumenaenderung pro Hauptprogrammdurchlauf" RAT_FUNC "%8.2" "(mm^3)/s" COEFFS 0 2.000000e-02 0.000000 0 0.000000 1.000000e-02 /end COMPU_METHOD
/begin COMPU_METHOD dt_KW "Umrechnung Ansteuerbeginnaenderung" RAT_FUNC "%8.3" "Grad KW/s" COEFFS 0 320000.000000 0.000000 0 0.000000 23437.500000 /end COMPU_METHOD
/begin COMPU_METHOD m_BI_ "mittlerer spezifischer Verbrauch (Klimamoment-Uebersetzungsfaktor einbezogen)" RAT_FUNC "%8.6" "mm^3/Nm" COEFFS 0 1.000000 0.000000 0 0.000000 6.424900e-05 /end COMPU_METHOD
/begin COMPU_METHOD zuDT1_dLDF "Verstaerkungskoeffizient fuer dLDF/dt fuer HE-Beginn-Korrektur" RAT_FUNC "%8.6" "1/s" COEFFS 0 1.310720e+09 0.000000 0 0.000000 250000.000000 /end COMPU_METHOD
/end MODULE
/end PROJECT
