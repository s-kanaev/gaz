ASAP2_VERSION 1 3
/begin PROJECT _ "  P079.VC4.VA02  B07902C4.DAM:  DAMPAR_03"
/begin HEADER "EDC15C" PROJECT_NO VAR02 VERSION "MAX_KLKF" /end HEADER
/begin MODULE DIM " "
/begin MOD_COMMON " " S_REC_LAYOUT MSA15 DEPOSIT ABSOLUTE BYTE_ORDER MSB_LAST /end MOD_COMMON
/begin RECORD_LAYOUT MSA15_FW4 FNC_VALUES 1 SWORD COLUMN_DIR DIRECT /end RECORD_LAYOUT
/begin RECORD_LAYOUT MSA15_FW3 FNC_VALUES 1 UWORD COLUMN_DIR DIRECT /end RECORD_LAYOUT
/begin RECORD_LAYOUT MSA15_KL118 SRC_ADDR_X 1 UWORD NO_AXIS_PTS_X 2 UWORD AXIS_PTS_X 3 SWORD INDEX_INCR DIRECT FNC_VALUES 4 SWORD COLUMN_DIR DIRECT /end RECORD_LAYOUT
/begin RECORD_LAYOUT MSA15_KF382 SRC_ADDR_X 1 UWORD NO_AXIS_PTS_X 2 UWORD AXIS_PTS_X 3 SWORD INDEX_INCR DIRECT SRC_ADDR_Y 4 UWORD NO_AXIS_PTS_Y 5 UWORD AXIS_PTS_Y 6 SWORD INDEX_INCR DIRECT FNC_VALUES 7 SWORD COLUMN_DIR DIRECT /end RECORD_LAYOUT
/begin RECORD_LAYOUT MSA15_FW1 FNC_VALUES 1 UBYTE COLUMN_DIR DIRECT /end RECORD_LAYOUT
/begin RECORD_LAYOUT MSA15_GKF4 FNC_VALUES 1 SWORD COLUMN_DIR DIRECT /end RECORD_LAYOUT
/begin RECORD_LAYOUT MSA15_SST115 SRC_ADDR_X 1 UWORD NO_AXIS_PTS_X 2 UWORD AXIS_PTS_X 3 SWORD INDEX_INCR DIRECT /end RECORD_LAYOUT
/begin RECORD_LAYOUT MSA15_GKL4 FNC_VALUES 1 SWORD COLUMN_DIR DIRECT /end RECORD_LAYOUT
/begin CHARACTERISTIC zuwPQ_PBKF "#SSD RPC Steuer-KF DBE-Ventil TV = f(n, PSOLL)" MAP 0xF5844 MSA15_KF382 0 PROZ 0.000000 100.000000
 /begin AXIS_DESCR STD_AXIS dzmNmit N 8 0.000000 6000.000000 EXTENDED_LIMITS 0.000000 32767.000000 /end AXIS_DESCR
 /begin AXIS_DESCR STD_AXIS zumPQsoll RP 8 200000.000000 1350000.000000 EXTENDED_LIMITS -3276800.000000 3276700.000000 /end AXIS_DESCR
 EXTENDED_LIMITS -327.680000 327.670000 /end CHARACTERISTIC
/begin CHARACTERISTIC zuwPQ_dpKF "RPC BegrenzungsKF Solldruckspruenge ( Normalkennfeld )" MAP 0xF572C MSA15_GKF4 0 dRP 0.000000 67500000.000000
 /begin AXIS_DESCR COM_AXIS dzmNmit N 16 0.000000 6000.000000 AXIS_PTS_REF zuwXstzv EXTENDED_LIMITS 0.000000 32767.000000 /end AXIS_DESCR
 /begin AXIS_DESCR COM_AXIS mrmM_EMTS MM3 8 0.000000 325.000000 AXIS_PTS_REF zuwYstzv8 EXTENDED_LIMITS -327.680000 327.670000 /end AXIS_DESCR
 EXTENDED_LIMITS -163840000.000000 163835000.000000 /end CHARACTERISTIC
/begin CHARACTERISTIC zuwPQ_dpT1 "Zeit fuer zuwPQBdpKF nach d(M_E)+d(ldoE)-Triggerung" VALUE 0xF59B4 MSA15_FW4 0 ZEIT_HP 0.000000 1310700000.000000 /end CHARACTERISTIC
/begin CHARACTERISTIC zuwPQ_dpT2 "Zeit bis 100% zuwPQ_dpKF nach d(M_E)+d(ldoE)-Triggerung" VALUE 0xF59B6 MSA15_FW4 0 ZEIT_HP 0.000000 1310700000.000000 /end CHARACTERISTIC
/begin CHARACTERISTIC zuwPQ_mnKL "Begrenzungskennlinie Raildruck" CURVE 0xF5610 MSA15_KL118 0 RP 200000.000000 1350000.000000
 /begin AXIS_DESCR STD_AXIS dzmNmit N 6 0.000000 6000.000000 EXTENDED_LIMITS 0.000000 32767.000000 /end AXIS_DESCR
 EXTENDED_LIMITS -3276800.000000 3276700.000000 /end CHARACTERISTIC
/begin CHARACTERISTIC zuwPQabsdf "#SSD Raildruckueberwachung Vorgabewert bei Fehler        ! ***BC266 BEW2WI" VALUE 0xF8AA0 MSA15_FW4 0 RP 0.000000 1350000.000000 EXTENDED_LIMITS -3276800.000000 3276700.000000 /end CHARACTERISTIC
/begin CHARACTERISTIC zuwPQmaxKF "RPC Max-Druck; Pmax = f(n,M_EAKT)" MAP 0xF562C MSA15_GKF4 0 RP 200000.000000 1350000.000000
 /begin AXIS_DESCR COM_AXIS dzmNmit N 16 0.000000 6000.000000 AXIS_PTS_REF zuwXstzv EXTENDED_LIMITS 0.000000 32767.000000 /end AXIS_DESCR
 /begin AXIS_DESCR COM_AXIS mrmM_EAKT MM3 8 0.000000 325.000000 AXIS_PTS_REF zuwYEakt8 EXTENDED_LIMITS -327.680000 327.670000 /end AXIS_DESCR
 EXTENDED_LIMITS -3276800.000000 3276700.000000 /end CHARACTERISTIC
/begin CHARACTERISTIC zuwPQminKL "#SSD RPC Mindestdruck als f(n)" CURVE 0xF59E0 MSA15_KL118 0 RP 0.000000 1350000.000000
 /begin AXIS_DESCR STD_AXIS dzmNmit N 16 0.000000 6000.000000 EXTENDED_LIMITS 0.000000 32767.000000 /end AXIS_DESCR
 EXTENDED_LIMITS -3276800.000000 3276700.000000 /end CHARACTERISTIC
/begin CHARACTERISTIC zuwPQmindf "#SSD RPC Minmialdruck bei def. RDS" VALUE 0xF5018 MSA15_FW4 0 RP 0.000000 1350000.000000 EXTENDED_LIMITS -3276800.000000 3276700.000000 /end CHARACTERISTIC
/begin CHARACTERISTIC zuwPQmxdef "#SSD RPC Maximaldruck bei defektem System" VALUE 0xF4FFC MSA15_FW4 0 RP 200000.000000 1350000.000000 EXTENDED_LIMITS -3276800.000000 3276700.000000 /end CHARACTERISTIC
/begin CHARACTERISTIC zuwPRNEGKL "RPC P-Verstaerkung neg. Grossignal" CURVE 0xF592C MSA15_GKL4 0 RPC_KP 0.000000 0.001000
 /begin AXIS_DESCR COM_AXIS dzmNmit N 16 0.000000 6000.000000 AXIS_PTS_REF zuwXstzv EXTENDED_LIMITS 0.000000 32767.000000 /end AXIS_DESCR
 EXTENDED_LIMITS -0.001600 0.001600 /end CHARACTERISTIC
/begin CHARACTERISTIC zuwPRPOSKL "RPC P-Verstaerkung pos. Grossignal" CURVE 0xF590C MSA15_GKL4 0 RPC_KP 0.000000 0.001000
 /begin AXIS_DESCR COM_AXIS dzmNmit N 16 0.000000 6000.000000 AXIS_PTS_REF zuwXstzv EXTENDED_LIMITS 0.000000 32767.000000 /end AXIS_DESCR
 EXTENDED_LIMITS -0.001600 0.001600 /end CHARACTERISTIC
/begin CHARACTERISTIC zuwPRSIGKL "RPC P-Verstaerkung Kleinsignal" CURVE 0xF58EC MSA15_GKL4 0 RPC_KP 0.000000 0.001000
 /begin AXIS_DESCR COM_AXIS dzmNmit N 16 0.000000 6000.000000 AXIS_PTS_REF zuwXstzv EXTENDED_LIMITS 0.000000 32767.000000 /end AXIS_DESCR
 EXTENDED_LIMITS -0.001600 0.001600 /end CHARACTERISTIC
/begin CHARACTERISTIC zuwPR_FEN "RPC Fenster Kleinsignal P-Anteil" VALUE 0xF59C4 MSA15_FW4 0 RP 0.000000 1350000.000000 EXTENDED_LIMITS -3276800.000000 3276700.000000 /end CHARACTERISTIC
/begin CHARACTERISTIC zuwP_PBmax "#SSD RPC max.TV DBE-Ventil: Leckageerkennung" VALUE 0xF5004 MSA15_FW4 0 PROZ 0.000000 100.000000 EXTENDED_LIMITS -327.680000 327.670000 /end CHARACTERISTIC
/begin CHARACTERISTIC zuwP_reg "RPC Schwelle Umschalten Steuern -> Regeln" VALUE 0xF8A7C MSA15_FW3 0 RP 0.000000 1350000.000000 EXTENDED_LIMITS -3276800.000000 3276700.000000 /end CHARACTERISTIC
/begin CHARACTERISTIC zuwPmax_KF "KDP Plaus.: P_Rail_max = f(N,I_DRV)" MAP 0xF8AAC MSA15_KF382 0 RP 0.000000 1350000.000000
 /begin AXIS_DESCR STD_AXIS dzmNmit N 2 0.000000 6000.000000 EXTENDED_LIMITS 0.000000 32767.000000 /end AXIS_DESCR
 /begin AXIS_DESCR STD_AXIS anmIDV IDV 2 0.000000 5000.000000 EXTENDED_LIMITS -32768.000000 32767.000000 /end AXIS_DESCR
 EXTENDED_LIMITS -3276800.000000 3276700.000000 /end CHARACTERISTIC
/begin CHARACTERISTIC zuwPmin_KF "KDP Plaus.: P_Rail_min = f(N,I_DRV)" MAP 0xF8AC4 MSA15_KF382 0 RP 0.000000 1350000.000000
 /begin AXIS_DESCR STD_AXIS dzmNmit N 2 0.000000 6000.000000 EXTENDED_LIMITS 0.000000 32767.000000 /end AXIS_DESCR
 /begin AXIS_DESCR STD_AXIS anmIDV IDV 2 0.000000 5000.000000 EXTENDED_LIMITS -32768.000000 32767.000000 /end AXIS_DESCR
 EXTENDED_LIMITS -3276800.000000 3276700.000000 /end CHARACTERISTIC
/begin CHARACTERISTIC zuwPplaus "#SSD RPC Schwelle, ab der Drucktest sinnvoll" VALUE 0xF500C MSA15_FW4 0 RP 0.000000 1350000.000000 EXTENDED_LIMITS -3276800.000000 3276700.000000 /end CHARACTERISTIC
/begin CHARACTERISTIC zuwRAmaxKL "RPC max. Regelabweichung = f(n)" CURVE 0xF5A24 MSA15_KL118 0 RP 0.000000 1350000.000000
 /begin AXIS_DESCR STD_AXIS dzmNmit N 12 0.000000 6000.000000 EXTENDED_LIMITS 0.000000 32767.000000 /end AXIS_DESCR
 EXTENDED_LIMITS -3276800.000000 3276700.000000 /end CHARACTERISTIC
/begin CHARACTERISTIC zuwRDUH1 "#SSD RPC Raildruckueberhoehung ein       ! ***BC266 BEW2WI" VALUE 0xF8C1C MSA15_FW4 0 RP 0.000000 1500000.000000 EXTENDED_LIMITS -3276800.000000 3276700.000000 /end CHARACTERISTIC
/begin CHARACTERISTIC zuwRDUH2 "#SSD RPC Raildruckueberhoehung aus       ! ***BC266 BEW2WI" VALUE 0xF8C1A MSA15_FW4 0 RP 0.000000 1500000.000000 EXTENDED_LIMITS -3276800.000000 3276700.000000 /end CHARACTERISTIC
/begin CHARACTERISTIC zuwRDUHIK "RPC Kleinsignalverstaerkung" VALUE 0xF5020 MSA15_FW4 0 DEZ_DW -32768.000000 32767.000000 /end CHARACTERISTIC
/begin CHARACTERISTIC zuwRDUH_C "#SSD RPC Counter fuer Raildruckueberhoehung      ! ***BC266 BEW2WI" VALUE 0xF501E MSA15_FW3 0 DEZ_DW_U 0.000000 65535.000000 /end CHARACTERISTIC
/begin CHARACTERISTIC zuwRDUH_I "#SSD RPC I-Anteil Verstaerkung   ! ***BC266 BEW2WI" VALUE 0xF501C MSA15_FW4 0 DEZ_DW -32768.000000 32767.000000 /end CHARACTERISTIC
/begin CHARACTERISTIC zuwRD_UE_N "#SSD Schalter zum Abschalten der kaskadierten Abschaltung        ! ***BC266 BEW2" VALUE 0xF8AA4 MSA15_FW1 0 DEZ_DB_U 0.000000 255.000000 /end CHARACTERISTIC
/begin CHARACTERISTIC zuwT4GWKF "Abschaltung NE Abgastemperaturgrundkennfeld" MAP 0xF9174 MSA15_KF382 0 T -50.040010 899.960000
 /begin AXIS_DESCR STD_AXIS dzmNmit N 2 0.000000 6000.000000 EXTENDED_LIMITS 0.000000 32767.000000 /end AXIS_DESCR
 /begin AXIS_DESCR STD_AXIS mrmM_EAKT MM3 2 0.000000 100.000000 EXTENDED_LIMITS -327.680000 327.670000 /end AXIS_DESCR
 EXTENDED_LIMITS -273.140000 3003.560000 /end CHARACTERISTIC
/begin CHARACTERISTIC zuwT4LTKL "Abschaltung NE Abgastemperatur Korrekturkennlinie" CURVE 0xF918C MSA15_KL118 0 FAKT -3.200000 3.200000
 /begin AXIS_DESCR STD_AXIS anmLTF T 2 -50.040010 199.960000 EXTENDED_LIMITS -273.140000 3003.560000 /end AXIS_DESCR
 EXTENDED_LIMITS -3.276800 3.276700 /end CHARACTERISTIC
/begin CHARACTERISTIC zuwT4WTKL "Abschaltung NE Abgastemperatur Grundkennlinie" CURVE 0xF9168 MSA15_KL118 0 FAKT -3.200000 3.200000
 /begin AXIS_DESCR STD_AXIS anmWTF T 2 -50.040010 149.960000 EXTENDED_LIMITS -273.140000 3003.560000 /end AXIS_DESCR
 EXTENDED_LIMITS -3.276800 3.276700 /end CHARACTERISTIC
/begin CHARACTERISTIC zuwT4_aus "INJ Ausschaltschwelle der NE-Deaktivierungshysterese [Grad C]" VALUE 0xF934C MSA15_FW4 0 T -50.040010 899.960000 EXTENDED_LIMITS -273.140000 3003.560000 /end CHARACTERISTIC
/begin CHARACTERISTIC zuwT4_ein "INJ Einschaltschwelle der NE-Deaktivierungshysterese [Grad C]" VALUE 0xF934A MSA15_FW4 0 T -50.040010 899.960000 EXTENDED_LIMITS -273.140000 3003.560000 /end CHARACTERISTIC
/begin CHARACTERISTIC zuwTImin0 "#SSD INJ untere TI-Schwelle" VALUE 0xF5A70 MSA15_FW4 0 AD_uS 70.000000 200.000000 EXTENDED_LIMITS -32768.000000 32767.000000 /end CHARACTERISTIC
/begin CHARACTERISTIC zuwTImin1 "#SSD INJ obere TI-Schwelle" VALUE 0xF5A72 MSA15_FW4 0 AD_uS 70.000000 200.000000 EXTENDED_LIMITS -32768.000000 32767.000000 /end CHARACTERISTIC
/begin CHARACTERISTIC zuwTMKATKL "INJ Korr.faktor abh. von Katalysatortemp." CURVE 0xF9304 MSA15_KL118 0 FAKT 0.000000 1.000000
 /begin AXIS_DESCR STD_AXIS zuoNE_Tkat TempKelv 2 230.000000 1200.000000 EXTENDED_LIMITS 0.000000 3276.700000 /end AXIS_DESCR
 EXTENDED_LIMITS -3.276800 3.276700 /end CHARACTERISTIC
/begin CHARACTERISTIC zuwTV_AUS "#SSD RPC maximales TV bei defektem System" VALUE 0xF4FFE MSA15_FW4 0 PROZ 0.000000 50.000000 EXTENDED_LIMITS -327.680000 327.670000 /end CHARACTERISTIC
/begin CHARACTERISTIC zuwTpause "#SSD INJ Pause nach Recharge" VALUE 0xF7470 MSA15_FW4 0 AD_uS 0.000000 136.000000 EXTENDED_LIMITS -32768.000000 32767.000000 /end CHARACTERISTIC
/begin CHARACTERISTIC zuwTrchgKL "#SSD INJ Rechargezeit Trchg = f(Ubatt)" CURVE 0xF9AEE MSA15_KL118 0 AD_uS 200.000000 7000.000000
 /begin AXIS_DESCR STD_AXIS anmUBT U_B 8 5007.385000 20005.920000 EXTENDED_LIMITS 0.000000 773948.100000 /end AXIS_DESCR
 EXTENDED_LIMITS -32768.000000 32767.000000 /end CHARACTERISTIC
/begin CHARACTERISTIC zuwVEA_KF "INJ AGR-KF VE-Schaltung, Wert = f(N, armM_List)" MAP 0xF7862 MSA15_KF382 0 VEon_off 0.000000 100.000000
 /begin AXIS_DESCR STD_AXIS dzmNmit N 2 0.000000 6000.000000 EXTENDED_LIMITS 0.000000 32767.000000 /end AXIS_DESCR
 /begin AXIS_DESCR STD_AXIS armM_List M_L 2 0.000000 1500.000000 EXTENDED_LIMITS -3276.800000 3276.700000 /end AXIS_DESCR
 EXTENDED_LIMITS -3276.800000 3276.700000 /end CHARACTERISTIC
/begin CHARACTERISTIC zuwVEKF "INJ GrundwerteKF VE-Schaltung, Wert = f(N, M_EMOT)" MAP 0xF787A MSA15_GKF4 0 VEon_off 0.000000 100.000000
 /begin AXIS_DESCR COM_AXIS dzmNmit N 16 0.000000 6000.000000 AXIS_PTS_REF zuwXstzv EXTENDED_LIMITS 0.000000 32767.000000 /end AXIS_DESCR
 /begin AXIS_DESCR COM_AXIS mrmM_EMTS MM3 8 0.000000 325.000000 AXIS_PTS_REF zuwYstzv8 EXTENDED_LIMITS -327.680000 327.670000 /end AXIS_DESCR
 EXTENDED_LIMITS -3276.800000 3276.700000 /end CHARACTERISTIC
/begin CHARACTERISTIC zuwVEPkKL "INJ Korrektur-KL VE_Schaltung als f(ADF)" CURVE 0xF9A62 MSA15_KL118 0 VEon_off -100.000000 100.000000
 /begin AXIS_DESCR STD_AXIS ldmADF P 4 0.000000 3500.000000 EXTENDED_LIMITS -32768.000000 32767.000000 /end AXIS_DESCR
 EXTENDED_LIMITS -3276.800000 3276.700000 /end CHARACTERISTIC
/begin CHARACTERISTIC zuwVEWkKL "INJ Korrektur-KL VE-Schaltung als f(WTF)" CURVE 0xF9A46 MSA15_KL118 0 VEon_off -100.000000 100.000000
 /begin AXIS_DESCR STD_AXIS anmWTF T 6 -50.040010 149.960000 EXTENDED_LIMITS -273.140000 3003.560000 /end AXIS_DESCR
 EXTENDED_LIMITS -3276.800000 3276.700000 /end CHARACTERISTIC
/begin CHARACTERISTIC zuwVEaus "INJ untere Schwelle fuer VE ausschalten" VALUE 0xF5A78 MSA15_FW4 0 VEon_off 0.000000 100.000000 EXTENDED_LIMITS -3276.800000 3276.700000 /end CHARACTERISTIC
/begin CHARACTERISTIC zuwVEein "INJ obere Schwelle fuer VE einschalten" VALUE 0xF5A7A MSA15_FW4 0 VEon_off 0.000000 100.000000 EXTENDED_LIMITS -3276.800000 3276.700000 /end CHARACTERISTIC
/begin CHARACTERISTIC zuwVEvkKL "INJ Korrektur-KL VE_Schaltung als f(v)" CURVE 0xF9A76 MSA15_KL118 0 VEon_off -100.000000 100.000000
 /begin AXIS_DESCR STD_AXIS fgmFGAKT V 2 0.000000 300.000000 EXTENDED_LIMITS 0.000000 327.670000 /end AXIS_DESCR
 EXTENDED_LIMITS -3276.800000 3276.700000 /end CHARACTERISTIC
/begin AXIS_PTS zuwXstzv "X-Stuetzstellenverteilung fuer dzmNmit" 0xF4F3C dzmNmit MSA15_SST115 0 N 16 0.000000 6000.000000 EXTENDED_LIMITS 0.000000 32767.000000 /end AXIS_PTS
/begin AXIS_PTS zuwYEakt8 "Y-Stuetzstellenverteilung fuer mrmM_EAKT" 0xF4FC4 mrmM_EAKT MSA15_SST115 0 MM3 8 0.000000 325.000000 EXTENDED_LIMITS -327.680000 327.670000 /end AXIS_PTS
/begin AXIS_PTS zuwYstzv8 "Y-Stuetzstellenverteilung fuer mrmM_EMTS     ! ***BC081 bar2wi" 0xF4F8C mrmM_EMTS MSA15_SST115 0 MM3 8 0.000000 325.000000 EXTENDED_LIMITS -327.680000 327.670000 /end AXIS_PTS
/begin CHARACTERISTIC zuwdPKmax "#SSD RPC max. Soll/Ist Druckdiff: Leckageerkennung" VALUE 0xF5002 MSA15_FW4 0 RP 0.000000 1350000.000000 EXTENDED_LIMITS -3276800.000000 3276700.000000 /end CHARACTERISTIC
/begin CHARACTERISTIC zuwdPKmin "#SSD RPC max. Soll/Ist Druckdiff., < 0: DBE klemmt" VALUE 0xF5006 MSA15_FW4 0 RP -1350000.000000 0.000000 EXTENDED_LIMITS -3276800.000000 3276700.000000 /end CHARACTERISTIC
/begin CHARACTERISTIC zuwdPQneg "#SSD RPC maximaler Solldruckabfall pro Sekunde" VALUE 0xF5016 MSA15_FW4 0 dRP 0.000000 100000000.000000 EXTENDED_LIMITS -163840000.000000 163835000.000000 /end CHARACTERISTIC
/begin CHARACTERISTIC zuwtNEmin0 "INJ obere Mindestdauer der NE-Hysterese [us]" VALUE 0xF9350 MSA15_FW4 0 AD_uS 70.000000 200.000000 EXTENDED_LIMITS -32768.000000 32767.000000 /end CHARACTERISTIC
/begin CHARACTERISTIC zuwtNEmin1 "INJ obere Mindestdauer der NE-Hysterese [us]" VALUE 0xF934E MSA15_FW4 0 AD_uS 0.000000 200.000000 EXTENDED_LIMITS -32768.000000 32767.000000 /end CHARACTERISTIC
/begin CHARACTERISTIC zuwt_NEaus "INJ Ausschaltverzoegerung der NE-Deaktivierungshysterese [us]" VALUE 0xF9348 MSA15_FW4 0 ZEIT_ST 0.000000 655350000.000000 /end CHARACTERISTIC
/begin COMPU_METHOD AD_uS "Ansteuerdauer" RAT_FUNC "%8.2" "uS" COEFFS 0 1.000000 0.000000 0 0.000000 1.000000 /end COMPU_METHOD
/begin COMPU_METHOD B "Umrechnung Beschleunigung" RAT_FUNC "%8.5" "m/s^2" COEFFS 0 3.276800e-02 0.000000 0 0.000000 2.777780e-03 /end COMPU_METHOD
/begin COMPU_METHOD BI_ "Spezifischer Verbrauch" RAT_FUNC "%8.6" "mm^3/Nm" COEFFS 0 1.000000 0.000000 0 0.000000 1.000000e-05 /end COMPU_METHOD
/begin COMPU_METHOD BSTZ_TIC_h "Umrechnung von Betriebstundentics in h" RAT_FUNC "%8.3" "Std" COEFFS 0 10.000000 0.000000 0 0.000000 1.000000 /end COMPU_METHOD
/begin COMPU_METHOD BSTZ_TIC_s "Umrechnung von Betriebstundentics in s" RAT_FUNC "%8.2" "s" COEFFS 0 1.000000 0.000000 0 0.000000 1.000000 /end COMPU_METHOD
/begin COMPU_METHOD B_VINC "Umrechnung Beschleunigung in Geschwindigkeitsinkrement * 256" RAT_FUNC "%8.5" "m/s^2" COEFFS 0 18.432000 5.000000e-03 0 0.000000 1.000000e-02 /end COMPU_METHOD
/begin COMPU_METHOD DEZ_DB "Uebernahme von Festwerten von -128 bis 127" RAT_FUNC "%8.4" "-" COEFFS 0 1.000000 0.000000 0 0.000000 1.000000 /end COMPU_METHOD
/begin COMPU_METHOD DEZ_DB_U "Uebernahme von Festwerten von 0 bis 255" RAT_FUNC "%8.4" "-" COEFFS 0 1.000000 0.000000 0 0.000000 1.000000 /end COMPU_METHOD
/begin COMPU_METHOD DEZ_DW "Uebernahme von Festwerten von -32768 bis 32767" RAT_FUNC "%8.2" "-" COEFFS 0 1.000000 0.000000 0 0.000000 1.000000 /end COMPU_METHOD
/begin COMPU_METHOD DEZ_DW_U "Uebernahme von Festwerten von 0 bis 65535" RAT_FUNC "%8.2" "-" COEFFS 0 1.000000 0.000000 0 0.000000 1.000000 /end COMPU_METHOD
/begin COMPU_METHOD DIF_T "Umrechnung Temperaturdifferenz" RAT_FUNC "%8.3" "Grad C" COEFFS 0 1.000000 0.000000 0 0.000000 1.000000e-01 /end COMPU_METHOD
/begin COMPU_METHOD DIV10KM "Dividiert durch 10 [km]" RAT_FUNC "%8.1" "km" COEFFS 0 1.000000 0.000000 0 0.000000 10.000000 /end COMPU_METHOD
/begin COMPU_METHOD ELon_off "Quantisierung 3.EL-Schaltung" RAT_FUNC "%8.3" "-" COEFFS 0 10.000000 0.000000 0 0.000000 1.000000 /end COMPU_METHOD
/begin COMPU_METHOD FAKT "Umrechnung fuer multiplikative Faktoren" RAT_FUNC "%8.6" "-" COEFFS 0 1.000000 0.000000 0 0.000000 1.000000e-04 /end COMPU_METHOD
/begin COMPU_METHOD FGG_NE "Umrechnung Normexponent fuer FGG" RAT_FUNC "%1.0" "" COEFFS 0 271.000000 264.000000 0 0.000000 1.000000 /end COMPU_METHOD
/begin COMPU_METHOD FGG_SF "Umrechnung Streckenfaktor fuer FGG" RAT_FUNC "%8.5" "Imp/m" COEFFS 0 0.000000 3600000.000000 0 81.920000 0.000000 /end COMPU_METHOD
/begin COMPU_METHOD GradKW "GradKW fuer Gatearray" RAT_FUNC "%8.4" "Grad KW" COEFFS 0 1.000000 0.000000 0 0.000000 2.343750e-02 /end COMPU_METHOD
/begin COMPU_METHOD IDV "Umrechnung Strom Druckregelventil" RAT_FUNC "%8.2" "mA" COEFFS 0 1.000000 0.000000 0 0.000000 1.000000 /end COMPU_METHOD
/begin COMPU_METHOD IRc2PZM10 "Umrechnung 10-Bit PZM in Strom" RAT_FUNC "%8.2" "mA" COEFFS 0 1.859810e-02 0.000000 0 0.000000 1.000000 /end COMPU_METHOD
/begin COMPU_METHOD KDF "Umrechnung Kraftstoffdruck-Fuehler Hochdruckkreis" RAT_FUNC "%7.0" "hPa" COEFFS 0 1.000000 0.000000 0 0.000000 100.000000 /end COMPU_METHOD
/begin COMPU_METHOD LFZ "Laufzeit" RAT_FUNC "%8.1" "uS" COEFFS 0 1.000000 0.000000 0 0.000000 2.000000 /end COMPU_METHOD
/begin COMPU_METHOD LMM "Umrechnung Luftmassenmesser Rohwert" RAT_FUNC "%8.4" "%" COEFFS 0 1.000000 0.000000 0 0.000000 1.000000e-02 /end COMPU_METHOD
/begin COMPU_METHOD MLS_N_DW "Motorluefterdrehzahl MLS" RAT_FUNC "%8.2" "1/min" COEFFS 0 32767.000000 0.000000 0 0.000000 3000.000000 /end COMPU_METHOD
/begin COMPU_METHOD MM3 "1 * 10E-2" RAT_FUNC "%8.4" "mm^3" COEFFS 0 1.000000 0.000000 0 0.000000 1.000000e-02 /end COMPU_METHOD
/begin COMPU_METHOD MM3pS "1 * 10E-2" RAT_FUNC "%8.4" "mm^3/s" COEFFS 0 100.000000 0.000000 0 0.000000 1.000000 /end COMPU_METHOD
/begin COMPU_METHOD MM3pSek "Einduesvolumen pro Sekunde" RAT_FUNC "%8.2" "mm^3/sec" COEFFS 0 2000000.000000 0.000000 0 0.000000 1000000.000000 /end COMPU_METHOD
/begin COMPU_METHOD MOMENT "Umrechnung Moment" RAT_FUNC "%8.2" "Nm(bei n_Kli=800 1/m" COEFFS 0 1.000000 0.000000 0 0.000000 1.000000 /end COMPU_METHOD
/begin COMPU_METHOD MOMENT_16 "Umrechnung Moment fuer 16 bit" RAT_FUNC "%8.4" "Nm" COEFFS 0 1.000000 0.000000 0 0.000000 1.556440e-02 /end COMPU_METHOD
/begin COMPU_METHOD MOMENT_C "Umrechnung Moment fuer CAN" RAT_FUNC "%8.2" "Nm" COEFFS 0 1.000000 0.000000 0 0.000000 2.000000 /end COMPU_METHOD
/begin COMPU_METHOD M_E "Umrechnung Menge" RAT_FUNC "%8.4" "mm^3" COEFFS 0 1.000000 0.000000 0 0.000000 1.000000e-02 /end COMPU_METHOD
/begin COMPU_METHOD M_L "Umrechnung Luftmasse" RAT_FUNC "%8.3" "mg/Hub Luft" COEFFS 0 1.000000 0.000000 0 0.000000 1.000000e-01 /end COMPU_METHOD
/begin COMPU_METHOD M_Lt "Umrechnung Luftmassendurchsatz" RAT_FUNC "%8.3" "kg/h Luft" COEFFS 0 1.000000 0.000000 0 0.000000 1.000000e-01 /end COMPU_METHOD
/begin COMPU_METHOD N "Umrechnung Drehzahl" RAT_FUNC "%8.2" "1/min" COEFFS 0 1.000000 0.000000 0 0.000000 1.000000 /end COMPU_METHOD
/begin COMPU_METHOD P "Umrechnung Ladedruck" RAT_FUNC "%8.2" "hPa" COEFFS 0 1.000000 0.000000 0 0.000000 1.000000 /end COMPU_METHOD
/begin COMPU_METHOD PROZ "Umrechnung Tastverhaeltnis" RAT_FUNC "%8.4" "%" COEFFS 0 1.000000 0.000000 0 0.000000 1.000000e-02 /end COMPU_METHOD
/begin COMPU_METHOD PROZ_S "Umrechnung Schleiferspannung in Prozent" RAT_FUNC "%8.4" "%" COEFFS 0 1.000000 0.000000 0 0.000000 1.000000e-02 /end COMPU_METHOD
/begin COMPU_METHOD RP "Railpressure" RAT_FUNC "%7.0" "hPa" COEFFS 0 1.000000 0.000000 0 0.000000 100.000000 /end COMPU_METHOD
/begin COMPU_METHOD RPC_KP "P-Verstaerkung KP (RPC)" RAT_FUNC "%10.8" " % / hPa " COEFFS 0 6.553600e+06 0.000000 0 0.000000 3.200000e-01 /end COMPU_METHOD
/begin COMPU_METHOD T "Umrechnung Temperatur" RAT_FUNC "%8.3" "Grad C" COEFFS 0 1.000000 273.140000 0 0.000000 1.000000e-01 /end COMPU_METHOD
/begin COMPU_METHOD TempKelv "Umrechnung Temperatur" RAT_FUNC "%8.3" "Kelvin" COEFFS 0 1.000000 0.000000 0 0.000000 1.000000e-01 /end COMPU_METHOD
/begin COMPU_METHOD U "Umrechnung fuer Spannungen" RAT_FUNC "%8.1" "mV" COEFFS 0 1023.000000 0.000000 0 0.000000 5000.000000 /end COMPU_METHOD
/begin COMPU_METHOD U_B "Umrechnung fuer Spannungen bis zu 12V" RAT_FUNC "%8.1" "mV" COEFFS 0 1023.000000 0.000000 0 0.000000 24163.000000 /end COMPU_METHOD
/begin COMPU_METHOD U_C "Umrechnung fuer Spannungen bis zu   V" RAT_FUNC "%7.0" "mV" COEFFS 0 4.861000e-02 0.000000 0 0.000000 1.000000 /end COMPU_METHOD
/begin COMPU_METHOD U_G "Umrechnung fuer Geberspeisespannungen der Sensoren" RAT_FUNC "%8.1" "mV" COEFFS 0 10230000.000000 0.000000 0 0.000000 180500000.000000 /end COMPU_METHOD
/begin COMPU_METHOD V "Umrechnung Geschwindigkeit" RAT_FUNC "%8.4" "km/h" COEFFS 0 1.000000 0.000000 0 0.000000 1.000000e-02 /end COMPU_METHOD
/begin COMPU_METHOD VB_C "Umrechnung Verbrauch fuer CAN" RAT_FUNC "%8.2" "ul" COEFFS 0 1.000000 0.000000 0 0.000000 1.000000 /end COMPU_METHOD
/begin COMPU_METHOD VB_MES "Maximaler Verbrauch/Messung" RAT_FUNC "%8.4" "l/h" COEFFS 0 1692308.000000 0.000000 0 0.000000 36864.000000 /end COMPU_METHOD
/begin COMPU_METHOD VDF "Umrechnung Kraftstoffvorfoerderdruck" RAT_FUNC "%8.2" "hPa" COEFFS 0 1.000000 0.000000 0 0.000000 1.000000 /end COMPU_METHOD
/begin COMPU_METHOD VEon_off "Quantisierung VE-Aktivierung" RAT_FUNC "%8.3" "-" COEFFS 0 10.000000 0.000000 0 0.000000 1.000000 /end COMPU_METHOD
/begin COMPU_METHOD V_DIFF "Umrechnung Geschwindigkeitsdifferenzen" RAT_FUNC "%8.4" "km/h" COEFFS 0 1.000000 0.000000 0 0.000000 1.000000e-02 /end COMPU_METHOD
/begin COMPU_METHOD V_N "Umrechnung V/N" RAT_FUNC "%8.6" "(km/h)/(1/min)" COEFFS 0 256.000000 0.000000 0 0.000000 1.000000e-02 /end COMPU_METHOD
/begin COMPU_METHOD ZEIT_HP "Umrechnung Timer Hauptprogramm" RAT_FUNC "%10.0" "us" COEFFS 0 1.000000 0.000000 0 0.000000 20000.000000 /end COMPU_METHOD
/begin COMPU_METHOD ZEIT_KLKF "Umrechnung Zeit Softwaretimer speziell fuer KL/KF" RAT_FUNC "%9.0" "us" COEFFS 0 1.000000 0.000000 0 0.000000 10000.000000 /end COMPU_METHOD
/begin COMPU_METHOD ZEIT_ST "Umrechnung Zeit Softwaretimer" RAT_FUNC "%9.0" "us" COEFFS 0 1.000000 0.000000 0 0.000000 10000.000000 /end COMPU_METHOD
/begin COMPU_METHOD ZEIT_ST_S "Umrechnung Zeit Softwaretimer (Sec)" RAT_FUNC "%8.4" "s" COEFFS 0 1000000.000000 0.000000 0 0.000000 10000.000000 /end COMPU_METHOD
/begin COMPU_METHOD ZEIT_T0 "Umrechnung Timer0" RAT_FUNC "%8.2" "us" COEFFS 0 1.000000 0.000000 0 0.000000 1.000000 /end COMPU_METHOD
/begin COMPU_METHOD dL_dZHP5 "Umrechnung Ladedruckdifferenz 100ms" RAT_FUNC "%8.2" "hPa/s" COEFFS 0 100000.000000 0.000000 0 0.000000 100000.000000 /end COMPU_METHOD
/begin COMPU_METHOD dM_E_dZ "Mengenaenderung pro Hauptprogrammdurchlauf" RAT_FUNC "%8.2" "mm^3/s" COEFFS 0 2.000000e-02 0.000000 0 0.000000 1.000000e-02 /end COMPU_METHOD
/begin COMPU_METHOD dN "Umrechnung Drehzahloffset" RAT_FUNC "%8.2" "1/min" COEFFS 0 1.000000 0.000000 0 0.000000 1.000000 /end COMPU_METHOD
/begin COMPU_METHOD dN_dZ_U "Drehzahlaenderung pro Hauptprogrammdurchlauf" RAT_FUNC "%7.0" "(U/min)/s" COEFFS 0 2.000000e-02 0.000000 0 0.000000 1.000000 /end COMPU_METHOD
/begin COMPU_METHOD dP_dZ "Ladedruckaenderung pro Hauptprogrammdurchlauf" RAT_FUNC "%7.0" "hPa/s" COEFFS 0 2.000000e-02 0.000000 0 0.000000 1.000000 /end COMPU_METHOD
/begin COMPU_METHOD dRP "Raildrucksprung" RAT_FUNC "%9.0" "hPa/sec" COEFFS 0 20000.000000 0.000000 0 0.000000 100000000.000000 /end COMPU_METHOD
/begin COMPU_METHOD dT_dZHP5 "Umrechnung Temperaturdifferenz 100ms" RAT_FUNC "%8.2" "Grad C/s" COEFFS 0 100000.000000 0.000000 0 0.000000 100000.000000 /end COMPU_METHOD
/begin COMPU_METHOD NoCompuMethod "" RAT_FUNC "%4.0" "" COEFFS 0 1 0 0 0 1 /end COMPU_METHOD
/begin MEASUREMENT admADF "ADF Atmosphaerendruck Diagnose" SWORD P 0 0 -32768.000000 32767.000000 ECU_ADDRESS 0xC170 BIT_MASK 0xFFFF /end MEASUREMENT
/begin MEASUREMENT admAT1 "AT1 Abgastemperaturfuehler 1 Diagnose" SWORD T 0 0 -273.140000 3003.560000 ECU_ADDRESS 0xC174 BIT_MASK 0xFFFF /end MEASUREMENT
/begin MEASUREMENT admAT2 "AT2 Abgastemperaturfuehler 2 Diagnose" SWORD T 0 0 -273.140000 3003.560000 ECU_ADDRESS 0xC178 BIT_MASK 0xFFFF /end MEASUREMENT
/begin MEASUREMENT admIDV "IDV Istwert Stromregelung Druckregelventil Diagnose" SWORD IDV 0 0 -32768.000000 32767.000000 ECU_ADDRESS 0xC142 BIT_MASK 0xFFFF /end MEASUREMENT
/begin MEASUREMENT admKDF "KDF Kraftstoffdruckfuehler Diagnose" SWORD KDF 0 0 -3276800.000000 3276700.000000 ECU_ADDRESS 0xC180 BIT_MASK 0xFFFF /end MEASUREMENT
/begin MEASUREMENT admKTF "KTF Kraftstofftemperatur Diagnose" SWORD T 0 0 -273.140000 3003.560000 ECU_ADDRESS 0xC164 BIT_MASK 0xFFFF /end MEASUREMENT
/begin MEASUREMENT admLDF "LDF Lade- / Saugrohr-Druck Diagnose" SWORD P 0 0 -32768.000000 32767.000000 ECU_ADDRESS 0xC13E BIT_MASK 0xFFFF /end MEASUREMENT
/begin MEASUREMENT admLMM "LMM Luftmassenmesser HFM Diagnose" SWORD LMM 0 0 -327.680000 327.670000 ECU_ADDRESS 0xC146 BIT_MASK 0xFFFF /end MEASUREMENT
/begin MEASUREMENT admLTF "LTF Lufttemperatur Diagnose" SWORD T 0 0 -273.140000 3003.560000 ECU_ADDRESS 0xC160 BIT_MASK 0xFFFF /end MEASUREMENT
/begin MEASUREMENT admOTF "OTF Oeltemperartur Diagnose" SWORD T 0 0 -273.140000 3003.560000 ECU_ADDRESS 0xC16C BIT_MASK 0xFFFF /end MEASUREMENT
/begin MEASUREMENT admPGS "PGS Pedalwertgeber 2 - Position (ungefiltert) Diagnose" SWORD PROZ_S 0 0 -327.680000 327.670000 ECU_ADDRESS 0xC154 BIT_MASK 0xFFFF /end MEASUREMENT
/begin MEASUREMENT admPWG "PWG Pedalwertgeber 1 - Position (ungefiltert) Diagnose" SWORD PROZ_S 0 0 -327.680000 327.670000 ECU_ADDRESS 0xC14C BIT_MASK 0xFFFF /end MEASUREMENT
/begin MEASUREMENT admUBT "UBT Batteriespannung Diagnose" SWORD U_B 0 0 0.000000 773948.100000 ECU_ADDRESS 0xC17C BIT_MASK 0xFFFF /end MEASUREMENT
/begin MEASUREMENT admUC1 "UC Kondensatorspannung Bank 1 Diagnose" SWORD U_C 0 0 0.000000 1348179.000000 ECU_ADDRESS 0xC138 BIT_MASK 0xFFFF /end MEASUREMENT
/begin MEASUREMENT admUC2 "UC Kondensatorspannung Bank 2 Diagnose" SWORD U_C 0 0 0.000000 1348179.000000 ECU_ADDRESS 0xC13A BIT_MASK 0xFFFF /end MEASUREMENT
/begin MEASUREMENT admUG1 "UG1 Geber-Speisung 1 Diagnose" SWORD U_G 0 0 0.000000 578147.000000 ECU_ADDRESS 0xC18C BIT_MASK 0xFFFF /end MEASUREMENT
/begin MEASUREMENT admUG2 "UG2 Geber-Speisung 2 Diagnose" SWORD U_G 0 0 0.000000 578147.000000 ECU_ADDRESS 0xC190 BIT_MASK 0xFFFF /end MEASUREMENT
/begin MEASUREMENT admVDF "VDF Vorfoerderdruck Diagnose" SWORD VDF 0 0 -32768.000000 32767.000000 ECU_ADDRESS 0xC168 BIT_MASK 0xFFFF /end MEASUREMENT
/begin MEASUREMENT admWTF "WTF Wassertemperatur Diagnose" SWORD T 0 0 -273.140000 3003.560000 ECU_ADDRESS 0xC158 BIT_MASK 0xFFFF /end MEASUREMENT
/begin MEASUREMENT agmMLSstat "MLS Status MLS Zustandsautomat" UBYTE DEZ_DB_U 0 0 0.000000 255.000000 ECU_ADDRESS 0xC3F1 BIT_MASK 0xFF /end MEASUREMENT
/begin MEASUREMENT agmfMLSDia "MLS Kurzschlußfehler" UBYTE DEZ_DB_U 0 0 0.000000 255.000000 ECU_ADDRESS 0xC3F2 BIT_MASK 0xFF /end MEASUREMENT
/begin MEASUREMENT agoDSLKLN "AGG nur VS100: ermittelter Schwellenwert fuer DZ-Hysterese" UWORD N 0 0 0.000000 32767.000000 ECU_ADDRESS 0xDC28 BIT_MASK 0xFFFF /end MEASUREMENT
/begin MEASUREMENT agoDSL_N "AGG Zustand der DZ-Hysterese" UWORD DEZ_DW_U 0 0 0.000000 65535.000000 ECU_ADDRESS 0xDB5A BIT_MASK 0xFFFF /end MEASUREMENT
/begin MEASUREMENT agoDSL_V "AGG Zustand der FG-Hysterese" UWORD DEZ_DW_U 0 0 0.000000 65535.000000 ECU_ADDRESS 0xDB58 BIT_MASK 0xFFFF /end MEASUREMENT
/begin MEASUREMENT agoFGfakt "MLS Gewichtungsfaktor fuer CAN-MLS-Drehzahl" UWORD FAKT 0 0 -3.276800 3.276700 ECU_ADDRESS 0xDA26 BIT_MASK 0xFFFF /end MEASUREMENT
/begin MEASUREMENT agoMLSKF "MLS Aus KF ermittelte Lueftersolldrehzahl" UWORD MLS_N_DW 0 0 0.000000 32766.990000 ECU_ADDRESS 0xDC2C BIT_MASK 0xFFFF /end MEASUREMENT
/begin MEASUREMENT agoMLSMAX "MLS Lueftersolldrehzahl nach Maximum-Auswahl" UWORD MLS_N_DW 0 0 0.000000 32766.990000 ECU_ADDRESS 0xDB44 BIT_MASK 0xFFFF /end MEASUREMENT
/begin MEASUREMENT agoMLSWTF "MLS WTF-Signal fuer Luefterdrehzahl-KF" UWORD T 0 0 -273.140000 3003.560000 ECU_ADDRESS 0xDB66 BIT_MASK 0xFFFF /end MEASUREMENT
/begin MEASUREMENT agoMLS_C "MLS geschw.gewichtet CAN-MLS-Drehzahl" UWORD MLS_N_DW 0 0 0.000000 32766.990000 ECU_ADDRESS 0xDA24 BIT_MASK 0xFFFF /end MEASUREMENT
/begin MEASUREMENT agoMLSext "MLS Drehzahl bei externer Anforderung" UWORD MLS_N_DW 0 0 0.000000 32766.990000 ECU_ADDRESS 0xDF18 BIT_MASK 0xFFFF /end MEASUREMENT
/begin MEASUREMENT agoN_ELroh "MLS Lueftersolldrehzahl nach Zustandsautomat" UWORD MLS_N_DW 0 0 0.000000 32766.990000 ECU_ADDRESS 0xDA16 BIT_MASK 0xFFFF /end MEASUREMENT
/begin MEASUREMENT agoPWM_kor "MLS batteriespg.kompensiertes PWM" UWORD PROZ 0 0 -327.680000 327.670000 ECU_ADDRESS 0xDA1C BIT_MASK 0xFFFF /end MEASUREMENT
/begin MEASUREMENT agoPWM_roh "MLS aus gefiltertem TV berechnetes PWM fuer EL" UWORD PROZ 0 0 -327.680000 327.670000 ECU_ADDRESS 0xDA1E BIT_MASK 0xFFFF /end MEASUREMENT
/begin MEASUREMENT agoTHSS12 "Zustand der Grosse kucStatus1 und kucStatus2" UWORD DEZ_DW_U 0 0 0.000000 65535.000000 ECU_ADDRESS 0xDB5C BIT_MASK 0xFFFF /end MEASUREMENT
/begin MEASUREMENT agoTV_beg "MLS begrenztes TV fuer MLS" UWORD PROZ 0 0 -327.680000 327.670000 ECU_ADDRESS 0xDA18 BIT_MASK 0xFFFF /end MEASUREMENT
/begin MEASUREMENT agoTV_fil "MLS gefiltertes, unkorrigiertes TV fuer EL" UWORD PROZ 0 0 -327.680000 327.670000 ECU_ADDRESS 0xDA20 BIT_MASK 0xFFFF /end MEASUREMENT
/begin MEASUREMENT agoTV_kor "MLS rueckgerechnetes korr. TV" UWORD PROZ 0 0 -327.680000 327.670000 ECU_ADDRESS 0xDA1A BIT_MASK 0xFFFF /end MEASUREMENT
/begin MEASUREMENT agoTV_roh "MLS ungefiltertes TV aus Drehzahl-KL" UWORD PROZ 0 0 -327.680000 327.670000 ECU_ADDRESS 0xDA22 BIT_MASK 0xFFFF /end MEASUREMENT
/begin MEASUREMENT anmADF "ADF Atmosphaerendruck" SWORD P 0 0 -32768.000000 32767.000000 ECU_ADDRESS 0xC16E BIT_MASK 0xFFFF /end MEASUREMENT
/begin MEASUREMENT anmAT1 "AT1 Abgastemperaturfuehler" SWORD T 0 0 -273.140000 3003.560000 ECU_ADDRESS 0xC172 BIT_MASK 0xFFFF /end MEASUREMENT
/begin MEASUREMENT anmAT2 "AT2 Abgastemperaturfuehler" SWORD T 0 0 -273.140000 3003.560000 ECU_ADDRESS 0xC176 BIT_MASK 0xFFFF /end MEASUREMENT
/begin MEASUREMENT anmIDV "IDV Istwert Stromregelung Druckregelventil" SWORD IDV 0 0 -32768.000000 32767.000000 ECU_ADDRESS 0xC140 BIT_MASK 0xFFFF /end MEASUREMENT
/begin MEASUREMENT anmKDF "KDF Kraftstoffdruckfuehler" SWORD KDF 0 0 -3276800.000000 3276700.000000 ECU_ADDRESS 0xC17E BIT_MASK 0xFFFF /end MEASUREMENT
/begin MEASUREMENT anmKDFAADR "Adresse für Abgleichkennlinie" SWORD DEZ_DW 0 0 -32768.000000 32767.000000 ECU_ADDRESS 0xC0E2 BIT_MASK 0xFFFF /end MEASUREMENT
/begin MEASUREMENT anmKDF_AG1 "Abgleichwert 1 KDF" SWORD KDF 0 0 -3276800.000000 3276700.000000 ECU_ADDRESS 0xC0DE BIT_MASK 0xFFFF /end MEASUREMENT
/begin MEASUREMENT anmKDF_AG2 "Abgleichwert 2 KDF" SWORD KDF 0 0 -3276800.000000 3276700.000000 ECU_ADDRESS 0xC0E0 BIT_MASK 0xFFFF /end MEASUREMENT
/begin MEASUREMENT anmKTF "KTF Kraftstofftemperatur" SWORD T 0 0 -273.140000 3003.560000 ECU_ADDRESS 0xC162 BIT_MASK 0xFFFF /end MEASUREMENT
/begin MEASUREMENT anmLDF "LDF Lade- / Saugrohr-Druck" SWORD P 0 0 -32768.000000 32767.000000 ECU_ADDRESS 0xC13C BIT_MASK 0xFFFF /end MEASUREMENT
/begin MEASUREMENT anmLDF_U "nicht abgeglichener LDF-Wert" SWORD P 0 0 -32768.000000 32767.000000 ECU_ADDRESS 0xC1A0 BIT_MASK 0xFFFF /end MEASUREMENT
/begin MEASUREMENT anmLMM "LMM1 letzter Analogwert Luftmassenmesser HFM" SWORD LMM 0 0 -327.680000 327.670000 ECU_ADDRESS 0xC144 BIT_MASK 0xFFFF /end MEASUREMENT
/begin MEASUREMENT anmLMM_1 "LMM1 vorletzter Analogwert Luftmassenmesser HFM" SWORD LMM 0 0 -327.680000 327.670000 ECU_ADDRESS 0xC148 BIT_MASK 0xFFFF /end MEASUREMENT
/begin MEASUREMENT anmLTF "LTF Lufttemperatur" SWORD T 0 0 -273.140000 3003.560000 ECU_ADDRESS 0xC15E BIT_MASK 0xFFFF /end MEASUREMENT
/begin MEASUREMENT anmMUX_akt "aktuelle MUX-Stellung" SBYTE DEZ_DB_U 0 0 0.000000 255.000000 ECU_ADDRESS 0xC393 BIT_MASK 0xFF /end MEASUREMENT
/begin MEASUREMENT anmOTF "OTF Oeltemperatur" SWORD T 0 0 -273.140000 3003.560000 ECU_ADDRESS 0xC16A BIT_MASK 0xFFFF /end MEASUREMENT
/begin MEASUREMENT anmPAGLS "Rohwert LDF-Abgleichwert" SWORD P 0 0 -32768.000000 32767.000000 ECU_ADDRESS 0xC19C BIT_MASK 0xFFFF /end MEASUREMENT
/begin MEASUREMENT anmPAGNR "gewichteter LDF-Abgleichwert" SWORD P 0 0 -32768.000000 32767.000000 ECU_ADDRESS 0xC19E BIT_MASK 0xFFFF /end MEASUREMENT
/begin MEASUREMENT anmPGS "PGS Pedalwertgeber 2 - Position (ungefiltert)" SWORD PROZ_S 0 0 -327.680000 327.670000 ECU_ADDRESS 0xC152 BIT_MASK 0xFFFF /end MEASUREMENT
/begin MEASUREMENT anmPWG "PWG Pedalwertgeber 1 - Position (ungefiltert)" SWORD PROZ_S 0 0 -327.680000 327.670000 ECU_ADDRESS 0xC14A BIT_MASK 0xFFFF /end MEASUREMENT
/begin MEASUREMENT anmUBT "UBT Batteriespannung" SWORD U_B 0 0 0.000000 773948.100000 ECU_ADDRESS 0xC17A BIT_MASK 0xFFFF /end MEASUREMENT
/begin MEASUREMENT anmUC1 "UC Kondensatorspannung Bank 1" SWORD U_C 0 0 0.000000 1348179.000000 ECU_ADDRESS 0xC182 BIT_MASK 0xFFFF /end MEASUREMENT
/begin MEASUREMENT anmUC2 "UC Kondensatorspannung Bank 2" SWORD U_C 0 0 0.000000 1348179.000000 ECU_ADDRESS 0xC186 BIT_MASK 0xFFFF /end MEASUREMENT
/begin MEASUREMENT anmUG1 "UG1 Geber-Speisung 1" SWORD U_G 0 0 0.000000 578147.000000 ECU_ADDRESS 0xC18A BIT_MASK 0xFFFF /end MEASUREMENT
/begin MEASUREMENT anmUG2 "UG2 Geber-Speisung 2" SWORD U_G 0 0 0.000000 578147.000000 ECU_ADDRESS 0xC18E BIT_MASK 0xFFFF /end MEASUREMENT
/begin MEASUREMENT anmU_PGS "PGS Pedalwertgeber 2 - Rohwert" SWORD U 0 0 0.000000 160151.500000 ECU_ADDRESS 0xC150 BIT_MASK 0xFFFF /end MEASUREMENT
/begin MEASUREMENT anmU_PWG "PWG Pedalwertgeber 1 - Rohwert" SWORD U 0 0 0.000000 160151.500000 ECU_ADDRESS 0xC14E BIT_MASK 0xFFFF /end MEASUREMENT
/begin MEASUREMENT anmVDF "VDF Vorfoerderdruck" SWORD VDF 0 0 -32768.000000 32767.000000 ECU_ADDRESS 0xC166 BIT_MASK 0xFFFF /end MEASUREMENT
/begin MEASUREMENT anmWTF "WTF Wassertemperatur" SWORD T 0 0 -273.140000 3003.560000 ECU_ADDRESS 0xC156 BIT_MASK 0xFFFF /end MEASUREMENT
/begin MEASUREMENT anoKDFAB "resultierender Abgleichwert KDF" SWORD KDF 0 0 -3276800.000000 3276700.000000 ECU_ADDRESS 0xDC3A BIT_MASK 0xFFFF /end MEASUREMENT
/begin MEASUREMENT anoU_ADF "ADF Rohwert Atmosphaerendruckfuehler" SWORD U 0 0 0.000000 160151.500000 ECU_ADDRESS 0xDA86 BIT_MASK 0xFFFF /end MEASUREMENT
/begin MEASUREMENT anoU_AT1 "AT1 Rohwert Abgasemperaturfuehler 1" SWORD U 0 0 0.000000 160151.500000 ECU_ADDRESS 0xDA8A BIT_MASK 0xFFFF /end MEASUREMENT
/begin MEASUREMENT anoU_AT2 "AT2 Rohwert Abgasemperaturfuehler 2" SWORD U 0 0 0.000000 160151.500000 ECU_ADDRESS 0xDA88 BIT_MASK 0xFFFF /end MEASUREMENT
/begin MEASUREMENT anoU_IDV "U Rohwert Spannung zur Strommessung IDV" SWORD U 0 0 0.000000 160151.500000 ECU_ADDRESS 0xDA9E BIT_MASK 0xFFFF /end MEASUREMENT
/begin MEASUREMENT anoU_KDF "KDF Rohwert Kraftstoffdruckfuehler" SWORD U 0 0 0.000000 160151.500000 ECU_ADDRESS 0xDBBE BIT_MASK 0xFFFF /end MEASUREMENT
/begin MEASUREMENT anoU_KTF "KTF Rohwert Kraftstofftemperaturfuehler" SWORD U 0 0 0.000000 160151.500000 ECU_ADDRESS 0xDA90 BIT_MASK 0xFFFF /end MEASUREMENT
/begin MEASUREMENT anoU_LDF "LDF Rohwert Ladedruck-/Saugrohrdruckfuehler" SWORD U 0 0 0.000000 160151.500000 ECU_ADDRESS 0xDA9C BIT_MASK 0xFFFF /end MEASUREMENT
/begin MEASUREMENT anoU_LDFA "LDF Rohwert gemittelt altalt (Ladedruck-/Saugrohrdruckfuehler)" SWORD U 0 0 0.000000 160151.500000 ECU_ADDRESS 0xDA9A BIT_MASK 0xFFFF /end MEASUREMENT
/begin MEASUREMENT anoU_LMM "LMM Rohwert Luftmassenmesser HFM" SWORD U 0 0 0.000000 160151.500000 ECU_ADDRESS 0xDA98 BIT_MASK 0xFFFF /end MEASUREMENT
/begin MEASUREMENT anoU_LMMA "LMM Rohwert Luftmassenmesser altalt (HFM)" SWORD U 0 0 0.000000 160151.500000 ECU_ADDRESS 0xDA96 BIT_MASK 0xFFFF /end MEASUREMENT
/begin MEASUREMENT anoU_LTF "LTF Rohwert Lufttemperaturfuehler" SWORD U 0 0 0.000000 160151.500000 ECU_ADDRESS 0xDA8E BIT_MASK 0xFFFF /end MEASUREMENT
/begin MEASUREMENT anoU_OTF "OTF Rohwert Kraftstofftemperaturfuehler" SWORD U 0 0 0.000000 160151.500000 ECU_ADDRESS 0xDA0C BIT_MASK 0xFFFF /end MEASUREMENT
/begin MEASUREMENT anoU_PGS "PGS Rohwert Pedalwertgeber 2" SWORD U 0 0 0.000000 160151.500000 ECU_ADDRESS 0xDA92 BIT_MASK 0xFFFF /end MEASUREMENT
/begin MEASUREMENT anoU_PGSLT "PGS Pedalwertgeber 2 - Rohwert nach LTI-Messung" SWORD U 0 0 0.000000 160151.500000 ECU_ADDRESS 0xD986 BIT_MASK 0xFFFF /end MEASUREMENT
/begin MEASUREMENT anoU_PWG "PWG Rohwert Pedalwertgeber 1" SWORD U 0 0 0.000000 160151.500000 ECU_ADDRESS 0xDA94 BIT_MASK 0xFFFF /end MEASUREMENT
/begin MEASUREMENT anoU_TST "TST Rohwert ADC-Testspannung" SWORD U 0 0 0.000000 160151.500000 ECU_ADDRESS 0xDAD2 BIT_MASK 0xFFFF /end MEASUREMENT
/begin MEASUREMENT anoU_UBT "UBT Rohwert Batteriespannung" SWORD U 0 0 0.000000 160151.500000 ECU_ADDRESS 0xDA7E BIT_MASK 0xFFFF /end MEASUREMENT
/begin MEASUREMENT anoU_UC1 "UC Rohwert Kondensatorspannung Bank 1" SWORD U 0 0 0.000000 160151.500000 ECU_ADDRESS 0xDBC4 BIT_MASK 0xFFFF /end MEASUREMENT
/begin MEASUREMENT anoU_UC2 "UC Rohwert Kondensatorspannung Bank 2" SWORD U 0 0 0.000000 160151.500000 ECU_ADDRESS 0xDBC2 BIT_MASK 0xFFFF /end MEASUREMENT
/begin MEASUREMENT anoU_UG1 "UG1 Geber-Speisung1" SWORD U 0 0 0.000000 160151.500000 ECU_ADDRESS 0xDA84 BIT_MASK 0xFFFF /end MEASUREMENT
/begin MEASUREMENT anoU_UG2 "UG2 Geber-Speisung2" SWORD U 0 0 0.000000 160151.500000 ECU_ADDRESS 0xDA82 BIT_MASK 0xFFFF /end MEASUREMENT
/begin MEASUREMENT anoU_VDF "VDF Rohwert Vorfoerderdruckfuehler" SWORD U 0 0 0.000000 160151.500000 ECU_ADDRESS 0xDA80 BIT_MASK 0xFFFF /end MEASUREMENT
/begin MEASUREMENT anoU_WTF "WTF Rohwert Wassertemperaturfuehler" SWORD U 0 0 0.000000 160151.500000 ECU_ADDRESS 0xDA8C BIT_MASK 0xFFFF /end MEASUREMENT
/begin MEASUREMENT armARF_AGL "ARF additive Sollwertkorrektur ueber Abgleichwert" SWORD M_L 0 0 -3276.800000 3276.700000 ECU_ADDRESS 0xC212 BIT_MASK 0xFFFF /end MEASUREMENT
/begin MEASUREMENT armLABAGR "AGR-Abschaltung und Drallklappe oeffnen" SBYTE DEZ_DB_U 0 0 0.000000 255.000000 ECU_ADDRESS 0xC3AE BIT_MASK 0xFF /end MEASUREMENT
/begin MEASUREMENT armLABGK1 "Freigabe Lastabgleich im LL" SBYTE DEZ_DB_U 0 0 0.000000 255.000000 ECU_ADDRESS 0xC3AC BIT_MASK 0xFF /end MEASUREMENT
/begin MEASUREMENT armLABGK2 "Freigabe Lastabgleich im Lastbereich" SBYTE DEZ_DB_U 0 0 0.000000 255.000000 ECU_ADDRESS 0xC3AD BIT_MASK 0xFF /end MEASUREMENT
/begin MEASUREMENT armLABUMW "Umweltbedingungen" UBYTE DEZ_DB_U 0 0 0.000000 255.000000 ECU_ADDRESS 0xC3AF BIT_MASK 0xFF /end MEASUREMENT
/begin MEASUREMENT armLMAB21 "Lastabgleichwert im LL" SWORD FAKT 0 0 -3.276800 3.276700 ECU_ADDRESS 0xC218 BIT_MASK 0xFFFF /end MEASUREMENT
/begin MEASUREMENT armLMAB22 "Lastabgleichwert im Lastbereich" SWORD FAKT 0 0 -3.276800 3.276700 ECU_ADDRESS 0xC21A BIT_MASK 0xFFFF /end MEASUREMENT
/begin MEASUREMENT armLMABG1 "Nullpunktabgleichswert" SWORD M_Lt 0 0 -3276.800000 3276.700000 ECU_ADDRESS 0xC214 BIT_MASK 0xFFFF /end MEASUREMENT
/begin MEASUREMENT armLMABG2 "Lastabgleichswert" SWORD M_Lt 0 0 -3276.800000 3276.700000 ECU_ADDRESS 0xC216 BIT_MASK 0xFFFF /end MEASUREMENT
/begin MEASUREMENT armLMLLLM "Grenze unterer Luftmassenbereich" UWORD M_Lt 0 0 -3276.800000 3276.700000 ECU_ADDRESS 0xC21E BIT_MASK 0xFFFF /end MEASUREMENT
/begin MEASUREMENT armLMLLSM "Grenze oberer Luftmassenbereich" UWORD M_Lt 0 0 -3276.800000 3276.700000 ECU_ADDRESS 0xC220 BIT_MASK 0xFFFF /end MEASUREMENT
/begin MEASUREMENT armLMSYNC "Synchronisation Abspeicherung HFM-Nullpunktabgleich" SWORD DEZ_DW_U 0 0 0.000000 65535.000000 ECU_ADDRESS 0xC21C BIT_MASK 0xFFFF /end MEASUREMENT
/begin MEASUREMENT armM_LGW "M_L Luft-Sollwert aus ARF-Grundkennfeld" SWORD M_L 0 0 -3276.800000 3276.700000 ECU_ADDRESS 0xC20A BIT_MASK 0xFFFF /end MEASUREMENT
/begin MEASUREMENT armM_List "M_L aktuelle Luftmasse" SWORD M_L 0 0 -3276.800000 3276.700000 ECU_ADDRESS 0xC20C BIT_MASK 0xFFFF /end MEASUREMENT
/begin MEASUREMENT armM_Lsoll "M_L Sollwert fuer ARF-Regelung" SWORD M_L 0 0 -3276.800000 3276.700000 ECU_ADDRESS 0xC310 BIT_MASK 0xFFFF /end MEASUREMENT
/begin MEASUREMENT armPkorr "P_L T_L-abhaengig korrigierter Ladedruck" SWORD P 0 0 -32768.000000 32767.000000 ECU_ADDRESS 0xC210 BIT_MASK 0xFFFF /end MEASUREMENT
/begin MEASUREMENT armREG_2 "ARF-Status  Regelung / Steuerung / Abschaltung" UBYTE DEZ_DW_U 0 0 0.000000 65535.000000 ECU_ADDRESS 0xC3AB BIT_MASK 0xFF /end MEASUREMENT
/begin MEASUREMENT aroDRA1 "Ausgang Drallklappe Korrekturwert LTF" SWORD PROZ 0 0 -327.680000 327.670000 ECU_ADDRESS 0xD8F4 BIT_MASK 0xFFFF /end MEASUREMENT
/begin MEASUREMENT aroDRA2 "Ausgang Drallklappe Korrekturwert WTF" SWORD PROZ 0 0 -327.680000 327.670000 ECU_ADDRESS 0xD8F2 BIT_MASK 0xFFFF /end MEASUREMENT
/begin MEASUREMENT aroDRA3 "Ausgang Drallklappe Grundkennfeld" SWORD PROZ 0 0 -327.680000 327.670000 ECU_ADDRESS 0xD8F0 BIT_MASK 0xFFFF /end MEASUREMENT
/begin MEASUREMENT aroDRA4 "Summenausgang Drallklappe" SWORD PROZ 0 0 -327.680000 327.670000 ECU_ADDRESS 0xD8EE BIT_MASK 0xFFFF /end MEASUREMENT
/begin MEASUREMENT aroIST_1 "LMM-Eingangssignal nach Einschaltkorrektur" SWORD LMM 0 0 -327.680000 327.670000 ECU_ADDRESS 0xDCB2 BIT_MASK 0xFFFF /end MEASUREMENT
/begin MEASUREMENT aroIST_11 "LMM nach Nullpunktabgleich" SWORD M_Lt 0 0 -3276.800000 3276.700000 ECU_ADDRESS 0xD91C BIT_MASK 0xFFFF /end MEASUREMENT
/begin MEASUREMENT aroIST_2 "P_L Luft-/Ladedruck vor T_L-abhaengiger Korrektur" SWORD P 0 0 -32768.000000 32767.000000 ECU_ADDRESS 0xDCB0 BIT_MASK 0xFFFF /end MEASUREMENT
/begin MEASUREMENT aroIST_3 "T_L Luft-/Ladelufttemperatur fuer Druckkorrektur" SWORD T 0 0 -273.140000 3003.560000 ECU_ADDRESS 0xDCAE BIT_MASK 0xFFFF /end MEASUREMENT
/begin MEASUREMENT aroIST_4 "MLt Luftmassenstrom n. Liniarisierung + Mittelung" SWORD M_Lt 0 0 -3276.800000 3276.700000 ECU_ADDRESS 0xDCAC BIT_MASK 0xFFFF /end MEASUREMENT
/begin MEASUREMENT aroIST_44 "MLt Luftmassenstrom n. Liniarisierung+Mittelung+Lastabgleich" SWORD M_Lt 0 0 -3276.800000 3276.700000 ECU_ADDRESS 0xD90A BIT_MASK 0xFFFF /end MEASUREMENT
/begin MEASUREMENT aroIST_4P "MLt Luftmassenstrom n. Liniarisierung + Mittelung + PT1" SWORD M_Lt 0 0 -3276.800000 3276.700000 ECU_ADDRESS 0xDF08 BIT_MASK 0xFFFF /end MEASUREMENT
/begin MEASUREMENT aroIST_5 "M_L normierte Luftmasse (nicht T_L/P_ADF-korrig.)" SWORD M_L 0 0 -3276.800000 3276.700000 ECU_ADDRESS 0xDCAA BIT_MASK 0xFFFF /end MEASUREMENT
/begin MEASUREMENT aroIST_alt "M_L nach Linearisierung (vorletzter Wert)" SWORD M_Lt 0 0 -3276.800000 3276.700000 ECU_ADDRESS 0xDCA6 BIT_MASK 0xFFFF /end MEASUREMENT
/begin MEASUREMENT aroIST_neu "M_L nach Linearisierung (letzter Wert)" SWORD M_Lt 0 0 -3276.800000 3276.700000 ECU_ADDRESS 0xDCA8 BIT_MASK 0xFFFF /end MEASUREMENT
/begin MEASUREMENT aroKORLL "Lastabgleichwert im LL" SWORD M_Lt 0 0 -3276.800000 3276.700000 ECU_ADDRESS 0xD908 BIT_MASK 0xFFFF /end MEASUREMENT
/begin MEASUREMENT aroKORML "Lastabgleichwert Normallast" SWORD M_Lt 0 0 -3276.800000 3276.700000 ECU_ADDRESS 0xD906 BIT_MASK 0xFFFF /end MEASUREMENT
/begin MEASUREMENT aroKORVL "lastabgleichwert Vollast" SWORD M_Lt 0 0 -3276.800000 3276.700000 ECU_ADDRESS 0xD904 BIT_MASK 0xFFFF /end MEASUREMENT
/begin MEASUREMENT aroLABGKT "Abgleiche durchgefuehrt" UWORD DEZ_DW_U 0 0 0.000000 65535.000000 ECU_ADDRESS 0xDF12 BIT_MASK 0xFFFF /end MEASUREMENT
/begin MEASUREMENT aroLDF_GR "LDF-Gradient" SWORD dL_dZHP5 0 0 -32768.000000 32767.000000 ECU_ADDRESS 0xDF04 BIT_MASK 0xFFFF /end MEASUREMENT
/begin MEASUREMENT aroLMAB211 "Korrekturfaktor Leerlaufbereich" SWORD FAKT 0 0 -3.276800 3.276700 ECU_ADDRESS 0xDF0A BIT_MASK 0xFFFF /end MEASUREMENT
/begin MEASUREMENT aroLMAB221 "Korrekturfaktor Lastabgleich" SWORD FAKT 0 0 -3.276800 3.276700 ECU_ADDRESS 0xDF0C BIT_MASK 0xFFFF /end MEASUREMENT
/begin MEASUREMENT aroLMABNP "Nullpunktabgleichwert" SWORD M_Lt 0 0 -3276.800000 3276.700000 ECU_ADDRESS 0xDF16 BIT_MASK 0xFFFF /end MEASUREMENT
/begin MEASUREMENT aroLMLLLM1 "Korrekturfaktor Leerlaufabgleich" SWORD M_Lt 0 0 -3276.800000 3276.700000 ECU_ADDRESS 0xDF0E BIT_MASK 0xFFFF /end MEASUREMENT
/begin MEASUREMENT aroLMLLSM1 "Korrekturfaktor Lastabgleich" SWORD M_Lt 0 0 -3276.800000 3276.700000 ECU_ADDRESS 0xDF10 BIT_MASK 0xFFFF /end MEASUREMENT
/begin MEASUREMENT aroLMM_PS "gerechneter Luftmassenwert" SWORD M_Lt 0 0 -3276.800000 3276.700000 ECU_ADDRESS 0xDF14 BIT_MASK 0xFFFF /end MEASUREMENT
/begin MEASUREMENT aroLMM_PTn "berechnete Luftmasse" SWORD M_Lt 0 0 -3276.800000 3276.700000 ECU_ADDRESS 0xD90C BIT_MASK 0xFFFF /end MEASUREMENT
/begin MEASUREMENT aroLTF_GR "Lufttemperaturanstieg gefiltert" SWORD dT_dZHP5 0 0 -32768.000000 32767.000000 ECU_ADDRESS 0xD90E BIT_MASK 0xFFFF /end MEASUREMENT
/begin MEASUREMENT aroM_E "M_E Wunschmenge" SWORD MM3 0 0 -327.680000 327.670000 ECU_ADDRESS 0xDCB4 BIT_MASK 0xFFFF /end MEASUREMENT
/begin MEASUREMENT aroREDLL3t "Wartezeit fuer ARF-Reduzierung(arwREDULL3) im Leerlauf" SWORD ZEIT_HP 0 0 0.000000 1310700000.000000 ECU_ADDRESS 0xDA64 BIT_MASK 0xFFFF /end MEASUREMENT
/begin MEASUREMENT aroREG_1 "TV_A Steuer-/Regelwert vor EPW-Anpassung" SWORD PROZ 0 0 -327.680000 327.670000 ECU_ADDRESS 0xDCA4 BIT_MASK 0xFFFF /end MEASUREMENT
/begin MEASUREMENT aroREG_2 "ARF-Status  Regelung / Steuerung / Abschaltung" UWORD DEZ_DW_U 0 0 0.000000 65535.000000 ECU_ADDRESS 0xDCA2 BIT_MASK 0xFFFF /end MEASUREMENT
/begin MEASUREMENT aroRGIAnt "TV_A I-Anteil des ARF-PI-Reglers" SWORD PROZ 0 0 -327.680000 327.670000 ECU_ADDRESS 0xDC9E BIT_MASK 0xFFFF /end MEASUREMENT
/begin MEASUREMENT aroRGPAnt "TV_A P-Anteil des ARF-PI-Reglers" SWORD PROZ 0 0 -327.680000 327.670000 ECU_ADDRESS 0xDCA0 BIT_MASK 0xFFFF /end MEASUREMENT
/begin MEASUREMENT aroSOLL_0 "M_L Luft-Sollwert aus ARF-Grundkennfeld" SWORD M_L 0 0 -3276.800000 3276.700000 ECU_ADDRESS 0xDCB6 BIT_MASK 0xFFFF /end MEASUREMENT
/begin MEASUREMENT aroSOLL_1 "M_L Luft-Sollwert nach Abgleichkorrektur" SWORD M_L 0 0 -3276.800000 3276.700000 ECU_ADDRESS 0xDCC2 BIT_MASK 0xFFFF /end MEASUREMENT
/begin MEASUREMENT aroSOLL_2 "M_L Luft-Sollwert nach P_ADF-abhaengiger Korrektur" SWORD M_L 0 0 -3276.800000 3276.700000 ECU_ADDRESS 0xDCC0 BIT_MASK 0xFFFF /end MEASUREMENT
/begin MEASUREMENT aroSOLL_3 "M_L Luft-Sollwert nach T_L-abhaengiger Korrektur" SWORD M_L 0 0 -3276.800000 3276.700000 ECU_ADDRESS 0xDCBE BIT_MASK 0xFFFF /end MEASUREMENT
/begin MEASUREMENT aroSOLL_4 "M_L Luft-Sollwert nach T_W-abhaengiger Korrektur" SWORD M_L 0 0 -3276.800000 3276.700000 ECU_ADDRESS 0xDCBC BIT_MASK 0xFFFF /end MEASUREMENT
/begin MEASUREMENT aroSOLL_5 "M_L Luft-Sollwert nach Sollwertbegrenzung" SWORD M_L 0 0 -3276.800000 3276.700000 ECU_ADDRESS 0xDCBA BIT_MASK 0xFFFF /end MEASUREMENT
/begin MEASUREMENT aroSOLL_6 "M_L Luftmenge aus dynamischer Vorsteuerung" SWORD M_L 0 0 -3276.800000 3276.700000 ECU_ADDRESS 0xDCB8 BIT_MASK 0xFFFF /end MEASUREMENT
/begin MEASUREMENT aroSTABG1 "Freigabe Lastabgleich im LL" SWORD DEZ_DW_U 0 0 0.000000 65535.000000 ECU_ADDRESS 0xD91A BIT_MASK 0xFFFF /end MEASUREMENT
/begin MEASUREMENT aroSTABG2 "Freigabe Lastabgleich im Lastbereich" SWORD DEZ_DW_U 0 0 0.000000 65535.000000 ECU_ADDRESS 0xD910 BIT_MASK 0xFFFF /end MEASUREMENT
/begin MEASUREMENT aroWU_LLR "M_E Wunschmenge + Leerlaufreglermenge" SWORD MM3 0 0 -327.680000 327.670000 ECU_ADDRESS 0xDCC4 BIT_MASK 0xFFFF /end MEASUREMENT
/begin MEASUREMENT camASC_REG "ABS/ASC Eingriff (CAN)" UBYTE DEZ_DB_U 0 0 0.000000 255.000000 ECU_ADDRESS 0xC3BE BIT_MASK 0xFF /end MEASUREMENT
/begin MEASUREMENT camAUSBL "Ausblendbedingungen fuer CAN-Fehler" UBYTE DEZ_DB_U 0 0 0.000000 255.000000 ECU_ADDRESS 0xC3B8 BIT_MASK 0xFF /end MEASUREMENT
/begin MEASUREMENT camCANSTAT "CAN-Controller Status" UBYTE DEZ_DB_U 0 0 0.000000 255.000000 ECU_ADDRESS 0xC3B1 BIT_MASK 0xFF /end MEASUREMENT
/begin MEASUREMENT camDSC_BRE "Aktiver Bremseingriff des DSC" UBYTE DEZ_DB_U 0 0 0.000000 255.000000 ECU_ADDRESS 0xC3A0 BIT_MASK 0xFF /end MEASUREMENT
/begin MEASUREMENT camDSC_FGR "Reversible Abschaltung des FGR" UBYTE DEZ_DB_U 0 0 0.000000 255.000000 ECU_ADDRESS 0xC3A1 BIT_MASK 0xFF /end MEASUREMENT
/begin MEASUREMENT camDSC_REG "DSC Eingriff (CAN)" UBYTE DEZ_DB_U 0 0 0.000000 255.000000 ECU_ADDRESS 0xC3BF BIT_MASK 0xFF /end MEASUREMENT
/begin MEASUREMENT camEKPCRAS "Bitkombination ueber CAN fuer EKP-abschalten bei Crash" UBYTE DEZ_DB_U 0 0 0.000000 255.000000 ECU_ADDRESS 0xC3B5 BIT_MASK 0xFF /end MEASUREMENT
/begin MEASUREMENT camFST "Fuellstandsinfo aus INSTR2" SBYTE DEZ_DB_U 0 0 0.000000 255.000000 ECU_ADDRESS 0xC3A8 BIT_MASK 0xFF /end MEASUREMENT
/begin MEASUREMENT camGANG "Ganginfo aus EGS1-Botschaft" SWORD DEZ_DB_U 0 0 0.000000 255.000000 ECU_ADDRESS 0xC24A BIT_MASK 0xFFFF /end MEASUREMENT
/begin MEASUREMENT camKLI_gef "KLI gefunden/nicht gefunden zustand; 01 -> KLI gefunden; 02 -> KLI nicht gefunde" UBYTE DEZ_DB_U 0 0 0.000000 255.000000 ECU_ADDRESS 0xC3BA BIT_MASK 0xFF /end MEASUREMENT
/begin MEASUREMENT camLM_KK "Lastmoment Klimakompressor" SWORD MOMENT 0 0 -32768.000000 32767.000000 ECU_ADDRESS 0xC244 BIT_MASK 0xFFFF /end MEASUREMENT
/begin MEASUREMENT camN_EL "MLS Drehzahlstufe E-Luefter" UWORD MLS_N_DW 0 0 0.000000 32766.990000 ECU_ADDRESS 0xC246 BIT_MASK 0xFFFF /end MEASUREMENT
/begin MEASUREMENT camRangeSt "Aktueller Range Status" UBYTE DEZ_DB_U 0 0 0.000000 255.000000 ECU_ADDRESS 0xC3C0 BIT_MASK 0xFF /end MEASUREMENT
/begin MEASUREMENT camS_AC "Schalter Klimabereitschaft" UBYTE DEZ_DB_U 0 0 0.000000 255.000000 ECU_ADDRESS 0xC3B3 BIT_MASK 0xFF /end MEASUREMENT
/begin MEASUREMENT camS_FST "Schalter Fuellstand (=Reserve aktiv) aus INSTR2" SBYTE DEZ_DB_U 0 0 0.000000 255.000000 ECU_ADDRESS 0xC3A9 BIT_MASK 0xFF /end MEASUREMENT
/begin MEASUREMENT camS_HZL "Anforderung Heizleistung von Klimasteuerung (per CAN)" SBYTE DEZ_DB_U 0 0 0.000000 255.000000 ECU_ADDRESS 0xC3BB BIT_MASK 0xFF /end MEASUREMENT
/begin MEASUREMENT camS_KO "Schalter Klimakompressor" UBYTE DEZ_DB_U 0 0 0.000000 255.000000 ECU_ADDRESS 0xC3B2 BIT_MASK 0xFF /end MEASUREMENT
/begin MEASUREMENT camS_SAKT "Status Schaltvorgang (0 .. kein Schaltvorg. / 1 .. Schaltvorg. aktiv)" UBYTE DEZ_DB_U 0 0 0.000000 255.000000 ECU_ADDRESS 0xC3BD BIT_MASK 0xFF /end MEASUREMENT
/begin MEASUREMENT camS_WK "Status Wandlerkupplung" UBYTE DEZ_DB_U 0 0 0.000000 255.000000 ECU_ADDRESS 0xC3B4 BIT_MASK 0xFF /end MEASUREMENT
/begin MEASUREMENT camT_UMG "Umgebungstemperatur (vom CAN)" SWORD T 0 0 -273.140000 3003.560000 ECU_ADDRESS 0xC248 BIT_MASK 0xFFFF /end MEASUREMENT
/begin MEASUREMENT caoN_ELcan "MLS Luefterdrehzahl aus CAN, nicht umgerechnet" UWORD DEZ_DW_U 0 0 0.000000 65535.000000 ECU_ADDRESS 0xDA14 BIT_MASK 0xFFFF /end MEASUREMENT
/begin MEASUREMENT caoVERB "Kraftstoffverbrauch fuer CAN DDE4-VERBRAUCH unkorrigiert ! ***BC144 hem2wi" UWORD VB_C 0 0 0.000000 65535.000000 ECU_ADDRESS 0xD974 BIT_MASK 0xFFFF /end MEASUREMENT
/begin MEASUREMENT comARF_fun "ARF-Funktion" SBYTE DEZ_DB_U 0 0 0.000000 255.000000 ECU_ADDRESS 0xC382 BIT_MASK 0xFF /end MEASUREMENT
/begin MEASUREMENT comASC3EEP "Status ASC3 Botschaft" UBYTE DEZ_DB_U 0 0 0.000000 255.000000 ECU_ADDRESS 0xC389 BIT_MASK 0xFF /end MEASUREMENT
/begin MEASUREMENT comBYP_fun "Status Universalschnittstelle (Ein/Aus)" UBYTE DEZ_DB_U 0 0 0.000000 255.000000 ECU_ADDRESS 0xC37F BIT_MASK 0xFF /end MEASUREMENT
/begin MEASUREMENT comFGR_MSW "FGR  aktiviert mit Mainswitch ja/nein aus EEPROM" UBYTE DEZ_DB_U 0 0 0.000000 255.000000 ECU_ADDRESS 0xC38A BIT_MASK 0xFF /end MEASUREMENT
/begin MEASUREMENT comFGR_opt "FGR-Option" SBYTE DEZ_DB_U 0 0 0.000000 255.000000 ECU_ADDRESS 0xC388 BIT_MASK 0xFF /end MEASUREMENT
/begin MEASUREMENT comGDB_opt "GDB-Option" SBYTE DEZ_DB_U 0 0 0.000000 255.000000 ECU_ADDRESS 0xC38C BIT_MASK 0xFF /end MEASUREMENT
/begin MEASUREMENT comGTR_opt "Identifikation Handschalter/Automatik" SBYTE DEZ_DB_U 0 0 0.000000 255.000000 ECU_ADDRESS 0xC38D BIT_MASK 0xFF /end MEASUREMENT
/begin MEASUREMENT comLDR_fun "LDR-Funktion" SBYTE DEZ_DB_U 0 0 0.000000 255.000000 ECU_ADDRESS 0xC385 BIT_MASK 0xFF /end MEASUREMENT
/begin MEASUREMENT dimBRE "Bremsinfo BRE(dimDIGprell.A) verodert mit dimBRK" UBYTE DEZ_DW_U 0 0 0.000000 65535.000000 ECU_ADDRESS 0xC3D2 BIT_MASK 0xFF /end MEASUREMENT
/begin MEASUREMENT dimBRK "Zustand des redundanten Bremskontakt" UBYTE DEZ_DW_U 0 0 0.000000 65535.000000 ECU_ADDRESS 0xC3CB BIT_MASK 0xFF /end MEASUREMENT
/begin MEASUREMENT dimDIG_0 "Auf log. 0 erkannte Digitaleingaenge" UWORD DEZ_DW_U 0 0 0.000000 65535.000000 ECU_ADDRESS 0xC252 BIT_MASK 0xFFFF /end MEASUREMENT
/begin MEASUREMENT dimDIG_1 "Auf log. 1 erkannte Digitaleingaenge" UWORD DEZ_DW_U 0 0 0.000000 65535.000000 ECU_ADDRESS 0xC254 BIT_MASK 0xFFFF /end MEASUREMENT
/begin MEASUREMENT dimDIGprel "Entprellte logische Zustaende d. digit. Eingaenge" UWORD DEZ_DW_U 0 0 0.000000 65535.000000 ECU_ADDRESS 0xC250 BIT_MASK 0xFFFF /end MEASUREMENT
/begin MEASUREMENT dimF_MFL "FGR Multifunktionslenkrad" UWORD DEZ_DW_U 0 0 0.000000 65535.000000 ECU_ADDRESS 0xC24E BIT_MASK 0xFFFF /end MEASUREMENT
/begin MEASUREMENT dimGZR "DI Status Gluehzeitrueckmeldung" UBYTE DEZ_DB_U 0 0 0.000000 255.000000 ECU_ADDRESS 0xC3CD BIT_MASK 0xFF /end MEASUREMENT
/begin MEASUREMENT dimK15 "DI Status Kl15" UBYTE DEZ_DB_U 0 0 0.000000 255.000000 ECU_ADDRESS 0xC3D0 BIT_MASK 0xFF /end MEASUREMENT
/begin MEASUREMENT dimKUP "Zustand der Kupplung nach Fehlerbehandlung" UBYTE DEZ_DW_U 0 0 0.000000 65535.000000 ECU_ADDRESS 0xC3C7 BIT_MASK 0xFF /end MEASUREMENT
/begin MEASUREMENT dimKWH "Zustand Heizleistungsanforderung/HS" UBYTE DEZ_DW_U 0 0 0.000000 65535.000000 ECU_ADDRESS 0xC3CC BIT_MASK 0xFF /end MEASUREMENT
/begin MEASUREMENT dimMLS "DI MLS externe Anforderung" UBYTE DEZ_DB_U 0 0 0.000000 255.000000 ECU_ADDRESS 0xC3C5 BIT_MASK 0xFF /end MEASUREMENT
/begin MEASUREMENT dimODS "Oeldruckschalter" UBYTE DEZ_DW_U 0 0 0.000000 65535.000000 ECU_ADDRESS 0xC3C4 BIT_MASK 0xFF /end MEASUREMENT
/begin MEASUREMENT dimZHR "DI Status Zusatzheizung" UBYTE DEZ_DB_U 0 0 0.000000 255.000000 ECU_ADDRESS 0xC3CC BIT_MASK 0xFF /end MEASUREMENT
/begin MEASUREMENT dioROH "Digitaleingaeange roh" UWORD DEZ_DW_U 0 0 0.000000 65535.000000 ECU_ADDRESS 0xDC50 BIT_MASK 0xFFFF /end MEASUREMENT
/begin MEASUREMENT dzmABTAS "T Abtastzeit der aktuellen DZG-Segmentperiode" UWORD ZEIT_T0 0 0 0.000000 65535.000000 ECU_ADDRESS 0xC01A BIT_MASK 0xFFFF /end MEASUREMENT
/begin MEASUREMENT dzmNakt "N aktuelle Drehzahl aus letzter Periode (ungemittelt)" SWORD N 0 0 0.000000 32767.000000 ECU_ADDRESS 0xC014 BIT_MASK 0xFFFF /end MEASUREMENT
/begin MEASUREMENT dzmNink "N Hilfsdrehzahl aus GAD40-INKPEDA-Register" SWORD N 0 0 0.000000 32767.000000 ECU_ADDRESS 0xC018 BIT_MASK 0xFFFF /end MEASUREMENT
/begin MEASUREMENT dzmNmit "N Drehzahl (einfach gemittelt)" SWORD N 0 0 0.000000 32767.000000 ECU_ADDRESS 0xC016 BIT_MASK 0xFFFF /end MEASUREMENT
/begin MEASUREMENT dzmPECC_V "dynamisches Timeout" UBYTE DEZ_DB_U 0 0 0.000000 255.000000 ECU_ADDRESS 0xC369 BIT_MASK 0xFF /end MEASUREMENT
/begin MEASUREMENT dzmSCHEDUL "interner Schedulcontroller" UWORD DEZ_DW_U 0 0 0.000000 65535.000000 ECU_ADDRESS 0xC020 BIT_MASK 0xFFFF /end MEASUREMENT
/begin MEASUREMENT dzmSEGM "N Segmentzaehler fuer DZG-Interrupt" SBYTE DEZ_DB 0 0 -128.000000 127.000000 ECU_ADDRESS 0xC337 BIT_MASK 0xFF /end MEASUREMENT
/begin MEASUREMENT dzmUEBER "Ueberdrehzahlerkennung aus DZG(Bit 0)" SBYTE DEZ_DB 0 0 -128.000000 127.000000 ECU_ADDRESS 0xC355 BIT_MASK 0xFF /end MEASUREMENT
/begin MEASUREMENT dzmzMk1 "Selektive Mengenkorrektur Zylinder 1" SWORD MM3 0 0 -327.680000 327.670000 ECU_ADDRESS 0xC118 BIT_MASK 0xFFFF /end MEASUREMENT
/begin MEASUREMENT dzmzMk2 "Selektive Mengenkorrektur Zylinder 2" SWORD MM3 0 0 -327.680000 327.670000 ECU_ADDRESS 0xC11A BIT_MASK 0xFFFF /end MEASUREMENT
/begin MEASUREMENT dzmzMk3 "Selektive Mengenkorrektur Zylinder 3" SWORD MM3 0 0 -327.680000 327.670000 ECU_ADDRESS 0xC11C BIT_MASK 0xFFFF /end MEASUREMENT
/begin MEASUREMENT dzmzMk4 "Selektive Mengenkorrektur Zylinder 4" SWORD MM3 0 0 -327.680000 327.670000 ECU_ADDRESS 0xC11E BIT_MASK 0xFFFF /end MEASUREMENT
/begin MEASUREMENT dzmzMk5 "Selektive Mengenkorrektur Zylinder 5" SWORD MM3 0 0 -327.680000 327.670000 ECU_ADDRESS 0xC120 BIT_MASK 0xFFFF /end MEASUREMENT
/begin MEASUREMENT dzmzMk6 "Selektive Mengenkorrektur Zylinder 6" SWORD MM3 0 0 -327.680000 327.670000 ECU_ADDRESS 0xC122 BIT_MASK 0xFFFF /end MEASUREMENT
/begin MEASUREMENT dzmzMk7 "Selektive Mengenkorrektur Zylinder 7" SWORD MM3 0 0 -327.680000 327.670000 ECU_ADDRESS 0xC124 BIT_MASK 0xFFFF /end MEASUREMENT
/begin MEASUREMENT dzmzMk8 "Selektive Mengenkorrektur Zylinder 8" SWORD MM3 0 0 -327.680000 327.670000 ECU_ADDRESS 0xC126 BIT_MASK 0xFFFF /end MEASUREMENT
/begin MEASUREMENT dzmzN1 "Selektive Drehzahl Zylinder 1" UWORD N 0 0 0.000000 32767.000000 ECU_ADDRESS 0xC108 BIT_MASK 0xFFFF /end MEASUREMENT
/begin MEASUREMENT dzmzN2 "Selektive Drehzahl Zylinder 2" UWORD N 0 0 0.000000 32767.000000 ECU_ADDRESS 0xC10A BIT_MASK 0xFFFF /end MEASUREMENT
/begin MEASUREMENT dzmzN3 "Selektive Drehzahl Zylinder 3" UWORD N 0 0 0.000000 32767.000000 ECU_ADDRESS 0xC10C BIT_MASK 0xFFFF /end MEASUREMENT
/begin MEASUREMENT dzmzN4 "Selektive Drehzahl Zylinder 4" UWORD N 0 0 0.000000 32767.000000 ECU_ADDRESS 0xC10E BIT_MASK 0xFFFF /end MEASUREMENT
/begin MEASUREMENT dzmzN5 "Selektive Drehzahl Zylinder 5" UWORD N 0 0 0.000000 32767.000000 ECU_ADDRESS 0xC110 BIT_MASK 0xFFFF /end MEASUREMENT
/begin MEASUREMENT dzmzN6 "Selektive Drehzahl Zylinder 6" UWORD N 0 0 0.000000 32767.000000 ECU_ADDRESS 0xC112 BIT_MASK 0xFFFF /end MEASUREMENT
/begin MEASUREMENT dzmzN7 "Selektive Drehzahl Zylinder 7" UWORD N 0 0 0.000000 32767.000000 ECU_ADDRESS 0xC114 BIT_MASK 0xFFFF /end MEASUREMENT
/begin MEASUREMENT dzmzN8 "Selektive Drehzahl Zylinder 8" UWORD N 0 0 0.000000 32767.000000 ECU_ADDRESS 0xC116 BIT_MASK 0xFFFF /end MEASUREMENT
/begin MEASUREMENT dzoAktZyl "aktueller Zylinder" UBYTE DEZ_DB_U 0 0 0.000000 255.000000 ECU_ADDRESS 0xD8D8 BIT_MASK 0xFF /end MEASUREMENT
/begin MEASUREMENT dzoDZGPERH "T High-Zeit der aktuellen DZG-Segmentperiode" UWORD ZEIT_T0 0 0 0.000000 65535.000000 ECU_ADDRESS 0xDB76 BIT_MASK 0xFFFF /end MEASUREMENT
/begin MEASUREMENT dzoDZGPERL "T Low-Zeit der aktuellen DZG-Segmentperiode" UWORD ZEIT_T0 0 0 0.000000 65535.000000 ECU_ADDRESS 0xDB78 BIT_MASK 0xFFFF /end MEASUREMENT
/begin MEASUREMENT dzoPerHigh "letzte Periodendauer f. Ber. d. zylsel. Drehzahlen (Byte 2)" UBYTE DEZ_DB_U 0 0 0.000000 255.000000 ECU_ADDRESS 0xD8D4 BIT_MASK 0xFF /end MEASUREMENT
/begin MEASUREMENT dzoPerLow "letzte Periodendauer f. Ber. d. zylsel. Drehzahlen (Byte 0,1)   ###crq576 Zu" UWORD DEZ_DW_U 0 0 0.000000 65535.000000 ECU_ADDRESS 0xD8D6 BIT_MASK 0xFFFF /end MEASUREMENT
/begin MEASUREMENT dzoTS_AKTH "High-Word von dzmTS_AKT" SWORD DEZ_DB_U 0 0 0.000000 255.000000 ECU_ADDRESS 0xD898 BIT_MASK 0xFFFF /end MEASUREMENT
/begin MEASUREMENT dzoTS_AKTL "Low-Word von dzmTS_AKT" SWORD DEZ_DB_U 0 0 0.000000 255.000000 ECU_ADDRESS 0xD89A BIT_MASK 0xFFFF /end MEASUREMENT
/begin MEASUREMENT dzoWINKUHR "DZG Winkelposition Drehzahlinterrupt" UWORD GradKW 0 0 -768.000000 767.976600 ECU_ADDRESS 0xDCD8 BIT_MASK 0xFFFF /end MEASUREMENT
/begin MEASUREMENT edmDIA_P "ED Diagnose Pointer" UWORD DEZ_DW_U 0 0 0.000000 65535.000000 ECU_ADDRESS 0xC130 BIT_MASK 0xFFFF /end MEASUREMENT
/begin MEASUREMENT edmFSP_S_Z "Fehlerspeicherung Status" UWORD DEZ_DW_U 0 0 0.000000 65535.000000 ECU_ADDRESS 0xC12E BIT_MASK 0xFFFF /end MEASUREMENT
/begin MEASUREMENT edmGAFZ "Fehlerzaehler des Gate-Arrays" UBYTE DEZ_DB_U 0 0 0.000000 255.000000 ECU_ADDRESS 0xC390 BIT_MASK 0xFF /end MEASUREMENT
/begin MEASUREMENT edmM_E_AUS "Mengenausgabe ausschalten durch CC55x" UBYTE DEZ_DB_U 0 0 0.000000 255.000000 ECU_ADDRESS 0xC38F BIT_MASK 0xFF /end MEASUREMENT
/begin MEASUREMENT edmRSTCD "Restart Code" UWORD DEZ_DW_U 0 0 0.000000 65535.000000 ECU_ADDRESS 0xC004 BIT_MASK 0xFFFF /end MEASUREMENT
/begin MEASUREMENT edoCKRSP "Gate-Array" UWORD DEZ_DW_U 0 0 0.000000 65535.000000 ECU_ADDRESS 0xDBD8 BIT_MASK 0xFFFF /end MEASUREMENT
/begin MEASUREMENT edoGAFRG "Gatearray Frage" UWORD DEZ_DW_U 0 0 0.000000 65535.000000 ECU_ADDRESS 0xDBCC BIT_MASK 0xFFFF /end MEASUREMENT
/begin MEASUREMENT edoGAFZ "Fehlerzaehler des Gate-Arrays" UWORD DEZ_DW_U 0 0 0.000000 65535.000000 ECU_ADDRESS 0xDBD0 BIT_MASK 0xFFFF /end MEASUREMENT
/begin MEASUREMENT edoGAREQ "neue Frage vom Gate-Array" UWORD DEZ_DW_U 0 0 0.000000 65535.000000 ECU_ADDRESS 0xDBCE BIT_MASK 0xFFFF /end MEASUREMENT
/begin MEASUREMENT edoHRLFZ "HRL_Fehlerzaehler" UWORD DEZ_DW_U 0 0 0.000000 65535.000000 ECU_ADDRESS 0xDBD2 BIT_MASK 0xFFFF /end MEASUREMENT
/begin MEASUREMENT edoININR "aktuelle Testnummer der Eigendiagnose" UWORD DEZ_DW_U 0 0 0.000000 65535.000000 ECU_ADDRESS 0xDBC0 BIT_MASK 0xFFFF /end MEASUREMENT
/begin MEASUREMENT edoLFZ10 "Laufzeitolda 10 msec Raster in usec" UWORD LFZ 0 0 0.000000 131070.000000 ECU_ADDRESS 0xDAB0 BIT_MASK 0xFFFF /end MEASUREMENT
/begin MEASUREMENT edoLFZM10 "max. Laufzeitolda 10 msec Raster in usec" UWORD LFZ 0 0 0.000000 131070.000000 ECU_ADDRESS 0xDAAE BIT_MASK 0xFFFF /end MEASUREMENT
/begin MEASUREMENT edoLFZM100 "max. Brutto-Laufzeit des 100 msec Raster" UWORD LFZ 0 0 0.000000 131070.000000 ECU_ADDRESS 0xDC48 BIT_MASK 0xFFFF /end MEASUREMENT
/begin MEASUREMENT edoLFZM20 "max. Brutto-Laufzeit des 20 msec Raster" UWORD LFZ 0 0 0.000000 131070.000000 ECU_ADDRESS 0xDC4C BIT_MASK 0xFFFF /end MEASUREMENT
/begin MEASUREMENT edoLFZMN "max. Laufzeitolda n-synch. Raster in usec" UWORD LFZ 0 0 0.000000 131070.000000 ECU_ADDRESS 0xDBBA BIT_MASK 0xFFFF /end MEASUREMENT
/begin MEASUREMENT edoLFZN "Laufzeitolda n-synch. Raster in usec" UWORD LFZ 0 0 0.000000 131070.000000 ECU_ADDRESS 0xDBBC BIT_MASK 0xFFFF /end MEASUREMENT
/begin MEASUREMENT edoLFZ_100 "Brutto-Laufzeit des 100 msec Raster" UWORD LFZ 0 0 0.000000 131070.000000 ECU_ADDRESS 0xDC4A BIT_MASK 0xFFFF /end MEASUREMENT
/begin MEASUREMENT edoLFZ_20 "Brutto-Laufzeit des 20 msec Raster" UWORD LFZ 0 0 0.000000 131070.000000 ECU_ADDRESS 0xDC4E BIT_MASK 0xFFFF /end MEASUREMENT
/begin MEASUREMENT edoRSTDZ "Deadline Zeit’berschreitung" UWORD DEZ_DW_U 0 0 0.000000 65535.000000 ECU_ADDRESS 0xDBD4 BIT_MASK 0xFFFF /end MEASUREMENT
/begin MEASUREMENT edoRSTSH "Restart Adresse High" UWORD DEZ_DW_U 0 0 0.000000 65535.000000 ECU_ADDRESS 0xDBDA BIT_MASK 0xFFFF /end MEASUREMENT
/begin MEASUREMENT edoRSTSL "Restart Adresse Low" UWORD DEZ_DW_U 0 0 0.000000 65535.000000 ECU_ADDRESS 0xDBDC BIT_MASK 0xFFFF /end MEASUREMENT
/begin MEASUREMENT ehmBW220_1 "Diagnosebits CY220/Ueb.st.HS/LS/LL BNK1:1..4/BNK2:1..4" UWORD DEZ_DW_U 0 0 0.000000 65535.000000 ECU_ADDRESS 0xC256 BIT_MASK 0xFFFF /end MEASUREMENT
/begin MEASUREMENT ehmBW220_2 "Diagnosebits CY220/SL:Bit 0..7/BTS410:Bit 15" UWORD DEZ_DW_U 0 0 0.000000 65535.000000 ECU_ADDRESS 0xC258 BIT_MASK 0xFFFF /end MEASUREMENT
/begin MEASUREMENT ehmDAKS "Diagnose Abluftlappensteuerung" UWORD PROZ 0 0 -327.680000 327.670000 ECU_ADDRESS 0xC290 BIT_MASK 0xFFFF /end MEASUREMENT
/begin MEASUREMENT ehmDARS "TV Diagnose ARF-Steller" UWORD PROZ 0 0 -327.680000 327.670000 ECU_ADDRESS 0xC28A BIT_MASK 0xFFFF /end MEASUREMENT
/begin MEASUREMENT ehmDASK "Diagnose Abstellklappe" UWORD PROZ 0 0 -327.680000 327.670000 ECU_ADDRESS 0xC286 BIT_MASK 0xFFFF /end MEASUREMENT
/begin MEASUREMENT ehmDDRA "Diagnose Drallklappe" UWORD PROZ 0 0 -327.680000 327.670000 ECU_ADDRESS 0xC288 BIT_MASK 0xFFFF /end MEASUREMENT
/begin MEASUREMENT ehmDEKP "Diagnose elektrische Kraftstoffpumpe" UWORD PROZ 0 0 -327.680000 327.670000 ECU_ADDRESS 0xC298 BIT_MASK 0xFFFF /end MEASUREMENT
/begin MEASUREMENT ehmDGRS "Diagnose Gluehrelaissteller" UWORD PROZ 0 0 -327.680000 327.670000 ECU_ADDRESS 0xC280 BIT_MASK 0xFFFF /end MEASUREMENT
/begin MEASUREMENT ehmDKDR "TV Diagnose Kraftstoffdruckregler" UWORD PROZ 0 0 -327.680000 327.670000 ECU_ADDRESS 0xC28E BIT_MASK 0xFFFF /end MEASUREMENT
/begin MEASUREMENT ehmDKHP "Diagnose Elementabschaltung" UWORD PROZ 0 0 -327.680000 327.670000 ECU_ADDRESS 0xC28C BIT_MASK 0xFFFF /end MEASUREMENT
/begin MEASUREMENT ehmDKLI "Diagnose Klimakompressor" UWORD PROZ 0 0 -327.680000 327.670000 ECU_ADDRESS 0xC29A BIT_MASK 0xFFFF /end MEASUREMENT
/begin MEASUREMENT ehmDKWH "TV Diag. Anst. Kuehlwasserheizung" UWORD PROZ 0 0 -327.680000 327.670000 ECU_ADDRESS 0xC29E BIT_MASK 0xFFFF /end MEASUREMENT
/begin MEASUREMENT ehmDLDS "TV Diagnose Ladedrucksteller" UWORD PROZ 0 0 -327.680000 327.670000 ECU_ADDRESS 0xC27E BIT_MASK 0xFFFF /end MEASUREMENT
/begin MEASUREMENT ehmDMLS "TV Diagnose elektrischer Motorluefter" UWORD PROZ 0 0 -327.680000 327.670000 ECU_ADDRESS 0xC282 BIT_MASK 0xFFFF /end MEASUREMENT
/begin MEASUREMENT ehmDMML "TV Diagnose Motorlager" UWORD PROZ 0 0 -327.680000 327.670000 ECU_ADDRESS 0xC284 BIT_MASK 0xFFFF /end MEASUREMENT
/begin MEASUREMENT ehmDNOX "Diagnose Additional injection pump ON/OFF" UWORD PROZ 0 0 -327.680000 327.670000 ECU_ADDRESS 0xC292 BIT_MASK 0xFFFF /end MEASUREMENT
/begin MEASUREMENT ehmDODS "TV Diag. Anst. Oeldruckschalter" UWORD PROZ 0 0 -327.680000 327.670000 ECU_ADDRESS 0xC29C BIT_MASK 0xFFFF /end MEASUREMENT
/begin MEASUREMENT ehmDTHS "Diagnose Thermostat" UWORD PROZ 0 0 -327.680000 327.670000 ECU_ADDRESS 0xC296 BIT_MASK 0xFFFF /end MEASUREMENT
/begin MEASUREMENT ehmDZHR "Diagnose Zusatzheizung" UWORD PROZ 0 0 -327.680000 327.670000 ECU_ADDRESS 0xC294 BIT_MASK 0xFFFF /end MEASUREMENT
/begin MEASUREMENT ehmFAKS "TV Ansteuerung Abluftlappensteuerung" UWORD PROZ 0 0 -327.680000 327.670000 ECU_ADDRESS 0xC26C BIT_MASK 0xFFFF /end MEASUREMENT
/begin MEASUREMENT ehmFARS "TV Ansteuerung ARF-Steller" UWORD PROZ 0 0 -327.680000 327.670000 ECU_ADDRESS 0xC266 BIT_MASK 0xFFFF /end MEASUREMENT
/begin MEASUREMENT ehmFASK "Ansteuerung Abstellklappe" UWORD PROZ 0 0 -327.680000 327.670000 ECU_ADDRESS 0xC262 BIT_MASK 0xFFFF /end MEASUREMENT
/begin MEASUREMENT ehmFDRA "Ansteuerung Drallklappe" UWORD PROZ 0 0 -327.680000 327.670000 ECU_ADDRESS 0xC264 BIT_MASK 0xFFFF /end MEASUREMENT
/begin MEASUREMENT ehmFEKP "TV Ansteuerung elektrische Kraftstoffpumpe" UWORD PROZ 0 0 -327.680000 327.670000 ECU_ADDRESS 0xC274 BIT_MASK 0xFFFF /end MEASUREMENT
/begin MEASUREMENT ehmFGAZ "Gluehanzeige" UWORD DEZ_DW_U 0 0 0.000000 65535.000000 ECU_ADDRESS 0xC2CA BIT_MASK 0xFFFF /end MEASUREMENT
/begin MEASUREMENT ehmFGRS "TV Ansteuerung Gluehrelaissteller" UWORD PROZ 0 0 -327.680000 327.670000 ECU_ADDRESS 0xC25C BIT_MASK 0xFFFF /end MEASUREMENT
/begin MEASUREMENT ehmFKDR "TV Ansteuerung Kraftstoffdruckregler" UWORD PROZ 0 0 -327.680000 327.670000 ECU_ADDRESS 0xC26A BIT_MASK 0xFFFF /end MEASUREMENT
/begin MEASUREMENT ehmFKHP "Ansteuerung Elementabschaltung" UWORD PROZ 0 0 -327.680000 327.670000 ECU_ADDRESS 0xC268 BIT_MASK 0xFFFF /end MEASUREMENT
/begin MEASUREMENT ehmFKLI "TV Ansteuerung Klimakompressor" UWORD PROZ 0 0 -327.680000 327.670000 ECU_ADDRESS 0xC276 BIT_MASK 0xFFFF /end MEASUREMENT
/begin MEASUREMENT ehmFKWH "Ansteuerung Kuehlwasserheizung" UWORD PROZ 0 0 -327.680000 327.670000 ECU_ADDRESS 0xC27C BIT_MASK 0xFFFF /end MEASUREMENT
/begin MEASUREMENT ehmFLDS "TV Ansteuerung Ladedrucksteller" UWORD PROZ 0 0 -327.680000 327.670000 ECU_ADDRESS 0xC25A BIT_MASK 0xFFFF /end MEASUREMENT
/begin MEASUREMENT ehmFMLS "TV Ansteuerung elektrischer Motorluefter" UWORD PROZ 0 0 -327.680000 327.670000 ECU_ADDRESS 0xC25E BIT_MASK 0xFFFF /end MEASUREMENT
/begin MEASUREMENT ehmFMML "TV Ansteuerung Motorlager" UWORD PROZ 0 0 -327.680000 327.670000 ECU_ADDRESS 0xC260 BIT_MASK 0xFFFF /end MEASUREMENT
/begin MEASUREMENT ehmFNOX "Ansteuerung Additional injection pump ON/OFF" UWORD PROZ 0 0 -327.680000 327.670000 ECU_ADDRESS 0xC26E BIT_MASK 0xFFFF /end MEASUREMENT
/begin MEASUREMENT ehmFODS "Ansteuerung Oeldruckschalter" UWORD PROZ 0 0 -327.680000 327.670000 ECU_ADDRESS 0xC27A BIT_MASK 0xFFFF /end MEASUREMENT
/begin MEASUREMENT ehmFTHS "Ansteuerung Thermostat" UWORD PROZ 0 0 -327.680000 327.670000 ECU_ADDRESS 0xC272 BIT_MASK 0xFFFF /end MEASUREMENT
/begin MEASUREMENT ehmFZHR "Ansteuerung Zusatzheizung" UWORD PROZ 0 0 -327.680000 327.670000 ECU_ADDRESS 0xC270 BIT_MASK 0xFFFF /end MEASUREMENT
/begin MEASUREMENT ehmI_STEL "TV_I Stellgroesse Stromregler" SWORD PROZ 0 0 -327.680000 327.670000 ECU_ADDRESS 0xC02E BIT_MASK 0xFFFF /end MEASUREMENT
/begin MEASUREMENT ehmSAKS "EST-Status Abluftlappensteuerung" UWORD DEZ_DW_U 0 0 0.000000 65535.000000 ECU_ADDRESS 0xC2B2 BIT_MASK 0xFFFF /end MEASUREMENT
/begin MEASUREMENT ehmSARS "EST-Status ARF-Steller" UWORD DEZ_DW_U 0 0 0.000000 65535.000000 ECU_ADDRESS 0xC2AC BIT_MASK 0xFFFF /end MEASUREMENT
/begin MEASUREMENT ehmSASK "EST-Status Abstellklappe" UWORD DEZ_DW_U 0 0 0.000000 65535.000000 ECU_ADDRESS 0xC2A8 BIT_MASK 0xFFFF /end MEASUREMENT
/begin MEASUREMENT ehmSDRA "EST-Status Drallklappe" UWORD DEZ_DW_U 0 0 0.000000 65535.000000 ECU_ADDRESS 0xC2AA BIT_MASK 0xFFFF /end MEASUREMENT
/begin MEASUREMENT ehmSEKP "EST-Status elektrische Kraftstoffpumpe" UWORD DEZ_DW_U 0 0 0.000000 65535.000000 ECU_ADDRESS 0xC2BA BIT_MASK 0xFFFF /end MEASUREMENT
/begin MEASUREMENT ehmSGRS "EST-Status Gluehrelaissteller" UWORD DEZ_DW_U 0 0 0.000000 65535.000000 ECU_ADDRESS 0xC2A2 BIT_MASK 0xFFFF /end MEASUREMENT
/begin MEASUREMENT ehmSKDR "EST-Status Kraftstoffdruckregler" UWORD DEZ_DW_U 0 0 0.000000 65535.000000 ECU_ADDRESS 0xC2B0 BIT_MASK 0xFFFF /end MEASUREMENT
/begin MEASUREMENT ehmSKHP "EST-Status Elementabschaltung" UWORD DEZ_DW_U 0 0 0.000000 65535.000000 ECU_ADDRESS 0xC2AE BIT_MASK 0xFFFF /end MEASUREMENT
/begin MEASUREMENT ehmSKLI "EST-Status Klimakompressor" UWORD DEZ_DW_U 0 0 0.000000 65535.000000 ECU_ADDRESS 0xC2BC BIT_MASK 0xFFFF /end MEASUREMENT
/begin MEASUREMENT ehmSKWH "EST-Status Kuehlwasserheizung" UWORD DEZ_DW_U 0 0 0.000000 65535.000000 ECU_ADDRESS 0xC2C0 BIT_MASK 0xFFFF /end MEASUREMENT
/begin MEASUREMENT ehmSLDS "EST-Status Ladedrucksteller" UWORD DEZ_DW_U 0 0 0.000000 65535.000000 ECU_ADDRESS 0xC2A0 BIT_MASK 0xFFFF /end MEASUREMENT
/begin MEASUREMENT ehmSMLS "EST-Status elektrischer Motorluefter" UWORD DEZ_DW_U 0 0 0.000000 65535.000000 ECU_ADDRESS 0xC2A4 BIT_MASK 0xFFFF /end MEASUREMENT
/begin MEASUREMENT ehmSMML "EST-Status Motorlager" UWORD DEZ_DW_U 0 0 0.000000 65535.000000 ECU_ADDRESS 0xC2A6 BIT_MASK 0xFFFF /end MEASUREMENT
/begin MEASUREMENT ehmSNOX "EST-Status Additional injection pump ON/OFF" UWORD DEZ_DW_U 0 0 0.000000 65535.000000 ECU_ADDRESS 0xC2B4 BIT_MASK 0xFFFF /end MEASUREMENT
/begin MEASUREMENT ehmSODS "EST-Status Oeldruckschalter" UWORD DEZ_DW_U 0 0 0.000000 65535.000000 ECU_ADDRESS 0xC2BE BIT_MASK 0xFFFF /end MEASUREMENT
/begin MEASUREMENT ehmSTHS "EST-Status Thermostat" UWORD DEZ_DW_U 0 0 0.000000 65535.000000 ECU_ADDRESS 0xC2B8 BIT_MASK 0xFFFF /end MEASUREMENT
/begin MEASUREMENT ehmSZHR "EST-Status Zusatzheizung" UWORD DEZ_DW_U 0 0 0.000000 65535.000000 ECU_ADDRESS 0xC2B6 BIT_MASK 0xFFFF /end MEASUREMENT
/begin MEASUREMENT ehmUC1FE "UC-Fehlerzaehler Bank 1" UWORD DEZ_DW_U 0 0 0.000000 65535.000000 ECU_ADDRESS 0xC028 BIT_MASK 0xFFFF /end MEASUREMENT
/begin MEASUREMENT ehmUC2FE "UC-Fehlerzaehler Bank 2" UWORD DEZ_DW_U 0 0 0.000000 65535.000000 ECU_ADDRESS 0xC02A BIT_MASK 0xFFFF /end MEASUREMENT
/begin MEASUREMENT ehmUC_RMIN "min. Spannung fuer die UC-Ueberwachung" UWORD U_C 0 0 0.000000 1348179.000000 ECU_ADDRESS 0xC02C BIT_MASK 0xFFFF /end MEASUREMENT
/begin MEASUREMENT ehoBW1 "Diagnosebits Endstufe 0..7" UWORD DEZ_DW_U 0 0 0.000000 65535.000000 ECU_ADDRESS 0xD982 BIT_MASK 0xFFFF /end MEASUREMENT
/begin MEASUREMENT ehoBW2 "Diagnosebits Endstufe 8..15" UWORD DEZ_DW_U 0 0 0.000000 65535.000000 ECU_ADDRESS 0xD980 BIT_MASK 0xFFFF /end MEASUREMENT
/begin MEASUREMENT ehoBW3 "Diagnosebits Endstufe 16..24" UWORD DEZ_DW_U 0 0 0.000000 65535.000000 ECU_ADDRESS 0xD97E BIT_MASK 0xFFFF /end MEASUREMENT
/begin MEASUREMENT ehoBW4 "Diagnosebits Endstufe 25..31" UWORD DEZ_DW_U 0 0 0.000000 65535.000000 ECU_ADDRESS 0xD97C BIT_MASK 0xFFFF /end MEASUREMENT
/begin MEASUREMENT ehoBW5 "reserviert fuer Diagnosebits BTS721" UWORD DEZ_DW_U 0 0 0.000000 65535.000000 ECU_ADDRESS 0xD97A BIT_MASK 0xFFFF /end MEASUREMENT
/begin MEASUREMENT ehoI_IANT "TV_I I-Anteil des PI-Stromregler" SWORD PROZ 0 0 -327.680000 327.670000 ECU_ADDRESS 0xDC46 BIT_MASK 0xFFFF /end MEASUREMENT
/begin MEASUREMENT ehoI_IST "TV_I Istwert Stromregelung" SWORD IDV 0 0 -32768.000000 32767.000000 ECU_ADDRESS 0xDC40 BIT_MASK 0xFFFF /end MEASUREMENT
/begin MEASUREMENT ehoI_PANT "TV_I P-Anteil des PI-Stromregler" SWORD PROZ 0 0 -327.680000 327.670000 ECU_ADDRESS 0xDC44 BIT_MASK 0xFFFF /end MEASUREMENT
/begin MEASUREMENT ehoI_RAW "TV_I Regelabweichung Stromregelung" SWORD IDV 0 0 -32768.000000 32767.000000 ECU_ADDRESS 0xDC42 BIT_MASK 0xFFFF /end MEASUREMENT
/begin MEASUREMENT ehoI_SOLL "TV_I Sollwert Stromregelung" SWORD IDV 0 0 -32768.000000 32767.000000 ECU_ADDRESS 0xDC3E BIT_MASK 0xFFFF /end MEASUREMENT
/begin MEASUREMENT ehoUEBTEM "EH Uebertemperatur der CJ920 Endstufen" UWORD DEZ_DW_U 0 0 0.000000 65535.000000 ECU_ADDRESS 0xDB74 BIT_MASK 0xFFFF /end MEASUREMENT
/begin MEASUREMENT ehoUEBTEM1 "EH Uebertemperatur der CJ920 Endstufen" UWORD PROZ 0 0 -327.680000 327.670000 ECU_ADDRESS 0xDB72 BIT_MASK 0xFFFF /end MEASUREMENT
/begin MEASUREMENT fbmBSTZ_UB "UB akt. Betriebstundenzaehler" UWORD BSTZ_TIC_h 0 0 0.000000 6553.500000 ECU_ADDRESS 0xC2FE BIT_MASK 0xFFFF /end MEASUREMENT
/begin MEASUREMENT fbmBSTZg "gesp. Betriebstundenzaehler" UWORD BSTZ_TIC_h 0 0 0.000000 6553.500000 ECU_ADDRESS 0xC300 BIT_MASK 0xFFFF /end MEASUREMENT
/begin MEASUREMENT fbmDCycle "Driving Cycle erreicht (0:nein/255:ja)" UBYTE DEZ_DB_U 0 0 0.000000 255.000000 ECU_ADDRESS 0xC396 BIT_MASK 0xFF /end MEASUREMENT
/begin MEASUREMENT fbmDIA_C "Diagnoselampe ueber CAN" UBYTE DEZ_DB_U 0 0 0.000000 255.000000 ECU_ADDRESS 0xC3B7 BIT_MASK 0xFF /end MEASUREMENT
/begin MEASUREMENT fbmMIL_C "Malfunction Indicator Lamp ueber CAN" UBYTE DEZ_DB_U 0 0 0.000000 255.000000 ECU_ADDRESS 0xC3B9 BIT_MASK 0xFF /end MEASUREMENT
/begin MEASUREMENT fbmRDYNES "Readyness" UBYTE DEZ_DB_U 0 0 0.000000 255.000000 ECU_ADDRESS 0xC398 BIT_MASK 0xFF /end MEASUREMENT
/begin MEASUREMENT fbmSDIAL "Anforderung Diagnoselampe aus Fehlerbehandlung (0:Aus,1:Ein,2:Blinken)" UBYTE DEZ_DB_U 0 0 0.000000 255.000000 ECU_ADDRESS 0xC394 BIT_MASK 0xFF /end MEASUREMENT
/begin MEASUREMENT fbmSMIL "Anforderung MIL aus Fehlerbehandlung (0:Aus,1:Ein,2:Blinken)" UBYTE DEZ_DB_U 0 0 0.000000 255.000000 ECU_ADDRESS 0xC39A BIT_MASK 0xFF /end MEASUREMENT
/begin MEASUREMENT fbmTRIP "Trip erreicht (0:nein/255:ja)" UBYTE DEZ_DB_U 0 0 0.000000 255.000000 ECU_ADDRESS 0xC395 BIT_MASK 0xFF /end MEASUREMENT
/begin MEASUREMENT fbmWUC "Warm Up Cycle erreicht (0:nein/255:ja)" UBYTE DEZ_DB_U 0 0 0.000000 255.000000 ECU_ADDRESS 0xC397 BIT_MASK 0xFF /end MEASUREMENT
/begin MEASUREMENT fboBRS_PLT "BRE/BRK- Einzelbetaetigungs-Zeitsumme bis beide aktiv, (0=inaktiv)" UWORD ZEIT_HP 0 0 0.000000 1310700000.000000 ECU_ADDRESS 0xD978 BIT_MASK 0xFFFF /end MEASUREMENT
/begin MEASUREMENT fboBSTZh "akt. Betriebstundenzaehler High-Word" UWORD BSTZ_TIC_h 0 0 0.000000 6553.500000 ECU_ADDRESS 0xDA0E BIT_MASK 0xFFFF /end MEASUREMENT
/begin MEASUREMENT fboBSTZl "akt. Betriebstundenzaehler Low-Word" UWORD BSTZ_TIC_s 0 0 0.000000 65535.000000 ECU_ADDRESS 0xDA10 BIT_MASK 0xFFFF /end MEASUREMENT
/begin MEASUREMENT fboDIALA "DIA Lampe Status" UBYTE DEZ_DB_U 0 0 0.000000 255.000000 ECU_ADDRESS 0xDC3C BIT_MASK 0xFF /end MEASUREMENT
/begin MEASUREMENT fboMILA "MIL Status" UBYTE DEZ_DB_U 0 0 0.000000 255.000000 ECU_ADDRESS 0xD9A6 BIT_MASK 0xFF /end MEASUREMENT
/begin MEASUREMENT fboOADF "Geprueft Fehlerpfad Athmosphaerendruckfuehler ADF" UBYTE DEZ_DB_U 0 0 0.000000 255.000000 ECU_ADDRESS 0xDD93 BIT_MASK 0xFF /end MEASUREMENT
/begin MEASUREMENT fboOARS "Geprueft Fehlerpfad ARF-Steller EPW" UBYTE DEZ_DB_U 0 0 0.000000 255.000000 ECU_ADDRESS 0xDDA0 BIT_MASK 0xFF /end MEASUREMENT
/begin MEASUREMENT fboOARSX "Geprueft Fehlerpfad ARF-Steller Extended ARS" UBYTE DEZ_DB_U 0 0 0.000000 255.000000 ECU_ADDRESS 0xDDCA BIT_MASK 0xFF /end MEASUREMENT
/begin MEASUREMENT fboOASK "Geprueft Fehlerpfad Abstellklappe" UBYTE DEZ_DB_U 0 0 0.000000 255.000000 ECU_ADDRESS 0xDDCB BIT_MASK 0xFF /end MEASUREMENT
/begin MEASUREMENT fboOAT1 "Geprueft Fehlerpfad Abgastemperaturfuehler 1 AT1" UBYTE DEZ_DB_U 0 0 0.000000 255.000000 ECU_ADDRESS 0xDD90 BIT_MASK 0xFF /end MEASUREMENT
/begin MEASUREMENT fboOAT2 "Geprueft Fehlerpfad Abgastemperaturfuehler 2 AT2" UBYTE DEZ_DB_U 0 0 0.000000 255.000000 ECU_ADDRESS 0xDD91 BIT_MASK 0xFF /end MEASUREMENT
/begin MEASUREMENT fboOAUZ "Geprueft Fehlerpfad Aussetzerkennung" UBYTE DEZ_DB_U 0 0 0.000000 255.000000 ECU_ADDRESS 0xDDB6 BIT_MASK 0xFF /end MEASUREMENT
/begin MEASUREMENT fboOBRE "Geprueft Fehlerpfad Bremssignal" UBYTE DEZ_DB_U 0 0 0.000000 255.000000 ECU_ADDRESS 0xDDAB BIT_MASK 0xFF /end MEASUREMENT
/begin MEASUREMENT fboOCAN "Geprueft Fehlerpfad CAN-Controller" UBYTE DEZ_DB_U 0 0 0.000000 255.000000 ECU_ADDRESS 0xDDB3 BIT_MASK 0xFF /end MEASUREMENT
/begin MEASUREMENT fboODRA "Geprueft Fehlerpfad Drallklappe" UBYTE DEZ_DB_U 0 0 0.000000 255.000000 ECU_ADDRESS 0xDDCC BIT_MASK 0xFF /end MEASUREMENT
/begin MEASUREMENT fboODZG "Geprueft Fehlerpfad Drehzahlgeber DZG" UBYTE DEZ_DB_U 0 0 0.000000 255.000000 ECU_ADDRESS 0xDD82 BIT_MASK 0xFF /end MEASUREMENT
/begin MEASUREMENT fboOEAB "Geprueft Fehlerpfad elektrische Abschaltung EAB" UBYTE DEZ_DB_U 0 0 0.000000 255.000000 ECU_ADDRESS 0xDDA9 BIT_MASK 0xFF /end MEASUREMENT
/begin MEASUREMENT fboOEEP "Geprueft Fehlerpfad EEPROM und Konfiguration" UBYTE DEZ_DB_U 0 0 0.000000 255.000000 ECU_ADDRESS 0xDD80 BIT_MASK 0xFF /end MEASUREMENT
/begin MEASUREMENT fboOEKP "Geprueft Fehlerpfad" UBYTE DEZ_DB_U 0 0 0.000000 255.000000 ECU_ADDRESS 0xDDA8 BIT_MASK 0xFF /end MEASUREMENT
/begin MEASUREMENT fboOEWS "Geprueft Fehlerpfad Elektronische Wegfahrsperre EWS" UBYTE DEZ_DB_U 0 0 0.000000 255.000000 ECU_ADDRESS 0xDDC0 BIT_MASK 0xFF /end MEASUREMENT
/begin MEASUREMENT fboOFGA "Geprueft Fehlerpfad Fahrgeschwindigkeitsregler Bedienteil" UBYTE DEZ_DB_U 0 0 0.000000 255.000000 ECU_ADDRESS 0xDD9A BIT_MASK 0xFF /end MEASUREMENT
/begin MEASUREMENT fboOFGG "Geprueft Fehlerpfad Fahrgeschwindigkeitsgeber FGG" UBYTE DEZ_DB_U 0 0 0.000000 255.000000 ECU_ADDRESS 0xDD9B BIT_MASK 0xFF /end MEASUREMENT
/begin MEASUREMENT fboOGAZ "Geprueft Fehlerpfad GAZ" UBYTE DEZ_DB_U 0 0 0.000000 255.000000 ECU_ADDRESS 0xDDAA BIT_MASK 0xFF /end MEASUREMENT
/begin MEASUREMENT fboOGRS "Geprueft Fehlerpfad" UBYTE DEZ_DB_U 0 0 0.000000 255.000000 ECU_ADDRESS 0xDD9D BIT_MASK 0xFF /end MEASUREMENT
/begin MEASUREMENT fboOGZ1 "Geprueft Fehlerpfad Integriertes Gluehen 1" UBYTE DEZ_DB_U 0 0 0.000000 255.000000 ECU_ADDRESS 0xDDAE BIT_MASK 0xFF /end MEASUREMENT
/begin MEASUREMENT fboOGZ2 "Geprueft Fehlerpfad Integriertes Gluehen 1" UBYTE DEZ_DB_U 0 0 0.000000 255.000000 ECU_ADDRESS 0xDDAF BIT_MASK 0xFF /end MEASUREMENT
/begin MEASUREMENT fboOHGB "Geprueft Fehlerpfad HGB" UBYTE DEZ_DB_U 0 0 0.000000 255.000000 ECU_ADDRESS 0xDDB5 BIT_MASK 0xFF /end MEASUREMENT
/begin MEASUREMENT fboOHRL "Geprueft Fehlerpfad Hauptrelais Hauptrelais" UBYTE DEZ_DB_U 0 0 0.000000 255.000000 ECU_ADDRESS 0xDDB0 BIT_MASK 0xFF /end MEASUREMENT
/begin MEASUREMENT fboOI11 "Geprueft Fehlerpfad Injektor 1 Bank 1" UBYTE DEZ_DB_U 0 0 0.000000 255.000000 ECU_ADDRESS 0xDDB7 BIT_MASK 0xFF /end MEASUREMENT
/begin MEASUREMENT fboOI12 "Geprueft Fehlerpfad Injektor 1 Bank 2" UBYTE DEZ_DB_U 0 0 0.000000 255.000000 ECU_ADDRESS 0xDDBB BIT_MASK 0xFF /end MEASUREMENT
/begin MEASUREMENT fboOI21 "Geprueft Fehlerpfad Injektor 2 Bank 1" UBYTE DEZ_DB_U 0 0 0.000000 255.000000 ECU_ADDRESS 0xDDB8 BIT_MASK 0xFF /end MEASUREMENT
/begin MEASUREMENT fboOI22 "Geprueft Fehlerpfad Injektor 2 Bank 2" UBYTE DEZ_DB_U 0 0 0.000000 255.000000 ECU_ADDRESS 0xDDBC BIT_MASK 0xFF /end MEASUREMENT
/begin MEASUREMENT fboOI31 "Geprueft Fehlerpfad Injektor 3 Bank 1" UBYTE DEZ_DB_U 0 0 0.000000 255.000000 ECU_ADDRESS 0xDDB9 BIT_MASK 0xFF /end MEASUREMENT
/begin MEASUREMENT fboOI32 "Geprueft Fehlerpfad Injektor 3 Bank 2" UBYTE DEZ_DB_U 0 0 0.000000 255.000000 ECU_ADDRESS 0xDDBD BIT_MASK 0xFF /end MEASUREMENT
/begin MEASUREMENT fboOI41 "Geprueft Fehlerpfad Injektor 4 Bank 1" UBYTE DEZ_DB_U 0 0 0.000000 255.000000 ECU_ADDRESS 0xDDBA BIT_MASK 0xFF /end MEASUREMENT
/begin MEASUREMENT fboOI42 "Geprueft Fehlerpfad Injektor 4 Bank 2" UBYTE DEZ_DB_U 0 0 0.000000 255.000000 ECU_ADDRESS 0xDDBE BIT_MASK 0xFF /end MEASUREMENT
/begin MEASUREMENT fboOIDV "Geprueft Fehlerpfad Stromregelung IDV" UBYTE DEZ_DB_U 0 0 0.000000 255.000000 ECU_ADDRESS 0xDD97 BIT_MASK 0xFF /end MEASUREMENT
/begin MEASUREMENT fboOIWZ "Geprueft Fehlerpfad Inkrement_winkel_Zeitsystem IWZ" UBYTE DEZ_DB_U 0 0 0.000000 255.000000 ECU_ADDRESS 0xDD83 BIT_MASK 0xFF /end MEASUREMENT
/begin MEASUREMENT fboOK15 "Geprueft Fehlerpfad Klemme 15" UBYTE DEZ_DB_U 0 0 0.000000 255.000000 ECU_ADDRESS 0xDDB2 BIT_MASK 0xFF /end MEASUREMENT
/begin MEASUREMENT fboOKAT "Geprueft Fehlerpfad Kat-Ueberwachung" UBYTE DEZ_DB_U 0 0 0.000000 255.000000 ECU_ADDRESS 0xDDAD BIT_MASK 0xFF /end MEASUREMENT
/begin MEASUREMENT fboOKDF "Geprueft Fehlerpfad Kraftstoffdruckfuehler KDF" UBYTE DEZ_DB_U 0 0 0.000000 255.000000 ECU_ADDRESS 0xDD87 BIT_MASK 0xFF /end MEASUREMENT
/begin MEASUREMENT fboOKDP "Geprueft Fehlerpfad Kraftstoffdruck-plausibilitaet" UBYTE DEZ_DB_U 0 0 0.000000 255.000000 ECU_ADDRESS 0xDD88 BIT_MASK 0xFF /end MEASUREMENT
/begin MEASUREMENT fboOKDR "Geprueft Fehlerpfad Kraftstoffdruckregelventil" UBYTE DEZ_DB_U 0 0 0.000000 255.000000 ECU_ADDRESS 0xDDA2 BIT_MASK 0xFF /end MEASUREMENT
/begin MEASUREMENT fboOKHP "Geprueft Fehlerpfad Elementabschaltung" UBYTE DEZ_DB_U 0 0 0.000000 255.000000 ECU_ADDRESS 0xDDA1 BIT_MASK 0xFF /end MEASUREMENT
/begin MEASUREMENT fboOKLI "Geprueft Fehlerpfad Klimaausgang" UBYTE DEZ_DB_U 0 0 0.000000 255.000000 ECU_ADDRESS 0xDDA3 BIT_MASK 0xFF /end MEASUREMENT
/begin MEASUREMENT fboOKTF "Geprueft Fehlerpfad Kraftstofftemperaturfuehler KTF" UBYTE DEZ_DB_U 0 0 0.000000 255.000000 ECU_ADDRESS 0xDD8D BIT_MASK 0xFF /end MEASUREMENT
/begin MEASUREMENT fboOKUP "Geprueft Fehlerpfad Kupplungsignal" UBYTE DEZ_DB_U 0 0 0.000000 255.000000 ECU_ADDRESS 0xDDAC BIT_MASK 0xFF /end MEASUREMENT
/begin MEASUREMENT fboOLDF "Geprueft Fehlerpfad Ladedruckfuehler LDF" UBYTE DEZ_DB_U 0 0 0.000000 255.000000 ECU_ADDRESS 0xDD92 BIT_MASK 0xFF /end MEASUREMENT
/begin MEASUREMENT fboOLDS "Geprueft Fehlerpfad Ladedruck- / Drosselklappensteller" UBYTE DEZ_DB_U 0 0 0.000000 255.000000 ECU_ADDRESS 0xDD9C BIT_MASK 0xFF /end MEASUREMENT
/begin MEASUREMENT fboOLDSX "Geprueft Fehlerpfad Ladedruck- / Drosselklappensteller Ansaugtrakt 1 Extended LD" UBYTE DEZ_DB_U 0 0 0.000000 255.000000 ECU_ADDRESS 0xDDC9 BIT_MASK 0xFF /end MEASUREMENT
/begin MEASUREMENT fboOLMM "Geprueft Fehlerpfad Luftmengenmesser LMM" UBYTE DEZ_DB_U 0 0 0.000000 255.000000 ECU_ADDRESS 0xDD94 BIT_MASK 0xFF /end MEASUREMENT
/begin MEASUREMENT fboOLTF "Geprueft Fehlerpfad Lufttemperaturfuehler LTF" UBYTE DEZ_DB_U 0 0 0.000000 255.000000 ECU_ADDRESS 0xDD8F BIT_MASK 0xFF /end MEASUREMENT
/begin MEASUREMENT fboOMML "Geprueft Fehlerpfad Motorlager" UBYTE DEZ_DB_U 0 0 0.000000 255.000000 ECU_ADDRESS 0xDD9F BIT_MASK 0xFF /end MEASUREMENT
/begin MEASUREMENT fboONLT "Geprueft Fehlerpfad Abstellen ueber Nullmenge, Injektorabschaltung (OFF)" UBYTE DEZ_DB_U 0 0 0.000000 255.000000 ECU_ADDRESS 0xDDBF BIT_MASK 0xFF /end MEASUREMENT
/begin MEASUREMENT fboOOTF "Geprueft Fehlerpfad Oeltemperaturfuehler OTF" UBYTE DEZ_DB_U 0 0 0.000000 255.000000 ECU_ADDRESS 0xDD8E BIT_MASK 0xFF /end MEASUREMENT
/begin MEASUREMENT fboOPGS "Geprueft Fehlerpfad Pedalwertgeber PGS" UBYTE DEZ_DB_U 0 0 0.000000 255.000000 ECU_ADDRESS 0xDD8A BIT_MASK 0xFF /end MEASUREMENT
/begin MEASUREMENT fboOPWG "Geprueft Fehlerpfad Pedalwertgeber PWG" UBYTE DEZ_DB_U 0 0 0.000000 255.000000 ECU_ADDRESS 0xDD89 BIT_MASK 0xFF /end MEASUREMENT
/begin MEASUREMENT fboORUC "Geprueft Fehlerpfad Microcontroller uC" UBYTE DEZ_DB_U 0 0 0.000000 255.000000 ECU_ADDRESS 0xDD81 BIT_MASK 0xFF /end MEASUREMENT
/begin MEASUREMENT fboOSTB "Geprueft Fehlerpfad Spannungs-Stabilisator" UBYTE DEZ_DB_U 0 0 0.000000 255.000000 ECU_ADDRESS 0xDDB1 BIT_MASK 0xFF /end MEASUREMENT
/begin MEASUREMENT fboOTNK2 "Geprueft Fehlerpfad Abgastemperaturfuehler NachKAT2" UBYTE DEZ_DB_U 0 0 0.000000 255.000000 ECU_ADDRESS 0xDDC2 BIT_MASK 0xFF /end MEASUREMENT
/begin MEASUREMENT fboOTVK2 "Geprueft Fehlerpfad Abgastemperaturfuehler VorKAT2" UBYTE DEZ_DB_U 0 0 0.000000 255.000000 ECU_ADDRESS 0xDDC1 BIT_MASK 0xFF /end MEASUREMENT
/begin MEASUREMENT fboOUBT "Geprueft Fehlerpfad Batteriespannung BATT" UBYTE DEZ_DB_U 0 0 0.000000 255.000000 ECU_ADDRESS 0xDD84 BIT_MASK 0xFF /end MEASUREMENT
/begin MEASUREMENT fboOUC1 "Geprueft Fehlerpfad Kondensatorspannung UC1" UBYTE DEZ_DB_U 0 0 0.000000 255.000000 ECU_ADDRESS 0xDD85 BIT_MASK 0xFF /end MEASUREMENT
/begin MEASUREMENT fboOUC2 "Geprueft Fehlerpfad Kondensatorspannung UC2" UBYTE DEZ_DB_U 0 0 0.000000 255.000000 ECU_ADDRESS 0xDD86 BIT_MASK 0xFF /end MEASUREMENT
/begin MEASUREMENT fboOUG1 "Geprueft Fehlerpfad Geber-Speisung 1" UBYTE DEZ_DB_U 0 0 0.000000 255.000000 ECU_ADDRESS 0xDD98 BIT_MASK 0xFF /end MEASUREMENT
/begin MEASUREMENT fboOUG2 "Geprueft Fehlerpfad Geber-Speisung 2" UBYTE DEZ_DB_U 0 0 0.000000 255.000000 ECU_ADDRESS 0xDD99 BIT_MASK 0xFF /end MEASUREMENT
/begin MEASUREMENT fboOVDF "Geprueft Fehlerpfad Vorfoerderdruckfuehler VDF" UBYTE DEZ_DB_U 0 0 0.000000 255.000000 ECU_ADDRESS 0xDD95 BIT_MASK 0xFF /end MEASUREMENT
/begin MEASUREMENT fboOVDP "Geprueft Fehlerpfad Vorfoerderdruck-Ueberwachung VDP" UBYTE DEZ_DB_U 0 0 0.000000 255.000000 ECU_ADDRESS 0xDD96 BIT_MASK 0xFF /end MEASUREMENT
/begin MEASUREMENT fboOWTF "Geprueft Fehlerpfad Wassertemperaturfuehler WTF" UBYTE DEZ_DB_U 0 0 0.000000 255.000000 ECU_ADDRESS 0xDD8C BIT_MASK 0xFF /end MEASUREMENT
/begin MEASUREMENT fboOZHR "Geprueft Fehlerpfad Zusatzheizung" UBYTE DEZ_DB_U 0 0 0.000000 255.000000 ECU_ADDRESS 0xDDA6 BIT_MASK 0xFF /end MEASUREMENT
/begin MEASUREMENT fboO_00 "Gepruefte Pfade 1 bis 16" UWORD DEZ_DW_U 0 0 0.000000 65535.000000 ECU_ADDRESS 0xDDE0 BIT_MASK 0xFFFF /end MEASUREMENT
/begin MEASUREMENT fboO_02 "Gepruefte Pfade 17 bis 32" UWORD DEZ_DW_U 0 0 0.000000 65535.000000 ECU_ADDRESS 0xDDE2 BIT_MASK 0xFFFF /end MEASUREMENT
/begin MEASUREMENT fboO_04 "Gepruefte Pfade 33 bis 48" UWORD DEZ_DW_U 0 0 0.000000 65535.000000 ECU_ADDRESS 0xDDE4 BIT_MASK 0xFFFF /end MEASUREMENT
/begin MEASUREMENT fboO_06 "Gepruefte Pfade 49 bis 64" UWORD DEZ_DW_U 0 0 0.000000 65535.000000 ECU_ADDRESS 0xDDE6 BIT_MASK 0xFFFF /end MEASUREMENT
/begin MEASUREMENT fboO_08 "Gepruefte Pfade 65 bis 80" UWORD DEZ_DW_U 0 0 0.000000 65535.000000 ECU_ADDRESS 0xDDE8 BIT_MASK 0xFFFF /end MEASUREMENT
/begin MEASUREMENT fboO_10 "Gepruefte Pfade 81 bis 96" UWORD DEZ_DW_U 0 0 0.000000 65535.000000 ECU_ADDRESS 0xDDEA BIT_MASK 0xFFFF /end MEASUREMENT
/begin MEASUREMENT fboO_DP "Anzahl ueber Driving Cycle  entprellte Pfade" UBYTE DEZ_DB_U 0 0 0.000000 255.000000 ECU_ADDRESS 0xDDEE BIT_MASK 0xFF /end MEASUREMENT
/begin MEASUREMENT fboO_DT "Anzahl gepruefte ueber Driving Cycle entprellte Pfade (255=alle)" UBYTE DEZ_DB_U 0 0 0.000000 255.000000 ECU_ADDRESS 0xDDEF BIT_MASK 0xFF /end MEASUREMENT
/begin MEASUREMENT fboO_TP "Anzahl ueber Trip entprellte Pfade" UBYTE DEZ_DB_U 0 0 0.000000 255.000000 ECU_ADDRESS 0xDDEC BIT_MASK 0xFF /end MEASUREMENT
/begin MEASUREMENT fboO_TT "Anzahl gepruefte ueber Trip entprellte Pfade (255=alle)" UBYTE DEZ_DB_U 0 0 0.000000 255.000000 ECU_ADDRESS 0xDDED BIT_MASK 0xFF /end MEASUREMENT
/begin MEASUREMENT fboSADF "Fehlerpfad Athmosphaerendruckfuehler ADF" UBYTE DEZ_DB_U 0 0 0.000000 255.000000 ECU_ADDRESS 0xDD13 BIT_MASK 0xFF /end MEASUREMENT
/begin MEASUREMENT fboSAKS "Fehlerpfad Abluftklappensteuerung AKS" UBYTE DEZ_DB_U 0 0 0.000000 255.000000 ECU_ADDRESS 0xDD24 BIT_MASK 0xFF /end MEASUREMENT
/begin MEASUREMENT fboSARS "Fehlerpfad ARF-Steller EPW" UBYTE DEZ_DB_U 0 0 0.000000 255.000000 ECU_ADDRESS 0xDD20 BIT_MASK 0xFF /end MEASUREMENT
/begin MEASUREMENT fboSARSX "Fehlerpfad ARF-Steller Extended ARS" UBYTE DEZ_DB_U 0 0 0.000000 255.000000 ECU_ADDRESS 0xDD4A BIT_MASK 0xFF /end MEASUREMENT
/begin MEASUREMENT fboSASK "Fehlerpfad Abstellklappe" UBYTE DEZ_DB_U 0 0 0.000000 255.000000 ECU_ADDRESS 0xDD4B BIT_MASK 0xFF /end MEASUREMENT
/begin MEASUREMENT fboSAT1 "Fehlerpfad Abgastemperaturfuehler AT1" UBYTE DEZ_DB_U 0 0 0.000000 255.000000 ECU_ADDRESS 0xDD10 BIT_MASK 0xFF /end MEASUREMENT
/begin MEASUREMENT fboSAT2 "Fehlerpfad Abgastemperaturfuehler AT2" UBYTE DEZ_DB_U 0 0 0.000000 255.000000 ECU_ADDRESS 0xDD11 BIT_MASK 0xFF /end MEASUREMENT
/begin MEASUREMENT fboSAUZ "Fehlerpfad Aussetzererkennung AUZ" UBYTE DEZ_DB_U 0 0 0.000000 255.000000 ECU_ADDRESS 0xDD36 BIT_MASK 0xFF /end MEASUREMENT
/begin MEASUREMENT fboSBRE "Fehlerpfad Bremssignal" UBYTE DEZ_DB_U 0 0 0.000000 255.000000 ECU_ADDRESS 0xDD2B BIT_MASK 0xFF /end MEASUREMENT
/begin MEASUREMENT fboSCAN "Fehlerpfad CAN-Controller" UBYTE DEZ_DB_U 0 0 0.000000 255.000000 ECU_ADDRESS 0xDD33 BIT_MASK 0xFF /end MEASUREMENT
/begin MEASUREMENT fboSDLA "Fehlerpfad Diagnoselampe" UBYTE DEZ_DB_U 0 0 0.000000 255.000000 ECU_ADDRESS 0xDD4E BIT_MASK 0xFF /end MEASUREMENT
/begin MEASUREMENT fboSDRA "Fehlerpfad Drallklappe" UBYTE DEZ_DB_U 0 0 0.000000 255.000000 ECU_ADDRESS 0xDD4C BIT_MASK 0xFF /end MEASUREMENT
/begin MEASUREMENT fboSDZG "Fehlerpfad Drehzahlgeber DZG" UBYTE DEZ_DB_U 0 0 0.000000 255.000000 ECU_ADDRESS 0xDD02 BIT_MASK 0xFF /end MEASUREMENT
/begin MEASUREMENT fboSEAB "Fehlerpfad elektrische Abschaltung EAB" UBYTE DEZ_DB_U 0 0 0.000000 255.000000 ECU_ADDRESS 0xDD29 BIT_MASK 0xFF /end MEASUREMENT
/begin MEASUREMENT fboSEEP "Fehlerpfad EEPROM und Konfiguration" UBYTE DEZ_DB_U 0 0 0.000000 255.000000 ECU_ADDRESS 0xDD00 BIT_MASK 0xFF /end MEASUREMENT
/begin MEASUREMENT fboSEKP "Fehlerpfad elektrische Kraftstoffpumpe EKP" UBYTE DEZ_DB_U 0 0 0.000000 255.000000 ECU_ADDRESS 0xDD28 BIT_MASK 0xFF /end MEASUREMENT
/begin MEASUREMENT fboSEWS "Fehlerpfad Elektronische Wegfahrsperre EWS" UBYTE DEZ_DB_U 0 0 0.000000 255.000000 ECU_ADDRESS 0xDD40 BIT_MASK 0xFF /end MEASUREMENT
/begin MEASUREMENT fboSEXT "Fehlerpfad CAN-Botschaften" UBYTE DEZ_DB_U 0 0 0.000000 255.000000 ECU_ADDRESS 0xDD34 BIT_MASK 0xFF /end MEASUREMENT
/begin MEASUREMENT fboSFGA "Fehlerpfad Fahrgeschwindigkeitsregler Bedienteil" UBYTE DEZ_DB_U 0 0 0.000000 255.000000 ECU_ADDRESS 0xDD1A BIT_MASK 0xFF /end MEASUREMENT
/begin MEASUREMENT fboSFGG "Fehlerpfad Fahrgeschwindigkeitsgeber FGG" UBYTE DEZ_DB_U 0 0 0.000000 255.000000 ECU_ADDRESS 0xDD1B BIT_MASK 0xFF /end MEASUREMENT
/begin MEASUREMENT fboSGAZ "Fehlerpfad Gluehanzeige" UBYTE DEZ_DB_U 0 0 0.000000 255.000000 ECU_ADDRESS 0xDD2A BIT_MASK 0xFF /end MEASUREMENT
/begin MEASUREMENT fboSGRS "Fehlerpfad Gluehrelaissteller GRS" UBYTE DEZ_DB_U 0 0 0.000000 255.000000 ECU_ADDRESS 0xDD1D BIT_MASK 0xFF /end MEASUREMENT
/begin MEASUREMENT fboSGZ1 "Fehlerpfad Integriertes Gluehen 1" UBYTE DEZ_DB_U 0 0 0.000000 255.000000 ECU_ADDRESS 0xDD2E BIT_MASK 0xFF /end MEASUREMENT
/begin MEASUREMENT fboSGZ2 "Fehlerpfad Integriertes Gluehen 2" UBYTE DEZ_DB_U 0 0 0.000000 255.000000 ECU_ADDRESS 0xDD2F BIT_MASK 0xFF /end MEASUREMENT
/begin MEASUREMENT fboSHGB "Fehlerpfad Hoechstgeschwindigkeitsbegrenzung HGB" UBYTE DEZ_DB_U 0 0 0.000000 255.000000 ECU_ADDRESS 0xDD35 BIT_MASK 0xFF /end MEASUREMENT
/begin MEASUREMENT fboSHRL "Fehlerpfad Hauptrelais HRL" UBYTE DEZ_DB_U 0 0 0.000000 255.000000 ECU_ADDRESS 0xDD30 BIT_MASK 0xFF /end MEASUREMENT
/begin MEASUREMENT fboSI11 "Fehlerpfad Injektor 1 Bank 1" UBYTE DEZ_DB_U 0 0 0.000000 255.000000 ECU_ADDRESS 0xDD37 BIT_MASK 0xFF /end MEASUREMENT
/begin MEASUREMENT fboSI12 "Fehlerpfad Injektor 1 Bank 2" UBYTE DEZ_DB_U 0 0 0.000000 255.000000 ECU_ADDRESS 0xDD3B BIT_MASK 0xFF /end MEASUREMENT
/begin MEASUREMENT fboSI21 "Fehlerpfad Injektor 2 Bank 1" UBYTE DEZ_DB_U 0 0 0.000000 255.000000 ECU_ADDRESS 0xDD38 BIT_MASK 0xFF /end MEASUREMENT
/begin MEASUREMENT fboSI22 "Fehlerpfad Injektor 2 Bank 2" UBYTE DEZ_DB_U 0 0 0.000000 255.000000 ECU_ADDRESS 0xDD3C BIT_MASK 0xFF /end MEASUREMENT
/begin MEASUREMENT fboSI31 "Fehlerpfad Injektor 3 Bank 1" UBYTE DEZ_DB_U 0 0 0.000000 255.000000 ECU_ADDRESS 0xDD39 BIT_MASK 0xFF /end MEASUREMENT
/begin MEASUREMENT fboSI32 "Fehlerpfad Injektor 3 Bank 2" UBYTE DEZ_DB_U 0 0 0.000000 255.000000 ECU_ADDRESS 0xDD3D BIT_MASK 0xFF /end MEASUREMENT
/begin MEASUREMENT fboSI41 "Fehlerpfad Injektor 4 Bank 1" UBYTE DEZ_DB_U 0 0 0.000000 255.000000 ECU_ADDRESS 0xDD3A BIT_MASK 0xFF /end MEASUREMENT
/begin MEASUREMENT fboSI42 "Fehlerpfad Injektor 4 Bank 2" UBYTE DEZ_DB_U 0 0 0.000000 255.000000 ECU_ADDRESS 0xDD3E BIT_MASK 0xFF /end MEASUREMENT
/begin MEASUREMENT fboSIDV "Fehlerpfad Stromregelung IDV" UBYTE DEZ_DB_U 0 0 0.000000 255.000000 ECU_ADDRESS 0xDD17 BIT_MASK 0xFF /end MEASUREMENT
/begin MEASUREMENT fboSIWZ "Fehlerpfad Inkrement_winkel_Zeitsystem IWZ" UBYTE DEZ_DB_U 0 0 0.000000 255.000000 ECU_ADDRESS 0xDD03 BIT_MASK 0xFF /end MEASUREMENT
/begin MEASUREMENT fboSK15 "Fehlerpfad Klemme 15" UBYTE DEZ_DB_U 0 0 0.000000 255.000000 ECU_ADDRESS 0xDD32 BIT_MASK 0xFF /end MEASUREMENT
/begin MEASUREMENT fboSKAT "Fehlerpfad Kat-Ueberwachung" UBYTE DEZ_DB_U 0 0 0.000000 255.000000 ECU_ADDRESS 0xDD2D BIT_MASK 0xFF /end MEASUREMENT
/begin MEASUREMENT fboSKDF "Fehlerpfad Kraftstoffdruckfuehler KDF" UBYTE DEZ_DB_U 0 0 0.000000 255.000000 ECU_ADDRESS 0xDD07 BIT_MASK 0xFF /end MEASUREMENT
/begin MEASUREMENT fboSKDP "Fehlerpfad Kraftstoffdruck-plausibilitaet" UBYTE DEZ_DB_U 0 0 0.000000 255.000000 ECU_ADDRESS 0xDD08 BIT_MASK 0xFF /end MEASUREMENT
/begin MEASUREMENT fboSKDR "Fehlerpfad Kraftstoffdruckregelventil" UBYTE DEZ_DB_U 0 0 0.000000 255.000000 ECU_ADDRESS 0xDD22 BIT_MASK 0xFF /end MEASUREMENT
/begin MEASUREMENT fboSKDS "Fehlerpfad Kraftstoffdruckueberwachung im Start" UBYTE DEZ_DB_U 0 0 0.000000 255.000000 ECU_ADDRESS 0xDD4F BIT_MASK 0xFF /end MEASUREMENT
/begin MEASUREMENT fboSKHP "Fehlerpfad Elementabschaltung" UBYTE DEZ_DB_U 0 0 0.000000 255.000000 ECU_ADDRESS 0xDD21 BIT_MASK 0xFF /end MEASUREMENT
/begin MEASUREMENT fboSKLI "Fehlerpfad Klimaausgang" UBYTE DEZ_DB_U 0 0 0.000000 255.000000 ECU_ADDRESS 0xDD23 BIT_MASK 0xFF /end MEASUREMENT
/begin MEASUREMENT fboSKTF "Fehlerpfad Kraftstofftemperaturfuehler KTF" UBYTE DEZ_DB_U 0 0 0.000000 255.000000 ECU_ADDRESS 0xDD0D BIT_MASK 0xFF /end MEASUREMENT
/begin MEASUREMENT fboSKUP "Fehlerpfad Kupplungsignal" UBYTE DEZ_DB_U 0 0 0.000000 255.000000 ECU_ADDRESS 0xDD2C BIT_MASK 0xFF /end MEASUREMENT
/begin MEASUREMENT fboSKW2 "Fehlerpfad KWH" UBYTE DEZ_DB_U 0 0 0.000000 255.000000 ECU_ADDRESS 0xDD47 BIT_MASK 0xFF /end MEASUREMENT
/begin MEASUREMENT fboSKWH "Fehlerpfad KWH Endstufe" UBYTE DEZ_DB_U 0 0 0.000000 255.000000 ECU_ADDRESS 0xDD48 BIT_MASK 0xFF /end MEASUREMENT
/begin MEASUREMENT fboSLDF "Fehlerpfad Ladedruckfuehler LDF" UBYTE DEZ_DB_U 0 0 0.000000 255.000000 ECU_ADDRESS 0xDD12 BIT_MASK 0xFF /end MEASUREMENT
/begin MEASUREMENT fboSLDS "Fehlerpfad Ladedruck- / Drosselklappensteller" UBYTE DEZ_DB_U 0 0 0.000000 255.000000 ECU_ADDRESS 0xDD1C BIT_MASK 0xFF /end MEASUREMENT
/begin MEASUREMENT fboSLDSX "Fehlerpfad Ladedruck- / Drosselklappensteller Ansaugtrakt 1 Extended LDS" UBYTE DEZ_DB_U 0 0 0.000000 255.000000 ECU_ADDRESS 0xDD49 BIT_MASK 0xFF /end MEASUREMENT
/begin MEASUREMENT fboSLMM "Fehlerpfad Luftmassenmesser LMM" UBYTE DEZ_DB_U 0 0 0.000000 255.000000 ECU_ADDRESS 0xDD14 BIT_MASK 0xFF /end MEASUREMENT
/begin MEASUREMENT fboSLRR "Fehlerpfad Laufruheregler" UBYTE DEZ_DB_U 0 0 0.000000 255.000000 ECU_ADDRESS 0xDD4D BIT_MASK 0xFF /end MEASUREMENT
/begin MEASUREMENT fboSLTF "Fehlerpfad Lufttemperaturfuehler LTF" UBYTE DEZ_DB_U 0 0 0.000000 255.000000 ECU_ADDRESS 0xDD0F BIT_MASK 0xFF /end MEASUREMENT
/begin MEASUREMENT fboSMLS "Fehlerpfad Motorlueftersteuerung MLS" UBYTE DEZ_DB_U 0 0 0.000000 255.000000 ECU_ADDRESS 0xDD1E BIT_MASK 0xFF /end MEASUREMENT
/begin MEASUREMENT fboSMML "Fehlerpfad Motorlager MML" UBYTE DEZ_DB_U 0 0 0.000000 255.000000 ECU_ADDRESS 0xDD1F BIT_MASK 0xFF /end MEASUREMENT
/begin MEASUREMENT fboSNLT "Fehlerpfad Abstellen ueber OFF oder Nullmenge beim NL Test" UBYTE DEZ_DB_U 0 0 0.000000 255.000000 ECU_ADDRESS 0xDD3F BIT_MASK 0xFF /end MEASUREMENT
/begin MEASUREMENT fboSNOX "Fehlerpfad HC-Einduesung" UBYTE DEZ_DB_U 0 0 0.000000 255.000000 ECU_ADDRESS 0xDD25 BIT_MASK 0xFF /end MEASUREMENT
/begin MEASUREMENT fboSODS "Fehlerpfad ODS Endstufe" UBYTE DEZ_DB_U 0 0 0.000000 255.000000 ECU_ADDRESS 0xDD45 BIT_MASK 0xFF /end MEASUREMENT
/begin MEASUREMENT fboSOTF "Fehlerpfad Motoroeltemperaturfuehler OTF" UBYTE DEZ_DB_U 0 0 0.000000 255.000000 ECU_ADDRESS 0xDD0E BIT_MASK 0xFF /end MEASUREMENT
/begin MEASUREMENT fboSPGS "Fehlerpfad Pedalwertgeber PGS" UBYTE DEZ_DB_U 0 0 0.000000 255.000000 ECU_ADDRESS 0xDD0A BIT_MASK 0xFF /end MEASUREMENT
/begin MEASUREMENT fboSPWG "Fehlerpfad Pedalwertgeber PWG" UBYTE DEZ_DB_U 0 0 0.000000 255.000000 ECU_ADDRESS 0xDD09 BIT_MASK 0xFF /end MEASUREMENT
/begin MEASUREMENT fboSRUC "Fehlerpfad Microcontroller uC" UBYTE DEZ_DB_U 0 0 0.000000 255.000000 ECU_ADDRESS 0xDD01 BIT_MASK 0xFF /end MEASUREMENT
/begin MEASUREMENT fboSSTB "Fehlerpfad Spannungs-Stabilisator" UBYTE DEZ_DB_U 0 0 0.000000 255.000000 ECU_ADDRESS 0xDD31 BIT_MASK 0xFF /end MEASUREMENT
/begin MEASUREMENT fboSTHS "Fehlerpfad gesteuerter Thermostat" UBYTE DEZ_DB_U 0 0 0.000000 255.000000 ECU_ADDRESS 0xDD27 BIT_MASK 0xFF /end MEASUREMENT
/begin MEASUREMENT fboSTNK2 "Fehlerpfad Abgastemperaturfuehler NachKAT2" UBYTE DEZ_DB_U 0 0 0.000000 255.000000 ECU_ADDRESS 0xDD42 BIT_MASK 0xFF /end MEASUREMENT
/begin MEASUREMENT fboSTST "Fehlerpfad ADC-Ueberwachung" UBYTE DEZ_DB_U 0 0 0.000000 255.000000 ECU_ADDRESS 0xDD0B BIT_MASK 0xFF /end MEASUREMENT
/begin MEASUREMENT fboSTVK2 "Fehlerpfad Abgastemperaturfuehler VorKAT2" UBYTE DEZ_DB_U 0 0 0.000000 255.000000 ECU_ADDRESS 0xDD41 BIT_MASK 0xFF /end MEASUREMENT
/begin MEASUREMENT fboST_UMG "Fehlerpfad Umgebungstemperatur" UBYTE DEZ_DB_U 0 0 0.000000 255.000000 ECU_ADDRESS 0xDD46 BIT_MASK 0xFF /end MEASUREMENT
/begin MEASUREMENT fboSUBT "Fehlerpfad Batteriespannung BATT" UBYTE DEZ_DB_U 0 0 0.000000 255.000000 ECU_ADDRESS 0xDD04 BIT_MASK 0xFF /end MEASUREMENT
/begin MEASUREMENT fboSUC1 "Fehlerpfad Kondensatorspannung UC1" UBYTE DEZ_DB_U 0 0 0.000000 255.000000 ECU_ADDRESS 0xDD05 BIT_MASK 0xFF /end MEASUREMENT
/begin MEASUREMENT fboSUC2 "Fehlerpfad Kondensatorspannung UC2" UBYTE DEZ_DB_U 0 0 0.000000 255.000000 ECU_ADDRESS 0xDD06 BIT_MASK 0xFF /end MEASUREMENT
/begin MEASUREMENT fboSUG1 "Fehlerpfad Geber-Speisung 1" UBYTE DEZ_DB_U 0 0 0.000000 255.000000 ECU_ADDRESS 0xDD18 BIT_MASK 0xFF /end MEASUREMENT
/begin MEASUREMENT fboSUG2 "Fehlerpfad Geber-Speisung 2" UBYTE DEZ_DB_U 0 0 0.000000 255.000000 ECU_ADDRESS 0xDD19 BIT_MASK 0xFF /end MEASUREMENT
/begin MEASUREMENT fboSVDF "Fehlerpfad Vorfoerderdruckfuehler VDF" UBYTE DEZ_DB_U 0 0 0.000000 255.000000 ECU_ADDRESS 0xDD15 BIT_MASK 0xFF /end MEASUREMENT
/begin MEASUREMENT fboSVDP "Fehlerpfad Vorfoerderdruck-Ueberwachung VDP" UBYTE DEZ_DB_U 0 0 0.000000 255.000000 ECU_ADDRESS 0xDD16 BIT_MASK 0xFF /end MEASUREMENT
/begin MEASUREMENT fboSWTF "Fehlerpfad Wassertemperaturfuehler WTF" UBYTE DEZ_DB_U 0 0 0.000000 255.000000 ECU_ADDRESS 0xDD0C BIT_MASK 0xFF /end MEASUREMENT
/begin MEASUREMENT fboSZHR "Fehlerpfad Zusatzheizung" UBYTE DEZ_DB_U 0 0 0.000000 255.000000 ECU_ADDRESS 0xDD26 BIT_MASK 0xFF /end MEASUREMENT
/begin MEASUREMENT fboS_00 "Defekte Pfade 1 bis 16" UWORD DEZ_DW_U 0 0 0.000000 65535.000000 ECU_ADDRESS 0xDD60 BIT_MASK 0xFFFF /end MEASUREMENT
/begin MEASUREMENT fboS_02 "Defekte Pfade 17 bis 32" UWORD DEZ_DW_U 0 0 0.000000 65535.000000 ECU_ADDRESS 0xDD62 BIT_MASK 0xFFFF /end MEASUREMENT
/begin MEASUREMENT fboS_04 "Defekte Pfade 33 bis 48" UWORD DEZ_DW_U 0 0 0.000000 65535.000000 ECU_ADDRESS 0xDD64 BIT_MASK 0xFFFF /end MEASUREMENT
/begin MEASUREMENT fboS_06 "Defekte Pfade 49 bis 64" UWORD DEZ_DW_U 0 0 0.000000 65535.000000 ECU_ADDRESS 0xDD66 BIT_MASK 0xFFFF /end MEASUREMENT
/begin MEASUREMENT fboS_08 "Defekte Pfade 65 bis 80" UWORD DEZ_DW_U 0 0 0.000000 65535.000000 ECU_ADDRESS 0xDD68 BIT_MASK 0xFFFF /end MEASUREMENT
/begin MEASUREMENT fboS_10 "Defekte Pfade 81 bis 96" UWORD DEZ_DW_U 0 0 0.000000 65535.000000 ECU_ADDRESS 0xDD6A BIT_MASK 0xFFFF /end MEASUREMENT
/begin MEASUREMENT fboS_ND "Anzahl defekter Pfade" UBYTE DEZ_DB_U 0 0 0.000000 255.000000 ECU_ADDRESS 0xDD6F BIT_MASK 0xFF /end MEASUREMENT
/begin MEASUREMENT fboS_NP "Anzahl definierter Pfade" UBYTE DEZ_DB_U 0 0 0.000000 255.000000 ECU_ADDRESS 0xDD6E BIT_MASK 0xFF /end MEASUREMENT
/begin MEASUREMENT fboTIK "Timercounter" UBYTE DEZ_DB_U 0 0 0.000000 255.000000 ECU_ADDRESS 0xDA12 BIT_MASK 0xFF /end MEASUREMENT
/begin MEASUREMENT fboTask "Aktiv Task" UBYTE DEZ_DB_U 0 0 0.000000 255.000000 ECU_ADDRESS 0xD9A4 BIT_MASK 0xFF /end MEASUREMENT
/begin MEASUREMENT fgmBESCH "Beschleunigung" SWORD B 0 0 -10.850690 10.765920 ECU_ADDRESS 0xC1A6 BIT_MASK 0xFFFF /end MEASUREMENT
/begin MEASUREMENT fgmDAT_NE "FGG Normexponent" SWORD FGG_NE 0 0 0.000000 7.000000 ECU_ADDRESS 0xC308 BIT_MASK 0xFFFF /end MEASUREMENT
/begin MEASUREMENT fgmDAT_SF "FGG Streckenfaktor" UWORD FGG_SF 0 0 0.670563 67.092080 ECU_ADDRESS 0xC306 BIT_MASK 0xFFFF /end MEASUREMENT
/begin MEASUREMENT fgmFGAKT "V aktuelle Geschwindigkeit" SWORD V 0 0 0.000000 327.670000 ECU_ADDRESS 0xC1A4 BIT_MASK 0xFFFF /end MEASUREMENT
/begin MEASUREMENT fgm_VzuN "V/N aktuelles Verhaeltnis Geschwindigkeit/Drehzahl" SWORD V_N 0 0 -1.280000 1.279961 ECU_ADDRESS 0xC1A8 BIT_MASK 0xFFFF /end MEASUREMENT
/begin MEASUREMENT fgoSTAT "FGG Statusbits" UWORD DEZ_DW_U 0 0 0.000000 65535.000000 ECU_ADDRESS 0xDC52 BIT_MASK 0xFFFF /end MEASUREMENT
/begin MEASUREMENT fgoVzuNfil "V/N gefiltertes Verhaeltnis v/n v:gefiltert n:gefiltert" SWORD V_N 0 0 -1.280000 1.279961 ECU_ADDRESS 0xDC00 BIT_MASK 0xFFFF /end MEASUREMENT
/begin MEASUREMENT gsmGAZ_C "Vorgluehlampe ueber CAN" UBYTE DEZ_DB_U 0 0 0.000000 255.000000 ECU_ADDRESS 0xC3B6 BIT_MASK 0xFF /end MEASUREMENT
/begin MEASUREMENT gsmGS_Pha "Gluehzeitsteuerung Gluehphase" UWORD DEZ_DW_U 0 0 0.000000 65535.000000 ECU_ADDRESS 0xC2CC BIT_MASK 0xFFFF /end MEASUREMENT
/begin MEASUREMENT gsmSndByte "GZS Sendebyte" UBYTE DEZ_DB_U 0 0 0.000000 255.000000 ECU_ADDRESS 0xC403 BIT_MASK 0xFF /end MEASUREMENT
/begin MEASUREMENT gsoEmByte "GZS empfangenes Byte" UWORD DEZ_DW_U 0 0 0.000000 65535.000000 ECU_ADDRESS 0xDC98 BIT_MASK 0xFFFF /end MEASUREMENT
/begin MEASUREMENT gsoGS_Pha "Gluehzeitsteuerung Gluehphase" UWORD DEZ_DW_U 0 0 0.000000 65535.000000 ECU_ADDRESS 0xDC9C BIT_MASK 0xFFFF /end MEASUREMENT
/begin MEASUREMENT gsoGS_SGlL "GZS gesendete Gluehleistung" UBYTE DEZ_DB_U 0 0 0.000000 255.000000 ECU_ADDRESS 0xDC9A BIT_MASK 0xFF /end MEASUREMENT
/begin MEASUREMENT gsoGS_TIME "Allgemeiner Gluehzeit fuer alle Gluehphase" UWORD ZEIT_ST 0 0 0.000000 655350000.000000 ECU_ADDRESS 0xD91E BIT_MASK 0xFFFF /end MEASUREMENT
/begin MEASUREMENT gsoGS_WTF "Gaenderte voerlauefig Wassertemperatur" SWORD T 0 0 -273.140000 3003.560000 ECU_ADDRESS 0xD8CC BIT_MASK 0xFFFF /end MEASUREMENT
/begin MEASUREMENT gsoGS_t_NG "Gluehzeitsteuerung Nachgluehzeit nach IPO2" UWORD ZEIT_KLKF 0 0 -327680000.000000 327670000.000000 ECU_ADDRESS 0xDB54 BIT_MASK 0xFFFF /end MEASUREMENT
/begin MEASUREMENT gsoGS_t_VG "Gluehzeitsteuerung Vorgluehzeit nach IPO3" UWORD ZEIT_KLKF 0 0 -327680000.000000 327670000.000000 ECU_ADDRESS 0xDB52 BIT_MASK 0xFFFF /end MEASUREMENT
/begin MEASUREMENT gsoPW_EmSt "GZS Empfangsstatus" UWORD DEZ_DW_U 0 0 0.000000 65535.000000 ECU_ADDRESS 0xDB4C BIT_MASK 0xFFFF /end MEASUREMENT
/begin MEASUREMENT gsoPW_GAZ "GZS Gluehanzeige" UWORD DEZ_DW_U 0 0 0.000000 65535.000000 ECU_ADDRESS 0xDB4A BIT_MASK 0xFFFF /end MEASUREMENT
/begin MEASUREMENT gsoPW_GlL "GZS Gluehleistung" SWORD PROZ 0 0 -327.680000 327.670000 ECU_ADDRESS 0xDB56 BIT_MASK 0xFFFF /end MEASUREMENT
/begin MEASUREMENT gsoPW_Pha "GZS Ueberwachungsphase des Gluehgeraetes" UWORD DEZ_DW_U 0 0 0.000000 65535.000000 ECU_ADDRESS 0xDB48 BIT_MASK 0xFFFF /end MEASUREMENT
/begin MEASUREMENT gsoPW_TkTi "GZS Tuerkontaktgluehzeit" UWORD ZEIT_ST 0 0 0.000000 655350000.000000 ECU_ADDRESS 0xDB4E BIT_MASK 0xFFFF /end MEASUREMENT
/begin MEASUREMENT khmN_LLKWH "Anhebung der Leerlaufdrehzahl bei aktiver KWH" SWORD N 0 0 0.000000 32767.000000 ECU_ADDRESS 0xC024 BIT_MASK 0xFFFF /end MEASUREMENT
/begin MEASUREMENT khmfKWHDia "KWH Kurzschlußfehler" UBYTE DEZ_DB_U 0 0 0.000000 255.000000 ECU_ADDRESS 0xC372 BIT_MASK 0xFF /end MEASUREMENT
/begin MEASUREMENT khoGENLAST "KWH - gefilterte Generatorbelastung" SWORD PROZ 0 0 -327.680000 327.670000 ECU_ADDRESS 0xD8E6 BIT_MASK 0xFFFF /end MEASUREMENT
/begin MEASUREMENT khoKHGLsol "KWH - Generatorbelastung Sollwert gefiltert" SWORD PROZ 0 0 -327.680000 327.670000 ECU_ADDRESS 0xD8E2 BIT_MASK 0xFFFF /end MEASUREMENT
/begin MEASUREMENT khoKHGLsor "KWH - Generatorbelastung Sollwert roh" SWORD PROZ 0 0 -327.680000 327.670000 ECU_ADDRESS 0xD8E4 BIT_MASK 0xFFFF /end MEASUREMENT
/begin MEASUREMENT khoNOR_AB "KWH - Zustandsanzeigen und Abschaltbedingungen" SWORD DEZ_DW 0 0 -32768.000000 32767.000000 ECU_ADDRESS 0xD8E8 BIT_MASK 0xFFFF /end MEASUREMENT
/begin MEASUREMENT khoRGIAnt "KWH - Generatorbelastung Regler I-Anteil" SWORD PROZ 0 0 -327.680000 327.670000 ECU_ADDRESS 0xD8DE BIT_MASK 0xFFFF /end MEASUREMENT
/begin MEASUREMENT khoRGPAnt "KWH - Generatorbelastung Regler P-Anteil" SWORD PROZ 0 0 -327.680000 327.670000 ECU_ADDRESS 0xD8E0 BIT_MASK 0xFFFF /end MEASUREMENT
/begin MEASUREMENT khoTWAUS_O "KWH - oberer Wassertemperaturschwellwert" SWORD T 0 0 -273.140000 3003.560000 ECU_ADDRESS 0xD8EA BIT_MASK 0xFFFF /end MEASUREMENT
/begin MEASUREMENT khoTWAUS_U "KWH - unterer Wassertemperaturschwellwert" SWORD T 0 0 -273.140000 3003.560000 ECU_ADDRESS 0xD8EC BIT_MASK 0xFFFF /end MEASUREMENT
/begin MEASUREMENT klmKLG_EEP "Detektion der Klimanlage 0x0C -> KLI detektiert und gespeichert" UBYTE DEZ_DB_U 0 0 0.000000 255.000000 ECU_ADDRESS 0xC3F3 BIT_MASK 0xFF /end MEASUREMENT
/begin MEASUREMENT klmKLI_gef "Info 'Klimakompressor gefunden'" UBYTE DEZ_DB_U 0 0 0.000000 255.000000 ECU_ADDRESS 0xC3F4 BIT_MASK 0xFF /end MEASUREMENT
/begin MEASUREMENT klmN_LLKLM "Anhebung der Leerlaufdrehzahl bei Klimakompressor ein" SWORD N 0 0 0.000000 32767.000000 ECU_ADDRESS 0xC1D6 BIT_MASK 0xFFFF /end MEASUREMENT
/begin MEASUREMENT kloKLM_OLD "Klimakompressor Abschaltbedingungen" UWORD DEZ_DW_U 0 0 0.000000 65535.000000 ECU_ADDRESS 0xDA62 BIT_MASK 0xFFFF /end MEASUREMENT
/begin MEASUREMENT kloKLM_SAB "Klimakompressorabschaltung Status" UWORD DEZ_DW_U 0 0 0.000000 65535.000000 ECU_ADDRESS 0xDA60 BIT_MASK 0xFFFF /end MEASUREMENT
/begin MEASUREMENT ldmADF "P_ADF aktueller Atmosphaerendruck (aus ADF oder LDF)" SWORD P 0 0 -32768.000000 32767.000000 ECU_ADDRESS 0xC222 BIT_MASK 0xFFFF /end MEASUREMENT
/begin MEASUREMENT ldmE "LDR Regelabweichung" SWORD P 0 0 -32768.000000 32767.000000 ECU_ADDRESS 0xC228 BIT_MASK 0xFFFF /end MEASUREMENT
/begin MEASUREMENT ldmFW_B "Fahrweise (0..oekologisch, 1..sportlich)" SBYTE DEZ_DB 0 0 -128.000000 127.000000 ECU_ADDRESS 0xC3FA BIT_MASK 0xFF /end MEASUREMENT
/begin MEASUREMENT ldmM_E "LDR Menge" UWORD MM3 0 0 -327.680000 327.670000 ECU_ADDRESS 0xC314 BIT_MASK 0xFFFF /end MEASUREMENT
/begin MEASUREMENT ldmP_Llin "P_L aktueller Ladedruck (gefiltert) / Luftdruck" SWORD P 0 0 -32768.000000 32767.000000 ECU_ADDRESS 0xC224 BIT_MASK 0xFFFF /end MEASUREMENT
/begin MEASUREMENT ldmP_Lsoll "Sollwert Ladedruck" SWORD P 0 0 -32768.000000 32767.000000 ECU_ADDRESS 0xC312 BIT_MASK 0xFFFF /end MEASUREMENT
/begin MEASUREMENT ldmT_LTGG "T_L Errechnete Lufttemperatur" SWORD T 0 0 -273.140000 3003.560000 ECU_ADDRESS 0xC226 BIT_MASK 0xFFFF /end MEASUREMENT
/begin MEASUREMENT ldoDRAMP1 "D-Verstärkung" SWORD FAKT 0 0 -3.276800 3.276700 ECU_ADDRESS 0xD912 BIT_MASK 0xFFFF /end MEASUREMENT
/begin MEASUREMENT ldoDRAMP2 "D-Verstärkung" SWORD FAKT 0 0 -3.276800 3.276700 ECU_ADDRESS 0xD8DA BIT_MASK 0xFFFF /end MEASUREMENT
/begin MEASUREMENT ldoE "LDR Regelabweichung" SWORD P 0 0 -32768.000000 32767.000000 ECU_ADDRESS 0xDC6A BIT_MASK 0xFFFF /end MEASUREMENT
/begin MEASUREMENT ldoFLDRAB1 "LDR Abschaltbits Teil 1 bei Fehlern" UWORD DEZ_DW_U 0 0 0.000000 65535.000000 ECU_ADDRESS 0xDC78 BIT_MASK 0xFFFF /end MEASUREMENT
/begin MEASUREMENT ldoFLDRAB2 "LDR Abschaltbits Teil 2 bei Fehlern" UWORD DEZ_DW_U 0 0 0.000000 65535.000000 ECU_ADDRESS 0xDC76 BIT_MASK 0xFFFF /end MEASUREMENT
/begin MEASUREMENT ldoFW "Fahrweise vor Filter" SWORD FAKT 0 0 -3.276800 3.276700 ECU_ADDRESS 0xDC74 BIT_MASK 0xFFFF /end MEASUREMENT
/begin MEASUREMENT ldoFWfi "Fahrweise nach Filter" SWORD FAKT 0 0 -3.276800 3.276700 ECU_ADDRESS 0xDC72 BIT_MASK 0xFFFF /end MEASUREMENT
/begin MEASUREMENT ldoGRmax "LDR obere Reglerbegrenzung" SWORD PROZ 0 0 -327.680000 327.670000 ECU_ADDRESS 0xDC64 BIT_MASK 0xFFFF /end MEASUREMENT
/begin MEASUREMENT ldoGRmin "LDR untere Reglerbegrenzung" SWORD PROZ 0 0 -327.680000 327.670000 ECU_ADDRESS 0xDC66 BIT_MASK 0xFFFF /end MEASUREMENT
/begin MEASUREMENT ldoLDB_DPN "P_L N-abhaeng. Offset zur P_ATM-Berechnung aus LDF" SWORD P 0 0 -32768.000000 32767.000000 ECU_ADDRESS 0xDC84 BIT_MASK 0xFFFF /end MEASUREMENT
/begin MEASUREMENT ldoLDF_d "dLDF ungefiltert pro hp-Durchlauf" SWORD dP_dZ 0 0 -1638400.000000 1638350.000000 ECU_ADDRESS 0xDA08 BIT_MASK 0xFFFF /end MEASUREMENT
/begin MEASUREMENT ldoM_Est "M_E LDR Mengeneingang Steuerung" SWORD MM3 0 0 -327.680000 327.670000 ECU_ADDRESS 0xDC5E BIT_MASK 0xFFFF /end MEASUREMENT
/begin MEASUREMENT ldoRGDAnt "LDR-D-Anteil" SWORD PROZ 0 0 -327.680000 327.670000 ECU_ADDRESS 0xDC7A BIT_MASK 0xFFFF /end MEASUREMENT
/begin MEASUREMENT ldoRGIAnt "TV_L I-Anteil des PI-Regler LDR" SWORD PROZ 0 0 -327.680000 327.670000 ECU_ADDRESS 0xDC7C BIT_MASK 0xFFFF /end MEASUREMENT
/begin MEASUREMENT ldoRGPAnt "TV_L P-Anteil des PI-Regler LDR" SWORD PROZ 0 0 -327.680000 327.670000 ECU_ADDRESS 0xDC7E BIT_MASK 0xFFFF /end MEASUREMENT
/begin MEASUREMENT ldoRGPITV "TV aus LD-PI-Regler (ohne D-Anteil)" SWORD PROZ 0 0 -327.680000 327.670000 ECU_ADDRESS 0xDC80 BIT_MASK 0xFFFF /end MEASUREMENT
/begin MEASUREMENT ldoRG_BER "M_E-/N-Bereiche zur LDR-Ueberwachung /-Abschaltung" SWORD DEZ_DW 0 0 -32768.000000 32767.000000 ECU_ADDRESS 0xDC82 BIT_MASK 0xFFFF /end MEASUREMENT
/begin MEASUREMENT ldoRG_TV "LDR TV Steueranteil + PIDT1-Regleranteil" SWORD PROZ 0 0 -327.680000 327.670000 ECU_ADDRESS 0xDC68 BIT_MASK 0xFFFF /end MEASUREMENT
/begin MEASUREMENT ldoRG_TVUB "LDR TV Steueranteil + PID vor Begrenzung" SWORD PROZ 0 0 -327.680000 327.670000 ECU_ADDRESS 0xDC62 BIT_MASK 0xFFFF /end MEASUREMENT
/begin MEASUREMENT ldoSWDYANT "P_L Sollwertanteil aus dynam. Vorsteuerung  LDR" SWORD P 0 0 -32768.000000 32767.000000 ECU_ADDRESS 0xDC88 BIT_MASK 0xFFFF /end MEASUREMENT
/begin MEASUREMENT ldoSWPA_K1 "P_L Korrekturwert 1 = f(P_ATM)  LDR" SWORD P 0 0 -32768.000000 32767.000000 ECU_ADDRESS 0xDC94 BIT_MASK 0xFFFF /end MEASUREMENT
/begin MEASUREMENT ldoSWPLBEG "P_L Ladedruck-Sollwert nach Minimum-Begrenzung LDR" SWORD P 0 0 -32768.000000 32767.000000 ECU_ADDRESS 0xDC8A BIT_MASK 0xFFFF /end MEASUREMENT
/begin MEASUREMENT ldoSWPLGKF "P_L Ladedruck-Sollwert aus Grundkennfeld LDR" SWORD P 0 0 -32768.000000 32767.000000 ECU_ADDRESS 0xDC96 BIT_MASK 0xFFFF /end MEASUREMENT
/begin MEASUREMENT ldoSWPLMAX "P_L Max. zulaessiger Ladedruck-Sollwert = f(N) LDR" SWORD P 0 0 -32768.000000 32767.000000 ECU_ADDRESS 0xDC8C BIT_MASK 0xFFFF /end MEASUREMENT
/begin MEASUREMENT ldoSWPL_K1 "P_L Relativdruck-Sollwert nach Korrektur 1  LDR" SWORD P 0 0 -32768.000000 32767.000000 ECU_ADDRESS 0xDC92 BIT_MASK 0xFFFF /end MEASUREMENT
/begin MEASUREMENT ldoSWPL_K2 "P_L Relativdruck-Sollwert nach Korrektur 2  LDR" SWORD P 0 0 -32768.000000 32767.000000 ECU_ADDRESS 0xDC8E BIT_MASK 0xFFFF /end MEASUREMENT
/begin MEASUREMENT ldoSWP_L "P_L Ladedruck-Sollwert  LDR" SWORD P 0 0 -32768.000000 32767.000000 ECU_ADDRESS 0xDC86 BIT_MASK 0xFFFF /end MEASUREMENT
/begin MEASUREMENT ldoSWTL_K2 "F_L Korrekturfaktor 2  = f(T_L)  LDR" SWORD FAKT 0 0 -3.276800 3.276700 ECU_ADDRESS 0xDC90 BIT_MASK 0xFFFF /end MEASUREMENT
/begin MEASUREMENT ldoTV1 "LDR TV Steuerung aus einem der 2 GrundKF" SWORD PROZ 0 0 -327.680000 327.670000 ECU_ADDRESS 0xDC70 BIT_MASK 0xFFFF /end MEASUREMENT
/begin MEASUREMENT ldoTV2 "LDR TV Steuerung nach ADF-Korrektur" SWORD PROZ 0 0 -327.680000 327.670000 ECU_ADDRESS 0xDC6E BIT_MASK 0xFFFF /end MEASUREMENT
/begin MEASUREMENT ldoTVsteu "LDR TV Steuerung (endgueltig)" SWORD PROZ 0 0 -327.680000 327.670000 ECU_ADDRESS 0xDC6C BIT_MASK 0xFFFF /end MEASUREMENT
/begin MEASUREMENT ldoVERB "aktueller Verbrauch" UWORD VB_MES 0 0 0.000000 713.772500 ECU_ADDRESS 0xDC5C BIT_MASK 0xFFFF /end MEASUREMENT
/begin MEASUREMENT mrmARDOFF "M_E Status Schubabschaltung" SWORD DEZ_DB_U 0 0 0.000000 255.000000 ECU_ADDRESS 0xC064 BIT_MASK 0xFFFF /end MEASUREMENT
/begin MEASUREMENT mrmASR_gef "ASR gefunden (0: kein ASR/1:ASR vorhanden)" UBYTE DEZ_DB_U 0 0 0.000000 255.000000 ECU_ADDRESS 0xC3BC BIT_MASK 0xFF /end MEASUREMENT
/begin MEASUREMENT mrmBEG_AGL "F_ME Abgleichfaktor fuer Begrenzungsmenge" SWORD FAKT 0 0 -3.276800 3.276700 ECU_ADDRESS 0xC1D2 BIT_MASK 0xFFFF /end MEASUREMENT
/begin MEASUREMENT mrmCASE_A "ARD Zustand-Bits der aktiven Ruckeldaempfung" SWORD DEZ_DW 0 0 -32768.000000 32767.000000 ECU_ADDRESS 0xC30E BIT_MASK 0xFFFF /end MEASUREMENT
/begin MEASUREMENT mrmCASE_L "LLR Zustand-Bits der Leerlaufregelung" SWORD DEZ_DW 0 0 -32768.000000 32767.000000 ECU_ADDRESS 0xC30C BIT_MASK 0xFFFF /end MEASUREMENT
/begin MEASUREMENT mrmDZG_HAU "Haeufigkeitszaehler Drehzahl" SBYTE DEZ_DB_U 0 0 0.000000 255.000000 ECU_ADDRESS 0xC3F8 BIT_MASK 0xFF /end MEASUREMENT
/begin MEASUREMENT mrmDZG_MAX "Maximaldrehzahl" SWORD N 0 0 0.000000 32767.000000 ECU_ADDRESS 0xC302 BIT_MASK 0xFFFF /end MEASUREMENT
/begin MEASUREMENT mrmEAB_SHU "EAB Zustand EAB-Test im Schub" UBYTE DEZ_DB_U 0 0 0.000000 255.000000 ECU_ADDRESS 0xC378 BIT_MASK 0xFF /end MEASUREMENT
/begin MEASUREMENT mrmFGR_EEP "Detektion des Fahrgeschwindigkeitsreglers, 0x09 -> FGR detektiert und gespeicher" UBYTE DEZ_DB_U 0 0 0.000000 255.000000 ECU_ADDRESS 0xC39C BIT_MASK 0xFF /end MEASUREMENT
/begin MEASUREMENT mrmFGR_SAT "FGR Status" UWORD DEZ_DB_U 0 0 0.000000 255.000000 ECU_ADDRESS 0xC1B0 BIT_MASK 0xFFFF /end MEASUREMENT
/begin MEASUREMENT mrmFG_SOLL "FGR V-Sollwert Regler" SWORD V 0 0 0.000000 327.670000 ECU_ADDRESS 0xC1AC BIT_MASK 0xFFFF /end MEASUREMENT
/begin MEASUREMENT mrmF_GANG "FGR aktuelle Gangstufe" UWORD DEZ_DW 0 0 -32768.000000 32767.000000 ECU_ADDRESS 0xC1AE BIT_MASK 0xFFFF /end MEASUREMENT
/begin MEASUREMENT mrmGANGfil "gefilterter Gang" SWORD DEZ_DW 0 0 -32768.000000 32767.000000 ECU_ADDRESS 0xC1FA BIT_MASK 0xFFFF /end MEASUREMENT
/begin MEASUREMENT mrmHCTWkor "HCD Gewichtungsfaktor HC = f(WTF)" UWORD FAKT 0 0 -3.276800 3.276700 ECU_ADDRESS 0xC208 BIT_MASK 0xFFFF /end MEASUREMENT
/begin MEASUREMENT mrmKM_akt "aktueller KM-Stand von Kombiinstrument" UWORD DIV10KM 0 0 0.000000 655350.000000 ECU_ADDRESS 0xC1C4 BIT_MASK 0xFFFF /end MEASUREMENT
/begin MEASUREMENT mrmKOM_ST1 "CAN Kombi-Instrument Status1" UBYTE DEZ_DB_U 0 0 0.000000 255.000000 ECU_ADDRESS 0xC39F BIT_MASK 0xFF /end MEASUREMENT
/begin MEASUREMENT mrmLFZ_RED "Abschaltbedingung fuer Laufzeitreduktion" UBYTE DEZ_DB 0 0 -128.000000 127.000000 ECU_ADDRESS 0xC3AA BIT_MASK 0xFF /end MEASUREMENT
/begin MEASUREMENT mrmLLIINIT "M_E Initialisierungswert LLR-Integrator = f(T_W)" SWORD MM3 0 0 -327.680000 327.670000 ECU_ADDRESS 0xC1E8 BIT_MASK 0xFFFF /end MEASUREMENT
/begin MEASUREMENT mrmLLRIAnt "M_E Menge aus I-Anteil des PI-Reglers" SWORD MM3 0 0 -327.680000 327.670000 ECU_ADDRESS 0xC1DC BIT_MASK 0xFFFF /end MEASUREMENT
/begin MEASUREMENT mrmLLRPAnt "M_E Menge aus P-Anteil des PI-Reglers" SWORD MM3 0 0 -327.680000 327.670000 ECU_ADDRESS 0xC1DA BIT_MASK 0xFFFF /end MEASUREMENT
/begin MEASUREMENT mrmLLR_AGL "N Abgleichwert fuer Leerlaufdrehzahlkorrektur" SWORD dN 0 0 -32768.000000 32767.000000 ECU_ADDRESS 0xC1D8 BIT_MASK 0xFFFF /end MEASUREMENT
/begin MEASUREMENT mrmLLR_PW "Ersatzdrehzahl" SWORD N 0 0 0.000000 32767.000000 ECU_ADDRESS 0xC1FC BIT_MASK 0xFFFF /end MEASUREMENT
/begin MEASUREMENT mrmLLR_PWD "PWG Plausibilisierung LL-Drehzahlerhoehung (j/n)" UBYTE DEZ_DB_U 0 0 0.000000 255.000000 ECU_ADDRESS 0xC3A5 BIT_MASK 0xFF /end MEASUREMENT
/begin MEASUREMENT mrmLL_ZIEL "LLR Solldrehzahl-Zieldrehzahl" SWORD N 0 0 0.000000 32767.000000 ECU_ADDRESS 0xC074 BIT_MASK 0xFFFF /end MEASUREMENT
/begin MEASUREMENT mrmL_FGR "FGR-Status-Indicator-Lampe ueber CAN" UBYTE DEZ_DB_U 0 0 0.000000 255.000000 ECU_ADDRESS 0xC39D BIT_MASK 0xFF /end MEASUREMENT
/begin MEASUREMENT mrmMDRFCS "Mengendriftkompensation Checksum" UBYTE DEZ_DB_U 0 0 0.000000 255.000000 ECU_ADDRESS 0xC3A7 BIT_MASK 0xFF /end MEASUREMENT
/begin MEASUREMENT mrmMEAGLCS "M_E Mengenabgleich-Checksum aus EEPROM" UBYTE DEZ_DB_U 0 0 0.000000 255.000000 ECU_ADDRESS 0xC3A6 BIT_MASK 0xFF /end MEASUREMENT
/begin MEASUREMENT mrmME_RA_B "Mengenrampe laeuft Wunschmengenbildung" UBYTE DEZ_DB_U 0 0 0.000000 255.000000 ECU_ADDRESS 0xC3A2 BIT_MASK 0xFF /end MEASUREMENT
/begin MEASUREMENT mrmMOT_WL "Warmlaufzustand des Motors" SBYTE DEZ_DB 0 0 -128.000000 127.000000 ECU_ADDRESS 0xC371 BIT_MASK 0xFF /end MEASUREMENT
/begin MEASUREMENT mrmMSR_AKT "Status MSR-Eingriff" UWORD DEZ_DW 0 0 -32768.000000 32767.000000 ECU_ADDRESS 0xC1C6 BIT_MASK 0xFFFF /end MEASUREMENT
/begin MEASUREMENT mrmM_DXMSR "M_E externer Momenteneingriff MSR" SWORD MM3 0 0 -327.680000 327.670000 ECU_ADDRESS 0xC1DE BIT_MASK 0xFFFF /end MEASUREMENT
/begin MEASUREMENT mrmM_EAKT "M_E Aktuelle Einspritzmenge (ohne ARD)" SWORD MM3 0 0 -327.680000 327.670000 ECU_ADDRESS 0xC1CE BIT_MASK 0xFFFF /end MEASUREMENT
/begin MEASUREMENT mrmM_EARD "M_E Menge - Gesamt vor Begrenzung ARD" SWORD MM3 0 0 -327.680000 327.670000 ECU_ADDRESS 0xC058 BIT_MASK 0xFFFF /end MEASUREMENT
/begin MEASUREMENT mrmM_EBEGR "M_E resultierende Begrenzungsmenge" SWORD MM3 0 0 -327.680000 327.670000 ECU_ADDRESS 0xC1D0 BIT_MASK 0xFFFF /end MEASUREMENT
/begin MEASUREMENT mrmM_EDELB "M_E begrenzte Abgleichmenge" SWORD M_E 0 0 -327.680000 327.670000 ECU_ADDRESS 0xC1EC BIT_MASK 0xFFFF /end MEASUREMENT
/begin MEASUREMENT mrmM_EDRF "Endgueltig Driftkompensation Menge" SWORD M_E 0 0 -327.680000 327.670000 ECU_ADDRESS 0xC1F0 BIT_MASK 0xFFFF /end MEASUREMENT
/begin MEASUREMENT mrmM_EFAHF "M_E Fahrmenge nach LRR und Schub" SWORD MM3 0 0 -327.680000 327.670000 ECU_ADDRESS 0xC0CE BIT_MASK 0xFFFF /end MEASUREMENT
/begin MEASUREMENT mrmM_EFAHR "M_E Fahrmenge nach LRR" SWORD MM3 0 0 -327.680000 327.670000 ECU_ADDRESS 0xC0CC BIT_MASK 0xFFFF /end MEASUREMENT
/begin MEASUREMENT mrmM_EFGR "M_E Wunschmenge aus FGR" SWORD MM3 0 0 -327.680000 327.670000 ECU_ADDRESS 0xC1BA BIT_MASK 0xFFFF /end MEASUREMENT
/begin MEASUREMENT mrmM_EHGB "HGB Ausgangsmenge" SWORD MM3 0 0 -327.680000 327.670000 ECU_ADDRESS 0xC1E0 BIT_MASK 0xFFFF /end MEASUREMENT
/begin MEASUREMENT mrmM_EKORR "M_E Fahrmenge korrigerte mit Vollast und Mengenabgleich" SWORD MM3 0 0 -327.680000 327.670000 ECU_ADDRESS 0xC1EE BIT_MASK 0xFFFF /end MEASUREMENT
/begin MEASUREMENT mrmM_ELFZ "Fahrmenge + Driftmenge" SWORD MM3 0 0 -327.680000 327.670000 ECU_ADDRESS 0xC1F6 BIT_MASK 0xFFFF /end MEASUREMENT
/begin MEASUREMENT mrmM_ELLBE "M_E begrenzte Leerlaufmenge" SWORD MM3 0 0 -327.680000 327.670000 ECU_ADDRESS 0xC05A BIT_MASK 0xFFFF /end MEASUREMENT
/begin MEASUREMENT mrmM_ELLR "M_E Menge aus LLR" SWORD MM3 0 0 -327.680000 327.670000 ECU_ADDRESS 0xC1CC BIT_MASK 0xFFFF /end MEASUREMENT
/begin MEASUREMENT mrmM_ELRR "M_E Menge aus LRR" SWORD MM3 0 0 -327.680000 327.670000 ECU_ADDRESS 0xC056 BIT_MASK 0xFFFF /end MEASUREMENT
/begin MEASUREMENT mrmM_EMOT "M_E Einspritzmenge nach ARD" SWORD MM3 0 0 -327.680000 327.670000 ECU_ADDRESS 0xC060 BIT_MASK 0xFFFF /end MEASUREMENT
/begin MEASUREMENT mrmM_EMTS "M_E Einspritzmenge nach ARD und Schub" SWORD MM3 0 0 -327.680000 327.670000 ECU_ADDRESS 0xC062 BIT_MASK 0xFFFF /end MEASUREMENT
/begin MEASUREMENT mrmM_EPWG "M_E Wunschmenge = f(PWG) aus Fahrverhaltenkennfeld" SWORD MM3 0 0 -327.680000 327.670000 ECU_ADDRESS 0xC1CA BIT_MASK 0xFFFF /end MEASUREMENT
/begin MEASUREMENT mrmM_EPWGR "PWG - Menge roh (ungefiltert)" SWORD MM3 0 0 -327.680000 327.670000 ECU_ADDRESS 0xC1C2 BIT_MASK 0xFFFF /end MEASUREMENT
/begin MEASUREMENT mrmM_ESTAR "M_E resultierender Startmengen-Sollwert" SWORD MM3 0 0 -327.680000 327.670000 ECU_ADDRESS 0xC30A BIT_MASK 0xFFFF /end MEASUREMENT
/begin MEASUREMENT mrmM_EWNmx "M_E max. aus Fahrerwuschme. PWG/FGR und ext. ME" SWORD MM3 0 0 -327.680000 327.670000 ECU_ADDRESS 0xC1B4 BIT_MASK 0xFFFF /end MEASUREMENT
/begin MEASUREMENT mrmM_EWUBE "M_E Differenz aus Begrenzungsmenge / Leerlaufmenge" SWORD MM3 0 0 -327.680000 327.670000 ECU_ADDRESS 0xC05E BIT_MASK 0xFFFF /end MEASUREMENT
/begin MEASUREMENT mrmM_EWUN "M_E Fahrerwunschmenge nach externem Mengeneingriff" SWORD MM3 0 0 -327.680000 327.670000 ECU_ADDRESS 0xC1B6 BIT_MASK 0xFFFF /end MEASUREMENT
/begin MEASUREMENT mrmM_EWUNF "M_E Fahrerwunschmenge aus PWG oder FGR" SWORD MM3 0 0 -327.680000 327.670000 ECU_ADDRESS 0xC1B2 BIT_MASK 0xFFFF /end MEASUREMENT
/begin MEASUREMENT mrmM_EWUNL "M_E Fahrerwunschmenge + Leerlaufmenge" SWORD MM3 0 0 -327.680000 327.670000 ECU_ADDRESS 0xC1BC BIT_MASK 0xFFFF /end MEASUREMENT
/begin MEASUREMENT mrmM_EWUNR "M_E Fahrerwunschmenge roh + Leerlaufmenge" SWORD MM3 0 0 -327.680000 327.670000 ECU_ADDRESS 0xC1BE BIT_MASK 0xFFFF /end MEASUREMENT
/begin MEASUREMENT mrmM_EWUSO "M_E Wunschmenge vor aktivem Ruckeldaempfer" SWORD MM3 0 0 -327.680000 327.670000 ECU_ADDRESS 0xC05C BIT_MASK 0xFFFF /end MEASUREMENT
/begin MEASUREMENT mrmM_EXASR "Externe ASR-Menge" SWORD MM3 0 0 -327.680000 327.670000 ECU_ADDRESS 0xC1F8 BIT_MASK 0xFFFF /end MEASUREMENT
/begin MEASUREMENT mrmN_LLBAS "N Leerlaufsolldrehzahl" SWORD N 0 0 0.000000 32767.000000 ECU_ADDRESS 0xC07A BIT_MASK 0xFFFF /end MEASUREMENT
/begin MEASUREMENT mrmN_LLBAT "LLR Solldrehzahl-Zieldrehzahl" SWORD N 0 0 0.000000 32767.000000 ECU_ADDRESS 0xC078 BIT_MASK 0xFFFF /end MEASUREMENT
/begin MEASUREMENT mrmN_LLDIA "N Leerlaufsolldrehzahl fuer Diagnose" SWORD N 0 0 0.000000 32767.000000 ECU_ADDRESS 0xC076 BIT_MASK 0xFFFF /end MEASUREMENT
/begin MEASUREMENT mrmPSRCV "Pseudorecovery-Request (j/n)" UWORD DEZ_DW_U 0 0 0.000000 65535.000000 ECU_ADDRESS 0xC0FE BIT_MASK 0xFFFF /end MEASUREMENT
/begin MEASUREMENT mrmPWG_roh "PWG ungefilterte Pedalwertger-Position" SWORD PROZ_S 0 0 -327.680000 327.670000 ECU_ADDRESS 0xC1C0 BIT_MASK 0xFFFF /end MEASUREMENT
/begin MEASUREMENT mrmPWGfi "PWG gefilterte Pedalwertgeber-Position" SWORD PROZ_S 0 0 -327.680000 327.670000 ECU_ADDRESS 0xC1C8 BIT_MASK 0xFFFF /end MEASUREMENT
/begin MEASUREMENT mrmSERVAGL "AGL Serviceabgleich" UWORD FAKT 0 0 -3.276800 3.276700 ECU_ADDRESS 0xC1E6 BIT_MASK 0xFFFF /end MEASUREMENT
/begin MEASUREMENT mrmSICH_F "Sicherheitsfallbit" SBYTE DEZ_DB 0 0 -128.000000 127.000000 ECU_ADDRESS 0xC3A4 BIT_MASK 0xFF /end MEASUREMENT
/begin MEASUREMENT mrmSTART_B "Startbit" SBYTE DEZ_DB 0 0 -128.000000 127.000000 ECU_ADDRESS 0xC34B BIT_MASK 0xFF /end MEASUREMENT
/begin MEASUREMENT mrmSTAStrt "Wiederstart ueber abgebrochenem Nachlauf" UWORD DEZ_DW_U 0 0 0.000000 65535.000000 ECU_ADDRESS 0xC100 BIT_MASK 0xFFFF /end MEASUREMENT
/begin MEASUREMENT mrmSTATUS "Status Motorbetriebsphase" UWORD DEZ_DW_U 0 0 0.000000 65535.000000 ECU_ADDRESS 0xC07C BIT_MASK 0xFFFF /end MEASUREMENT
/begin MEASUREMENT mrmSTA_AGL "M_E Abgleichwert fuer Startmengenkorrektur" SWORD MM3 0 0 -327.680000 327.670000 ECU_ADDRESS 0xC1E4 BIT_MASK 0xFFFF /end MEASUREMENT
/begin MEASUREMENT mrmSTNABW "Startabwurfdrehzahl" SWORD N 0 0 0.000000 32767.000000 ECU_ADDRESS 0xC1FE BIT_MASK 0xFFFF /end MEASUREMENT
/begin MEASUREMENT mrmST_ABWF "STA Zeit nach Startabwurf" UWORD ZEIT_ST_S 0 0 0.000000 655.350000 ECU_ADDRESS 0xC01E BIT_MASK 0xFFFF /end MEASUREMENT
/begin MEASUREMENT mrmSYSERR "Systemfehler status (TRUE oder FALSE)" UBYTE DEZ_DB_U 0 0 0.000000 255.000000 ECU_ADDRESS 0xC3A3 BIT_MASK 0xFF /end MEASUREMENT
/begin MEASUREMENT mrmTST_AUS "NL Abschaltmessage" UWORD DEZ_DW_U 0 0 0.000000 65535.000000 ECU_ADDRESS 0xC0FA BIT_MASK 0xFFFF /end MEASUREMENT
/begin MEASUREMENT mrmTST_VOR "Vorlaefiger Zustand aus Nachlauf von mrmTST_AUS" UWORD DEZ_DW_U 0 0 0.000000 65535.000000 ECU_ADDRESS 0xC0FC BIT_MASK 0xFFFF /end MEASUREMENT
/begin MEASUREMENT mrmVERBkFk "Korrekturfaktor Kraftstoffverbrauch" UWORD FAKT 0 0 -3.276800 3.276700 ECU_ADDRESS 0xC24C BIT_MASK 0xFFFF /end MEASUREMENT
/begin MEASUREMENT mrmV_SOLHN "HGB nachg. v-Soll" SWORD V 0 0 0.000000 327.670000 ECU_ADDRESS 0xC1E2 BIT_MASK 0xFFFF /end MEASUREMENT
/begin MEASUREMENT mrmWTF_HAU "Haeufigkeitszaehler Wassertemperatur" SBYTE DEZ_DB_U 0 0 0.000000 255.000000 ECU_ADDRESS 0xC3F9 BIT_MASK 0xFF /end MEASUREMENT
/begin MEASUREMENT mrmWTF_MAX "Maximalwassertemperatur" SWORD T 0 0 -273.140000 3003.560000 ECU_ADDRESS 0xC304 BIT_MASK 0xFFFF /end MEASUREMENT
/begin MEASUREMENT mrmdNdt20 "Drehzahlgradient mrwdNdt20 bezogen auf 20ms" SWORD dN_dZ_U 0 0 -1638400.000000 1638350.000000 ECU_ADDRESS 0xC1D4 BIT_MASK 0xFFFF /end MEASUREMENT
/begin MEASUREMENT mroABF_LAD "Abgefallener Ladeluftschlauch" UBYTE DEZ_DB_U 0 0 0.000000 255.000000 ECU_ADDRESS 0xDF1C BIT_MASK 0xFF /end MEASUREMENT
/begin MEASUREMENT mroAGL_FLG "M_E bitweise Anzeige Mengenabgleich-Flags" SWORD DEZ_DW_U 0 0 0.000000 65535.000000 ECU_ADDRESS 0xDA00 BIT_MASK 0xFFFF /end MEASUREMENT
/begin MEASUREMENT mroAKT_HGB "HGB Status (1:aktiv)" SWORD DEZ_DB_U 0 0 0.000000 255.000000 ECU_ADDRESS 0xDABC BIT_MASK 0xFFFF /end MEASUREMENT
/begin MEASUREMENT mroAKT_NL "Aktueller Zustand KL_15 fuer Nachlauf-Test" UWORD DEZ_DW_U 0 0 0.000000 65535.000000 ECU_ADDRESS 0xDAE6 BIT_MASK 0xFFFF /end MEASUREMENT
/begin MEASUREMENT mroAKT_SWN "HGB Status" SWORD DEZ_DB_U 0 0 0.000000 255.000000 ECU_ADDRESS 0xDABE BIT_MASK 0xFFFF /end MEASUREMENT
/begin MEASUREMENT mroAKT_TES "NL aktueller Abschalttest" UWORD DEZ_DW_U 0 0 0.000000 65535.000000 ECU_ADDRESS 0xDADA BIT_MASK 0xFFFF /end MEASUREMENT
/begin MEASUREMENT mroALIVE "ASC-Alive Zaehler" SWORD DEZ_DW 0 0 -32768.000000 32767.000000 ECU_ADDRESS 0xD990 BIT_MASK 0xFFFF /end MEASUREMENT
/begin MEASUREMENT mroALIVEX "Status der ASC-Alive Plausibilisierung" SWORD DEZ_DW 0 0 -32768.000000 32767.000000 ECU_ADDRESS 0xD98E BIT_MASK 0xFFFF /end MEASUREMENT
/begin MEASUREMENT mroALI_ASC "ASR Momentplausibilisierung bei MSR Eingriff" SWORD MOMENT_C 0 0 -65536.000000 65534.000000 ECU_ADDRESS 0xD98C BIT_MASK 0xFFFF /end MEASUREMENT
/begin MEASUREMENT mroALI_MSR "MSR Momentplausibilisierung bei ASR Eingriff" SWORD MOMENT_C 0 0 -65536.000000 65534.000000 ECU_ADDRESS 0xD98A BIT_MASK 0xFFFF /end MEASUREMENT
/begin MEASUREMENT mroASRSTAT "ASR - Status" UWORD DEZ_DW 0 0 -32768.000000 32767.000000 ECU_ADDRESS 0xDB1C BIT_MASK 0xFFFF /end MEASUREMENT
/begin MEASUREMENT mroBDBx_KL "M_E Begr.Menge aus gangabh. Drehmo.-KL normal oder ueberhoeht" UWORD MM3 0 0 -327.680000 327.670000 ECU_ADDRESS 0xD9A8 BIT_MASK 0xFFFF /end MEASUREMENT
/begin MEASUREMENT mroBF_EKOC "M_E Mengenreduktionsfaktor aus Kochschutz" UWORD FAKT 0 0 -3.276800 3.276700 ECU_ADDRESS 0xDAF2 BIT_MASK 0xFFFF /end MEASUREMENT
/begin MEASUREMENT mroBI_FAHR "Fahrmengenverbrauch" SWORD BI_ 0 0 -0.327680 0.327670 ECU_ADDRESS 0xDB34 BIT_MASK 0xFFFF /end MEASUREMENT
/begin MEASUREMENT mroBI_REIB "Reibmengenverbrauch" SWORD BI_ 0 0 -0.327680 0.327670 ECU_ADDRESS 0xDB32 BIT_MASK 0xFFFF /end MEASUREMENT
/begin MEASUREMENT mroBI_SOLL "Sollmengenverbrauch" SWORD BI_ 0 0 -0.327680 0.327670 ECU_ADDRESS 0xDB36 BIT_MASK 0xFFFF /end MEASUREMENT
/begin MEASUREMENT mroBM_EABG "M_E Begrenzungsmenge nach Mengenabgleich" UWORD MM3 0 0 -327.680000 327.670000 ECU_ADDRESS 0xD85A BIT_MASK 0xFFFF /end MEASUREMENT
/begin MEASUREMENT mroBM_EERH "M_E T_W-abhaengige Erhoehung der Begrenzungsmenge" UWORD MM3 0 0 -327.680000 327.670000 ECU_ADDRESS 0xDAF6 BIT_MASK 0xFFFF /end MEASUREMENT
/begin MEASUREMENT mroBM_EERS "M_E Begrenzungsmenge bei Systemfehler" UWORD MM3 0 0 -327.680000 327.670000 ECU_ADDRESS 0xDAEE BIT_MASK 0xFFFF /end MEASUREMENT
/begin MEASUREMENT mroBM_ELAD "M_E Vollastmenge aus Rauch + Lader" UWORD MM3 0 0 -327.680000 327.670000 ECU_ADDRESS 0xD99E BIT_MASK 0xFFFF /end MEASUREMENT
/begin MEASUREMENT mroBM_EMOM "M_E Begrenzungsmenge aus Drehmomentbegrenzung-KL" UWORD MM3 0 0 -327.680000 327.670000 ECU_ADDRESS 0xDAFC BIT_MASK 0xFFFF /end MEASUREMENT
/begin MEASUREMENT mroBM_ENBG "M_E Begrenzungsmenge aus Drehzahlbegrenzung-KL" UWORD MM3 0 0 -327.680000 327.670000 ECU_ADDRESS 0xDAFA BIT_MASK 0xFFFF /end MEASUREMENT
/begin MEASUREMENT mroBM_ENSU "M_E Begrenzungsmenge n. Mengenreduktion (Kochschutz)" SWORD MM3 0 0 -327.680000 327.670000 ECU_ADDRESS 0xDAF0 BIT_MASK 0xFFFF /end MEASUREMENT
/begin MEASUREMENT mroBM_EOV "M_E Begrenzungsmenge nach Overfueling" UWORD MM3 0 0 -327.680000 327.670000 ECU_ADDRESS 0xD858 BIT_MASK 0xFFFF /end MEASUREMENT
/begin MEASUREMENT mroBM_ERA0 "M_E Rauchmenge aus RAU-KF" UWORD MM3 0 0 -327.680000 327.670000 ECU_ADDRESS 0xD888 BIT_MASK 0xFFFF /end MEASUREMENT
/begin MEASUREMENT mroBM_ERA1 "M_E Rauchmenge nach erster Korrektur bezueglich ADF" UWORD MM3 0 0 -327.680000 327.670000 ECU_ADDRESS 0xD886 BIT_MASK 0xFFFF /end MEASUREMENT
/begin MEASUREMENT mroBM_ERA2 "M_E Rauchmenge nach Korrekturen bezueglich ADF und LTF" SWORD MM3 0 0 -327.680000 327.670000 ECU_ADDRESS 0xDF22 BIT_MASK 0xFFFF /end MEASUREMENT
/begin MEASUREMENT mroBM_ERAL "M_E Rauchmenge abgefallener Ladeluftschlauch" SWORD MM3 0 0 -327.680000 327.670000 ECU_ADDRESS 0xDF1A BIT_MASK 0xFFFF /end MEASUREMENT
/begin MEASUREMENT mroBM_ERAU "M_E Begrenzungsmenge aus Rauchbegrenzungs-Kennfeld" UWORD MM3 0 0 -327.680000 327.670000 ECU_ADDRESS 0xDB00 BIT_MASK 0xFFFF /end MEASUREMENT
/begin MEASUREMENT mroBM_ERAx "M_E Rauchmenge nach Korrekturen bzw. abgefallener Ladeluftschlauch   ! ***BC118 " UWORD MM3 0 0 -327.680000 327.670000 ECU_ADDRESS 0xD902 BIT_MASK 0xFFFF /end MEASUREMENT
/begin MEASUREMENT mroBM_ESER "M_E Begrenzungsmenge vor Mengenabgleich" UWORD MM3 0 0 -327.680000 327.670000 ECU_ADDRESS 0xDAF8 BIT_MASK 0xFFFF /end MEASUREMENT
/begin MEASUREMENT mroBM_ETUR "M_E Begrenzungsmenge aus Turboschubbegrenzung" UWORD MM3 0 0 -327.680000 327.670000 ECU_ADDRESS 0xDAFE BIT_MASK 0xFFFF /end MEASUREMENT
/begin MEASUREMENT mroBM_EVSU "M_E Begrenzungsmenge nach T_W-abh. Mengenerhoehung" UWORD MM3 0 0 -327.680000 327.670000 ECU_ADDRESS 0xDAF4 BIT_MASK 0xFFFF /end MEASUREMENT
/begin MEASUREMENT mroBM_EdPV "Vorfoerderdruck Ergebnis Mengenbegrenzungs-KF" SWORD MM3 0 0 -327.680000 327.670000 ECU_ADDRESS 0xD9AC BIT_MASK 0xFFFF /end MEASUREMENT
/begin MEASUREMENT mroBM_OVFL "M_E Erhoehungsmenge durch Overfueling" UWORD MM3 0 0 -327.680000 327.670000 ECU_ADDRESS 0xD85E BIT_MASK 0xFFFF /end MEASUREMENT
/begin MEASUREMENT mroBM_TL "Begrenzungsmenge bei leerem Tank" UWORD MM3 0 0 -327.680000 327.670000 ECU_ADDRESS 0xD872 BIT_MASK 0xFFFF /end MEASUREMENT
/begin MEASUREMENT mroBM_TLfr "Zustandsolda Tankleerbegrenzung" UBYTE DEZ_DB 0 0 -128.000000 127.000000 ECU_ADDRESS 0xD870 BIT_MASK 0xFF /end MEASUREMENT
/begin MEASUREMENT mroB_ASR "ASR-Kontrollbit (CAN)" UWORD DEZ_DW 0 0 -32768.000000 32767.000000 ECU_ADDRESS 0xDB10 BIT_MASK 0xFFFF /end MEASUREMENT
/begin MEASUREMENT mroB_MSR "MSR-Kontrollbit (CAN)" UWORD DEZ_DW 0 0 -32768.000000 32767.000000 ECU_ADDRESS 0xDB0E BIT_MASK 0xFFFF /end MEASUREMENT
/begin MEASUREMENT mroCASE_FF "ARD Zustand des ARD - FuehrungsFormers" SWORD DEZ_DW_U 0 0 0.000000 65535.000000 ECU_ADDRESS 0xDC08 BIT_MASK 0xFFFF /end MEASUREMENT
/begin MEASUREMENT mroCASE_R "dyn. RAU-KF 1, RAU-KF 2,3,4" UWORD DEZ_DW_U 0 0 0.000000 65535.000000 ECU_ADDRESS 0xD896 BIT_MASK 0xFFFF /end MEASUREMENT
/begin MEASUREMENT mroCASE_SR "ARD Zustand des ARD - Stoerreglers" SWORD DEZ_DW_U 0 0 0.000000 65535.000000 ECU_ADDRESS 0xDC0C BIT_MASK 0xFFFF /end MEASUREMENT
/begin MEASUREMENT mroDRFMI1 "Mengendriftkomp.MIN begr." SWORD M_E 0 0 -327.680000 327.670000 ECU_ADDRESS 0xD994 BIT_MASK 0xFFFF /end MEASUREMENT
/begin MEASUREMENT mroDRFMX1 "Mengendriftkomp.MAX begr." SWORD M_E 0 0 -327.680000 327.670000 ECU_ADDRESS 0xD992 BIT_MASK 0xFFFF /end MEASUREMENT
/begin MEASUREMENT mroDZG_SLZ "Schleppzeiger Drehzahl" SWORD N 0 0 0.000000 32767.000000 ECU_ADDRESS 0xD918 BIT_MASK 0xFFFF /end MEASUREMENT
/begin MEASUREMENT mroEABZSTD "EAB Zustand" UWORD DEZ_DW_U 0 0 0.000000 65535.000000 ECU_ADDRESS 0xDAD6 BIT_MASK 0xFFFF /end MEASUREMENT
/begin MEASUREMENT mroEGSSTAT "EGS - Status" UWORD DEZ_DW 0 0 -32768.000000 32767.000000 ECU_ADDRESS 0xDB30 BIT_MASK 0xFFFF /end MEASUREMENT
/begin MEASUREMENT mroEKPCANS "Zustaende bei EKP-Abschaltung ueber CAN" UWORD DEZ_DW_U 0 0 0.000000 65535.000000 ECU_ADDRESS 0xD99C BIT_MASK 0xFFFF /end MEASUREMENT
/begin MEASUREMENT mroFABZUST "Zustand Ablaufsteuerung" UWORD DEZ_DW_U 0 0 0.000000 65535.000000 ECU_ADDRESS 0xDA32 BIT_MASK 0xFFFF /end MEASUREMENT
/begin MEASUREMENT mroFBEDSIG "Bedienteilsignal zur Ablaufsteuerung" UWORD DEZ_DW_U 0 0 0.000000 65535.000000 ECU_ADDRESS 0xDA2C BIT_MASK 0xFFFF /end MEASUREMENT
/begin MEASUREMENT mroFBEGR1 "Mengenbegrenzung bei Fehlern (bits)" UWORD DEZ_DW_U 0 0 0.000000 65535.000000 ECU_ADDRESS 0xDAE2 BIT_MASK 0xFFFF /end MEASUREMENT
/begin MEASUREMENT mroFBEGR2 "Mengenbegrenzung bei Fehlern (bits)" UWORD DEZ_DW_U 0 0 0.000000 65535.000000 ECU_ADDRESS 0xDAE0 BIT_MASK 0xFFFF /end MEASUREMENT
/begin MEASUREMENT mroFBEZUST "Zustand Bedienteilsteuerung" UWORD DEZ_DW_U 0 0 0.000000 65535.000000 ECU_ADDRESS 0xDA34 BIT_MASK 0xFFFF /end MEASUREMENT
/begin MEASUREMENT mroFF_Sig "ARD Signalabhaengige parameter des ARD FuehrungsFormers" SWORD DEZ_DW_U 0 0 0.000000 65535.000000 ECU_ADDRESS 0xDC24 BIT_MASK 0xFFFF /end MEASUREMENT
/begin MEASUREMENT mroFGANG "Gang aus VzuN Gangerkennung" UWORD DEZ_DW_U 0 0 0.000000 65535.000000 ECU_ADDRESS 0xDA52 BIT_MASK 0xFFFF /end MEASUREMENT
/begin MEASUREMENT mroFGF_AKT "Gewichtungsfaktor fuer lin. Interpolation" SWORD FAKT 0 0 -3.276800 3.276700 ECU_ADDRESS 0xDB6C BIT_MASK 0xFFFF /end MEASUREMENT
/begin MEASUREMENT mroFGR_ABN "Abschalt/Einschaltbedingungen" UWORD DEZ_DW_U 0 0 0.000000 65535.000000 ECU_ADDRESS 0xDAB2 BIT_MASK 0xFFFF /end MEASUREMENT
/begin MEASUREMENT mroFGR_PWG "PWG, virtueller Wert aus FGR-Menge" SWORD PROZ_S 0 0 -327.680000 327.670000 ECU_ADDRESS 0xD9B2 BIT_MASK 0xFFFF /end MEASUREMENT
/begin MEASUREMENT mroFMI "Menge I-Regler" SWORD M_E 0 0 -327.680000 327.670000 ECU_ADDRESS 0xDA3E BIT_MASK 0xFFFF /end MEASUREMENT
/begin MEASUREMENT mroFMMERA "Mengenrampe Aus/Bremse" SWORD M_E 0 0 -327.680000 327.670000 ECU_ADDRESS 0xDA38 BIT_MASK 0xFFFF /end MEASUREMENT
/begin MEASUREMENT mroFMP "Menge P-Regler" SWORD M_E 0 0 -327.680000 327.670000 ECU_ADDRESS 0xDA40 BIT_MASK 0xFFFF /end MEASUREMENT
/begin MEASUREMENT mroFMPT1 "Menge PT1-Regler" SWORD M_E 0 0 -327.680000 327.670000 ECU_ADDRESS 0xDA3C BIT_MASK 0xFFFF /end MEASUREMENT
/begin MEASUREMENT mroFMREG "Gesamtmenge Regler." SWORD M_E 0 0 -327.680000 327.670000 ECU_ADDRESS 0xDA36 BIT_MASK 0xFFFF /end MEASUREMENT
/begin MEASUREMENT mroFMROFS "Menge Ueberg.Rampe" SWORD M_E 0 0 -327.680000 327.670000 ECU_ADDRESS 0xDA3A BIT_MASK 0xFFFF /end MEASUREMENT
/begin MEASUREMENT mroFMVOR "Menge Vorsteuerung" UWORD M_E 0 0 -327.680000 327.670000 ECU_ADDRESS 0xDA42 BIT_MASK 0xFFFF /end MEASUREMENT
/begin MEASUREMENT mroFPM_BED "PWG Plausibilisierung Bedingung fuer Zustandswechsel" UWORD DEZ_DW_U 0 0 0.000000 65535.000000 ECU_ADDRESS 0xD984 BIT_MASK 0xFFFF /end MEASUREMENT
/begin MEASUREMENT mroFPM_FEN "PWG aktuelles Plausibilitaets-Fenster" UWORD U 0 0 0.000000 160151.500000 ECU_ADDRESS 0xD972 BIT_MASK 0xFFFF /end MEASUREMENT
/begin MEASUREMENT mroFPM_ZAK "PWG Plausibilisierung Zustand aktuell" UWORD DEZ_DW_U 0 0 0.000000 65535.000000 ECU_ADDRESS 0xDAD0 BIT_MASK 0xFFFF /end MEASUREMENT
/begin MEASUREMENT mroFRGCOM "Reglerkommandos vor Regler" UWORD DEZ_DW_U 0 0 0.000000 65535.000000 ECU_ADDRESS 0xDA2A BIT_MASK 0xFFFF /end MEASUREMENT
/begin MEASUREMENT mroFRGCOM2 "Reglerkommandos nach Regler" UWORD DEZ_DW_U 0 0 0.000000 65535.000000 ECU_ADDRESS 0xDA28 BIT_MASK 0xFFFF /end MEASUREMENT
/begin MEASUREMENT mroFUETIM "Zeit zur Rampenueberhoehung ( S/B, WA )" UWORD ZEIT_ST 0 0 0.000000 655350000.000000 ECU_ADDRESS 0xDA50 BIT_MASK 0xFFFF /end MEASUREMENT
/begin MEASUREMENT mroFVDIFF "Regelabweichung P-Regler" SWORD V_DIFF 0 0 -327.680000 327.670000 ECU_ADDRESS 0xDA4E BIT_MASK 0xFFFF /end MEASUREMENT
/begin MEASUREMENT mroFVDIFFI "Regelabweichung I-Regler" SWORD V_DIFF 0 0 -327.680000 327.670000 ECU_ADDRESS 0xDA44 BIT_MASK 0xFFFF /end MEASUREMENT
/begin MEASUREMENT mroFVDIFFT "begrenzte Regelabweichung PT1" SWORD V_DIFF 0 0 -327.680000 327.670000 ECU_ADDRESS 0xDA46 BIT_MASK 0xFFFF /end MEASUREMENT
/begin MEASUREMENT mroFVSODIF "WA+: Differenz Rampenistwert zu Rampenende" SWORD V_DIFF 0 0 -327.680000 327.670000 ECU_ADDRESS 0xDA54 BIT_MASK 0xFFFF /end MEASUREMENT
/begin MEASUREMENT mroFVSOFKT "Faktor fuer Ueberhoehung Sollwertrampeninkrement" UWORD PROZ 0 0 -327.680000 327.670000 ECU_ADDRESS 0xD976 BIT_MASK 0xFFFF /end MEASUREMENT
/begin MEASUREMENT mroFVSOIN2 "Sollwertrampeninkrement nach Ueberhoehung" UWORD B_VINC 0 0 -17.778050 17.776960 ECU_ADDRESS 0xDA4A BIT_MASK 0xFFFF /end MEASUREMENT
/begin MEASUREMENT mroFVSOINC "Sollwertrampeninkrement" UWORD B_VINC 0 0 -17.778050 17.776960 ECU_ADDRESS 0xDA4C BIT_MASK 0xFFFF /end MEASUREMENT
/begin MEASUREMENT mroFVSOLL "Sollgeschwindigkeit FGR" UWORD V 0 0 0.000000 327.670000 ECU_ADDRESS 0xDA30 BIT_MASK 0xFFFF /end MEASUREMENT
/begin MEASUREMENT mroFVSOLLR "Sollgeschwindigkeit Regler" UWORD V 0 0 0.000000 327.670000 ECU_ADDRESS 0xDA2E BIT_MASK 0xFFFF /end MEASUREMENT
/begin MEASUREMENT mroFVSORA "Sollwertrampe" UWORD V 0 0 0.000000 327.670000 ECU_ADDRESS 0xDA48 BIT_MASK 0xFFFF /end MEASUREMENT
/begin MEASUREMENT mroGG "aktuelle Getriebegruppe" SBYTE DEZ_DB 0 0 -128.000000 127.000000 ECU_ADDRESS 0xDC12 BIT_MASK 0xFF /end MEASUREMENT
/begin MEASUREMENT mroHCDCNT_ "HC Einduesung Aus counter" SWORD DEZ_DW_U 0 0 0.000000 65535.000000 ECU_ADDRESS 0xD8CA BIT_MASK 0xFFFF /end MEASUREMENT
/begin MEASUREMENT mroHCTAbg_ "HCD HC Grundwert = f(n, ATF)" UWORD MM3pSek 0 0 -16383.500000 16383.500000 ECU_ADDRESS 0xDC2A BIT_MASK 0xFFFF /end MEASUREMENT
/begin MEASUREMENT mroHCinj_ "HCD HC:output of integrator" UWORD MM3 0 0 -327.680000 327.670000 ECU_ADDRESS 0xDB5E BIT_MASK 0xFFFF /end MEASUREMENT
/begin MEASUREMENT mroHCko "HCD HC Korrektur = f(n, M_EMOT)" UWORD MM3pSek 0 0 -16383.500000 16383.500000 ECU_ADDRESS 0xDC26 BIT_MASK 0xFFFF /end MEASUREMENT
/begin MEASUREMENT mroHCkor_ "HCD HC gewichtet, absolut" UWORD MM3pSek 0 0 -16383.500000 16383.500000 ECU_ADDRESS 0xDB62 BIT_MASK 0xFFFF /end MEASUREMENT
/begin MEASUREMENT mroHCroh_ "HCD HC ungewichtet" UWORD MM3pSek 0 0 -16383.500000 16383.500000 ECU_ADDRESS 0xDB64 BIT_MASK 0xFFFF /end MEASUREMENT
/begin MEASUREMENT mroHCstat_ "HCD HC :state variable" UWORD DEZ_DB_U 0 0 0.000000 255.000000 ECU_ADDRESS 0xDB60 BIT_MASK 0xFFFF /end MEASUREMENT
/begin MEASUREMENT mroHGB_RA "HGB Regelabweichung" SWORD V_DIFF 0 0 -327.680000 327.670000 ECU_ADDRESS 0xDAB4 BIT_MASK 0xFFFF /end MEASUREMENT
/begin MEASUREMENT mroHGI "HGB I-Anteil" SWORD MM3 0 0 -327.680000 327.670000 ECU_ADDRESS 0xDAB6 BIT_MASK 0xFFFF /end MEASUREMENT
/begin MEASUREMENT mroHGP "HGB P-Anteil" SWORD MM3 0 0 -327.680000 327.670000 ECU_ADDRESS 0xDAB8 BIT_MASK 0xFFFF /end MEASUREMENT
/begin MEASUREMENT mroKickDwn "Schalter Kickdown" UWORD DEZ_DW 0 0 -32768.000000 32767.000000 ECU_ADDRESS 0xD8C8 BIT_MASK 0xFFFF /end MEASUREMENT
/begin MEASUREMENT mroLLGngPN "LLR - Drehzahlanhebung bei P/N Stellung d. Automatik" UWORD N 0 0 0.000000 32767.000000 ECU_ADDRESS 0xD874 BIT_MASK 0xFFFF /end MEASUREMENT
/begin MEASUREMENT mroLLRDAnt "M_E Menge aus DT1-Vorsteuerung LLR" SWORD MM3 0 0 -327.680000 327.670000 ECU_ADDRESS 0xDADC BIT_MASK 0xFFFF /end MEASUREMENT
/begin MEASUREMENT mroLLRMAX "Leerlaufregler-Solldrehzahl" SWORD N 0 0 0.000000 32767.000000 ECU_ADDRESS 0xDB7A BIT_MASK 0xFFFF /end MEASUREMENT
/begin MEASUREMENT mroLLRNGng "LLR - Gangabhaengige Drehzahlanhebung" UWORD N 0 0 0.000000 32767.000000 ECU_ADDRESS 0xD876 BIT_MASK 0xFFFF /end MEASUREMENT
/begin MEASUREMENT mroLLRSNAB "Startabwurfdrehzahl fuer Maximalwertbildung" SWORD N 0 0 0.000000 32767.000000 ECU_ADDRESS 0xD882 BIT_MASK 0xFFFF /end MEASUREMENT
/begin MEASUREMENT mroLMK_STA "LMK Klimalastmomentkompensation - Status" UWORD DEZ_DW_U 0 0 0.000000 65535.000000 ECU_ADDRESS 0xDB0A BIT_MASK 0xFFFF /end MEASUREMENT
/begin MEASUREMENT mroLM_KK_N "Klimalastmoment mit verbesserte Aufloesung" UWORD DEZ_DW 0 0 -32768.000000 32767.000000 ECU_ADDRESS 0xD8CE BIT_MASK 0xFFFF /end MEASUREMENT
/begin MEASUREMENT mroLRPUF_0 "M_E Pufferelement 0 fuer Mengenanteil der HE der LRR" SWORD MM3 0 0 -327.680000 327.670000 ECU_ADDRESS 0xD92E BIT_MASK 0xFFFF /end MEASUREMENT
/begin MEASUREMENT mroLRPUF_1 "M_E Pufferelement 1 fuer Mengenanteil der HE der LRR" SWORD MM3 0 0 -327.680000 327.670000 ECU_ADDRESS 0xD92C BIT_MASK 0xFFFF /end MEASUREMENT
/begin MEASUREMENT mroLRPUF_2 "M_E Pufferelement 2 fuer Mengenanteil der HE der LRR" SWORD MM3 0 0 -327.680000 327.670000 ECU_ADDRESS 0xD92A BIT_MASK 0xFFFF /end MEASUREMENT
/begin MEASUREMENT mroLRPUF_3 "M_E Pufferelement 3 fuer Mengenanteil der HE der LRR" SWORD MM3 0 0 -327.680000 327.670000 ECU_ADDRESS 0xD928 BIT_MASK 0xFFFF /end MEASUREMENT
/begin MEASUREMENT mroLRPUF_4 "M_E Pufferelement 4 fuer Mengenanteil der HE der LRR" SWORD MM3 0 0 -327.680000 327.670000 ECU_ADDRESS 0xD926 BIT_MASK 0xFFFF /end MEASUREMENT
/begin MEASUREMENT mroLRPUF_5 "M_E Pufferelement 5 fuer Mengenanteil der HE der LRR" SWORD MM3 0 0 -327.680000 327.670000 ECU_ADDRESS 0xD924 BIT_MASK 0xFFFF /end MEASUREMENT
/begin MEASUREMENT mroLRR1NW "Nsegm LRR Segmentdrehzahl aus Bandpass fuer 1fach NW-Freq." SWORD DEZ_DW 0 0 -32768.000000 32767.000000 ECU_ADDRESS 0xDC1C BIT_MASK 0xFFFF /end MEASUREMENT
/begin MEASUREMENT mroLRR2NW "Nsegm LRR Segmentdrehzahl aus Bandpass fuer 2fach NW-Freq." SWORD DEZ_DW 0 0 -32768.000000 32767.000000 ECU_ADDRESS 0xDC1A BIT_MASK 0xFFFF /end MEASUREMENT
/begin MEASUREMENT mroLRR3NW "Nsegm LRR Segmentdrehzahl aus Bandpass fuer 3fach NW-Freq." SWORD DEZ_DW 0 0 -32768.000000 32767.000000 ECU_ADDRESS 0xDC18 BIT_MASK 0xFFFF /end MEASUREMENT
/begin MEASUREMENT mroLRR4NW "Nsegm LRR Segmentdrehzahl aus Bandpass fuer 4fach NW-Freq." SWORD DEZ_DW 0 0 -32768.000000 32767.000000 ECU_ADDRESS 0xDC16 BIT_MASK 0xFFFF /end MEASUREMENT
/begin MEASUREMENT mroLRRI1 "M_E I-Anteil des 1. LRR-PI-Reglers" SWORD MM3 0 0 -327.680000 327.670000 ECU_ADDRESS 0xD89C BIT_MASK 0xFFFF /end MEASUREMENT
/begin MEASUREMENT mroLRRI2 "M_E I-Anteil des 2. LRR-PI-Reglers" SWORD MM3 0 0 -327.680000 327.670000 ECU_ADDRESS 0xD89E BIT_MASK 0xFFFF /end MEASUREMENT
/begin MEASUREMENT mroLRRI3 "M_E I-Anteil des 3. LRR-PI-Reglers" SWORD MM3 0 0 -327.680000 327.670000 ECU_ADDRESS 0xD8A0 BIT_MASK 0xFFFF /end MEASUREMENT
/begin MEASUREMENT mroLRRI4 "M_E I-Anteil des 4. LRR-PI-Reglers" SWORD MM3 0 0 -327.680000 327.670000 ECU_ADDRESS 0xD8A2 BIT_MASK 0xFFFF /end MEASUREMENT
/begin MEASUREMENT mroLRRI5 "M_E I-Anteil des 5. LRR-PI-Reglers" SWORD MM3 0 0 -327.680000 327.670000 ECU_ADDRESS 0xD8A4 BIT_MASK 0xFFFF /end MEASUREMENT
/begin MEASUREMENT mroLRRI6 "M_E I-Anteil des 6. LRR-PI-Reglers" SWORD MM3 0 0 -327.680000 327.670000 ECU_ADDRESS 0xD8A6 BIT_MASK 0xFFFF /end MEASUREMENT
/begin MEASUREMENT mroLRROFFS "LRR" SWORD DEZ_DW 0 0 -32768.000000 32767.000000 ECU_ADDRESS 0xDC06 BIT_MASK 0xFFFF /end MEASUREMENT
/begin MEASUREMENT mroLRRReg "Nsegm Segmentdrehzahl-Regelabweichung fuer LRR" SWORD dN 0 0 -32768.000000 32767.000000 ECU_ADDRESS 0xDAD8 BIT_MASK 0xFFFF /end MEASUREMENT
/begin MEASUREMENT mroLRRZust "LRR" SWORD DEZ_DW 0 0 -32768.000000 32767.000000 ECU_ADDRESS 0xDC04 BIT_MASK 0xFFFF /end MEASUREMENT
/begin MEASUREMENT mroLRR_BGR "Begrenzungsmenge fuer LRR-Eingriff" SWORD M_E 0 0 -327.680000 327.670000 ECU_ADDRESS 0xD850 BIT_MASK 0xFFFF /end MEASUREMENT
/begin MEASUREMENT mroLRR_MAX "Maximum f. n-Ungleichf.erkennung" SWORD M_E 0 0 -327.680000 327.670000 ECU_ADDRESS 0xDC60 BIT_MASK 0xFFFF /end MEASUREMENT
/begin MEASUREMENT mroLRR_MIN "Minimum f. n-Ungleichf.erkennung" SWORD M_E 0 0 -327.680000 327.670000 ECU_ADDRESS 0xDC38 BIT_MASK 0xFFFF /end MEASUREMENT
/begin MEASUREMENT mroLRR_dHE "M_E Aktueller Mengenanteil LRR fuer HE" SWORD MM3 0 0 -327.680000 327.670000 ECU_ADDRESS 0xD8AE BIT_MASK 0xFFFF /end MEASUREMENT
/begin MEASUREMENT mroLTZ_ERG "Ergebnis des letzten durchgefuehrten Tests im NL" UWORD DEZ_DW_U 0 0 0.000000 65535.000000 ECU_ADDRESS 0xDAC4 BIT_MASK 0xFFFF /end MEASUREMENT
/begin MEASUREMENT mroLTZ_TES "letzter durchgefuehrter Test im NL" UWORD DEZ_DW_U 0 0 0.000000 65535.000000 ECU_ADDRESS 0xDAC6 BIT_MASK 0xFFFF /end MEASUREMENT
/begin MEASUREMENT mroMD_ASR "Momenteingriff ASR" SWORD MOMENT_C 0 0 -65536.000000 65534.000000 ECU_ADDRESS 0xDB20 BIT_MASK 0xFFFF /end MEASUREMENT
/begin MEASUREMENT mroMD_EGS "Momenteingriff EGS" SWORD MOMENT_C 0 0 -65536.000000 65534.000000 ECU_ADDRESS 0xDB24 BIT_MASK 0xFFFF /end MEASUREMENT
/begin MEASUREMENT mroMD_FAHR "Fahrerwunschmoment" SWORD MOMENT_C 0 0 -65536.000000 65534.000000 ECU_ADDRESS 0xDB28 BIT_MASK 0xFFFF /end MEASUREMENT
/begin MEASUREMENT mroMD_KK "LMK Nachgebildetes Klimalastmoment" SWORD MOMENT_16 0 0 0.000000 510.000000 ECU_ADDRESS 0xDA5A BIT_MASK 0xFFFF /end MEASUREMENT
/begin MEASUREMENT mroMD_MSR "Momenteingriff MSR" SWORD MOMENT_C 0 0 -65536.000000 65534.000000 ECU_ADDRESS 0xDB1E BIT_MASK 0xFFFF /end MEASUREMENT
/begin MEASUREMENT mroMD_REIB "Reibmoment" SWORD MOMENT_C 0 0 -65536.000000 65534.000000 ECU_ADDRESS 0xDB26 BIT_MASK 0xFFFF /end MEASUREMENT
/begin MEASUREMENT mroMD_SOLL "Sollmoment" SWORD MOMENT_C 0 0 -65536.000000 65534.000000 ECU_ADDRESS 0xDB2A BIT_MASK 0xFFFF /end MEASUREMENT
/begin MEASUREMENT mroMD_TXU "Drehmomentsignal vom elektronisch gesteuerten Zwischengetriebe" SWORD MOMENT_C 0 0 -65536.000000 65534.000000 ECU_ADDRESS 0xDCE8 BIT_MASK 0xFFFF /end MEASUREMENT
/begin MEASUREMENT mroMD_WMOM "Moment nach Drehmomentbegrenzung" SWORD MOMENT_C 0 0 -65536.000000 65534.000000 ECU_ADDRESS 0xDF00 BIT_MASK 0xFFFF /end MEASUREMENT
/begin MEASUREMENT mroME_KFVB "Kraftstoffverbr.KF-Eingang & inv. FVHKF (Menge)" SWORD MM3 0 0 -327.680000 327.670000 ECU_ADDRESS 0xDB0C BIT_MASK 0xFFFF /end MEASUREMENT
/begin MEASUREMENT mroMSRSTAT "MSR - Status" UWORD DEZ_DW 0 0 -32768.000000 32767.000000 ECU_ADDRESS 0xDB1A BIT_MASK 0xFFFF /end MEASUREMENT
/begin MEASUREMENT mroM_ARDFF "M_E Menge ARD - Fuehrungsformer" SWORD MM3 0 0 -327.680000 327.670000 ECU_ADDRESS 0xDC0E BIT_MASK 0xFFFF /end MEASUREMENT
/begin MEASUREMENT mroM_ARDSR "M_E Menge ARD - Stoerregler" SWORD MM3 0 0 -327.680000 327.670000 ECU_ADDRESS 0xDC0A BIT_MASK 0xFFFF /end MEASUREMENT
/begin MEASUREMENT mroM_EAKTf "Aktuelle Menge vor Startumschalter" SWORD MM3 0 0 -327.680000 327.670000 ECU_ADDRESS 0xDC22 BIT_MASK 0xFFFF /end MEASUREMENT
/begin MEASUREMENT mroM_EASR "Eingriffsmenge des ASR" SWORD MM3 0 0 -327.680000 327.670000 ECU_ADDRESS 0xDB14 BIT_MASK 0xFFFF /end MEASUREMENT
/begin MEASUREMENT mroM_EDELT "M_E Abgleichmenge (aus KF ) vor Begrenzung" SWORD M_E 0 0 -327.680000 327.670000 ECU_ADDRESS 0xDA02 BIT_MASK 0xFFFF /end MEASUREMENT
/begin MEASUREMENT mroM_EDRFB "Driftkomp. Begrenzung ueber EEPROM" SWORD M_E 0 0 -327.680000 327.670000 ECU_ADDRESS 0xD998 BIT_MASK 0xFFFF /end MEASUREMENT
/begin MEASUREMENT mroM_EDRFD "Driftkomp. Begrenzung ueber Datensatz" SWORD M_E 0 0 -327.680000 327.670000 ECU_ADDRESS 0xD996 BIT_MASK 0xFFFF /end MEASUREMENT
/begin MEASUREMENT mroM_EDRFO "Driftkomp. Menge (aus KF) vor Begrenzung" SWORD M_E 0 0 -327.680000 327.670000 ECU_ADDRESS 0xD99A BIT_MASK 0xFFFF /end MEASUREMENT
/begin MEASUREMENT mroM_EEGS "Ersatzmenge fuer Botschaftsausfall des EGS" SWORD MM3 0 0 -327.680000 327.670000 ECU_ADDRESS 0xDB2E BIT_MASK 0xFFFF /end MEASUREMENT
/begin MEASUREMENT mroM_EFAHR "Fahrer Wunschmenge (mit Max-Auswahl mit begrenzter LLR-Menge)" UWORD MM3 0 0 -327.680000 327.670000 ECU_ADDRESS 0xDA06 BIT_MASK 0xFFFF /end MEASUREMENT
/begin MEASUREMENT mroM_EFAHf "Fahrmenge vor Startumschalter" SWORD MM3 0 0 -327.680000 327.670000 ECU_ADDRESS 0xDC1E BIT_MASK 0xFFFF /end MEASUREMENT
/begin MEASUREMENT mroM_EFAMA "M_E Fahrmenge korrigiert m. Vollast und M_E Abgleich" SWORD M_E 0 0 -327.680000 327.670000 ECU_ADDRESS 0xD9B6 BIT_MASK 0xFFFF /end MEASUREMENT
/begin MEASUREMENT mroM_EFAVA "M_E Fahrmenge korrigiert m. Vollastabgleich" SWORD M_E 0 0 -327.680000 327.670000 ECU_ADDRESS 0xD9B8 BIT_MASK 0xFFFF /end MEASUREMENT
/begin MEASUREMENT mroM_EFVO "M_E = f(N, PWGfi), obere Nenngeschwindigkeit" SWORD MM3 0 0 -327.680000 327.670000 ECU_ADDRESS 0xDB70 BIT_MASK 0xFFFF /end MEASUREMENT
/begin MEASUREMENT mroM_EFVOR "M_E = f(N, PWG_roh), obere Nenngeschwindigkeit" SWORD MM3 0 0 -327.680000 327.670000 ECU_ADDRESS 0xDB6A BIT_MASK 0xFFFF /end MEASUREMENT
/begin MEASUREMENT mroM_EFVU "M_E = f(N, PWGfi), untere Nenngeschwindigkeit" SWORD MM3 0 0 -327.680000 327.670000 ECU_ADDRESS 0xDB6E BIT_MASK 0xFFFF /end MEASUREMENT
/begin MEASUREMENT mroM_EFVUR "M_E = f(N, PWG_roh), untere Nenngeschwindigkeit" SWORD MM3 0 0 -327.680000 327.670000 ECU_ADDRESS 0xDB68 BIT_MASK 0xFFFF /end MEASUREMENT
/begin MEASUREMENT mroM_ELDNB "M_E Ladeschutz-Vollastmenge f(N,P_ADF)" UWORD MM3 0 0 -327.680000 327.670000 ECU_ADDRESS 0xD9A0 BIT_MASK 0xFFFF /end MEASUREMENT
/begin MEASUREMENT mroM_ELMK "LMK Klimalastmomentkompensation - Fahrerwunsch-Aufschaltmenge" SWORD MM3 0 0 -327.680000 327.670000 ECU_ADDRESS 0xDB08 BIT_MASK 0xFFFF /end MEASUREMENT
/begin MEASUREMENT mroM_ELMKB "LMK Klimalastmomentkompensation - Fahrerwunsch-Aufschaltmenge (begrenzt)" SWORD MM3 0 0 -327.680000 327.670000 ECU_ADDRESS 0xDC56 BIT_MASK 0xFFFF /end MEASUREMENT
/begin MEASUREMENT mroM_EMOTf "Motormenge vor Startumschalter" SWORD MM3 0 0 -327.680000 327.670000 ECU_ADDRESS 0xDC20 BIT_MASK 0xFFFF /end MEASUREMENT
/begin MEASUREMENT mroM_EMSR "Eingriffsmenge des MSR" SWORD MM3 0 0 -327.680000 327.670000 ECU_ADDRESS 0xDB12 BIT_MASK 0xFFFF /end MEASUREMENT
/begin MEASUREMENT mroM_ERBK "Reibmenge nach Klimalastmomentkompensation" SWORD MM3 0 0 -327.680000 327.670000 ECU_ADDRESS 0xDB02 BIT_MASK 0xFFFF /end MEASUREMENT
/begin MEASUREMENT mroM_ERBLM "LMK Klimalastmomentkompensation - Reib-Aufschaltmenge" SWORD MM3 0 0 -327.680000 327.670000 ECU_ADDRESS 0xDB06 BIT_MASK 0xFFFF /end MEASUREMENT
/begin MEASUREMENT mroM_EREIB "Reibmenge aus Reibmengenkennfeld" SWORD MM3 0 0 -327.680000 327.670000 ECU_ADDRESS 0xDB22 BIT_MASK 0xFFFF /end MEASUREMENT
/begin MEASUREMENT mroM_ESAB "M_E Startkorrekturmenge aus Startmengen-Abgleich" UWORD MM3 0 0 -327.680000 327.670000 ECU_ADDRESS 0xDAC8 BIT_MASK 0xFFFF /end MEASUREMENT
/begin MEASUREMENT mroM_ESERV "Serviceabgleichfaktor" SWORD FAKT 0 0 -3.276800 3.276700 ECU_ADDRESS 0xD8D0 BIT_MASK 0xFFFF /end MEASUREMENT
/begin MEASUREMENT mroM_ESTAG "M_E Startmenge nach Startmengen-Abgleich" UWORD MM3 0 0 -327.680000 327.670000 ECU_ADDRESS 0xDAEA BIT_MASK 0xFFFF /end MEASUREMENT
/begin MEASUREMENT mroM_ESTER "M_E Startmenge nach zeitabh. Startmengenerhoehung" UWORD MM3 0 0 -327.680000 327.670000 ECU_ADDRESS 0xDAE8 BIT_MASK 0xFFFF /end MEASUREMENT
/begin MEASUREMENT mroM_ESTIP "M_E T_W-abhaengige Startmenge aus Kennfeld" UWORD MM3 0 0 -327.680000 327.670000 ECU_ADDRESS 0xDAEC BIT_MASK 0xFFFF /end MEASUREMENT
/begin MEASUREMENT mroM_ETXU "Ersatzmenge bei TXU Botschaftsausfall" SWORD MM3 0 0 -327.680000 327.670000 ECU_ADDRESS 0xDEDE BIT_MASK 0xFFFF /end MEASUREMENT
/begin MEASUREMENT mroM_EWUNG "M_E Begrenzung auf KTF zul. Menge" SWORD MM3 0 0 -327.680000 327.670000 ECU_ADDRESS 0xDB46 BIT_MASK 0xFFFF /end MEASUREMENT
/begin MEASUREMENT mroM_EWUNV "Vorfoerderdruck Ergebnis nach Mengeneingriff" SWORD MM3 0 0 -327.680000 327.670000 ECU_ADDRESS 0xD9AA BIT_MASK 0xFFFF /end MEASUREMENT
/begin MEASUREMENT mroM_EWUNX "M_E Maximun von PWG- und FGR-Menge" SWORD MM3 0 0 -327.680000 327.670000 ECU_ADDRESS 0xDB04 BIT_MASK 0xFFFF /end MEASUREMENT
/begin MEASUREMENT mroM_EXASR "Ersatzmenge fuer Botschaftsausfall des ASR" SWORD MM3 0 0 -327.680000 327.670000 ECU_ADDRESS 0xDB18 BIT_MASK 0xFFFF /end MEASUREMENT
/begin MEASUREMENT mroM_EXGS "Externer Mengeneingriff EGS" SWORD MM3 0 0 -327.680000 327.670000 ECU_ADDRESS 0xDB2C BIT_MASK 0xFFFF /end MEASUREMENT
/begin MEASUREMENT mroM_EXMSR "Ersatzmenge fuer Botschaftsausfall des MSR" SWORD MM3 0 0 -327.680000 327.670000 ECU_ADDRESS 0xDB16 BIT_MASK 0xFFFF /end MEASUREMENT
/begin MEASUREMENT mroM_EXTXU "externer Mengeneingriff" SWORD MM3 0 0 -327.680000 327.670000 ECU_ADDRESS 0xDF06 BIT_MASK 0xFFFF /end MEASUREMENT
/begin MEASUREMENT mroNLT_min "Maximum der Nachlaufzeiten" UWORD ZEIT_ST 0 0 0.000000 655350000.000000 ECU_ADDRESS 0xDF26 BIT_MASK 0xFFFF /end MEASUREMENT
/begin MEASUREMENT mroNL_OFF "Abschaltursache bei Ueberwachung" UWORD DEZ_DW_U 0 0 0.000000 65535.000000 ECU_ADDRESS 0xDAC0 BIT_MASK 0xFFFF /end MEASUREMENT
/begin MEASUREMENT mroN_Kl15 "N gespeicherte Drehzahl zum Zeitpunkt Kl_15 = 0" SWORD N 0 0 0.000000 32767.000000 ECU_ADDRESS 0xDAE4 BIT_MASK 0xFFFF /end MEASUREMENT
/begin MEASUREMENT mroNalt "Drehzahl_alt" SWORD N 0 0 0.000000 32767.000000 ECU_ADDRESS 0xD852 BIT_MASK 0xFFFF /end MEASUREMENT
/begin MEASUREMENT mroODSStat "Status ODS Behandlung" UWORD DEZ_DW_U 0 0 0.000000 65535.000000 ECU_ADDRESS 0xD884 BIT_MASK 0xFFFF /end MEASUREMENT
/begin MEASUREMENT mroOVFL_ST "Status der Overfuelingbedingungen" UBYTE DEZ_DB_U 0 0 0.000000 255.000000 ECU_ADDRESS 0xD85C BIT_MASK 0xFF /end MEASUREMENT
/begin MEASUREMENT mroPIND_LE "M_E Leseindex fuer Mengenpuffer" SBYTE DEZ_DB_U 0 0 0.000000 255.000000 ECU_ADDRESS 0xD8B0 BIT_MASK 0xFF /end MEASUREMENT
/begin MEASUREMENT mroPIND_SH "M_E Schreibeindex fuer Mengenpuffer" SBYTE DEZ_DB_U 0 0 0.000000 255.000000 ECU_ADDRESS 0xD8B2 BIT_MASK 0xFF /end MEASUREMENT
/begin MEASUREMENT mroPVsoll "Vorfoerderdruck Sollwert" SWORD VDF 0 0 -32768.000000 32767.000000 ECU_ADDRESS 0xD9B0 BIT_MASK 0xFFFF /end MEASUREMENT
/begin MEASUREMENT mroPWG_R_I "Status PWG Rampe Istzustand" UWORD DEZ_DW_U 0 0 0.000000 65535.000000 ECU_ADDRESS 0xDACA BIT_MASK 0xFFFF /end MEASUREMENT
/begin MEASUREMENT mroPWG_R_S "Status PWG Rampe Sollzustand" UWORD DEZ_DW_U 0 0 0.000000 65535.000000 ECU_ADDRESS 0xDACC BIT_MASK 0xFFFF /end MEASUREMENT
/begin MEASUREMENT mroPWG_neu "PWG Sollwert vor Anstieg-/Abfall-Rampe" SWORD PROZ_S 0 0 -327.680000 327.670000 ECU_ADDRESS 0xDACE BIT_MASK 0xFFFF /end MEASUREMENT
/begin MEASUREMENT mroRAMP_L "Umschaltung Rauchbeg. stat.--> dyn. Rampe aktiv" UBYTE DEZ_DB_U 0 0 0.000000 255.000000 ECU_ADDRESS 0xDF20 BIT_MASK 0xFF /end MEASUREMENT
/begin MEASUREMENT mroRAMP_LD "Abgef. Ladeluftschlauch Rampe aktiv" UBYTE DEZ_DB_U 0 0 0.000000 255.000000 ECU_ADDRESS 0xDF1E BIT_MASK 0xFF /end MEASUREMENT
/begin MEASUREMENT mroSEG_LAG "M_E Mengenpuffer fuer lesen -  1:bereit / 0:nicht bereit" SBYTE DEZ_DB_U 0 0 0.000000 255.000000 ECU_ADDRESS 0xD8AC BIT_MASK 0xFF /end MEASUREMENT
/begin MEASUREMENT mroSTAstat "Status bei Wiederstart ohne K15 Aus/Ein (0 inakt./1 warten freig./2 freig/4 neus" UWORD DEZ_DW_U 0 0 0.000000 65535.000000 ECU_ADDRESS 0xDF24 BIT_MASK 0xFFFF /end MEASUREMENT
/begin MEASUREMENT mroST_NLSt "Start aus NL aktueller Zustand (0-kein abgeb. NL, 1-abgeb. NL warten auf N, 2-wa" UWORD DEZ_DW_U 0 0 0.000000 65535.000000 ECU_ADDRESS 0xD878 BIT_MASK 0xFFFF /end MEASUREMENT
/begin MEASUREMENT mroSycCout "LRR" SWORD DEZ_DW 0 0 -32768.000000 32767.000000 ECU_ADDRESS 0xDC02 BIT_MASK 0xFFFF /end MEASUREMENT
/begin MEASUREMENT mroTXUSTAT "TXU Drehmomenteneingriff Status" SWORD DEZ_DB_U 0 0 0.000000 255.000000 ECU_ADDRESS 0xDEE0 BIT_MASK 0xFFFF /end MEASUREMENT
/begin MEASUREMENT mroT_EKP "WTF abhaengige EKP-Vorsteuerzeit" UWORD ZEIT_ST 0 0 0.000000 655350000.000000 ECU_ADDRESS 0xD988 BIT_MASK 0xFFFF /end MEASUREMENT
/begin MEASUREMENT mroVDP_ZAK "Zustand Vorfoerderdruck-Ueberwachung" UWORD DEZ_DW_U 0 0 0.000000 65535.000000 ECU_ADDRESS 0xDAA4 BIT_MASK 0xFFFF /end MEASUREMENT
/begin MEASUREMENT mroV_SOLH "HGB Sollgeschw." SWORD V 0 0 0.000000 327.670000 ECU_ADDRESS 0xDABA BIT_MASK 0xFFFF /end MEASUREMENT
/begin MEASUREMENT mroWTF_SLZ "Schleppzeiger Wassertemperatur" SWORD T 0 0 -273.140000 3003.560000 ECU_ADDRESS 0xD916 BIT_MASK 0xFFFF /end MEASUREMENT
/begin MEASUREMENT mrodNdt20 "Drehzahlgradient mrwdNdt20 bezogen auf 20ms" SWORD dN_dZ_U 0 0 -1638400.000000 1638350.000000 ECU_ADDRESS 0xD856 BIT_MASK 0xFFFF /end MEASUREMENT
/begin MEASUREMENT mrodNdtT "Gefilterter Drehzahlgradient" SWORD dN_dZ_U 0 0 -1638400.000000 1638350.000000 ECU_ADDRESS 0xD87C BIT_MASK 0xFFFF /end MEASUREMENT
/begin MEASUREMENT mrodNdtfil "Drehzahlgradient gefiltert" SWORD dN_dZ_U 0 0 -1638400.000000 1638350.000000 ECU_ADDRESS 0xD854 BIT_MASK 0xFFFF /end MEASUREMENT
/begin MEASUREMENT mrodPV "Vorfoerderdruck Delta = Sollwert-Istwert" SWORD VDF 0 0 -32768.000000 32767.000000 ECU_ADDRESS 0xD9AE BIT_MASK 0xFFFF /end MEASUREMENT
/begin MEASUREMENT phmKWH_Mes "KWH Ausgangs Vergleichsmessung" SWORD DEZ_DB_U 0 0 0.000000 255.000000 ECU_ADDRESS 0xC192 BIT_MASK 0xFFFF /end MEASUREMENT
/begin MEASUREMENT xcmBYPSTAN "Fehler-Status Universalschnittstelle n-sync" UBYTE DEZ_DB_U 0 0 0.000000 255.000000 ECU_ADDRESS 0xC380 BIT_MASK 0xFF /end MEASUREMENT
/begin MEASUREMENT xcmBYPSTAT "Fehler-Status Universalschnittstelle n- und t-sync" UBYTE DEZ_DB_U 0 0 0.000000 255.000000 ECU_ADDRESS 0xC381 BIT_MASK 0xFF /end MEASUREMENT
/begin MEASUREMENT xcmCL_WTF "DIAG WTF-Testergebnis loeschen" UBYTE DEZ_DB_U 0 0 0.000000 255.000000 ECU_ADDRESS 0xC37C BIT_MASK 0xFF /end MEASUREMENT
/begin MEASUREMENT xcmCode_Fl "EWS Flags der EWS-Auswertetask" UWORD DEZ_DW_U 0 0 0.000000 65535.000000 ECU_ADDRESS 0xC324 BIT_MASK 0xFFFF /end MEASUREMENT
/begin MEASUREMENT xcmDMode "DIAG Status Injektorensperrung (Diagnose)" UBYTE DEZ_DB_U 0 0 0.000000 255.000000 ECU_ADDRESS 0xC37A BIT_MASK 0xFF /end MEASUREMENT
/begin MEASUREMENT xcmDiaEwsC "EWS Diagnosekommando" UBYTE DEZ_DB_U 0 0 0.000000 255.000000 ECU_ADDRESS 0xC3ED BIT_MASK 0xFF /end MEASUREMENT
/begin MEASUREMENT xcmDiaEwsU "EWS Statusmessage Urcodepruefung" UBYTE DEZ_DB_U 0 0 0.000000 255.000000 ECU_ADDRESS 0xC3EF BIT_MASK 0xFF /end MEASUREMENT
/begin MEASUREMENT xcmDiaEwsZ "EWS Statusmessage Zustand Auswertetask" UBYTE DEZ_DB_U 0 0 0.000000 255.000000 ECU_ADDRESS 0xC3EE BIT_MASK 0xFF /end MEASUREMENT
/begin MEASUREMENT xcmEWC_H "EWS HighWord des empfangenen WC" UWORD DEZ_DW_U 0 0 0.000000 65535.000000 ECU_ADDRESS 0xC31E BIT_MASK 0xFFFF /end MEASUREMENT
/begin MEASUREMENT xcmEWC_L "EWS LowWord des empfangenen WC" UWORD DEZ_DW_U 0 0 0.000000 65535.000000 ECU_ADDRESS 0xC320 BIT_MASK 0xFFFF /end MEASUREMENT
/begin MEASUREMENT xcmEWS_FS "EWS Freischalteflag" UBYTE DEZ_DB_U 0 0 0.000000 255.000000 ECU_ADDRESS 0xC3E7 BIT_MASK 0xFF /end MEASUREMENT
/begin MEASUREMENT xcmEWS_ME0 "EWS Abschalteflag" UBYTE DEZ_DB_U 0 0 0.000000 255.000000 ECU_ADDRESS 0xC3E8 BIT_MASK 0xFF /end MEASUREMENT
/begin MEASUREMENT xcmEmpfang "EWS Telegramme empfangen" SBYTE DEZ_DB 0 0 -128.000000 127.000000 ECU_ADDRESS 0xC3FD BIT_MASK 0xFF /end MEASUREMENT
/begin MEASUREMENT xcmEwsReFg "EWS-Recycling Freigabestatus (0/1)" UBYTE DEZ_DB_U 0 0 0.000000 255.000000 ECU_ADDRESS 0xC3F0 BIT_MASK 0xFF /end MEASUREMENT
/begin MEASUREMENT xcmFang_G "EWS Fangbereichszaehler grob" SBYTE DEZ_DB 0 0 -128.000000 127.000000 ECU_ADDRESS 0xC401 BIT_MASK 0xFF /end MEASUREMENT
/begin MEASUREMENT xcmLRRaus "LRR Deaktievierungs Flag" UBYTE DEZ_DB_U 0 0 0.000000 255.000000 ECU_ADDRESS 0xC37D BIT_MASK 0xFF /end MEASUREMENT
/begin MEASUREMENT xcmMcMLock "McMess lock/unlock status information" UBYTE DEZ_DB_U 0 0 0.000000 255.000000 ECU_ADDRESS 0xC3F7 BIT_MASK 0xFF /end MEASUREMENT
/begin MEASUREMENT xcmProEinA "EWS Serielle Schnittstelle aktivieren" SBYTE DEZ_DB 0 0 -128.000000 127.000000 ECU_ADDRESS 0xC3FE BIT_MASK 0xFF /end MEASUREMENT
/begin MEASUREMENT xcmProt_Fl "EWS Flags der EWS-Empfangstask" UBYTE DEZ_DB_U 0 0 0.000000 255.000000 ECU_ADDRESS 0xC400 BIT_MASK 0xFF /end MEASUREMENT
/begin MEASUREMENT xcmTiO "EWS Telegrammformat in Ordnung" UBYTE DEZ_DB_U 0 0 0.000000 255.000000 ECU_ADDRESS 0xC3FF BIT_MASK 0xFF /end MEASUREMENT
/begin MEASUREMENT xcmTimeOff "EWS TimerOffset wegen Klemme 15-'AUS'" UWORD DEZ_DW_U 0 0 0.000000 65535.000000 ECU_ADDRESS 0xC326 BIT_MASK 0xFFFF /end MEASUREMENT
/begin MEASUREMENT xcmUC_EE1 "EWS Urcodekopie 1" UWORD DEZ_DW_U 0 0 0.000000 65535.000000 ECU_ADDRESS 0xC2CE BIT_MASK 0xFFFF /end MEASUREMENT
/begin MEASUREMENT xcmUC_EE2 "EWS Urcodekopie 2" UWORD DEZ_DW_U 0 0 0.000000 65535.000000 ECU_ADDRESS 0xC2D0 BIT_MASK 0xFFFF /end MEASUREMENT
/begin MEASUREMENT xcmUC_EE3 "EWS Urcodekopie 3" UWORD DEZ_DW_U 0 0 0.000000 65535.000000 ECU_ADDRESS 0xC2D2 BIT_MASK 0xFFFF /end MEASUREMENT
/begin MEASUREMENT xcmUC_S "EWS Urcode" UWORD DEZ_DW_U 0 0 0.000000 65535.000000 ECU_ADDRESS 0xC2F8 BIT_MASK 0xFFFF /end MEASUREMENT
/begin MEASUREMENT xcmWC_E11H "EWS Wechselcode(i) Kopie 1High" UWORD DEZ_DW_U 0 0 0.000000 65535.000000 ECU_ADDRESS 0xC2DE BIT_MASK 0xFFFF /end MEASUREMENT
/begin MEASUREMENT xcmWC_E11L "EWS Wechselcode(i) Kopie 1Low" UWORD DEZ_DW_U 0 0 0.000000 65535.000000 ECU_ADDRESS 0xC2DC BIT_MASK 0xFFFF /end MEASUREMENT
/begin MEASUREMENT xcmWC_E12H "EWS Wechselcode(i) Kopie 2High" UWORD DEZ_DW_U 0 0 0.000000 65535.000000 ECU_ADDRESS 0xC2E2 BIT_MASK 0xFFFF /end MEASUREMENT
/begin MEASUREMENT xcmWC_E12L "EWS Wechselcode(i) Kopie 2Low" UWORD DEZ_DW_U 0 0 0.000000 65535.000000 ECU_ADDRESS 0xC2E0 BIT_MASK 0xFFFF /end MEASUREMENT
/begin MEASUREMENT xcmWC_E13H "EWS Wechselcode(i) Kopie 3High" UWORD DEZ_DW_U 0 0 0.000000 65535.000000 ECU_ADDRESS 0xC2E6 BIT_MASK 0xFFFF /end MEASUREMENT
/begin MEASUREMENT xcmWC_E13L "EWS Wechselcode(i) Kopie 3Low" UWORD DEZ_DW_U 0 0 0.000000 65535.000000 ECU_ADDRESS 0xC2E4 BIT_MASK 0xFFFF /end MEASUREMENT
/begin MEASUREMENT xcmWC_E21H "EWS Wechselcode(i-1) Kopie 1High" UWORD DEZ_DW_U 0 0 0.000000 65535.000000 ECU_ADDRESS 0xC2EA BIT_MASK 0xFFFF /end MEASUREMENT
/begin MEASUREMENT xcmWC_E21L "EWS Wechselcode(i-1) Kopie 1Low" UWORD DEZ_DW_U 0 0 0.000000 65535.000000 ECU_ADDRESS 0xC2E8 BIT_MASK 0xFFFF /end MEASUREMENT
/begin MEASUREMENT xcmWC_E22H "EWS Wechselcode(i-1) Kopie 2High" UWORD DEZ_DW_U 0 0 0.000000 65535.000000 ECU_ADDRESS 0xC2EE BIT_MASK 0xFFFF /end MEASUREMENT
/begin MEASUREMENT xcmWC_E22L "EWS Wechselcode(i-1) Kopie 2Low" UWORD DEZ_DW_U 0 0 0.000000 65535.000000 ECU_ADDRESS 0xC2EC BIT_MASK 0xFFFF /end MEASUREMENT
/begin MEASUREMENT xcmWC_E23H "EWS Wechselcode(i-1) Kopie 3High" UWORD DEZ_DW_U 0 0 0.000000 65535.000000 ECU_ADDRESS 0xC2F2 BIT_MASK 0xFFFF /end MEASUREMENT
/begin MEASUREMENT xcmWC_E23L "EWS Wechselcode(i-1) Kopie 3Low" UWORD DEZ_DW_U 0 0 0.000000 65535.000000 ECU_ADDRESS 0xC2F0 BIT_MASK 0xFFFF /end MEASUREMENT
/begin MEASUREMENT xcmWC_S1H "EWS Wechselcode(i) High" UWORD DEZ_DW_U 0 0 0.000000 65535.000000 ECU_ADDRESS 0xC2D6 BIT_MASK 0xFFFF /end MEASUREMENT
/begin MEASUREMENT xcmWC_S1L "EWS Wechselcode(i) Low" UWORD DEZ_DW_U 0 0 0.000000 65535.000000 ECU_ADDRESS 0xC2D4 BIT_MASK 0xFFFF /end MEASUREMENT
/begin MEASUREMENT xcmWC_S2H "EWS Wechselcode(i-1) High" UWORD DEZ_DW_U 0 0 0.000000 65535.000000 ECU_ADDRESS 0xC2DA BIT_MASK 0xFFFF /end MEASUREMENT
/begin MEASUREMENT xcmWC_S2L "EWS Wechselcode(i-1) Low" UWORD DEZ_DW_U 0 0 0.000000 65535.000000 ECU_ADDRESS 0xC2D8 BIT_MASK 0xFFFF /end MEASUREMENT
/begin MEASUREMENT xcmZF_EE "EWS Zufallszahl aus EEPROM" UWORD DEZ_DW_U 0 0 0.000000 65535.000000 ECU_ADDRESS 0xC2F4 BIT_MASK 0xFFFF /end MEASUREMENT
/begin MEASUREMENT xcmZF_S "EWS empfangene Zufallszahl" UWORD DEZ_DW_U 0 0 0.000000 65535.000000 ECU_ADDRESS 0xC2F6 BIT_MASK 0xFFFF /end MEASUREMENT
/begin MEASUREMENT xcmZ_E "EWS Uebertragungsfehlerzaehler" SWORD DEZ_DW 0 0 -32768.000000 32767.000000 ECU_ADDRESS 0xC322 BIT_MASK 0xFFFF /end MEASUREMENT
/begin MEASUREMENT xcmZ_F "EWS Falschcodezaehler" SBYTE DEZ_DB 0 0 -128.000000 127.000000 ECU_ADDRESS 0xC402 BIT_MASK 0xFF /end MEASUREMENT
/begin MEASUREMENT xcm_R_EE "EWS Empfangsinfo fuer Ur- und Wechselcodes" UBYTE DEZ_DB_U 0 0 0.000000 255.000000 ECU_ADDRESS 0xC3EA BIT_MASK 0xFF /end MEASUREMENT
/begin MEASUREMENT xcm_SG_STA "EWS neuer Steuergeraetestatus" UBYTE DEZ_DB_U 0 0 0.000000 255.000000 ECU_ADDRESS 0xC3EC BIT_MASK 0xFF /end MEASUREMENT
/begin MEASUREMENT xcm_STATUS "EWS Steuergeraetestatus" UBYTE DEZ_DB_U 0 0 0.000000 255.000000 ECU_ADDRESS 0xC3EB BIT_MASK 0xFF /end MEASUREMENT
/begin MEASUREMENT xcm_S_EE "EWS Speicherinfo fuer Ur- und Wechselcodes" UBYTE DEZ_DB_U 0 0 0.000000 255.000000 ECU_ADDRESS 0xC3E9 BIT_MASK 0xFF /end MEASUREMENT
/begin MEASUREMENT xcm_mode "Aktiv Ext. Komm. Protokoll (Mode A=Prok. Detektion,B=KWP2000*,C=KWP2000)" UBYTE DEZ_DB_U 0 0 0.000000 255.000000 ECU_ADDRESS 0xC3FC BIT_MASK 0xFF /end MEASUREMENT
/begin MEASUREMENT xcoBYP_COS "Ueberwachungszaehler ASCET-Bypass n-sync." UWORD DEZ_DW_U 0 0 0.000000 65535.000000 ECU_ADDRESS 0xD968 BIT_MASK 0xFFFF /end MEASUREMENT
/begin MEASUREMENT xcoBYP_COX "Ueberwachungszaehler ASCET-Bypass t-sync." UWORD DEZ_DW_U 0 0 0.000000 65535.000000 ECU_ADDRESS 0xD96A BIT_MASK 0xFFFF /end MEASUREMENT
/begin MEASUREMENT xcoInFeMo "Mode der Injektorfehlertest (Mode A/B/C)" UBYTE DEZ_DB_U 0 0 0.000000 255.000000 ECU_ADDRESS 0xD8D2 BIT_MASK 0xFF /end MEASUREMENT
/begin MEASUREMENT xco_Byte01 "empfangene Byte 0 und 1 des EWS-Protokolls" SWORD DEZ_DW 0 0 -32768.000000 32767.000000 ECU_ADDRESS 0xDAAA BIT_MASK 0xFFFF /end MEASUREMENT
/begin MEASUREMENT xco_Byte23 "empfangene Byte 2 und 3 des EWS-Protokolls" SWORD DEZ_DW 0 0 -32768.000000 32767.000000 ECU_ADDRESS 0xDAA8 BIT_MASK 0xFFFF /end MEASUREMENT
/begin MEASUREMENT xco_Byte45 "empfangene Byte 4 und 5 des EWS-Protokolls" SWORD DEZ_DW 0 0 -32768.000000 32767.000000 ECU_ADDRESS 0xDAA6 BIT_MASK 0xFFFF /end MEASUREMENT
/begin MEASUREMENT xco_gstBit "gestoerte Bits im EWS-Protokoll" SWORD DEZ_DW 0 0 -32768.000000 32767.000000 ECU_ADDRESS 0xDAAC BIT_MASK 0xFFFF /end MEASUREMENT
/begin MEASUREMENT zhmERR "Status Zumesshandler [ges. Bit 1: Unplaus WUP, 2: Menge frei, 8: NW-Fehler]" UWORD DEZ_DW_U 0 0 0.000000 65535.000000 ECU_ADDRESS 0xF950 BIT_MASK 0xFFFF /end MEASUREMENT
/begin MEASUREMENT zhmHECUR "ZH Anzugstromdauer" UWORD AD_uS 0 0 -32768.000000 32767.000000 ECU_ADDRESS 0xC0EE BIT_MASK 0xFFFF /end MEASUREMENT
/begin MEASUREMENT zhmIRCHG "ZH Rechargestrom" UWORD IRc2PZM10 0 0 0.000000 55005.500000 ECU_ADDRESS 0xC0EC BIT_MASK 0xFFFF /end MEASUREMENT
/begin MEASUREMENT zhmNWI_ST "NW Interrupt-Status [Err.-.-.-.Frq.Off.On.Ini]" UWORD DEZ_DW_U 0 0 0.000000 65535.000000 ECU_ADDRESS 0xC0F6 BIT_MASK 0xFFFF /end MEASUREMENT
/begin MEASUREMENT zhmNWUM_ZA "NW Umdrehungszaehler" UBYTE DEZ_DB_U 0 0 0.000000 255.000000 ECU_ADDRESS 0xC377 BIT_MASK 0xFF /end MEASUREMENT
/begin MEASUREMENT zhmNW_INK "NW Nockenwellen Flanke bei letztem Interrupt" UWORD GradKW 0 0 -768.000000 767.976600 ECU_ADDRESS 0xC0F8 BIT_MASK 0xFFFF /end MEASUREMENT
/begin MEASUREMENT zhmUM_ZA "Umdrehungszaehler (1 Tick = 2 Umdrehungen)" UBYTE DEZ_DB_U 0 0 0.000000 255.000000 ECU_ADDRESS 0xC375 BIT_MASK 0xFF /end MEASUREMENT
/begin MEASUREMENT zhoBANK1 "Einspritzzaehler Bank 1" SWORD DEZ_DW_U 0 0 0.000000 65535.000000 ECU_ADDRESS 0xDBE8 BIT_MASK 0xFFFF /end MEASUREMENT
/begin MEASUREMENT zhoBANK2 "Einspritzzaehler Bank 2" UWORD DEZ_DW_U 0 0 0.000000 65535.000000 ECU_ADDRESS 0xDBE6 BIT_MASK 0xFFFF /end MEASUREMENT
/begin MEASUREMENT zhoDZINK "INKPEDA-Ersatzdrehzahl fuer Entscheidung ob Fehlerspeicherung" UWORD N 0 0 0.000000 32767.000000 ECU_ADDRESS 0xD87A BIT_MASK 0xFFFF /end MEASUREMENT
/begin MEASUREMENT zhoDZPTF "gefilterte DZ zur Schwellenbildung bei IWZ-Fehler" UWORD N 0 0 0.000000 32767.000000 ECU_ADDRESS 0xDB92 BIT_MASK 0xFFFF /end MEASUREMENT
/begin MEASUREMENT zhoNW_ERR "Fehlerhafte NW-Position (wird im Gut Fall nicht beschr.)" UWORD GradKW 0 0 -768.000000 767.976600 ECU_ADDRESS 0xDBEA BIT_MASK 0xFFFF /end MEASUREMENT
/begin MEASUREMENT zhoNW_OFF "Winkeluhrstand einer gueltigen NW_Flanke" SWORD GradKW 0 0 -768.000000 767.976600 ECU_ADDRESS 0xDBE4 BIT_MASK 0xFFFF /end MEASUREMENT
/begin MEASUREMENT zhoNW_ON "Winkeluhrstand einer gueltigen NW_Flanke" SWORD GradKW 0 0 -768.000000 767.976600 ECU_ADDRESS 0xDBE2 BIT_MASK 0xFFFF /end MEASUREMENT
/begin MEASUREMENT zhoNW_Woff "NW Nockenwellen Flanke bei Interrupt (Off-Phase)" UWORD GradKW 0 0 -768.000000 767.976600 ECU_ADDRESS 0xDAC2 BIT_MASK 0xFFFF /end MEASUREMENT
/begin MEASUREMENT zhoNW_Won "NW Nockenwellen Flanke bei Interrupt (On-Phase)" UWORD GradKW 0 0 -768.000000 767.976600 ECU_ADDRESS 0xDB42 BIT_MASK 0xFFFF /end MEASUREMENT
/begin MEASUREMENT zhoNsync "Inkrement-Drehzahl bei Ini., Rcv. oder abgebr. Nachlauf" SWORD N 0 0 0.000000 32767.000000 ECU_ADDRESS 0xD9A2 BIT_MASK 0xFFFF /end MEASUREMENT
/begin MEASUREMENT zhoSYNC_ST "Synchronisationsstatus des Zumesshandlers" UWORD DEZ_DW_U 0 0 0.000000 65535.000000 ECU_ADDRESS 0xDBEE BIT_MASK 0xFFFF /end MEASUREMENT
/begin MEASUREMENT zhoWINKUHR "Winkeluhrstand bei BOB Interrupt" SWORD GradKW 0 0 -768.000000 767.976600 ECU_ADDRESS 0xDBF0 BIT_MASK 0xFFFF /end MEASUREMENT
/begin MEASUREMENT zhoWUPSRC "WUP Quelle [-.-.-.-.-.-.-.-.WUPFIRST.B2ONIR.B1ONIR.PZVUNPL.-.-.-.PRWUP0]" SWORD DEZ_DW_U 0 0 0.000000 65535.000000 ECU_ADDRESS 0xDC54 BIT_MASK 0xFFFF /end MEASUREMENT
/begin MEASUREMENT zumABHGW "INJ AB HE Grundwerte KF" SWORD GradKW 0 0 -768.000000 767.976600 ECU_ADDRESS 0xC09A BIT_MASK 0xFFFF /end MEASUREMENT
/begin MEASUREMENT zumABHLk "INJ K-Faktor Anst.-beg. HE = f(LTF)" SWORD FAKT 0 0 -3.276800 3.276700 ECU_ADDRESS 0xC04E BIT_MASK 0xFFFF /end MEASUREMENT
/begin MEASUREMENT zumABHPk "INJ K-Faktor Anst.-beg. HE = f(ADF)" SWORD FAKT 0 0 -3.276800 3.276700 ECU_ADDRESS 0xC050 BIT_MASK 0xFFFF /end MEASUREMENT
/begin MEASUREMENT zumABHSf "INJ K-Faktor Anst.-beg. HE = f(mrmST_ABWF)" SWORD FAKT 0 0 -3.276800 3.276700 ECU_ADDRESS 0xC052 BIT_MASK 0xFFFF /end MEASUREMENT
/begin MEASUREMENT zumABHW2 "INJ K-Faktor Anst.-beg.(2.ter. Freiheitsgrad) HE = f(WTF)" SWORD FAKT 0 0 -3.276800 3.276700 ECU_ADDRESS 0xC04C BIT_MASK 0xFFFF /end MEASUREMENT
/begin MEASUREMENT zumABHWk "INJ K-Faktor Anst.-beg. HE = f(WTF)" SWORD FAKT 0 0 -3.276800 3.276700 ECU_ADDRESS 0xC04A BIT_MASK 0xFFFF /end MEASUREMENT
/begin MEASUREMENT zumABR_NE "INJ Ansteuerbeginn NE ohne HE" SWORD GradKW 0 0 -768.000000 767.976600 ECU_ADDRESS 0xC092 BIT_MASK 0xFFFF /end MEASUREMENT
/begin MEASUREMENT zumABVLk "INJ K-Fakt Anst.-beg. VE = f(LTF)" SWORD FAKT 0 0 -3.276800 3.276700 ECU_ADDRESS 0xC03C BIT_MASK 0xFFFF /end MEASUREMENT
/begin MEASUREMENT zumABVWk "INJ K-Fakt Anst.-beg. VE = f(WTF)" SWORD FAKT 0 0 -3.276800 3.276700 ECU_ADDRESS 0xC03A BIT_MASK 0xFFFF /end MEASUREMENT
/begin MEASUREMENT zumABWLkKL "Dynamische Korrektur Ansteuerbeginn" SWORD FAKT 0 0 -3.276800 3.276700 ECU_ADDRESS 0xC0E6 BIT_MASK 0xFFFF /end MEASUREMENT
/begin MEASUREMENT zumAB_HE "INJ Ansteuerbeginn HE" SWORD GradKW 0 0 -768.000000 767.976600 ECU_ADDRESS 0xC09C BIT_MASK 0xFFFF /end MEASUREMENT
/begin MEASUREMENT zumAB_NE "INJ Ansteuerbeginn NE" SWORD GradKW 0 0 -768.000000 767.976600 ECU_ADDRESS 0xC090 BIT_MASK 0xFFFF /end MEASUREMENT
/begin MEASUREMENT zumAD_HE "INJ Ansteuerdauer HE" SWORD AD_uS 0 0 -32768.000000 32767.000000 ECU_ADDRESS 0xC0A6 BIT_MASK 0xFFFF /end MEASUREMENT
/begin MEASUREMENT zumAD_NE "INJ Ansteuerdauer NE" SWORD AD_uS 0 0 -32768.000000 32767.000000 ECU_ADDRESS 0xC096 BIT_MASK 0xFFFF /end MEASUREMENT
/begin MEASUREMENT zumAD_NE1 "INJ Ansteuerdauer NE" SWORD AD_uS 0 0 -32768.000000 32767.000000 ECU_ADDRESS 0xC096 BIT_MASK 0xFFFF /end MEASUREMENT
/begin MEASUREMENT zumANEON3 "Abschaltung Menge/WTF Nacheinspritzung" SWORD DEZ_DW_U 0 0 0.000000 65535.000000 ECU_ADDRESS 0xC08C BIT_MASK 0xFFFF /end MEASUREMENT
/begin MEASUREMENT zumANE_T "Abschaltung Abgastemperatur Nacheinspritzung" SWORD DEZ_DW_U 0 0 0.000000 65535.000000 ECU_ADDRESS 0xC08E BIT_MASK 0xFFFF /end MEASUREMENT
/begin MEASUREMENT zumINJKL "Schalter Injektorklasse" SWORD DEZ_DB 0 0 -128.000000 127.000000 ECU_ADDRESS 0xC0D0 BIT_MASK 0xFFFF /end MEASUREMENT
/begin MEASUREMENT zumLFTstat "INJ Rail-Entlueftung Status" SBYTE DEZ_DB 0 0 -128.000000 127.000000 ECU_ADDRESS 0xC374 BIT_MASK 0xFF /end MEASUREMENT
/begin MEASUREMENT zumMEVLk "INJ K-Faktor Menge VE = f(LTF)" SWORD FAKT 0 0 -3.276800 3.276700 ECU_ADDRESS 0xC044 BIT_MASK 0xFFFF /end MEASUREMENT
/begin MEASUREMENT zumMEVPk "INJ K-Faktor Menge VE = f(ADF)" SWORD FAKT 0 0 -3.276800 3.276700 ECU_ADDRESS 0xC048 BIT_MASK 0xFFFF /end MEASUREMENT
/begin MEASUREMENT zumMEVSLk "Mengenberechnung VE Korrekturfaktor Startfall" SWORD FAKT 0 0 -3.276800 3.276700 ECU_ADDRESS 0xC0D2 BIT_MASK 0xFFFF /end MEASUREMENT
/begin MEASUREMENT zumMEVSPk "Mengenberechnung VE Korrekturfaktor Startfall" SWORD FAKT 0 0 -3.276800 3.276700 ECU_ADDRESS 0xC0D4 BIT_MASK 0xFFFF /end MEASUREMENT
/begin MEASUREMENT zumMEVWk "INJ K-Faktor Menge VE = f(WTF)" SWORD FAKT 0 0 -3.276800 3.276700 ECU_ADDRESS 0xC046 BIT_MASK 0xFFFF /end MEASUREMENT
/begin MEASUREMENT zumME_NE2 "Message Ansteuerdauer (Menge) nach Korrektur" SWORD MM3 0 0 -327.680000 327.670000 ECU_ADDRESS 0xC094 BIT_MASK 0xFFFF /end MEASUREMENT
/begin MEASUREMENT zumME_VEL "INJ Zwischengespeicherte Menge VE" SWORD MM3 0 0 -327.680000 327.670000 ECU_ADDRESS 0xC0A4 BIT_MASK 0xFFFF /end MEASUREMENT
/begin MEASUREMENT zumM_KORR "INJ Korrekturmenge" SWORD MM3 0 0 -327.680000 327.670000 ECU_ADDRESS 0xC0E4 BIT_MASK 0xFFFF /end MEASUREMENT
/begin MEASUREMENT zumPQLk "RPC Korr-Fakt Raildrucksollwert = f(LTF)" UWORD FAKT 0 0 -3.276800 3.276700 ECU_ADDRESS 0xC2C4 BIT_MASK 0xFFFF /end MEASUREMENT
/begin MEASUREMENT zumPQPk "RPC Korr-Fakt Raildrucksollwert = f(ADF)" UWORD FAKT 0 0 -3.276800 3.276700 ECU_ADDRESS 0xC2C6 BIT_MASK 0xFFFF /end MEASUREMENT
/begin MEASUREMENT zumPQWk "RPC Korr-Fakt Raildrucksollwert = f(WTF)" UWORD FAKT 0 0 -3.276800 3.276700 ECU_ADDRESS 0xC2C2 BIT_MASK 0xFFFF /end MEASUREMENT
/begin MEASUREMENT zumPQsoll "RPC Raildruck Sollwert" SWORD RP 0 0 -3276800.000000 3276700.000000 ECU_ADDRESS 0xC030 BIT_MASK 0xFFFF /end MEASUREMENT
/begin MEASUREMENT zumP_RAIL "RPC Raildruck" SWORD RP 0 0 -3276800.000000 3276700.000000 ECU_ADDRESS 0xC032 BIT_MASK 0xFFFF /end MEASUREMENT
/begin MEASUREMENT zumP_RAILa "RPC Raildruck aktuell" SWORD RP 0 0 -3276800.000000 3276700.000000 ECU_ADDRESS 0xC036 BIT_MASK 0xFFFF /end MEASUREMENT
/begin MEASUREMENT zumP_RAILm "RPC Raildruck gemittelt" SWORD RP 0 0 -3276800.000000 3276700.000000 ECU_ADDRESS 0xC034 BIT_MASK 0xFFFF /end MEASUREMENT
/begin MEASUREMENT zumP_TEST "RPC Nachlauf: Raildrucktestwert" SWORD RP 0 0 -3276800.000000 3276700.000000 ECU_ADDRESS 0xC038 BIT_MASK 0xFFFF /end MEASUREMENT
/begin MEASUREMENT zumRP_CHK "RPC Raildruck Pruefung ja = 1, nein = 0" SBYTE DEZ_DB_U 0 0 0.000000 255.000000 ECU_ADDRESS 0xC373 BIT_MASK 0xFF /end MEASUREMENT
/begin MEASUREMENT zumRP_ZUST "RPC Zustandsvariable fuer Regelung/steuerung" UBYTE DEZ_DB_U 0 0 0.000000 255.000000 ECU_ADDRESS 0xC3E6 BIT_MASK 0xFF /end MEASUREMENT
/begin MEASUREMENT zumRPfak "INJ K-Faktor dyn. AB-Verlagerung" SWORD FAKT 0 0 -3.276800 3.276700 ECU_ADDRESS 0xC09E BIT_MASK 0xFFFF /end MEASUREMENT
/begin MEASUREMENT zumTrchg "INJ Nachladezeit fuer VE" SWORD AD_uS 0 0 -32768.000000 32767.000000 ECU_ADDRESS 0xC07E BIT_MASK 0xFFFF /end MEASUREMENT
/begin MEASUREMENT zumVEPk "INJ K-Wert VE-Schaltung = f(ADF)" SWORD VEon_off 0 0 -3276.800000 3276.700000 ECU_ADDRESS 0xC040 BIT_MASK 0xFFFF /end MEASUREMENT
/begin MEASUREMENT zumVERB "INJ ME_FAHR 20 ms summiert" UWORD MM3 0 0 -327.680000 327.670000 ECU_ADDRESS 0xC0A0 BIT_MASK 0xFFFF /end MEASUREMENT
/begin MEASUREMENT zumVEWk "INJ K-Wert VE-Schaltung = f(WTF)" SWORD VEon_off 0 0 -3276.800000 3276.700000 ECU_ADDRESS 0xC03E BIT_MASK 0xFFFF /end MEASUREMENT
/begin MEASUREMENT zumdLRR_HE "INJ Mengenanteil LRR fuer HE" SWORD MM3 0 0 -327.680000 327.670000 ECU_ADDRESS 0xC0A2 BIT_MASK 0xFFFF /end MEASUREMENT
/begin MEASUREMENT zuoABHE2W "INJ AB HE 2.te Korrektur W-Temp" SWORD GradKW 0 0 -768.000000 767.976600 ECU_ADDRESS 0xDC5A BIT_MASK 0xFFFF /end MEASUREMENT
/begin MEASUREMENT zuoABHEKL "INJ AB HE Korrektur L-Temp" SWORD GradKW 0 0 -768.000000 767.976600 ECU_ADDRESS 0xDB90 BIT_MASK 0xFFFF /end MEASUREMENT
/begin MEASUREMENT zuoABHEKP "INJ AB HE Korrektur L-Druck" SWORD GradKW 0 0 -768.000000 767.976600 ECU_ADDRESS 0xDB8E BIT_MASK 0xFFFF /end MEASUREMENT
/begin MEASUREMENT zuoABHEKS "INJ AB HE Korrektur Startabwurfzeit" SWORD GradKW 0 0 -768.000000 767.976600 ECU_ADDRESS 0xDC58 BIT_MASK 0xFFFF /end MEASUREMENT
/begin MEASUREMENT zuoABHEKW "INJ AB HE Korrektur W-Temp" SWORD GradKW 0 0 -768.000000 767.976600 ECU_ADDRESS 0xDB8C BIT_MASK 0xFFFF /end MEASUREMENT
/begin MEASUREMENT zuoABHS "Ansteuerbeginn HE" SWORD GradKW 0 0 -768.000000 767.976600 ECU_ADDRESS 0xD88A BIT_MASK 0xFFFF /end MEASUREMENT
/begin MEASUREMENT zuoABHSGW "Ansteuerbeginn HE Grundwert" SWORD GradKW 0 0 -768.000000 767.976600 ECU_ADDRESS 0xD88E BIT_MASK 0xFFFF /end MEASUREMENT
/begin MEASUREMENT zuoABHSL "Ansteuerbeginn HE Korrekturwert" SWORD GradKW 0 0 -768.000000 767.976600 ECU_ADDRESS 0xD868 BIT_MASK 0xFFFF /end MEASUREMENT
/begin MEASUREMENT zuoABHSLk "Ansteuerbeginn HE Korrekturwert" SWORD GradKW 0 0 -768.000000 767.976600 ECU_ADDRESS 0xD86A BIT_MASK 0xFFFF /end MEASUREMENT
/begin MEASUREMENT zuoABHSP "Ansteuerbeginn HE Korrekturwert" SWORD GradKW 0 0 -768.000000 767.976600 ECU_ADDRESS 0xD864 BIT_MASK 0xFFFF /end MEASUREMENT
/begin MEASUREMENT zuoABHSPk "Ansteuerbeginn HE Korrekturwert" SWORD GradKW 0 0 -768.000000 767.976600 ECU_ADDRESS 0xD866 BIT_MASK 0xFFFF /end MEASUREMENT
/begin MEASUREMENT zuoABHSk "Ansteuerbeginn HE Korrekturwert" SWORD GradKW 0 0 -768.000000 767.976600 ECU_ADDRESS 0xD88C BIT_MASK 0xFFFF /end MEASUREMENT
/begin MEASUREMENT zuoABPWLkK "Olda Ansteuerbeginn nach dyn. Korrektur" SWORD GradKW 0 0 -768.000000 767.976600 ECU_ADDRESS 0xD892 BIT_MASK 0xFFFF /end MEASUREMENT
/begin MEASUREMENT zuoABPkKF "INJ Korr.-Winkel dyn. AB-Verlagerung aus KF" SWORD GradKW 0 0 -768.000000 767.976600 ECU_ADDRESS 0xDB82 BIT_MASK 0xFFFF /end MEASUREMENT
/begin MEASUREMENT zuoABR_VE "INJ Ansteuerbeginn VE relativ zu HE" SWORD GradKW 0 0 -768.000000 767.976600 ECU_ADDRESS 0xDB98 BIT_MASK 0xFFFF /end MEASUREMENT
/begin MEASUREMENT zuoABVGW "INJ Ansteuerbeginn VE GW" SWORD GradKW 0 0 -768.000000 767.976600 ECU_ADDRESS 0xDC36 BIT_MASK 0xFFFF /end MEASUREMENT
/begin MEASUREMENT zuoABVKF "INJ Ansteuerbeginn VE KorrekturKF" SWORD GradKW 0 0 -768.000000 767.976600 ECU_ADDRESS 0xDC34 BIT_MASK 0xFFFF /end MEASUREMENT
/begin MEASUREMENT zuoABVKW "INJ Ansteuerbeginn VE Korrekturwert" SWORD GradKW 0 0 -768.000000 767.976600 ECU_ADDRESS 0xDBAC BIT_MASK 0xFFFF /end MEASUREMENT
/begin MEASUREMENT zuoABVMIN "INJ Minimalwert Ansteuerbeginn" SWORD GradKW 0 0 -768.000000 767.976600 ECU_ADDRESS 0xDBAA BIT_MASK 0xFFFF /end MEASUREMENT
/begin MEASUREMENT zuoAB_HEk "INJ Ansteuerbeginn HE Phasenkorr." SWORD GradKW 0 0 -768.000000 767.976600 ECU_ADDRESS 0xDB7C BIT_MASK 0xFFFF /end MEASUREMENT
/begin MEASUREMENT zuoAB_VE "INJ Ansteuerbeginn VE korr." SWORD GradKW 0 0 -768.000000 767.976600 ECU_ADDRESS 0xDBAE BIT_MASK 0xFFFF /end MEASUREMENT
/begin MEASUREMENT zuoAB_VE1 "INJ Ansteuerbeginn VE1" SWORD GradKW 0 0 -768.000000 767.976600 ECU_ADDRESS 0xDB96 BIT_MASK 0xFFFF /end MEASUREMENT
/begin MEASUREMENT zuoABdHE "INJ Korr.-Winkel dyn. AB-Verlagerung begrenzt" SWORD GradKW 0 0 -768.000000 767.976600 ECU_ADDRESS 0xDB7E BIT_MASK 0xFFFF /end MEASUREMENT
/begin MEASUREMENT zuoABdHEu "INJ Korr.-Winkel dyn. AB-Verlagerung mit Fakt." SWORD GradKW 0 0 -768.000000 767.976600 ECU_ADDRESS 0xDB80 BIT_MASK 0xFFFF /end MEASUREMENT
/begin MEASUREMENT zuoAD_HE "INJ Ansteuerdauer HE" SWORD AD_uS 0 0 -32768.000000 32767.000000 ECU_ADDRESS 0xDB88 BIT_MASK 0xFFFF /end MEASUREMENT
/begin MEASUREMENT zuoAD_NE3 "Olda Ansteuerdauer (Dauer) nach Kennfeld" SWORD AD_uS 0 0 -32768.000000 32767.000000 ECU_ADDRESS 0xD8F6 BIT_MASK 0xFFFF /end MEASUREMENT
/begin MEASUREMENT zuoAD_VE1 "INJ Ansteuerdauer VE1" SWORD AD_uS 0 0 -32768.000000 32767.000000 ECU_ADDRESS 0xDB94 BIT_MASK 0xFFFF /end MEASUREMENT
/begin MEASUREMENT zuoANEON0 "Abschaltung NE Menge/WTF vor Korrektur" SWORD PROZ 0 0 -327.680000 327.670000 ECU_ADDRESS 0xDCDC BIT_MASK 0xFFFF /end MEASUREMENT
/begin MEASUREMENT zuoANEON1 "Abschaltung NE Menge/WTF nach Korrektur" SWORD PROZ 0 0 -327.680000 327.670000 ECU_ADDRESS 0xDCD2 BIT_MASK 0xFFFF /end MEASUREMENT
/begin MEASUREMENT zuoANEON2 "Abschaltung NE Menge/LTF nach Korrektur" SWORD PROZ 0 0 -327.680000 327.670000 ECU_ADDRESS 0xD8F8 BIT_MASK 0xFFFF /end MEASUREMENT
/begin MEASUREMENT zuoANE_1 "Abschaltung NE Abgastemperatur" SWORD T 0 0 -273.140000 3003.560000 ECU_ADDRESS 0xDCD0 BIT_MASK 0xFFFF /end MEASUREMENT
/begin MEASUREMENT zuoEKDPF1 "RPC Fehlerzaehler 1" SWORD DEZ_DW_U 0 0 0.000000 65535.000000 ECU_ADDRESS 0xDCF2 BIT_MASK 0xFFFF /end MEASUREMENT
/begin MEASUREMENT zuoEKDPF2 "RPC Fehlerzaehler 2" SWORD DEZ_DW_U 0 0 0.000000 65535.000000 ECU_ADDRESS 0xDCE6 BIT_MASK 0xFFFF /end MEASUREMENT
/begin MEASUREMENT zuoEKDPF3 "RPC Fehlerzaehler 3" SWORD DEZ_DW_U 0 0 0.000000 65535.000000 ECU_ADDRESS 0xDCF0 BIT_MASK 0xFFFF /end MEASUREMENT
/begin MEASUREMENT zuoEKDPF4 "RPC Fehlerzaehler 4" SWORD DEZ_DW_U 0 0 0.000000 65535.000000 ECU_ADDRESS 0xDCEE BIT_MASK 0xFFFF /end MEASUREMENT
/begin MEASUREMENT zuoEKDPF5 "RPC Fehlerzaehler 5" SWORD DEZ_DW_U 0 0 0.000000 65535.000000 ECU_ADDRESS 0xDCEC BIT_MASK 0xFFFF /end MEASUREMENT
/begin MEASUREMENT zuoEKDPF6 "RPC Fehlerzaehler 6" SWORD DEZ_DW_U 0 0 0.000000 65535.000000 ECU_ADDRESS 0xDCE4 BIT_MASK 0xFFFF /end MEASUREMENT
/begin MEASUREMENT zuoEKDPF7 "RPC Fehlerzaehler 7" SWORD DEZ_DW_U 0 0 0.000000 65535.000000 ECU_ADDRESS 0xDCEA BIT_MASK 0xFFFF /end MEASUREMENT
/begin MEASUREMENT zuoEL_KF "RPC 3.Elementschaltung" SWORD ELon_off 0 0 -3276.800000 3276.700000 ECU_ADDRESS 0xDCFE BIT_MASK 0xFFFF /end MEASUREMENT
/begin MEASUREMENT zuoHE_STAT "INJ HE-Schalter" UWORD DEZ_DB_U 0 0 0.000000 255.000000 ECU_ADDRESS 0xDB84 BIT_MASK 0xFFFF /end MEASUREMENT
/begin MEASUREMENT zuoKAT_dT "Temp.Differenz ueber Katalysator (AT1-AT2)" SWORD DIF_T 0 0 -3276.800000 3276.700000 ECU_ADDRESS 0xDCCE BIT_MASK 0xFFFF /end MEASUREMENT
/begin MEASUREMENT zuoKDPTst "Status des KDP-Plausibilitaetstests" UWORD DEZ_DW_U 0 0 0.000000 65535.000000 ECU_ADDRESS 0xDAA2 BIT_MASK 0xFFFF /end MEASUREMENT
/begin MEASUREMENT zuoLDF_dt1 "dLDF-DT1 gefiltert als Eingang fuer zuwABHPLKF" SWORD dP_dZ 0 0 -1638400.000000 1638350.000000 ECU_ADDRESS 0xDA0A BIT_MASK 0xFFFF /end MEASUREMENT
/begin MEASUREMENT zuoLRRF_KF "INJ Korrektorfaktor fuer LRR VE - Anteil = f (M_EMOT; P_RAIL)" SWORD FAKT 0 0 -3.276800 3.276700 ECU_ADDRESS 0xD8B6 BIT_MASK 0xFFFF /end MEASUREMENT
/begin MEASUREMENT zuoMEHE "INJ Menge HE" SWORD MM3 0 0 -327.680000 327.670000 ECU_ADDRESS 0xDB8A BIT_MASK 0xFFFF /end MEASUREMENT
/begin MEASUREMENT zuoMEHNEk "Olda Korrekturmenge" SWORD MM3 0 0 -327.680000 327.670000 ECU_ADDRESS 0xD8FC BIT_MASK 0xFFFF /end MEASUREMENT
/begin MEASUREMENT zuoMEHVNEk "Olda Korrekturmenge HE um VE" SWORD MM3 0 0 -327.680000 327.670000 ECU_ADDRESS 0xD894 BIT_MASK 0xFFFF /end MEASUREMENT
/begin MEASUREMENT zuoMENE "INJ Menge der Nacheinspritzung" SWORD MM3 0 0 -327.680000 327.670000 ECU_ADDRESS 0xDCCA BIT_MASK 0xFFFF /end MEASUREMENT
/begin MEASUREMENT zuoMEVGW "INJ GW KF Menge VE" SWORD MM3 0 0 -327.680000 327.670000 ECU_ADDRESS 0xDC32 BIT_MASK 0xFFFF /end MEASUREMENT
/begin MEASUREMENT zuoMEVWk "Mengenberechnung VE Korrekturfaktor Startfall" SWORD FAKT 0 0 -3.276800 3.276700 ECU_ADDRESS 0xD890 BIT_MASK 0xFFFF /end MEASUREMENT
/begin MEASUREMENT zuoME_KORR "INJ Menge nach Korrektur" SWORD MM3 0 0 -327.680000 327.670000 ECU_ADDRESS 0xD900 BIT_MASK 0xFFFF /end MEASUREMENT
/begin MEASUREMENT zuoME_NE1 "Olda Ansteuerdauer (Menge) nach Grundkennfeld" SWORD MM3 0 0 -327.680000 327.670000 ECU_ADDRESS 0xD8FE BIT_MASK 0xFFFF /end MEASUREMENT
/begin MEASUREMENT zuoME_NEWk "Olda Ansteuerdauer Korrektur WTF und Menge" SWORD MM3 0 0 -327.680000 327.670000 ECU_ADDRESS 0xD8FA BIT_MASK 0xFFFF /end MEASUREMENT
/begin MEASUREMENT zuoME_VE "INJ Menge VE" SWORD MM3 0 0 -327.680000 327.670000 ECU_ADDRESS 0xDB9C BIT_MASK 0xFFFF /end MEASUREMENT
/begin MEASUREMENT zuoME_VE_N "INJ Menge VE Normalbetrieb" SWORD MM3 0 0 -327.680000 327.670000 ECU_ADDRESS 0xDBA8 BIT_MASK 0xFFFF /end MEASUREMENT
/begin MEASUREMENT zuoME_VE_k "INJ Korrekturmenge VE" SWORD MM3 0 0 -327.680000 327.670000 ECU_ADDRESS 0xDBA6 BIT_MASK 0xFFFF /end MEASUREMENT
/begin MEASUREMENT zuoMHVdiff "INJ M_EFAHR - Menge VE" SWORD MM3 0 0 -327.680000 327.670000 ECU_ADDRESS 0xDB9A BIT_MASK 0xFFFF /end MEASUREMENT
/begin MEASUREMENT zuoMHmin "INJ min. Menge HE = f(n)" SWORD MM3 0 0 -327.680000 327.670000 ECU_ADDRESS 0xDB86 BIT_MASK 0xFFFF /end MEASUREMENT
/begin MEASUREMENT zuoMVE_MLR "INJ Menge VE mit LRR - Korrektor" SWORD MM3 0 0 -327.680000 327.670000 ECU_ADDRESS 0xD8B8 BIT_MASK 0xFFFF /end MEASUREMENT
/begin MEASUREMENT zuoMVE_OLR "INJ Menge VE ohne LRR - Korrektor" SWORD MM3 0 0 -327.680000 327.670000 ECU_ADDRESS 0xD8BA BIT_MASK 0xFFFF /end MEASUREMENT
/begin MEASUREMENT zuoMV_Lk "VE-Korrektur ueber LTF" SWORD MM3 0 0 -327.680000 327.670000 ECU_ADDRESS 0xD87E BIT_MASK 0xFFFF /end MEASUREMENT
/begin MEASUREMENT zuoMV_Pk "VE-Korrektur ueber ADF" SWORD MM3 0 0 -327.680000 327.670000 ECU_ADDRESS 0xDC14 BIT_MASK 0xFFFF /end MEASUREMENT
/begin MEASUREMENT zuoMV_Wk "VE-Korrektur ueber WTF" SWORD MM3 0 0 -327.680000 327.670000 ECU_ADDRESS 0xD880 BIT_MASK 0xFFFF /end MEASUREMENT
/begin MEASUREMENT zuoMVmax "INJ maximale VE-Menge" SWORD MM3 0 0 -327.680000 327.670000 ECU_ADDRESS 0xDBA4 BIT_MASK 0xFFFF /end MEASUREMENT
/begin MEASUREMENT zuoMVmin "INJ min. Menge VE = f(n)" SWORD MM3 0 0 -327.680000 327.670000 ECU_ADDRESS 0xDBA0 BIT_MASK 0xFFFF /end MEASUREMENT
/begin MEASUREMENT zuoM_List "M_L aktuelle Luftmasse (Betriebspunktanzeige zuwMLkKL)" SWORD M_L 0 0 -3276.800000 3276.700000 ECU_ADDRESS 0xD9B4 BIT_MASK 0xFFFF /end MEASUREMENT
/begin MEASUREMENT zuoM_VESLk "INJ Korrekturmenge VE" SWORD MM3 0 0 -327.680000 327.670000 ECU_ADDRESS 0xD86E BIT_MASK 0xFFFF /end MEASUREMENT
/begin MEASUREMENT zuoM_VESPk "INJ Korrekturmenge VE" SWORD MM3 0 0 -327.680000 327.670000 ECU_ADDRESS 0xD86C BIT_MASK 0xFFFF /end MEASUREMENT
/begin MEASUREMENT zuoNEBGR "INJ NE Menge maximal" SWORD MM3 0 0 -327.680000 327.670000 ECU_ADDRESS 0xDCC8 BIT_MASK 0xFFFF /end MEASUREMENT
/begin MEASUREMENT zuoNEME_W1 "INJ Wunsch NE Menge" SWORD MM3 0 0 -327.680000 327.670000 ECU_ADDRESS 0xDCC6 BIT_MASK 0xFFFF /end MEASUREMENT
/begin MEASUREMENT zuoNEMEps1 "INJ NE Menge pro Sekunde" SWORD MM3pS 0 0 -327.680000 327.670000 ECU_ADDRESS 0xDCDA BIT_MASK 0xFFFF /end MEASUREMENT
/begin MEASUREMENT zuoNESTAT "INJ Schalterstellung NE" SWORD DEZ_DW_U 0 0 0.000000 65535.000000 ECU_ADDRESS 0xDCE2 BIT_MASK 0xFFFF /end MEASUREMENT
/begin MEASUREMENT zuoNE_Tkat "INJ Katalysatortemperatur" SWORD TempKelv 0 0 0.000000 3276.700000 ECU_ADDRESS 0xDCD4 BIT_MASK 0xFFFF /end MEASUREMENT
/begin MEASUREMENT zuoNE_aus "INJ Abschaltursache Nacheinspritzung" UWORD DEZ_DW_U 0 0 0.000000 65535.000000 ECU_ADDRESS 0xDCCC BIT_MASK 0xFFFF /end MEASUREMENT
/begin MEASUREMENT zuoNEsum1 "INJ NE Menge aufsummiert" SWORD MM3 0 0 -327.680000 327.670000 ECU_ADDRESS 0xDCD6 BIT_MASK 0xFFFF /end MEASUREMENT
/begin MEASUREMENT zuoNMEmn "INJ Mindest-NE-Menge" SWORD MM3 0 0 -327.680000 327.670000 ECU_ADDRESS 0xDCDE BIT_MASK 0xFFFF /end MEASUREMENT
/begin MEASUREMENT zuoPQBdpKF "Maximaler Raildruckgradient aus Akustik-Kennfeld" SWORD dRP 0 0 -163840000.000000 163835000.000000 ECU_ADDRESS 0xD8BE BIT_MASK 0xFFFF /end MEASUREMENT
/begin MEASUREMENT zuoPQSta_C "Raildruckueberwachung im Start Counter" UWORD DEZ_DW_U 0 0 0.000000 65535.000000 ECU_ADDRESS 0xDED2 BIT_MASK 0xFFFF /end MEASUREMENT
/begin MEASUREMENT zuoPQ_STAT "Status der Raildruck-Gradientenbegrenzung" UWORD DEZ_DB_U 0 0 0.000000 255.000000 ECU_ADDRESS 0xD8C2 BIT_MASK 0xFFFF /end MEASUREMENT
/begin MEASUREMENT zuoPQ_dpKF "Maximaler Raildruckgradient aus Normalkennfeld" SWORD dRP 0 0 -163840000.000000 163835000.000000 ECU_ADDRESS 0xD8BC BIT_MASK 0xFFFF /end MEASUREMENT
/begin MEASUREMENT zuoPQ_dp_t "Zeit fuer Raildruckgradient zuoPQBdpKF/zuoPQ_dpKF - Interpolation" UWORD ZEIT_HP 0 0 0.000000 1310700000.000000 ECU_ADDRESS 0xD8C0 BIT_MASK 0xFFFF /end MEASUREMENT
/begin MEASUREMENT zuoPQmin "RPC min. Raildruck" SWORD RP 0 0 -3276800.000000 3276700.000000 ECU_ADDRESS 0xDCF6 BIT_MASK 0xFFFF /end MEASUREMENT
/begin MEASUREMENT zuoPS_GW "RPC Solldruck: Grundwert" SWORD RP 0 0 -3276800.000000 3276700.000000 ECU_ADDRESS 0xDC30 BIT_MASK 0xFFFF /end MEASUREMENT
/begin MEASUREMENT zuoPS_KL "RPC Solldruck: Korrektur Lufttemp." SWORD RP 0 0 -3276800.000000 3276700.000000 ECU_ADDRESS 0xDA78 BIT_MASK 0xFFFF /end MEASUREMENT
/begin MEASUREMENT zuoPS_KLk "RPC Solldruck: Korrektur Lufttemp." SWORD RP 0 0 -3276800.000000 3276700.000000 ECU_ADDRESS 0xD862 BIT_MASK 0xFFFF /end MEASUREMENT
/begin MEASUREMENT zuoPS_KP "RPC Solldruck: Korrektur Atmosphaerendruck" SWORD RP 0 0 -3276800.000000 3276700.000000 ECU_ADDRESS 0xDA74 BIT_MASK 0xFFFF /end MEASUREMENT
/begin MEASUREMENT zuoPS_KPk "RPC Solldruck: Korrektur Atmosphaerendruck" SWORD RP 0 0 -3276800.000000 3276700.000000 ECU_ADDRESS 0xD860 BIT_MASK 0xFFFF /end MEASUREMENT
/begin MEASUREMENT zuoPS_KW "RPC Solldruck: Korrektur Wassertemp." SWORD RP 0 0 -3276800.000000 3276700.000000 ECU_ADDRESS 0xDA76 BIT_MASK 0xFFFF /end MEASUREMENT
/begin MEASUREMENT zuoPS_Kges "RPC Solldruck: gesamte Korrektur" SWORD RP 0 0 -3276800.000000 3276700.000000 ECU_ADDRESS 0xDA72 BIT_MASK 0xFFFF /end MEASUREMENT
/begin MEASUREMENT zuoPS_MB "Raildruckuberwachung nach Mengenbegrenzung durch fbeEKDPF6" SWORD RP 0 0 -3276800.000000 3276700.000000 ECU_ADDRESS 0xD914 BIT_MASK 0xFFFF /end MEASUREMENT
/begin MEASUREMENT zuoPS_NB "RPC Solldruck vor Begrenzung" SWORD RP 0 0 -3276800.000000 3276700.000000 ECU_ADDRESS 0xDAA0 BIT_MASK 0xFFFF /end MEASUREMENT
/begin MEASUREMENT zuoPS_REG "RPC TV DBE fuer Raildruck, geregelt" SWORD PROZ 0 0 -327.680000 327.670000 ECU_ADDRESS 0xDA6A BIT_MASK 0xFFFF /end MEASUREMENT
/begin MEASUREMENT zuoPS_Tk "RPC Solldruck nach Temp.-Begrenzung" SWORD RP 0 0 -3276800.000000 3276700.000000 ECU_ADDRESS 0xDA7A BIT_MASK 0xFFFF /end MEASUREMENT
/begin MEASUREMENT zuoPS_VS "RPC TV DBE fuer Raildruck, gesteuert" SWORD PROZ 0 0 -327.680000 327.670000 ECU_ADDRESS 0xDA6C BIT_MASK 0xFFFF /end MEASUREMENT
/begin MEASUREMENT zuoPS_oB "RPC Solldruck: korrigiert, aber unbegrenzt" SWORD RP 0 0 -3276800.000000 3276700.000000 ECU_ADDRESS 0xDA70 BIT_MASK 0xFFFF /end MEASUREMENT
/begin MEASUREMENT zuoPSmax "RPC maxmialer Solldruck" SWORD RP 0 0 -3276800.000000 3276700.000000 ECU_ADDRESS 0xDA6E BIT_MASK 0xFFFF /end MEASUREMENT
/begin MEASUREMENT zuoPdiff "RPC Soll - Istdruck" SWORD RP 0 0 -3276800.000000 3276700.000000 ECU_ADDRESS 0xDCF8 BIT_MASK 0xFFFF /end MEASUREMENT
/begin MEASUREMENT zuoPlim "RPC Raildruckmaximun = f(n,KTF)" SWORD RP 0 0 -3276800.000000 3276700.000000 ECU_ADDRESS 0xDAD4 BIT_MASK 0xFFFF /end MEASUREMENT
/begin MEASUREMENT zuoRAmax "RPC max. Regelabweichung PQsoll-P_RAIL" SWORD RP 0 0 -3276800.000000 3276700.000000 ECU_ADDRESS 0xDCF4 BIT_MASK 0xFFFF /end MEASUREMENT
/begin MEASUREMENT zuoRDUH_C "Raildruckueberhoehung Counter" UWORD DEZ_DW_U 0 0 0.000000 65535.000000 ECU_ADDRESS 0xDF02 BIT_MASK 0xFFFF /end MEASUREMENT
/begin MEASUREMENT zuoRP_Iant "RPC Raildruck I-Anteil High" SWORD PROZ 0 0 -327.680000 327.670000 ECU_ADDRESS 0xDA68 BIT_MASK 0xFFFF /end MEASUREMENT
/begin MEASUREMENT zuoRP_Pant "RPC Raildruck P-Anteil High" SWORD PROZ 0 0 -327.680000 327.670000 ECU_ADDRESS 0xDA66 BIT_MASK 0xFFFF /end MEASUREMENT
/begin MEASUREMENT zuoRPbeg "INJ zuoRPdyn begrenzt" SWORD RP 0 0 -3276800.000000 3276700.000000 ECU_ADDRESS 0xDCFC BIT_MASK 0xFFFF /end MEASUREMENT
/begin MEASUREMENT zuoRPdyn "INJ begr.Solldruck - korr.Solldruck" SWORD RP 0 0 -3276800.000000 3276700.000000 ECU_ADDRESS 0xDCFA BIT_MASK 0xFFFF /end MEASUREMENT
/begin MEASUREMENT zuoTve "INJ Zeit fuer kompl. VE" SWORD AD_uS 0 0 -32768.000000 32767.000000 ECU_ADDRESS 0xDBA2 BIT_MASK 0xFFFF /end MEASUREMENT
/begin MEASUREMENT zuoVE_ON1 "INJ KF VE einschalten" SWORD VEon_off 0 0 -3276.800000 3276.700000 ECU_ADDRESS 0xDBB4 BIT_MASK 0xFFFF /end MEASUREMENT
/begin MEASUREMENT zuoVE_ON2 "INJ KL1 VE einschalten" SWORD VEon_off 0 0 -3276.800000 3276.700000 ECU_ADDRESS 0xDBB2 BIT_MASK 0xFFFF /end MEASUREMENT
/begin MEASUREMENT zuoVE_ON3 "OLDA VE v-korr einschalten" SWORD VEon_off 0 0 -3276.800000 3276.700000 ECU_ADDRESS 0xD8DC BIT_MASK 0xFFFF /end MEASUREMENT
/begin MEASUREMENT zuoVE_ONA "VE-AGR KF VE einschalten" SWORD VEon_off 0 0 -3276.800000 3276.700000 ECU_ADDRESS 0xDADE BIT_MASK 0xFFFF /end MEASUREMENT
/begin MEASUREMENT zuoVE_ONS "Summe VE einschalten" SWORD VEon_off 0 0 -3276.800000 3276.700000 ECU_ADDRESS 0xDBB0 BIT_MASK 0xFFFF /end MEASUREMENT
/begin MEASUREMENT zuoVE_STAT "INJ VE-Schalter" UWORD DEZ_DW_U 0 0 0.000000 65535.000000 ECU_ADDRESS 0xDB9E BIT_MASK 0xFFFF /end MEASUREMENT
/begin MEASUREMENT zuodLRR_VE "INJ Mengenanteil LRR fuer VE" SWORD MM3 0 0 -327.680000 327.670000 ECU_ADDRESS 0xD8B4 BIT_MASK 0xFFFF /end MEASUREMENT
/begin MEASUREMENT zuodPQB_ME "Triggerschwelle d(M_E/dt) fuer Raildruckgradient" SWORD dM_E_dZ 0 0 -16384.000000 16383.500000 ECU_ADDRESS 0xD8C6 BIT_MASK 0xFFFF /end MEASUREMENT
/begin MEASUREMENT zuodPQB_PL "Triggerschwelle d(ldoE/dt) fuer Raildruckgradient" SWORD dP_dZ 0 0 -1638400.000000 1638350.000000 ECU_ADDRESS 0xD8C4 BIT_MASK 0xFFFF /end MEASUREMENT
/begin MEASUREMENT zuodPS "Maximaler Raildruckgradient" SWORD dRP 0 0 -163840000.000000 163835000.000000 ECU_ADDRESS 0xDC2E BIT_MASK 0xFFFF /end MEASUREMENT
/end MODULE
/end PROJECT
