ASAP2_VERSION 1 21
/begin PROJECT Pro4017 "R4 1.8l 5V T lÑngs FR5ROM F5051"
/begin HEADER "" PROJECT_NO Pro4017 VERSION "PrV = F21dc mit 00" /end HEADER
/begin MODULE DIM " "
/begin MOD_COMMON " " S_REC_LAYOUT ME7 BYTE_ORDER MSB_LAST /end MOD_COMMON
/begin COMPU_METHOD bs_ub_q0p049_o6p25 "" RAT_FUNC "%6.5" "g" COEFFS 0 255.000000 1600.000000 0 0.000000 12.500000 /end COMPU_METHOD
/begin COMPU_METHOD B_TRUE "boolsche ZustÑnde, positive Logik" TAB_VERB "%6.3" "" COMPU_TAB_REF B_TRUE /end COMPU_METHOD
/begin COMPU_METHOD B_TRUE___UW "boolsche ZustÑnde, positive Logik" TAB_VERB "%6.3" "" COMPU_TAB_REF B_TRUE /end COMPU_METHOD
/begin COMPU_METHOD DEZ "1 : 1 Umrechnug (dez/hex)" RAT_FUNC "%6.2" "" COEFFS 0 1.000000 0.000000 0 0.000000 1.000000 /end COMPU_METHOD
/begin COMPU_METHOD dez "1 : 1 Umrechnug (dez/hex)" RAT_FUNC "%6.2" "" COEFFS 0 1.000000 0.000000 0 0.000000 1.000000 /end COMPU_METHOD
/begin COMPU_METHOD dez___UW "1 : 1 Umrechnug (dez/hex)" RAT_FUNC "%6.2" "" COEFFS 0 1.000000 0.000000 0 0.000000 1.000000 /end COMPU_METHOD
/begin COMPU_METHOD fak_ub_b1 "" RAT_FUNC "%6.4" "-" COEFFS 0 256.000000 0.000000 0 0.000000 1.000000 /end COMPU_METHOD
/begin COMPU_METHOD fak_ub_b2 "" RAT_FUNC "%6.4" "-" COEFFS 0 256.000000 0.000000 0 0.000000 2.000000 /end COMPU_METHOD
/begin COMPU_METHOD fak_ub_b4 "" RAT_FUNC "%6.4" "-" COEFFS 0 256.000000 0.000000 0 0.000000 4.000000 /end COMPU_METHOD
/begin COMPU_METHOD fak_uw_b16 "" RAT_FUNC "%6.5" "-" COEFFS 0 6.553600e+04 0.000000 0 0.000000 16.000000 /end COMPU_METHOD
/begin COMPU_METHOD fak_uw_b2 "" RAT_FUNC "%7.6" "-" COEFFS 0 6.553600e+04 0.000000 0 0.000000 2.000000 /end COMPU_METHOD
/begin COMPU_METHOD fak_uw_b32 "" RAT_FUNC "%6.5" "-" COEFFS 0 6.553600e+04 0.000000 0 0.000000 32.000000 /end COMPU_METHOD
/begin COMPU_METHOD fak_uw_b4 "" RAT_FUNC "%7.6" "-" COEFFS 0 6.553600e+04 0.000000 0 0.000000 4.000000 /end COMPU_METHOD
/begin COMPU_METHOD fak_uw_q0p001 "" RAT_FUNC "%6.4" "" COEFFS 0 6.553600e+04 0.000000 0 0.000000 65.536000 /end COMPU_METHOD
/begin COMPU_METHOD kw_ub_q0p5 "" RAT_FUNC "%6.3" "∞KW" COEFFS 0 256.000000 0.000000 0 0.000000 128.000000 /end COMPU_METHOD
/begin COMPU_METHOD lw_sw_q0p04375 "" RAT_FUNC "%6.4" "∞" COEFFS 0 32767.000000 0.000000 0 0.000000 1434.000000 /end COMPU_METHOD
/begin COMPU_METHOD mdt_sw_b2556 "" RAT_FUNC "%6.4" "Nms" COEFFS 0 6.553600e+04 0.000000 0 0.000000 5112.000000 /end COMPU_METHOD
/begin COMPU_METHOD md_ub_q10 "" RAT_FUNC "%6.1" "Nm" COEFFS 0 1.000000 0.000000 0 0.000000 10.000000 /end COMPU_METHOD
/begin COMPU_METHOD m_ub_b1020 "" RAT_FUNC "%6.2" "kg/h" COEFFS 0 1.000000 0.000000 0 0.000000 4.000000 /end COMPU_METHOD
/begin COMPU_METHOD m_ub_b23p3 "" RAT_FUNC "%6.3" "kg" COEFFS 0 2812.500000 0.000000 0 0.000000 256.000000 /end COMPU_METHOD
/begin COMPU_METHOD m_ub_b25p6 "" RAT_FUNC "%6.3" "kg/h" COEFFS 0 256.000000 0.000000 0 0.000000 25.600000 /end COMPU_METHOD
/begin COMPU_METHOD m_uw_b25p6 "" RAT_FUNC "%6.5" "kg/h" COEFFS 0 6.553600e+04 0.000000 0 0.000000 25.600000 /end COMPU_METHOD
/begin COMPU_METHOD m_uw_b6553p5 "" RAT_FUNC "%6.3" "kg/h" COEFFS 0 1.000000 0.000000 0 0.000000 1.000000e-01 /end COMPU_METHOD
/begin COMPU_METHOD m_uw_q0p0005 "" RAT_FUNC "%6.5" "kg/h" COEFFS 0 1.000000 0.000000 0 0.000000 5.000000e-04 /end COMPU_METHOD
/begin COMPU_METHOD nmot_ub_q10 "" RAT_FUNC "%6.1" "U/min" COEFFS 0 1.000000 0.000000 0 0.000000 10.000000 /end COMPU_METHOD
/begin COMPU_METHOD nmot_ub_q40 "" RAT_FUNC "%6.1" "Upm" COEFFS 0 1.000000 0.000000 0 0.000000 40.000000 /end COMPU_METHOD
/begin COMPU_METHOD nmot_uw_q0p25 "" RAT_FUNC "%6.3" "U/min" COEFFS 0 1.000000 0.000000 0 0.000000 2.500000e-01 /end COMPU_METHOD
/begin COMPU_METHOD p_sw_q0p039 "" RAT_FUNC "%6.4" "hPa" COEFFS 0 256.000000 0.000000 0 0.000000 10.000000 /end COMPU_METHOD
/begin COMPU_METHOD p_ub_q5 "" RAT_FUNC "%6.2" "hPa" COEFFS 0 1.000000 0.000000 0 0.000000 5.000000 /end COMPU_METHOD
/begin COMPU_METHOD p_uw_b32 "" RAT_FUNC "%6.5" "hPa/%" COEFFS 0 6.553600e+04 0.000000 0 0.000000 32.000000 /end COMPU_METHOD
/begin COMPU_METHOD p_uw_q0p039 "" RAT_FUNC "%6.4" "hPa" COEFFS 0 256.000000 0.000000 0 0.000000 10.000000 /end COMPU_METHOD
/begin COMPU_METHOD relDK_ub_b100 "" RAT_FUNC "%6.3" "% DK" COEFFS 0 255.000000 0.000000 0 0.000000 100.000000 /end COMPU_METHOD
/begin COMPU_METHOD relDK_uw_b100 "" RAT_FUNC "%6.4" "% DK" COEFFS 0 65535.000000 0.000000 0 0.000000 100.000000 /end COMPU_METHOD
/begin COMPU_METHOD relNWU_q0p0234 "" RAT_FUNC "%6.4" "%/NWU" COEFFS 0 32.000000 0.000000 0 0.000000 7.500000e-01 /end COMPU_METHOD
/begin COMPU_METHOD relPED_ub_b100 "" RAT_FUNC "%6.3" "% PED" COEFFS 0 255.000000 0.000000 0 0.000000 100.000000 /end COMPU_METHOD
/begin COMPU_METHOD relPED_uw_b100 "" RAT_FUNC "%6.4" "% PED" COEFFS 0 65535.000000 0.000000 0 0.000000 100.000000 /end COMPU_METHOD
/begin COMPU_METHOD rel_sw_q0p0234 "" RAT_FUNC "%6.4" "%/seg" COEFFS 0 32.000000 0.000000 0 0.000000 7.500000e-01 /end COMPU_METHOD
/begin COMPU_METHOD rel_ub_b100 "" RAT_FUNC "%6.3" "%" COEFFS 0 256.000000 0.000000 0 0.000000 100.000000 /end COMPU_METHOD
/begin COMPU_METHOD rel_ub_b99p6 "" RAT_FUNC "%6.3" "%" COEFFS 0 256.000000 0.000000 0 0.000000 100.000000 /end COMPU_METHOD
/begin COMPU_METHOD rel_ub_q0p1875 "" RAT_FUNC "%6.3" "Grad KW/ms" COEFFS 0 256.000000 0.000000 0 0.000000 48.000000 /end COMPU_METHOD
/begin COMPU_METHOD rel_ub_q0p75 "" RAT_FUNC "%6.3" "%" COEFFS 0 1.000000 0.000000 0 0.000000 7.500000e-01 /end COMPU_METHOD
/begin COMPU_METHOD rel_uw_b0p3 "" RAT_FUNC "%8.7" "%/hPa" COEFFS 0 6.553600e+04 0.000000 0 0.000000 3.000000e-01 /end COMPU_METHOD
/begin COMPU_METHOD rel_uw_b100 "" RAT_FUNC "%6.4" "%" COEFFS 0 6.553600e+04 0.000000 0 0.000000 100.000000 /end COMPU_METHOD
/begin COMPU_METHOD rel_uw_b200 "" RAT_FUNC "%6.4" "%" COEFFS 0 6.553600e+04 0.000000 0 0.000000 200.000000 /end COMPU_METHOD
/begin COMPU_METHOD rel_uw_b728 "" RAT_FUNC "%4.2" "%/s" COEFFS 0 6.553600 0.000000 0 0.000000 1.000000 /end COMPU_METHOD
/begin COMPU_METHOD rel_uw_q0p0234 "" RAT_FUNC "%6.4" "%" COEFFS 0 32.000000 0.000000 0 0.000000 7.500000e-01 /end COMPU_METHOD
/begin COMPU_METHOD r_ub_q64 "" RAT_FUNC "%6.1" "Ohm" COEFFS 0 1.000000 0.000000 0 0.000000 64.000000 /end COMPU_METHOD
/begin COMPU_METHOD r_uw_q2 "" RAT_FUNC "%6.2" "Ohm" COEFFS 0 1.000000 0.000000 0 0.000000 2.000000 /end COMPU_METHOD
/begin COMPU_METHOD spg_ubatt "" RAT_FUNC "%6.4" "V" COEFFS 0 1.000000 0.000000 0 0.000000 7.040000e-02 /end COMPU_METHOD
/begin COMPU_METHOD spg_ub_b5 "" RAT_FUNC "%6.4" "V" COEFFS 0 256.000000 0.000000 0 0.000000 5.000000 /end COMPU_METHOD
/begin COMPU_METHOD spg_ub_q0p0052_o0p2 "" RAT_FUNC "%6.3" "V" COEFFS 0 255.000000 51.000000 0 0.000000 1.330000 /end COMPU_METHOD
/begin COMPU_METHOD spg_uw_q0p001222 "" RAT_FUNC "%6.4" "V" COEFFS 0 1.000000 0.000000 0 0.000000 1.222000e-03 /end COMPU_METHOD
/begin COMPU_METHOD spg_uw_q0p00488 "" RAT_FUNC "%6.4" "V" COEFFS 0 1024.000000 0.000000 0 0.000000 5.000000 /end COMPU_METHOD
/begin COMPU_METHOD s_q1_km "" RAT_FUNC "%6.2" "km" COEFFS 0 1.000000 0.000000 0 0.000000 1.000000 /end COMPU_METHOD
/begin COMPU_METHOD s_q6_km "" RAT_FUNC "%6.2" "km" COEFFS 0 1.000000 0.000000 0 0.000000 6.000000 /end COMPU_METHOD
/begin COMPU_METHOD t10msxs_ub_b10p2 "" RAT_FUNC "%6.4" "s" COEFFS 0 1.000000 0.000000 0 0.000000 4.000000e-02 /end COMPU_METHOD
/begin COMPU_METHOD t10msxs_uw_b655p35 "" RAT_FUNC "%6.4" "s" COEFFS 0 1.000000 0.000000 0 0.000000 1.000000e-02 /end COMPU_METHOD
/begin COMPU_METHOD t1sxs_uw_q1 "" RAT_FUNC "%6.2" "s" COEFFS 0 1.000000 0.000000 0 0.000000 1.000000 /end COMPU_METHOD
/begin COMPU_METHOD t500usxms_ub_q0p5 "" RAT_FUNC "%6.3" "ms" COEFFS 0 1.000000 0.000000 0 0.000000 5.000000e-01 /end COMPU_METHOD
/begin COMPU_METHOD t6minxmin_q6 "" RAT_FUNC "%6.2" "min" COEFFS 0 1.000000 0.000000 0 0.000000 6.000000 /end COMPU_METHOD
/begin COMPU_METHOD temp_sw_q0p75 "" RAT_FUNC "%6.3" "Grad C" COEFFS 0 4.000000 0.000000 0 0.000000 3.000000 /end COMPU_METHOD
/begin COMPU_METHOD temp_ub_q0p75_o48 "" RAT_FUNC "%6.2" "Grad C" COEFFS 0 1.000000 48.000000 0 0.000000 7.500000e-01 /end COMPU_METHOD
/begin COMPU_METHOD temp_ub_q1_o40 "" RAT_FUNC "%6.2" "Grad C" COEFFS 0 1.000000 40.000000 0 0.000000 1.000000 /end COMPU_METHOD
/begin COMPU_METHOD temp_ub_q1_o60 "" RAT_FUNC "%6.2" "Grad C" COEFFS 0 1.000000 60.000000 0 0.000000 1.000000 /end COMPU_METHOD
/begin COMPU_METHOD temp_ub_q5_o50 "" RAT_FUNC "%6.2" "Grad C" COEFFS 0 1.000000 50.000000 0 0.000000 5.000000 /end COMPU_METHOD
/begin COMPU_METHOD temp_uw_q0p0195_o50 "" RAT_FUNC "%6.2" "Grad C" COEFFS 0 256.000000 12800.000000 0 0.000000 5.000000 /end COMPU_METHOD
/begin COMPU_METHOD tinjection_sy "" RAT_FUNC "%6.4" "ms" COEFFS 0 312.500000 0.000000 0 0.000000 1.000000 /end COMPU_METHOD
/begin COMPU_METHOD tsquant "Umrechnung Segmentzeit in DMD" RAT_FUNC "%6.2" "us" COEFFS 0 8.333330e-01 0.000000 0 0.000000 1.000000 /end COMPU_METHOD
/begin COMPU_METHOD t_q16us "" RAT_FUNC "%6.1" "us" COEFFS 0 1.000000 0.000000 0 0.000000 16.000000 /end COMPU_METHOD
/begin COMPU_METHOD uefktget_ub_b25p4 "" RAT_FUNC "%6.3" "" COEFFS 0 10.000000 0.000000 0 0.000000 1.000000 /end COMPU_METHOD
/begin COMPU_METHOD vfzgkb_uw_b655 "" RAT_FUNC "%6.4" "km/h" COEFFS 0 6.553600e+04 0.000000 0 0.000000 655.000000 /end COMPU_METHOD
/begin COMPU_METHOD vfzg_q1p0 "" RAT_FUNC "%6.2" "km/h" COEFFS 0 1.000000 0.000000 0 0.000000 1.000000 /end COMPU_METHOD
/begin COMPU_METHOD vfzg_ub_q1p25___UB "" RAT_FUNC "%6.2" "km/h" COEFFS 0 1.000000 0.000000 0 0.000000 1.250000 /end COMPU_METHOD
/begin COMPU_METHOD vfzg_uw_b325 "" RAT_FUNC "%6.4" "km/h" COEFFS 0 6.553600e+04 0.000000 0 0.000000 325.000000 /end COMPU_METHOD
/begin COMPU_METHOD vfzg_uw_b512 "" RAT_FUNC "%6.4" "km/h" COEFFS 0 6.553600e+04 0.000000 0 0.000000 512.000000 /end COMPU_METHOD
/begin COMPU_METHOD vfzg_uw_q0p00781 "" RAT_FUNC "%6.4" "km/h" COEFFS 0 1.000000 0.000000 0 0.000000 7.812500e-03 /end COMPU_METHOD
/begin COMPU_METHOD vrad_uw_b655 "" RAT_FUNC "%6.4" "km/h" COEFFS 0 6.553600e+04 0.000000 0 0.000000 655.000000 /end COMPU_METHOD
/begin COMPU_METHOD vs_uw_b25p6 "" RAT_FUNC "%6.5" "m^3/h" COEFFS 0 6.553600e+04 0.000000 0 0.000000 25.600000 /end COMPU_METHOD
/begin COMPU_METHOD zw_ub_q6 "" RAT_FUNC "%6.2" "Grad KW" COEFFS 0 255.000000 0.000000 0 0.000000 1530.000000 /end COMPU_METHOD
/begin COMPU_VTAB B_TRUE "" TAB_VERB 2 0 "----" 1 "TRUE" /end COMPU_VTAB
/begin MEASUREMENT tmot "Motor-Temperatur" UBYTE temp_ub_q0p75_o48 0 0 -48.000000 143.250000 /begin IF_DATA ASAP1B_ETK KP_BLOB 0x380B61 1 1 /end IF_DATA BIT_MASK 0xFF /end MEASUREMENT
/begin MEASUREMENT rl "relative LuftfÅllung" UBYTE rel_ub_q0p75 0 0 0.000000 191.250000 /begin IF_DATA ASAP1B_ETK KP_BLOB 0xF997 0 1 /end IF_DATA BIT_MASK 0xFF /end MEASUREMENT
/begin MEASUREMENT nmot "Motordrehzahl" UBYTE nmot_ub_q40 0 0 0.000000 10200.000000 /begin IF_DATA ASAP1B_ETK KP_BLOB 0xF876 0 1 /end IF_DATA BIT_MASK 0xFF /end MEASUREMENT
/begin MEASUREMENT tans "Ansauglufttemperatur" UBYTE temp_ub_q0p75_o48 0 0 -48.000000 143.250000 /begin IF_DATA ASAP1B_ETK KP_BLOB 0x380B59 1 1 /end IF_DATA BIT_MASK 0xFF /end MEASUREMENT
/begin MEASUREMENT fho "Korrekturfaktor Hîhe" UBYTE fak_ub_b4 0 0 0.000000 3.984375 /begin IF_DATA ASAP1B_ETK KP_BLOB 0x380AEB 1 1 /end IF_DATA BIT_MASK 0xFF /end MEASUREMENT
/begin MEASUREMENT wped "Normierter Fahrpedalwinkel" UBYTE relPED_ub_b100 0 0 0.000000 100.000000 /begin IF_DATA ASAP1B_ETK KP_BLOB 0x380ABA 1 1 /end IF_DATA BIT_MASK 0xFF /end MEASUREMENT
/begin MEASUREMENT nmot_w "Motordrehzahl" UWORD nmot_uw_q0p25 0 0 0.000000 16383.750000 /begin IF_DATA ASAP1B_ETK KP_BLOB 0xF878 0 2 /end IF_DATA BIT_MASK 0xFFFF /end MEASUREMENT
/begin MEASUREMENT ml "Luftmassenflu·" UBYTE m_ub_b1020 0 0 0.000000 1020.000000 /begin IF_DATA ASAP1B_ETK KP_BLOB 0xF996 0 1 /end IF_DATA BIT_MASK 0xFF /end MEASUREMENT
/begin MEASUREMENT mifa_w "indiziertes Motormoment Fahrerwunsch" UWORD rel_uw_b100 0 0 0.000000 99.998474 /begin IF_DATA ASAP1B_ETK KP_BLOB 0x38243C 1 2 /end IF_DATA BIT_MASK 0xFFFF /end MEASUREMENT
/begin MEASUREMENT pu "Umgebungsdruck" UBYTE p_ub_q5 0 0 0.000000 1275.000000 /begin IF_DATA ASAP1B_ETK KP_BLOB 0x380AEC 1 1 /end IF_DATA BIT_MASK 0xFF /end MEASUREMENT
/begin MEASUREMENT wdkba "Drosselklappenwinkel bezogen auf unteren Anschlag" UBYTE relDK_ub_b100 0 0 0.000000 100.000000 /begin IF_DATA ASAP1B_ETK KP_BLOB 0x380ACB 1 1 /end IF_DATA BIT_MASK 0xFF /end MEASUREMENT
/begin MEASUREMENT gangi "Ist-Gang" UBYTE dez 0 0 0.000000 255.000000 /begin IF_DATA ASAP1B_ETK KP_BLOB 0x380AB5 1 1 /end IF_DATA BIT_MASK 0xFF /end MEASUREMENT
/begin MEASUREMENT tmst "Motorstarttemperatur" UBYTE temp_ub_q0p75_o48 0 0 -48.000000 143.250000 /begin IF_DATA ASAP1B_ETK KP_BLOB 0x380B5F 1 1 /end IF_DATA BIT_MASK 0xFF /end MEASUREMENT
/begin MEASUREMENT ml_w "Luftmassenflu· gefiltert (Word)" UWORD m_uw_b6553p5 0 0 0.000000 6553.500000 /begin IF_DATA ASAP1B_ETK KP_BLOB 0xF998 0 2 /end IF_DATA BIT_MASK 0xFFFF /end MEASUREMENT
/begin MEASUREMENT vziel_w "Zielgeschwindigkeit FGR" UWORD vfzg_uw_b512 0 0 0.000000 511.992188 /begin IF_DATA ASAP1B_ETK KP_BLOB 0x381D62 1 2 /end IF_DATA BIT_MASK 0xFFFF /end MEASUREMENT
/begin MEASUREMENT mizuvfil "ZulÑssiges indiziertes Moment vor Filter" UBYTE rel_ub_b99p6 0 0 0.000000 99.609375 /begin IF_DATA ASAP1B_ETK KP_BLOB 0x380C53 1 1 /end IF_DATA BIT_MASK 0xFF /end MEASUREMENT
/begin MEASUREMENT rl_w "relative LuftfÅllung (Word)" UWORD rel_uw_q0p0234 0 0 0.000000 1535.976562 /begin IF_DATA ASAP1B_ETK KP_BLOB 0xF99C 0 2 /end IF_DATA BIT_MASK 0xFFFF /end MEASUREMENT
/begin MEASUREMENT vfzg "Fahrzeuggeschwindigkeit" UBYTE vfzg_ub_q1p25___UB 0 0 0.000000 318.750000 /begin IF_DATA ASAP1B_ETK KP_BLOB 0x380982 1 1 /end IF_DATA BIT_MASK 0xFF /end MEASUREMENT
/begin MEASUREMENT tkatm "Katalysatortemperatur aus Modell" UBYTE temp_ub_q5_o50 0 0 -50.000000 1225.000000 /begin IF_DATA ASAP1B_ETK KP_BLOB 0x380A6D 1 1 /end IF_DATA BIT_MASK 0xFF /end MEASUREMENT
/begin MEASUREMENT tabgm "Abgastemperatur vor Kat aus Modell" UBYTE temp_ub_q5_o50 0 0 -50.000000 1225.000000 /begin IF_DATA ASAP1B_ETK KP_BLOB 0x380A68 1 1 /end IF_DATA BIT_MASK 0xFF /end MEASUREMENT
/begin MEASUREMENT mrfgr_w "Relative Momentenanforderung von FGR" UWORD rel_uw_b200 0 0 0.000000 199.996948 /begin IF_DATA ASAP1B_ETK KP_BLOB 0x381D92 1 2 /end IF_DATA BIT_MASK 0xFFFF /end MEASUREMENT
/begin MEASUREMENT wnwue "Winkel Nockenwellenueberschneidung" UBYTE kw_ub_q0p5 0 0 0.000000 127.500000 /begin IF_DATA ASAP1B_ETK KP_BLOB 0x380B00 1 1 /end IF_DATA BIT_MASK 0xFF /end MEASUREMENT
/begin MEASUREMENT klaf_kge "" UWORD fak_uw_q0p001 0 0 0.000000 65.535000 /begin IF_DATA ASAP1B_ETK KP_BLOB 0x381E62 1 2 /end IF_DATA BIT_MASK 0xFFFF /end MEASUREMENT
/begin MEASUREMENT pspvds_w "Quotient Saugrohrdruck/Druck vor DK" UWORD fak_uw_b2 0 0 0.000000 1.999969 /begin IF_DATA ASAP1B_ETK KP_BLOB 0x381E7A 1 2 /end IF_DATA BIT_MASK 0xFFFF /end MEASUREMENT
/begin MEASUREMENT tempin "Temperatur Eingang (Adressierung von FWFTBRTA)" UBYTE temp_ub_q0p75_o48 0 0 -48.000000 143.250000 /begin IF_DATA ASAP1B_ETK KP_BLOB 0x380AF4 1 1 /end IF_DATA BIT_MASK 0xFF /end MEASUREMENT
/begin MEASUREMENT tmotfil "gefilterte Motortemperatur" UBYTE temp_ub_q0p75_o48 0 0 -48.000000 143.250000 /begin IF_DATA ASAP1B_ETK KP_BLOB 0x38334D 1 1 /end IF_DATA BIT_MASK 0xFF /end MEASUREMENT
/begin MEASUREMENT tsges_w "Saugrohrgesamttemperatur (nach AGR-Einleitung) (word)" SWORD temp_sw_q0p75 0 0 -24576.000000 24575.250000 /begin IF_DATA ASAP1B_ETK KP_BLOB 0x381EEC 1 2 /end IF_DATA BIT_MASK 0xFFFF /end MEASUREMENT
/begin MEASUREMENT fho_w "Korrekturfaktor Hîhe (word)" UWORD fak_uw_b4 0 0 0.000000 3.999939 /begin IF_DATA ASAP1B_ETK KP_BLOB 0x381E9A 1 2 /end IF_DATA BIT_MASK 0xFFFF /end MEASUREMENT
/begin MEASUREMENT tabst_w "Abstellzeit" UWORD t1sxs_uw_q1 0 0 0.000000 65535.000000 /begin IF_DATA ASAP1B_ETK KP_BLOB 0x382080 1 2 /end IF_DATA BIT_MASK 0xFFFF /end MEASUREMENT
/begin MEASUREMENT tmotab "Motortemperatur beim Abstellen" UBYTE temp_ub_q0p75_o48 0 0 -48.000000 143.250000 /begin IF_DATA ASAP1B_ETK KP_BLOB 0x38335E 1 1 /end IF_DATA BIT_MASK 0xFF /end MEASUREMENT
/begin MEASUREMENT ub "Batteriespannung" UBYTE spg_ubatt 0 0 0.000000 17.952000 /begin IF_DATA ASAP1B_ETK KP_BLOB 0x380AB1 1 1 /end IF_DATA BIT_MASK 0xFF /end MEASUREMENT
/begin MEASUREMENT mrfa_w "Relatives Fahrerwunschmoment aus FGR und Pedal" UWORD rel_uw_b200 0 0 0.000000 199.996948 /begin IF_DATA ASAP1B_ETK KP_BLOB 0x38244C 1 2 /end IF_DATA BIT_MASK 0xFFFF /end MEASUREMENT
/begin MEASUREMENT rlp_w "rel. LuftfÅllung praediziert fÅr Einspritzberechnung (Word)" UWORD rel_uw_q0p0234 0 0 0.000000 1535.976562 /begin IF_DATA ASAP1B_ETK KP_BLOB 0x381FD4 1 2 /end IF_DATA BIT_MASK 0xFFFF /end MEASUREMENT
/begin MEASUREMENT xqtm_w "Temperaturquotient" UWORD fak_uw_b16 0 0 0.000000 15.999756 /begin IF_DATA ASAP1B_ETK KP_BLOB 0x382082 1 2 /end IF_DATA BIT_MASK 0xFFFF /end MEASUREMENT
/begin MEASUREMENT tum_ein "Umgebungstemperatur fÅr Abstellzeitberechnung" UBYTE temp_ub_q0p75_o48 0 0 -48.000000 143.250000 /begin IF_DATA ASAP1B_ETK KP_BLOB 0x380B4C 1 1 /end IF_DATA BIT_MASK 0xFF /end MEASUREMENT
/begin MEASUREMENT tmrw "Motortemperatur-Referenzwert aus Modell" UBYTE temp_ub_q0p75_o48 0 0 -48.000000 143.250000 /begin IF_DATA ASAP1B_ETK KP_BLOB 0x380B5D 1 1 /end IF_DATA BIT_MASK 0xFF /end MEASUREMENT
/begin MEASUREMENT tmew "Motortemperatur-Ersatzwert aus Modell" UBYTE temp_ub_q0p75_o48 0 0 -48.000000 143.250000 /begin IF_DATA ASAP1B_ETK KP_BLOB 0x380B5A 1 1 /end IF_DATA BIT_MASK 0xFF /end MEASUREMENT
/begin MEASUREMENT evtmod "Einla·ventiltemperatur modelliert (Temperaturmodell)" UBYTE temp_ub_q0p75_o48 0 0 -48.000000 143.250000 /begin IF_DATA ASAP1B_ETK KP_BLOB 0x380AF0 1 1 /end IF_DATA BIT_MASK 0xFF /end MEASUREMENT
/begin MEASUREMENT tnst_w "Zeit nach Startende" UWORD t10msxs_uw_b655p35 0 0 0.000000 655.350000 /begin IF_DATA ASAP1B_ETK KP_BLOB 0x382672 1 2 /end IF_DATA BIT_MASK 0xFFFF /end MEASUREMENT
/begin MEASUREMENT mstedte "Massenstrom TEV fÅr DTEV" UBYTE m_ub_b25p6 0 0 0.000000 25.500000 /begin IF_DATA ASAP1B_ETK KP_BLOB 0x380CD4 1 1 /end IF_DATA BIT_MASK 0xFF /end MEASUREMENT
/begin MEASUREMENT msntate_kge "" UWORD rel_uw_b100 0 0 0.000000 99.998474 /begin IF_DATA ASAP1B_ETK KP_BLOB 0x3827C8 1 2 /end IF_DATA BIT_MASK 0xFFFF /end MEASUREMENT
/begin MEASUREMENT mshfm_w "Massenstrom HFM 16-Bit Grî·e" UWORD m_uw_b6553p5 0 0 0.000000 6553.500000 /begin IF_DATA ASAP1B_ETK KP_BLOB 0xF988 0 2 /end IF_DATA BIT_MASK 0xFFFF /end MEASUREMENT
/begin MEASUREMENT phtevpu_w "Quotient Druck hinter TEV / Umgebungsdruck" UWORD fak_uw_b2 0 0 0.000000 1.999969 /begin IF_DATA ASAP1B_ETK KP_BLOB 0x3827DA 1 2 /end IF_DATA BIT_MASK 0xFFFF /end MEASUREMENT
/begin MEASUREMENT agrr "AbgasrÅckfÅhrrate" UBYTE rel_ub_b99p6 0 0 0.000000 99.609375 /begin IF_DATA ASAP1B_ETK KP_BLOB 0x380AE7 1 1 /end IF_DATA BIT_MASK 0xFF /end MEASUREMENT
/begin MEASUREMENT agrr_w "AbgasrÅckfÅhrrate word" UWORD rel_uw_b100 0 0 0.000000 99.998474 /begin IF_DATA ASAP1B_ETK KP_BLOB 0x381E32 1 2 /end IF_DATA BIT_MASK 0xFFFF /end MEASUREMENT
/begin MEASUREMENT bbd2ctr "" UBYTE dez 0 0 0.000000 255.000000 /begin IF_DATA ASAP1B_ETK KP_BLOB 0x380A3A 1 1 /end IF_DATA BIT_MASK 0xFF /end MEASUREMENT
/begin MEASUREMENT bbdcy "Byte fÅr Bedingung B_dcy als Triggerevent in DCLA" UBYTE dez 0 0 0.000000 255.000000 /begin IF_DATA ASAP1B_ETK KP_BLOB 0x380A32 1 1 /end IF_DATA BIT_MASK 0xFF /end MEASUREMENT
/begin MEASUREMENT bbno "Byte fÅr Bedingung B_no  als Triggerevent in DCLA" UBYTE dez 0 0 0.000000 255.000000 /begin IF_DATA ASAP1B_ETK KP_BLOB 0x383301 1 1 /end IF_DATA BIT_MASK 0xFF /end MEASUREMENT
/begin MEASUREMENT bbsp3 "Byte fÅr Bedingung B_sp3 als Triggerevent in DCLA" UBYTE dez 0 0 0.000000 255.000000 /begin IF_DATA ASAP1B_ETK KP_BLOB 0x383302 1 1 /end IF_DATA BIT_MASK 0xFF /end MEASUREMENT
/begin MEASUREMENT bbtim "Byte fÅr Bedingung B_tim als Triggerevent in DCLA" UBYTE dez 0 0 0.000000 255.000000 /begin IF_DATA ASAP1B_ETK KP_BLOB 0x380A33 1 1 /end IF_DATA BIT_MASK 0xFF /end MEASUREMENT
/begin MEASUREMENT bbwuc "Byte fÅr Bedingung B_wuc als Triggerevent in DCLA" UBYTE dez 0 0 0.000000 255.000000 /begin IF_DATA ASAP1B_ETK KP_BLOB 0x380A36 1 1 /end IF_DATA BIT_MASK 0xFF /end MEASUREMENT
/begin MEASUREMENT BGTABSTbits "" UBYTE dez 0 0 0.000000 255.000000 /begin IF_DATA ASAP1B_ETK KP_BLOB 0x383359 1 1 /end IF_DATA BIT_MASK 0xFF /end MEASUREMENT
/begin MEASUREMENT bmfz_w "ZÑhler BM-Fehler fÅr DG Diagnose" UWORD dez___UW 0 0 0.000000 65535.000000 /begin IF_DATA ASAP1B_ETK KP_BLOB 0x381AAA 1 2 /end IF_DATA BIT_MASK 0xFFFF /end MEASUREMENT
/begin MEASUREMENT bmLosCtr_w "ZÑhler (Word) Neusynchronisationen durch LÅckenverlust" UWORD dez___UW 0 0 0.000000 65535.000000 /begin IF_DATA ASAP1B_ETK KP_BLOB 0x383C30 1 2 /end IF_DATA BIT_MASK 0xFFFF /end MEASUREMENT
/begin MEASUREMENT bs "Signal Beschleunigungssensor Rad" UBYTE bs_ub_q0p049_o6p25 0 0 -6.274510 6.225490 /begin IF_DATA ASAP1B_ETK KP_BLOB 0x380C59 1 1 /end IF_DATA BIT_MASK 0xFF /end MEASUREMENT
/begin MEASUREMENT bz_can "BotschaftszÑhler bei ASR/MSR" UBYTE DEZ 0 0 0.000000 255.000000 /begin IF_DATA ASAP1B_ETK KP_BLOB 0x3809BE 1 1 /end IF_DATA BIT_MASK 0xFF /end MEASUREMENT
/begin MEASUREMENT bz_gra "CAN-BotschaftszÑhler fÅr GRA" UBYTE DEZ 0 0 0.000000 255.000000 /begin IF_DATA ASAP1B_ETK KP_BLOB 0x3809BF 1 1 /end IF_DATA BIT_MASK 0xFF /end MEASUREMENT
/begin MEASUREMENT bz_msr "MSR-BotschaftszÑhler" UBYTE DEZ 0 0 0.000000 255.000000 /begin IF_DATA ASAP1B_ETK KP_BLOB 0x3809C0 1 1 /end IF_DATA BIT_MASK 0xFF /end MEASUREMENT
/begin MEASUREMENT B_aava "Bedingung Endstufendiagnose AAV auf" UWORD B_TRUE___UW 0 0 0.000000 0.000000 /begin IF_DATA ASAP1B_ETK KP_BLOB 0xFD56 0 2 /end IF_DATA BIT_MASK 0x8 /end MEASUREMENT
/begin MEASUREMENT B_aavz "Bedingung Endstufendiagnose AAV zu" UWORD B_TRUE___UW 0 0 0.000000 0.000000 /begin IF_DATA ASAP1B_ETK KP_BLOB 0xFD56 0 2 /end IF_DATA BIT_MASK 0x10 /end MEASUREMENT
/begin MEASUREMENT B_abgle "Bedingung: Fehler beim VerstÑrkerabgleich" UWORD B_TRUE___UW 0 0 0.000000 0.000000 /begin IF_DATA ASAP1B_ETK KP_BLOB 0xFD40 0 2 /end IF_DATA BIT_MASK 0x10 /end MEASUREMENT
/begin MEASUREMENT B_abstnl "Bedingung Abstellzeitermittlung Åber SG-Nachlauf" UWORD B_TRUE___UW 0 0 0.000000 0.000000 /begin IF_DATA ASAP1B_ETK KP_BLOB 0xFD00 0 2 /end IF_DATA BIT_MASK 0x2 /end MEASUREMENT
/begin MEASUREMENT B_abstnlg "Bedingung Abstellzeitermittlung Åber SG-Nachlauf ist gÅltig" UBYTE B_TRUE 0 0 0.000000 0.000000 /begin IF_DATA ASAP1B_ETK KP_BLOB 0x383359 1 1 /end IF_DATA BIT_MASK 0x1 /end MEASUREMENT
/begin MEASUREMENT B_abstnlgp "Bedingung Abstellzeitermittlung Åber SG-Nachlauf gÅltig und plausibel" UWORD B_TRUE___UW 0 0 0.000000 0.000000 /begin IF_DATA ASAP1B_ETK KP_BLOB 0xFD64 0 2 /end IF_DATA BIT_MASK 0x200 /end MEASUREMENT
/begin MEASUREMENT B_acc "Bedingung: ACC-SteuergerÑt vorhanden" UWORD B_TRUE___UW 0 0 0.000000 0.000000 /begin IF_DATA ASAP1B_ETK KP_BLOB 0xFD74 0 2 /end IF_DATA BIT_MASK 0x20 /end MEASUREMENT
/begin MEASUREMENT B_amsrf "Bedingung ASR-MSR Konsistenzfehler" UWORD B_TRUE___UW 0 0 0.000000 0.000000 /begin IF_DATA ASAP1B_ETK KP_BLOB 0xFD0E 0 2 /end IF_DATA BIT_MASK 0x1 /end MEASUREMENT
/begin MEASUREMENT B_amsrinpl "Bedingung ASR/MSR-Eingriff irreversibel verboten" UWORD B_TRUE___UW 0 0 0.000000 0.000000 /begin IF_DATA ASAP1B_ETK KP_BLOB 0xFD0E 0 2 /end IF_DATA BIT_MASK 0x2 /end MEASUREMENT
/begin MEASUREMENT B_amsrknpl "Bedingung unplausible KonsistenzprÅfung bei ASR/MSR" UWORD B_TRUE___UW 0 0 0.000000 0.000000 /begin IF_DATA ASAP1B_ETK KP_BLOB 0xFD0E 0 2 /end IF_DATA BIT_MASK 0x4 /end MEASUREMENT
/begin MEASUREMENT B_amsrn "Bedingung ASR-MSR nicht aktiv" UWORD B_TRUE___UW 0 0 0.000000 0.000000 /begin IF_DATA ASAP1B_ETK KP_BLOB 0xFD0E 0 2 /end IF_DATA BIT_MASK 0x8 /end MEASUREMENT
/begin MEASUREMENT B_amsrnbot "Bedingung keine neue ASR/MSR-Botschaft erhalten" UWORD B_TRUE___UW 0 0 0.000000 0.000000 /begin IF_DATA ASAP1B_ETK KP_BLOB 0xFD0E 0 2 /end IF_DATA BIT_MASK 0x10 /end MEASUREMENT
/begin MEASUREMENT B_asr "Bedingung fÅr ASR aktiv" UWORD B_TRUE___UW 0 0 0.000000 0.000000 /begin IF_DATA ASAP1B_ETK KP_BLOB 0xFD82 0 2 /end IF_DATA BIT_MASK 0x8 /end MEASUREMENT
/begin MEASUREMENT B_asrakt "ASR-Funktion aktiviert" UWORD B_TRUE___UW 0 0 0.000000 0.000000 /begin IF_DATA ASAP1B_ETK KP_BLOB 0xFD0E 0 2 /end IF_DATA BIT_MASK 0x20 /end MEASUREMENT
/begin MEASUREMENT B_asresp "Bedingung ASR/ESP verbaut" UWORD B_TRUE___UW 0 0 0.000000 0.000000 /begin IF_DATA ASAP1B_ETK KP_BLOB 0xFD0E 0 2 /end IF_DATA BIT_MASK 0x40 /end MEASUREMENT
/begin MEASUREMENT B_asr_can "Bedingung ASR-Anforderung Åber CAN" UWORD B_TRUE___UW 0 0 0.000000 0.000000 /begin IF_DATA ASAP1B_ETK KP_BLOB 0xFD0E 0 2 /end IF_DATA BIT_MASK 0x80 /end MEASUREMENT
/begin MEASUREMENT B_avcadr "" UWORD B_TRUE___UW 0 0 0.000000 0.000000 /begin IF_DATA ASAP1B_ETK KP_BLOB 0x383AFC 1 2 /end IF_DATA BIT_MASK 0x1000 /end MEASUREMENT
/begin MEASUREMENT B_avcas "" UWORD B_TRUE___UW 0 0 0.000000 0.000000 /begin IF_DATA ASAP1B_ETK KP_BLOB 0x383AFE 1 2 /end IF_DATA BIT_MASK 0x1000 /end MEASUREMENT
/begin MEASUREMENT B_avcat "" UWORD B_TRUE___UW 0 0 0.000000 0.000000 /begin IF_DATA ASAP1B_ETK KP_BLOB 0x383B00 1 2 /end IF_DATA BIT_MASK 0x1000 /end MEASUREMENT
/begin MEASUREMENT B_avcge "" UWORD B_TRUE___UW 0 0 0.000000 0.000000 /begin IF_DATA ASAP1B_ETK KP_BLOB 0x383B02 1 2 /end IF_DATA BIT_MASK 0x1000 /end MEASUREMENT
/begin MEASUREMENT B_avcif "" UWORD B_TRUE___UW 0 0 0.000000 0.000000 /begin IF_DATA ASAP1B_ETK KP_BLOB 0x383B04 1 2 /end IF_DATA BIT_MASK 0x1000 /end MEASUREMENT
/begin MEASUREMENT B_avcins "" UWORD B_TRUE___UW 0 0 0.000000 0.000000 /begin IF_DATA ASAP1B_ETK KP_BLOB 0x383B06 1 2 /end IF_DATA BIT_MASK 0x1000 /end MEASUREMENT
/begin MEASUREMENT B_avclws "" UWORD B_TRUE___UW 0 0 0.000000 0.000000 /begin IF_DATA ASAP1B_ETK KP_BLOB 0x383B08 1 2 /end IF_DATA BIT_MASK 0x1000 /end MEASUREMENT
/begin MEASUREMENT B_bebm "" UWORD B_TRUE___UW 0 0 0.000000 0.000000 /begin IF_DATA ASAP1B_ETK KP_BLOB 0x383AF6 1 2 /end IF_DATA BIT_MASK 0x20 /end MEASUREMENT
/begin MEASUREMENT B_becadr "" UWORD B_TRUE___UW 0 0 0.000000 0.000000 /begin IF_DATA ASAP1B_ETK KP_BLOB 0x383AFC 1 2 /end IF_DATA BIT_MASK 0x20 /end MEASUREMENT
/begin MEASUREMENT B_becas "" UWORD B_TRUE___UW 0 0 0.000000 0.000000 /begin IF_DATA ASAP1B_ETK KP_BLOB 0x383AFE 1 2 /end IF_DATA BIT_MASK 0x20 /end MEASUREMENT
/begin MEASUREMENT B_becat "" UWORD B_TRUE___UW 0 0 0.000000 0.000000 /begin IF_DATA ASAP1B_ETK KP_BLOB 0x383B00 1 2 /end IF_DATA BIT_MASK 0x20 /end MEASUREMENT
/begin MEASUREMENT B_becge "" UWORD B_TRUE___UW 0 0 0.000000 0.000000 /begin IF_DATA ASAP1B_ETK KP_BLOB 0x383B02 1 2 /end IF_DATA BIT_MASK 0x20 /end MEASUREMENT
/begin MEASUREMENT B_becif "" UWORD B_TRUE___UW 0 0 0.000000 0.000000 /begin IF_DATA ASAP1B_ETK KP_BLOB 0x383B04 1 2 /end IF_DATA BIT_MASK 0x20 /end MEASUREMENT
/begin MEASUREMENT B_becins "" UWORD B_TRUE___UW 0 0 0.000000 0.000000 /begin IF_DATA ASAP1B_ETK KP_BLOB 0x383B06 1 2 /end IF_DATA BIT_MASK 0x20 /end MEASUREMENT
/begin MEASUREMENT B_beclws "" UWORD B_TRUE___UW 0 0 0.000000 0.000000 /begin IF_DATA ASAP1B_ETK KP_BLOB 0x383B08 1 2 /end IF_DATA BIT_MASK 0x20 /end MEASUREMENT
/begin MEASUREMENT B_bedk "" UWORD B_TRUE___UW 0 0 0.000000 0.000000 /begin IF_DATA ASAP1B_ETK KP_BLOB 0x383B0A 1 2 /end IF_DATA BIT_MASK 0x20 /end MEASUREMENT
/begin MEASUREMENT B_bedk1p "" UWORD B_TRUE___UW 0 0 0.000000 0.000000 /begin IF_DATA ASAP1B_ETK KP_BLOB 0x383B0C 1 2 /end IF_DATA BIT_MASK 0x20 /end MEASUREMENT
/begin MEASUREMENT B_bedk2p "" UWORD B_TRUE___UW 0 0 0.000000 0.000000 /begin IF_DATA ASAP1B_ETK KP_BLOB 0x383B0E 1 2 /end IF_DATA BIT_MASK 0x20 /end MEASUREMENT
/begin MEASUREMENT B_bedvee "" UWORD B_TRUE___UW 0 0 0.000000 0.000000 /begin IF_DATA ASAP1B_ETK KP_BLOB 0x383B1A 1 2 /end IF_DATA BIT_MASK 0x20 /end MEASUREMENT
/begin MEASUREMENT B_bedvef "" UWORD B_TRUE___UW 0 0 0.000000 0.000000 /begin IF_DATA ASAP1B_ETK KP_BLOB 0x383B1C 1 2 /end IF_DATA BIT_MASK 0x20 /end MEASUREMENT
/begin MEASUREMENT B_bedvefo "" UWORD B_TRUE___UW 0 0 0.000000 0.000000 /begin IF_DATA ASAP1B_ETK KP_BLOB 0x383B1E 1 2 /end IF_DATA BIT_MASK 0x20 /end MEASUREMENT
/begin MEASUREMENT B_bedvel "" UWORD B_TRUE___UW 0 0 0.000000 0.000000 /begin IF_DATA ASAP1B_ETK KP_BLOB 0x383B20 1 2 /end IF_DATA BIT_MASK 0x20 /end MEASUREMENT
/begin MEASUREMENT B_bedven "" UWORD B_TRUE___UW 0 0 0.000000 0.000000 /begin IF_DATA ASAP1B_ETK KP_BLOB 0x383B22 1 2 /end IF_DATA BIT_MASK 0x20 /end MEASUREMENT
/begin MEASUREMENT B_bedver "" UWORD B_TRUE___UW 0 0 0.000000 0.000000 /begin IF_DATA ASAP1B_ETK KP_BLOB 0x383B24 1 2 /end IF_DATA BIT_MASK 0x20 /end MEASUREMENT
/begin MEASUREMENT B_bedvet "" UWORD B_TRUE___UW 0 0 0.000000 0.000000 /begin IF_DATA ASAP1B_ETK KP_BLOB 0x383B26 1 2 /end IF_DATA BIT_MASK 0x20 /end MEASUREMENT
/begin MEASUREMENT B_bedveu "" UWORD B_TRUE___UW 0 0 0.000000 0.000000 /begin IF_DATA ASAP1B_ETK KP_BLOB 0x383B28 1 2 /end IF_DATA BIT_MASK 0x20 /end MEASUREMENT
/begin MEASUREMENT B_bedveub "" UWORD B_TRUE___UW 0 0 0.000000 0.000000 /begin IF_DATA ASAP1B_ETK KP_BLOB 0x383B2A 1 2 /end IF_DATA BIT_MASK 0x20 /end MEASUREMENT
/begin MEASUREMENT B_bedveuw "" UWORD B_TRUE___UW 0 0 0.000000 0.000000 /begin IF_DATA ASAP1B_ETK KP_BLOB 0x383B2C 1 2 /end IF_DATA BIT_MASK 0x20 /end MEASUREMENT
/begin MEASUREMENT B_bedvev "" UWORD B_TRUE___UW 0 0 0.000000 0.000000 /begin IF_DATA ASAP1B_ETK KP_BLOB 0x383B2E 1 2 /end IF_DATA BIT_MASK 0x20 /end MEASUREMENT
/begin MEASUREMENT B_ben "" UWORD B_TRUE___UW 0 0 0.000000 0.000000 /begin IF_DATA ASAP1B_ETK KP_BLOB 0x383BBA 1 2 /end IF_DATA BIT_MASK 0x20 /end MEASUREMENT
/begin MEASUREMENT B_besch "Bedingung FGR im Zustand Beschleunigen" UWORD B_TRUE___UW 0 0 0.000000 0.000000 /begin IF_DATA ASAP1B_ETK KP_BLOB 0xFD4E 0 2 /end IF_DATA BIT_MASK 0x8 /end MEASUREMENT
/begin MEASUREMENT B_bkbm "Bedingung Ersatzwert aktiv: Bezugsmarke" UWORD B_TRUE___UW 0 0 0.000000 0.000000 /begin IF_DATA ASAP1B_ETK KP_BLOB 0x383AF6 1 2 /end IF_DATA BIT_MASK 0x40 /end MEASUREMENT
/begin MEASUREMENT B_bkcadr "Bedingung: CAN-Schnittstelle, Timeout Botschaft ADR" UWORD B_TRUE___UW 0 0 0.000000 0.000000 /begin IF_DATA ASAP1B_ETK KP_BLOB 0x383AFC 1 2 /end IF_DATA BIT_MASK 0x40 /end MEASUREMENT
/begin MEASUREMENT B_bkcas "Bedingung: CAN-Schnittstelle, Timeout ASC" UWORD B_TRUE___UW 0 0 0.000000 0.000000 /begin IF_DATA ASAP1B_ETK KP_BLOB 0x383AFE 1 2 /end IF_DATA BIT_MASK 0x40 /end MEASUREMENT
/begin MEASUREMENT B_bkcat "Bedingung: CAN-Schnittstelle, Timeout ASR" UWORD B_TRUE___UW 0 0 0.000000 0.000000 /begin IF_DATA ASAP1B_ETK KP_BLOB 0x383B00 1 2 /end IF_DATA BIT_MASK 0x40 /end MEASUREMENT
/begin MEASUREMENT B_bkcge "Bedingung: CAN-Schnittstelle, Timeout EGS" UWORD B_TRUE___UW 0 0 0.000000 0.000000 /begin IF_DATA ASAP1B_ETK KP_BLOB 0x383B02 1 2 /end IF_DATA BIT_MASK 0x40 /end MEASUREMENT
/begin MEASUREMENT B_bkcif "Bedingung: CAN-Schnittstelle, interner Fehler" UWORD B_TRUE___UW 0 0 0.000000 0.000000 /begin IF_DATA ASAP1B_ETK KP_BLOB 0x383B04 1 2 /end IF_DATA BIT_MASK 0x40 /end MEASUREMENT
/begin MEASUREMENT B_bkcins "Bedingung: CAN-Schnittstelle, Timeout Instrument" UWORD B_TRUE___UW 0 0 0.000000 0.000000 /begin IF_DATA ASAP1B_ETK KP_BLOB 0x383B06 1 2 /end IF_DATA BIT_MASK 0x40 /end MEASUREMENT
/begin MEASUREMENT B_bkclws "Bedingung: CAN-Schnittstelle, Timeout Botschaft Lenkwinkelsensor" UWORD B_TRUE___UW 0 0 0.000000 0.000000 /begin IF_DATA ASAP1B_ETK KP_BLOB 0x383B08 1 2 /end IF_DATA BIT_MASK 0x40 /end MEASUREMENT
/begin MEASUREMENT B_bkdk "Bedingung Eratzwert aktiv: Fehler Drosselklappenpoti lîschen" UWORD B_TRUE___UW 0 0 0.000000 0.000000 /begin IF_DATA ASAP1B_ETK KP_BLOB 0x383B0A 1 2 /end IF_DATA BIT_MASK 0x40 /end MEASUREMENT
/begin MEASUREMENT B_bkdk1p "Bedingung Ersatzwert aktiv: Drosselklappe 1.Poti" UWORD B_TRUE___UW 0 0 0.000000 0.000000 /begin IF_DATA ASAP1B_ETK KP_BLOB 0x383B0C 1 2 /end IF_DATA BIT_MASK 0x40 /end MEASUREMENT
/begin MEASUREMENT B_bkdk2p "Bedingung Ersatzwert aktiv: Drosselklappe 2.Poti" UWORD B_TRUE___UW 0 0 0.000000 0.000000 /begin IF_DATA ASAP1B_ETK KP_BLOB 0x383B0E 1 2 /end IF_DATA BIT_MASK 0x40 /end MEASUREMENT
/begin MEASUREMENT B_bkdvee "Bedingung: DV-E Endstufe" UWORD B_TRUE___UW 0 0 0.000000 0.000000 /begin IF_DATA ASAP1B_ETK KP_BLOB 0x383B1A 1 2 /end IF_DATA BIT_MASK 0x40 /end MEASUREMENT
/begin MEASUREMENT B_bkdvef "Bedingung: DV-E Fehler bei FederprÅfung" UWORD B_TRUE___UW 0 0 0.000000 0.000000 /begin IF_DATA ASAP1B_ETK KP_BLOB 0x383B1C 1 2 /end IF_DATA BIT_MASK 0x40 /end MEASUREMENT
/begin MEASUREMENT B_bkdvefo "" UWORD B_TRUE___UW 0 0 0.000000 0.000000 /begin IF_DATA ASAP1B_ETK KP_BLOB 0x383B1E 1 2 /end IF_DATA BIT_MASK 0x40 /end MEASUREMENT
/begin MEASUREMENT B_bkdvel "Bedingung: DV-E Lageabweichung" UWORD B_TRUE___UW 0 0 0.000000 0.000000 /begin IF_DATA ASAP1B_ETK KP_BLOB 0x383B20 1 2 /end IF_DATA BIT_MASK 0x40 /end MEASUREMENT
/begin MEASUREMENT B_bkdven "Ersatzwert aktiv: DV-E Notluftposition" UWORD B_TRUE___UW 0 0 0.000000 0.000000 /begin IF_DATA ASAP1B_ETK KP_BLOB 0x383B22 1 2 /end IF_DATA BIT_MASK 0x40 /end MEASUREMENT
/begin MEASUREMENT B_bkdver "Bedingung: DV-E Regelbereich" UWORD B_TRUE___UW 0 0 0.000000 0.000000 /begin IF_DATA ASAP1B_ETK KP_BLOB 0x383B24 1 2 /end IF_DATA BIT_MASK 0x40 /end MEASUREMENT
/begin MEASUREMENT B_bkdvet "" UWORD B_TRUE___UW 0 0 0.000000 0.000000 /begin IF_DATA ASAP1B_ETK KP_BLOB 0x383B26 1 2 /end IF_DATA BIT_MASK 0x40 /end MEASUREMENT
/begin MEASUREMENT B_bkdveu "Ersatzwert aktiv: DV-E UMA-Lernen" UWORD B_TRUE___UW 0 0 0.000000 0.000000 /begin IF_DATA ASAP1B_ETK KP_BLOB 0x383B28 1 2 /end IF_DATA BIT_MASK 0x40 /end MEASUREMENT
/begin MEASUREMENT B_bkdveub "" UWORD B_TRUE___UW 0 0 0.000000 0.000000 /begin IF_DATA ASAP1B_ETK KP_BLOB 0x383B2A 1 2 /end IF_DATA BIT_MASK 0x40 /end MEASUREMENT
/begin MEASUREMENT B_bkdveuw "Bedingung Ersatzwert aktiv: Fehler bei UMA-Wiederlernen" UWORD B_TRUE___UW 0 0 0.000000 0.000000 /begin IF_DATA ASAP1B_ETK KP_BLOB 0x383B2C 1 2 /end IF_DATA BIT_MASK 0x40 /end MEASUREMENT
/begin MEASUREMENT B_bkdvev "Ersatzwert aktiv: DV-E VerstÑrkerabgleich" UWORD B_TRUE___UW 0 0 0.000000 0.000000 /begin IF_DATA ASAP1B_ETK KP_BLOB 0x383B2E 1 2 /end IF_DATA BIT_MASK 0x40 /end MEASUREMENT
/begin MEASUREMENT B_bkn "Bedingung: Drehzahlsignalgeber aktiv" UWORD B_TRUE___UW 0 0 0.000000 0.000000 /begin IF_DATA ASAP1B_ETK KP_BLOB 0x383BBA 1 2 /end IF_DATA BIT_MASK 0x40 /end MEASUREMENT
/begin MEASUREMENT B_bkva "Bedingung BKV angesteuert" UWORD B_TRUE___UW 0 0 0.000000 0.000000 /begin IF_DATA ASAP1B_ETK KP_BLOB 0xFD0E 0 2 /end IF_DATA BIT_MASK 0x100 /end MEASUREMENT
/begin MEASUREMENT B_bkvv "Bedingung BKV verbaut (fÅr Auswertung Bremse)" UWORD B_TRUE___UW 0 0 0.000000 0.000000 /begin IF_DATA ASAP1B_ETK KP_BLOB 0xFD0E 0 2 /end IF_DATA BIT_MASK 0x200 /end MEASUREMENT
/begin MEASUREMENT B_bkvvc "Bedingung BKV verbaut (Rohsignal)" UWORD B_TRUE___UW 0 0 0.000000 0.000000 /begin IF_DATA ASAP1B_ETK KP_BLOB 0xFD0E 0 2 /end IF_DATA BIT_MASK 0x400 /end MEASUREMENT
/begin MEASUREMENT B_br1en "Bedingung Empfang Botschaft Bremse 1" UWORD B_TRUE___UW 0 0 0.000000 0.000000 /begin IF_DATA ASAP1B_ETK KP_BLOB 0xFD0E 0 2 /end IF_DATA BIT_MASK 0x800 /end MEASUREMENT
/begin MEASUREMENT B_ckien "Bedingung CAN-öbertragung vom Kombiinstrument enable" UWORD B_TRUE___UW 0 0 0.000000 0.000000 /begin IF_DATA ASAP1B_ETK KP_BLOB 0xFD0E 0 2 /end IF_DATA BIT_MASK 0x1000 /end MEASUREMENT
/begin MEASUREMENT B_clbm "Bedingung Fehlerpfad Bezugsmarkengeber lîschen" UWORD B_TRUE___UW 0 0 0.000000 0.000000 /begin IF_DATA ASAP1B_ETK KP_BLOB 0x383AF6 1 2 /end IF_DATA BIT_MASK 0x80 /end MEASUREMENT
/begin MEASUREMENT B_clcadr "Bedingung CAN-Schnittstelle, Timeout Botschaft ADR lîschen" UWORD B_TRUE___UW 0 0 0.000000 0.000000 /begin IF_DATA ASAP1B_ETK KP_BLOB 0x383AFC 1 2 /end IF_DATA BIT_MASK 0x80 /end MEASUREMENT
/begin MEASUREMENT B_clcas "Bedingung Fehlerpfad CAS lîschen" UWORD B_TRUE___UW 0 0 0.000000 0.000000 /begin IF_DATA ASAP1B_ETK KP_BLOB 0x383AFE 1 2 /end IF_DATA BIT_MASK 0x80 /end MEASUREMENT
/begin MEASUREMENT B_clcat "Bedingung Fehlerpfad CAT lîschen" UWORD B_TRUE___UW 0 0 0.000000 0.000000 /begin IF_DATA ASAP1B_ETK KP_BLOB 0x383B00 1 2 /end IF_DATA BIT_MASK 0x80 /end MEASUREMENT
/begin MEASUREMENT B_clcge "Bedingung Fehlerpfad CGE lîschen" UWORD B_TRUE___UW 0 0 0.000000 0.000000 /begin IF_DATA ASAP1B_ETK KP_BLOB 0x383B02 1 2 /end IF_DATA BIT_MASK 0x80 /end MEASUREMENT
/begin MEASUREMENT B_clcif "Bedingung Fehlerpfad CIF lîschen" UWORD B_TRUE___UW 0 0 0.000000 0.000000 /begin IF_DATA ASAP1B_ETK KP_BLOB 0x383B04 1 2 /end IF_DATA BIT_MASK 0x80 /end MEASUREMENT
/begin MEASUREMENT B_clcins "Bedingung Fehlerpfad CINS lîschen" UWORD B_TRUE___UW 0 0 0.000000 0.000000 /begin IF_DATA ASAP1B_ETK KP_BLOB 0x383B06 1 2 /end IF_DATA BIT_MASK 0x80 /end MEASUREMENT
/begin MEASUREMENT B_clclws "Bedingung CAN-Schnittstelle, Timeout Botschaft Lenkwinkelsensor lîschen" UWORD B_TRUE___UW 0 0 0.000000 0.000000 /begin IF_DATA ASAP1B_ETK KP_BLOB 0x383B08 1 2 /end IF_DATA BIT_MASK 0x80 /end MEASUREMENT
/begin MEASUREMENT B_cldk "Bedingung Fehlerpfad DK (Drosselklappen-Poti) lîschen" UWORD B_TRUE___UW 0 0 0.000000 0.000000 /begin IF_DATA ASAP1B_ETK KP_BLOB 0x383B0A 1 2 /end IF_DATA BIT_MASK 0x80 /end MEASUREMENT
/begin MEASUREMENT B_cldk1p "Bedingung Fehlerpfad DK1P (Drosselklappen-Poti 1) lîschen" UWORD B_TRUE___UW 0 0 0.000000 0.000000 /begin IF_DATA ASAP1B_ETK KP_BLOB 0x383B0C 1 2 /end IF_DATA BIT_MASK 0x80 /end MEASUREMENT
/begin MEASUREMENT B_cldk2p "Bedingung Fehlerpfad DK2P (Drosselklappen-Poti 2) lîschen" UWORD B_TRUE___UW 0 0 0.000000 0.000000 /begin IF_DATA ASAP1B_ETK KP_BLOB 0x383B0E 1 2 /end IF_DATA BIT_MASK 0x80 /end MEASUREMENT
/begin MEASUREMENT B_cldvee "Flag fÅr Lîschma·nahmen: DV-E Endstufe" UWORD B_TRUE___UW 0 0 0.000000 0.000000 /begin IF_DATA ASAP1B_ETK KP_BLOB 0x383B1A 1 2 /end IF_DATA BIT_MASK 0x80 /end MEASUREMENT
/begin MEASUREMENT B_cldvef "Flag fÅr Lîschung: DV-E Fehler bei FederprÅfung" UWORD B_TRUE___UW 0 0 0.000000 0.000000 /begin IF_DATA ASAP1B_ETK KP_BLOB 0x383B1C 1 2 /end IF_DATA BIT_MASK 0x80 /end MEASUREMENT
/begin MEASUREMENT B_cldvefo "Flag fÅr Lîschung: Fehler bei FederprÅfung 'ôffnen'" UWORD B_TRUE___UW 0 0 0.000000 0.000000 /begin IF_DATA ASAP1B_ETK KP_BLOB 0x383B1E 1 2 /end IF_DATA BIT_MASK 0x80 /end MEASUREMENT
/begin MEASUREMENT B_cldvel "Flag fÅr Lîschma·nahmen: DV-E Lageabweichung" UWORD B_TRUE___UW 0 0 0.000000 0.000000 /begin IF_DATA ASAP1B_ETK KP_BLOB 0x383B20 1 2 /end IF_DATA BIT_MASK 0x80 /end MEASUREMENT
/begin MEASUREMENT B_cldven "Flag fÅr Lîschung: DV-E Fehler bei PrÅfung Notluftposition" UWORD B_TRUE___UW 0 0 0.000000 0.000000 /begin IF_DATA ASAP1B_ETK KP_BLOB 0x383B22 1 2 /end IF_DATA BIT_MASK 0x80 /end MEASUREMENT
/begin MEASUREMENT B_cldver "Flag fÅr Lîschma·nahmen: DV-E Regelabweichung" UWORD B_TRUE___UW 0 0 0.000000 0.000000 /begin IF_DATA ASAP1B_ETK KP_BLOB 0x383B24 1 2 /end IF_DATA BIT_MASK 0x80 /end MEASUREMENT
/begin MEASUREMENT B_cldvet "Flag fÅr Lîschung: DV-E-Tauscherkennung ohne Adaption" UWORD B_TRUE___UW 0 0 0.000000 0.000000 /begin IF_DATA ASAP1B_ETK KP_BLOB 0x383B26 1 2 /end IF_DATA BIT_MASK 0x80 /end MEASUREMENT
/begin MEASUREMENT B_cldveu "Flag fÅr Lîschung: DV-E Fehler beim UMA-Lernen" UWORD B_TRUE___UW 0 0 0.000000 0.000000 /begin IF_DATA ASAP1B_ETK KP_BLOB 0x383B28 1 2 /end IF_DATA BIT_MASK 0x80 /end MEASUREMENT
/begin MEASUREMENT B_cldveub "Flag fÅr Lîschung: DV-E-Adaption Abbruch wg. Umweltbedingung" UWORD B_TRUE___UW 0 0 0.000000 0.000000 /begin IF_DATA ASAP1B_ETK KP_BLOB 0x383B2A 1 2 /end IF_DATA BIT_MASK 0x80 /end MEASUREMENT
/begin MEASUREMENT B_cldveuw "Flag fÅr Lîschung: Fehler bei UMA-Wiederlernen" UWORD B_TRUE___UW 0 0 0.000000 0.000000 /begin IF_DATA ASAP1B_ETK KP_BLOB 0x383B2C 1 2 /end IF_DATA BIT_MASK 0x80 /end MEASUREMENT
/begin MEASUREMENT B_cldvev "Flag fÅr Lîschung: DV-E Fehler bei VerstÑrkerabgleich" UWORD B_TRUE___UW 0 0 0.000000 0.000000 /begin IF_DATA ASAP1B_ETK KP_BLOB 0x383B2E 1 2 /end IF_DATA BIT_MASK 0x80 /end MEASUREMENT
/begin MEASUREMENT B_cln "Bedingung Fehlerpfad Drehzahlgeber lîschen" UWORD B_TRUE___UW 0 0 0.000000 0.000000 /begin IF_DATA ASAP1B_ETK KP_BLOB 0x383BBA 1 2 /end IF_DATA BIT_MASK 0x80 /end MEASUREMENT
/begin MEASUREMENT B_ctout "Bedingung: CAN-timeout PrÅfung" UWORD B_TRUE___UW 0 0 0.000000 0.000000 /begin IF_DATA ASAP1B_ETK KP_BLOB 0xFD0E 0 2 /end IF_DATA BIT_MASK 0x2000 /end MEASUREMENT
/begin MEASUREMENT B_cvtad "Bedingung Adaptionsfreigabe bei CVT-Getriebe" UWORD B_TRUE___UW 0 0 0.000000 0.000000 /begin IF_DATA ASAP1B_ETK KP_BLOB 0xFD0E 0 2 /end IF_DATA BIT_MASK 0x4000 /end MEASUREMENT
/begin MEASUREMENT B_dcy "Bedingung 'driving cycle' erkannt" UBYTE B_TRUE 0 0 0.000000 0.000000 /begin IF_DATA ASAP1B_ETK KP_BLOB 0x380A32 1 1 /end IF_DATA BIT_MASK 0x1 /end MEASUREMENT
/begin MEASUREMENT B_desee "Diagnose Endstufe: Eingangsbedingungen erfÅllt" UWORD B_TRUE___UW 0 0 0.000000 0.000000 /begin IF_DATA ASAP1B_ETK KP_BLOB 0xFD54 0 2 /end IF_DATA BIT_MASK 0x100 /end MEASUREMENT
/begin MEASUREMENT B_dkaden "Bedingung: DK-Sollwert aus DK-Adaption und -PrÅfung verwenden" UWORD B_TRUE___UW 0 0 0.000000 0.000000 /begin IF_DATA ASAP1B_ETK KP_BLOB 0xFD40 0 2 /end IF_DATA BIT_MASK 0x40 /end MEASUREMENT
/begin MEASUREMENT B_dknolu "Bedingung Drosselklappensteller stromlos" UWORD B_TRUE___UW 0 0 0.000000 0.000000 /begin IF_DATA ASAP1B_ETK KP_BLOB 0xFD46 0 2 /end IF_DATA BIT_MASK 0x100 /end MEASUREMENT
/begin MEASUREMENT B_dkp1e "Bedingung Fehler DK-Poti 1" UWORD B_TRUE___UW 0 0 0.000000 0.000000 /begin IF_DATA ASAP1B_ETK KP_BLOB 0xFD3C 0 2 /end IF_DATA BIT_MASK 0x8000 /end MEASUREMENT
/begin MEASUREMENT B_dkp1mn "Bedingung Bereichsverletzung DK-Poti 1 nach unten" UWORD B_TRUE___UW 0 0 0.000000 0.000000 /begin IF_DATA ASAP1B_ETK KP_BLOB 0xFD3E 0 2 /end IF_DATA BIT_MASK 0x2 /end MEASUREMENT
/begin MEASUREMENT B_dkp1mx "Bedingung Bereichsverletzung DK-Poti 1 nach oben" UWORD B_TRUE___UW 0 0 0.000000 0.000000 /begin IF_DATA ASAP1B_ETK KP_BLOB 0xFD3E 0 2 /end IF_DATA BIT_MASK 0x4 /end MEASUREMENT
/begin MEASUREMENT B_dkp1np "Bedingung DK-Poti 1 unplausibel zu Ersatzwert aus FÅllung" UWORD B_TRUE___UW 0 0 0.000000 0.000000 /begin IF_DATA ASAP1B_ETK KP_BLOB 0xFD3E 0 2 /end IF_DATA BIT_MASK 0x8 /end MEASUREMENT
/begin MEASUREMENT B_dkp2e "Bedingung Fehler DK-Poti 2" UWORD B_TRUE___UW 0 0 0.000000 0.000000 /begin IF_DATA ASAP1B_ETK KP_BLOB 0xFD3E 0 2 /end IF_DATA BIT_MASK 0x10 /end MEASUREMENT
/begin MEASUREMENT B_dkp2mn "Bedingung Bereichsverletzung DK-Poti 2 nach unten" UWORD B_TRUE___UW 0 0 0.000000 0.000000 /begin IF_DATA ASAP1B_ETK KP_BLOB 0xFD3E 0 2 /end IF_DATA BIT_MASK 0x40 /end MEASUREMENT
/begin MEASUREMENT B_dkp2mx "Bedingung Bereichsverletzung DK-Poti 2 nach oben" UWORD B_TRUE___UW 0 0 0.000000 0.000000 /begin IF_DATA ASAP1B_ETK KP_BLOB 0xFD3E 0 2 /end IF_DATA BIT_MASK 0x80 /end MEASUREMENT
/begin MEASUREMENT B_dkp2np "Bedingung DK-Poti 2 unplausibel zu Ersatzwert aus FÅllung" UWORD B_TRUE___UW 0 0 0.000000 0.000000 /begin IF_DATA ASAP1B_ETK KP_BLOB 0xFD3E 0 2 /end IF_DATA BIT_MASK 0x100 /end MEASUREMENT
/begin MEASUREMENT B_dlrbe "Bedingung: DLR-Stellbereich wurde Åberschritten" UWORD B_TRUE___UW 0 0 0.000000 0.000000 /begin IF_DATA ASAP1B_ETK KP_BLOB 0xFD44 0 2 /end IF_DATA BIT_MASK 0x20 /end MEASUREMENT
/begin MEASUREMENT B_dlrpide "Bedingung: Fehler, DLR-Stellbereich am Anschlag" UWORD B_TRUE___UW 0 0 0.000000 0.000000 /begin IF_DATA ASAP1B_ETK KP_BLOB 0xFD44 0 2 /end IF_DATA BIT_MASK 0x200 /end MEASUREMENT
/begin MEASUREMENT B_dteaa "Bedingung AufsteuerprÅfung fÅr TEV Diagnose aktiv" UWORD B_TRUE___UW 0 0 0.000000 0.000000 /begin IF_DATA ASAP1B_ETK KP_BLOB 0xFD8A 0 2 /end IF_DATA BIT_MASK 0x10 /end MEASUREMENT
/begin MEASUREMENT B_dteaav "Bedingung AAV geschlossen" UWORD B_TRUE___UW 0 0 0.000000 0.000000 /begin IF_DATA ASAP1B_ETK KP_BLOB 0xFD08 0 2 /end IF_DATA BIT_MASK 0x1 /end MEASUREMENT
/begin MEASUREMENT B_dveese "Bedingung: DV-E-Endstufen-Fehler" UWORD B_TRUE___UW 0 0 0.000000 0.000000 /begin IF_DATA ASAP1B_ETK KP_BLOB 0xFD44 0 2 /end IF_DATA BIT_MASK 0x1000 /end MEASUREMENT
/begin MEASUREMENT B_ectal "Bedingung Tankinfo vom Kombi ist fehlerhaft" UWORD B_TRUE___UW 0 0 0.000000 0.000000 /begin IF_DATA ASAP1B_ETK KP_BLOB 0xFD0E 0 2 /end IF_DATA BIT_MASK 0x8000 /end MEASUREMENT
/begin MEASUREMENT B_eev "Bedingung Endstufenfehler EV" UWORD B_TRUE___UW 0 0 0.000000 0.000000 /begin IF_DATA ASAP1B_ETK KP_BLOB 0xFD54 0 2 /end IF_DATA BIT_MASK 0x400 /end MEASUREMENT
/begin MEASUREMENT B_epcl "Bedingung fÅr Ansteuerung EGAS-Fehlerlampe" UWORD B_TRUE___UW 0 0 0.000000 0.000000 /begin IF_DATA ASAP1B_ETK KP_BLOB 0xFD1C 0 2 /end IF_DATA BIT_MASK 0x1 /end MEASUREMENT
/begin MEASUREMENT B_esdia "Endstufendiagnose aktiv" UWORD B_TRUE___UW 0 0 0.000000 0.000000 /begin IF_DATA ASAP1B_ETK KP_BLOB 0xFD54 0 2 /end IF_DATA BIT_MASK 0x200 /end MEASUREMENT
/begin MEASUREMENT B_fabr "Bedingung Fahrer bremst aus CAN-Botschaft" UWORD B_TRUE___UW 0 0 0.000000 0.000000 /begin IF_DATA ASAP1B_ETK KP_BLOB 0xFD10 0 2 /end IF_DATA BIT_MASK 0x1 /end MEASUREMENT
/begin MEASUREMENT B_faevz "Bedingung Zylinderausblendung durch Tester" UWORD B_TRUE___UW 0 0 0.000000 0.000000 /begin IF_DATA ASAP1B_ETK KP_BLOB 0xFD84 0 2 /end IF_DATA BIT_MASK 0x100 /end MEASUREMENT
/begin MEASUREMENT B_fbm "Bedingung Bezugsmarkenfehler => mindestens 1 Zahn zuviel oder zuwenig erkannt" UWORD B_TRUE___UW 0 0 0.000000 0.000000 /begin IF_DATA ASAP1B_ETK KP_BLOB 0xFD1E 0 2 /end IF_DATA BIT_MASK 0x80 /end MEASUREMENT
/begin MEASUREMENT B_fgr "Bedingung FGR (Tempomat) aktiv" UWORD B_TRUE___UW 0 0 0.000000 0.000000 /begin IF_DATA ASAP1B_ETK KP_BLOB 0xFD7E 0 2 /end IF_DATA BIT_MASK 0x400 /end MEASUREMENT
/begin MEASUREMENT B_fgrabz "Bedingung zusÑtzliche FGR-Abschaltung" UWORD B_TRUE___UW 0 0 0.000000 0.000000 /begin IF_DATA ASAP1B_ETK KP_BLOB 0xFD10 0 2 /end IF_DATA BIT_MASK 0x2 /end MEASUREMENT
/begin MEASUREMENT B_fgrat "Bedingung: Tip-Schalter Aus am FGR-Bedienteil betÑtigt" UWORD B_TRUE___UW 0 0 0.000000 0.000000 /begin IF_DATA ASAP1B_ETK KP_BLOB 0xFD3A 0 2 /end IF_DATA BIT_MASK 0x800 /end MEASUREMENT
/begin MEASUREMENT B_fgren "Bedingung Fahrgeschwindigkeitsregelung aktiv (Enable)" UWORD B_TRUE___UW 0 0 0.000000 0.000000 /begin IF_DATA ASAP1B_ETK KP_BLOB 0xFD54 0 2 /end IF_DATA BIT_MASK 0x10 /end MEASUREMENT
/begin MEASUREMENT B_fgrhe "Bedingung: FGR-Bedienteil-Fehler" UWORD B_TRUE___UW 0 0 0.000000 0.000000 /begin IF_DATA ASAP1B_ETK KP_BLOB 0xFD3A 0 2 /end IF_DATA BIT_MASK 0x4000 /end MEASUREMENT
/begin MEASUREMENT B_fgrhsa "Bedingung: FGR-Hauptschalter aus" UWORD B_TRUE___UW 0 0 0.000000 0.000000 /begin IF_DATA ASAP1B_ETK KP_BLOB 0xFD3C 0 2 /end IF_DATA BIT_MASK 0x2 /end MEASUREMENT
/begin MEASUREMENT B_fgrsv "Bedingung Tip-Schalter Setzen/Verzîgern am FGR-Bedienteil betÑtigt" UWORD B_TRUE___UW 0 0 0.000000 0.000000 /begin IF_DATA ASAP1B_ETK KP_BLOB 0xFD10 0 2 /end IF_DATA BIT_MASK 0x4 /end MEASUREMENT
/begin MEASUREMENT B_fgrtbe "Bedingung: FGR-Taste Beschleunigen" UWORD B_TRUE___UW 0 0 0.000000 0.000000 /begin IF_DATA ASAP1B_ETK KP_BLOB 0xFD3C 0 2 /end IF_DATA BIT_MASK 0x8 /end MEASUREMENT
/begin MEASUREMENT B_fgrtse "Bedingung: FGR-Taste-Setzen" UWORD B_TRUE___UW 0 0 0.000000 0.000000 /begin IF_DATA ASAP1B_ETK KP_BLOB 0xFD3C 0 2 /end IF_DATA BIT_MASK 0x10 /end MEASUREMENT
/begin MEASUREMENT B_fgrtve "Bedingung: FGR-Taste Verzîgern" UWORD B_TRUE___UW 0 0 0.000000 0.000000 /begin IF_DATA ASAP1B_ETK KP_BLOB 0xFD3C 0 2 /end IF_DATA BIT_MASK 0x20 /end MEASUREMENT
/begin MEASUREMENT B_fgrtwa "Bedingung: FGR-Taste Wiederaufnahme" UWORD B_TRUE___UW 0 0 0.000000 0.000000 /begin IF_DATA ASAP1B_ETK KP_BLOB 0xFD3C 0 2 /end IF_DATA BIT_MASK 0x40 /end MEASUREMENT
/begin MEASUREMENT B_fgrwb "Bedingung Tip-Schalter Wiederaufnahme/Beschleunigen am FGR-Bedienteil betÑtigt" UWORD B_TRUE___UW 0 0 0.000000 0.000000 /begin IF_DATA ASAP1B_ETK KP_BLOB 0xFD10 0 2 /end IF_DATA BIT_MASK 0x8 /end MEASUREMENT
/begin MEASUREMENT B_fgr_um "FGR-/ACC-Momenteneingriff in der FunktionsÅberwachung erlaubt" UWORD B_TRUE___UW 0 0 0.000000 0.000000 /begin IF_DATA ASAP1B_ETK KP_BLOB 0xFD86 0 2 /end IF_DATA BIT_MASK 0x8 /end MEASUREMENT
/begin MEASUREMENT B_fkmsmn "schnelle Massenstromadaption fkmsdks im unteren Anschlag" UWORD B_TRUE___UW 0 0 0.000000 0.000000 /begin IF_DATA ASAP1B_ETK KP_BLOB 0xFD56 0 2 /end IF_DATA BIT_MASK 0x80 /end MEASUREMENT
/begin MEASUREMENT B_fkmsmx "schnelle Massenstromadaption fkmsdks im oberen Anschlag" UWORD B_TRUE___UW 0 0 0.000000 0.000000 /begin IF_DATA ASAP1B_ETK KP_BLOB 0xFD56 0 2 /end IF_DATA BIT_MASK 0x100 /end MEASUREMENT
/begin MEASUREMENT B_fkpvmn "langsame Massenstromadaption fkpvdk im unteren Anschlag" UWORD B_TRUE___UW 0 0 0.000000 0.000000 /begin IF_DATA ASAP1B_ETK KP_BLOB 0xFD56 0 2 /end IF_DATA BIT_MASK 0x400 /end MEASUREMENT
/begin MEASUREMENT B_fkpvmx "langsame Massenstromadaption fkpvdk im oberen Anschlag" UWORD B_TRUE___UW 0 0 0.000000 0.000000 /begin IF_DATA ASAP1B_ETK KP_BLOB 0xFD56 0 2 /end IF_DATA BIT_MASK 0x800 /end MEASUREMENT
/begin MEASUREMENT B_fproab "Bedingung: DV-E-PrÅfung îffnende Feder Abbruch, Feder îffnet nicht" UWORD B_TRUE___UW 0 0 0.000000 0.000000 /begin IF_DATA ASAP1B_ETK KP_BLOB 0xFD40 0 2 /end IF_DATA BIT_MASK 0x400 /end MEASUREMENT
/begin MEASUREMENT B_fproe "Bedingung: ôffnende FederprÅfung Fehler" UWORD B_TRUE___UW 0 0 0.000000 0.000000 /begin IF_DATA ASAP1B_ETK KP_BLOB 0xFD40 0 2 /end IF_DATA BIT_MASK 0x800 /end MEASUREMENT
/begin MEASUREMENT B_fprook "Bedingung: îffnende FederprÅfung i.O." UWORD B_TRUE___UW 0 0 0.000000 0.000000 /begin IF_DATA ASAP1B_ETK KP_BLOB 0xFD40 0 2 /end IF_DATA BIT_MASK 0x1000 /end MEASUREMENT
/begin MEASUREMENT B_fprordy "Bedingung: ôffnende FederprÅfung fertig" UWORD B_TRUE___UW 0 0 0.000000 0.000000 /begin IF_DATA ASAP1B_ETK KP_BLOB 0xFD40 0 2 /end IF_DATA BIT_MASK 0x2000 /end MEASUREMENT
/begin MEASUREMENT B_fprovb "Bedingung: ôffnende FederprÅfung verboten" UWORD B_TRUE___UW 0 0 0.000000 0.000000 /begin IF_DATA ASAP1B_ETK KP_BLOB 0xFD40 0 2 /end IF_DATA BIT_MASK 0x4000 /end MEASUREMENT
/begin MEASUREMENT B_fprrdy "DK-RÅckstellfeder-PrÅfung beendet" UWORD B_TRUE___UW 0 0 0.000000 0.000000 /begin IF_DATA ASAP1B_ETK KP_BLOB 0xFD40 0 2 /end IF_DATA BIT_MASK 0x8000 /end MEASUREMENT
/begin MEASUREMENT B_fprzab "Bedingung: DV-E-RÅckstellfederprÅfung Abbruch, Feder schlie·t nicht" UWORD B_TRUE___UW 0 0 0.000000 0.000000 /begin IF_DATA ASAP1B_ETK KP_BLOB 0xFD42 0 2 /end IF_DATA BIT_MASK 0x1 /end MEASUREMENT
/begin MEASUREMENT B_fprze "Bedingung: Fehler in der DV-E-RÅckstellfederprÅfung" UWORD B_TRUE___UW 0 0 0.000000 0.000000 /begin IF_DATA ASAP1B_ETK KP_BLOB 0xFD42 0 2 /end IF_DATA BIT_MASK 0x2 /end MEASUREMENT
/begin MEASUREMENT B_fprzvb "Bedingung: DV-E-RÅckstellfederprÅfung verboten" UWORD B_TRUE___UW 0 0 0.000000 0.000000 /begin IF_DATA ASAP1B_ETK KP_BLOB 0xFD42 0 2 /end IF_DATA BIT_MASK 0x8 /end MEASUREMENT
/begin MEASUREMENT B_ftbm "" UWORD B_TRUE___UW 0 0 0.000000 0.000000 /begin IF_DATA ASAP1B_ETK KP_BLOB 0x383AF6 1 2 /end IF_DATA BIT_MASK 0x10 /end MEASUREMENT
/begin MEASUREMENT B_ftcadr "" UWORD B_TRUE___UW 0 0 0.000000 0.000000 /begin IF_DATA ASAP1B_ETK KP_BLOB 0x383AFC 1 2 /end IF_DATA BIT_MASK 0x10 /end MEASUREMENT
/begin MEASUREMENT B_ftcas "" UWORD B_TRUE___UW 0 0 0.000000 0.000000 /begin IF_DATA ASAP1B_ETK KP_BLOB 0x383AFE 1 2 /end IF_DATA BIT_MASK 0x10 /end MEASUREMENT
/begin MEASUREMENT B_ftcat "" UWORD B_TRUE___UW 0 0 0.000000 0.000000 /begin IF_DATA ASAP1B_ETK KP_BLOB 0x383B00 1 2 /end IF_DATA BIT_MASK 0x10 /end MEASUREMENT
/begin MEASUREMENT B_ftcge "" UWORD B_TRUE___UW 0 0 0.000000 0.000000 /begin IF_DATA ASAP1B_ETK KP_BLOB 0x383B02 1 2 /end IF_DATA BIT_MASK 0x10 /end MEASUREMENT
/begin MEASUREMENT B_ftcif "" UWORD B_TRUE___UW 0 0 0.000000 0.000000 /begin IF_DATA ASAP1B_ETK KP_BLOB 0x383B04 1 2 /end IF_DATA BIT_MASK 0x10 /end MEASUREMENT
/begin MEASUREMENT B_ftcins "" UWORD B_TRUE___UW 0 0 0.000000 0.000000 /begin IF_DATA ASAP1B_ETK KP_BLOB 0x383B06 1 2 /end IF_DATA BIT_MASK 0x10 /end MEASUREMENT
/begin MEASUREMENT B_ftclws "" UWORD B_TRUE___UW 0 0 0.000000 0.000000 /begin IF_DATA ASAP1B_ETK KP_BLOB 0x383B08 1 2 /end IF_DATA BIT_MASK 0x10 /end MEASUREMENT
/begin MEASUREMENT B_ftdk "" UWORD B_TRUE___UW 0 0 0.000000 0.000000 /begin IF_DATA ASAP1B_ETK KP_BLOB 0x383B0A 1 2 /end IF_DATA BIT_MASK 0x10 /end MEASUREMENT
/begin MEASUREMENT B_ftdk1p "" UWORD B_TRUE___UW 0 0 0.000000 0.000000 /begin IF_DATA ASAP1B_ETK KP_BLOB 0x383B0C 1 2 /end IF_DATA BIT_MASK 0x10 /end MEASUREMENT
/begin MEASUREMENT B_ftdk2p "" UWORD B_TRUE___UW 0 0 0.000000 0.000000 /begin IF_DATA ASAP1B_ETK KP_BLOB 0x383B0E 1 2 /end IF_DATA BIT_MASK 0x10 /end MEASUREMENT
/begin MEASUREMENT B_ftdvee "" UWORD B_TRUE___UW 0 0 0.000000 0.000000 /begin IF_DATA ASAP1B_ETK KP_BLOB 0x383B1A 1 2 /end IF_DATA BIT_MASK 0x10 /end MEASUREMENT
/begin MEASUREMENT B_ftdvef "" UWORD B_TRUE___UW 0 0 0.000000 0.000000 /begin IF_DATA ASAP1B_ETK KP_BLOB 0x383B1C 1 2 /end IF_DATA BIT_MASK 0x10 /end MEASUREMENT
/begin MEASUREMENT B_ftdvefo "" UWORD B_TRUE___UW 0 0 0.000000 0.000000 /begin IF_DATA ASAP1B_ETK KP_BLOB 0x383B1E 1 2 /end IF_DATA BIT_MASK 0x10 /end MEASUREMENT
/begin MEASUREMENT B_ftdvel "" UWORD B_TRUE___UW 0 0 0.000000 0.000000 /begin IF_DATA ASAP1B_ETK KP_BLOB 0x383B20 1 2 /end IF_DATA BIT_MASK 0x10 /end MEASUREMENT
/begin MEASUREMENT B_ftdven "" UWORD B_TRUE___UW 0 0 0.000000 0.000000 /begin IF_DATA ASAP1B_ETK KP_BLOB 0x383B22 1 2 /end IF_DATA BIT_MASK 0x10 /end MEASUREMENT
/begin MEASUREMENT B_ftdver "" UWORD B_TRUE___UW 0 0 0.000000 0.000000 /begin IF_DATA ASAP1B_ETK KP_BLOB 0x383B24 1 2 /end IF_DATA BIT_MASK 0x10 /end MEASUREMENT
/begin MEASUREMENT B_ftdvet "" UWORD B_TRUE___UW 0 0 0.000000 0.000000 /begin IF_DATA ASAP1B_ETK KP_BLOB 0x383B26 1 2 /end IF_DATA BIT_MASK 0x10 /end MEASUREMENT
/begin MEASUREMENT B_ftdveu "" UWORD B_TRUE___UW 0 0 0.000000 0.000000 /begin IF_DATA ASAP1B_ETK KP_BLOB 0x383B28 1 2 /end IF_DATA BIT_MASK 0x10 /end MEASUREMENT
/begin MEASUREMENT B_ftdveub "" UWORD B_TRUE___UW 0 0 0.000000 0.000000 /begin IF_DATA ASAP1B_ETK KP_BLOB 0x383B2A 1 2 /end IF_DATA BIT_MASK 0x10 /end MEASUREMENT
/begin MEASUREMENT B_ftdveuw "" UWORD B_TRUE___UW 0 0 0.000000 0.000000 /begin IF_DATA ASAP1B_ETK KP_BLOB 0x383B2C 1 2 /end IF_DATA BIT_MASK 0x10 /end MEASUREMENT
/begin MEASUREMENT B_ftdvev "" UWORD B_TRUE___UW 0 0 0.000000 0.000000 /begin IF_DATA ASAP1B_ETK KP_BLOB 0x383B2E 1 2 /end IF_DATA BIT_MASK 0x10 /end MEASUREMENT
/begin MEASUREMENT B_ftn "" UWORD B_TRUE___UW 0 0 0.000000 0.000000 /begin IF_DATA ASAP1B_ETK KP_BLOB 0x383BBA 1 2 /end IF_DATA BIT_MASK 0x10 /end MEASUREMENT
/begin MEASUREMENT B_gekoa "Bedingung Kompressor wegen Getriebeeingriff abschalten" UWORD B_TRUE___UW 0 0 0.000000 0.000000 /begin IF_DATA ASAP1B_ETK KP_BLOB 0xFD10 0 2 /end IF_DATA BIT_MASK 0x10 /end MEASUREMENT
/begin MEASUREMENT B_ges "Bedingung Getriebeschutz Åber Zylinderausblendung" UWORD B_TRUE___UW 0 0 0.000000 0.000000 /begin IF_DATA ASAP1B_ETK KP_BLOB 0xFD10 0 2 /end IF_DATA BIT_MASK 0x20 /end MEASUREMENT
/begin MEASUREMENT B_geuew "Bedingung ZeitÅberwachung Getriebeeingriff (CAN)" UWORD B_TRUE___UW 0 0 0.000000 0.000000 /begin IF_DATA ASAP1B_ETK KP_BLOB 0xFD10 0 2 /end IF_DATA BIT_MASK 0x40 /end MEASUREMENT
/begin MEASUREMENT B_gsaf "Bedingung Getriebe-Schalteingriff-Anforderung" UWORD B_TRUE___UW 0 0 0.000000 0.000000 /begin IF_DATA ASAP1B_ETK KP_BLOB 0xFD10 0 2 /end IF_DATA BIT_MASK 0x80 /end MEASUREMENT
/begin MEASUREMENT B_gsch "Bedingung Getriebeschaltung aktiv" UWORD B_TRUE___UW 0 0 0.000000 0.000000 /begin IF_DATA ASAP1B_ETK KP_BLOB 0xFD10 0 2 /end IF_DATA BIT_MASK 0x100 /end MEASUREMENT
/begin MEASUREMENT B_hfm "Bedingung HFM messbereit" UWORD B_TRUE___UW 0 0 0.000000 0.000000 /begin IF_DATA ASAP1B_ETK KP_BLOB 0xFD56 0 2 /end IF_DATA BIT_MASK 0x40 /end MEASUREMENT
/begin MEASUREMENT B_i_ska_fr "irrev. Sicherheitskraftstoffabschaltung vom FR" UWORD B_TRUE___UW 0 0 0.000000 0.000000 /begin IF_DATA ASAP1B_ETK KP_BLOB 0xFD46 0 2 /end IF_DATA BIT_MASK 0x4000 /end MEASUREMENT
/begin MEASUREMENT B_kd "Kick-Down" UBYTE B_TRUE 0 0 0.000000 0.000000 /begin IF_DATA ASAP1B_ETK KP_BLOB 0x380ABB 1 1 /end IF_DATA BIT_MASK 0x1 /end MEASUREMENT
/begin MEASUREMENT B_kl15 "Bedingung Klemme 15" UWORD B_TRUE___UW 0 0 0.000000 0.000000 /begin IF_DATA ASAP1B_ETK KP_BLOB 0xFD84 0 2 /end IF_DATA BIT_MASK 0x80 /end MEASUREMENT
/begin MEASUREMENT B_ko "Bedingung Kompressor freigegeben" UWORD B_TRUE___UW 0 0 0.000000 0.000000 /begin IF_DATA ASAP1B_ETK KP_BLOB 0xFDA0 0 2 /end IF_DATA BIT_MASK 0x10 /end MEASUREMENT
/begin MEASUREMENT B_koe "Bedingung fÅr Kompressoreinschalten" UWORD B_TRUE___UW 0 0 0.000000 0.000000 /begin IF_DATA ASAP1B_ETK KP_BLOB 0xFDA0 0 2 /end IF_DATA BIT_MASK 0x100 /end MEASUREMENT
/begin MEASUREMENT B_kov "Bedingung Klimakompressor verboten" UWORD B_TRUE___UW 0 0 0.000000 0.000000 /begin IF_DATA ASAP1B_ETK KP_BLOB 0xFDA2 0 2 /end IF_DATA BIT_MASK 0x20 /end MEASUREMENT
/begin MEASUREMENT B_kuppl "Bedingung Kupplung betÑtigt" UWORD B_TRUE___UW 0 0 0.000000 0.000000 /begin IF_DATA ASAP1B_ETK KP_BLOB 0xFD48 0 2 /end IF_DATA BIT_MASK 0x20 /end MEASUREMENT
/begin MEASUREMENT B_kvakbi "Bedingung aufsummierter Kraftstoffverbrauch ist Åbergelaufen" UWORD B_TRUE___UW 0 0 0.000000 0.000000 /begin IF_DATA ASAP1B_ETK KP_BLOB 0xFDA6 0 2 /end IF_DATA BIT_MASK 0x80 /end MEASUREMENT
/begin MEASUREMENT B_ll "Bedingung Leerlauf" UWORD B_TRUE___UW 0 0 0.000000 0.000000 /begin IF_DATA ASAP1B_ETK KP_BLOB 0xFD7E 0 2 /end IF_DATA BIT_MASK 0x2000 /end MEASUREMENT
/begin MEASUREMENT B_lrnakt "Lernaktiv Bit" UWORD B_TRUE___UW 0 0 0.000000 0.000000 /begin IF_DATA ASAP1B_ETK KP_BLOB 0xFD42 0 2 /end IF_DATA BIT_MASK 0x10 /end MEASUREMENT
/begin MEASUREMENT B_lrnerf "Lernerfolg Bit" UBYTE B_TRUE 0 0 0.000000 0.000000 /begin IF_DATA ASAP1B_ETK KP_BLOB 0x38334B 1 1 /end IF_DATA BIT_MASK 0x8 /end MEASUREMENT
/begin MEASUREMENT B_lrnrdy "Lernen ist beendet" UWORD B_TRUE___UW 0 0 0.000000 0.000000 /begin IF_DATA ASAP1B_ETK KP_BLOB 0xFD42 0 2 /end IF_DATA BIT_MASK 0x40 /end MEASUREMENT
/begin MEASUREMENT B_lrnvb "Lernverbot Bit" UWORD B_TRUE___UW 0 0 0.000000 0.000000 /begin IF_DATA ASAP1B_ETK KP_BLOB 0xFD42 0 2 /end IF_DATA BIT_MASK 0x100 /end MEASUREMENT
/begin MEASUREMENT B_lrnws "Lernwertspeicherung Bit" UBYTE B_TRUE 0 0 0.000000 0.000000 /begin IF_DATA ASAP1B_ETK KP_BLOB 0x38334B 1 1 /end IF_DATA BIT_MASK 0x1 /end MEASUREMENT
/begin MEASUREMENT B_lwser "Fehler im Lenkwinkelsensorpfad" UWORD B_TRUE___UW 0 0 0.000000 0.000000 /begin IF_DATA ASAP1B_ETK KP_BLOB 0xFD10 0 2 /end IF_DATA BIT_MASK 0x200 /end MEASUREMENT
/begin MEASUREMENT B_lwsok "Bedingung LWS-Caninfo ist fehlerfrei" UWORD B_TRUE___UW 0 0 0.000000 0.000000 /begin IF_DATA ASAP1B_ETK KP_BLOB 0xFD10 0 2 /end IF_DATA BIT_MASK 0x400 /end MEASUREMENT
/begin MEASUREMENT B_md "Bedingung Momentenanforderung ADR Åber CAN" UWORD B_TRUE___UW 0 0 0.000000 0.000000 /begin IF_DATA ASAP1B_ETK KP_BLOB 0xFD10 0 2 /end IF_DATA BIT_MASK 0x800 /end MEASUREMENT
/begin MEASUREMENT B_mdwaner "Bedingung Fehler auf mdwan_w" UWORD B_TRUE___UW 0 0 0.000000 0.000000 /begin IF_DATA ASAP1B_ETK KP_BLOB 0xFD10 0 2 /end IF_DATA BIT_MASK 0x1000 /end MEASUREMENT
/begin MEASUREMENT B_mgbget "Bedingung Momentengradientenbegrenzung aktiv" UWORD B_TRUE___UW 0 0 0.000000 0.000000 /begin IF_DATA ASAP1B_ETK KP_BLOB 0xFD10 0 2 /end IF_DATA BIT_MASK 0x2000 /end MEASUREMENT
/begin MEASUREMENT B_mil "MIL-Ansteuerung" UWORD B_TRUE___UW 0 0 0.000000 0.000000 /begin IF_DATA ASAP1B_ETK KP_BLOB 0xFD1A 0 2 /end IF_DATA BIT_MASK 0x8000 /end MEASUREMENT
/begin MEASUREMENT B_milfb "MIL-Ansteuerung fremdbestimmt durch externes SG" UWORD B_TRUE___UW 0 0 0.000000 0.000000 /begin IF_DATA ASAP1B_ETK KP_BLOB 0xFD10 0 2 /end IF_DATA BIT_MASK 0x4000 /end MEASUREMENT
/begin MEASUREMENT B_mnbm "Fehlertyp: hÑufige Korrektur bei einem Zahn zuwenig" UWORD B_TRUE___UW 0 0 0.000000 0.000000 /begin IF_DATA ASAP1B_ETK KP_BLOB 0x383AF6 1 2 /end IF_DATA BIT_MASK 0x200 /end MEASUREMENT
/begin MEASUREMENT B_mncadr "Fehlertyp min.: CAN-Schnittstelle, Timeout Botschaft ADR" UWORD B_TRUE___UW 0 0 0.000000 0.000000 /begin IF_DATA ASAP1B_ETK KP_BLOB 0x383AFC 1 2 /end IF_DATA BIT_MASK 0x200 /end MEASUREMENT
/begin MEASUREMENT B_mncas "Fehlertyp min.: CAN-Schnittstelle, Timeout ASC" UWORD B_TRUE___UW 0 0 0.000000 0.000000 /begin IF_DATA ASAP1B_ETK KP_BLOB 0x383AFE 1 2 /end IF_DATA BIT_MASK 0x200 /end MEASUREMENT
/begin MEASUREMENT B_mncat "Fehlertyp min.: CAN-Schnittstelle, Timeout ASR" UWORD B_TRUE___UW 0 0 0.000000 0.000000 /begin IF_DATA ASAP1B_ETK KP_BLOB 0x383B00 1 2 /end IF_DATA BIT_MASK 0x200 /end MEASUREMENT
/begin MEASUREMENT B_mncge "Fehlertyp min.: CAN-Schnittstelle, Timeout EGS" UWORD B_TRUE___UW 0 0 0.000000 0.000000 /begin IF_DATA ASAP1B_ETK KP_BLOB 0x383B02 1 2 /end IF_DATA BIT_MASK 0x200 /end MEASUREMENT
/begin MEASUREMENT B_mncif "Fehlertyp min.: CAN-Schnittstelle, interner Fehler" UWORD B_TRUE___UW 0 0 0.000000 0.000000 /begin IF_DATA ASAP1B_ETK KP_BLOB 0x383B04 1 2 /end IF_DATA BIT_MASK 0x200 /end MEASUREMENT
/begin MEASUREMENT B_mncins "Fehlertyp min.: CAN-Schnittstelle, Timeout Instrument" UWORD B_TRUE___UW 0 0 0.000000 0.000000 /begin IF_DATA ASAP1B_ETK KP_BLOB 0x383B06 1 2 /end IF_DATA BIT_MASK 0x200 /end MEASUREMENT
/begin MEASUREMENT B_mnclws "Fehlertyp min.: CAN-Schnittstelle, Timeout Botschaft Lenkwinkelsensor" UWORD B_TRUE___UW 0 0 0.000000 0.000000 /begin IF_DATA ASAP1B_ETK KP_BLOB 0x383B08 1 2 /end IF_DATA BIT_MASK 0x200 /end MEASUREMENT
/begin MEASUREMENT B_mndk "Fehlertype: Kurzschlu· nach Masse Drosselklappenpoti" UWORD B_TRUE___UW 0 0 0.000000 0.000000 /begin IF_DATA ASAP1B_ETK KP_BLOB 0x383B0A 1 2 /end IF_DATA BIT_MASK 0x200 /end MEASUREMENT
/begin MEASUREMENT B_mndk1p "Fehlertyp min.: Drosselklappe 1. Poti" UWORD B_TRUE___UW 0 0 0.000000 0.000000 /begin IF_DATA ASAP1B_ETK KP_BLOB 0x383B0C 1 2 /end IF_DATA BIT_MASK 0x200 /end MEASUREMENT
/begin MEASUREMENT B_mndk2p "Fehlertyp min.: Drosselklappe 2. Poti" UWORD B_TRUE___UW 0 0 0.000000 0.000000 /begin IF_DATA ASAP1B_ETK KP_BLOB 0x383B0E 1 2 /end IF_DATA BIT_MASK 0x200 /end MEASUREMENT
/begin MEASUREMENT B_mndvee "Fehlerzyp min.: DV-E Endstufe" UWORD B_TRUE___UW 0 0 0.000000 0.000000 /begin IF_DATA ASAP1B_ETK KP_BLOB 0x383B1A 1 2 /end IF_DATA BIT_MASK 0x200 /end MEASUREMENT
/begin MEASUREMENT B_mndvef "Fehlertyp min.: DV-E Fehler bei PrÅfung der îffnenden Feder" UWORD B_TRUE___UW 0 0 0.000000 0.000000 /begin IF_DATA ASAP1B_ETK KP_BLOB 0x383B1C 1 2 /end IF_DATA BIT_MASK 0x200 /end MEASUREMENT
/begin MEASUREMENT B_mndvefo "Fehlertyp min.: Fehler bei FederprÅfung 'ôffnen'" UWORD B_TRUE___UW 0 0 0.000000 0.000000 /begin IF_DATA ASAP1B_ETK KP_BLOB 0x383B1E 1 2 /end IF_DATA BIT_MASK 0x200 /end MEASUREMENT
/begin MEASUREMENT B_mndvel "Fehlertyp min.: DV-E Lageabweichung" UWORD B_TRUE___UW 0 0 0.000000 0.000000 /begin IF_DATA ASAP1B_ETK KP_BLOB 0x383B20 1 2 /end IF_DATA BIT_MASK 0x200 /end MEASUREMENT
/begin MEASUREMENT B_mndven "Fehlertyp min.: DV-E Fehler bei PrÅfung Notluftposition" UWORD B_TRUE___UW 0 0 0.000000 0.000000 /begin IF_DATA ASAP1B_ETK KP_BLOB 0x383B22 1 2 /end IF_DATA BIT_MASK 0x200 /end MEASUREMENT
/begin MEASUREMENT B_mndver "Fehlerzyp min.: DV-E Regelbereich, kurzfristig Åberschritten" UWORD B_TRUE___UW 0 0 0.000000 0.000000 /begin IF_DATA ASAP1B_ETK KP_BLOB 0x383B24 1 2 /end IF_DATA BIT_MASK 0x200 /end MEASUREMENT
/begin MEASUREMENT B_mndvet "" UWORD B_TRUE___UW 0 0 0.000000 0.000000 /begin IF_DATA ASAP1B_ETK KP_BLOB 0x383B26 1 2 /end IF_DATA BIT_MASK 0x200 /end MEASUREMENT
/begin MEASUREMENT B_mndveu "Fehlertyp min.: DV-E Fehler beim UMA-Lernen" UWORD B_TRUE___UW 0 0 0.000000 0.000000 /begin IF_DATA ASAP1B_ETK KP_BLOB 0x383B28 1 2 /end IF_DATA BIT_MASK 0x200 /end MEASUREMENT
/begin MEASUREMENT B_mndveub "Fehlertyp min.: DV-E-Adaption Abbruch wg. Umweltbed/Unterspng" UWORD B_TRUE___UW 0 0 0.000000 0.000000 /begin IF_DATA ASAP1B_ETK KP_BLOB 0x383B2A 1 2 /end IF_DATA BIT_MASK 0x200 /end MEASUREMENT
/begin MEASUREMENT B_mndveuw "" UWORD B_TRUE___UW 0 0 0.000000 0.000000 /begin IF_DATA ASAP1B_ETK KP_BLOB 0x383B2C 1 2 /end IF_DATA BIT_MASK 0x200 /end MEASUREMENT
/begin MEASUREMENT B_mndvev "Fehlertyp min.: DV-E Fehler bei VerstÑrkerabgleich" UWORD B_TRUE___UW 0 0 0.000000 0.000000 /begin IF_DATA ASAP1B_ETK KP_BLOB 0x383B2E 1 2 /end IF_DATA BIT_MASK 0x200 /end MEASUREMENT
/begin MEASUREMENT B_mnn "Fehlerart: Synchronisationsmarke hÑufig nicht gefunden" UWORD B_TRUE___UW 0 0 0.000000 0.000000 /begin IF_DATA ASAP1B_ETK KP_BLOB 0x383BBA 1 2 /end IF_DATA BIT_MASK 0x200 /end MEASUREMENT
/begin MEASUREMENT B_motaus "CAN-Signal: 'Motor AUS'-Anforderung vom F1-Getriebe (KUP)" UWORD B_TRUE___UW 0 0 0.000000 0.000000 /begin IF_DATA ASAP1B_ETK KP_BLOB 0xFD10 0 2 /end IF_DATA BIT_MASK 0x8000 /end MEASUREMENT
/begin MEASUREMENT B_msr "Bedingung fÅr Momentenschlupfregelung" UWORD B_TRUE___UW 0 0 0.000000 0.000000 /begin IF_DATA ASAP1B_ETK KP_BLOB 0xFD82 0 2 /end IF_DATA BIT_MASK 0x80 /end MEASUREMENT
/begin MEASUREMENT B_msrakt "MSR-Funktion aktiviert" UWORD B_TRUE___UW 0 0 0.000000 0.000000 /begin IF_DATA ASAP1B_ETK KP_BLOB 0xFD12 0 2 /end IF_DATA BIT_MASK 0x1 /end MEASUREMENT
/begin MEASUREMENT B_msrdis "Bedingung MSR-Eingriff nicht zugelassen" UWORD B_TRUE___UW 0 0 0.000000 0.000000 /begin IF_DATA ASAP1B_ETK KP_BLOB 0xFD12 0 2 /end IF_DATA BIT_MASK 0x2 /end MEASUREMENT
/begin MEASUREMENT B_msrphnpl "Bedingung MSR-Eingriff physikalisch nicht plausibel" UWORD B_TRUE___UW 0 0 0.000000 0.000000 /begin IF_DATA ASAP1B_ETK KP_BLOB 0xFD12 0 2 /end IF_DATA BIT_MASK 0x4 /end MEASUREMENT
/begin MEASUREMENT B_msrtnpl "Bedingung MSR-Eingriff aufgrund Topffunktion nicht plausibel" UWORD B_TRUE___UW 0 0 0.000000 0.000000 /begin IF_DATA ASAP1B_ETK KP_BLOB 0xFD12 0 2 /end IF_DATA BIT_MASK 0x8 /end MEASUREMENT
/begin MEASUREMENT B_msrvnpl "Bedingung MSR-Eingriff aufgrund Geschwindigkeitsschwelle nicht plausibel" UWORD B_TRUE___UW 0 0 0.000000 0.000000 /begin IF_DATA ASAP1B_ETK KP_BLOB 0xFD12 0 2 /end IF_DATA BIT_MASK 0x10 /end MEASUREMENT
/begin MEASUREMENT B_msr_can "Bedingung MSR-Anforderung Åber CAN" UWORD B_TRUE___UW 0 0 0.000000 0.000000 /begin IF_DATA ASAP1B_ETK KP_BLOB 0xFD12 0 2 /end IF_DATA BIT_MASK 0x20 /end MEASUREMENT
/begin MEASUREMENT B_mxbm "Fehlertyp: hÑufige Korrektur bei einem Zahn zuviel" UWORD B_TRUE___UW 0 0 0.000000 0.000000 /begin IF_DATA ASAP1B_ETK KP_BLOB 0x383AF6 1 2 /end IF_DATA BIT_MASK 0x100 /end MEASUREMENT
/begin MEASUREMENT B_mxcadr "Fehlertyp max.: CAN-Schnittstelle, Timeout Botschaft ADR" UWORD B_TRUE___UW 0 0 0.000000 0.000000 /begin IF_DATA ASAP1B_ETK KP_BLOB 0x383AFC 1 2 /end IF_DATA BIT_MASK 0x100 /end MEASUREMENT
/begin MEASUREMENT B_mxcas "Fehlertyp max.: CAN-Schnittstelle, Timeout Botschaft ASC" UWORD B_TRUE___UW 0 0 0.000000 0.000000 /begin IF_DATA ASAP1B_ETK KP_BLOB 0x383AFE 1 2 /end IF_DATA BIT_MASK 0x100 /end MEASUREMENT
/begin MEASUREMENT B_mxcat "Fehlertyp max.: CAN-Schnittstelle, Timeout ASR" UWORD B_TRUE___UW 0 0 0.000000 0.000000 /begin IF_DATA ASAP1B_ETK KP_BLOB 0x383B00 1 2 /end IF_DATA BIT_MASK 0x100 /end MEASUREMENT
/begin MEASUREMENT B_mxcge "Fehlertyp max.: CAN-Schnittstelle, Timeout EGS" UWORD B_TRUE___UW 0 0 0.000000 0.000000 /begin IF_DATA ASAP1B_ETK KP_BLOB 0x383B02 1 2 /end IF_DATA BIT_MASK 0x100 /end MEASUREMENT
/begin MEASUREMENT B_mxcif "Fehlertyp max.: CAN-Schnittstelle, interner Fehler            2" UWORD B_TRUE___UW 0 0 0.000000 0.000000 /begin IF_DATA ASAP1B_ETK KP_BLOB 0x383B04 1 2 /end IF_DATA BIT_MASK 0x100 /end MEASUREMENT
/begin MEASUREMENT B_mxcins "Fehlertyp max.: CAN-Schnittstelle, Timeout Instrument" UWORD B_TRUE___UW 0 0 0.000000 0.000000 /begin IF_DATA ASAP1B_ETK KP_BLOB 0x383B06 1 2 /end IF_DATA BIT_MASK 0x100 /end MEASUREMENT
/begin MEASUREMENT B_mxclws "Fehlertyp max.: CAN-Schnittstelle, Timeout Botschaft Lenkwinkelsensor" UWORD B_TRUE___UW 0 0 0.000000 0.000000 /begin IF_DATA ASAP1B_ETK KP_BLOB 0x383B08 1 2 /end IF_DATA BIT_MASK 0x100 /end MEASUREMENT
/begin MEASUREMENT B_mxdk "Fehlertype: Kurzschlu· nach Ubat Drosselklappenpoti" UWORD B_TRUE___UW 0 0 0.000000 0.000000 /begin IF_DATA ASAP1B_ETK KP_BLOB 0x383B0A 1 2 /end IF_DATA BIT_MASK 0x100 /end MEASUREMENT
/begin MEASUREMENT B_mxdk1p "Fehlertyp max.: Drosselklappe 1. Poti" UWORD B_TRUE___UW 0 0 0.000000 0.000000 /begin IF_DATA ASAP1B_ETK KP_BLOB 0x383B0C 1 2 /end IF_DATA BIT_MASK 0x100 /end MEASUREMENT
/begin MEASUREMENT B_mxdk2p "Fehlertyp max.: Drosselklappe 2. Poti" UWORD B_TRUE___UW 0 0 0.000000 0.000000 /begin IF_DATA ASAP1B_ETK KP_BLOB 0x383B0E 1 2 /end IF_DATA BIT_MASK 0x100 /end MEASUREMENT
/begin MEASUREMENT B_mxdvee "Fehlertyp max.: DV-E Endstufe" UWORD B_TRUE___UW 0 0 0.000000 0.000000 /begin IF_DATA ASAP1B_ETK KP_BLOB 0x383B1A 1 2 /end IF_DATA BIT_MASK 0x100 /end MEASUREMENT
/begin MEASUREMENT B_mxdvef "Fehlertyp max.: DV-E Fehler bei PrÅfung der RÅckstellfeder" UWORD B_TRUE___UW 0 0 0.000000 0.000000 /begin IF_DATA ASAP1B_ETK KP_BLOB 0x383B1C 1 2 /end IF_DATA BIT_MASK 0x100 /end MEASUREMENT
/begin MEASUREMENT B_mxdvefo "Fehlertyp max.: Fehler bei FederprÅfung 'ôffnen'" UWORD B_TRUE___UW 0 0 0.000000 0.000000 /begin IF_DATA ASAP1B_ETK KP_BLOB 0x383B1E 1 2 /end IF_DATA BIT_MASK 0x100 /end MEASUREMENT
/begin MEASUREMENT B_mxdvel "Fehlerzyp max.: DV-E Lageabweichung" UWORD B_TRUE___UW 0 0 0.000000 0.000000 /begin IF_DATA ASAP1B_ETK KP_BLOB 0x383B20 1 2 /end IF_DATA BIT_MASK 0x100 /end MEASUREMENT
/begin MEASUREMENT B_mxdven "Fehlertyp max.: DV-E Fehler bei PrÅfung Notluftposition" UWORD B_TRUE___UW 0 0 0.000000 0.000000 /begin IF_DATA ASAP1B_ETK KP_BLOB 0x383B22 1 2 /end IF_DATA BIT_MASK 0x100 /end MEASUREMENT
/begin MEASUREMENT B_mxdver "Fehlertyp max.: DV-E Regelbereich, langfristig verletzt" UWORD B_TRUE___UW 0 0 0.000000 0.000000 /begin IF_DATA ASAP1B_ETK KP_BLOB 0x383B24 1 2 /end IF_DATA BIT_MASK 0x100 /end MEASUREMENT
/begin MEASUREMENT B_mxdvet "" UWORD B_TRUE___UW 0 0 0.000000 0.000000 /begin IF_DATA ASAP1B_ETK KP_BLOB 0x383B26 1 2 /end IF_DATA BIT_MASK 0x100 /end MEASUREMENT
/begin MEASUREMENT B_mxdveu "Fehlertyp max.: DV-E Fehler beim UMA-Lernen" UWORD B_TRUE___UW 0 0 0.000000 0.000000 /begin IF_DATA ASAP1B_ETK KP_BLOB 0x383B28 1 2 /end IF_DATA BIT_MASK 0x100 /end MEASUREMENT
/begin MEASUREMENT B_mxdveub "Fehlertyp max.: DV-E-Adaption Abbruch wg. Umweltbedingung" UWORD B_TRUE___UW 0 0 0.000000 0.000000 /begin IF_DATA ASAP1B_ETK KP_BLOB 0x383B2A 1 2 /end IF_DATA BIT_MASK 0x100 /end MEASUREMENT
/begin MEASUREMENT B_mxdveuw "" UWORD B_TRUE___UW 0 0 0.000000 0.000000 /begin IF_DATA ASAP1B_ETK KP_BLOB 0x383B2C 1 2 /end IF_DATA BIT_MASK 0x100 /end MEASUREMENT
/begin MEASUREMENT B_mxdvev "Fehlertyp max.: DV-E Fehler bei VerstÑrkerabgleich" UWORD B_TRUE___UW 0 0 0.000000 0.000000 /begin IF_DATA ASAP1B_ETK KP_BLOB 0x383B2E 1 2 /end IF_DATA BIT_MASK 0x100 /end MEASUREMENT
/begin MEASUREMENT B_mxn "Fehlerart: hÑufiger LÅckenverlust beim LÅckencheck" UWORD B_TRUE___UW 0 0 0.000000 0.000000 /begin IF_DATA ASAP1B_ETK KP_BLOB 0x383BBA 1 2 /end IF_DATA BIT_MASK 0x100 /end MEASUREMENT
/begin MEASUREMENT B_nachlstp "Bedingung SG-Nachlauf beendet" UWORD B_TRUE___UW 0 0 0.000000 0.000000 /begin IF_DATA ASAP1B_ETK KP_BLOB 0x383CCE 1 2 /end IF_DATA BIT_MASK 0x2000 /end MEASUREMENT
/begin MEASUREMENT B_ngasok "Bedingung Ringspeicher fÅr ngas-Berechnung ok" UWORD B_TRUE___UW 0 0 0.000000 0.000000 /begin IF_DATA ASAP1B_ETK KP_BLOB 0xFD1C 0 2 /end IF_DATA BIT_MASK 0x4 /end MEASUREMENT
/begin MEASUREMENT B_nlpe "Bedingung: Fehler in NLP-PrÅfung u. -Lernen" UWORD B_TRUE___UW 0 0 0.000000 0.000000 /begin IF_DATA ASAP1B_ETK KP_BLOB 0xFD42 0 2 /end IF_DATA BIT_MASK 0x400 /end MEASUREMENT
/begin MEASUREMENT B_nlperf "Dauer-RAM, Bedingung: NLP-Erfassung erfolgreich" UBYTE B_TRUE 0 0 0.000000 0.000000 /begin IF_DATA ASAP1B_ETK KP_BLOB 0x38334B 1 1 /end IF_DATA BIT_MASK 0x2 /end MEASUREMENT
/begin MEASUREMENT B_nlpnew "Bedingung: NLP-Position ist noch nicht bekannt" UWORD B_TRUE___UW 0 0 0.000000 0.000000 /begin IF_DATA ASAP1B_ETK KP_BLOB 0xFD42 0 2 /end IF_DATA BIT_MASK 0x800 /end MEASUREMENT
/begin MEASUREMENT B_nlwst "Anforderung SteuergerÑtenachlauf fÅr Wiederholstarterkennung" UWORD B_TRUE___UW 0 0 0.000000 0.000000 /begin IF_DATA ASAP1B_ETK KP_BLOB 0x383CCE 1 2 /end IF_DATA BIT_MASK 0x4 /end MEASUREMENT
/begin MEASUREMENT B_nmin "Bedingung Unterdrehzahl: n < NMIN" UWORD B_TRUE___UW 0 0 0.000000 0.000000 /begin IF_DATA ASAP1B_ETK KP_BLOB 0xFD1E 0 2 /end IF_DATA BIT_MASK 0x400 /end MEASUREMENT
/begin MEASUREMENT B_nmot "Bedingung Motordrehzahl: n > NMIN" UWORD B_TRUE___UW 0 0 0.000000 0.000000 /begin IF_DATA ASAP1B_ETK KP_BLOB 0xFD1E 0 2 /end IF_DATA BIT_MASK 0x800 /end MEASUREMENT
/begin MEASUREMENT B_no "unendlich-Trigger fÅr Fehlerpfadmanagement" UBYTE B_TRUE 0 0 0.000000 0.000000 /begin IF_DATA ASAP1B_ETK KP_BLOB 0x383301 1 1 /end IF_DATA BIT_MASK 0x1 /end MEASUREMENT
/begin MEASUREMENT B_nomsr_fr "kein ASR-/MSR-Eingriff vom FR" UWORD B_TRUE___UW 0 0 0.000000 0.000000 /begin IF_DATA ASAP1B_ETK KP_BLOB 0xFD12 0 2 /end IF_DATA BIT_MASK 0x40 /end MEASUREMENT
/begin MEASUREMENT B_nomsr_um "MSR-Momentenvorgabe in der FunktionsÅberwachung nicht Åbernommen" UWORD B_TRUE___UW 0 0 0.000000 0.000000 /begin IF_DATA ASAP1B_ETK KP_BLOB 0xFD86 0 2 /end IF_DATA BIT_MASK 0x20 /end MEASUREMENT
/begin MEASUREMENT B_npbm "Fehlertyp: Bezugsmarkenfehler beim LÅckencheck" UWORD B_TRUE___UW 0 0 0.000000 0.000000 /begin IF_DATA ASAP1B_ETK KP_BLOB 0x383AF6 1 2 /end IF_DATA BIT_MASK 0x800 /end MEASUREMENT
/begin MEASUREMENT B_npcadr "Fehlertyp: CAN-Schnittstelle, Timeout Botschaft ADR" UWORD B_TRUE___UW 0 0 0.000000 0.000000 /begin IF_DATA ASAP1B_ETK KP_BLOB 0x383AFC 1 2 /end IF_DATA BIT_MASK 0x800 /end MEASUREMENT
/begin MEASUREMENT B_npcas "Fehlertyp: CAN-Schnittstelle, Timeout ASC" UWORD B_TRUE___UW 0 0 0.000000 0.000000 /begin IF_DATA ASAP1B_ETK KP_BLOB 0x383AFE 1 2 /end IF_DATA BIT_MASK 0x800 /end MEASUREMENT
/begin MEASUREMENT B_npcat "Fehlertyp: CAN-Schnittstelle Timeout ASR" UWORD B_TRUE___UW 0 0 0.000000 0.000000 /begin IF_DATA ASAP1B_ETK KP_BLOB 0x383B00 1 2 /end IF_DATA BIT_MASK 0x800 /end MEASUREMENT
/begin MEASUREMENT B_npcge "Fehlerart:CAN-Schnittstelle, Timeout EGS" UWORD B_TRUE___UW 0 0 0.000000 0.000000 /begin IF_DATA ASAP1B_ETK KP_BLOB 0x383B02 1 2 /end IF_DATA BIT_MASK 0x800 /end MEASUREMENT
/begin MEASUREMENT B_npcif "Fehlertyp: nicht plausibles Signal vom CAN (bus-off)" UWORD B_TRUE___UW 0 0 0.000000 0.000000 /begin IF_DATA ASAP1B_ETK KP_BLOB 0x383B04 1 2 /end IF_DATA BIT_MASK 0x800 /end MEASUREMENT
/begin MEASUREMENT B_npcins "Fehlerart:CAN-Schnittstelle, Timeout Instrument" UWORD B_TRUE___UW 0 0 0.000000 0.000000 /begin IF_DATA ASAP1B_ETK KP_BLOB 0x383B06 1 2 /end IF_DATA BIT_MASK 0x800 /end MEASUREMENT
/begin MEASUREMENT B_npclws "" UWORD B_TRUE___UW 0 0 0.000000 0.000000 /begin IF_DATA ASAP1B_ETK KP_BLOB 0x383B08 1 2 /end IF_DATA BIT_MASK 0x800 /end MEASUREMENT
/begin MEASUREMENT B_npdk "Bedingung unplausible Potisignale von der Drosselklappe" UWORD B_TRUE___UW 0 0 0.000000 0.000000 /begin IF_DATA ASAP1B_ETK KP_BLOB 0x383B0A 1 2 /end IF_DATA BIT_MASK 0x800 /end MEASUREMENT
/begin MEASUREMENT B_npdk1p "Fehlertyp unplaus.: Drosselklappe 1. Poti" UWORD B_TRUE___UW 0 0 0.000000 0.000000 /begin IF_DATA ASAP1B_ETK KP_BLOB 0x383B0C 1 2 /end IF_DATA BIT_MASK 0x800 /end MEASUREMENT
/begin MEASUREMENT B_npdk2p "Fehlertyp unplaus.: Drosselklappe 2. Poti" UWORD B_TRUE___UW 0 0 0.000000 0.000000 /begin IF_DATA ASAP1B_ETK KP_BLOB 0x383B0E 1 2 /end IF_DATA BIT_MASK 0x800 /end MEASUREMENT
/begin MEASUREMENT B_npdvee "Fehlerzyp unplaus.: DV-E Endstufe" UWORD B_TRUE___UW 0 0 0.000000 0.000000 /begin IF_DATA ASAP1B_ETK KP_BLOB 0x383B1A 1 2 /end IF_DATA BIT_MASK 0x800 /end MEASUREMENT
/begin MEASUREMENT B_npdvef "Fehlertyp unplaus.: DV-E Fehler bei FederprÅfung" UWORD B_TRUE___UW 0 0 0.000000 0.000000 /begin IF_DATA ASAP1B_ETK KP_BLOB 0x383B1C 1 2 /end IF_DATA BIT_MASK 0x800 /end MEASUREMENT
/begin MEASUREMENT B_npdvefo "" UWORD B_TRUE___UW 0 0 0.000000 0.000000 /begin IF_DATA ASAP1B_ETK KP_BLOB 0x383B1E 1 2 /end IF_DATA BIT_MASK 0x800 /end MEASUREMENT
/begin MEASUREMENT B_npdvel "Fehlerzyp unplaus.: DV-E Lageabweichung" UWORD B_TRUE___UW 0 0 0.000000 0.000000 /begin IF_DATA ASAP1B_ETK KP_BLOB 0x383B20 1 2 /end IF_DATA BIT_MASK 0x800 /end MEASUREMENT
/begin MEASUREMENT B_npdven "Fehlertyp unplaus.: DV-E Fehler bei PrÅfung Notluftposition" UWORD B_TRUE___UW 0 0 0.000000 0.000000 /begin IF_DATA ASAP1B_ETK KP_BLOB 0x383B22 1 2 /end IF_DATA BIT_MASK 0x800 /end MEASUREMENT
/begin MEASUREMENT B_npdver "Fehlerzyp unplaus.: DV-E Regelbereich" UWORD B_TRUE___UW 0 0 0.000000 0.000000 /begin IF_DATA ASAP1B_ETK KP_BLOB 0x383B24 1 2 /end IF_DATA BIT_MASK 0x800 /end MEASUREMENT
/begin MEASUREMENT B_npdvet "Fehlertyp 'unplausibel': DV-E-Tauscherkennung ohne Adaption" UWORD B_TRUE___UW 0 0 0.000000 0.000000 /begin IF_DATA ASAP1B_ETK KP_BLOB 0x383B26 1 2 /end IF_DATA BIT_MASK 0x800 /end MEASUREMENT
/begin MEASUREMENT B_npdveu "Fehlertyp unplaus.: DV-E Fehler beim UMA-Lernen" UWORD B_TRUE___UW 0 0 0.000000 0.000000 /begin IF_DATA ASAP1B_ETK KP_BLOB 0x383B28 1 2 /end IF_DATA BIT_MASK 0x800 /end MEASUREMENT
/begin MEASUREMENT B_npdveub "" UWORD B_TRUE___UW 0 0 0.000000 0.000000 /begin IF_DATA ASAP1B_ETK KP_BLOB 0x383B2A 1 2 /end IF_DATA BIT_MASK 0x800 /end MEASUREMENT
/begin MEASUREMENT B_npdveuw "Fehlertyp 'unplausibel' bei UMA-Wiederlernen" UWORD B_TRUE___UW 0 0 0.000000 0.000000 /begin IF_DATA ASAP1B_ETK KP_BLOB 0x383B2C 1 2 /end IF_DATA BIT_MASK 0x800 /end MEASUREMENT
/begin MEASUREMENT B_npdvev "Fehlertyp unplaus.: DV-E Fehler bei VerstÑrkerabgleich" UWORD B_TRUE___UW 0 0 0.000000 0.000000 /begin IF_DATA ASAP1B_ETK KP_BLOB 0x383B2E 1 2 /end IF_DATA BIT_MASK 0x800 /end MEASUREMENT
/begin MEASUREMENT B_npn "Fehlerart: hÑufiger Bezugsmarkenfehler beim LÅckencheck" UWORD B_TRUE___UW 0 0 0.000000 0.000000 /begin IF_DATA ASAP1B_ETK KP_BLOB 0x383BBA 1 2 /end IF_DATA BIT_MASK 0x800 /end MEASUREMENT
/begin MEASUREMENT B_nsp "Bedingung Nachspritzer" UWORD B_TRUE___UW 0 0 0.000000 0.000000 /begin IF_DATA ASAP1B_ETK KP_BLOB 0xFD5C 0 2 /end IF_DATA BIT_MASK 0x200 /end MEASUREMENT
/begin MEASUREMENT B_nswo2 "Bedingung Drehzahl > NSWO2" UWORD B_TRUE___UW 0 0 0.000000 0.000000 /begin IF_DATA ASAP1B_ETK KP_BLOB 0xFD02 0 2 /end IF_DATA BIT_MASK 0x2000 /end MEASUREMENT
/begin MEASUREMENT B_nuamsr "Bedingung Nachrichtenunterbrechung bei ASR/MSR" UWORD B_TRUE___UW 0 0 0.000000 0.000000 /begin IF_DATA ASAP1B_ETK KP_BLOB 0xFD12 0 2 /end IF_DATA BIT_MASK 0x80 /end MEASUREMENT
/begin MEASUREMENT B_pltab "Bedingung PlausibilitÑtsprÅfung Abstellzeit mîglich" UWORD B_TRUE___UW 0 0 0.000000 0.000000 /begin IF_DATA ASAP1B_ETK KP_BLOB 0xFD64 0 2 /end IF_DATA BIT_MASK 0x400 /end MEASUREMENT
/begin MEASUREMENT B_pwf "Bedingung Powerfail" UWORD B_TRUE___UW 0 0 0.000000 0.000000 /begin IF_DATA ASAP1B_ETK KP_BLOB 0xFD88 0 2 /end IF_DATA BIT_MASK 0x10 /end MEASUREMENT
/begin MEASUREMENT B_pycadr "" UWORD B_TRUE___UW 0 0 0.000000 0.000000 /begin IF_DATA ASAP1B_ETK KP_BLOB 0x383AFC 1 2 /end IF_DATA BIT_MASK 0x2000 /end MEASUREMENT
/begin MEASUREMENT B_pycas "" UWORD B_TRUE___UW 0 0 0.000000 0.000000 /begin IF_DATA ASAP1B_ETK KP_BLOB 0x383AFE 1 2 /end IF_DATA BIT_MASK 0x2000 /end MEASUREMENT
/begin MEASUREMENT B_pycat "" UWORD B_TRUE___UW 0 0 0.000000 0.000000 /begin IF_DATA ASAP1B_ETK KP_BLOB 0x383B00 1 2 /end IF_DATA BIT_MASK 0x2000 /end MEASUREMENT
/begin MEASUREMENT B_pycge "" UWORD B_TRUE___UW 0 0 0.000000 0.000000 /begin IF_DATA ASAP1B_ETK KP_BLOB 0x383B02 1 2 /end IF_DATA BIT_MASK 0x2000 /end MEASUREMENT
/begin MEASUREMENT B_pycif "" UWORD B_TRUE___UW 0 0 0.000000 0.000000 /begin IF_DATA ASAP1B_ETK KP_BLOB 0x383B04 1 2 /end IF_DATA BIT_MASK 0x2000 /end MEASUREMENT
/begin MEASUREMENT B_pycins "" UWORD B_TRUE___UW 0 0 0.000000 0.000000 /begin IF_DATA ASAP1B_ETK KP_BLOB 0x383B06 1 2 /end IF_DATA BIT_MASK 0x2000 /end MEASUREMENT
/begin MEASUREMENT B_pyclws "" UWORD B_TRUE___UW 0 0 0.000000 0.000000 /begin IF_DATA ASAP1B_ETK KP_BLOB 0x383B08 1 2 /end IF_DATA BIT_MASK 0x2000 /end MEASUREMENT
/begin MEASUREMENT B_rlp "Bedingung Lastpraediktion aktiv" UWORD B_TRUE___UW 0 0 0.000000 0.000000 /begin IF_DATA ASAP1B_ETK KP_BLOB 0xFD5C 0 2 /end IF_DATA BIT_MASK 0x400 /end MEASUREMENT
/begin MEASUREMENT B_rlpns "Einschaltbedingung Lastpraediktion nach Start" UWORD B_TRUE___UW 0 0 0.000000 0.000000 /begin IF_DATA ASAP1B_ETK KP_BLOB 0xFD5C 0 2 /end IF_DATA BIT_MASK 0x800 /end MEASUREMENT
/begin MEASUREMENT B_sa "Schubabschaltung" UWORD B_TRUE___UW 0 0 0.000000 0.000000 /begin IF_DATA ASAP1B_ETK KP_BLOB 0xFD84 0 2 /end IF_DATA BIT_MASK 0x2 /end MEASUREMENT
/begin MEASUREMENT B_sacvt "Bedingung SchubabschaltunterstÅtzung fÅr CVT-Getriebe" UWORD B_TRUE___UW 0 0 0.000000 0.000000 /begin IF_DATA ASAP1B_ETK KP_BLOB 0xFD12 0 2 /end IF_DATA BIT_MASK 0x100 /end MEASUREMENT
/begin MEASUREMENT B_savacc "Bedingung: Schubabschalteverbot von ACC" UWORD B_TRUE___UW 0 0 0.000000 0.000000 /begin IF_DATA ASAP1B_ETK KP_BLOB 0xFD12 0 2 /end IF_DATA BIT_MASK 0x200 /end MEASUREMENT
/begin MEASUREMENT B_savmsr "Bedingung Schubabschalteverbot bei MSR-Anforderung" UWORD B_TRUE___UW 0 0 0.000000 0.000000 /begin IF_DATA ASAP1B_ETK KP_BLOB 0xFD12 0 2 /end IF_DATA BIT_MASK 0x400 /end MEASUREMENT
/begin MEASUREMENT B_sccadr "" UWORD B_TRUE___UW 0 0 0.000000 0.000000 /begin IF_DATA ASAP1B_ETK KP_BLOB 0x383AFC 1 2 /end IF_DATA BIT_MASK 0x4000 /end MEASUREMENT
/begin MEASUREMENT B_sccas "" UWORD B_TRUE___UW 0 0 0.000000 0.000000 /begin IF_DATA ASAP1B_ETK KP_BLOB 0x383AFE 1 2 /end IF_DATA BIT_MASK 0x4000 /end MEASUREMENT
/begin MEASUREMENT B_sccat "" UWORD B_TRUE___UW 0 0 0.000000 0.000000 /begin IF_DATA ASAP1B_ETK KP_BLOB 0x383B00 1 2 /end IF_DATA BIT_MASK 0x4000 /end MEASUREMENT
/begin MEASUREMENT B_sccge "" UWORD B_TRUE___UW 0 0 0.000000 0.000000 /begin IF_DATA ASAP1B_ETK KP_BLOB 0x383B02 1 2 /end IF_DATA BIT_MASK 0x4000 /end MEASUREMENT
/begin MEASUREMENT B_sccif "" UWORD B_TRUE___UW 0 0 0.000000 0.000000 /begin IF_DATA ASAP1B_ETK KP_BLOB 0x383B04 1 2 /end IF_DATA BIT_MASK 0x4000 /end MEASUREMENT
/begin MEASUREMENT B_sccins "" UWORD B_TRUE___UW 0 0 0.000000 0.000000 /begin IF_DATA ASAP1B_ETK KP_BLOB 0x383B06 1 2 /end IF_DATA BIT_MASK 0x4000 /end MEASUREMENT
/begin MEASUREMENT B_scclws "" UWORD B_TRUE___UW 0 0 0.000000 0.000000 /begin IF_DATA ASAP1B_ETK KP_BLOB 0x383B08 1 2 /end IF_DATA BIT_MASK 0x4000 /end MEASUREMENT
/begin MEASUREMENT B_sibm "Fehlertyp: keine Bezugsmarke im Start gefunden" UWORD B_TRUE___UW 0 0 0.000000 0.000000 /begin IF_DATA ASAP1B_ETK KP_BLOB 0x383AF6 1 2 /end IF_DATA BIT_MASK 0x400 /end MEASUREMENT
/begin MEASUREMENT B_sicadr "Signalfehler CAN-Timeout Botschaft ADR" UWORD B_TRUE___UW 0 0 0.000000 0.000000 /begin IF_DATA ASAP1B_ETK KP_BLOB 0x383AFC 1 2 /end IF_DATA BIT_MASK 0x400 /end MEASUREMENT
/begin MEASUREMENT B_sicas "Signalfehler CAN-Timeout ASC-Botschaften" UWORD B_TRUE___UW 0 0 0.000000 0.000000 /begin IF_DATA ASAP1B_ETK KP_BLOB 0x383AFE 1 2 /end IF_DATA BIT_MASK 0x400 /end MEASUREMENT
/begin MEASUREMENT B_sicat "Fehlertyp: ASR/MSR Codierfehler" UWORD B_TRUE___UW 0 0 0.000000 0.000000 /begin IF_DATA ASAP1B_ETK KP_BLOB 0x383B00 1 2 /end IF_DATA BIT_MASK 0x400 /end MEASUREMENT
/begin MEASUREMENT B_sicge "Signalfehler CAN-Timeout EGS-Botschaft" UWORD B_TRUE___UW 0 0 0.000000 0.000000 /begin IF_DATA ASAP1B_ETK KP_BLOB 0x383B02 1 2 /end IF_DATA BIT_MASK 0x400 /end MEASUREMENT
/begin MEASUREMENT B_sicif "Signalfehler CAN-Schnittstelle (Bus off)" UWORD B_TRUE___UW 0 0 0.000000 0.000000 /begin IF_DATA ASAP1B_ETK KP_BLOB 0x383B04 1 2 /end IF_DATA BIT_MASK 0x400 /end MEASUREMENT
/begin MEASUREMENT B_sicins "Signalfehler CAN-Timeout Botschaft Kombi-Instruments" UWORD B_TRUE___UW 0 0 0.000000 0.000000 /begin IF_DATA ASAP1B_ETK KP_BLOB 0x383B06 1 2 /end IF_DATA BIT_MASK 0x400 /end MEASUREMENT
/begin MEASUREMENT B_siclws "Signalfehler CAN-Timeout Botschaft Lenkwinkelsensor" UWORD B_TRUE___UW 0 0 0.000000 0.000000 /begin IF_DATA ASAP1B_ETK KP_BLOB 0x383B08 1 2 /end IF_DATA BIT_MASK 0x400 /end MEASUREMENT
/begin MEASUREMENT B_sidk "Fehlertyp: Fehler Drosselklappenpoti lîschen" UWORD B_TRUE___UW 0 0 0.000000 0.000000 /begin IF_DATA ASAP1B_ETK KP_BLOB 0x383B0A 1 2 /end IF_DATA BIT_MASK 0x400 /end MEASUREMENT
/begin MEASUREMENT B_sidk1p "Fehlendes Signal: Drosselklappe 1. Poti" UWORD B_TRUE___UW 0 0 0.000000 0.000000 /begin IF_DATA ASAP1B_ETK KP_BLOB 0x383B0C 1 2 /end IF_DATA BIT_MASK 0x400 /end MEASUREMENT
/begin MEASUREMENT B_sidk2p "Fehlendes Signal: Drosselklappe 2. Poti" UWORD B_TRUE___UW 0 0 0.000000 0.000000 /begin IF_DATA ASAP1B_ETK KP_BLOB 0x383B0E 1 2 /end IF_DATA BIT_MASK 0x400 /end MEASUREMENT
/begin MEASUREMENT B_sidvee "Fehlertyp sig.: DV-E Endstufe" UWORD B_TRUE___UW 0 0 0.000000 0.000000 /begin IF_DATA ASAP1B_ETK KP_BLOB 0x383B1A 1 2 /end IF_DATA BIT_MASK 0x400 /end MEASUREMENT
/begin MEASUREMENT B_sidvef "Fehlertyp sig.: DV-E Fehler bei FederprÅfung" UWORD B_TRUE___UW 0 0 0.000000 0.000000 /begin IF_DATA ASAP1B_ETK KP_BLOB 0x383B1C 1 2 /end IF_DATA BIT_MASK 0x400 /end MEASUREMENT
/begin MEASUREMENT B_sidvefo "" UWORD B_TRUE___UW 0 0 0.000000 0.000000 /begin IF_DATA ASAP1B_ETK KP_BLOB 0x383B1E 1 2 /end IF_DATA BIT_MASK 0x400 /end MEASUREMENT
/begin MEASUREMENT B_sidvel "Fehlertyp sig.: DV-E Lageabweichung" UWORD B_TRUE___UW 0 0 0.000000 0.000000 /begin IF_DATA ASAP1B_ETK KP_BLOB 0x383B20 1 2 /end IF_DATA BIT_MASK 0x400 /end MEASUREMENT
/begin MEASUREMENT B_sidven "Fehlertyp sig.: DV-E Fehler bei PrÅfung Notluftposition" UWORD B_TRUE___UW 0 0 0.000000 0.000000 /begin IF_DATA ASAP1B_ETK KP_BLOB 0x383B22 1 2 /end IF_DATA BIT_MASK 0x400 /end MEASUREMENT
/begin MEASUREMENT B_sidver "Fehlertyp sig.: DV-E Regelbereich" UWORD B_TRUE___UW 0 0 0.000000 0.000000 /begin IF_DATA ASAP1B_ETK KP_BLOB 0x383B24 1 2 /end IF_DATA BIT_MASK 0x400 /end MEASUREMENT
/begin MEASUREMENT B_sidvet "" UWORD B_TRUE___UW 0 0 0.000000 0.000000 /begin IF_DATA ASAP1B_ETK KP_BLOB 0x383B26 1 2 /end IF_DATA BIT_MASK 0x400 /end MEASUREMENT
/begin MEASUREMENT B_sidveu "Fehlertyp sig.: DV-E Fehler beim UMA-Lernen" UWORD B_TRUE___UW 0 0 0.000000 0.000000 /begin IF_DATA ASAP1B_ETK KP_BLOB 0x383B28 1 2 /end IF_DATA BIT_MASK 0x400 /end MEASUREMENT
/begin MEASUREMENT B_sidveub "" UWORD B_TRUE___UW 0 0 0.000000 0.000000 /begin IF_DATA ASAP1B_ETK KP_BLOB 0x383B2A 1 2 /end IF_DATA BIT_MASK 0x400 /end MEASUREMENT
/begin MEASUREMENT B_sidveuw "" UWORD B_TRUE___UW 0 0 0.000000 0.000000 /begin IF_DATA ASAP1B_ETK KP_BLOB 0x383B2C 1 2 /end IF_DATA BIT_MASK 0x400 /end MEASUREMENT
/begin MEASUREMENT B_sidvev "Fehlertyp sig.: DV-E Fehler bei VerstÑrkerabgleich" UWORD B_TRUE___UW 0 0 0.000000 0.000000 /begin IF_DATA ASAP1B_ETK KP_BLOB 0x383B2E 1 2 /end IF_DATA BIT_MASK 0x400 /end MEASUREMENT
/begin MEASUREMENT B_sin "Fehlertyp: kein Drehzahlsignal vorhanden" UWORD B_TRUE___UW 0 0 0.000000 0.000000 /begin IF_DATA ASAP1B_ETK KP_BLOB 0x383BBA 1 2 /end IF_DATA BIT_MASK 0x400 /end MEASUREMENT
/begin MEASUREMENT B_sp3 "Spezial-Bereichs-Trigger der Diagnose Kraftstoffversorgungssystem" UBYTE B_TRUE 0 0 0.000000 0.000000 /begin IF_DATA ASAP1B_ETK KP_BLOB 0x383302 1 1 /end IF_DATA BIT_MASK 0x1 /end MEASUREMENT
/begin MEASUREMENT B_st "Bedingung Start" UWORD B_TRUE___UW 0 0 0.000000 0.000000 /begin IF_DATA ASAP1B_ETK KP_BLOB 0xFD88 0 2 /end IF_DATA BIT_MASK 0x20 /end MEASUREMENT
/begin MEASUREMENT B_statbr "Status Bremseneingriff Åber CAN" UWORD B_TRUE___UW 0 0 0.000000 0.000000 /begin IF_DATA ASAP1B_ETK KP_BLOB 0xFD12 0 2 /end IF_DATA BIT_MASK 0x800 /end MEASUREMENT
/begin MEASUREMENT B_statge "Status Getriebeeingriff Åber CAN" UWORD B_TRUE___UW 0 0 0.000000 0.000000 /begin IF_DATA ASAP1B_ETK KP_BLOB 0xFD12 0 2 /end IF_DATA BIT_MASK 0x1000 /end MEASUREMENT
/begin MEASUREMENT B_statmd "Status Momentensignale fÅr CAN" UWORD B_TRUE___UW 0 0 0.000000 0.000000 /begin IF_DATA ASAP1B_ETK KP_BLOB 0xFD12 0 2 /end IF_DATA BIT_MASK 0x2000 /end MEASUREMENT
/begin MEASUREMENT B_statme "Bedingung Momenteneingriff ASR/MSR/ESP statisch nicht erfÅllbar" UWORD B_TRUE___UW 0 0 0.000000 0.000000 /begin IF_DATA ASAP1B_ETK KP_BLOB 0xFD12 0 2 /end IF_DATA BIT_MASK 0x4000 /end MEASUREMENT
/begin MEASUREMENT B_statnb "Bedingung Normalbetrieb (fÅr CAN-Ausgabe)" UWORD B_TRUE___UW 0 0 0.000000 0.000000 /begin IF_DATA ASAP1B_ETK KP_BLOB 0xFD12 0 2 /end IF_DATA BIT_MASK 0x8000 /end MEASUREMENT
/begin MEASUREMENT B_statto "Bedingung ASR-Timeout erkannt (fÅr CAN-Ausgabe)" UWORD B_TRUE___UW 0 0 0.000000 0.000000 /begin IF_DATA ASAP1B_ETK KP_BLOB 0xFD14 0 2 /end IF_DATA BIT_MASK 0x1 /end MEASUREMENT
/begin MEASUREMENT B_stend "1 = Startende erkannt" UWORD B_TRUE___UW 0 0 0.000000 0.000000 /begin IF_DATA ASAP1B_ETK KP_BLOB 0xFD88 0 2 /end IF_DATA BIT_MASK 0x40 /end MEASUREMENT
/begin MEASUREMENT B_swe_b "Bedingung Schlechtwegstrecke erkannt duch Bit Åber CAN (aus ABS-SG)" UWORD B_TRUE___UW 0 0 0.000000 0.000000 /begin IF_DATA ASAP1B_ETK KP_BLOB 0xFD14 0 2 /end IF_DATA BIT_MASK 0x2 /end MEASUREMENT
/begin MEASUREMENT B_syserr "Bedingung fÅr mind. 1 Fehler (E_abc) im System erkannt" UBYTE B_TRUE 0 0 0.000000 0.000000 /begin IF_DATA ASAP1B_ETK KP_BLOB 0x380A3A 1 1 /end IF_DATA BIT_MASK 0x2 /end MEASUREMENT
/begin MEASUREMENT B_tabunpl "Bedingung Abstellzeit unplausibel" UWORD B_TRUE___UW 0 0 0.000000 0.000000 /begin IF_DATA ASAP1B_ETK KP_BLOB 0xFD64 0 2 /end IF_DATA BIT_MASK 0x800 /end MEASUREMENT
/begin MEASUREMENT B_talcan "Bedingung Tank leer aus Kombi-Botschaft" UWORD B_TRUE___UW 0 0 0.000000 0.000000 /begin IF_DATA ASAP1B_ETK KP_BLOB 0xFD14 0 2 /end IF_DATA BIT_MASK 0x4 /end MEASUREMENT
/begin MEASUREMENT B_talkbi "Bedingung Tank leer vom Kombi" UWORD B_TRUE___UW 0 0 0.000000 0.000000 /begin IF_DATA ASAP1B_ETK KP_BLOB 0xFD14 0 2 /end IF_DATA BIT_MASK 0x8 /end MEASUREMENT
/begin MEASUREMENT B_tbeph "Bedingung Taste Beschleunigen positive Flanke Halten" UWORD B_TRUE___UW 0 0 0.000000 0.000000 /begin IF_DATA ASAP1B_ETK KP_BLOB 0xFD50 0 2 /end IF_DATA BIT_MASK 0x10 /end MEASUREMENT
/begin MEASUREMENT B_tbgrac "Bedingung FGR beschleunigen fÅr CAN-Ausgabe" UWORD B_TRUE___UW 0 0 0.000000 0.000000 /begin IF_DATA ASAP1B_ETK KP_BLOB 0xFD14 0 2 /end IF_DATA BIT_MASK 0x10 /end MEASUREMENT
/begin MEASUREMENT B_tfu "Bedingung TemperaturfÅhler Umgebung vorhanden" UWORD B_TRUE___UW 0 0 0.000000 0.000000 /begin IF_DATA ASAP1B_ETK KP_BLOB 0xFD02 0 2 /end IF_DATA BIT_MASK 0x8000 /end MEASUREMENT
/begin MEASUREMENT B_tim "Zeit-Trigger fÅr Fehlerpfadmanagement" UBYTE B_TRUE 0 0 0.000000 0.000000 /begin IF_DATA ASAP1B_ETK KP_BLOB 0x380A33 1 1 /end IF_DATA BIT_MASK 0x1 /end MEASUREMENT
/begin MEASUREMENT B_tippg "Bedingung WÑhlhebel in Stellung 'Tippgasse'" UWORD B_TRUE___UW 0 0 0.000000 0.000000 /begin IF_DATA ASAP1B_ETK KP_BLOB 0xFD14 0 2 /end IF_DATA BIT_MASK 0x20 /end MEASUREMENT
/begin MEASUREMENT B_tired "Bedingung ti-Reduktion" UWORD B_TRUE___UW 0 0 0.000000 0.000000 /begin IF_DATA ASAP1B_ETK KP_BLOB 0xFD5C 0 2 /end IF_DATA BIT_MASK 0x1000 /end MEASUREMENT
/begin MEASUREMENT B_tmkicb "Bedingung Motortemperatur aus Kombibotschaft auswertbar" UWORD B_TRUE___UW 0 0 0.000000 0.000000 /begin IF_DATA ASAP1B_ETK KP_BLOB 0xFD14 0 2 /end IF_DATA BIT_MASK 0x40 /end MEASUREMENT
/begin MEASUREMENT B_tolcb "Bedingung ôltemperatur aus Kombibotschaft auswertbar" UWORD B_TRUE___UW 0 0 0.000000 0.000000 /begin IF_DATA ASAP1B_ETK KP_BLOB 0xFD14 0 2 /end IF_DATA BIT_MASK 0x80 /end MEASUREMENT
/begin MEASUREMENT B_trip "Flag fÅr erfÅllten 'trip'" UBYTE B_TRUE 0 0 0.000000 0.000000 /begin IF_DATA ASAP1B_ETK KP_BLOB 0x380A3A 1 1 /end IF_DATA BIT_MASK 0x1 /end MEASUREMENT
/begin MEASUREMENT B_tveph "Bedingung Taste Verzîgern positive Flanke Halten" UWORD B_TRUE___UW 0 0 0.000000 0.000000 /begin IF_DATA ASAP1B_ETK KP_BLOB 0xFD50 0 2 /end IF_DATA BIT_MASK 0x2000 /end MEASUREMENT
/begin MEASUREMENT B_tvgrac "Bedingung FGR verzîgern fÅr CAN-Ausgabe" UWORD B_TRUE___UW 0 0 0.000000 0.000000 /begin IF_DATA ASAP1B_ETK KP_BLOB 0xFD14 0 2 /end IF_DATA BIT_MASK 0x100 /end MEASUREMENT
/begin MEASUREMENT B_ugdsp "Bedingung praedizierter DK-Sollwinkel im ungedrosselten Bereich" UWORD B_TRUE___UW 0 0 0.000000 0.000000 /begin IF_DATA ASAP1B_ETK KP_BLOB 0xFD5C 0 2 /end IF_DATA BIT_MASK 0x2000 /end MEASUREMENT
/begin MEASUREMENT B_uhrrmin "Bedingung Uhr mit relativem MinutenzÑhler" UWORD B_TRUE___UW 0 0 0.000000 0.000000 /begin IF_DATA ASAP1B_ETK KP_BLOB 0xFD04 0 2 /end IF_DATA BIT_MASK 0x1 /end MEASUREMENT
/begin MEASUREMENT B_uhrrsec "Bedingung Uhr mit relativem SekundenzÑhler" UWORD B_TRUE___UW 0 0 0.000000 0.000000 /begin IF_DATA ASAP1B_ETK KP_BLOB 0xFD04 0 2 /end IF_DATA BIT_MASK 0x2 /end MEASUREMENT
/begin MEASUREMENT B_umae "Bedingung: Fehler beim UMA-Lernen" UWORD B_TRUE___UW 0 0 0.000000 0.000000 /begin IF_DATA ASAP1B_ETK KP_BLOB 0xFD42 0 2 /end IF_DATA BIT_MASK 0x2000 /end MEASUREMENT
/begin MEASUREMENT B_umauab "Bedingung: UMA-Lernen wÑhrend Urinitialisierung abgebrochen (SKA)" UWORD B_TRUE___UW 0 0 0.000000 0.000000 /begin IF_DATA ASAP1B_ETK KP_BLOB 0xFD44 0 2 /end IF_DATA BIT_MASK 0x1 /end MEASUREMENT
/begin MEASUREMENT B_vbemg "Bedingung Verbrennungserkennung mîglich" UWORD B_TRUE___UW 0 0 0.000000 0.000000 /begin IF_DATA ASAP1B_ETK KP_BLOB 0xFD60 0 2 /end IF_DATA BIT_MASK 0x40 /end MEASUREMENT
/begin MEASUREMENT B_wdk2sel "Bedingung DK-Winkel-Berechnung fÅr Lageregler aus Poti 2" UWORD B_TRUE___UW 0 0 0.000000 0.000000 /begin IF_DATA ASAP1B_ETK KP_BLOB 0xFD40 0 2 /end IF_DATA BIT_MASK 0x4 /end MEASUREMENT
/begin MEASUREMENT B_wdksive "Bedingung: Fehler im Vergleich DK-Winkel-Sollwert/-Istwert" UWORD B_TRUE___UW 0 0 0.000000 0.000000 /begin IF_DATA ASAP1B_ETK KP_BLOB 0xFD46 0 2 /end IF_DATA BIT_MASK 0x80 /end MEASUREMENT
/begin MEASUREMENT B_wiauf "Bedingung FGR im Zustand Wiederaufnahme" UWORD B_TRUE___UW 0 0 0.000000 0.000000 /begin IF_DATA ASAP1B_ETK KP_BLOB 0xFD52 0 2 /end IF_DATA BIT_MASK 0x4 /end MEASUREMENT
/begin MEASUREMENT B_wk "Bedingung: Wandlerkupplung ÅberbrÅckt" UWORD B_TRUE___UW 0 0 0.000000 0.000000 /begin IF_DATA ASAP1B_ETK KP_BLOB 0xFD14 0 2 /end IF_DATA BIT_MASK 0x200 /end MEASUREMENT
/begin MEASUREMENT B_wkauf "Bedingung Wandlerkupplung offen" UWORD B_TRUE___UW 0 0 0.000000 0.000000 /begin IF_DATA ASAP1B_ETK KP_BLOB 0xFD14 0 2 /end IF_DATA BIT_MASK 0x400 /end MEASUREMENT
/begin MEASUREMENT B_wkr "Bedingung fÅr Wandlerkupplung geregelt" UWORD B_TRUE___UW 0 0 0.000000 0.000000 /begin IF_DATA ASAP1B_ETK KP_BLOB 0xFD14 0 2 /end IF_DATA BIT_MASK 0x800 /end MEASUREMENT
/begin MEASUREMENT B_zges "Bedingung Zwischengasanforderung vom Getriebe-SG" UWORD B_TRUE___UW 0 0 0.000000 0.000000 /begin IF_DATA ASAP1B_ETK KP_BLOB 0xFD14 0 2 /end IF_DATA BIT_MASK 0x1000 /end MEASUREMENT
/begin MEASUREMENT cs_gra "berechnte Checksumme der GRA-Botschaft" UBYTE DEZ 0 0 0.000000 255.000000 /begin IF_DATA ASAP1B_ETK KP_BLOB 0x3809C1 1 1 /end IF_DATA BIT_MASK 0xFF /end MEASUREMENT
/begin MEASUREMENT ctrerf1 "ZÑhler fÅr Anzahl erkannter Fehler im System seit powerfail" UBYTE dez 0 0 0.000000 255.000000 /begin IF_DATA ASAP1B_ETK KP_BLOB 0x380A3B 1 1 /end IF_DATA BIT_MASK 0xFF /end MEASUREMENT
/begin MEASUREMENT ctrrdy1 "ZÑhler fÅr Anzahl geprÅfter Fehlerpfade im System seit powerfail" UBYTE dez 0 0 0.000000 255.000000 /begin IF_DATA ASAP1B_ETK KP_BLOB 0x380A3C 1 1 /end IF_DATA BIT_MASK 0xFF /end MEASUREMENT
/begin MEASUREMENT ctrsfp "ZÑhler fÅr Anzahl Fehlerpfade im System" UBYTE dez 0 0 0.000000 255.000000 /begin IF_DATA ASAP1B_ETK KP_BLOB 0x380A3D 1 1 /end IF_DATA BIT_MASK 0xFF /end MEASUREMENT
/begin MEASUREMENT ctrzyf0 "ZÑhler fÅr Anzahl ungeprÅfter Fehlerpfade im System seit Start" UBYTE dez 0 0 0.000000 255.000000 /begin IF_DATA ASAP1B_ETK KP_BLOB 0x380A3E 1 1 /end IF_DATA BIT_MASK 0xFF /end MEASUREMENT
/begin MEASUREMENT ctrzyf1 "ZÑhler fÅr Anzahl geprÅfter Fehlerpfade im System seit Start" UBYTE dez 0 0 0.000000 255.000000 /begin IF_DATA ASAP1B_ETK KP_BLOB 0x380A3F 1 1 /end IF_DATA BIT_MASK 0xFF /end MEASUREMENT
/begin MEASUREMENT dcycnt "Driving cycle - counter" UWORD dez___UW 0 0 0.000000 65535.000000 /begin IF_DATA ASAP1B_ETK KP_BLOB 0x383842 1 2 /end IF_DATA BIT_MASK 0xFFFF /end MEASUREMENT
/begin MEASUREMENT devoff "EV-Ausblendmaske bei Testeranforderung" UBYTE dez 0 0 0.000000 255.000000 /begin IF_DATA ASAP1B_ETK KP_BLOB 0x380C5A 1 1 /end IF_DATA BIT_MASK 0xFF /end MEASUREMENT
/begin MEASUREMENT dfcmFcm "" UBYTE dez 0 0 0.000000 255.000000 /begin IF_DATA ASAP1B_ETK KP_BLOB 0x383303 1 1 /end IF_DATA BIT_MASK 0xFF /end MEASUREMENT
/begin MEASUREMENT dfcmNo "" UBYTE dez 0 0 0.000000 255.000000 /begin IF_DATA ASAP1B_ETK KP_BLOB 0x383304 1 1 /end IF_DATA BIT_MASK 0xFF /end MEASUREMENT
/begin MEASUREMENT dfcmSfp "" UBYTE dez 0 0 0.000000 255.000000 /begin IF_DATA ASAP1B_ETK KP_BLOB 0x383305 1 1 /end IF_DATA BIT_MASK 0xFF /end MEASUREMENT
/begin MEASUREMENT dfpmEpclState "" UWORD dez___UW 0 0 0.000000 65535.000000 /begin IF_DATA ASAP1B_ETK KP_BLOB 0x383844 1 2 /end IF_DATA BIT_MASK 0xFFFF /end MEASUREMENT
/begin MEASUREMENT dfpmMilState "" UWORD dez___UW 0 0 0.000000 65535.000000 /begin IF_DATA ASAP1B_ETK KP_BLOB 0x383845 1 2 /end IF_DATA BIT_MASK 0xFFFF /end MEASUREMENT
/begin MEASUREMENT dfp_ap "" UBYTE dez 0 0 0.000000 255.000000 /begin IF_DATA ASAP1B_ETK KP_BLOB 0x383306 1 1 /end IF_DATA BIT_MASK 0xFF /end MEASUREMENT
/begin MEASUREMENT dpsdvs_w "delta Saugrohrdruck aus Drosselventilen (Word)" SWORD p_sw_q0p039 0 0 -1280.000000 1279.960938 /begin IF_DATA ASAP1B_ETK KP_BLOB 0x381FBE 1 2 /end IF_DATA BIT_MASK 0xFFFF /end MEASUREMENT
/begin MEASUREMENT dpsfg_w "delta-Frischgaspartialdruck im Saugrohr" SWORD p_sw_q0p039 0 0 -1280.000000 1279.960938 /begin IF_DATA ASAP1B_ETK KP_BLOB 0x381E40 1 2 /end IF_DATA BIT_MASK 0xFFFF /end MEASUREMENT
/begin MEASUREMENT dpsmp_w "delta extrapolierter Saugrohrdruck (Word)" SWORD p_sw_q0p039 0 0 -1280.000000 1279.960938 /begin IF_DATA ASAP1B_ETK KP_BLOB 0x381FC0 1 2 /end IF_DATA BIT_MASK 0xFFFF /end MEASUREMENT
/begin MEASUREMENT dpvl_w "Druckabfall am Luftfilter" UWORD p_uw_q0p039 0 0 0.000000 2559.960938 /begin IF_DATA ASAP1B_ETK KP_BLOB 0x3827C4 1 2 /end IF_DATA BIT_MASK 0xFFFF /end MEASUREMENT
/begin MEASUREMENT drlas_w "FÅllungsÑnderung pro Arbeitsspiel" SWORD relNWU_q0p0234 0 0 -768.000000 767.976562 /begin IF_DATA ASAP1B_ETK KP_BLOB 0x381EC8 1 2 /end IF_DATA BIT_MASK 0xFFFF /end MEASUREMENT
/begin MEASUREMENT drlp_w "delta-Einspritzberechnungs-Last aus Praediktion (Word)" SWORD rel_sw_q0p0234 0 0 -768.000000 767.976562 /begin IF_DATA ASAP1B_ETK KP_BLOB 0xF9B2 0 2 /end IF_DATA BIT_MASK 0xFFFF /end MEASUREMENT
/begin MEASUREMENT drl_w "FÅllungsÑnderung (Word)" SWORD rel_sw_q0p0234 0 0 -768.000000 767.976562 /begin IF_DATA ASAP1B_ETK KP_BLOB 0x381E42 1 2 /end IF_DATA BIT_MASK 0xFFFF /end MEASUREMENT
/begin MEASUREMENT dveadchst "DV-E-Adaption: Status PrÅfbedingungen" UBYTE dez 0 0 0.000000 255.000000 /begin IF_DATA ASAP1B_ETK KP_BLOB 0x380AD2 1 1 /end IF_DATA BIT_MASK 0xFF /end MEASUREMENT
/begin MEASUREMENT egaspfad "EGAS-Pfad als Umweltbedingung fÅr FunktionsÅberwachungs-Diagnoseeintrag" UBYTE dez 0 0 0.000000 255.000000 /begin IF_DATA ASAP1B_ETK KP_BLOB 0x380C93 1 1 /end IF_DATA BIT_MASK 0xFF /end MEASUREMENT
/begin MEASUREMENT ei_msrc_um "irreversibles Fehlerbit bei der MSR-öberwachung der FunktionsÅberwachung" UWORD B_TRUE___UW 0 0 0.000000 0.000000 /begin IF_DATA ASAP1B_ETK KP_BLOB 0xFD86 0 2 /end IF_DATA BIT_MASK 0x40 /end MEASUREMENT
/begin MEASUREMENT ei_mver_um "irreversibles Fehlerbit beim Momentenvergleich der FunktionsÅberwachung" UWORD B_TRUE___UW 0 0 0.000000 0.000000 /begin IF_DATA ASAP1B_ETK KP_BLOB 0xFD86 0 2 /end IF_DATA BIT_MASK 0x80 /end MEASUREMENT
/begin MEASUREMENT evz_austot "Einspritzausblendmuster total" UBYTE dez 0 0 0.000000 255.000000 /begin IF_DATA ASAP1B_ETK KP_BLOB 0x380B1E 1 1 /end IF_DATA BIT_MASK 0xFF /end MEASUREMENT
/begin MEASUREMENT E_bm "Errorflag: Bezugsmarkengeber" UWORD B_TRUE___UW 0 0 0.000000 0.000000 /begin IF_DATA ASAP1B_ETK KP_BLOB 0x383AF6 1 2 /end IF_DATA BIT_MASK 0x1 /end MEASUREMENT
/begin MEASUREMENT E_cadr "Errorflag: CAN-Schnittstelle, Timeout Botschaft ADR" UWORD B_TRUE___UW 0 0 0.000000 0.000000 /begin IF_DATA ASAP1B_ETK KP_BLOB 0x383AFC 1 2 /end IF_DATA BIT_MASK 0x1 /end MEASUREMENT
/begin MEASUREMENT E_cas "Errorflag: CAN-Schnittstelle, Timeout ASC" UWORD B_TRUE___UW 0 0 0.000000 0.000000 /begin IF_DATA ASAP1B_ETK KP_BLOB 0x383AFE 1 2 /end IF_DATA BIT_MASK 0x1 /end MEASUREMENT
/begin MEASUREMENT E_cat "Errorflag: CAN-Schnittstelle, Timeout Bremsbotschaft setzen" UWORD B_TRUE___UW 0 0 0.000000 0.000000 /begin IF_DATA ASAP1B_ETK KP_BLOB 0x383B00 1 2 /end IF_DATA BIT_MASK 0x1 /end MEASUREMENT
/begin MEASUREMENT E_cge "Errorflag: CAN-Schnittstelle, Timeout EGS" UWORD B_TRUE___UW 0 0 0.000000 0.000000 /begin IF_DATA ASAP1B_ETK KP_BLOB 0x383B02 1 2 /end IF_DATA BIT_MASK 0x1 /end MEASUREMENT
/begin MEASUREMENT E_cif "Errorflag: CAN-Schnittstelle, interner Fehler" UWORD B_TRUE___UW 0 0 0.000000 0.000000 /begin IF_DATA ASAP1B_ETK KP_BLOB 0x383B04 1 2 /end IF_DATA BIT_MASK 0x1 /end MEASUREMENT
/begin MEASUREMENT E_cins "Errorflag: CAN-Schnittstelle, Timeout Instrument" UWORD B_TRUE___UW 0 0 0.000000 0.000000 /begin IF_DATA ASAP1B_ETK KP_BLOB 0x383B06 1 2 /end IF_DATA BIT_MASK 0x1 /end MEASUREMENT
/begin MEASUREMENT E_clws "Errorflag: CAN-Schnittstelle, Timeout Botschaft Lenkwinkelsensor" UWORD B_TRUE___UW 0 0 0.000000 0.000000 /begin IF_DATA ASAP1B_ETK KP_BLOB 0x383B08 1 2 /end IF_DATA BIT_MASK 0x1 /end MEASUREMENT
/begin MEASUREMENT E_dk "Errorflag: DK - Potentiometer" UWORD B_TRUE___UW 0 0 0.000000 0.000000 /begin IF_DATA ASAP1B_ETK KP_BLOB 0x383B0A 1 2 /end IF_DATA BIT_MASK 0x1 /end MEASUREMENT
/begin MEASUREMENT E_dk1p "Errorflag: Drosselklappe 1. Poti" UWORD B_TRUE___UW 0 0 0.000000 0.000000 /begin IF_DATA ASAP1B_ETK KP_BLOB 0x383B0C 1 2 /end IF_DATA BIT_MASK 0x1 /end MEASUREMENT
/begin MEASUREMENT E_dk2p "Errorflag: Drosselklappe 2. Poti" UWORD B_TRUE___UW 0 0 0.000000 0.000000 /begin IF_DATA ASAP1B_ETK KP_BLOB 0x383B0E 1 2 /end IF_DATA BIT_MASK 0x1 /end MEASUREMENT
/begin MEASUREMENT E_dvee "Errorflag: DV-E Endstufe" UWORD B_TRUE___UW 0 0 0.000000 0.000000 /begin IF_DATA ASAP1B_ETK KP_BLOB 0x383B1A 1 2 /end IF_DATA BIT_MASK 0x1 /end MEASUREMENT
/begin MEASUREMENT E_dvef "Errorflag: DV-E Fehler bei FederprÅfung" UWORD B_TRUE___UW 0 0 0.000000 0.000000 /begin IF_DATA ASAP1B_ETK KP_BLOB 0x383B1C 1 2 /end IF_DATA BIT_MASK 0x1 /end MEASUREMENT
/begin MEASUREMENT E_dvefo "Errorflag: DV-E-Fehler bei FederprÅfung 'ôffnen'" UWORD B_TRUE___UW 0 0 0.000000 0.000000 /begin IF_DATA ASAP1B_ETK KP_BLOB 0x383B1E 1 2 /end IF_DATA BIT_MASK 0x1 /end MEASUREMENT
/begin MEASUREMENT E_dvel "Errorflag: DV-E Lageabweichung" UWORD B_TRUE___UW 0 0 0.000000 0.000000 /begin IF_DATA ASAP1B_ETK KP_BLOB 0x383B20 1 2 /end IF_DATA BIT_MASK 0x1 /end MEASUREMENT
/begin MEASUREMENT E_dven "Errorflag: DV-E Fehler bei PrÅfung Notluftposition" UWORD B_TRUE___UW 0 0 0.000000 0.000000 /begin IF_DATA ASAP1B_ETK KP_BLOB 0x383B22 1 2 /end IF_DATA BIT_MASK 0x1 /end MEASUREMENT
/begin MEASUREMENT E_dver "Errorflag: DV-E Regelbereich" UWORD B_TRUE___UW 0 0 0.000000 0.000000 /begin IF_DATA ASAP1B_ETK KP_BLOB 0x383B24 1 2 /end IF_DATA BIT_MASK 0x1 /end MEASUREMENT
/begin MEASUREMENT E_dvet "Errorflag: DV-E-Tauscherkennung ohne Adaption" UWORD B_TRUE___UW 0 0 0.000000 0.000000 /begin IF_DATA ASAP1B_ETK KP_BLOB 0x383B26 1 2 /end IF_DATA BIT_MASK 0x1 /end MEASUREMENT
/begin MEASUREMENT E_dveu "Errorflag: DV-E Fehler beim UMA-Lernen" UWORD B_TRUE___UW 0 0 0.000000 0.000000 /begin IF_DATA ASAP1B_ETK KP_BLOB 0x383B28 1 2 /end IF_DATA BIT_MASK 0x1 /end MEASUREMENT
/begin MEASUREMENT E_dveub "Errorflag: DV-E-Adaption Abbruch wg. Umweltbedingung" UWORD B_TRUE___UW 0 0 0.000000 0.000000 /begin IF_DATA ASAP1B_ETK KP_BLOB 0x383B2A 1 2 /end IF_DATA BIT_MASK 0x1 /end MEASUREMENT
/begin MEASUREMENT E_dveuw "Errorflag: Fehler bei UMA-Wiederlernen" UWORD B_TRUE___UW 0 0 0.000000 0.000000 /begin IF_DATA ASAP1B_ETK KP_BLOB 0x383B2C 1 2 /end IF_DATA BIT_MASK 0x1 /end MEASUREMENT
/begin MEASUREMENT E_dvev "Errorflag: DV-E Fehler bei VerstÑrkerabgleich" UWORD B_TRUE___UW 0 0 0.000000 0.000000 /begin IF_DATA ASAP1B_ETK KP_BLOB 0x383B2E 1 2 /end IF_DATA BIT_MASK 0x1 /end MEASUREMENT
/begin MEASUREMENT E_n "Errorflag: Drehzahlsignalgeber" UWORD B_TRUE___UW 0 0 0.000000 0.000000 /begin IF_DATA ASAP1B_ETK KP_BLOB 0x383BBA 1 2 /end IF_DATA BIT_MASK 0x1 /end MEASUREMENT
/begin MEASUREMENT E_swe_b "Status Schlechtwegeausbelendung (CAN) ungÅltig" UWORD B_TRUE___UW 0 0 0.000000 0.000000 /begin IF_DATA ASAP1B_ETK KP_BLOB 0xFD14 0 2 /end IF_DATA BIT_MASK 0x2000 /end MEASUREMENT
/begin MEASUREMENT fafte_w "Faktor Ausflu· TankentlÅftungsventil" UWORD fak_uw_b2 0 0 0.000000 1.999969 /begin IF_DATA ASAP1B_ETK KP_BLOB 0x3827C6 1 2 /end IF_DATA BIT_MASK 0xFFFF /end MEASUREMENT
/begin MEASUREMENT fcmEnd "Anzahl EintrÑge im Fehlerspeicher" UBYTE dez 0 0 0.000000 255.000000 /begin IF_DATA ASAP1B_ETK KP_BLOB 0x383307 1 1 /end IF_DATA BIT_MASK 0xFF /end MEASUREMENT
/begin MEASUREMENT FCMTab "" UWORD dez___UW 0 0 0.000000 65535.000000 /begin IF_DATA ASAP1B_ETK KP_BLOB 0x383846 1 2 /end IF_DATA BIT_MASK 0xFFFF /end MEASUREMENT
/begin MEASUREMENT fgnsol "Faktor zur Beeinflussung der Getriebesolldrehzahl" UBYTE rel_ub_b99p6 0 0 0.000000 99.609375 /begin IF_DATA ASAP1B_ETK KP_BLOB 0x380C15 1 1 /end IF_DATA BIT_MASK 0xFF /end MEASUREMENT
/begin MEASUREMENT flglrs "CARB FREEZE FRAME Byte, Bank 1, fÅr LR" UBYTE dez 0 0 0.000000 255.000000 /begin IF_DATA ASAP1B_ETK KP_BLOB 0x380CDD 1 1 /end IF_DATA BIT_MASK 0xFF /end MEASUREMENT
/begin MEASUREMENT fprstep_c "SchrittzÑhler DK-RÅckstellfeder-PrÅfung" UBYTE dez 0 0 0.000000 255.000000 /begin IF_DATA ASAP1B_ETK KP_BLOB 0x380AD3 1 1 /end IF_DATA BIT_MASK 0xFF /end MEASUREMENT
/begin MEASUREMENT fr2_u "Lambda-Regler-Ausgang; Bank2 (Byte)" UBYTE fak_ub_b2 0 0 0.000000 1.992188 /begin IF_DATA ASAP1B_ETK KP_BLOB 0x380A40 1 1 /end IF_DATA BIT_MASK 0xFF /end MEASUREMENT
/begin MEASUREMENT fr2_w "Lambda-Regler-Ausgang; Bank2 (Word)" UWORD fak_uw_b2 0 0 0.000000 1.999969 /begin IF_DATA ASAP1B_ETK KP_BLOB 0x38288A 1 2 /end IF_DATA BIT_MASK 0xFFFF /end MEASUREMENT
/begin MEASUREMENT fra2_u "multiplikative Gemischkorrektur der Gemischadaption (Byte)" UBYTE fak_ub_b2 0 0 0.000000 1.992188 /begin IF_DATA ASAP1B_ETK KP_BLOB 0x380A41 1 1 /end IF_DATA BIT_MASK 0xFF /end MEASUREMENT
/begin MEASUREMENT fra_u "multiplikative Gemischkorrektur der Gemischadaption (Byte)" UBYTE fak_ub_b2 0 0 0.000000 1.992188 /begin IF_DATA ASAP1B_ETK KP_BLOB 0x380A42 1 1 /end IF_DATA BIT_MASK 0xFF /end MEASUREMENT
/begin MEASUREMENT fra_w "multiplikative Gemischkorrektur der Gemischadaption (Word)" UWORD fak_uw_b2 0 0 0.000000 1.999969 /begin IF_DATA ASAP1B_ETK KP_BLOB 0x381FF4 1 2 /end IF_DATA BIT_MASK 0xFFFF /end MEASUREMENT
/begin MEASUREMENT frhodk_w "Faktor Luftdichtekorrektur fÅr DK-Durchflu· f(Ansauglufttemp.,Hîhe) 16 Bit" UWORD fak_uw_b2 0 0 0.000000 1.999969 /begin IF_DATA ASAP1B_ETK KP_BLOB 0x381E60 1 2 /end IF_DATA BIT_MASK 0xFFFF /end MEASUREMENT
/begin MEASUREMENT fr_u "Lambda-Regler-Ausgang (Byte)" UBYTE fak_ub_b2 0 0 0.000000 1.992188 /begin IF_DATA ASAP1B_ETK KP_BLOB 0x380A43 1 1 /end IF_DATA BIT_MASK 0xFF /end MEASUREMENT
/begin MEASUREMENT fr_w "Lambda-Regler-Ausgang (Word)" UWORD fak_uw_b2 0 0 0.000000 1.999969 /begin IF_DATA ASAP1B_ETK KP_BLOB 0x3828A8 1 2 /end IF_DATA BIT_MASK 0xFFFF /end MEASUREMENT
/begin MEASUREMENT ftbr "Faktor Temperaturkorrektur im Brennraum" UBYTE fak_ub_b2 0 0 0.000000 1.992188 /begin IF_DATA ASAP1B_ETK KP_BLOB 0x380AF1 1 1 /end IF_DATA BIT_MASK 0xFF /end MEASUREMENT
/begin MEASUREMENT ftbr_w "Faktor Temperaturkorrektur im Brennraum" UWORD fak_uw_b2 0 0 0.000000 1.999969 /begin IF_DATA ASAP1B_ETK KP_BLOB 0x381EEA 1 2 /end IF_DATA BIT_MASK 0xFFFF /end MEASUREMENT
/begin MEASUREMENT ftho_w "Faktor Korrektur Hîhe und Temperatur" UWORD fak_uw_b2 0 0 0.000000 1.999969 /begin IF_DATA ASAP1B_ETK KP_BLOB 0x3827C0 1 2 /end IF_DATA BIT_MASK 0xFFFF /end MEASUREMENT
/begin MEASUREMENT ftsr "Korrekturfaktor Lufttemperatur im Saugrohr" UBYTE fak_ub_b2 0 0 0.000000 1.992188 /begin IF_DATA ASAP1B_ETK KP_BLOB 0xF9AE 0 1 /end IF_DATA BIT_MASK 0xFF /end MEASUREMENT
/begin MEASUREMENT ftu "Faktor Temperatur Umgebung" UBYTE fak_ub_b2 0 0 0.000000 1.992188 /begin IF_DATA ASAP1B_ETK KP_BLOB 0x380AF2 1 1 /end IF_DATA BIT_MASK 0xFF /end MEASUREMENT
/begin MEASUREMENT ftvdk "Korrekturfaktor Temperatur vor Drosselklappe" UBYTE fak_ub_b2 0 0 0.000000 1.992188 /begin IF_DATA ASAP1B_ETK KP_BLOB 0xF9AF 0 1 /end IF_DATA BIT_MASK 0xFF /end MEASUREMENT
/begin MEASUREMENT ftw "Faktor Temperaturgewichtung tmot, tans" UBYTE fak_ub_b1 0 0 0.000000 0.996094 /begin IF_DATA ASAP1B_ETK KP_BLOB 0x380AF3 1 1 /end IF_DATA BIT_MASK 0xFF /end MEASUREMENT
/begin MEASUREMENT fupsrl_w "Faktor systembezogene Umrechnung Druck auf FÅllung (16-Bit)" UWORD rel_uw_b0p3 0 0 0.000000 0.299995 /begin IF_DATA ASAP1B_ETK KP_BLOB 0x381E34 1 2 /end IF_DATA BIT_MASK 0xFFFF /end MEASUREMENT
/begin MEASUREMENT fvisrm_w "Faktor VerstÑrkung Integrator Saugrohrmodell" UWORD p_uw_b32 0 0 0.000000 31.999512 /begin IF_DATA ASAP1B_ETK KP_BLOB 0x381E36 1 2 /end IF_DATA BIT_MASK 0xFFFF /end MEASUREMENT
/begin MEASUREMENT fwprs_w "Faktor Preadiktionswinkel bezogen auf Segment" UWORD fak_uw_b32 0 0 0.000000 31.999512 /begin IF_DATA ASAP1B_ETK KP_BLOB 0x381FC2 1 2 /end IF_DATA BIT_MASK 0xFFFF /end MEASUREMENT
/begin MEASUREMENT gangauti "bei Automatikgetriebe Åber CAN empfangener aktueller Gang" UBYTE DEZ 0 0 0.000000 255.000000 /begin IF_DATA ASAP1B_ETK KP_BLOB 0x3809C2 1 1 /end IF_DATA BIT_MASK 0xFF /end MEASUREMENT
/begin MEASUREMENT imlatm "integr. Luftmassenfluss ab Motorstart bis Max.wert" UBYTE m_ub_b23p3 0 0 0.000000 23.210667 /begin IF_DATA ASAP1B_ETK KP_BLOB 0x380A67 1 1 /end IF_DATA BIT_MASK 0xFF /end MEASUREMENT
/begin MEASUREMENT irspsyn "Index fÅr Ringspeicheradressierung tsegrsp_w, nmotrsp_w, rlrsp_w" UBYTE dez 0 0 0.000000 255.000000 /begin IF_DATA ASAP1B_ETK KP_BLOB 0x380A52 1 1 /end IF_DATA BIT_MASK 0xFF /end MEASUREMENT
/begin MEASUREMENT km01tr "Triggersignal vom Kombi (Quantisierung 1km)" UWORD s_q1_km 0 0 0.000000 65535.000000 /begin IF_DATA ASAP1B_ETK KP_BLOB 0x380FEC 1 2 /end IF_DATA BIT_MASK 0xFFFF /end MEASUREMENT
/begin MEASUREMENT kmstand_w "" UWORD s_q6_km 0 0 0.000000 393210.000000 /begin IF_DATA ASAP1B_ETK KP_BLOB 0x380FEE 1 2 /end IF_DATA BIT_MASK 0xFFFF /end MEASUREMENT
/begin MEASUREMENT kvakbi_w "aufsummierter Kraftstoffverbrauch fÅr Kombiausgabe" UWORD dez___UW 0 0 0.000000 65535.000000 /begin IF_DATA ASAP1B_ETK KP_BLOB 0x38290A 1 2 /end IF_DATA BIT_MASK 0xFFFF /end MEASUREMENT
/begin MEASUREMENT lrnstep_c "ZÑhler fÅr Lerndauer eines Lernsteps" UBYTE dez 0 0 0.000000 255.000000 /begin IF_DATA ASAP1B_ETK KP_BLOB 0x380AD5 1 1 /end IF_DATA BIT_MASK 0xFF /end MEASUREMENT
/begin MEASUREMENT lws_w "Lenkwinkel" SWORD lw_sw_q0p04375 0 0 -1434.043764 1434.000000 /begin IF_DATA ASAP1B_ETK KP_BLOB 0x380FF0 1 2 /end IF_DATA BIT_MASK 0xFFFF /end MEASUREMENT
/begin MEASUREMENT mdgbeg "Momentengradientenbegrenzung durch Getriebe" UBYTE md_ub_q10 0 0 0.000000 2550.000000 /begin IF_DATA ASAP1B_ETK KP_BLOB 0x3809C3 1 1 /end IF_DATA BIT_MASK 0xFF /end MEASUREMENT
/begin MEASUREMENT mdgrad_w "Momentengradientenbegrenzung durch Getriebe" UWORD rel_uw_b728 0 0 0.000000 9999.847412 /begin IF_DATA ASAP1B_ETK KP_BLOB 0x380FF2 1 2 /end IF_DATA BIT_MASK 0xFFFF /end MEASUREMENT
/begin MEASUREMENT mdverl_w "Motor-Verlustmoment" UWORD rel_uw_b100 0 0 0.000000 99.998474 /begin IF_DATA ASAP1B_ETK KP_BLOB 0x3823BC 1 2 /end IF_DATA BIT_MASK 0xFFFF /end MEASUREMENT
/begin MEASUREMENT mdwancan "Drehmomentaufnahme des Wandlers Åber CAN" UBYTE rel_ub_b99p6 0 0 0.000000 99.609375 /begin IF_DATA ASAP1B_ETK KP_BLOB 0x3809C4 1 1 /end IF_DATA BIT_MASK 0xFF /end MEASUREMENT
/begin MEASUREMENT miasrllk "indiziertes Soll-Motormoment fÅr langsamen ASR-Eingriff" UBYTE rel_ub_b99p6 0 0 0.000000 99.609375 /begin IF_DATA ASAP1B_ETK KP_BLOB 0x3809C5 1 1 /end IF_DATA BIT_MASK 0xFF /end MEASUREMENT
/begin MEASUREMENT miasrl_can "Anforderung 'langsamer ASR-Eingriff' Åber CAN" UBYTE rel_ub_b99p6 0 0 0.000000 99.609375 /begin IF_DATA ASAP1B_ETK KP_BLOB 0x3809C6 1 1 /end IF_DATA BIT_MASK 0xFF /end MEASUREMENT
/begin MEASUREMENT miasrl_w "Indiziertes Soll-Motormoment ASR fÅr langsamen Eingriff" UWORD rel_uw_b100 0 0 0.000000 99.998474 /begin IF_DATA ASAP1B_ETK KP_BLOB 0x380FF4 1 2 /end IF_DATA BIT_MASK 0xFFFF /end MEASUREMENT
/begin MEASUREMENT miasrslk "indiziertes Soll-Motormoment fÅr schnellen ASR-Eingriff" UBYTE rel_ub_b99p6 0 0 0.000000 99.609375 /begin IF_DATA ASAP1B_ETK KP_BLOB 0x3809C7 1 1 /end IF_DATA BIT_MASK 0xFF /end MEASUREMENT
/begin MEASUREMENT miasrs_can "Anforderung 'schneller ASR-Eingriff' Åber CAN" UBYTE rel_ub_b99p6 0 0 0.000000 99.609375 /begin IF_DATA ASAP1B_ETK KP_BLOB 0x3809C8 1 1 /end IF_DATA BIT_MASK 0xFF /end MEASUREMENT
/begin MEASUREMENT miasrs_w "Indiziertes Soll-Motormoment ASR fÅr schnellen Eingriff" UWORD rel_uw_b100 0 0 0.000000 99.998474 /begin IF_DATA ASAP1B_ETK KP_BLOB 0x380FF6 1 2 /end IF_DATA BIT_MASK 0xFFFF /end MEASUREMENT
/begin MEASUREMENT miautget_w "Motormoment ohne Getriebeeingriff" UWORD rel_uw_b100 0 0 0.000000 99.998474 /begin IF_DATA ASAP1B_ETK KP_BLOB 0x3824F4 1 2 /end IF_DATA BIT_MASK 0xFFFF /end MEASUREMENT
/begin MEASUREMENT miautgs_w "Motorsollmoment ohne Getriebeeingriff" UWORD rel_uw_b100 0 0 0.000000 99.998474 /begin IF_DATA ASAP1B_ETK KP_BLOB 0x3824F6 1 2 /end IF_DATA BIT_MASK 0xFFFF /end MEASUREMENT
/begin MEASUREMENT mibas_w "indiziertes Basis-Moment" UWORD rel_uw_b100 0 0 0.000000 99.998474 /begin IF_DATA ASAP1B_ETK KP_BLOB 0x382494 1 2 /end IF_DATA BIT_MASK 0xFFFF /end MEASUREMENT
/begin MEASUREMENT mifab_w "begrenztes indiziertes Motormoment Fahrerwunsch" UWORD rel_uw_b100 0 0 0.000000 99.998474 /begin IF_DATA ASAP1B_ETK KP_BLOB 0x382480 1 2 /end IF_DATA BIT_MASK 0xFFFF /end MEASUREMENT
/begin MEASUREMENT mifar_w "indiziertes Fahrerwunschmoment vor énderungsbegrenzung plus I-Anteil des LL-Regr" UWORD rel_uw_b100 0 0 0.000000 99.998474 /begin IF_DATA ASAP1B_ETK KP_BLOB 0x380FF8 1 2 /end IF_DATA BIT_MASK 0xFFFF /end MEASUREMENT
/begin MEASUREMENT miges_w "Indiziertes Soll-Motormoment fÅr Getriebeschutz" UWORD rel_uw_b100 0 0 0.000000 99.998474 /begin IF_DATA ASAP1B_ETK KP_BLOB 0x380FFA 1 2 /end IF_DATA BIT_MASK 0xFFFF /end MEASUREMENT
/begin MEASUREMENT migs_w "Indiziertes Soll-Motormoment GS fÅr schnellen Eingriff" UWORD rel_uw_b100 0 0 0.000000 99.998474 /begin IF_DATA ASAP1B_ETK KP_BLOB 0x380FFC 1 2 /end IF_DATA BIT_MASK 0xFFFF /end MEASUREMENT
/begin MEASUREMENT miist_w "indiziertes Motormoment Hochdruckphase Istwert" UWORD rel_uw_b100 0 0 0.000000 99.998474 /begin IF_DATA ASAP1B_ETK KP_BLOB 0x3824A6 1 2 /end IF_DATA BIT_MASK 0xFFFF /end MEASUREMENT
/begin MEASUREMENT mimax_w "maximal erreichbares indiziertes Moment" UWORD rel_uw_b100 0 0 0.000000 99.998474 /begin IF_DATA ASAP1B_ETK KP_BLOB 0x382472 1 2 /end IF_DATA BIT_MASK 0xFFFF /end MEASUREMENT
/begin MEASUREMENT mimin_w "Minimales Motor-Moment" UWORD rel_uw_b100 0 0 0.000000 99.998474 /begin IF_DATA ASAP1B_ETK KP_BLOB 0x3823AA 1 2 /end IF_DATA BIT_MASK 0xFFFF /end MEASUREMENT
/begin MEASUREMENT mimsrlk "MSR-Eingriffsmoment" UBYTE rel_ub_b99p6 0 0 0.000000 99.609375 /begin IF_DATA ASAP1B_ETK KP_BLOB 0x3809C9 1 1 /end IF_DATA BIT_MASK 0xFF /end MEASUREMENT
/begin MEASUREMENT mimsr_can "MSR-Wunsch Åber CAN" UBYTE rel_ub_b99p6 0 0 0.000000 99.609375 /begin IF_DATA ASAP1B_ETK KP_BLOB 0x3809CA 1 1 /end IF_DATA BIT_MASK 0xFF /end MEASUREMENT
/begin MEASUREMENT mimsr_w "Indiziertes Soll-Motormoment MSR" UWORD rel_uw_b100 0 0 0.000000 99.998474 /begin IF_DATA ASAP1B_ETK KP_BLOB 0x380FFE 1 2 /end IF_DATA BIT_MASK 0xFFFF /end MEASUREMENT
/begin MEASUREMENT misol_w "Indiziertes resultierendes Sollmoment" UWORD rel_uw_b100 0 0 0.000000 99.998474 /begin IF_DATA ASAP1B_ETK KP_BLOB 0xF9D0 0 2 /end IF_DATA BIT_MASK 0xFFFF /end MEASUREMENT
/begin MEASUREMENT mivbeg_w "inidziertes Fahrerwunschmoment vor énderungsbegrenzung" UWORD rel_uw_b100 0 0 0.000000 99.998474 /begin IF_DATA ASAP1B_ETK KP_BLOB 0x382444 1 2 /end IF_DATA BIT_MASK 0xFFFF /end MEASUREMENT
/begin MEASUREMENT mizwmn_w "indiziertes Motormoment beim spÑtesten ZÅndwinkel" UWORD rel_uw_b100 0 0 0.000000 99.998474 /begin IF_DATA ASAP1B_ETK KP_BLOB 0x3824D2 1 2 /end IF_DATA BIT_MASK 0xFFFF /end MEASUREMENT
/begin MEASUREMENT mi_duf "Istmoment beim Ansprechen des Momentenvergleichs in der FunktionsÅberwachung" UBYTE rel_ub_b99p6 0 0 0.000000 99.609375 /begin IF_DATA ASAP1B_ETK KP_BLOB 0x380C94 1 1 /end IF_DATA BIT_MASK 0xFF /end MEASUREMENT
/begin MEASUREMENT mi_um "Berechnetes Ist-Moment in der FunktionsÅberwachung" UBYTE rel_ub_b99p6 0 0 0.000000 99.609375 /begin IF_DATA ASAP1B_ETK KP_BLOB 0x380929 1 1 /end IF_DATA BIT_MASK 0xFF /end MEASUREMENT
/begin MEASUREMENT mpfad "Momenten-Pfad in Funktion und FunktionsÅberwachung als Umweltbedingung fÅr Diag." UBYTE dez 0 0 0.000000 255.000000 /begin IF_DATA ASAP1B_ETK KP_BLOB 0x380C95 1 1 /end IF_DATA BIT_MASK 0xFF /end MEASUREMENT
/begin MEASUREMENT mracc_w "Relativer Momentenwunsch von ACC" UWORD rel_uw_b200 0 0 0.000000 199.996948 /begin IF_DATA ASAP1B_ETK KP_BLOB 0x381000 1 2 /end IF_DATA BIT_MASK 0xFFFF /end MEASUREMENT
/begin MEASUREMENT mrped_w "relatives Fahrerwunschmoment aus Fahrpedal" UWORD rel_uw_b200 0 0 0.000000 199.996948 /begin IF_DATA ASAP1B_ETK KP_BLOB 0x38244E 1 2 /end IF_DATA BIT_MASK 0xFFFF /end MEASUREMENT
/begin MEASUREMENT msndko_w "normierter Leckluftmassenstrom Åber Drosselklappe (word)" UWORD m_uw_b6553p5 0 0 0.000000 6553.500000 /begin IF_DATA ASAP1B_ETK KP_BLOB 0x383C5C 1 2 /end IF_DATA BIT_MASK 0xFFFF /end MEASUREMENT
/begin MEASUREMENT msndkpk_w "normierter praedizierter korrig. Massenstrom ueber Drosselklappe (word)" UWORD m_uw_b6553p5 0 0 0.000000 6553.500000 /begin IF_DATA ASAP1B_ETK KP_BLOB 0x381FC4 1 2 /end IF_DATA BIT_MASK 0xFFFF /end MEASUREMENT
/begin MEASUREMENT msntetev_w "normierter, Åberkritischer Massenstrom durch das TEV" UWORD m_uw_b25p6 0 0 0.000000 25.599609 /begin IF_DATA ASAP1B_ETK KP_BLOB 0x3827CA 1 2 /end IF_DATA BIT_MASK 0xFFFF /end MEASUREMENT
/begin MEASUREMENT msntevo_w "normierter, Åberkritischer Massenstrom durch das 100% offene TEV" UWORD m_uw_b25p6 0 0 0.000000 25.599609 /begin IF_DATA ASAP1B_ETK KP_BLOB 0x3827C2 1 2 /end IF_DATA BIT_MASK 0xFFFF /end MEASUREMENT
/begin MEASUREMENT msnwdk_kge "" UWORD rel_uw_b100 0 0 0.000000 99.998474 /begin IF_DATA ASAP1B_ETK KP_BLOB 0x381E70 1 2 /end IF_DATA BIT_MASK 0xFFFF /end MEASUREMENT
/begin MEASUREMENT msrmdt_w "Inhalt des MSR-PlausibilitÑtstopfes" SWORD mdt_sw_b2556 0 0 -2556.000000 2555.921997 /begin IF_DATA ASAP1B_ETK KP_BLOB 0x381002 1 2 /end IF_DATA BIT_MASK 0xFFFF /end MEASUREMENT
/begin MEASUREMENT mste "Massenstrom TankentlÅftung ins Saugrohr" UBYTE m_ub_b25p6 0 0 0.000000 25.500000 /begin IF_DATA ASAP1B_ETK KP_BLOB 0xF9EE 0 1 /end IF_DATA BIT_MASK 0xFF /end MEASUREMENT
/begin MEASUREMENT mstedte_w "Massenstrom TEV fÅr TEB (Word)" UWORD m_uw_b25p6 0 0 0.000000 25.599609 /begin IF_DATA ASAP1B_ETK KP_BLOB 0x3827CC 1 2 /end IF_DATA BIT_MASK 0xFFFF /end MEASUREMENT
/begin MEASUREMENT mstehl_w "Massenstrom TankentlÅftung ins Saugrohr (Anteil der Einleitung vor Lader)" UWORD m_uw_b25p6 0 0 0.000000 25.599609 /begin IF_DATA ASAP1B_ETK KP_BLOB 0x3827CE 1 2 /end IF_DATA BIT_MASK 0xFFFF /end MEASUREMENT
/begin MEASUREMENT msteo_w "Massenstom durch das 100% offene TEV" UWORD m_uw_b25p6 0 0 0.000000 25.599609 /begin IF_DATA ASAP1B_ETK KP_BLOB 0x3827D0 1 2 /end IF_DATA BIT_MASK 0xFFFF /end MEASUREMENT
/begin MEASUREMENT mstesg_w "Massenstrom TankentlÅftung ins Saugrohr (Anteil Einleitung auf Unterdruckseite)" UWORD m_uw_b25p6 0 0 0.000000 25.599609 /begin IF_DATA ASAP1B_ETK KP_BLOB 0x3827D2 1 2 /end IF_DATA BIT_MASK 0xFFFF /end MEASUREMENT
/begin MEASUREMENT mstetev_w "Massenstrom durch das TEV" UWORD m_uw_b25p6 0 0 0.000000 25.599609 /begin IF_DATA ASAP1B_ETK KP_BLOB 0x3827D4 1 2 /end IF_DATA BIT_MASK 0xFFFF /end MEASUREMENT
/begin MEASUREMENT mstevl_w "Anteil Massenstrom durch das TEV der Einleitung vor Lader" UWORD m_uw_b25p6 0 0 0.000000 25.599609 /begin IF_DATA ASAP1B_ETK KP_BLOB 0x3827D6 1 2 /end IF_DATA BIT_MASK 0xFFFF /end MEASUREMENT
/begin MEASUREMENT mste_w "Massenstrom TankentlÅftung in das Saugrohr" UWORD m_uw_b25p6 0 0 0.000000 25.599609 /begin IF_DATA ASAP1B_ETK KP_BLOB 0x3827D8 1 2 /end IF_DATA BIT_MASK 0xFFFF /end MEASUREMENT
/begin MEASUREMENT nllcvt1 " Drehzahlvorgabe aus CVT-Getriebe" UBYTE nmot_ub_q10 0 0 0.000000 2550.000000 /begin IF_DATA ASAP1B_ETK KP_BLOB 0x3809CB 1 1 /end IF_DATA BIT_MASK 0xFF /end MEASUREMENT
/begin MEASUREMENT nstat "Solldrehzahl stationÑr" UBYTE nmot_ub_q10 0 0 0.000000 2550.000000 /begin IF_DATA ASAP1B_ETK KP_BLOB 0x380C20 1 1 /end IF_DATA BIT_MASK 0xFF /end MEASUREMENT
/begin MEASUREMENT pirgro_w "Rohwert Partialdruck Restgas internes AGR" UWORD p_uw_q0p039 0 0 0.000000 2559.960938 /begin IF_DATA ASAP1B_ETK KP_BLOB 0x381E38 1 2 /end IF_DATA BIT_MASK 0xFFFF /end MEASUREMENT
/begin MEASUREMENT pirg_w "Partialdruck Restgas interne AGR (16-Bit)" UWORD p_uw_q0p039 0 0 0.000000 2559.960938 /begin IF_DATA ASAP1B_ETK KP_BLOB 0x381E3A 1 2 /end IF_DATA BIT_MASK 0xFFFF /end MEASUREMENT
/begin MEASUREMENT psagr_w "Partialdruck durch externes Restgas (Restluft+Inertgas)" UWORD p_uw_q0p039 0 0 0.000000 2559.960938 /begin IF_DATA ASAP1B_ETK KP_BLOB 0x381EFA 1 2 /end IF_DATA BIT_MASK 0xFFFF /end MEASUREMENT
/begin MEASUREMENT psfg_w "Frischgaspartialdruck im Saugrohr (word)" UWORD p_uw_q0p039 0 0 0.000000 2559.960938 /begin IF_DATA ASAP1B_ETK KP_BLOB 0x381E44 1 2 /end IF_DATA BIT_MASK 0xFFFF /end MEASUREMENT
/begin MEASUREMENT psmppvdk_w "praed. ps/Druck vor Drosselklappe (word)" UWORD fak_uw_q0p001 0 0 0.000000 65.535000 /begin IF_DATA ASAP1B_ETK KP_BLOB 0x381FC6 1 2 /end IF_DATA BIT_MASK 0xFFFF /end MEASUREMENT
/begin MEASUREMENT psmp_w "extrapolierter Saugrohrdruck (Word)" UWORD p_uw_q0p039 0 0 0.000000 2559.960938 /begin IF_DATA ASAP1B_ETK KP_BLOB 0x381FC8 1 2 /end IF_DATA BIT_MASK 0xFFFF /end MEASUREMENT
/begin MEASUREMENT psmx_w "Saugrohrmaximaldruckbegrenzung fÅr modellierten Saugrohrdruck" UWORD p_uw_q0p039 0 0 0.000000 2559.960938 /begin IF_DATA ASAP1B_ETK KP_BLOB 0x381E46 1 2 /end IF_DATA BIT_MASK 0xFFFF /end MEASUREMENT
/begin MEASUREMENT pspmx_w "max. praedizierter Saugrohrdruck" UWORD p_uw_q0p039 0 0 0.000000 2559.960938 /begin IF_DATA ASAP1B_ETK KP_BLOB 0x381FCA 1 2 /end IF_DATA BIT_MASK 0xFFFF /end MEASUREMENT
/begin MEASUREMENT psp_w "praedizierter Saugrohrdruck (Word)" UWORD p_uw_q0p039 0 0 0.000000 2559.960938 /begin IF_DATA ASAP1B_ETK KP_BLOB 0x381FCC 1 2 /end IF_DATA BIT_MASK 0xFFFF /end MEASUREMENT
/begin MEASUREMENT psrlro_w "Rohwert fÅr Faktor systembezogene Umrechnung Druck auf FÅllung" UWORD rel_uw_b0p3 0 0 0.000000 0.299995 /begin IF_DATA ASAP1B_ETK KP_BLOB 0x381E3C 1 2 /end IF_DATA BIT_MASK 0xFFFF /end MEASUREMENT
/begin MEASUREMENT ps_w "Saugrohr-Absolutdruck (Word)" UWORD p_uw_q0p039 0 0 0.000000 2559.960938 /begin IF_DATA ASAP1B_ETK KP_BLOB 0xF99A 0 2 /end IF_DATA BIT_MASK 0xFFFF /end MEASUREMENT
/begin MEASUREMENT pu_w "Umgebungsdruck 16-Bit" UWORD p_uw_q0p039 0 0 0.000000 2559.960938 /begin IF_DATA ASAP1B_ETK KP_BLOB 0x381EA2 1 2 /end IF_DATA BIT_MASK 0xFFFF /end MEASUREMENT
/begin MEASUREMENT pvdkds_w "Druck vor Drosselklappe von Drucksensor (word)" UWORD p_uw_q0p039 0 0 0.000000 2559.960938 /begin IF_DATA ASAP1B_ETK KP_BLOB 0x381EB0 1 2 /end IF_DATA BIT_MASK 0xFFFF /end MEASUREMENT
/begin MEASUREMENT pvdk_w "Druck vor Drosselklappe 16-Bit" UWORD p_uw_q0p039 0 0 0.000000 2559.960938 /begin IF_DATA ASAP1B_ETK KP_BLOB 0x381E7C 1 2 /end IF_DATA BIT_MASK 0xFFFF /end MEASUREMENT
/begin MEASUREMENT pvl_w "Druck vor Lader" UWORD p_uw_q0p039 0 0 0.000000 2559.960938 /begin IF_DATA ASAP1B_ETK KP_BLOB 0x3827DC 1 2 /end IF_DATA BIT_MASK 0xFFFF /end MEASUREMENT
/begin MEASUREMENT rfagr_w "relative FÅllung AGR (word)" UWORD rel_uw_q0p0234 0 0 0.000000 1535.976562 /begin IF_DATA ASAP1B_ETK KP_BLOB 0x381E48 1 2 /end IF_DATA BIT_MASK 0xFFFF /end MEASUREMENT
/begin MEASUREMENT rfges_w "gesamte relative FÅllung (inclusive AGR) 16-Bit" UWORD rel_uw_q0p0234 0 0 0.000000 1535.976562 /begin IF_DATA ASAP1B_ETK KP_BLOB 0x381E3E 1 2 /end IF_DATA BIT_MASK 0xFFFF /end MEASUREMENT
/begin MEASUREMENT rinh2_u "Istwert (Byte) Innenwiderstand Ri-Nernstzelle der Lambdasonde hinter KAT Bank2" UBYTE r_ub_q64 0 0 0.000000 16320.000000 /begin IF_DATA ASAP1B_ETK KP_BLOB 0x380A44 1 1 /end IF_DATA BIT_MASK 0xFF /end MEASUREMENT
/begin MEASUREMENT rinh_u "Istwert (Byte) Innenwiderstand Ri-Nernstzelle der Lambdasonde hinter KAT" UBYTE r_ub_q64 0 0 0.000000 16320.000000 /begin IF_DATA ASAP1B_ETK KP_BLOB 0x380A45 1 1 /end IF_DATA BIT_MASK 0xFF /end MEASUREMENT
/begin MEASUREMENT rinh_w "Istwert (word) Innenwiderstand Ri-Nernstzelle der Lambdasonde hinter KAT" UWORD r_uw_q2 0 0 0.000000 131070.000000 /begin IF_DATA ASAP1B_ETK KP_BLOB 0x381B42 1 2 /end IF_DATA BIT_MASK 0xFFFF /end MEASUREMENT
/begin MEASUREMENT rinv2_u "Istwert (Byte) Innenwiderstand Ri-Nernstzelle der Lambdasonde vor KAT Bank2" UBYTE r_ub_q64 0 0 0.000000 16320.000000 /begin IF_DATA ASAP1B_ETK KP_BLOB 0x380A46 1 1 /end IF_DATA BIT_MASK 0xFF /end MEASUREMENT
/begin MEASUREMENT rinv2_w "Istwert (word) Innenwiderstand Ri-Nernstzelle der Lambdasonde vor KAT Bank2" UWORD r_uw_q2 0 0 0.000000 131070.000000 /begin IF_DATA ASAP1B_ETK KP_BLOB 0x381BB4 1 2 /end IF_DATA BIT_MASK 0xFFFF /end MEASUREMENT
/begin MEASUREMENT rinv_u "Istwert (Byte) Innenwiderstand Ri-Nernstzelle der Lambdasonde vor KAT" UBYTE r_ub_q64 0 0 0.000000 16320.000000 /begin IF_DATA ASAP1B_ETK KP_BLOB 0x380A47 1 1 /end IF_DATA BIT_MASK 0xFF /end MEASUREMENT
/begin MEASUREMENT rinv_w "Istwert (word) Innenwiderstand Ri-Nernstzelle der Lambdasonde vor KAT" UWORD r_uw_q2 0 0 0.000000 131070.000000 /begin IF_DATA ASAP1B_ETK KP_BLOB 0x381BB6 1 2 /end IF_DATA BIT_MASK 0xFFFF /end MEASUREMENT
/begin MEASUREMENT rldvs_w "relative LuftfÅllung durch Drosselventile am Saugrohr 16-Bit" UWORD rel_uw_q0p0234 0 0 0.000000 1535.976562 /begin IF_DATA ASAP1B_ETK KP_BLOB 0x381E7E 1 2 /end IF_DATA BIT_MASK 0xFFFF /end MEASUREMENT
/begin MEASUREMENT rlgas_w "FÅllungsgradient Åber ein Arbeitsspiel bestimmt" SWORD relNWU_q0p0234 0 0 -768.000000 767.976562 /begin IF_DATA ASAP1B_ETK KP_BLOB 0x381ECA 1 2 /end IF_DATA BIT_MASK 0xFFFF /end MEASUREMENT
/begin MEASUREMENT rlmp_w "rel. extrapolierte Luftfuellung (Word)" UWORD rel_uw_q0p0234 0 0 0.000000 1535.976562 /begin IF_DATA ASAP1B_ETK KP_BLOB 0x381FCE 1 2 /end IF_DATA BIT_MASK 0xFFFF /end MEASUREMENT
/begin MEASUREMENT rlp "rel. LuftfÅllung praediziert fÅr Einspritzberechnung" UBYTE rel_ub_q0p75 0 0 0.000000 191.250000 /begin IF_DATA ASAP1B_ETK KP_BLOB 0x380B24 1 1 /end IF_DATA BIT_MASK 0xFF /end MEASUREMENT
/begin MEASUREMENT rlpnb_w "rel. LuftfÅllung prÑdiziert, nicht begrenzt" UWORD rel_uw_q0p0234 0 0 0.000000 1535.976562 /begin IF_DATA ASAP1B_ETK KP_BLOB 0x381FD0 1 2 /end IF_DATA BIT_MASK 0xFFFF /end MEASUREMENT
/begin MEASUREMENT rlpu_w "rel. LuftfÅllung prÑdiziert, Untergrenze" UWORD rel_uw_q0p0234 0 0 0.000000 1535.976562 /begin IF_DATA ASAP1B_ETK KP_BLOB 0x381FD2 1 2 /end IF_DATA BIT_MASK 0xFFFF /end MEASUREMENT
/begin MEASUREMENT rlrohmp_w "rel. LuftfÅllung Saugrohrzufluss bei Saugrohrdruck psmp_w (Word)" UWORD rel_uw_q0p0234 0 0 0.000000 1535.976562 /begin IF_DATA ASAP1B_ETK KP_BLOB 0x381FD6 1 2 /end IF_DATA BIT_MASK 0xFFFF /end MEASUREMENT
/begin MEASUREMENT rlroh_w "relative LuftfÅllung: Rohwert vom Lastsensor (word)" UWORD rel_uw_q0p0234 0 0 0.000000 1535.976562 /begin IF_DATA ASAP1B_ETK KP_BLOB 0xF99E 0 2 /end IF_DATA BIT_MASK 0xFFFF /end MEASUREMENT
/begin MEASUREMENT rlrsp_w_0__A "Beginn Ringspeicher relative FÅllung" UWORD rel_uw_q0p0234 0 0 0.000000 1535.976562 /begin IF_DATA ASAP1B_ETK KP_BLOB 0x381ECC 1 2 /end IF_DATA BIT_MASK 0xFFFF /end MEASUREMENT
/begin MEASUREMENT rlrsp_w_1__A "Beginn Ringspeicher relative FÅllung" UWORD rel_uw_q0p0234 0 0 0.000000 1535.976562 /begin IF_DATA ASAP1B_ETK KP_BLOB 0x381ECE 1 2 /end IF_DATA BIT_MASK 0xFFFF /end MEASUREMENT
/begin MEASUREMENT rlrsp_w_2__A "Beginn Ringspeicher relative FÅllung" UWORD rel_uw_q0p0234 0 0 0.000000 1535.976562 /begin IF_DATA ASAP1B_ETK KP_BLOB 0x381ED0 1 2 /end IF_DATA BIT_MASK 0xFFFF /end MEASUREMENT
/begin MEASUREMENT rlrsp_w_3__A "Beginn Ringspeicher relative FÅllung" UWORD rel_uw_q0p0234 0 0 0.000000 1535.976562 /begin IF_DATA ASAP1B_ETK KP_BLOB 0x381ED2 1 2 /end IF_DATA BIT_MASK 0xFFFF /end MEASUREMENT
/begin MEASUREMENT rlrsp_w_4__A "Beginn Ringspeicher relative FÅllung" UWORD rel_uw_q0p0234 0 0 0.000000 1535.976562 /begin IF_DATA ASAP1B_ETK KP_BLOB 0x381ED4 1 2 /end IF_DATA BIT_MASK 0xFFFF /end MEASUREMENT
/begin MEASUREMENT rlrsp_w_5__A "Beginn Ringspeicher relative FÅllung" UWORD rel_uw_q0p0234 0 0 0.000000 1535.976562 /begin IF_DATA ASAP1B_ETK KP_BLOB 0x381ED6 1 2 /end IF_DATA BIT_MASK 0xFFFF /end MEASUREMENT
/begin MEASUREMENT rlugd_w "FÅllung im ungedrosselten Zustand" UWORD rel_uw_q0p0234 0 0 0.000000 1535.976562 /begin IF_DATA ASAP1B_ETK KP_BLOB 0x382476 1 2 /end IF_DATA BIT_MASK 0xFFFF /end MEASUREMENT
/begin MEASUREMENT rl_u "relative LuftfÅllung (Byte) fÅr Fehlerspeicher-Umwelten" UBYTE rel_ub_b100 0 0 0.000000 99.609375 /begin IF_DATA ASAP1B_ETK KP_BLOB 0x380A48 1 1 /end IF_DATA BIT_MASK 0xFF /end MEASUREMENT
/begin MEASUREMENT rml "relative Luftmasse (calc. load value) nach SAE J1979" UBYTE rel_ub_b99p6 0 0 0.000000 99.609375 /begin IF_DATA ASAP1B_ETK KP_BLOB 0x380AF8 1 1 /end IF_DATA BIT_MASK 0xFF /end MEASUREMENT
/begin MEASUREMENT rstpfad "Reset-Pfad als Umweltbedingung fÅr RechnerÅberwachungs-Diagnoseeintrag" UBYTE dez 0 0 0.000000 255.000000 /begin IF_DATA ASAP1B_ETK KP_BLOB 0x380C97 1 1 /end IF_DATA BIT_MASK 0xFF /end MEASUREMENT
/begin MEASUREMENT sfpbm "Status Fehlerpfad: Bezugsmarkengeber" UWORD dez___UW 0 0 0.000000 65535.000000 /begin IF_DATA ASAP1B_ETK KP_BLOB 0x383AF6 1 2 /end IF_DATA BIT_MASK 0xFFFF /end MEASUREMENT
/begin MEASUREMENT sfpcadr "Status Fehlerpfad: CAN-Schnittstelle, Timeout Botschaft ADR" UWORD dez___UW 0 0 0.000000 65535.000000 /begin IF_DATA ASAP1B_ETK KP_BLOB 0x383AFC 1 2 /end IF_DATA BIT_MASK 0xFFFF /end MEASUREMENT
/begin MEASUREMENT sfpcas "Status Fehlerpfad: Diagnose CAN-Timeout ASC-Schnittstelle" UWORD dez___UW 0 0 0.000000 65535.000000 /begin IF_DATA ASAP1B_ETK KP_BLOB 0x383AFE 1 2 /end IF_DATA BIT_MASK 0xFFFF /end MEASUREMENT
/begin MEASUREMENT sfpcat "Status Fehlerpfad: CAN-Schnittstelle, Timeout ASC" UWORD dez___UW 0 0 0.000000 65535.000000 /begin IF_DATA ASAP1B_ETK KP_BLOB 0x383B00 1 2 /end IF_DATA BIT_MASK 0xFFFF /end MEASUREMENT
/begin MEASUREMENT sfpcge "Status Fehlerpfad: Diagnose CAN-Timeout EGS-Schnittstelle" UWORD dez___UW 0 0 0.000000 65535.000000 /begin IF_DATA ASAP1B_ETK KP_BLOB 0x383B02 1 2 /end IF_DATA BIT_MASK 0xFFFF /end MEASUREMENT
/begin MEASUREMENT sfpcif "Status Fehlerpfad: CAN im Zustand Bus-Off" UWORD dez___UW 0 0 0.000000 65535.000000 /begin IF_DATA ASAP1B_ETK KP_BLOB 0x383B04 1 2 /end IF_DATA BIT_MASK 0xFFFF /end MEASUREMENT
/begin MEASUREMENT sfpcins "Status Fehlerpfad: Diagnose CAN-Timeout Kombiinstr." UWORD dez___UW 0 0 0.000000 65535.000000 /begin IF_DATA ASAP1B_ETK KP_BLOB 0x383B06 1 2 /end IF_DATA BIT_MASK 0xFFFF /end MEASUREMENT
/begin MEASUREMENT sfpclws "Status Fehlerpfad: CAN-Schnittstelle, Timeout Botschaft Lenkwinkelsensor" UWORD dez___UW 0 0 0.000000 65535.000000 /begin IF_DATA ASAP1B_ETK KP_BLOB 0x383B08 1 2 /end IF_DATA BIT_MASK 0xFFFF /end MEASUREMENT
/begin MEASUREMENT sfpdk "Status Fehlerpfad DK: Drosselklappe" UWORD dez___UW 0 0 0.000000 65535.000000 /begin IF_DATA ASAP1B_ETK KP_BLOB 0x383B0A 1 2 /end IF_DATA BIT_MASK 0xFFFF /end MEASUREMENT
/begin MEASUREMENT sfpdk1p "Status Fehlerpfad DK1P: Drosselklappe 1. Poti" UWORD dez___UW 0 0 0.000000 65535.000000 /begin IF_DATA ASAP1B_ETK KP_BLOB 0x383B0C 1 2 /end IF_DATA BIT_MASK 0xFFFF /end MEASUREMENT
/begin MEASUREMENT sfpdk2p "Status Fehlerpfad DK2P: Drosselklappe 2. Poti" UWORD dez___UW 0 0 0.000000 65535.000000 /begin IF_DATA ASAP1B_ETK KP_BLOB 0x383B0E 1 2 /end IF_DATA BIT_MASK 0xFFFF /end MEASUREMENT
/begin MEASUREMENT sfpdvee "Statuswort: DV-E Endstufe" UWORD dez___UW 0 0 0.000000 65535.000000 /begin IF_DATA ASAP1B_ETK KP_BLOB 0x383B1A 1 2 /end IF_DATA BIT_MASK 0xFFFF /end MEASUREMENT
/begin MEASUREMENT sfpdvef "Statuswort: DV-E Fehler bei FederprÅfung" UWORD dez___UW 0 0 0.000000 65535.000000 /begin IF_DATA ASAP1B_ETK KP_BLOB 0x383B1C 1 2 /end IF_DATA BIT_MASK 0xFFFF /end MEASUREMENT
/begin MEASUREMENT sfpdvefo "Status Fehlerpfad: DV-E-Fehler bei FederprÅfung 'ôffnen'" UWORD dez___UW 0 0 0.000000 65535.000000 /begin IF_DATA ASAP1B_ETK KP_BLOB 0x383B1E 1 2 /end IF_DATA BIT_MASK 0xFFFF /end MEASUREMENT
/begin MEASUREMENT sfpdvel "Statuswort: DV-E Lageabweichung" UWORD dez___UW 0 0 0.000000 65535.000000 /begin IF_DATA ASAP1B_ETK KP_BLOB 0x383B20 1 2 /end IF_DATA BIT_MASK 0xFFFF /end MEASUREMENT
/begin MEASUREMENT sfpdven "Statuswort: DV-E Fehler bei PrÅfung Notluftposition" UWORD dez___UW 0 0 0.000000 65535.000000 /begin IF_DATA ASAP1B_ETK KP_BLOB 0x383B22 1 2 /end IF_DATA BIT_MASK 0xFFFF /end MEASUREMENT
/begin MEASUREMENT sfpdver "Statuswort: DV-E Regelbereich" UWORD dez___UW 0 0 0.000000 65535.000000 /begin IF_DATA ASAP1B_ETK KP_BLOB 0x383B24 1 2 /end IF_DATA BIT_MASK 0xFFFF /end MEASUREMENT
/begin MEASUREMENT sfpdvet "Status Fehlerpfad: DV-E-Tauchserkennung ohne Adaption" UWORD dez___UW 0 0 0.000000 65535.000000 /begin IF_DATA ASAP1B_ETK KP_BLOB 0x383B26 1 2 /end IF_DATA BIT_MASK 0xFFFF /end MEASUREMENT
/begin MEASUREMENT sfpdveu "Statuswort: DV-E Fehler beim UMA-Lernen" UWORD dez___UW 0 0 0.000000 65535.000000 /begin IF_DATA ASAP1B_ETK KP_BLOB 0x383B28 1 2 /end IF_DATA BIT_MASK 0xFFFF /end MEASUREMENT
/begin MEASUREMENT sfpdveub "Status Fehlerpfad: DV-E-Adaption Abbruch wg. Umweltbedingung" UWORD dez___UW 0 0 0.000000 65535.000000 /begin IF_DATA ASAP1B_ETK KP_BLOB 0x383B2A 1 2 /end IF_DATA BIT_MASK 0xFFFF /end MEASUREMENT
/begin MEASUREMENT sfpdveuw "Status Fehlerpfad: UMA-Wiederlernen" UWORD dez___UW 0 0 0.000000 65535.000000 /begin IF_DATA ASAP1B_ETK KP_BLOB 0x383B2C 1 2 /end IF_DATA BIT_MASK 0xFFFF /end MEASUREMENT
/begin MEASUREMENT sfpdvev "Statuswort: DV-E Fehler bei VerstÑrkerabgleich" UWORD dez___UW 0 0 0.000000 65535.000000 /begin IF_DATA ASAP1B_ETK KP_BLOB 0x383B2E 1 2 /end IF_DATA BIT_MASK 0xFFFF /end MEASUREMENT
/begin MEASUREMENT sfpn "Status Fehlerpfad: Drehzahlgeber" UWORD dez___UW 0 0 0.000000 65535.000000 /begin IF_DATA ASAP1B_ETK KP_BLOB 0x383BBA 1 2 /end IF_DATA BIT_MASK 0xFFFF /end MEASUREMENT
/begin MEASUREMENT skapfad "SKA-Pfad als Umweltbedingung fÅr FunktionsÅberwachungs-Diagnoseeintrag" UBYTE dez 0 0 0.000000 255.000000 /begin IF_DATA ASAP1B_ETK KP_BLOB 0x380C96 1 1 /end IF_DATA BIT_MASK 0xFF /end MEASUREMENT
/begin MEASUREMENT statadr "ADR-StatusrÅckmeldung Åber CAN" UBYTE DEZ 0 0 0.000000 255.000000 /begin IF_DATA ASAP1B_ETK KP_BLOB 0x3809CC 1 1 /end IF_DATA BIT_MASK 0xFF /end MEASUREMENT
/begin MEASUREMENT statgra "Status GRA fÅr Ausgabe auf CAN" UBYTE DEZ 0 0 0.000000 255.000000 /begin IF_DATA ASAP1B_ETK KP_BLOB 0x3809CD 1 1 /end IF_DATA BIT_MASK 0xFF /end MEASUREMENT
/begin MEASUREMENT swOffDlBits "" UWORD dez___UW 0 0 0.000000 65535.000000 /begin IF_DATA ASAP1B_ETK KP_BLOB 0x383CCE 1 2 /end IF_DATA BIT_MASK 0xFFFF /end MEASUREMENT
/begin MEASUREMENT S_bls "Schalter Bremslicht" UWORD B_TRUE___UW 0 0 0.000000 0.000000 /begin IF_DATA ASAP1B_ETK KP_BLOB 0xFD0C 0 2 /end IF_DATA BIT_MASK 0x100 /end MEASUREMENT
/begin MEASUREMENT S_brs "Schalter Bremstest" UWORD B_TRUE___UW 0 0 0.000000 0.000000 /begin IF_DATA ASAP1B_ETK KP_BLOB 0xFD6C 0 2 /end IF_DATA BIT_MASK 0x10 /end MEASUREMENT
/begin MEASUREMENT S_fs "Schalter Fahrstufe" UWORD B_TRUE___UW 0 0 0.000000 0.000000 /begin IF_DATA ASAP1B_ETK KP_BLOB 0xFD14 0 2 /end IF_DATA BIT_MASK 0x4000 /end MEASUREMENT
/begin MEASUREMENT tabsmn_w "Abstellzeit aus relativem MinutenzÑhler" UWORD t1sxs_uw_q1 0 0 0.000000 65535.000000 /begin IF_DATA ASAP1B_ETK KP_BLOB 0x38207A 1 2 /end IF_DATA BIT_MASK 0xFFFF /end MEASUREMENT
/begin MEASUREMENT tabsnl_w "Abstellzeit aus SG-Nachlauf" UWORD t1sxs_uw_q1 0 0 0.000000 65535.000000 /begin IF_DATA ASAP1B_ETK KP_BLOB 0x383C92 1 2 /end IF_DATA BIT_MASK 0xFFFF /end MEASUREMENT
/begin MEASUREMENT tabssc_w "Abstellzeit aus relativem SekundenzÑhler" UWORD t1sxs_uw_q1 0 0 0.000000 65535.000000 /begin IF_DATA ASAP1B_ETK KP_BLOB 0x38207C 1 2 /end IF_DATA BIT_MASK 0xFFFF /end MEASUREMENT
/begin MEASUREMENT tabstm_w "Abstellzeit aus AbkÅhlung des Motors" UWORD t1sxs_uw_q1 0 0 0.000000 65535.000000 /begin IF_DATA ASAP1B_ETK KP_BLOB 0x38207E 1 2 /end IF_DATA BIT_MASK 0xFFFF /end MEASUREMENT
/begin MEASUREMENT tags_w "AGR Temperatur bei Einleitung ins Saugrohr (Word)" UWORD temp_uw_q0p0195_o50 0 0 -50.000000 1229.980469 /begin IF_DATA ASAP1B_ETK KP_BLOB 0x381EF4 1 2 /end IF_DATA BIT_MASK 0xFFFF /end MEASUREMENT
/begin MEASUREMENT tas_w "Zeit Åber ein Arbeitsspiel fÅr rlgas_w" UWORD t_q16us 0 0 0.000000 1048560.000000 /begin IF_DATA ASAP1B_ETK KP_BLOB 0x381ED8 1 2 /end IF_DATA BIT_MASK 0xFFFF /end MEASUREMENT
/begin MEASUREMENT tateist "aktuelles Ist-TastverhÑltnis TankentlÅftungsventil" UBYTE rel_ub_b99p6 0 0 0.000000 99.609375 /begin IF_DATA ASAP1B_ETK KP_BLOB 0x380CD5 1 1 /end IF_DATA BIT_MASK 0xFF /end MEASUREMENT
/begin MEASUREMENT tateslo1 "Um einen Rechenschritt verzîgertes SolltastverhÑltnis TankentlÅftungsventil" UBYTE rel_ub_b99p6 0 0 0.000000 99.609375 /begin IF_DATA ASAP1B_ETK KP_BLOB 0x380CD6 1 1 /end IF_DATA BIT_MASK 0xFF /end MEASUREMENT
/begin MEASUREMENT tateslo2 "Um zwei Rechenschritte verzîgertes SolltastverhÑltnis TankentlÅftungsventil" UBYTE rel_ub_b99p6 0 0 0.000000 99.609375 /begin IF_DATA ASAP1B_ETK KP_BLOB 0x380CD7 1 1 /end IF_DATA BIT_MASK 0xFF /end MEASUREMENT
/begin MEASUREMENT tateslo3 "Um drei Rechenschritte verzîgertes SolltastverhÑltnis TankentlÅftungsventil" UBYTE rel_ub_b99p6 0 0 0.000000 99.609375 /begin IF_DATA ASAP1B_ETK KP_BLOB 0x380CD8 1 1 /end IF_DATA BIT_MASK 0xFF /end MEASUREMENT
/begin MEASUREMENT tatesoll "gewÅnschtes Soll-TastverhÑltnis TankentlÅftungsventil" UBYTE rel_ub_b99p6 0 0 0.000000 99.609375 /begin IF_DATA ASAP1B_ETK KP_BLOB 0x380CB5 1 1 /end IF_DATA BIT_MASK 0xFF /end MEASUREMENT
/begin MEASUREMENT tevper "Periodendauer bei Ansteuerung TankentlÅftungsventil" UBYTE t500usxms_ub_q0p5 0 0 0.000000 127.500000 /begin IF_DATA ASAP1B_ETK KP_BLOB 0x380CB2 1 1 /end IF_DATA BIT_MASK 0xFF /end MEASUREMENT
/begin MEASUREMENT tevpero1 "Periodendauer TankentlÅftungsventil um einen Rechenschritt verzîgert" UBYTE t500usxms_ub_q0p5 0 0 0.000000 127.500000 /begin IF_DATA ASAP1B_ETK KP_BLOB 0x380CD9 1 1 /end IF_DATA BIT_MASK 0xFF /end MEASUREMENT
/begin MEASUREMENT tevpero2 "Periodendauer TankentlÅftungsventil um zwei Rechenschritte verzîgert" UBYTE t500usxms_ub_q0p5 0 0 0.000000 127.500000 /begin IF_DATA ASAP1B_ETK KP_BLOB 0x380CDA 1 1 /end IF_DATA BIT_MASK 0xFF /end MEASUREMENT
/begin MEASUREMENT tevpero3 "Periodendauer TankentlÅftungsventil um drei Rechenschritte verzîgert" UBYTE t500usxms_ub_q0p5 0 0 0.000000 127.500000 /begin IF_DATA ASAP1B_ETK KP_BLOB 0x380CDB 1 1 /end IF_DATA BIT_MASK 0xFF /end MEASUREMENT
/begin MEASUREMENT tevpervz "Verzîgerte Periodendauer TEV" UBYTE t500usxms_ub_q0p5 0 0 0.000000 127.500000 /begin IF_DATA ASAP1B_ETK KP_BLOB 0x380CDC 1 1 /end IF_DATA BIT_MASK 0xFF /end MEASUREMENT
/begin MEASUREMENT te_w "effektive Einspritzzeit (word)" UWORD tinjection_sy 0 0 0.000000 209.712000 /begin IF_DATA ASAP1B_ETK KP_BLOB 0x381FB4 1 2 /end IF_DATA BIT_MASK 0xFFFF /end MEASUREMENT
/begin MEASUREMENT tfst "TankfÅllstand" UBYTE dez 0 0 0.000000 255.000000 /begin IF_DATA ASAP1B_ETK KP_BLOB 0x380AB2 1 1 /end IF_DATA BIT_MASK 0xFF /end MEASUREMENT
/begin MEASUREMENT tkvad "" UBYTE dez 0 0 0.000000 255.000000 /begin IF_DATA ASAP1B_ETK KP_BLOB 0x380D2A 1 1 /end IF_DATA BIT_MASK 0xFF /end MEASUREMENT
/begin MEASUREMENT tmkic "Motortemperatur aus Kombibotschaft" UBYTE temp_ub_q0p75_o48 0 0 -48.000000 143.250000 /begin IF_DATA ASAP1B_ETK KP_BLOB 0x3809CE 1 1 /end IF_DATA BIT_MASK 0xFF /end MEASUREMENT
/begin MEASUREMENT tmotlin "Motortemperatur, linearisiert und umgerechnet" UBYTE temp_ub_q0p75_o48 0 0 -48.000000 143.250000 /begin IF_DATA ASAP1B_ETK KP_BLOB 0x380B5B 1 1 /end IF_DATA BIT_MASK 0xFF /end MEASUREMENT
/begin MEASUREMENT tmot_u "Motor-Temperatur mit def. Quantisierung fÅr FSP-Umwelten" UBYTE temp_ub_q1_o40 0 0 -40.000000 215.000000 /begin IF_DATA ASAP1B_ETK KP_BLOB 0x380A49 1 1 /end IF_DATA BIT_MASK 0xFF /end MEASUREMENT
/begin MEASUREMENT tolc "ôltemperatur aus Kombibotschaft" UBYTE temp_ub_q1_o60 0 0 -60.000000 195.000000 /begin IF_DATA ASAP1B_ETK KP_BLOB 0x3809CF 1 1 /end IF_DATA BIT_MASK 0xFF /end MEASUREMENT
/begin MEASUREMENT top_w "Operating time seit powerfail" UWORD t6minxmin_q6 0 0 0.000000 393210.000000 /begin IF_DATA ASAP1B_ETK KP_BLOB 0x383C1C 1 2 /end IF_DATA BIT_MASK 0xFFFF /end MEASUREMENT
/begin MEASUREMENT tpsvkmf2_u "gefilterter Periodendauerwert des Sondensignals vor Kat, Bank2 (Byte)" UBYTE t10msxs_ub_b10p2 0 0 0.000000 10.200000 /begin IF_DATA ASAP1B_ETK KP_BLOB 0x380A4A 1 1 /end IF_DATA BIT_MASK 0xFF /end MEASUREMENT
/begin MEASUREMENT tpsvkmf2_w "gefilterter Periodendauerwert des Sondensignals vor Kat, Bank2 (Word)" UWORD t10msxs_uw_b655p35 0 0 0.000000 655.350000 /begin IF_DATA ASAP1B_ETK KP_BLOB 0x383C3E 1 2 /end IF_DATA BIT_MASK 0xFFFF /end MEASUREMENT
/begin MEASUREMENT tpsvkmf_u "gefilterter Periodendauerwert des Sondensignals vor Kat. (Byte)" UBYTE t10msxs_ub_b10p2 0 0 0.000000 10.200000 /begin IF_DATA ASAP1B_ETK KP_BLOB 0x380A4B 1 1 /end IF_DATA BIT_MASK 0xFF /end MEASUREMENT
/begin MEASUREMENT tpsvkmf_w "gefilterter Periodendauerwert des Sondensignals vor Kat. (Word)" UWORD t10msxs_uw_b655p35 0 0 0.000000 655.350000 /begin IF_DATA ASAP1B_ETK KP_BLOB 0x383C40 1 2 /end IF_DATA BIT_MASK 0xFFFF /end MEASUREMENT
/begin MEASUREMENT tsegrsp_w_0__A "Beginn Ringspeicher fÅr Segmentzeit" UWORD tsquant 0 0 0.000000 78642.031457 /begin IF_DATA ASAP1B_ETK KP_BLOB 0xF888 0 2 /end IF_DATA BIT_MASK 0xFFFF /end MEASUREMENT
/begin MEASUREMENT tsegrsp_w_1__A "Beginn Ringspeicher fÅr Segmentzeit" UWORD tsquant 0 0 0.000000 78642.031457 /begin IF_DATA ASAP1B_ETK KP_BLOB 0xF88A 0 2 /end IF_DATA BIT_MASK 0xFFFF /end MEASUREMENT
/begin MEASUREMENT tsegrsp_w_2__A "Beginn Ringspeicher fÅr Segmentzeit" UWORD tsquant 0 0 0.000000 78642.031457 /begin IF_DATA ASAP1B_ETK KP_BLOB 0xF88C 0 2 /end IF_DATA BIT_MASK 0xFFFF /end MEASUREMENT
/begin MEASUREMENT tsegrsp_w_3__A "Beginn Ringspeicher fÅr Segmentzeit" UWORD tsquant 0 0 0.000000 78642.031457 /begin IF_DATA ASAP1B_ETK KP_BLOB 0xF88E 0 2 /end IF_DATA BIT_MASK 0xFFFF /end MEASUREMENT
/begin MEASUREMENT tsegrsp_w_4__A "Beginn Ringspeicher fÅr Segmentzeit" UWORD tsquant 0 0 0.000000 78642.031457 /begin IF_DATA ASAP1B_ETK KP_BLOB 0xF890 0 2 /end IF_DATA BIT_MASK 0xFFFF /end MEASUREMENT
/begin MEASUREMENT tsegrsp_w_5__A "Beginn Ringspeicher fÅr Segmentzeit" UWORD tsquant 0 0 0.000000 78642.031457 /begin IF_DATA ASAP1B_ETK KP_BLOB 0xF892 0 2 /end IF_DATA BIT_MASK 0xFFFF /end MEASUREMENT
/begin MEASUREMENT tum "Umgebungstemperatur" UBYTE temp_ub_q0p75_o48 0 0 -48.000000 143.250000 /begin IF_DATA ASAP1B_ETK KP_BLOB 0x3809D0 1 1 /end IF_DATA BIT_MASK 0xFF /end MEASUREMENT
/begin MEASUREMENT tumg "Umgebungstemperatur" UBYTE temp_ub_q0p75_o48 0 0 -48.000000 143.250000 /begin IF_DATA ASAP1B_ETK KP_BLOB 0xF7DC 0 1 /end IF_DATA BIT_MASK 0xFF /end MEASUREMENT
/begin MEASUREMENT tumta "Umgebungstemperatur aus Ansauglufttemperatur" UBYTE temp_ub_q0p75_o48 0 0 -48.000000 143.250000 /begin IF_DATA ASAP1B_ETK KP_BLOB 0x383358 1 1 /end IF_DATA BIT_MASK 0xFF /end MEASUREMENT
/begin MEASUREMENT tvu_w "Batteriespannungskorrektur" UWORD tinjection_sy 0 0 0.000000 209.712000 /begin IF_DATA ASAP1B_ETK KP_BLOB 0x38201C 1 2 /end IF_DATA BIT_MASK 0xFFFF /end MEASUREMENT
/begin MEASUREMENT TYP_bm "" UWORD B_TRUE___UW 0 0 0.000000 0.000000 /begin IF_DATA ASAP1B_ETK KP_BLOB 0x383AF6 1 2 /end IF_DATA BIT_MASK 0xF00 /end MEASUREMENT
/begin MEASUREMENT TYP_cadr "" UWORD B_TRUE___UW 0 0 0.000000 0.000000 /begin IF_DATA ASAP1B_ETK KP_BLOB 0x383AFC 1 2 /end IF_DATA BIT_MASK 0xF00 /end MEASUREMENT
/begin MEASUREMENT TYP_cas "" UWORD B_TRUE___UW 0 0 0.000000 0.000000 /begin IF_DATA ASAP1B_ETK KP_BLOB 0x383AFE 1 2 /end IF_DATA BIT_MASK 0xF00 /end MEASUREMENT
/begin MEASUREMENT TYP_cat "" UWORD B_TRUE___UW 0 0 0.000000 0.000000 /begin IF_DATA ASAP1B_ETK KP_BLOB 0x383B00 1 2 /end IF_DATA BIT_MASK 0xF00 /end MEASUREMENT
/begin MEASUREMENT TYP_cge "" UWORD B_TRUE___UW 0 0 0.000000 0.000000 /begin IF_DATA ASAP1B_ETK KP_BLOB 0x383B02 1 2 /end IF_DATA BIT_MASK 0xF00 /end MEASUREMENT
/begin MEASUREMENT TYP_cif "Fehlertyp: CAN im Zustand Bus-Off" UWORD B_TRUE___UW 0 0 0.000000 0.000000 /begin IF_DATA ASAP1B_ETK KP_BLOB 0x383B04 1 2 /end IF_DATA BIT_MASK 0xF00 /end MEASUREMENT
/begin MEASUREMENT TYP_cins "" UWORD B_TRUE___UW 0 0 0.000000 0.000000 /begin IF_DATA ASAP1B_ETK KP_BLOB 0x383B06 1 2 /end IF_DATA BIT_MASK 0xF00 /end MEASUREMENT
/begin MEASUREMENT TYP_clws "" UWORD B_TRUE___UW 0 0 0.000000 0.000000 /begin IF_DATA ASAP1B_ETK KP_BLOB 0x383B08 1 2 /end IF_DATA BIT_MASK 0xF00 /end MEASUREMENT
/begin MEASUREMENT TYP_dk "" UWORD B_TRUE___UW 0 0 0.000000 0.000000 /begin IF_DATA ASAP1B_ETK KP_BLOB 0x383B0A 1 2 /end IF_DATA BIT_MASK 0xF00 /end MEASUREMENT
/begin MEASUREMENT TYP_dk1p "" UWORD B_TRUE___UW 0 0 0.000000 0.000000 /begin IF_DATA ASAP1B_ETK KP_BLOB 0x383B0C 1 2 /end IF_DATA BIT_MASK 0xF00 /end MEASUREMENT
/begin MEASUREMENT TYP_dk2p "" UWORD B_TRUE___UW 0 0 0.000000 0.000000 /begin IF_DATA ASAP1B_ETK KP_BLOB 0x383B0E 1 2 /end IF_DATA BIT_MASK 0xF00 /end MEASUREMENT
/begin MEASUREMENT TYP_dvee "Fehlertyp: DV-E Endstufe" UWORD B_TRUE___UW 0 0 0.000000 0.000000 /begin IF_DATA ASAP1B_ETK KP_BLOB 0x383B1A 1 2 /end IF_DATA BIT_MASK 0xF00 /end MEASUREMENT
/begin MEASUREMENT TYP_dvef "Fehlertyp: DV-E Fehler bei FederprÅfung" UWORD B_TRUE___UW 0 0 0.000000 0.000000 /begin IF_DATA ASAP1B_ETK KP_BLOB 0x383B1C 1 2 /end IF_DATA BIT_MASK 0xF00 /end MEASUREMENT
/begin MEASUREMENT TYP_dvefo "" UWORD B_TRUE___UW 0 0 0.000000 0.000000 /begin IF_DATA ASAP1B_ETK KP_BLOB 0x383B1E 1 2 /end IF_DATA BIT_MASK 0xF00 /end MEASUREMENT
/begin MEASUREMENT TYP_dvel "Fehlertyp: DV-E Lageabweichung" UWORD B_TRUE___UW 0 0 0.000000 0.000000 /begin IF_DATA ASAP1B_ETK KP_BLOB 0x383B20 1 2 /end IF_DATA BIT_MASK 0xF00 /end MEASUREMENT
/begin MEASUREMENT TYP_dven "Fehlertyp: DV-E Fehler bei PrÅfung Notluftposition" UWORD B_TRUE___UW 0 0 0.000000 0.000000 /begin IF_DATA ASAP1B_ETK KP_BLOB 0x383B22 1 2 /end IF_DATA BIT_MASK 0xF00 /end MEASUREMENT
/begin MEASUREMENT TYP_dver "Fehlertyp: DV-E Regelbereich" UWORD B_TRUE___UW 0 0 0.000000 0.000000 /begin IF_DATA ASAP1B_ETK KP_BLOB 0x383B24 1 2 /end IF_DATA BIT_MASK 0xF00 /end MEASUREMENT
/begin MEASUREMENT TYP_dvet "" UWORD B_TRUE___UW 0 0 0.000000 0.000000 /begin IF_DATA ASAP1B_ETK KP_BLOB 0x383B26 1 2 /end IF_DATA BIT_MASK 0xF00 /end MEASUREMENT
/begin MEASUREMENT TYP_dveu "Fehlertyp: DV-E Fehler beim UMA-Lernen" UWORD B_TRUE___UW 0 0 0.000000 0.000000 /begin IF_DATA ASAP1B_ETK KP_BLOB 0x383B28 1 2 /end IF_DATA BIT_MASK 0xF00 /end MEASUREMENT
/begin MEASUREMENT TYP_dveub "" UWORD B_TRUE___UW 0 0 0.000000 0.000000 /begin IF_DATA ASAP1B_ETK KP_BLOB 0x383B2A 1 2 /end IF_DATA BIT_MASK 0xF00 /end MEASUREMENT
/begin MEASUREMENT TYP_dveuw "" UWORD B_TRUE___UW 0 0 0.000000 0.000000 /begin IF_DATA ASAP1B_ETK KP_BLOB 0x383B2C 1 2 /end IF_DATA BIT_MASK 0xF00 /end MEASUREMENT
/begin MEASUREMENT TYP_dvev "Fehlertyp: DV-E Fehler bei VerstÑrkerabgleich" UWORD B_TRUE___UW 0 0 0.000000 0.000000 /begin IF_DATA ASAP1B_ETK KP_BLOB 0x383B2E 1 2 /end IF_DATA BIT_MASK 0xF00 /end MEASUREMENT
/begin MEASUREMENT TYP_n "" UWORD B_TRUE___UW 0 0 0.000000 0.000000 /begin IF_DATA ASAP1B_ETK KP_BLOB 0x383BBA 1 2 /end IF_DATA BIT_MASK 0xF00 /end MEASUREMENT
/begin MEASUREMENT udkp1_u "Spannung Drosselklappen-Poti 1 (Byte)" UBYTE spg_ub_b5 0 0 0.000000 4.980469 /begin IF_DATA ASAP1B_ETK KP_BLOB 0x380A4C 1 1 /end IF_DATA BIT_MASK 0xFF /end MEASUREMENT
/begin MEASUREMENT udkp1_w "Spannung DK-Poti 1" UWORD spg_uw_q0p001222 0 0 0.000000 80.083770 /begin IF_DATA ASAP1B_ETK KP_BLOB 0x380F82 1 2 /end IF_DATA BIT_MASK 0xFFFF /end MEASUREMENT
/begin MEASUREMENT udkp2_u "Spannung Drosselklappen-Poti 2 (Byte)" UBYTE spg_ub_b5 0 0 0.000000 4.980469 /begin IF_DATA ASAP1B_ETK KP_BLOB 0x380A4D 1 1 /end IF_DATA BIT_MASK 0xFF /end MEASUREMENT
/begin MEASUREMENT udkp2_w "Spannung DK-Poti 2" UWORD spg_uw_q0p001222 0 0 0.000000 80.083770 /begin IF_DATA ASAP1B_ETK KP_BLOB 0x380F84 1 2 /end IF_DATA BIT_MASK 0xFFFF /end MEASUREMENT
/begin MEASUREMENT uefktget "öbertragungsfunktion (Mrad/Mkurbelwelle) von der Getriebesteuerung" UBYTE uefktget_ub_b25p4 0 0 0.000000 25.500000 /begin IF_DATA ASAP1B_ETK KP_BLOB 0x3809D1 1 1 /end IF_DATA BIT_MASK 0xFF /end MEASUREMENT
/begin MEASUREMENT uhsv "Spannung an der Heizerendstufe vor Kat" UBYTE spg_ub_b5 0 0 0.000000 4.980469 /begin IF_DATA ASAP1B_ETK KP_BLOB 0x3809B7 1 1 /end IF_DATA BIT_MASK 0xFF /end MEASUREMENT
/begin MEASUREMENT umsrln_w "KUMSRL * nmot_w" UWORD m_uw_q0p0005 0 0 0.000000 32.767500 /begin IF_DATA ASAP1B_ETK KP_BLOB 0x381E80 1 2 /end IF_DATA BIT_MASK 0xFFFF /end MEASUREMENT
/begin MEASUREMENT upwg1_u "Spannung PWG-Poti 1 (Byte)" UBYTE spg_ub_b5 0 0 0.000000 4.980469 /begin IF_DATA ASAP1B_ETK KP_BLOB 0x380A4E 1 1 /end IF_DATA BIT_MASK 0xFF /end MEASUREMENT
/begin MEASUREMENT upwg1_w "Spannung PWG-Poti 1 (Word)" UWORD spg_uw_q0p00488 0 0 0.000000 319.995117 /begin IF_DATA ASAP1B_ETK KP_BLOB 0x380F8E 1 2 /end IF_DATA BIT_MASK 0xFFFF /end MEASUREMENT
/begin MEASUREMENT upwg2d_u "Verdoppelte PWG-Poti-2-Spannung (Byte)" UBYTE spg_ub_b5 0 0 0.000000 4.980469 /begin IF_DATA ASAP1B_ETK KP_BLOB 0x380A4F 1 1 /end IF_DATA BIT_MASK 0xFF /end MEASUREMENT
/begin MEASUREMENT upwg2d_w "Verdoppelte PWG-Poti-2-Spannung (Word)" UWORD spg_uw_q0p00488 0 0 0.000000 319.995117 /begin IF_DATA ASAP1B_ETK KP_BLOB 0x381CA4 1 2 /end IF_DATA BIT_MASK 0xFFFF /end MEASUREMENT
/begin MEASUREMENT upwg2_u "Spannung PWG-Poti 2 (Byte)" UBYTE spg_ub_b5 0 0 0.000000 4.980469 /begin IF_DATA ASAP1B_ETK KP_BLOB 0x380A50 1 1 /end IF_DATA BIT_MASK 0xFF /end MEASUREMENT
/begin MEASUREMENT upwg2_w "Spannung PWG-Poti 2 (Word)" UWORD spg_uw_q0p00488 0 0 0.000000 319.995117 /begin IF_DATA ASAP1B_ETK KP_BLOB 0x380F90 1 2 /end IF_DATA BIT_MASK 0xFFFF /end MEASUREMENT
/begin MEASUREMENT ushk "Spannung Lambdasonde hinter Katalysator" UBYTE spg_ub_q0p0052_o0p2 0 0 -0.200000 1.130000 /begin IF_DATA ASAP1B_ETK KP_BLOB 0x380A71 1 1 /end IF_DATA BIT_MASK 0xFF /end MEASUREMENT
/begin MEASUREMENT ushk2 "Spannung Lambdasonde hinter Katalysator 2" UBYTE spg_ub_q0p0052_o0p2 0 0 -0.200000 1.130000 /begin IF_DATA ASAP1B_ETK KP_BLOB 0x380A72 1 1 /end IF_DATA BIT_MASK 0xFF /end MEASUREMENT
/begin MEASUREMENT usvk "Spannung Lambdasonde vor Kat" UBYTE spg_ub_q0p0052_o0p2 0 0 -0.200000 1.130000 /begin IF_DATA ASAP1B_ETK KP_BLOB 0x380A81 1 1 /end IF_DATA BIT_MASK 0xFF /end MEASUREMENT
/begin MEASUREMENT usvk2 "Spannung Lambdasonde vor Kat 2" UBYTE spg_ub_q0p0052_o0p2 0 0 -0.200000 1.130000 /begin IF_DATA ASAP1B_ETK KP_BLOB 0x380A82 1 1 /end IF_DATA BIT_MASK 0xFF /end MEASUREMENT
/begin MEASUREMENT vamsr_w "Referenzgeschwindigkeit vom ASR/MSR-SteuergerÑt" UWORD vfzg_uw_b325 0 0 0.000000 324.995041 /begin IF_DATA ASAP1B_ETK KP_BLOB 0x381004 1 2 /end IF_DATA BIT_MASK 0xFFFF /end MEASUREMENT
/begin MEASUREMENT vfzctr "" UBYTE dez 0 0 0.000000 255.000000 /begin IF_DATA ASAP1B_ETK KP_BLOB 0x380C5B 1 1 /end IF_DATA BIT_MASK 0xFF /end MEASUREMENT
/begin MEASUREMENT vfzg2_w "Fahrzeuggeschwindigkeit 2. Signal" UWORD vfzg_uw_q0p00781 0 0 0.000000 511.992188 /begin IF_DATA ASAP1B_ETK KP_BLOB 0x38250C 1 2 /end IF_DATA BIT_MASK 0xFFFF /end MEASUREMENT
/begin MEASUREMENT vfzgkb_w "Geschwindigkeit aus Kombi-Botschaft" UWORD vfzgkb_uw_b655 0 0 0.000000 654.990005 /begin IF_DATA ASAP1B_ETK KP_BLOB 0x381006 1 2 /end IF_DATA BIT_MASK 0xFFFF /end MEASUREMENT
/begin MEASUREMENT vfzg_u "Fahrzeuggeschwindigkeit, mit def. Quantisierung fÅr Tester" UBYTE vfzg_q1p0 0 0 0.000000 255.000000 /begin IF_DATA ASAP1B_ETK KP_BLOB 0x380A51 1 1 /end IF_DATA BIT_MASK 0xFF /end MEASUREMENT
/begin MEASUREMENT vrad_hl_w "" UWORD vrad_uw_b655 0 0 0.000000 654.990005 /begin IF_DATA ASAP1B_ETK KP_BLOB 0x381008 1 2 /end IF_DATA BIT_MASK 0xFFFF /end MEASUREMENT
/begin MEASUREMENT vrad_hr_w "" UWORD vrad_uw_b655 0 0 0.000000 654.990005 /begin IF_DATA ASAP1B_ETK KP_BLOB 0x38100A 1 2 /end IF_DATA BIT_MASK 0xFFFF /end MEASUREMENT
/begin MEASUREMENT vrad_vl_w "" UWORD vrad_uw_b655 0 0 0.000000 654.990005 /begin IF_DATA ASAP1B_ETK KP_BLOB 0x38100C 1 2 /end IF_DATA BIT_MASK 0xFFFF /end MEASUREMENT
/begin MEASUREMENT vrad_vr_w "" UWORD vrad_uw_b655 0 0 0.000000 654.990005 /begin IF_DATA ASAP1B_ETK KP_BLOB 0x38100E 1 2 /end IF_DATA BIT_MASK 0xFFFF /end MEASUREMENT
/begin MEASUREMENT vregdia_w "Volumenstrom TankentlÅftungsventil: Wert fÅr Diagnose Tankdichtheit" UWORD vs_uw_b25p6 0 0 0.000000 25.599609 /begin IF_DATA ASAP1B_ETK KP_BLOB 0x3827DE 1 2 /end IF_DATA BIT_MASK 0xFFFF /end MEASUREMENT
/begin MEASUREMENT vwkw "KW-Winkelgeschwindigkeit" UBYTE rel_ub_q0p1875 0 0 0.000000 47.812500 /begin IF_DATA ASAP1B_ETK KP_BLOB 0x380B25 1 1 /end IF_DATA BIT_MASK 0xFF /end MEASUREMENT
/begin MEASUREMENT wdkbapb_w "fuer Einspritzung praediz. begr. Drosselklappenwinkel (Word)" UWORD rel_uw_b100 0 0 0.000000 99.998474 /begin IF_DATA ASAP1B_ETK KP_BLOB 0x381FD8 1 2 /end IF_DATA BIT_MASK 0xFFFF /end MEASUREMENT
/begin MEASUREMENT wdkbap_w "fuer Einspritzung praedizierter Drosselklappenwinkel (Word)" UWORD rel_uw_b100 0 0 0.000000 99.998474 /begin IF_DATA ASAP1B_ETK KP_BLOB 0x382028 1 2 /end IF_DATA BIT_MASK 0xFFFF /end MEASUREMENT
/begin MEASUREMENT wdks "Sollwert DK-Winkel, bezogen auf unteren Anschlag" UBYTE relDK_ub_b100 0 0 0.000000 100.000000 /begin IF_DATA ASAP1B_ETK KP_BLOB 0x380B02 1 1 /end IF_DATA BIT_MASK 0xFF /end MEASUREMENT
/begin MEASUREMENT wdksp_w "PrÑdizierter Drosselklappen-Sollwinkel" UWORD relDK_uw_b100 0 0 0.000000 100.000000 /begin IF_DATA ASAP1B_ETK KP_BLOB 0x381F6C 1 2 /end IF_DATA BIT_MASK 0xFFFF /end MEASUREMENT
/begin MEASUREMENT wdkugd_w "Drosselklappenwinkel, bei dem 95% FÅllung erreicht wird" UWORD rel_uw_b100 0 0 0.000000 99.998474 /begin IF_DATA ASAP1B_ETK KP_BLOB 0x381E84 1 2 /end IF_DATA BIT_MASK 0xFFFF /end MEASUREMENT
/begin MEASUREMENT wea "Winkelmarke Einspritzabbruch" UBYTE zw_ub_q6 0 0 0.000000 1530.000000 /begin IF_DATA ASAP1B_ETK KP_BLOB 0x380B28 1 1 /end IF_DATA BIT_MASK 0xFF /end MEASUREMENT
/begin MEASUREMENT wee "Winkel Einspritzende im Normalbetrieb" UBYTE zw_ub_q6 0 0 0.000000 1530.000000 /begin IF_DATA ASAP1B_ETK KP_BLOB 0x380B2A 1 1 /end IF_DATA BIT_MASK 0xFF /end MEASUREMENT
/begin MEASUREMENT wpedv_w "Normierter Fahrpedalwinkel vor BerÅcksichtigung der Begrenzungen im Notfahren" UWORD relPED_uw_b100 0 0 0.000000 100.000000 /begin IF_DATA ASAP1B_ETK KP_BLOB 0x381CAC 1 2 /end IF_DATA BIT_MASK 0xFFFF /end MEASUREMENT
/begin MEASUREMENT wpfgr_w "RÅckgerechneter Pedalwert bei FGR-Betrieb" UWORD rel_uw_b100 0 0 0.000000 99.998474 /begin IF_DATA ASAP1B_ETK KP_BLOB 0x381D9A 1 2 /end IF_DATA BIT_MASK 0xFFFF /end MEASUREMENT
/begin MEASUREMENT wpr "Einspritzberechnungs-Praediktions-Winkel" UBYTE zw_ub_q6 0 0 0.000000 1530.000000 /begin IF_DATA ASAP1B_ETK KP_BLOB 0x380B26 1 1 /end IF_DATA BIT_MASK 0xFF /end MEASUREMENT
/begin MEASUREMENT wprnsp "Einspritzberechnungs-Praediktions-Winkel bei Nachspritzer" UBYTE zw_ub_q6 0 0 0.000000 1530.000000 /begin IF_DATA ASAP1B_ETK KP_BLOB 0x380B27 1 1 /end IF_DATA BIT_MASK 0xFF /end MEASUREMENT
/begin MEASUREMENT zrph "ZÑhler Raster Phasensignal" UBYTE dez 0 0 0.000000 255.000000 /begin IF_DATA ASAP1B_ETK KP_BLOB 0x380A5D 1 1 /end IF_DATA BIT_MASK 0xFF /end MEASUREMENT
/begin MEASUREMENT Z_bm "Zyklusflag: Bezugsmarkengeber" UWORD B_TRUE___UW 0 0 0.000000 0.000000 /begin IF_DATA ASAP1B_ETK KP_BLOB 0x383AF6 1 2 /end IF_DATA BIT_MASK 0x2 /end MEASUREMENT
/begin MEASUREMENT Z_cadr "Zyklusflag: CAN-Schnittstelle, Timeout Botschaft ADR" UWORD B_TRUE___UW 0 0 0.000000 0.000000 /begin IF_DATA ASAP1B_ETK KP_BLOB 0x383AFC 1 2 /end IF_DATA BIT_MASK 0x2 /end MEASUREMENT
/begin MEASUREMENT Z_cas "Zyklusflag: CAN-Schnittstelle, Timeout ASC" UWORD B_TRUE___UW 0 0 0.000000 0.000000 /begin IF_DATA ASAP1B_ETK KP_BLOB 0x383AFE 1 2 /end IF_DATA BIT_MASK 0x2 /end MEASUREMENT
/begin MEASUREMENT Z_cat "Zyklusflag: CAN-Schnittstelle, Timeout Bremsbotschaft setzen" UWORD B_TRUE___UW 0 0 0.000000 0.000000 /begin IF_DATA ASAP1B_ETK KP_BLOB 0x383B00 1 2 /end IF_DATA BIT_MASK 0x2 /end MEASUREMENT
/begin MEASUREMENT Z_cge "Zyklusflag: CAN-Schnittstelle, Timeout EGS" UWORD B_TRUE___UW 0 0 0.000000 0.000000 /begin IF_DATA ASAP1B_ETK KP_BLOB 0x383B02 1 2 /end IF_DATA BIT_MASK 0x2 /end MEASUREMENT
/begin MEASUREMENT Z_cif "Zyklusflag: CAN-Schnittstelle, interner Fehler" UWORD B_TRUE___UW 0 0 0.000000 0.000000 /begin IF_DATA ASAP1B_ETK KP_BLOB 0x383B04 1 2 /end IF_DATA BIT_MASK 0x2 /end MEASUREMENT
/begin MEASUREMENT Z_cins "Zyklusflag: CAN-Schnittstelle, Timeout Instrument" UWORD B_TRUE___UW 0 0 0.000000 0.000000 /begin IF_DATA ASAP1B_ETK KP_BLOB 0x383B06 1 2 /end IF_DATA BIT_MASK 0x2 /end MEASUREMENT
/begin MEASUREMENT Z_clws "Zyklusflag: CAN-Schnittstelle, Timeout Botschaft Lenkwinkelsensor" UWORD B_TRUE___UW 0 0 0.000000 0.000000 /begin IF_DATA ASAP1B_ETK KP_BLOB 0x383B08 1 2 /end IF_DATA BIT_MASK 0x2 /end MEASUREMENT
/begin MEASUREMENT Z_dk "Zyklusflag:	DK - Potentiometer" UWORD B_TRUE___UW 0 0 0.000000 0.000000 /begin IF_DATA ASAP1B_ETK KP_BLOB 0x383B0A 1 2 /end IF_DATA BIT_MASK 0x2 /end MEASUREMENT
/begin MEASUREMENT Z_dk1p "Zyklusflag: Drosselklappe 1. Poti" UWORD B_TRUE___UW 0 0 0.000000 0.000000 /begin IF_DATA ASAP1B_ETK KP_BLOB 0x383B0C 1 2 /end IF_DATA BIT_MASK 0x2 /end MEASUREMENT
/begin MEASUREMENT Z_dk2p "Zyklusflag: Drosselklappe 2. Poti" UWORD B_TRUE___UW 0 0 0.000000 0.000000 /begin IF_DATA ASAP1B_ETK KP_BLOB 0x383B0E 1 2 /end IF_DATA BIT_MASK 0x2 /end MEASUREMENT
/begin MEASUREMENT Z_dvee "Zyklusflag: DV-E Endstufe" UWORD B_TRUE___UW 0 0 0.000000 0.000000 /begin IF_DATA ASAP1B_ETK KP_BLOB 0x383B1A 1 2 /end IF_DATA BIT_MASK 0x2 /end MEASUREMENT
/begin MEASUREMENT Z_dvef "Zyklusflag: DV-E Fehler bei FederprÅfung" UWORD B_TRUE___UW 0 0 0.000000 0.000000 /begin IF_DATA ASAP1B_ETK KP_BLOB 0x383B1C 1 2 /end IF_DATA BIT_MASK 0x2 /end MEASUREMENT
/begin MEASUREMENT Z_dvefo "Zyklusflag: DV-E-Fehler bei FederprÅfung 'ôffnen'" UWORD B_TRUE___UW 0 0 0.000000 0.000000 /begin IF_DATA ASAP1B_ETK KP_BLOB 0x383B1E 1 2 /end IF_DATA BIT_MASK 0x2 /end MEASUREMENT
/begin MEASUREMENT Z_dvel "Zyklusflag: DV-E Lageabweichung" UWORD B_TRUE___UW 0 0 0.000000 0.000000 /begin IF_DATA ASAP1B_ETK KP_BLOB 0x383B20 1 2 /end IF_DATA BIT_MASK 0x2 /end MEASUREMENT
/begin MEASUREMENT Z_dven "Zyklusflag: DV-E Fehler bei PrÅfung Notluftposition" UWORD B_TRUE___UW 0 0 0.000000 0.000000 /begin IF_DATA ASAP1B_ETK KP_BLOB 0x383B22 1 2 /end IF_DATA BIT_MASK 0x2 /end MEASUREMENT
/begin MEASUREMENT Z_dver "Zyklusflag: DV-E Regelbereich" UWORD B_TRUE___UW 0 0 0.000000 0.000000 /begin IF_DATA ASAP1B_ETK KP_BLOB 0x383B24 1 2 /end IF_DATA BIT_MASK 0x2 /end MEASUREMENT
/begin MEASUREMENT Z_dvet "Zyklusflag: DV-E-Tauscherkennung ohne Adaption" UWORD B_TRUE___UW 0 0 0.000000 0.000000 /begin IF_DATA ASAP1B_ETK KP_BLOB 0x383B26 1 2 /end IF_DATA BIT_MASK 0x2 /end MEASUREMENT
/begin MEASUREMENT Z_dveu "Zyklusflag: DV-E Fehler beim UMA-Lernen" UWORD B_TRUE___UW 0 0 0.000000 0.000000 /begin IF_DATA ASAP1B_ETK KP_BLOB 0x383B28 1 2 /end IF_DATA BIT_MASK 0x2 /end MEASUREMENT
/begin MEASUREMENT Z_dveub "Zyklusflag: DV-E-Adaption Abbruch wg. Umweltbedingung" UWORD B_TRUE___UW 0 0 0.000000 0.000000 /begin IF_DATA ASAP1B_ETK KP_BLOB 0x383B2A 1 2 /end IF_DATA BIT_MASK 0x2 /end MEASUREMENT
/begin MEASUREMENT Z_dveuw "Zyklusflag: Fehler bei UMA-Wiederlernen" UWORD B_TRUE___UW 0 0 0.000000 0.000000 /begin IF_DATA ASAP1B_ETK KP_BLOB 0x383B2C 1 2 /end IF_DATA BIT_MASK 0x2 /end MEASUREMENT
/begin MEASUREMENT Z_dvev "Zyklusflag: DV-E Fehler bei VerstÑrkerabgleich" UWORD B_TRUE___UW 0 0 0.000000 0.000000 /begin IF_DATA ASAP1B_ETK KP_BLOB 0x383B2E 1 2 /end IF_DATA BIT_MASK 0x2 /end MEASUREMENT
/begin MEASUREMENT Z_ev "Zyklusflag: Einspritzventil Endstufe" UWORD B_TRUE___UW 0 0 0.000000 0.000000 /begin IF_DATA ASAP1B_ETK KP_BLOB 0xFD54 0 2 /end IF_DATA BIT_MASK 0x800 /end MEASUREMENT
/begin MEASUREMENT Z_n "Zyklusflag: Drehzahlsignalgeber" UWORD B_TRUE___UW 0 0 0.000000 0.000000 /begin IF_DATA ASAP1B_ETK KP_BLOB 0x383BBA 1 2 /end IF_DATA BIT_MASK 0x2 /end MEASUREMENT
/begin FUNCTION BGRLG "1.10      Berechnete Grî·e RL-GRADIENT"
 /begin LOC_MEASUREMENT tsegrsp_w_5__A tsegrsp_w_4__A tsegrsp_w_3__A tsegrsp_w_2__A tsegrsp_w_1__A tsegrsp_w_0__A tas_w rl_w rlrsp_w_5__A rlrsp_w_4__A rlrsp_w_3__A rlrsp_w_2__A rlrsp_w_1__A rlrsp_w_0__A rlgas_w irspsyn drlas_w B_ngasok /end LOC_MEASUREMENT
/end FUNCTION
/begin FUNCTION BGRLP "9.10      Berechnungsgroesse rlp praedizierte LuftfÅllung"
 /begin REF_CHARACTERISTIC WPRMX TNSURLP PSPVDKUG KLAF KFMSNWDK FPVMXP DWPRNSP DWPR DTEPRU DRLRLPU DRLMIN DRLDYNU CBGRLP /end REF_CHARACTERISTIC
 /begin LOC_MEASUREMENT wprnsp wpr wee wea wdkugd_w wdksp_w wdkbap_w wdkbapb_w vwkw umsrln_w tvu_w te_w rl_w rlrohmp_w rlp_w rlpu_w rlpnb_w rlp rlmp_w rldvs_w rfagr_w pvdk_w ps_w psp_w pspvds_w pspmx_w psmp_w psmppvdk_w pirg_w nmot_w mste msnwdk_kge msndkpk_w msndko_w klaf_kge fwprs_w fvisrm_w fupsrl_w frhodk_w drl_w drlp_w dpsmp_w dpsfg_w dpsdvs_w B_ugdsp B_tired B_stend B_st B_rlpns B_rlp B_nswo2 B_nsp B_ll B_dknolu /end LOC_MEASUREMENT
/end FUNCTION
/begin FUNCTION BGRML "1.20      Berechnungsgrî·e relative Luftmasse nach SAE J1979 Mode $01 + $02 PID $04" /begin REF_CHARACTERISTIC MLMAX /end REF_CHARACTERISTIC /begin LOC_MEASUREMENT rml ml_w /end LOC_MEASUREMENT /end FUNCTION
/begin FUNCTION BGSRM "2.120     FÅllungserfassung Saugrohrmodell" /begin REF_CHARACTERISTIC ZVTPRGSU KISRM KFURL KFPRG FPVMXN2 /end REF_CHARACTERISTIC
 /begin LOC_MEASUREMENT wnwue umsrln_w rl_w rlroh_w rl rfges_w rfagr_w pvdkds_w pu_w ps_w psrlro_w psmx_w psfg_w psagr_w pirg_w pirgro_w nmot_w ml_w ml fvisrm_w fupsrl_w ftsr ftbr_w fho_w drl_w dpsfg_w B_hfm agrr_w agrr /end LOC_MEASUREMENT
/end FUNCTION
/begin FUNCTION BGTABST "7.10      Berechnete Grî·e Abstellzeit"
 /begin REF_CHARACTERISTIC ZKTABTU VTUMTA TVTUMTA TUMTAI TNLSGM NTUMTA LNXQTM IMTUMTA DTUMTA DTABUNPL /end REF_CHARACTERISTIC
 /begin LOC_MEASUREMENT xqtm_w vfzg tum_ein tumta tumg tmst tmotab tans tabst_w tabstm_w tabssc_w tabsnl_w tabsmn_w swOffDlBits nmot imlatm B_vbemg B_uhrrsec B_uhrrmin B_tfu B_tabunpl B_stend B_pwf B_pltab B_nmin B_nlwst B_nachlstp B_abstnlgp B_abstnlg B_abstnl BGTABSTbits /end LOC_MEASUREMENT
/end FUNCTION
/begin FUNCTION BGTEMPK "10.30     FÅllungserfassung Berechnung Temperaturkompensation"
 /begin REF_CHARACTERISTIC ZTMMBR ZTDAGR ZBRT KFFWTBR FWFTBRTA FDVANS EVTMODO DEVTMAGR CWTEMPK /end REF_CHARACTERISTIC
 /begin LOC_MEASUREMENT tsges_w tmotfil tmot tempin tans tags_w rl nmot ftw ftvdk ftu ftsr ftbr_w ftbr evtmod B_nmot agrr_w /end LOC_MEASUREMENT
/end FUNCTION
/begin FUNCTION BGTEV "2.40      Berechnungsgrî·e Massenstrom TEV" /begin REF_CHARACTERISTIC NOVZTE MSNTATE KLAFTE FUMRMV DPVLMS /end REF_CHARACTERISTIC
 /begin LOC_MEASUREMENT vregdia_w tevpervz tevpero3 tevpero2 tevpero1 tevper tatesoll tateslo3 tateslo2 tateslo1 tateist pvl_w pu_w ps_w phtevpu_w mste_w mstevl_w mstetev_w mstesg_w msteo_w mstehl_w mstedte_w mstedte mste msntevo_w msntetev_w msntate_kge mshfm_w ftvdk ftho_w fho_w fafte_w dpvl_w B_dteaa /end LOC_MEASUREMENT
/end FUNCTION
/begin FUNCTION BGWDKM "1.0       Berechnung Dk-Winkel Modell" /begin REF_CHARACTERISTIC ZWDKM2 ZWDKM1 /end REF_CHARACTERISTIC /begin LOC_MEASUREMENT wdksp_w wdkbap_w /end LOC_MEASUREMENT /end FUNCTION
/begin FUNCTION BGWPFGR "1.10      Berechnungsgrî·e rÅckgerechneter Pedalwert bei FGR" /begin REF_CHARACTERISTIC WPFGRBMR TFWPFGR KFWPFGR CWBGWPFGR /end REF_CHARACTERISTIC /begin LOC_MEASUREMENT wpfgr_w nmot_w mrfgr_w B_wiauf B_besch /end LOC_MEASUREMENT /end FUNCTION
/begin FUNCTION CAN "51.270    CAN-Signalliste"
 /begin REF_CHARACTERISTIC VMINAMSR T_SFSEN T_NOMLWS T_NOMKBI23 T_NOMKBI1 T_NOMEGS T_NOMBR3 T_NOMASRTA T_NOMASR T_NOMALL T_GEUEW TVCAMSR TMSRCNU TMSRCERR RAMPASR NOASR NMAXKBI MSRMDTMX MOTTYP MDNORM MDMAXKBI MDIMX KVNPZ KLDMASRL FMOTC DBZ_MX DBZ_MN CW_CAN_S_3___A CW_CAN_S_2___A CW_CAN_S_1___A CW_CAN_S_0___A CW_CAN_R_3___A CW_CAN_R_2___A CW_CAN_R_1___A CW_CAN_R_0___A CW_CAN_C CWMSRCAN CWGEEIN CWGC_3_A CWGC_2_A CWGC_1_A CWGC_0_A CSGRA CANVERS BUSOFFTIME BUSOFFCTR /end REF_CHARACTERISTIC
 /begin LOC_MEASUREMENT wpfgr_w wpedv_w wdkba vziel_w vrad_vr_w vrad_vl_w vrad_hr_w vrad_hl_w vfzgkb_w vfzg vamsr_w uefktget udkp2_w udkp1_w ub tum tolc tnst_w tmot tmkic tkvad tans S_fs S_brs S_bls statgra statadr nstat nmot_w nmot nllcvt1 msrmdt_w mrped_w mrfgr_w mrfa_w mracc_w mizwmn_w mivbeg_w misol_w mimsr_w mimsr_can mimsrlk mimin_w mimax_w miist_w migs_w miges_w mifa_w mifar_w mifab_w mibas_w miautgs_w miautget_w miasrs_w miasrs_can miasrslk miasrl_w miasrl_can miasrllk mdwancan mdverl_w mdgrad_w mdgbeg lws_w kvakbi_w kmstand_w km01tr gangauti fho fgnsol E_swe_b ei_mver_um ei_msrc_um cs_gra B_zges B_wkr B_wkauf B_wk B_wdk2sel B_tvgrac B_tveph B_tolcb B_tmkicb B_tippg B_tbgrac B_tbeph B_talkbi B_talcan B_swe_b B_stend B_statto B_statnb B_statme B_statmd B_statge B_statbr B_st B_savmsr B_savacc B_sacvt B_nuamsr B_nomsr_um B_nomsr_fr B_msr_can B_msrvnpl B_msrtnpl B_msrphnpl B_msrdis B_msrakt B_msr B_motaus B_milfb B_mil B_mgbget B_mdwaner B_md B_lwsok B_lwser B_ll B_kvakbi B_kuppl B_kov B_koe B_ko B_kl15 B_kd B_i_ska_fr B_gsch B_gsaf B_geuew B_ges B_gekoa B_fgr_um B_fgrwb B_fgrtwa B_fgrtve B_fgrtse B_fgrtbe B_fgrsv B_fgrhsa B_fgrhe B_fgren B_fgrat B_fgrabz B_fgr B_fabr B_epcl B_ectal B_dknolu B_cvtad B_ctout B_ckien B_br1en B_bkvvc B_bkvv B_bkva B_asr_can B_asresp B_asrakt B_asr B_amsrnbot B_amsrn B_amsrknpl B_amsrinpl B_amsrf B_acc bz_msr bz_gra bz_can /end LOC_MEASUREMENT
/end FUNCTION
/begin FUNCTION CAN_DST "" /end FUNCTION
/begin FUNCTION CRAM "" /begin LOC_MEASUREMENT vfzg2_w vfzctr devoff B_faevz bs /end LOC_MEASUREMENT /end FUNCTION
/begin FUNCTION D2CTR "2.20      Diagnose; Ereigniscounter fÅr SystemÅberwachung" /begin REF_CHARACTERISTIC DFPSLBIT /end REF_CHARACTERISTIC
 /begin LOC_MEASUREMENT ctrzyf1 ctrzyf0 ctrsfp ctrrdy1 ctrerf1 B_trip B_syserr bbd2ctr /end LOC_MEASUREMENT
/end FUNCTION
/begin FUNCTION DAAVE "11.40     Diagnose; PlausibiltÑtsprÅfung Absperrventil AktivkohlebehÑlter Endstufe" /begin LOC_MEASUREMENT B_dteaav B_desee B_aavz B_aava /end LOC_MEASUREMENT /end FUNCTION
/begin FUNCTION DCLA "2.50      OBDII; Klassentabelle"
 /begin REF_CHARACTERISTIC CL39LINE CL38LINE CL37LINE CL36LINE CL35LINE CL34LINE CL33LINE CL32LINE CL31LINE CL30LINE /end REF_CHARACTERISTIC
/end FUNCTION
/begin FUNCTION DDCY "15.10     OBDII; ErfÅllung Bedingung 'driving cycle'" /begin REF_CHARACTERISTIC TWBDCY /end REF_CHARACTERISTIC /begin LOC_MEASUREMENT dcycnt B_stend B_pwf B_dcy bbdcy /end LOC_MEASUREMENT /end FUNCTION
/begin FUNCTION DDG "9.30      Diagnose Drehzahlgeber" /begin REF_CHARACTERISTIC ZIDNOBM ZIDFBM PGFLWA BMFMX BMFA /end REF_CHARACTERISTIC /begin LOC_MEASUREMENT zrph B_nmin B_fbm bmLosCtr_w bmfz_w /end LOC_MEASUREMENT /end FUNCTION
/begin FUNCTION DDPL "9.10      Diagnose; PlausibilitÑtsprÅfung Dauerversorgung (OBDII)" /begin LOC_MEASUREMENT B_pwf /end LOC_MEASUREMENT /end FUNCTION
/begin FUNCTION DDVE "7.30      Diagnose: EGAS-Steller DV-E" /begin REF_CHARACTERISTIC TPNSE /end REF_CHARACTERISTIC
 /begin LOC_MEASUREMENT lrnstep_c fprstep_c dveadchst B_wdksive B_umauab B_umae B_stend B_pwf B_nlpnew B_nlperf B_nlpe B_lrnws B_lrnvb B_lrnrdy B_lrnerf B_lrnakt B_fprzvb B_fprze B_fprzab B_fprrdy B_fprovb B_fprordy B_fprook B_fproe B_fproab B_dveese B_dlrpide B_dlrbe B_dkp2np B_dkp2mx B_dkp2mn B_dkp2e B_dkp1np B_dkp1mx B_dkp1mn B_dkp1e B_dkaden B_abgle /end LOC_MEASUREMENT
/end FUNCTION
/begin FUNCTION DECJ "14.0      Diagnose; Endstufe CJ4x/9x" /begin LOC_MEASUREMENT ub nmot B_esdia B_desee /end LOC_MEASUREMENT /end FUNCTION
/begin FUNCTION DEGFE "2.10      Diagnose der Eingangsgrî·en FÅllungserfassung" /begin REF_CHARACTERISTIC TDEGFEST TDEGFENO TDEGFEMX TDEGFEMN CWDEGFE /end REF_CHARACTERISTIC /begin LOC_MEASUREMENT B_stend B_fkpvmx B_fkpvmn B_fkmsmx B_fkmsmn /end LOC_MEASUREMENT /end FUNCTION
/begin FUNCTION DEKON "Konfiguration der Endstufendiagnose" /begin REF_CHARACTERISTIC ESKONF /end REF_CHARACTERISTIC /end FUNCTION
/begin FUNCTION DEKPE "11.11     Diagnose; Elektrokraftstoffpumpe Endstufe" /begin LOC_MEASUREMENT B_desee /end LOC_MEASUREMENT /end FUNCTION
/begin FUNCTION DEPCL "1.20      Diagnose; Elektronik Powertrain Control Lampe" /begin REF_CHARACTERISTIC TEPCLI TEPCL /end REF_CHARACTERISTIC /begin LOC_MEASUREMENT dfpmEpclState B_nmot B_epcl /end LOC_MEASUREMENT /end FUNCTION
/begin FUNCTION DEPCLE "1.20      Diagnose EPCL-Endstufe" /begin LOC_MEASUREMENT B_epcl B_desee /end LOC_MEASUREMENT /end FUNCTION
/begin FUNCTION DEVE "6.40      Diagnose; Einspritzventil - Endstufe" /begin LOC_MEASUREMENT Z_ev evz_austot B_stend B_sa B_eev B_desee /end LOC_MEASUREMENT /end FUNCTION
/begin FUNCTION DFFT "1.60      Diagnose; Freeze Frame Auswahltabelle"
 /begin LOC_MEASUREMENT wped wdks wdkba vfzg_u usvk2 usvk ushk2 ushk upwg2_u upwg2d_u upwg1_u uhsv udkp2_u udkp1_u ub tumg tpsvkmf_u tmrw tmot_u tmotlin tmot tmew tkatm tfst tans tabgm skapfad rstpfad rml rl rinv_u rinh_u pu nmot mpfad ml mi_um mi_duf mizuvfil gangi fr_u fra_u fra2_u fr2_u flglrs egaspfad /end LOC_MEASUREMENT
/end FUNCTION
/begin FUNCTION DFFTCNV "3.30      Diagnose; Freeze Frame Tabelle, Konvertierung zu Bytes" /begin REF_CHARACTERISTIC NMAX /end REF_CHARACTERISTIC
 /begin LOC_MEASUREMENT vfzg_u vfzg upwg2_w upwg2_u upwg2d_w upwg2d_u upwg1_w upwg1_u udkp2_w udkp2_u udkp1_w udkp1_u tpsvkmf_w tpsvkmf_u tpsvkmf2_w tpsvkmf2_u tmot_u tmotlin rl_w rl_u rlugd_w rinv_w rinv_u rinv2_w rinv2_u rinh_w rinh_u rinh2_u nmot_w fr_w fr_u fra_w fra_u fra2_u fr2_w fr2_u /end LOC_MEASUREMENT
/end FUNCTION
/begin FUNCTION DFFTK "1.10      Diagnose; Kundenspezifische Auswahlliste fÅr Freeze Frame-Werte" /begin LOC_MEASUREMENT tmot nmot /end LOC_MEASUREMENT /end FUNCTION
/begin FUNCTION DFPM "3.10      OBDII; Fehlerpfadmanager"
 /begin LOC_MEASUREMENT vfzg usvk ushk top_w tmotlin tmot tans skapfad rstpfad nmot mpfad mi_duf FCMTab fcmEnd egaspfad dfp_ap dfpmMilState dfpmEpclState dfcmSfp dfcmNo dfcmFcm B_tim B_sp3 B_pwf B_no bbwuc bbtim bbsp3 bbno /end LOC_MEASUREMENT
/end FUNCTION
/begin FUNCTION DFPMEEP "8.10      Diagnose; Fehlerpfadmanager, EEPROM-Speicherung" /begin LOC_MEASUREMENT FCMTab fcmEnd dfcmNo B_pwf /end LOC_MEASUREMENT /end FUNCTION
/begin FUNCTION DFPMPWF "1.10      Diagnose Fehlerpfadmanagement; Erkennung Powerfail" /begin LOC_MEASUREMENT fcmEnd /end LOC_MEASUREMENT /end FUNCTION
/begin FUNCTION DFPM_ADCOD "" /end FUNCTION
/begin FUNCTION DFPM_CADR "" /begin REF_CHARACTERISTIC TSFCADR FFTCADR CLACADR CDTCADR CDKCADR CDCCADR /end REF_CHARACTERISTIC
 /begin LOC_MEASUREMENT Z_cadr TYP_cadr sfpcadr E_cadr B_sicadr B_sccadr B_pycadr B_npcadr B_mxcadr B_mncadr B_ftcadr B_clcadr B_bkcadr B_becadr B_avcadr /end LOC_MEASUREMENT
/end FUNCTION
/begin FUNCTION DFPM_CAS "" /begin REF_CHARACTERISTIC TSFCAS FFTCAS CLACAS CDTCAS CDKCAS CDCCAS /end REF_CHARACTERISTIC
 /begin LOC_MEASUREMENT Z_cas TYP_cas sfpcas E_cas B_sicas B_sccas B_pycas B_npcas B_mxcas B_mncas B_ftcas B_clcas B_bkcas B_becas B_avcas /end LOC_MEASUREMENT
/end FUNCTION
/begin FUNCTION DFPM_CAT "" /begin REF_CHARACTERISTIC TSFCAT FFTCAT CLACAT CDTCAT CDKCAT CDCCAT /end REF_CHARACTERISTIC
 /begin LOC_MEASUREMENT Z_cat TYP_cat sfpcat E_cat B_sicat B_sccat B_pycat B_npcat B_mxcat B_mncat B_ftcat B_clcat B_bkcat B_becat B_avcat /end LOC_MEASUREMENT
/end FUNCTION
/begin FUNCTION DFPM_CGE "" /begin REF_CHARACTERISTIC TSFCGE FFTCGE CLACGE CDTCGE CDKCGE CDCCGE /end REF_CHARACTERISTIC
 /begin LOC_MEASUREMENT Z_cge TYP_cge sfpcge E_cge B_sicge B_sccge B_pycge B_npcge B_mxcge B_mncge B_ftcge B_clcge B_bkcge B_becge B_avcge /end LOC_MEASUREMENT
/end FUNCTION
/begin FUNCTION DFPM_CIF "" /begin REF_CHARACTERISTIC TSFCIF FFTCIF CLACIF CDTCIF CDKCIF CDCCIF /end REF_CHARACTERISTIC
 /begin LOC_MEASUREMENT Z_cif TYP_cif sfpcif E_cif B_sicif B_sccif B_pycif B_npcif B_mxcif B_mncif B_ftcif B_clcif B_bkcif B_becif B_avcif /end LOC_MEASUREMENT
/end FUNCTION
/begin FUNCTION DFPM_CINS "" /begin REF_CHARACTERISTIC TSFCINS FFTCINS CLACINS CDTCINS CDKCINS CDCCINS /end REF_CHARACTERISTIC
 /begin LOC_MEASUREMENT Z_cins TYP_cins sfpcins E_cins B_sicins B_sccins B_pycins B_npcins B_mxcins B_mncins B_ftcins B_clcins B_bkcins B_becins B_avcins /end LOC_MEASUREMENT
/end FUNCTION
/begin FUNCTION DFPM_CLWS "" /begin REF_CHARACTERISTIC TSFCLWS FFTCLWS CLACLWS CDTCLWS CDKCLWS CDCCLWS /end REF_CHARACTERISTIC
 /begin LOC_MEASUREMENT Z_clws TYP_clws sfpclws E_clws B_siclws B_scclws B_pyclws B_npclws B_mxclws B_mnclws B_ftclws B_clclws B_bkclws B_beclws B_avclws /end LOC_MEASUREMENT
/end FUNCTION
/begin FUNCTION DFPM_DDG ""
 /begin REF_CHARACTERISTIC TSFN TSFBM FFTN FFTBM CLAN CLABM CDTN CDTBM CDKN CDKBM CDCN CDCBM /end REF_CHARACTERISTIC
 /begin LOC_MEASUREMENT Z_n Z_bm TYP_n TYP_bm sfpn sfpbm E_n E_bm B_sin B_sibm B_npn B_npbm B_mxn B_mxbm B_mnn B_mnbm B_ftn B_ftbm B_cln B_clbm B_bkn B_bkbm B_ben B_bebm /end LOC_MEASUREMENT
/end FUNCTION
/begin FUNCTION DFPM_DDVE ""
 /begin REF_CHARACTERISTIC TSFDVEV TSFDVEUW TSFDVEUB TSFDVEU TSFDVET TSFDVER TSFDVEN TSFDVEL TSFDVEFO TSFDVEF TSFDVEE TSFDK2P TSFDK1P TSFDK FFTDVEV FFTDVEUW FFTDVEUB FFTDVEU FFTDVET FFTDVER FFTDVEN FFTDVEL FFTDVEFO FFTDVEF FFTDVEE FFTDK2P FFTDK1P FFTDK CLADVEV CLADVEUW CLADVEUB CLADVEU CLADVET CLADVER CLADVEN CLADVEL CLADVEFO CLADVEF CLADVEE CLADK2P CLADK1P CLADK CDTDVEV CDTDVEUW CDTDVEUB CDTDVEU CDTDVET CDTDVER CDTDVEN CDTDVEL CDTDVEFO CDTDVEF CDTDVEE CDTDK2P CDTDK1P CDTDK CDKDVEV CDKDVEUW CDKDVEUB CDKDVEU CDKDVET CDKDVER CDKDVEN CDKDVEL CDKDVEFO CDKDVEF CDKDVEE CDKDK2P CDKDK1P CDKDK CDCDVEV CDCDVEUW CDCDVEUB CDCDVEU CDCDVET CDCDVER CDCDVEN CDCDVEL CDCDVEFO CDCDVEF CDCDVEE CDCDK2P CDCDK1P CDCDK /end REF_CHARACTERISTIC
 /begin LOC_MEASUREMENT Z_dvev Z_dveuw Z_dveub Z_dveu Z_dvet Z_dver Z_dven Z_dvel Z_dvefo Z_dvef Z_dvee Z_dk2p Z_dk1p Z_dk TYP_dvev TYP_dveuw TYP_dveub TYP_dveu TYP_dvet TYP_dver TYP_dven TYP_dvel TYP_dvefo TYP_dvef TYP_dvee TYP_dk2p TYP_dk1p TYP_dk sfpdvev sfpdveuw sfpdveub sfpdveu sfpdvet sfpdver sfpdven sfpdvel sfpdvefo sfpdvef sfpdvee sfpdk2p sfpdk1p sfpdk E_dvev E_dveuw E_dveub E_dveu E_dvet E_dver E_dven E_dvel E_dvefo E_dvef E_dvee E_dk2p E_dk1p E_dk B_sidvev B_sidveuw B_sidveub B_sidveu B_sidvet B_sidver B_sidven B_sidvel B_sidvefo B_sidvef B_sidvee B_sidk2p B_sidk1p B_sidk B_npdvev B_npdveuw B_npdveub B_npdveu B_npdvet B_npdver B_npdven B_npdvel B_npdvefo B_npdvef B_npdvee B_npdk2p B_npdk1p B_npdk B_mxdvev B_mxdveuw B_mxdveub B_mxdveu B_mxdvet B_mxdver B_mxdven B_mxdvel B_mxdvefo B_mxdvef B_mxdvee B_mxdk2p B_mxdk1p B_mxdk B_mndvev B_mndveuw B_mndveub B_mndveu B_mndvet B_mndver B_mndven B_mndvel B_mndvefo B_mndvef B_mndvee B_mndk2p B_mndk1p B_mndk B_ftdvev B_ftdveuw B_ftdveub B_ftdveu B_ftdvet B_ftdver B_ftdven B_ftdvel B_ftdvefo B_ftdvef B_ftdvee B_ftdk2p B_ftdk1p B_ftdk B_cldvev B_cldveuw B_cldveub B_cldveu B_cldvet B_cldver B_cldven B_cldvel B_cldvefo B_cldvef B_cldvee B_cldk2p B_cldk1p B_cldk B_bkdvev B_bkdveuw B_bkdveub B_bkdveu B_bkdvet B_bkdver B_bkdven B_bkdvel B_bkdvefo B_bkdvef B_bkdvee B_bkdk2p B_bkdk1p B_bkdk B_bedvev B_bedveuw B_bedveub B_bedveu B_bedvet B_bedver B_bedven B_bedvel B_bedvefo B_bedvef B_bedvee B_bedk2p B_bedk1p B_bedk /end LOC_MEASUREMENT
/end FUNCTION
/end MODULE
/end PROJECT
