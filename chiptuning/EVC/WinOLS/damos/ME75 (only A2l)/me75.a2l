ASAP2_VERSION 1 21
/begin PROJECT Pro4017 "R4 1.8l 5V T lÑngs FR5ROM F5051"
/begin HEADER "" PROJECT_NO Pro4017 VERSION "PrV = F21dc mit 00" /end HEADER
/begin MODULE DIM " "
/begin MOD_COMMON " " S_REC_LAYOUT ME7 BYTE_ORDER MSB_LAST /end MOD_COMMON
/begin RECORD_LAYOUT ME7_FW4 FNC_VALUES 1 SWORD COLUMN_DIR DIRECT /end RECORD_LAYOUT
/begin RECORD_LAYOUT ME7_FW1 FNC_VALUES 1 UBYTE COLUMN_DIR DIRECT /end RECORD_LAYOUT
/begin RECORD_LAYOUT ME7_FW3 FNC_VALUES 1 UWORD COLUMN_DIR DIRECT /end RECORD_LAYOUT
/begin RECORD_LAYOUT ME7_GKL1 FNC_VALUES 1 UBYTE COLUMN_DIR DIRECT /end RECORD_LAYOUT
/begin RECORD_LAYOUT ME7_FWB1 FNC_VALUES 1 UBYTE COLUMN_DIR DIRECT /end RECORD_LAYOUT
/begin RECORD_LAYOUT ME7_GKL3 FNC_VALUES 1 UWORD COLUMN_DIR DIRECT /end RECORD_LAYOUT
/begin RECORD_LAYOUT ME7_KL98 NO_AXIS_PTS_X 1 UBYTE AXIS_PTS_X 2 UBYTE INDEX_INCR DIRECT FNC_VALUES 3 SBYTE COLUMN_DIR DIRECT /end RECORD_LAYOUT
/begin RECORD_LAYOUT ME7_FW2 FNC_VALUES 1 SBYTE COLUMN_DIR DIRECT /end RECORD_LAYOUT
/begin RECORD_LAYOUT ZF_KL111 NO_AXIS_PTS_X 1 UWORD AXIS_PTS_X 2 UWORD INDEX_INCR DIRECT FNC_VALUES 3 UWORD ROW_DIR DIRECT /end RECORD_LAYOUT
/begin RECORD_LAYOUT ME7_KL97 NO_AXIS_PTS_X 1 UBYTE AXIS_PTS_X 2 UBYTE INDEX_INCR DIRECT FNC_VALUES 3 UBYTE COLUMN_DIR DIRECT /end RECORD_LAYOUT
/begin RECORD_LAYOUT ME7_FWB3 FNC_VALUES 1 UWORD COLUMN_DIR DIRECT /end RECORD_LAYOUT
/begin RECORD_LAYOUT ME7_GKL2 FNC_VALUES 1 SBYTE COLUMN_DIR DIRECT /end RECORD_LAYOUT
/begin RECORD_LAYOUT ME7_KL99 NO_AXIS_PTS_X 1 UBYTE AXIS_PTS_X 2 UBYTE INDEX_INCR DIRECT FNC_VALUES 3 UWORD COLUMN_DIR DIRECT /end RECORD_LAYOUT
/begin RECORD_LAYOUT ME7_KL103 NO_AXIS_PTS_X 1 UBYTE AXIS_PTS_X 2 SBYTE INDEX_INCR DIRECT FNC_VALUES 3 UBYTE COLUMN_DIR DIRECT /end RECORD_LAYOUT
/begin RECORD_LAYOUT ME7_FKL1 FNC_VALUES 1 UBYTE COLUMN_DIR DIRECT /end RECORD_LAYOUT
/begin RECORD_LAYOUT ME7_SST97 NO_AXIS_PTS_X 1 UBYTE AXIS_PTS_X 2 UBYTE INDEX_INCR DIRECT /end RECORD_LAYOUT
/begin RECORD_LAYOUT ME7_GKF1 FNC_VALUES 1 UBYTE COLUMN_DIR DIRECT /end RECORD_LAYOUT
/begin RECORD_LAYOUT ME7_GKL4 FNC_VALUES 1 SWORD COLUMN_DIR DIRECT /end RECORD_LAYOUT
/begin RECORD_LAYOUT ME7_FKL3 FNC_VALUES 1 UWORD COLUMN_DIR DIRECT /end RECORD_LAYOUT
/begin CHARACTERISTIC LIMXDNS "Obere Integratorbegrenzung bei stehendem Fahrzeug" CURVE 0x81986D ME7_GKL1 0 rel_ub_b24p9 0.000000 24.900000
 /begin AXIS_DESCR COM_AXIS dns nmotd_sb_q10 0 -1280.000000 1270.000000 AXIS_PTS_REF SNS206LLSB /end AXIS_DESCR
/end CHARACTERISTIC
/begin CHARACTERISTIC LIMXVDNS "Obere Integratorbegrenzung bei rollendem Fahrzeug" CURVE 0x819873 ME7_GKL1 0 rel_ub_b24p9 0.000000 24.900000
 /begin AXIS_DESCR COM_AXIS dns nmotd_sb_q10 0 -1280.000000 1270.000000 AXIS_PTS_REF SNS206LLSB /end AXIS_DESCR
/end CHARACTERISTIC
/begin CHARACTERISTIC LISTM "Wert des Leerlaufintegrators im Start" CURVE 0x819879 ME7_GKL1 0 rel_ub_b24p9 0.000000 24.900000
 /begin AXIS_DESCR COM_AXIS tmot temp_ub_q0p75_o48 0 -48.000000 143.250000 AXIS_PTS_REF STM06LLUB /end AXIS_DESCR
/end CHARACTERISTIC
/begin CHARACTERISTIC LKRAN "Lastschwelle Klopfregel-Adaption" CURVE 0x8193F9 ME7_GKL1 0 rel_ub_q0p75 0.000000 191.250000
 /begin AXIS_DESCR COM_AXIS nmot nmot_ub_q40 0 0.000000 10200.000000 AXIS_PTS_REF SNM16KRUB /end AXIS_DESCR
/end CHARACTERISTIC
/begin CHARACTERISTIC LKRN "Lastschwelle Klopfregelung" CURVE 0x819409 ME7_GKL1 0 rel_ub_q0p75 0.000000 191.250000
 /begin AXIS_DESCR COM_AXIS nmot nmot_ub_q40 0 0.000000 10200.000000 AXIS_PTS_REF SNM16KRUB /end AXIS_DESCR
/end CHARACTERISTIC
/begin CHARACTERISTIC LLRICNF "Configurationsbyte fÅr LLR Integrator" VALUE 0x8156B0 ME7_FW1 0 dez 0.000000 255.000000 /end CHARACTERISTIC
/begin CHARACTERISTIC LMSTMOT "Motortemp.-Korrektur von Lambda-Motor-Soll" CURVE 0x819158 ME7_KL97 0 fak_ub_b2 0.000000 1.992190
 /begin AXIS_DESCR STD_AXIS tmot temp_ub_q0p75_o48 4 -48.000000 143.250000 DEPOSIT ABSOLUTE /end AXIS_DESCR
 EXTENDED_LIMITS 0.000000 1.992188 /end CHARACTERISTIC
/begin CHARACTERISTIC LNXQTM "NatÅrlicher Logarithmus aus Temperaturquotient" CURVE 0x81B9A4 ZF_KL111 0 fak_uw_b4 0.000000 3.999940
 /begin AXIS_DESCR STD_AXIS xqtm_w fak_uw_b16 12 0.000000 15.999800 DEPOSIT ABSOLUTE /end AXIS_DESCR
 EXTENDED_LIMITS 0.000000 3.999939 /end CHARACTERISTIC
/begin CHARACTERISTIC LRNST1_T "Wartezeit in Lernschritt 1" VALUE 0x814EBE ME7_FW1 0 t20msxs_ub_b5p1 0.020000 5.100000 EXTENDED_LIMITS 0.000000 5.100000 /end CHARACTERISTIC
/begin CHARACTERISTIC LRNST3_T "Wartezeit in Lernschritt 3" VALUE 0x814EBF ME7_FW1 0 t20msxs_ub_b5p1 0.020000 5.100000 EXTENDED_LIMITS 0.000000 5.100000 /end CHARACTERISTIC
/begin CHARACTERISTIC LRNST7_T "Wartezeit in Lernschritt 7" VALUE 0x814EC0 ME7_FW1 0 t20msxs_ub_b5p1 0.020000 5.100000 EXTENDED_LIMITS 0.000000 5.100000 /end CHARACTERISTIC
/begin CHARACTERISTIC LRNST9_T "Wartezeit in Lernschritt 9" VALUE 0x814EC1 ME7_FW1 0 t20msxs_ub_b5p1 0.020000 5.100000 EXTENDED_LIMITS 0.000000 5.100000 /end CHARACTERISTIC
/begin CHARACTERISTIC LRNVB_T "Lernverbotszeit fÅr 'normales Lernen'" VALUE 0x810C5C ME7_FW3 0 t20msxs_uw_q0p02 0.000000 1310.700000 /end CHARACTERISTIC
/begin CHARACTERISTIC LURBRL "Laufunruhe-Referenzwert bei Fahrzeug steht" CURVE 0x814A97 ME7_GKL2 0 luquant -80.844000 80.212400
 /begin AXIS_DESCR COM_AXIS rl rel_ub_q0p75 0 0.000000 191.250000 AXIS_PTS_REF SRL08DMUB /end AXIS_DESCR
 EXTENDED_LIMITS -80.843807 80.212215 /end CHARACTERISTIC
/begin CHARACTERISTIC LURFOST "Laufruhe-Referenzwert fÅr stop fuel-on Adaption, Vergleich mit lunw" VALUE 0x81453D ME7_FW1 0 luquant___UB 0.000000 161.056000 EXTENDED_LIMITS 0.000000 161.056022 /end CHARACTERISTIC
/begin CHARACTERISTIC LURKTM "Tmot-abhÑngiger Laufunruhe-Referenz-Korrekturwert" CURVE 0x814A9F ME7_GKL2 0 luquant -80.844000 80.212400
 /begin AXIS_DESCR COM_AXIS tmot temp_ub_q0p75_o48 0 -48.000000 143.250000 AXIS_PTS_REF STM08DMUB /end AXIS_DESCR
 EXTENDED_LIMITS -80.843807 80.212215 /end CHARACTERISTIC
/begin CHARACTERISTIC LURMIN1 "Drehzahlabh. Laufunruhe-Referenz-Minimalwert 1" CURVE 0x814AA7 ME7_GKL2 0 luquant -80.844000 80.212400
 /begin AXIS_DESCR COM_AXIS nmot nmot_ub_q40 0 0.000000 10200.000000 AXIS_PTS_REF SNM08DMUB /end AXIS_DESCR
 EXTENDED_LIMITS -80.843807 80.212215 /end CHARACTERISTIC
/begin CHARACTERISTIC LURMIN2 "Drehzahlabh. Laufunruhe-Referenz-Minimalwert 2" CURVE 0x814AAF ME7_GKL2 0 luquant -80.844000 80.212400
 /begin AXIS_DESCR COM_AXIS nmot nmot_ub_q40 0 0.000000 10200.000000 AXIS_PTS_REF SNM08DMUB /end AXIS_DESCR
 EXTENDED_LIMITS -80.843807 80.212215 /end CHARACTERISTIC
/begin CHARACTERISTIC LURMIN3 "Drehzahlabh. Laufunruhe-Referenz-Minimalwert 3" CURVE 0x814AB7 ME7_GKL2 0 luquant -80.844000 80.212400
 /begin AXIS_DESCR COM_AXIS nmot nmot_ub_q40 0 0.000000 10200.000000 AXIS_PTS_REF SNM08DMUB /end AXIS_DESCR
 EXTENDED_LIMITS -80.843807 80.212215 /end CHARACTERISTIC
/begin CHARACTERISTIC LWSER "Lenkilfelastmoment bei fehlerhaftem Lenkwinkelsensor" VALUE 0x8156DD ME7_FW1 0 rel_ub_b49p725 0.000000 49.725000 /end CHARACTERISTIC
/begin CHARACTERISTIC LZB1 "Leitzylinderzuordnung: Bank1 fÅhrt Bank2 bei Fehler KS 2" VAL_BLK 0x815414 ME7_FWB1 0 dez 0.000000 255.000000 NUMBER 8 /end CHARACTERISTIC
/begin CHARACTERISTIC LZB2 "Leitzylinderzuordnung: Bank2 fÅhrt Bank1 bei Fehler KS 1" VAL_BLK 0x81541C ME7_FWB1 0 dez 0.000000 255.000000 NUMBER 8 /end CHARACTERISTIC
/begin CHARACTERISTIC LZFUER "Festwerteblock: Leitzylinderzuordnung" VAL_BLK 0x815424 ME7_FWB1 0 dez 0.000000 255.000000 NUMBER 8 /end CHARACTERISTIC
/begin CHARACTERISTIC MDATNM "Drehmomentaufnahme AT-Getriebe in Fahrstufe N/P" CURVE 0x81CBCC ME7_GKL4 0 rel_sw_b100 0.000000 99.996900
 /begin AXIS_DESCR COM_AXIS tmot temp_ub_q0p75_o48 0 -48.000000 143.250000 AXIS_PTS_REF STM08MDUB /end AXIS_DESCR
 EXTENDED_LIMITS -100.000000 99.996948 /end CHARACTERISTIC
/begin CHARACTERISTIC MDATRM "Drehmomentanteil (Pumpenanteil) AT-Getriebe in Fahrstufe R" CURVE 0x81CBDC ME7_GKL4 0 rel_sw_b100 0.000000 99.996900
 /begin AXIS_DESCR COM_AXIS tmot temp_ub_q0p75_o48 0 -48.000000 143.250000 AXIS_PTS_REF STM08MDUB /end AXIS_DESCR
 EXTENDED_LIMITS -100.000000 99.996948 /end CHARACTERISTIC
/begin CHARACTERISTIC MDERKFON "Anzahl Aussetzer fÅr Adaptionsstop (Heilung)" VALUE 0x81018E ME7_FW3 0 dez___UW 0.000000 65535.000000 /end CHARACTERISTIC
/begin CHARACTERISTIC MDHYEZ "Momenten-Hysterese bei Entscheidung der Zylinderausblendung" VALUE 0x815985 ME7_FW1 0 rel_ub_b99p6 0.000000 99.609400 EXTENDED_LIMITS 0.000000 99.609375 /end CHARACTERISTIC
/begin CHARACTERISTIC MDHYST "Hysterese bei der Begrenzung des Sollmoments (Ebene 1 öberwachungskonzept)" VALUE 0x8132B8 ME7_FW3 0 rel_uw_b100 0.000000 99.998500 EXTENDED_LIMITS 0.000000 99.998474 /end CHARACTERISTIC
/begin CHARACTERISTIC MDIMX "Maximal erreichbares indiziertes Motormoment" VALUE 0x815973 ME7_FW1 0 rel_ub_b99p6 0.000000 99.609400 EXTENDED_LIMITS 0.000000 99.609375 /end CHARACTERISTIC
/begin CHARACTERISTIC MDIMX_UM "Maximal erreichbares indiziertes Motormoment fÅr die FunktionsÅberwachung" VALUE 0x814002 ME7_FW1 0 rel_ub_q0p3906___UB 0.000000 99.609400 EXTENDED_LIMITS 0.000000 99.609375 /end CHARACTERISTIC
/begin CHARACTERISTIC MDKOAB "Drehmomentschwelle um den Kompressor in Beschleunigung abzuschalten" CURVE 0x816479 ME7_GKL1 0 rel_ub_b200 0.000000 199.219000
 /begin AXIS_DESCR COM_AXIS nmot nmot_ub_q40 0 0.000000 10200.000000 AXIS_PTS_REF SNM08KOUB /end AXIS_DESCR
 EXTENDED_LIMITS 0.000000 199.218750 /end CHARACTERISTIC
/begin CHARACTERISTIC MDKOAN "Drehmomentschwelle um den Klimakompressor abzuschalten" CURVE 0x816481 ME7_GKL1 0 rel_ub_b200 0.000000 199.219000
 /begin AXIS_DESCR COM_AXIS nmot nmot_ub_q40 0 0.000000 10200.000000 AXIS_PTS_REF SNM08KOUB /end AXIS_DESCR
 EXTENDED_LIMITS 0.000000 199.218750 /end CHARACTERISTIC
/begin CHARACTERISTIC MDKOEN "Drehmomentschwelle um den Klimakompressor einzuschalten" CURVE 0x816489 ME7_GKL1 0 rel_ub_b200 0.000000 199.219000
 /begin AXIS_DESCR COM_AXIS nmot nmot_ub_q40 0 0.000000 10200.000000 AXIS_PTS_REF SNM08KOUB /end AXIS_DESCR
 EXTENDED_LIMITS 0.000000 199.218750 /end CHARACTERISTIC
/begin CHARACTERISTIC MDMAXKBI "maximales Drehmoment fÅr Ausgabe an Kombi" VALUE 0x8144EB ME7_FW1 0 md_ub_q10 0.000000 2550.000000 /end CHARACTERISTIC
/begin CHARACTERISTIC MDNORM "Maximales indiziertes Motormoment fÅr Moment-Normierung" VALUE 0x8144EC ME7_FW1 0 md_ub_q10 0.000000 2550.000000 /end CHARACTERISTIC
/begin CHARACTERISTIC MDR_AOG "oberer Grenzwert Anpassung Momentenreserve Leerlaufregelung" VALUE 0x815458 ME7_FW1 0 rel_ub_b25 0.000000 24.902300 EXTENDED_LIMITS 0.000000 24.902344 /end CHARACTERISTIC
/begin CHARACTERISTIC MDR_AUG "unterer Grenzwert Anpassung Momentenreserve Leerlaufregelung" VALUE 0x815459 ME7_FW1 0 rel_ub_b25 0.000000 24.902300 EXTENDED_LIMITS 0.000000 24.902344 /end CHARACTERISTIC
/begin CHARACTERISTIC MDSH "HîhenabhÑngiger Anteil des Schleppmomentes" CURVE 0x81CBFA ME7_KL98 0 rel_q0p1957___SB -25.048900 24.853200
 /begin AXIS_DESCR STD_AXIS fho fak_ub_b4 6 0.000000 3.984380 DEPOSIT ABSOLUTE /end AXIS_DESCR
 EXTENDED_LIMITS -25.048924 24.853229 /end CHARACTERISTIC
/begin CHARACTERISTIC MDSL "Momentenanforderung der Servolenkung" VALUE 0x8156DE ME7_FW1 0 rel_ub_b49p725 0.000000 49.725000 /end CHARACTERISTIC
/begin CHARACTERISTIC MDSLP "Moment zur Kompensation der SekundÑrluftpumpe (stat.)" VALUE 0x8156DF ME7_FW1 0 rel_ub_b49p725 0.000000 49.725000 /end CHARACTERISTIC
/begin CHARACTERISTIC MDSLPE "Moment zur Kompensation der SekundÑrluftpumpe (Einschalten)" VALUE 0x8156E0 ME7_FW1 0 rel_ub_b49p725 0.000000 49.725000 /end CHARACTERISTIC
/begin CHARACTERISTIC MDSM "Schleppmoment Temperaturanteil" CURVE 0x81CC08 ME7_KL99 0 rel_uw_b100 0.000000 99.998500
 /begin AXIS_DESCR STD_AXIS tmot temp_ub_q0p75_o48 10 -48.000000 143.250000 DEPOSIT ABSOLUTE /end AXIS_DESCR
 EXTENDED_LIMITS 0.000000 99.998474 /end CHARACTERISTIC
/begin CHARACTERISTIC MDST "Startmoment" CURVE 0x812A66 ME7_KL98 0 rel_sb_q0p78 -99.840000 99.060000
 /begin AXIS_DESCR STD_AXIS qnst fak_ub_b2 8 0.000000 1.992190 DEPOSIT ABSOLUTE /end AXIS_DESCR
/end CHARACTERISTIC
/begin CHARACTERISTIC MDWANER "Ersatzwert fur mdwan_w bei Fehler" VALUE 0x8155C6 ME7_FW1 0 rel_ub_b99p6 0.000000 99.609400 EXTENDED_LIMITS 0.000000 99.609375 /end CHARACTERISTIC
/begin CHARACTERISTIC MIFABGMX "Maximalwert mifa_w fÅr MomentenÑnderungsbegrenzung" VALUE 0x813274 ME7_FW3 0 rel_uw_b100 0.000000 99.998500 EXTENDED_LIMITS 0.000000 99.998474 /end CHARACTERISTIC
/begin CHARACTERISTIC MIFA_DAT_UC "" VAL_BLK 0x815AFA ME7_FWB1 0 rel_ub_q0p3906___UB 0.000000 99.609400 NUMBER 16 EXTENDED_LIMITS 0.000000 99.609375 /end CHARACTERISTIC
/begin CHARACTERISTIC MILANTI "MIL ist bei ti-Abschaltung an, auch im 1.dcy" VALUE 0x814AF7 ME7_FW1 0 dez 0.000000 1.000000 EXTENDED_LIMITS 0.000000 255.000000 /end CHARACTERISTIC
/begin CHARACTERISTIC MILSOL_DAT_UC "" VAL_BLK 0x815B0A ME7_FWB1 0 rel_ub_q0p3906___UB 0.000000 99.609400 NUMBER 16 EXTENDED_LIMITS 0.000000 99.609375 /end CHARACTERISTIC
/begin CHARACTERISTIC MKFADPN "Kupplungsmoment fÅr Umschaltung Dashpot-Filterzeit" CURVE 0x819955 ME7_GKL2 0 rel_sb_b100 -100.000000 99.218800
 /begin AXIS_DESCR COM_AXIS nmot_w nmot_uw_q0p25 0 0.000000 16383.800000 AXIS_PTS_REF SNM06MDUW /end AXIS_DESCR
 EXTENDED_LIMITS -100.000000 99.218750 /end CHARACTERISTIC
/begin CHARACTERISTIC MKMIFABG "Kupplungsmoment fÅr Aktivierung der MomentenÑnderungsbegrenzung" VALUE 0x813276 ME7_FW4 0 rel_sw_b100 -100.000000 99.996900 EXTENDED_LIMITS -100.000000 99.996948 /end CHARACTERISTIC
/begin CHARACTERISTIC MLDKVSF "Luftmassenschwelle fÅr Fehlerfreigabe im DKVS (Tank leer)" VALUE 0x81BA10 ME7_FW3 0 m_q0p00355 0.000000 233.013000 EXTENDED_LIMITS 0.000000 233.013333 /end CHARACTERISTIC
/begin CHARACTERISTIC MLDKVSG "Luftmassenschwelle fÅr Fehlerfreigabe Tank leer" VALUE 0x81BA12 ME7_FW3 0 m_q0p00355 0.000000 233.013000 EXTENDED_LIMITS 0.000000 233.013333 /end CHARACTERISTIC
/begin CHARACTERISTIC MLDTEFPF "Schwelle Motorluftmasse fÅr Freigabe öberprÅfung Diagnose DTEV passiv mîglich" VALUE 0x81D9A6 ME7_FW3 0 m_q0p1___UW 0.000000 80.000000 EXTENDED_LIMITS 0.000000 6553.500000 /end CHARACTERISTIC
/begin CHARACTERISTIC MLDTEPF "Schwelle Motorluftmasse fÅr Freigabe Diagnose DTEV passiv mîglich" VALUE 0x81D9A8 ME7_FW3 0 m_q0p1___UW 0.000000 80.000000 EXTENDED_LIMITS 0.000000 6553.500000 /end CHARACTERISTIC
/begin CHARACTERISTIC MLFKMSDK "Luftmassenstromschwelle fÅr multipl. Abgleich von HFM- und DK-Massenstrom" VALUE 0x8117FE ME7_FW3 0 m_uw_b6553p5 0.000000 6553.500000 /end CHARACTERISTIC
/begin CHARACTERISTIC MLHFM "Linearisierung der Hei·filmspannung" CURVE 0x810F20 ME7_FKL3 0 m_uw_b6553p5 0.000000 6553.500000
 /begin AXIS_DESCR FIX_AXIS uhfm_w spg_uw_q0p00488___SL 512 0.000000 4.995120 FIX_AXIS_PAR 0 1 512 /end AXIS_DESCR
/end CHARACTERISTIC
/begin CHARACTERISTIC MLKHMX "max. Luftmasse fÅr Katheizen" VALUE 0x819033 ME7_FW1 0 m_ub_b1020 0.000000 1020.000000 /end CHARACTERISTIC
/begin CHARACTERISTIC MLLASH "Luftmassenschwelle fÅr SchwingungsprÅfung hinter KAT" VALUE 0x81AD50 ME7_FW3 0 m_q0p1___UW 0.000000 6553.500000 /end CHARACTERISTIC
/begin CHARACTERISTIC MLMAX "Maximaler Luftflu· fÅr die Lastberechnung nach SAE J1979" VALUE 0x81B56A ME7_FW3 0 m_uw_b6553p5 0.000000 6553.500000 /end CHARACTERISTIC
/begin CHARACTERISTIC MLNKAX "Luftmassenschwelle fÅr Einschaltbereitschaft LRSHK" VALUE 0x813736 ME7_FW3 0 m_uw_b7281 0.000000 7281.670000 EXTENDED_LIMITS 0.000000 7281.666667 /end CHARACTERISTIC
/begin CHARACTERISTIC MLO1 "obere Luftmengenschwelle Bereich 1" VALUE 0x81B868 ME7_FW3 0 m_uw_b6553p5 0.000000 6553.500000 /end CHARACTERISTIC
/begin CHARACTERISTIC MLO2 "obere Luftmengenschwelle Bereich 2" VALUE 0x811F3A ME7_FW3 0 m_uw_b6553p5 0.000000 6553.500000 /end CHARACTERISTIC
/begin CHARACTERISTIC MLO3 "obere Luftmengenschwelle Bereich 3" VALUE 0x81B86A ME7_FW3 0 m_uw_b6553p5 0.000000 6553.500000 /end CHARACTERISTIC
/begin CHARACTERISTIC MLOFS "Kennlinienoffset HFM 5" VALUE 0x811320 ME7_FW3 0 m_uw_b6553p5 0.000000 6553.500000 /end CHARACTERISTIC
/begin CHARACTERISTIC MLOSTEST "obere Luftmassenschwelle fÅr Testbeginn SchwingungsprÅfung hinter KAT" VALUE 0x81AD52 ME7_FW3 0 m_q0p1___UW 0.000000 6553.500000 /end CHARACTERISTIC
/begin CHARACTERISTIC MLSLMX "max. Motor-Luftmasse fÅr SekundÑrlufteinblasung" VALUE 0x818343 ME7_FW1 0 m_ub_b1020 0.000000 1020.000000 /end CHARACTERISTIC
/begin CHARACTERISTIC MLSUS_0_A "Sollwert Luftmassen-Integral fÅr motorisches Katheizen" CURVE 0x819034 ME7_KL97 0 m_ub_b5p8 0.000000 5.802670
 /begin AXIS_DESCR STD_AXIS tmst temp_ub_q0p75_o48 12 -48.000000 143.250000 DEPOSIT ABSOLUTE /end AXIS_DESCR
 EXTENDED_LIMITS 0.000000 5.802667 /end CHARACTERISTIC
/begin CHARACTERISTIC MLSUS_1_A "Sollwert Luftmassen-Integral fÅr motorisches Katheizen" CURVE 0x81904D ME7_KL97 0 m_ub_b5p8 0.000000 5.802670
 /begin AXIS_DESCR STD_AXIS tmst temp_ub_q0p75_o48 12 -48.000000 143.250000 DEPOSIT ABSOLUTE /end AXIS_DESCR
 EXTENDED_LIMITS 0.000000 5.802667 /end CHARACTERISTIC
/begin CHARACTERISTIC MLSUS_2_A "Sollwert Luftmassen-Integral fÅr motorisches Katheizen" CURVE 0x819066 ME7_KL97 0 m_ub_b5p8 0.000000 5.802670
 /begin AXIS_DESCR STD_AXIS tmst temp_ub_q0p75_o48 12 -48.000000 143.250000 DEPOSIT ABSOLUTE /end AXIS_DESCR
 EXTENDED_LIMITS 0.000000 5.802667 /end CHARACTERISTIC
/begin CHARACTERISTIC MLU2 "untere Luftmengenschwelle Bereich 2" VALUE 0x81B86C ME7_FW3 0 m_uw_b6553p5 0.000000 6553.500000 /end CHARACTERISTIC
/begin CHARACTERISTIC MLU4 "untere Luftmengenschwelle Bereich 4" VALUE 0x811F3C ME7_FW3 0 m_uw_b6553p5 0.000000 6553.500000 /end CHARACTERISTIC
/begin CHARACTERISTIC MLUSSTG "Luftmassenschwelle fÅr DynamikprÅfung hinter KAT" VALUE 0x81AD54 ME7_FW3 0 m_q0p1___UW 0.000000 6553.500000 /end CHARACTERISTIC
/begin CHARACTERISTIC MLUSTEST "untere Luftmassenschwelle fÅr Testbeginn SchwingungsprÅfung hinter KAT" VALUE 0x81AD56 ME7_FW3 0 m_q0p1___UW 0.000000 6553.500000 /end CHARACTERISTIC
/begin CHARACTERISTIC MLWDSLAMN "min. Luftmasse fÅr Bedingung Adaption/Zusatzdiagnose (16 Bit)" VALUE 0x81A122 ME7_FW3 0 m_uw_b6553p5 0.000000 6553.500000 /end CHARACTERISTIC
/begin CHARACTERISTIC MLWDSLAMX "max. Luftmasse fÅr Bedingung Adaption/Zusatzdiagnose (16 Bit)" VALUE 0x81A124 ME7_FW3 0 m_uw_b6553p5 0.000000 6553.500000 /end CHARACTERISTIC
/begin CHARACTERISTIC MLWDSLKMN "min. Luftmasse fÅr Bedingung Kurztest-Diagnose (16 Bit)" VALUE 0x81A126 ME7_FW3 0 m_uw_b6553p5 0.000000 6553.500000 /end CHARACTERISTIC
/begin CHARACTERISTIC MLWDSLKMX "max. Luftmasse fÅr Bedingung Kurztest-Diagnose (16 Bit)" VALUE 0x81A128 ME7_FW3 0 m_uw_b6553p5 0.000000 6553.500000 /end CHARACTERISTIC
/begin CHARACTERISTIC MLWDSLMN "min. Luftmasse fÅr Bedingung Diagnose (16 Bit)" VALUE 0x81A12A ME7_FW3 0 m_uw_b6553p5 0.000000 6553.500000 /end CHARACTERISTIC
/begin CHARACTERISTIC MLWDSLMX "max. Luftmasse fÅr Bedingung Diagnose (16 Bit)" VALUE 0x81A12C ME7_FW3 0 m_uw_b6553p5 0.000000 6553.500000 /end CHARACTERISTIC
/begin CHARACTERISTIC MLWDSLOMN "min. Luftmasse fÅr Bedingung frm-Offset-Messung (16 Bit)" VALUE 0x81A12E ME7_FW3 0 m_uw_b6553p5 0.000000 6553.500000 /end CHARACTERISTIC
/begin CHARACTERISTIC MLWDSLOMX "max. Luftmasse fÅr Bedingung frm-Offset-Messung (16 Bit)" VALUE 0x81A130 ME7_FW3 0 m_uw_b6553p5 0.000000 6553.500000 /end CHARACTERISTIC
/begin CHARACTERISTIC MOTTYP "Motortyp fÅr Ausgabe an Kombi" VALUE 0x8144ED ME7_FW1 0 DEZ 0.000000 255.000000 /end CHARACTERISTIC
/begin CHARACTERISTIC MRESLL "LLR: Erhîhte Momentenreserve im LL nach Drehzahleinbruch" VALUE 0x815665 ME7_FW1 0 rel_ub_b24p9 0.000000 24.900000 /end CHARACTERISTIC
/begin CHARACTERISTIC MRESSL "Momentenreserve bei Servolenkung" VALUE 0x81285C ME7_FW3 0 rel_uw_b100 0.000000 99.998500 EXTENDED_LIMITS 0.000000 99.998474 /end CHARACTERISTIC
/begin CHARACTERISTIC MRFALLO "Obere Leerlaufschwelle des relativen Fahrerwunschmoments" VALUE 0x813278 ME7_FW3 0 rel_uw_b200 0.000000 199.997000 EXTENDED_LIMITS 0.000000 199.996948 /end CHARACTERISTIC
/begin CHARACTERISTIC MRFALLU "Untere Leerlaufschwelle des relativen Fahrerwunschmoments" VALUE 0x81327A ME7_FW3 0 rel_uw_b200 0.000000 199.997000 EXTENDED_LIMITS 0.000000 199.996948 /end CHARACTERISTIC
/begin CHARACTERISTIC MRFARUGD "Resetschwelle fÅr linearen Pedalweg im ungedrosselten DK-Bereich" VALUE 0x811B8C ME7_FW3 0 rel_uw_b200 0.000000 199.997000 EXTENDED_LIMITS 0.000000 199.996948 /end CHARACTERISTIC
/begin CHARACTERISTIC MRFAVLN "Vollasterkennungsschwelle des relativen Fahrerwunsches" CURVE 0x81D29A ZF_KL111 0 rel_uw_b200 0.000000 199.997000
 /begin AXIS_DESCR STD_AXIS nmot_w nmot_uw_q0p25 14 0.000000 16383.800000 DEPOSIT ABSOLUTE /end AXIS_DESCR
 EXTENDED_LIMITS 0.000000 199.996948 /end CHARACTERISTIC
/begin CHARACTERISTIC MRFAVW "Schwelle zur Umschaltung des Vorlagerungswinkels bei max. Fahrerwunsches" CURVE 0x81B858 ME7_GKL3 0 rel_uw_b200 0.000000 199.997000
 /begin AXIS_DESCR COM_AXIS nmot nmot_ub_q40 0 0.000000 10200.000000 AXIS_PTS_REF SNM08GKUB /end AXIS_DESCR
 EXTENDED_LIMITS 0.000000 199.996948 /end CHARACTERISTIC
/begin CHARACTERISTIC MRFGRLL "Schwelle relatives Moment vom Fahrgeschwindigkeitsregler fÅr Erkennung Leerlauf" VALUE 0x81AF12 ME7_FW3 0 rel_uw_b200 0.000000 199.997000 EXTENDED_LIMITS 0.000000 199.996948 /end CHARACTERISTIC
/begin CHARACTERISTIC MRFGRMAX "Maximalwert fÅr relatives Moment aus FGR" VALUE 0x810F0C ME7_FW3 0 rel_uw_b200 0.000000 199.997000 EXTENDED_LIMITS 0.000000 199.996948 /end CHARACTERISTIC
/begin CHARACTERISTIC MRFGRSTA "Startwert fÅr Relatives Moment bei Aktivierung FGR-Regler" VALUE 0x81AF14 ME7_FW3 0 rel_uw_b200 0.000000 199.997000 EXTENDED_LIMITS 0.000000 199.996948 /end CHARACTERISTIC
/begin CHARACTERISTIC MSALLMN "Minimale Leerlaufluftmassenadaption fÅr E-Gas" VALUE 0x8150E1 ME7_FW1 0 m_ub_q0p1 0.000000 25.500000 /end CHARACTERISTIC
/begin CHARACTERISTIC MSALLMX "Maximale Leerlaufluftmassenadaption fÅr E-Gas" VALUE 0x8150E2 ME7_FW1 0 m_ub_q0p1 0.000000 25.500000 /end CHARACTERISTIC
/begin CHARACTERISTIC MSDKLMMN "minimaler Massenstrom Åber Drosselklappe in TE" VALUE 0x813532 ME7_FW3 0 m_uw_b6553p5 0.000000 6553.500000 /end CHARACTERISTIC
/begin CHARACTERISTIC MSLBAS "Ini.- SekundÑrluftmasse" VALUE 0x818374 ME7_FW1 0 m_q0p4 0.000000 102.000000 /end CHARACTERISTIC
/begin CHARACTERISTIC MSLG "Massenstrom Leckluft gesamt" VALUE 0x8150E3 ME7_FW1 0 m_ub_q0p1 0.000000 25.500000 /end CHARACTERISTIC
/begin CHARACTERISTIC MSLUB "SekundÑrluftmasse abhÑngig von der Batteriespannung" CURVE 0x818344 ME7_KL97 0 m_ub_q0p4 0.000000 102.000000
 /begin AXIS_DESCR STD_AXIS ubf spg_ubatt 8 0.000000 17.952000 DEPOSIT ABSOLUTE /end AXIS_DESCR
/end CHARACTERISTIC
/begin CHARACTERISTIC MSLVMX "Diagnoseschwelle fÅr VentildichtheitsprÅfung" VALUE 0x818375 ME7_FW1 0 m_q0p4 0.000000 102.000000 /end CHARACTERISTIC
/begin CHARACTERISTIC MSLVMXX "Diagnoseschwelle fÅr absoluten Fehler Ventildichtheit" VALUE 0x818376 ME7_FW1 0 m_q0p4 0.000000 102.000000 /end CHARACTERISTIC
/begin CHARACTERISTIC MSNTATE "Kennlinie normierter Massenstrom durch TEV" CURVE 0x813676 ZF_KL111 0 m_uw_b25p6 0.000000 25.599600
 /begin AXIS_DESCR STD_AXIS msntate_kge rel_uw_b100 10 0.000000 99.998500 DEPOSIT ABSOLUTE /end AXIS_DESCR
 EXTENDED_LIMITS 0.000000 25.599609 /end CHARACTERISTIC
/begin CHARACTERISTIC MSRC_D_UC "" VAL_BLK 0x815B1A ME7_FWB1 0 dez 0.000000 255.000000 NUMBER 16 /end CHARACTERISTIC
/begin CHARACTERISTIC MSRC_T_UC "" VALUE 0x815C7D ME7_FW1 0 t40ms_ub_b10200 0.000000 10200.000000 /end CHARACTERISTIC
/begin CHARACTERISTIC MSRC_T_UM "Fehlerzeit fÅr MSR-Eingriff-öberwachung der FunktionsÅberwachung" VALUE 0x814072 ME7_FW1 0 t40ms_ub_b10200 0.000000 10200.000000 /end CHARACTERISTIC
/begin CHARACTERISTIC MSRMDTMX "Grî·te zulÑssige Momenten-Zeit-FlÑche bei der MSR-Topfplausibilisierung" VALUE 0x81017A ME7_FW4 0 mdt_sw_b2556 -2556.000000 2555.920000 EXTENDED_LIMITS -2556.000000 2555.921997 /end CHARACTERISTIC
/begin CHARACTERISTIC MVER_D_UC "" VAL_BLK 0x815B2A ME7_FWB1 0 dez 0.000000 255.000000 NUMBER 16 /end CHARACTERISTIC
/begin CHARACTERISTIC MVER_T_UC "" VALUE 0x815DFF ME7_FW1 0 t40ms_ub_b10200 0.000000 10200.000000 /end CHARACTERISTIC
/begin CHARACTERISTIC MVER_T_UM "Fehlerzeit beim Momentenvergleich in der FunktionsÅberwachung" VALUE 0x8141F4 ME7_FW1 0 t40ms_ub_b10200 0.000000 10200.000000 /end CHARACTERISTIC
/begin CHARACTERISTIC MWNTKB "Me·wert lesen normiert Testerkommunikation" VAL_BLK 0x81C080 ME7_FWB3 0 dez___UW 0.000000 65535.000000 NUMBER 10 /end CHARACTERISTIC
/begin CHARACTERISTIC MWNTKB0 "Me·wert lesen normiert Testerkommunikation Block 0" VAL_BLK 0x81C094 ME7_FWB3 0 dez___UW 0.000000 65535.000000 NUMBER 36 /end CHARACTERISTIC
/begin CHARACTERISTIC MWNTKB1 "Me·wert lesen normiert Testerkommunikation Block 1" VAL_BLK 0x81C0DC ME7_FWB3 0 dez___UW 0.000000 65535.000000 NUMBER 40 /end CHARACTERISTIC
/begin CHARACTERISTIC MWNTKB10 "Me·wert lesen normiert Testerkommunikation Block 10" VAL_BLK 0x81C12C ME7_FWB3 0 dez___UW 0.000000 65535.000000 NUMBER 40 /end CHARACTERISTIC
/begin CHARACTERISTIC MWNTKB11 "Me·wert lesen normiert Testerkommunikation Block 11" VAL_BLK 0x81C17C ME7_FWB3 0 dez___UW 0.000000 65535.000000 NUMBER 40 /end CHARACTERISTIC
/begin CHARACTERISTIC MWNTKB12 "Me·wert lesen normiert Testerkommunikation Block 12" VAL_BLK 0x81C1CC ME7_FWB3 0 dez___UW 0.000000 65535.000000 NUMBER 40 /end CHARACTERISTIC
/begin CHARACTERISTIC MWNTKB13 "Me·wert lesen normiert Testerkommunikation Block 13" VAL_BLK 0x81C21C ME7_FWB3 0 dez___UW 0.000000 65535.000000 NUMBER 40 /end CHARACTERISTIC
/begin CHARACTERISTIC MWNTKB14 "Me·wert lesen normiert Testerkommunikation Block 14" VAL_BLK 0x81C26C ME7_FWB3 0 dez___UW 0.000000 65535.000000 NUMBER 40 /end CHARACTERISTIC
/begin CHARACTERISTIC MWNTKB15 "Me·wert lesen normiert Testerkommunikation Block 15" VAL_BLK 0x81C2BC ME7_FWB3 0 dez___UW 0.000000 65535.000000 NUMBER 4 /end CHARACTERISTIC
/begin CHARACTERISTIC MWNTKB190 "Me·wert lesen normiert Testerkommunikation Block 190" VAL_BLK 0x81C2C4 ME7_FWB3 0 dez___UW 0.000000 65535.000000 NUMBER 10 /end CHARACTERISTIC
/begin CHARACTERISTIC MWNTKB191 "Me·wert lesen normiert Testerkommunikation Block 191" VAL_BLK 0x81C2D8 ME7_FWB3 0 dez___UW 0.000000 65535.000000 NUMBER 10 /end CHARACTERISTIC
/begin CHARACTERISTIC MWNTKB192 "Me·wert lesen normiert Testerkommunikation Block 192" VAL_BLK 0x81C2EC ME7_FWB3 0 dez___UW 0.000000 65535.000000 NUMBER 10 /end CHARACTERISTIC
/begin CHARACTERISTIC MWNTKB193 "Me·wert lesen normiert Testerkommunikation Block 193" VAL_BLK 0x81C300 ME7_FWB3 0 dez___UW 0.000000 65535.000000 NUMBER 10 /end CHARACTERISTIC
/begin CHARACTERISTIC MWNTKB194 "Me·wert lesen normiert Testerkommunikation Block 194" VAL_BLK 0x81C314 ME7_FWB3 0 dez___UW 0.000000 65535.000000 NUMBER 10 /end CHARACTERISTIC
/begin CHARACTERISTIC MWNTKB195 "Me·wert lesen normiert Testerkommunikation Block 195" VAL_BLK 0x81C328 ME7_FWB3 0 dez___UW 0.000000 65535.000000 NUMBER 10 /end CHARACTERISTIC
/begin CHARACTERISTIC MWNTKB196 "Me·wert lesen normiert Testerkommunikation Block 196" VAL_BLK 0x81C33C ME7_FWB3 0 dez___UW 0.000000 65535.000000 NUMBER 10 /end CHARACTERISTIC
/begin CHARACTERISTIC MWNTKB197 "Me·wert lesen normiert Testerkommunikation Block 197" VAL_BLK 0x81C350 ME7_FWB3 0 dez___UW 0.000000 65535.000000 NUMBER 10 /end CHARACTERISTIC
/begin CHARACTERISTIC MWNTKB198 "Me·wert lesen normiert Testerkommunikation Block 198" VAL_BLK 0x81C364 ME7_FWB3 0 dez___UW 0.000000 65535.000000 NUMBER 10 /end CHARACTERISTIC
/begin CHARACTERISTIC MWNTKB199 "Me·wert lesen normiert Testerkommunikation Block 199" VAL_BLK 0x81C378 ME7_FWB3 0 dez___UW 0.000000 65535.000000 NUMBER 10 /end CHARACTERISTIC
/begin CHARACTERISTIC MWNTKB2 "Me·wert lesen normiert Testerkommunikation Block 2" VAL_BLK 0x81C38C ME7_FWB3 0 dez___UW 0.000000 65535.000000 NUMBER 40 /end CHARACTERISTIC
/begin CHARACTERISTIC MWNTKB20 "Me·wert lesen normiert Testerkommunikation Block 20" VAL_BLK 0x81C3DC ME7_FWB3 0 dez___UW 0.000000 65535.000000 NUMBER 40 /end CHARACTERISTIC
/begin CHARACTERISTIC MWNTKB21 "Me·wert lesen normiert Testerkommunikation Block 21" VAL_BLK 0x81C42C ME7_FWB3 0 dez___UW 0.000000 65535.000000 NUMBER 40 /end CHARACTERISTIC
/begin CHARACTERISTIC MWNTKB22 "Me·wert lesen normiert Testerkommunikation Block 22" VAL_BLK 0x81C47C ME7_FWB3 0 dez___UW 0.000000 65535.000000 NUMBER 40 /end CHARACTERISTIC
/begin CHARACTERISTIC MWNTKB23 "Me·wert lesen normiert Testerkommunikation Block 23" VAL_BLK 0x81C4CC ME7_FWB3 0 dez___UW 0.000000 65535.000000 NUMBER 40 /end CHARACTERISTIC
/begin CHARACTERISTIC MWNTKB24 "Me·wert lesen normiert Testerkommunikation Block 24" VAL_BLK 0x81C51C ME7_FWB3 0 dez___UW 0.000000 65535.000000 NUMBER 40 /end CHARACTERISTIC
/begin CHARACTERISTIC MWNTKB25 "Me·wert lesen normiert Testerkommunikation Block 25" VAL_BLK 0x81C56C ME7_FWB3 0 dez___UW 0.000000 65535.000000 NUMBER 24 /end CHARACTERISTIC
/begin CHARACTERISTIC MWNTKB3 "Me·wert lesen normiert Testerkommunikation Block 3" VAL_BLK 0x81C59C ME7_FWB3 0 dez___UW 0.000000 65535.000000 NUMBER 40 /end CHARACTERISTIC
/begin CHARACTERISTIC MWNTKB4 "Me·wert lesen normiert Testerkommunikation Block 4" VAL_BLK 0x81C5EC ME7_FWB3 0 dez___UW 0.000000 65535.000000 NUMBER 40 /end CHARACTERISTIC
/begin CHARACTERISTIC MWNTKB5 "Me·wert lesen normiert Testerkommunikation Block 5" VAL_BLK 0x81C63C ME7_FWB3 0 dez___UW 0.000000 65535.000000 NUMBER 40 /end CHARACTERISTIC
/begin CHARACTERISTIC MWNTKB6 "Me·wert lesen normiert Testerkommunikation Block 6" VAL_BLK 0x81C68C ME7_FWB3 0 dez___UW 0.000000 65535.000000 NUMBER 40 /end CHARACTERISTIC
/begin CHARACTERISTIC MWNTKB7 "Me·wert lesen normiert Testerkommunikation Block 7" VAL_BLK 0x81C6DC ME7_FWB3 0 dez___UW 0.000000 65535.000000 NUMBER 40 /end CHARACTERISTIC
/begin CHARACTERISTIC MWNTKB8 "Me·wert lesen normiert Testerkommunikation Block 8" VAL_BLK 0x81C72C ME7_FWB3 0 dez___UW 0.000000 65535.000000 NUMBER 40 /end CHARACTERISTIC
/begin CHARACTERISTIC MWNTKB9 "Me·wert lesen normiert Testerkommunikation Block 9" VAL_BLK 0x81C77C ME7_FWB3 0 dez___UW 0.000000 65535.000000 NUMBER 40 /end CHARACTERISTIC
/begin CHARACTERISTIC MZFFIL_UC "" VALUE 0x815DFD ME7_FW1 0 zk40ms_ub_b10200 40.629900 10200.000000 EXTENDED_LIMITS 0.156863 10200.000000 /end CHARACTERISTIC
/begin CHARACTERISTIC MZFFIL_UM "Filter-Zeitkonstante fÅr verzîgertes Moment in der FunktionsÅberwachung" VALUE 0x8141F2 ME7_FW1 0 zk40ms_ub_b10200 40.629900 10200.000000 EXTENDED_LIMITS 0.156863 10200.000000 /end CHARACTERISTIC
/begin CHARACTERISTIC MZFPTR_DAT_UC "" VAL_BLK 0x815B3A ME7_FWB1 0 dez 0.000000 255.000000 NUMBER 16 /end CHARACTERISTIC
/begin CHARACTERISTIC MZFREG_DAT_UC "" MAP 0x815B4A ME7_FKF1 0 dez 0.000000 255.000000
 /begin AXIS_DESCR FIX_AXIS x_uc dez___SL 8 0.000000 7.000000 FIX_AXIS_PAR 0 0 8 /end AXIS_DESCR
 /begin AXIS_DESCR FIX_AXIS y_uc dez___SL 16 0.000000 15.000000 FIX_AXIS_PAR 0 0 16 /end AXIS_DESCR
/end CHARACTERISTIC
/begin RECORD_LAYOUT ME7_FKF1 FNC_VALUES 1 UBYTE COLUMN_DIR DIRECT /end RECORD_LAYOUT
/begin CHARACTERISTIC MZFTV_UC "" VALUE 0x815DFE ME7_FW1 0 t40ms_ub_b10200 0.000000 320.000000 EXTENDED_LIMITS 0.000000 10200.000000 /end CHARACTERISTIC
/begin CHARACTERISTIC MZFTV_UM "Verzugszeit fÅr zulÑssiges Moment mz_um in der FunktionsÅberwachg" VALUE 0x8141F3 ME7_FW1 0 t40ms_ub_b10200 40.000000 320.000000 EXTENDED_LIMITS 0.000000 10200.000000 /end CHARACTERISTIC
/begin CHARACTERISTIC MZF_DAT_UC "" VAL_BLK 0x815BCA ME7_FWB1 0 rel_ub_q0p3906___UB 0.000000 99.609400 NUMBER 16 EXTENDED_LIMITS 0.000000 99.609375 /end CHARACTERISTIC
/begin CHARACTERISTIC MZL_DAT_UC "" VAL_BLK 0x815BDA ME7_FWB1 0 rel_ub_q0p00153 0.000000 0.389074 NUMBER 16 /end CHARACTERISTIC
/begin CHARACTERISTIC N0 "Umrechnungskonstante fÅr Einrechnung Gemischkorrektur rkat" VALUE 0x8151C9 ME7_FW1 0 nmot_ub_q40 0.000000 10200.000000 /end CHARACTERISTIC
/begin CHARACTERISTIC NACHANZ "" VALUE 0x814379 ME7_FW1 0 dez 0.000000 255.000000 /end CHARACTERISTIC
/begin CHARACTERISTIC NARAO_0_A "obere Drehzahlschwelle fÅr AR aktiv" VALUE 0x817274 ME7_FW1 0 nmot_ub_q40 0.000000 10200.000000 /end CHARACTERISTIC
/begin CHARACTERISTIC NARAO_1_A "obere Drehzahlschwelle fÅr AR aktiv" VALUE 0x817275 ME7_FW1 0 nmot_ub_q40 0.000000 10200.000000 /end CHARACTERISTIC
/begin CHARACTERISTIC NARAO_2_A "obere Drehzahlschwelle fÅr AR aktiv" VALUE 0x817276 ME7_FW1 0 nmot_ub_q40 0.000000 10200.000000 /end CHARACTERISTIC
/begin CHARACTERISTIC NARAO_3_A "obere Drehzahlschwelle fÅr AR aktiv" VALUE 0x817277 ME7_FW1 0 nmot_ub_q40 0.000000 10200.000000 /end CHARACTERISTIC
/begin CHARACTERISTIC NARASTG_0_A "Drehzahlschwelle in hoeherem Gang fuer AR aktiv" CURVE 0x8156EA ME7_FKL1 0 nmot_ub_q40 0.000000 10200.000000
 /begin AXIS_DESCR FIX_AXIS gangi dez___SL 6 1.000000 6.000000 FIX_AXIS_PAR 1 0 6 /end AXIS_DESCR
/end CHARACTERISTIC
/begin CHARACTERISTIC NARASTG_1_A "Drehzahlschwelle in hoeherem Gang fuer AR aktiv" CURVE 0x8156F0 ME7_FKL1 0 nmot_ub_q40 0.000000 10200.000000
 /begin AXIS_DESCR FIX_AXIS gangi dez___SL 6 1.000000 6.000000 FIX_AXIS_PAR 1 0 6 /end AXIS_DESCR
/end CHARACTERISTIC
/begin CHARACTERISTIC NARASTG_2_A "Drehzahlschwelle in hoeherem Gang fuer AR aktiv" CURVE 0x8156F6 ME7_FKL1 0 nmot_ub_q40 0.000000 10200.000000
 /begin AXIS_DESCR FIX_AXIS gangi dez___SL 6 1.000000 6.000000 FIX_AXIS_PAR 1 0 6 /end AXIS_DESCR
/end CHARACTERISTIC
/begin CHARACTERISTIC NARASTG_3_A "Drehzahlschwelle in hoeherem Gang fuer AR aktiv" CURVE 0x8156FC ME7_FKL1 0 nmot_ub_q40 0.000000 10200.000000
 /begin AXIS_DESCR FIX_AXIS gangi dez___SL 6 1.000000 6.000000 FIX_AXIS_PAR 1 0 6 /end AXIS_DESCR
/end CHARACTERISTIC
/begin CHARACTERISTIC NARLL_0_A "Drehzahlschwelle fÅr AR im Leerlauf" VALUE 0x817280 ME7_FW1 0 nmot_ub_q40 0.000000 10200.000000 /end CHARACTERISTIC
/begin CHARACTERISTIC NARLL_1_A "Drehzahlschwelle fÅr AR im Leerlauf" VALUE 0x817281 ME7_FW1 0 nmot_ub_q40 0.000000 10200.000000 /end CHARACTERISTIC
/begin CHARACTERISTIC NARLL_2_A "Drehzahlschwelle fÅr AR im Leerlauf" VALUE 0x817282 ME7_FW1 0 nmot_ub_q40 0.000000 10200.000000 /end CHARACTERISTIC
/begin CHARACTERISTIC NARLL_3_A "Drehzahlschwelle fÅr AR im Leerlauf" VALUE 0x817283 ME7_FW1 0 nmot_ub_q40 0.000000 10200.000000 /end CHARACTERISTIC
/begin CHARACTERISTIC NASNOT "Drehzahlschwelle fÅr ASR-Verbot wegen AbwÅrgeschutz" VALUE 0x81570B ME7_FW1 0 nmot_ub_q40 0.000000 2560.000000 EXTENDED_LIMITS 0.000000 10200.000000 /end CHARACTERISTIC
/begin CHARACTERISTIC NC_T_UM "Fehlertoleranzzeit fÅr MotordrehzahlÅberwachung fÅr FunktionsÅberwachung" VALUE 0x814004 ME7_FW1 0 t40ms_ub_b10200 0.000000 10200.000000 /end CHARACTERISTIC
/begin CHARACTERISTIC NDABS "Drehzahlschwelle fÅr Auswertung Schlechtweginfo" VALUE 0x814AFA ME7_FW1 0 nmot_ub_q40 0.000000 10200.000000 /end CHARACTERISTIC
/begin CHARACTERISTIC NDFILOG "Schwelle fÅr Filterausgang ndfil" CURVE 0x812A78 ME7_FKL3 0 nmot_uw_q0p25 0.000000 16383.800000
 /begin AXIS_DESCR FIX_AXIS gangi dez___SL 6 1.000000 6.000000 FIX_AXIS_PAR 1 0 6 /end AXIS_DESCR
 EXTENDED_LIMITS 0.000000 16383.750000 /end CHARACTERISTIC
/begin CHARACTERISTIC NDIFFOG "Schwelle Drehzahldifferenz zum Auslîsen Ini der AR beim Verzîgern" CURVE 0x81CF7C ME7_FKL4 0 nmot_sw_q0p25 -8192.000000 8191.750000
 /begin AXIS_DESCR FIX_AXIS gangi dez___SL 6 1.000000 6.000000 FIX_AXIS_PAR 1 0 6 /end AXIS_DESCR
/end CHARACTERISTIC
/begin RECORD_LAYOUT ME7_FKL4 FNC_VALUES 1 SWORD COLUMN_DIR DIRECT /end RECORD_LAYOUT
/begin CHARACTERISTIC NDIF_UM "erlaubte Differenz zwischen nmot und nz_um in der FunktionsÅberwachung" VALUE 0x814005 ME7_FW1 0 nmot_ub_q40 0.000000 10200.000000 /end CHARACTERISTIC
/begin CHARACTERISTIC NDKPPU "Minimaldrehzahl fÅr Plausibilisierung DK-Poti 2 nach unten im Normalbetrieb" VALUE 0x814E83 ME7_FW1 0 nmot_ub_q40 200.000000 10200.000000 EXTENDED_LIMITS 0.000000 10200.000000 /end CHARACTERISTIC
/begin CHARACTERISTIC NDKRA "Drehzahlschwelle fÅr Diagnose Klopfregelanschlag" VALUE 0x815434 ME7_FW1 0 nmot_ub_q40 0.000000 10200.000000 /end CHARACTERISTIC
/begin CHARACTERISTIC NDKS "Drehzahlschwelle fÅr Dia KS" VALUE 0x819458 ME7_FW1 0 nmot_ub_q40 0.000000 10200.000000 /end CHARACTERISTIC
/begin CHARACTERISTIC NDKTSO "Obere Drehzahlgrenze fÅr DKAT-aktiv" VALUE 0x8184E1 ME7_FW1 0 nmot_ub_q40 0.000000 10200.000000 /end CHARACTERISTIC
/begin CHARACTERISTIC NDKTSOT "Obere Drehzahlgrenze fÅr Funktionsanforderung" VALUE 0x8184E2 ME7_FW1 0 nmot_ub_q40 0.000000 10200.000000 /end CHARACTERISTIC
/begin CHARACTERISTIC NDKTSU "untere Drehzahlgrenze fÅr DKAT-aktiv" VALUE 0x8184E3 ME7_FW1 0 nmot_ub_q40 0.000000 10200.000000 /end CHARACTERISTIC
/begin CHARACTERISTIC NDKTSUT "Untere Drehzahlgrenze fÅr Funktionsanforderung" VALUE 0x8184E4 ME7_FW1 0 nmot_ub_q40 0.000000 10200.000000 /end CHARACTERISTIC
/begin CHARACTERISTIC NDLDRAPU "Drehzahlschwelle fÅr LDRA Fehlerpfad und Heilung LDO Fehlerpfad" CURVE 0x819745 ME7_KL97 0 nmot_ub_q40 0.000000 10200.000000
 /begin AXIS_DESCR STD_AXIS pu p_ub_q5 2 0.000000 1275.000000 DEPOSIT ABSOLUTE /end AXIS_DESCR
/end CHARACTERISTIC
/begin CHARACTERISTIC NDLSO "obere Drehzahlschwelle fÅr digitale Leerlaufstabilisierung" VALUE 0x815EE1 ME7_FW1 0 nmot_ub_q10 0.000000 2550.000000 /end CHARACTERISTIC
/begin CHARACTERISTIC NDLSU "untere Drehzahlschwelle fÅr digitale Leerlaufstabilisierung" VALUE 0x815EE2 ME7_FW1 0 nmot_ub_q10 0.000000 2550.000000 /end CHARACTERISTIC
/begin CHARACTERISTIC NDMDKD "Drehzahlschwelle fÅr KD-EintrÑge bei Aussetzern (EOBD:4500U/min)" VALUE 0x814AF8 ME7_FW1 0 nmot_ub_q40 0.000000 10200.000000 /end CHARACTERISTIC
/begin CHARACTERISTIC NDNWMN "Minimaldrehzahl fÅr Diagnose Nockenwellensteuerung" VALUE 0x8188D0 ME7_FW1 0 nmot_ub_q40 0.000000 10200.000000 /end CHARACTERISTIC
/begin CHARACTERISTIC NDNWMX "Maximaldrehzahl fÅr Diagnose Nockenwellensteuerung" VALUE 0x8188D1 ME7_FW1 0 nmot_ub_q40 0.000000 10200.000000 /end CHARACTERISTIC
/begin CHARACTERISTIC NDSLMN "min. Drehzahl wÑhrend SekundÑrluft-Einblasung fÅr DSLS" VALUE 0x818377 ME7_FW1 0 nmot_ub_q40 0.000000 10200.000000 /end CHARACTERISTIC
/begin CHARACTERISTIC NDSLMX "max. Drehzahl fÅr Bedingung Diagnose" VALUE 0x818378 ME7_FW1 0 nmot_ub_q40 0.000000 10200.000000 /end CHARACTERISTIC
/begin CHARACTERISTIC NDSVLO "obere Drehzahlschwelle fÅr Signalvergleich Ladedruck mit Umgebungsdruck" VALUE 0x818609 ME7_FW1 0 nmot_ub_q40 0.000000 10200.000000 /end CHARACTERISTIC
/begin CHARACTERISTIC NDSVLU "Drehzahlschwelle fÅr Signalvergleich Ladedruck mit Umgebungsdruck" VALUE 0x81860A ME7_FW1 0 nmot_ub_q40 0.000000 10200.000000 /end CHARACTERISTIC
/begin CHARACTERISTIC NDV "Fehlererkennung Tachosignal / Drehzahlschwelle minimal" VALUE 0x818592 ME7_FW1 0 nmot_ub_q40 0.000000 10200.000000 /end CHARACTERISTIC
/begin CHARACTERISTIC NDVO "Fehlererkennung Fz-Geschwindigkeitssignal, obere Drehzahlgrenze" VALUE 0x818593 ME7_FW1 0 nmot_ub_q40 0.000000 10200.000000 /end CHARACTERISTIC
/begin CHARACTERISTIC NFANWS "Drehzahlschwelle fÅr Funktionsanforderung NWS" VALUE 0x8188B5 ME7_FW1 0 nmot_ub_q40 0.000000 10200.000000 /end CHARACTERISTIC
/begin CHARACTERISTIC NFGRMAX_0_A "Max. zul. Drehzahl bei FGR-Betrieb" VALUE 0x81700E ME7_FW1 0 nmot_ub_q40 0.000000 10200.000000 /end CHARACTERISTIC
/begin CHARACTERISTIC NFGRMAX_1_A "Max. zul. Drehzahl bei FGR-Betrieb" VALUE 0x81700F ME7_FW1 0 nmot_ub_q40 0.000000 10200.000000 /end CHARACTERISTIC
/begin CHARACTERISTIC NFHZ "Solldrehzahl bei eingeschalteter Frontscheibenheizung" VALUE 0x8197D5 ME7_FW1 0 nmot_ub_q10 0.000000 2550.000000 /end CHARACTERISTIC
/begin CHARACTERISTIC NFHZFS "Solldrehzahl bei eingeschalteter Frontscheibenheizung und B_fs=1" VALUE 0x8197D6 ME7_FW1 0 nmot_ub_q10 0.000000 2550.000000 /end CHARACTERISTIC
/begin CHARACTERISTIC NFLAGS_D_UC "" VAL_BLK 0x815BEA ME7_FWB1 0 dez 0.000000 255.000000 NUMBER 16 /end CHARACTERISTIC
/begin CHARACTERISTIC NFLUV "Drehzahlschwelle der Modifikation der Laufunruhe-Berechnung" VALUE 0x814ABF ME7_FW1 0 nmot_ub_q40 0.000000 10200.000000 /end CHARACTERISTIC
/begin CHARACTERISTIC NFS2M "Solldrehzahl 2 Fahrstufenschalter ein" CURVE 0x8197D7 ME7_GKL1 0 nmot_ub_q10 0.000000 2550.000000
 /begin AXIS_DESCR COM_AXIS tmot temp_ub_q0p75_o48 0 -48.000000 143.250000 AXIS_PTS_REF STM06LLUB /end AXIS_DESCR
/end CHARACTERISTIC
/begin CHARACTERISTIC NFSKHM "LL-Solldrehzahl mit Fahrstufe und Katheizen" CURVE 0x81907F ME7_GKL1 0 nmot_ub_q10 0.000000 2550.000000
 /begin AXIS_DESCR COM_AXIS tmot temp_ub_q0p75_o48 0 -48.000000 143.250000 AXIS_PTS_REF STM04__UB /end AXIS_DESCR
/end CHARACTERISTIC
/begin CHARACTERISTIC NFSKO_0_A "Solldrehzahl fÅr Klimaanlage bei B_fs=1" VALUE 0x81CBB4 ME7_FW1 0 nmot_ub_q10 0.000000 2550.000000 /end CHARACTERISTIC
/begin CHARACTERISTIC NFSKO_1_A "Solldrehzahl fÅr Klimaanlage bei B_fs=1" VALUE 0x81CBB5 ME7_FW1 0 nmot_ub_q10 0.000000 2550.000000 /end CHARACTERISTIC
/begin CHARACTERISTIC NFSKO_2_A "Solldrehzahl fÅr Klimaanlage bei B_fs=1" VALUE 0x81CBB6 ME7_FW1 0 nmot_ub_q10 0.000000 2550.000000 /end CHARACTERISTIC
/begin CHARACTERISTIC NFSKO_3_A "Solldrehzahl fÅr Klimaanlage bei B_fs=1" VALUE 0x81CBB7 ME7_FW1 0 nmot_ub_q10 0.000000 2550.000000 /end CHARACTERISTIC
/begin CHARACTERISTIC NFSKS "Solldrehzahl fÅr Kochschutz (Fahrstufe eingelegt)" VALUE 0x81555F ME7_FW1 0 nmot_ub_q10 0.000000 2550.000000 /end CHARACTERISTIC
/begin CHARACTERISTIC NFSLPWG "Solldrehzahl bei Ausfall PWG-Signal bei B_fs=1" VALUE 0x815560 ME7_FW1 0 nmot_ub_q10 0.000000 2550.000000 /end CHARACTERISTIC
/begin CHARACTERISTIC NFSM "Solldrehzahl Fahrstufenschalter ein" CURVE 0x8197DD ME7_GKL1 0 nmot_ub_q10 0.000000 2550.000000
 /begin AXIS_DESCR COM_AXIS tmot temp_ub_q0p75_o48 0 -48.000000 143.250000 AXIS_PTS_REF STM06LLUB /end AXIS_DESCR
/end CHARACTERISTIC
/begin CHARACTERISTIC NFSMIN_0_A "Minimale zulÑssige Solldrehzahl bei eingelegter Fahrstufe" VALUE 0x81CBB8 ME7_FW1 0 nmot_ub_q10 0.000000 2550.000000 /end CHARACTERISTIC
/begin CHARACTERISTIC NFSMIN_1_A "Minimale zulÑssige Solldrehzahl bei eingelegter Fahrstufe" VALUE 0x81CBB9 ME7_FW1 0 nmot_ub_q10 0.000000 2550.000000 /end CHARACTERISTIC
/begin CHARACTERISTIC NFSMIN_2_A "Minimale zulÑssige Solldrehzahl bei eingelegter Fahrstufe" VALUE 0x81CBBA ME7_FW1 0 nmot_ub_q10 0.000000 2550.000000 /end CHARACTERISTIC
/begin CHARACTERISTIC NFSMIN_3_A "Minimale zulÑssige Solldrehzahl bei eingelegter Fahrstufe" VALUE 0x81CBBB ME7_FW1 0 nmot_ub_q10 0.000000 2550.000000 /end CHARACTERISTIC
/begin CHARACTERISTIC NFSSL "SollDrehzahl bei Servolenkungsschalter aktiv und B_fs=1" VALUE 0x8197E3 ME7_FW1 0 nmot_ub_q10 0.000000 2550.000000 /end CHARACTERISTIC
/begin CHARACTERISTIC NGALU "Misfire Detection : Schwelle DrehzahlÑnderung fÅr Ausblendung" CURVE 0x8101A2 ME7_GKL3 0 nmotg_sw_q0p39___UW 0.000000 12799.800000
 /begin AXIS_DESCR COM_AXIS nmot nmot_ub_q40 0 0.000000 10200.000000 AXIS_PTS_REF SNM08DMUB /end AXIS_DESCR
 EXTENDED_LIMITS 0.000000 25599.937050 /end CHARACTERISTIC
/begin CHARACTERISTIC NGANGMIN_0_A "Schwelle fuer Gangerkennung, Mindestwert PLausibilitaetstest" VALUE 0x810C04 ME7_FW3 0 nmot_uw_q0p25 0.000000 16383.800000 EXTENDED_LIMITS 0.000000 16383.750000 /end CHARACTERISTIC
/begin CHARACTERISTIC NGANGMIN_1_A "Schwelle fuer Gangerkennung, Mindestwert PLausibilitaetstest" VALUE 0x810C06 ME7_FW3 0 nmot_uw_q0p25 0.000000 16383.800000 EXTENDED_LIMITS 0.000000 16383.750000 /end CHARACTERISTIC
/begin CHARACTERISTIC NGDNSA "Drehzahlgradient beim Absteuern der Schubabschalthysterese" VALUE 0x81284E ME7_FW4 0 nmotg_sw_q0p15625 -5120.000000 5119.840000 EXTENDED_LIMITS -5120.000000 5119.843750 /end CHARACTERISTIC
/begin CHARACTERISTIC NGFSAWE "Schwelle Drehzahlgradient fÅr Sperrung Filter SA/WE" VALUE 0x81327C ME7_FW4 0 nmotg_sw_q0p39 -12800.200000 12799.800000 EXTENDED_LIMITS -12800.163840 12799.773210 /end CHARACTERISTIC
/begin CHARACTERISTIC NGKRAWN "Schwellwert Drehzahlgradient fÅr Dynamikerkennung KRRA" CURVE 0x81BFA4 ME7_GKL4 0 nmotg_sw_q0p39 0.000000 12799.800000
 /begin AXIS_DESCR COM_AXIS nmot nmot_ub_q40 0 0.000000 10200.000000 AXIS_PTS_REF SNM16KRUB /end AXIS_DESCR
 EXTENDED_LIMITS -12800.163840 12799.773210 /end CHARACTERISTIC
/begin CHARACTERISTIC NGKRWN "Schwellwert Drehzahlgradient fÅr Dynamikerkennung KRKE" CURVE 0x81BFC4 ME7_GKL4 0 nmotg_sw_q0p39 0.000000 12799.800000
 /begin AXIS_DESCR COM_AXIS nmot nmot_ub_q40 0 0.000000 10200.000000 AXIS_PTS_REF SNM16KRUB /end AXIS_DESCR
 EXTENDED_LIMITS -12800.163840 12799.773210 /end CHARACTERISTIC
/begin CHARACTERISTIC NGNSNF "Drehzahlgradientenschwelle zur Auslîsung der DrehzahlnachfÅhrung" VALUE 0x815561 ME7_FW1 0 nmotg_ub_q100 0.000000 25500.000000 /end CHARACTERISTIC
/begin CHARACTERISTIC NKRAMAX "Drehzahl oberhalb der KR-Adaption gefreezt wird" VALUE 0x819419 ME7_FW1 0 nmot_ub_q40 0.000000 10200.000000 /end CHARACTERISTIC
/begin CHARACTERISTIC NKRAMIN "Drehzahl unterhalb der KR-Adaption gefreezt wird" VALUE 0x81941A ME7_FW1 0 nmot_ub_q40 0.000000 10200.000000 /end CHARACTERISTIC
/begin CHARACTERISTIC NKRF "Drehzahlschwelle fÅr Klopfregelfreigabe" VALUE 0x81941B ME7_FW1 0 nmot_ub_q40 0.000000 10200.000000 /end CHARACTERISTIC
/begin CHARACTERISTIC NKRMAX "Drehzahl oberhalb der KR gefreezt wird" VALUE 0x81941C ME7_FW1 0 nmot_ub_q40 0.000000 10200.000000 /end CHARACTERISTIC
/begin CHARACTERISTIC NKRUM "Drehzahlschwelle Umschalten Delta-Lastsignal fÅr Lastdynamik" VALUE 0x819452 ME7_FW1 0 nmot_ub_q40 0.000000 10200.000000 /end CHARACTERISTIC
/begin CHARACTERISTIC NKTDX "Maximale Drehzahlgrenze DKAT fÅr Berechnung" VALUE 0x8184E5 ME7_FW1 0 nmot_ub_q40 0.000000 10200.000000 /end CHARACTERISTIC
/begin CHARACTERISTIC NLDIAPU "Drehzahlschwelle fÅr Adaption I-Begrenzung" CURVE 0x8194AC ME7_KL97 0 nmot_ub_q40 0.000000 10200.000000
 /begin AXIS_DESCR STD_AXIS pu p_ub_q5 2 0.000000 1275.000000 DEPOSIT ABSOLUTE /end AXIS_DESCR
/end CHARACTERISTIC
/begin CHARACTERISTIC NLL2M "Solldrehzahl 2" CURVE 0x8197E4 ME7_GKL1 0 nmot_ub_q10 0.000000 2550.000000
 /begin AXIS_DESCR COM_AXIS tmot temp_ub_q0p75_o48 0 -48.000000 143.250000 AXIS_PTS_REF STM06LLUB /end AXIS_DESCR
/end CHARACTERISTIC
/begin CHARACTERISTIC NLLCVTMXV "Begrenzung der Drehzahlvorgabe (CVT-Getriebe)" CURVE 0x8197EA ME7_KL97 0 nmot_ub_q10 0.000000 2550.000000
 /begin AXIS_DESCR STD_AXIS vfzg vfzg_ub_q1p25___UB 8 0.000000 318.750000 DEPOSIT ABSOLUTE /end AXIS_DESCR
/end CHARACTERISTIC
/begin CHARACTERISTIC NLLKHM "Leerlaufsolldrehzahl bei Kat.-Heizung" CURVE 0x819083 ME7_GKL1 0 nmot_ub_q10 0.000000 2550.000000
 /begin AXIS_DESCR COM_AXIS tmot temp_ub_q0p75_o48 0 -48.000000 143.250000 AXIS_PTS_REF STM04__UB /end AXIS_DESCR
/end CHARACTERISTIC
/begin CHARACTERISTIC NLLKT "Leerlaufsolldrehzahl bei Kurztest SekundÑrluftdiagnose" VALUE 0x819087 ME7_FW1 0 nmot_ub_q10 0.000000 2550.000000 /end CHARACTERISTIC
/begin CHARACTERISTIC NLLM "Solldrehzahl" CURVE 0x8197FB ME7_GKL1 0 nmot_ub_q10 0.000000 2550.000000
 /begin AXIS_DESCR COM_AXIS tmot temp_ub_q0p75_o48 0 -48.000000 143.250000 AXIS_PTS_REF STM06LLUB /end AXIS_DESCR
/end CHARACTERISTIC
/begin CHARACTERISTIC NLLMIN_0_A "Minimale zulÑssige Solldrehzahl" VALUE 0x81CBBC ME7_FW1 0 nmot_ub_q10 0.000000 2550.000000 /end CHARACTERISTIC
/begin CHARACTERISTIC NLLMIN_1_A "Minimale zulÑssige Solldrehzahl" VALUE 0x81CBBD ME7_FW1 0 nmot_ub_q10 0.000000 2550.000000 /end CHARACTERISTIC
/begin CHARACTERISTIC NLLMIN_2_A "Minimale zulÑssige Solldrehzahl" VALUE 0x81CBBE ME7_FW1 0 nmot_ub_q10 0.000000 2550.000000 /end CHARACTERISTIC
/begin CHARACTERISTIC NLLMIN_3_A "Minimale zulÑssige Solldrehzahl" VALUE 0x81CBBF ME7_FW1 0 nmot_ub_q10 0.000000 2550.000000 /end CHARACTERISTIC
/begin CHARACTERISTIC NLPST1T "Wartezeit 1 im NLP-Lernen" VALUE 0x814EC2 ME7_FW1 0 t10msxs_ub_b2p55 0.010000 2.550000 EXTENDED_LIMITS 0.000000 2.550000 /end CHARACTERISTIC
/begin CHARACTERISTIC NLPST2T "Wartezeit 2 im NLP-Lernen" VALUE 0x814EC3 ME7_FW1 0 t10msxs_ub_b2p55 0.010000 2.550000 EXTENDED_LIMITS 0.000000 2.550000 /end CHARACTERISTIC
/begin CHARACTERISTIC NLRHO "obere Drehzahlgrenze fÅr Regelung hinter Kat" VALUE 0x815E9C ME7_FW1 0 nmot_ub_q40 0.000000 10200.000000 /end CHARACTERISTIC
/begin CHARACTERISTIC NLRHU "untere Drehzahlgrenze fÅr Regelung hinter Kat" VALUE 0x815E9D ME7_FW1 0 nmot_ub_q40 0.000000 10200.000000 /end CHARACTERISTIC
/begin CHARACTERISTIC NLRKA "Drehzahlschwelle fÅr UnterdrÅcken gesteuertes Kat-AusrÑumen" VALUE 0x815E92 ME7_FW1 0 nmot_ub_q40 0.000000 10200.000000 /end CHARACTERISTIC
/begin CHARACTERISTIC NLRSHB "Drehzahlschwelle, Abschalten LR bei Schub, in Verbindung mit LL und TLLRSHB" VALUE 0x815E8B ME7_FW1 0 nmot_ub_q40 0.000000 10200.000000 /end CHARACTERISTIC
/begin CHARACTERISTIC NLS_AOG "oberer Grenzwert Anpassung LL-Solldrehzahl" VALUE 0x81545A ME7_FW2 0 nmot_q10 -1280.000000 1270.000000 /end CHARACTERISTIC
/begin CHARACTERISTIC NLS_AUG "unterer Grenzwert Anpassung LL-Solldrehzahl" VALUE 0x81545B ME7_FW2 0 nmot_q10 -1280.000000 1270.000000 /end CHARACTERISTIC
/begin CHARACTERISTIC NMAX "Drehzahlbegrenzung" VALUE 0x81345C ME7_FW3 0 nmot_uw_q0p25 0.000000 16383.800000 EXTENDED_LIMITS 0.000000 16383.750000 /end CHARACTERISTIC
/begin CHARACTERISTIC NMAXDV "Drehzahlbegrenzung bei Fehlererkennung Geschwindigkeitssignal" VALUE 0x81345E ME7_FW3 0 nmot_uw_q0p25 0.000000 10200.000000 EXTENDED_LIMITS 0.000000 16383.750000 /end CHARACTERISTIC
/begin CHARACTERISTIC NMAXDVG "Drehzahlbegrenzung bei Fehlererkennung Geschwindigkeitssignal" CURVE 0x81D2E8 ME7_GKL3 0 nmot_uw_q0p25 0.000000 16383.800000
 /begin AXIS_DESCR COM_AXIS gangi dez 0 0.000000 255.000000 AXIS_PTS_REF SGA08MDUB /end AXIS_DESCR
 EXTENDED_LIMITS 0.000000 16383.750000 /end CHARACTERISTIC
/begin CHARACTERISTIC NMAXF "Fehlererkennung nmax - öberschreitung" VALUE 0x810BAA ME7_FW3 0 nmot_uw_q0p25 0.000000 16383.800000 EXTENDED_LIMITS 0.000000 16383.750000 /end CHARACTERISTIC
/begin CHARACTERISTIC NMAXKBI "Drehzahl bei maximalem Moment fÅr Ausgabe an Kombi" VALUE 0x8144EE ME7_FW1 0 nmotg_ub_q100 0.000000 25500.000000 /end CHARACTERISTIC
/begin CHARACTERISTIC NMAXNL "Drehzahlgrenze, Drehzahlgeber-Notlauf" VALUE 0x813460 ME7_FW3 0 nmot_uw_q0p25 0.000000 16383.800000 EXTENDED_LIMITS 0.000000 16383.750000 /end CHARACTERISTIC
/begin CHARACTERISTIC NMAXOG "erhîhte Drehzahlgrenze" VALUE 0x813462 ME7_FW3 0 nmot_uw_q0p25 0.000000 16383.800000 EXTENDED_LIMITS 0.000000 16383.750000 /end CHARACTERISTIC
/begin CHARACTERISTIC NMIALU "Min. Drehzahl fÅr Ausblendung der Aussetzererkennung" VALUE 0x8147FF ME7_FW1 0 nmot_ub_q40 0.000000 10200.000000 /end CHARACTERISTIC
/begin CHARACTERISTIC NMIDLU "Min. Drehzahl fÅr Ausblendung der Aussetzererkennung DMDDLU" VALUE 0x8147FC ME7_FW1 0 nmot_ub_q40 0.000000 10200.000000 /end CHARACTERISTIC
/begin CHARACTERISTIC NMIN "Minimal Drehzahl" VALUE 0x810B84 ME7_FW3 0 nmot_uw_q0p25 0.000000 16383.800000 EXTENDED_LIMITS 0.000000 16383.750000 /end CHARACTERISTIC
/begin CHARACTERISTIC NMINVMX "Minimale Drehzahlschwelle zur VMAX-Regelung" VALUE 0x815A5E ME7_FW1 0 nmot_ub_q40 0.000000 10200.000000 /end CHARACTERISTIC
/begin CHARACTERISTIC NMIN_UM "minimale Drehzahl fÅr MotordrehzahlÅberwachung der FunktionsÅberwachung" VALUE 0x814006 ME7_FW1 0 nmot_ub_q40 520.000000 10200.000000 EXTENDED_LIMITS 0.000000 10200.000000 /end CHARACTERISTIC
/begin CHARACTERISTIC NMN_DUF "Drehzahl-Schwelle fÅrs Setzen der Zyklusflags der FunktionsÅberwachungs-Diagnose" VALUE 0x815E16 ME7_FW1 0 nmot_ub_q40 0.000000 10200.000000 /end CHARACTERISTIC
/begin CHARACTERISTIC NMOTQSYN "Motordrehzahlschwelle zur Freigabe des Schnellstarts Åber PG Schnellstart" VALUE 0x810B86 ME7_FW3 0 nmot_uw_q0p25 0.000000 700.000000 EXTENDED_LIMITS 0.000000 16383.750000 /end CHARACTERISTIC
/begin CHARACTERISTIC NMOT_DAT_UC "" VAL_BLK 0x815BFA ME7_FWB1 0 nmot_ub_q40 0.000000 10200.000000 NUMBER 16 /end CHARACTERISTIC
/begin CHARACTERISTIC NMXALU "Max. Drehzahl fÅr Ausblendung der Aussetzererkennung" VALUE 0x814800 ME7_FW1 0 nmot_ub_q40 0.000000 10200.000000 /end CHARACTERISTIC
/begin CHARACTERISTIC NMXDAEF "Maximaldrehzahl fÅr Drosselklappen-Antrieb-Ersatz-Funktion" CURVE 0x815974 ME7_KL97 0 nmot_ub_q40 0.000000 10200.000000
 /begin AXIS_DESCR STD_AXIS wped relPED_ub_b100 6 0.000000 100.000000 DEPOSIT ABSOLUTE /end AXIS_DESCR
/end CHARACTERISTIC
/begin CHARACTERISTIC NMXDKPU "Maximaldrehzahl bei unbekannter Drosselklappenposition" VALUE 0x813464 ME7_FW3 0 nmot_uw_q0p25 0.000000 16383.800000 EXTENDED_LIMITS 0.000000 16383.750000 /end CHARACTERISTIC
/begin CHARACTERISTIC NMXPG "P-Glied bei NMAX-Regelung" CURVE 0x8199D2 ME7_GKL1 0 relnmot_q0p0039 0.000000 0.996094
 /begin AXIS_DESCR COM_AXIS gangi dez 0 0.000000 255.000000 AXIS_PTS_REF SGA08MDUB /end AXIS_DESCR
/end CHARACTERISTIC
/begin CHARACTERISTIC NMXPRLG "P-Glied bei NMAX-Regelung" MAP 0x8199DA ME7_GKF1 0 relnmot_q0p0039 0.000000 0.996094
 /begin AXIS_DESCR COM_AXIS rl rel_ub_q0p75 0 0.000000 191.250000 AXIS_PTS_REF SRL08NXUB /end AXIS_DESCR
 /begin AXIS_DESCR COM_AXIS gangi dez 0 0.000000 255.000000 AXIS_PTS_REF SGA08MDUB /end AXIS_DESCR
/end CHARACTERISTIC
/begin CHARACTERISTIC NMXSKA "Maximaldrehzahl bei unbekannter Drosselklappenposition -> Ev-Abschaltung" VALUE 0x81517E ME7_FW1 0 nmot_ub_q40 0.000000 10200.000000 /end CHARACTERISTIC
/begin CHARACTERISTIC NNSTA "DrehzahlÅbergang Normal -> Start" CURVE 0x819A29 ME7_KL97 0 nmot_ub_q40 0.000000 10200.000000
 /begin AXIS_DESCR STD_AXIS tans temp_ub_q0p75_o48 3 -48.000000 143.250000 DEPOSIT ABSOLUTE /end AXIS_DESCR
/end CHARACTERISTIC
/begin CHARACTERISTIC NO1 "obere Drehzahlschwelle Bereich 1" VALUE 0x818B0E ME7_FW1 0 nmot_ub_q40 0.000000 10200.000000 /end CHARACTERISTIC
/begin CHARACTERISTIC NOASR "Wert fÅr inaktiver ASR-Botschaft" VALUE 0x8144EF ME7_FW1 0 rel_ub_b99p6 0.000000 99.609400 EXTENDED_LIMITS 0.000000 99.609375 /end CHARACTERISTIC
/begin CHARACTERISTIC NOASR_UC "" VALUE 0x815C7E ME7_FW1 0 rel_ub_q0p3906___UB 0.000000 99.609400 EXTENDED_LIMITS 0.000000 99.609375 /end CHARACTERISTIC
/begin CHARACTERISTIC NOASR_UM "Inaktivmaske fÅr ASR" VALUE 0x814073 ME7_FW1 0 rel_ub_q0p3906___UB 0.000000 99.609400 EXTENDED_LIMITS 0.000000 99.609375 /end CHARACTERISTIC
/begin CHARACTERISTIC NOLRA "Codewort fÅr Adaptionsfreigabe" VALUE 0x818B0F ME7_FW1 0 dez 0.000000 255.000000 /end CHARACTERISTIC
/begin CHARACTERISTIC NOREA_UM "Kennung zur Anforderung kein Motorbetrieb mîglich aus %UFREAC der FunktionsÅberw" VALUE 0x814206 ME7_FW1 0 dez 0.000000 255.000000 /end CHARACTERISTIC
/begin CHARACTERISTIC NOVZTE "Codeword fÅr Soll-TastverhÑltnis nicht verzîgern" VALUE 0x815E89 ME7_FW1 0 dez 0.000000 255.000000 /end CHARACTERISTIC
/begin CHARACTERISTIC NRKAB "Mindestdrehzahl fÅr Begrenzung Stelleingriff rkat bei niedrigen Drehzahlen" VALUE 0x8151CA ME7_FW1 0 nmot_ub_q40 0.000000 10200.000000 /end CHARACTERISTIC
/begin CHARACTERISTIC NRLIP_UM "Motordrehzahl-Schwelle fÅr den rl/rlip-Vergleich in der FunktionsÅberwachg" VALUE 0x814063 ME7_FW1 0 nmot_ub_q40 0.000000 10200.000000 /end CHARACTERISTIC
/begin CHARACTERISTIC NRLMN "Minimaldrehzahl zur Berechnung von umsrln" VALUE 0x811B8E ME7_FW3 0 nmot_uw_q0p25 0.000000 16383.800000 EXTENDED_LIMITS 0.000000 16383.750000 /end CHARACTERISTIC
/begin CHARACTERISTIC NRLMNLLR "Minimaldrehzahl zur Berechnung von umsrln im LL" VALUE 0x811B90 ME7_FW3 0 nmot_uw_q0p25 0.000000 16383.800000 EXTENDED_LIMITS 0.000000 16383.750000 /end CHARACTERISTIC
/begin CHARACTERISTIC NRUBMX "Maximale Drehzahl fÅr Batteriespannungsregelung" VALUE 0x81858E ME7_FW1 0 nmot_ub_q10 0.000000 2550.000000 /end CHARACTERISTIC
/begin CHARACTERISTIC NSACFS_0_A "Solldrehzahl bei Klimaanlage ein (S_AC = 1) und eingelegter Fahrstufe (S_fs=1)" VALUE 0x81721E ME7_FW1 0 nmot_ub_q10 0.000000 2550.000000 /end CHARACTERISTIC
/begin CHARACTERISTIC NSACFS_1_A "Solldrehzahl bei Klimaanlage ein (S_AC = 1) und eingelegter Fahrstufe (S_fs=1)" VALUE 0x81721F ME7_FW1 0 nmot_ub_q10 0.000000 2550.000000 /end CHARACTERISTIC
/begin CHARACTERISTIC NSAC_0_A "Solldrehzahl bei Klimaanlage ein (S_AC = 1)" VALUE 0x81721C ME7_FW1 0 nmot_ub_q10 0.000000 2550.000000 /end CHARACTERISTIC
/begin CHARACTERISTIC NSAC_1_A "Solldrehzahl bei Klimaanlage ein (S_AC = 1)" VALUE 0x81721D ME7_FW1 0 nmot_ub_q10 0.000000 2550.000000 /end CHARACTERISTIC
/begin CHARACTERISTIC NSC_T_UM "NachstartÅberwachungszeit fÅr die FunktionsÅberwachung" VALUE 0x814218 ME7_FW3 0 t40msxs_uw_q0p04 0.000000 2621.400000 /end CHARACTERISTIC
/begin CHARACTERISTIC NSHLL "Mindestsolldrehzahl bei Hei·-Leerlauf" VALUE 0x815562 ME7_FW1 0 nmot_ub_q10 0.000000 2550.000000 /end CHARACTERISTIC
/begin CHARACTERISTIC NSKO_0_A "Solldrehzahl fÅr Klimaanlage" VALUE 0x81CBC0 ME7_FW1 0 nmot_ub_q10 0.000000 2550.000000 /end CHARACTERISTIC
/begin CHARACTERISTIC NSKO_1_A "Solldrehzahl fÅr Klimaanlage" VALUE 0x81CBC1 ME7_FW1 0 nmot_ub_q10 0.000000 2550.000000 /end CHARACTERISTIC
/begin CHARACTERISTIC NSKO_2_A "Solldrehzahl fÅr Klimaanlage" VALUE 0x81CBC2 ME7_FW1 0 nmot_ub_q10 0.000000 2550.000000 /end CHARACTERISTIC
/begin CHARACTERISTIC NSKO_3_A "Solldrehzahl fÅr Klimaanlage" VALUE 0x81CBC3 ME7_FW1 0 nmot_ub_q10 0.000000 2550.000000 /end CHARACTERISTIC
/begin CHARACTERISTIC NSKS "Solldrehzahl fÅr Kochschutz" VALUE 0x815563 ME7_FW1 0 nmot_ub_q10 0.000000 2550.000000 /end CHARACTERISTIC
/begin CHARACTERISTIC NSL "Solldrehzahl bei Servolenkung aktiv" VALUE 0x819801 ME7_FW1 0 nmot_ub_q10 0.000000 2550.000000 /end CHARACTERISTIC
/begin CHARACTERISTIC NSLBZFS "Solldrehzahl bei entladener Batterie bei B_fs=1" VALUE 0x819802 ME7_FW1 0 nmot_ub_q10 0.000000 2550.000000 /end CHARACTERISTIC
/begin CHARACTERISTIC NSLBZLL "Solldrehzahl bei entladener Batterie" VALUE 0x819803 ME7_FW1 0 nmot_ub_q10 0.000000 2550.000000 /end CHARACTERISTIC
/begin CHARACTERISTIC NSLBZS "Drehzahlschwelle zur Umschaltung der Solldrehzahl durch lbz" VALUE 0x819804 ME7_FW1 0 nmot_ub_q40 0.000000 10200.000000 /end CHARACTERISTIC
/begin CHARACTERISTIC NSLFAKAT "Solldrehzahl bei Kurztrip Katdiagnose" VALUE 0x8156E4 ME7_FW1 0 nmot_ub_q10 0.000000 2550.000000 /end CHARACTERISTIC
/begin CHARACTERISTIC NSLFASH "Solldrehzahl bei Kurztrip SchwingungsprÅfung" VALUE 0x8156E5 ME7_FW1 0 nmot_ub_q10 0.000000 2550.000000 /end CHARACTERISTIC
/begin CHARACTERISTIC NSLKVS "Solldrehzahl bei Kurztrip Diagnose Kraftstoffversorgung" VALUE 0x8156E6 ME7_FW1 0 nmot_ub_q10 0.000000 2550.000000 /end CHARACTERISTIC
/begin CHARACTERISTIC NSLLSH "Solldrehzahl bei Kurztrip Lambdasonde hinter Kat" VALUE 0x8156E7 ME7_FW1 0 nmot_ub_q10 0.000000 2550.000000 /end CHARACTERISTIC
/begin CHARACTERISTIC NSLPP "Solldrehzahl abhÑngig vom Pumpendruck der Servolenkung" CURVE 0x819805 ME7_KL97 0 nmot_ub_q10 0.000000 2550.000000 /begin AXIS_DESCR STD_AXIS psl dez 4 0.000000 255.000000 DEPOSIT ABSOLUTE /end AXIS_DESCR /end CHARACTERISTIC
/begin CHARACTERISTIC NSLPPFS "Solldrehzahl abhÑngig vom Pumpendruck der Servolenkung bei B_fs=1" CURVE 0x81980E ME7_KL97 0 nmot_ub_q10 0.000000 2550.000000 /begin AXIS_DESCR STD_AXIS psl dez 4 0.000000 255.000000 DEPOSIT ABSOLUTE /end AXIS_DESCR /end CHARACTERISTIC
/begin CHARACTERISTIC NSLPWG "Solldrehzahl bei Ausfall PWG-Signale" VALUE 0x815564 ME7_FW1 0 nmot_ub_q10 0.000000 2550.000000 /end CHARACTERISTIC
/begin CHARACTERISTIC NSNOT "Solldrehzahlanhebung bei B_nnot=1" VALUE 0x815565 ME7_FW1 0 nmot_ub_q10 0.000000 2550.000000 /end CHARACTERISTIC
/begin CHARACTERISTIC NSOF_T_UM "Entprellzeit fÅr Abschaltung der Nachstartaufweitung" VALUE 0x814007 ME7_FW1 0 t40ms_ub_b10200 0.000000 10200.000000 /end CHARACTERISTIC
/begin CHARACTERISTIC NSTAMXHA "HîhenabhÑngige Drehzahlschwelle fÅr STADAP aktiv" CURVE 0x818B16 ME7_KL97 0 nmot_ub_q40 0.000000 10200.000000
 /begin AXIS_DESCR STD_AXIS fho fak_ub_b4 16 0.000000 3.984380 DEPOSIT ABSOLUTE /end AXIS_DESCR
/end CHARACTERISTIC
/begin CHARACTERISTIC NSTART "Motordrehzahlschwelle fÅr Unterdrehzahl-Ausstieg bei Nachstartaufweitung" VALUE 0x815A49 ME7_FW1 0 nmot_ub_q40 0.000000 10200.000000 /end CHARACTERISTIC
/begin CHARACTERISTIC NSTEND "Motordrehzahlschwelle fÅr Start Ende bei Nachstartaufweitung" VALUE 0x815A4A ME7_FW1 0 nmot_ub_q40 0.000000 10200.000000 /end CHARACTERISTIC
/begin CHARACTERISTIC NSTNM "öbergang Start -> Normal" CURVE 0x819A30 ME7_KL97 0 nmot_ub_q40 0.000000 10200.000000
 /begin AXIS_DESCR STD_AXIS tmot temp_ub_q0p75_o48 3 -48.000000 143.250000 DEPOSIT ABSOLUTE /end AXIS_DESCR
/end CHARACTERISTIC
/begin CHARACTERISTIC NSWO1 "Drehzahlschwelle 1 Umschaltg. zur Rechenzeitersparnis" VALUE 0x814325 ME7_FW1 0 nmot_ub_q40 0.000000 10200.000000 /end CHARACTERISTIC
/begin CHARACTERISTIC NSWO2 "Drehzahlschwelle 2 Umschaltg. zur Rechenzeitersparnis" VALUE 0x814326 ME7_FW1 0 nmot_ub_q40 0.000000 10200.000000 /end CHARACTERISTIC
/begin CHARACTERISTIC NTEB "Angehobene Solldrehzahl bei stark beladenem AKF" VALUE 0x815566 ME7_FW1 0 nmot_ub_q10 0.000000 2550.000000 /end CHARACTERISTIC
/begin CHARACTERISTIC NTEBFS "Angehobene Solldrehzahl bei stark beladenem AKF und B_fs=1" VALUE 0x815567 ME7_FW1 0 nmot_ub_q10 0.000000 2550.000000 /end CHARACTERISTIC
/begin CHARACTERISTIC NTPKTO "obere Drehzahlschwelle fÅr Periodendauer-Kurztest" VALUE 0x814D9A ME7_FW1 0 nmot_ub_q40 0.000000 10200.000000 /end CHARACTERISTIC
/begin CHARACTERISTIC NTPKTU "untere Drehzahlschwelle fÅr Periodendauer-Kurztest" VALUE 0x814D9B ME7_FW1 0 nmot_ub_q40 0.000000 10200.000000 /end CHARACTERISTIC
/begin CHARACTERISTIC NTPVKO "obere Drehzahlschwelle fÅr PeriodendauerÅberwachung vor Kat" VALUE 0x814D9C ME7_FW1 0 nmot_ub_q40 0.000000 10200.000000 /end CHARACTERISTIC
/begin CHARACTERISTIC NTPVKU "untere Drehzahlschwelle fÅr PeriodendauerÅberwachung vor Kat" VALUE 0x814D9D ME7_FW1 0 nmot_ub_q40 0.000000 10200.000000 /end CHARACTERISTIC
/begin CHARACTERISTIC NTUMTA "Schwelle Drehzahl fÅr Bestimmung Umgebungstemperatur" VALUE 0x818E12 ME7_FW1 0 nmot_ub_q40 0.000000 10200.000000 /end CHARACTERISTIC
/begin CHARACTERISTIC NTUMTAT "Schwelle Drehzahl fÅr Bestimmung Umgebungstemperatur aus TANS" VALUE 0x81849A ME7_FW1 0 nmot_ub_q40 0.000000 10200.000000 /end CHARACTERISTIC
/begin CHARACTERISTIC NU3 "untere Drehzahlschwelle Bereich 3" VALUE 0x818B10 ME7_FW1 0 nmot_ub_q40 0.000000 10200.000000 /end CHARACTERISTIC
/begin CHARACTERISTIC NUKAO "obere Drehzahlgrenze fÅr öK-Adaption" VALUE 0x8153F7 ME7_FW1 0 nmot_ub_q40 0.000000 10200.000000 /end CHARACTERISTIC
/begin CHARACTERISTIC NUKAU "untere Drehzahlgrenze fÅr öK-Adaption" VALUE 0x8153F8 ME7_FW1 0 nmot_ub_q40 0.000000 10200.000000 /end CHARACTERISTIC
/begin CHARACTERISTIC NVERZMN "minimale Drehzahl fÅr Verzîgerung" VALUE 0x813534 ME7_FW3 0 nmot_uw_q0p25 0.000000 16383.800000 EXTENDED_LIMITS 0.000000 16383.750000 /end CHARACTERISTIC
/begin CHARACTERISTIC NVQUOT1O_0_A "Gangerkennung n/v 1 Gang oben" VALUE 0x810C08 ME7_FW3 0 qnv_uw_b512 0.000000 511.992000 EXTENDED_LIMITS 0.000000 511.992188 /end CHARACTERISTIC
/begin CHARACTERISTIC NVQUOT1O_1_A "Gangerkennung n/v 1 Gang oben" VALUE 0x810C0A ME7_FW3 0 qnv_uw_b512 0.000000 511.992000 EXTENDED_LIMITS 0.000000 511.992188 /end CHARACTERISTIC
/begin CHARACTERISTIC NVQUOT1U_0_A "Gangerekennung n/v 1 Gang unten" VALUE 0x810C0C ME7_FW3 0 qnv_uw_b512 0.000000 511.992000 EXTENDED_LIMITS 0.000000 511.992188 /end CHARACTERISTIC
/begin CHARACTERISTIC NVQUOT1U_1_A "Gangerekennung n/v 1 Gang unten" VALUE 0x810C0E ME7_FW3 0 qnv_uw_b512 0.000000 511.992000 EXTENDED_LIMITS 0.000000 511.992188 /end CHARACTERISTIC
/begin CHARACTERISTIC NVQUOT2O_0_A "Gangerkennung n/v 2 Gang oben" VALUE 0x810C10 ME7_FW3 0 qnv_uw_b512 0.000000 511.992000 EXTENDED_LIMITS 0.000000 511.992188 /end CHARACTERISTIC
/begin CHARACTERISTIC NVQUOT2O_1_A "Gangerkennung n/v 2 Gang oben" VALUE 0x810C12 ME7_FW3 0 qnv_uw_b512 0.000000 511.992000 EXTENDED_LIMITS 0.000000 511.992188 /end CHARACTERISTIC
/begin CHARACTERISTIC NVQUOT2U_0_A "Gangerkennung n/v 2 Gang unten" VALUE 0x810C14 ME7_FW3 0 qnv_uw_b512 0.000000 511.992000 EXTENDED_LIMITS 0.000000 511.992188 /end CHARACTERISTIC
/begin CHARACTERISTIC NVQUOT2U_1_A "Gangerkennung n/v 2 Gang unten" VALUE 0x810C16 ME7_FW3 0 qnv_uw_b512 0.000000 511.992000 EXTENDED_LIMITS 0.000000 511.992188 /end CHARACTERISTIC
/begin CHARACTERISTIC NVQUOT3O_0_A "Gangerkennung n/v 3 Gang oben" VALUE 0x810C18 ME7_FW3 0 qnv_uw_b512 0.000000 511.992000 EXTENDED_LIMITS 0.000000 511.992188 /end CHARACTERISTIC
/begin CHARACTERISTIC NVQUOT3O_1_A "Gangerkennung n/v 3 Gang oben" VALUE 0x810C1A ME7_FW3 0 qnv_uw_b512 0.000000 511.992000 EXTENDED_LIMITS 0.000000 511.992188 /end CHARACTERISTIC
/begin CHARACTERISTIC NVQUOT3U_0_A "Gangerkennung n/v 3 Gang unten" VALUE 0x810C1C ME7_FW3 0 qnv_uw_b512 0.000000 511.992000 EXTENDED_LIMITS 0.000000 511.992188 /end CHARACTERISTIC
/begin CHARACTERISTIC NVQUOT3U_1_A "Gangerkennung n/v 3 Gang unten" VALUE 0x810C1E ME7_FW3 0 qnv_uw_b512 0.000000 511.992000 EXTENDED_LIMITS 0.000000 511.992188 /end CHARACTERISTIC
/begin CHARACTERISTIC NVQUOT4O_0_A "Gangerkennung n/v 4 Gang oben" VALUE 0x810C20 ME7_FW3 0 qnv_uw_b512 0.000000 511.992000 EXTENDED_LIMITS 0.000000 511.992188 /end CHARACTERISTIC
/begin CHARACTERISTIC NVQUOT4O_1_A "Gangerkennung n/v 4 Gang oben" VALUE 0x810C22 ME7_FW3 0 qnv_uw_b512 0.000000 511.992000 EXTENDED_LIMITS 0.000000 511.992188 /end CHARACTERISTIC
/begin CHARACTERISTIC NVQUOT4U_0_A "Gangerkennung n/v 4 Gang unten" VALUE 0x810C24 ME7_FW3 0 qnv_uw_b512 0.000000 511.992000 EXTENDED_LIMITS 0.000000 511.992188 /end CHARACTERISTIC
/begin CHARACTERISTIC NVQUOT4U_1_A "Gangerkennung n/v 4 Gang unten" VALUE 0x810C26 ME7_FW3 0 qnv_uw_b512 0.000000 511.992000 EXTENDED_LIMITS 0.000000 511.992188 /end CHARACTERISTIC
/begin CHARACTERISTIC NVQUOT5O_0_A "Gangerkennung n/v 5 Gang oben" VALUE 0x810C28 ME7_FW3 0 qnv_uw_b512 0.000000 511.992000 EXTENDED_LIMITS 0.000000 511.992188 /end CHARACTERISTIC
/begin CHARACTERISTIC NVQUOT5O_1_A "Gangerkennung n/v 5 Gang oben" VALUE 0x810C2A ME7_FW3 0 qnv_uw_b512 0.000000 511.992000 EXTENDED_LIMITS 0.000000 511.992188 /end CHARACTERISTIC
/begin CHARACTERISTIC NVQUOT5U_0_A "Gangerkennung n/v 5 Gang unten" VALUE 0x810C2C ME7_FW3 0 qnv_uw_b512 0.000000 511.992000 EXTENDED_LIMITS 0.000000 511.992188 /end CHARACTERISTIC
/begin CHARACTERISTIC NVQUOT5U_1_A "Gangerkennung n/v 5 Gang unten" VALUE 0x810C2E ME7_FW3 0 qnv_uw_b512 0.000000 511.992000 EXTENDED_LIMITS 0.000000 511.992188 /end CHARACTERISTIC
/begin CHARACTERISTIC NVQUOT6O "Gangerkennung n/v 6 Gang oben" VALUE 0x810C00 ME7_FW3 0 qnv_uw_b512 0.000000 511.992000 EXTENDED_LIMITS 0.000000 511.992188 /end CHARACTERISTIC
/begin CHARACTERISTIC NVQUOT6U "Gangerkennung n/v 6 Gang unten" VALUE 0x810C02 ME7_FW3 0 qnv_uw_b512 0.000000 511.992000 EXTENDED_LIMITS 0.000000 511.992188 /end CHARACTERISTIC
/begin CHARACTERISTIC NWAFMN "Minimaldrehzahl fÅr Freigabe Winkeladaption NW-Flanken" VALUE 0x814D62 ME7_FW1 0 nmot_ub_q40 0.000000 10200.000000 /end CHARACTERISTIC
/begin CHARACTERISTIC NWAFMX "Maximaldrehzahl fÅr Freigabe Winkeladaption NW-Flanken" VALUE 0x814D63 ME7_FW1 0 nmot_ub_q40 0.000000 10200.000000 /end CHARACTERISTIC
/begin CHARACTERISTIC NWDK3 "Minimaldrehzahl fÅr Berechnung DK-Winkel-Ersatzwert aus FÅllungssignal" VALUE 0x814E84 ME7_FW1 0 nmot_ub_q40 200.000000 10200.000000 EXTENDED_LIMITS 0.000000 10200.000000 /end CHARACTERISTIC
/begin CHARACTERISTIC NWECVTM "Wiedereinsetzdrehzahl bei CVT-Getriebe" CURVE 0x8197A8 ME7_GKL1 0 nmot_ub_q40 0.000000 10200.000000
 /begin AXIS_DESCR COM_AXIS tmot temp_ub_q0p75_o48 0 -48.000000 143.250000 AXIS_PTS_REF STM05SAUB /end AXIS_DESCR
/end CHARACTERISTIC
/begin CHARACTERISTIC NWENG "Wiedereinsetzdrehzahl" CURVE 0x812850 ME7_KL103 0 nmot_ub_q40 0.000000 10200.000000
 /begin AXIS_DESCR STD_AXIS ngfil nmotg_sb_q100 5 -12800.000000 12700.000000 DEPOSIT ABSOLUTE /end AXIS_DESCR
/end CHARACTERISTIC
/begin CHARACTERISTIC NWPMBBR "Mindestdrehzahl fÅr Pedalwertbegrenzung bei betÑtigter Bremse" VALUE 0x814DB8 ME7_FW1 0 nmot_ub_q40 0.000000 10200.000000 /end CHARACTERISTIC
/begin CHARACTERISTIC NWSOS "Nockenwellensteuerung obere Schaltschwelle" VALUE 0x8188B6 ME7_FW1 0 fak_ub_b2 0.000000 1.992190 EXTENDED_LIMITS 0.000000 1.992188 /end CHARACTERISTIC
/begin CHARACTERISTIC NWSUS "Nockenwellensteuerung untere Schaltschwelle" VALUE 0x8188B7 ME7_FW1 0 fak_ub_b2 0.000000 1.992190 EXTENDED_LIMITS 0.000000 1.992188 /end CHARACTERISTIC
/begin CHARACTERISTIC NZHDTL "Drehzahlschwelle fÅr ZeitzÑhler Hei·-Leerlauf dekrementieren abh. von TL" CURVE 0x819817 ME7_KL97 0 nmot_ub_q40 0.000000 10200.000000
 /begin AXIS_DESCR STD_AXIS rl rel_ub_q0p75 4 0.000000 191.250000 DEPOSIT ABSOLUTE /end AXIS_DESCR
/end CHARACTERISTIC
/begin CHARACTERISTIC NZHITL "Drehzahlschwelle fÅr ZeitzÑhler Hei·-Leerlauf inkrementieren abh. von TL" CURVE 0x819820 ME7_KL97 0 nmot_ub_q40 0.000000 10200.000000
 /begin AXIS_DESCR STD_AXIS rl rel_ub_q0p75 4 0.000000 191.250000 DEPOSIT ABSOLUTE /end AXIS_DESCR
/end CHARACTERISTIC
/begin CHARACTERISTIC NZMSE "Drehzahlgrenze fÅr sicheres Verlassen der ZMS-Resonanz" VALUE 0x81EBAE ME7_FW3 0 nmot_uw_q0p25 0.000000 16383.800000 EXTENDED_LIMITS 0.000000 16383.750000 /end CHARACTERISTIC
/begin CHARACTERISTIC NZMSMN "untere Drehzahlgrenze fÅr ZMS-Schutz" VALUE 0x81EBB0 ME7_FW3 0 nmot_uw_q0p25 0.000000 16383.800000 EXTENDED_LIMITS 0.000000 16383.750000 /end CHARACTERISTIC
/begin CHARACTERISTIC NZMSMX "obere Drehzahlgrenze fÅr ZMS-Schutz" VALUE 0x81EBB2 ME7_FW3 0 nmot_uw_q0p25 0.000000 16383.800000 EXTENDED_LIMITS 0.000000 16383.750000 /end CHARACTERISTIC
/begin CHARACTERISTIC N_START_UM "Motordrehzahlschwelle fÅr Unterdrehzahl-Ausstieg fÅr die Fkt.-öberwachung" VALUE 0x814008 ME7_FW1 0 nmot_ub_q40 0.000000 10200.000000 /end CHARACTERISTIC
/begin CHARACTERISTIC N_STEND_UM "Motordrehzahlschwelle fÅr Startende in der Fkt.-öberwachung" VALUE 0x814009 ME7_FW1 0 nmot_ub_q40 0.000000 10200.000000 /end CHARACTERISTIC
/begin CHARACTERISTIC OFQSYNADAP "Offset zwischen adaptierter Phasenflanke und Phasenflanke im Start" VALUE 0x810B88 ME7_FW4 0 kw_q0p0156 -36.000000 36.000000 EXTENDED_LIMITS -512.000000 511.984375 /end CHARACTERISTIC
/begin CHARACTERISTIC PAGAVML "Abgasgegendruck am Ausla·ventil" CURVE 0x81B54C ZF_KL111 0 p_uw_q0p039 0.000000 2559.960000
 /begin AXIS_DESCR STD_AXIS ml_w m_uw_b6553p5 6 0.000000 6553.500000 DEPOSIT ABSOLUTE /end AXIS_DESCR
 EXTENDED_LIMITS 0.000000 2559.960938 /end CHARACTERISTIC
/begin CHARACTERISTIC PGFLWA "Anzahl PG-Flankenwechsel fÅr DG-Fehler B_signal" VALUE 0x8183AC ME7_FW1 0 DEZ 0.000000 255.000000 /end CHARACTERISTIC
/begin CHARACTERISTIC PHNOKA "Anfangswert fÅr ZÑhler Phasensignal nicht ok" VALUE 0x814D68 ME7_FW1 0 dez 0.000000 255.000000 /end CHARACTERISTIC
/begin CHARACTERISTIC PH_MINSEG "SegmentlÑnge kurzes Segment beim Schnellstart-Phasengebersignal" VALUE 0x814D6D ME7_FW1 0 kw_q6 0.000000 90.000000 EXTENDED_LIMITS 0.000000 1530.000000 /end CHARACTERISTIC
/begin CHARACTERISTIC PIDLDSUA "PrÑdiktionsintervall fÅr dynamische Schubumluftventilansteuerung" VALUE 0x815489 ME7_FW1 0 fak_ub_b64 0.000000 63.750000 /end CHARACTERISTIC
/begin CHARACTERISTIC PLRHAV "Wichtungsfaktor des P-Anteils in der LRHK Åber KAT-Alterung" CURVE 0x815E9E ME7_KL97 0 fak_ub_b1 0.000000 0.996094
 /begin AXIS_DESCR STD_AXIS iavkatf fak_ub_b1 8 0.000000 0.996094 DEPOSIT ABSOLUTE /end AXIS_DESCR
/end CHARACTERISTIC
/begin CHARACTERISTIC PLRHML "P-Anteil LRHK, wirkt zusammen mit gewichteter Sondenspannungsdiff. hinter KAT" CURVE 0x819D0D ME7_GKL2 0 t100msxs_sb_q0p01 -1.280000 1.270000
 /begin AXIS_DESCR COM_AXIS ml m_ub_b1020 0 0.000000 1020.000000 AXIS_PTS_REF SML08LHUB /end AXIS_DESCR
/end CHARACTERISTIC
/begin CHARACTERISTIC PSAPES "Saugrohrdruck fÅr Applikation Einspritzung" VALUE 0x81B8E4 ME7_FW3 0 p_uw_q0p039 0.000000 2559.960000 EXTENDED_LIMITS 0.000000 2559.960938 /end CHARACTERISTIC
/begin CHARACTERISTIC PSPVDKUG "VerhÑltnis pspvdk ungedrosselt" VALUE 0x81B4AC ME7_FW3 0 fak_uw_b2 0.000000 1.999970 EXTENDED_LIMITS 0.000000 1.999969 /end CHARACTERISTIC
/begin CHARACTERISTIC PUDWG "pu- Schwelle fÅr Diagnose Waste- Gate" VALUE 0x819753 ME7_FW1 0 p_ub_q5 0.000000 1275.000000 /end CHARACTERISTIC
/begin CHARACTERISTIC PUE "Ersatzwert fÅr Umgebungsdruck" VALUE 0x81B4D6 ME7_FW3 0 p_uw_q0p039 0.000000 2559.960000 EXTENDED_LIMITS 0.000000 2559.960938 /end CHARACTERISTIC
/begin CHARACTERISTIC PUKANS "Pulsationskorrektur abhÑngig von Ansauglufttemperatur" CURVE 0x8185E8 ME7_KL97 0 fak_ub_b2 0.000000 1.992190
 /begin AXIS_DESCR STD_AXIS tans temp_ub_q0p75_o48 8 -48.000000 143.250000 DEPOSIT ABSOLUTE /end AXIS_DESCR
 EXTENDED_LIMITS 0.000000 1.992188 /end CHARACTERISTIC
/begin CHARACTERISTIC PUKORRV "Umgebungsdruckkorrektur abhÑngig von Fahrzeuggeschwindigkeit" CURVE 0x81D9D0 ZF_KL111 0 p_uw_q0p039 0.000000 2559.960000
 /begin AXIS_DESCR STD_AXIS vfzg_w vfzg_uw_b512 8 0.000000 511.992000 DEPOSIT ABSOLUTE /end AXIS_DESCR
 EXTENDED_LIMITS 0.000000 2559.960938 /end CHARACTERISTIC
/begin CHARACTERISTIC PUMN "Umgebungsdruckbegrenzung minimal" VALUE 0x81B4D8 ME7_FW3 0 p_uw_q0p039 0.000000 2559.960000 EXTENDED_LIMITS 0.000000 2559.960938 /end CHARACTERISTIC
/begin CHARACTERISTIC PUMX "Umgebungsdruckbegrenzung maximal" VALUE 0x81B4DA ME7_FW3 0 p_uw_q0p039 0.000000 2559.960000 EXTENDED_LIMITS 0.000000 2559.960938 /end CHARACTERISTIC
/begin CHARACTERISTIC PUSMAX "maximal plausible Umgebungsdruckschwelle" VALUE 0x81361E ME7_FW3 0 p_uw_q0p039 0.000000 2559.960000 EXTENDED_LIMITS 0.000000 2559.960938 /end CHARACTERISTIC
/begin CHARACTERISTIC PUSMIN "minimal plausible Umgebungsdruckschwelle" VALUE 0x813620 ME7_FW3 0 p_uw_q0p039 0.000000 2559.960000 EXTENDED_LIMITS 0.000000 2559.960938 /end CHARACTERISTIC
/begin CHARACTERISTIC PUSPSMX "max. Abweichung von Umgebungsdruck und Saugrohrdruck" VALUE 0x81B4DC ME7_FW3 0 p_uw_q0p039 0.000000 2559.960000 EXTENDED_LIMITS 0.000000 2559.960938 /end CHARACTERISTIC
/begin CHARACTERISTIC PVDKMN "pvdk min. Schwelle fÅr Fehlererkennung Ladedrucksensor" VALUE 0x81B4DE ME7_FW3 0 p_uw_q0p039 0.000000 2559.960000 EXTENDED_LIMITS 0.000000 2559.960938 /end CHARACTERISTIC
/begin CHARACTERISTIC PVDKMX "Ladedruckgrenze fÅr Diagnose max. Fehler" CURVE 0x81B4E0 ZF_KL111 0 p_uw_q0p039 0.000000 2559.960000
 /begin AXIS_DESCR STD_AXIS nmot_w nmot_uw_q0p25 4 0.000000 16383.800000 DEPOSIT ABSOLUTE /end AXIS_DESCR
 EXTENDED_LIMITS 0.000000 2559.960938 /end CHARACTERISTIC
/begin CHARACTERISTIC PVDKPSMX "max. Abweichung von Saugrohrdruck und Druck vor Drosselklappe" VALUE 0x81B4F2 ME7_FW3 0 p_uw_q0p039 0.000000 2559.960000 EXTENDED_LIMITS 0.000000 2559.960938 /end CHARACTERISTIC
/begin CHARACTERISTIC PVDN "LLR: P-VerstÑrkung bei stehendem Fahrzeug" CURVE 0x8156B1 ME7_GKL1 0 fak_q0p00153 0.000000 0.389099
 /begin AXIS_DESCR COM_AXIS dn nmotd_sb_q10 0 -1280.000000 1270.000000 AXIS_PTS_REF SDN06LLSB /end AXIS_DESCR
/end CHARACTERISTIC
/begin CHARACTERISTIC PVDNV "LLR: P-VerstÑrkung bei rollendem Fahrzeug" CURVE 0x8156B7 ME7_GKL1 0 fak_q0p00153 0.000000 0.389099
 /begin AXIS_DESCR COM_AXIS dn nmotd_sb_q10 0 -1280.000000 1270.000000 AXIS_PTS_REF SDN06LLSB /end AXIS_DESCR
/end CHARACTERISTIC
/begin CHARACTERISTIC PVLDN "LLR: P-VerstÑrkung bei stehendem Fahrzeug (Luftanteil)" CURVE 0x8156BD ME7_GKL1 0 fak_q0p00153 0.000000 0.389099
 /begin AXIS_DESCR COM_AXIS dn nmotd_sb_q10 0 -1280.000000 1270.000000 AXIS_PTS_REF SDN06LLSB /end AXIS_DESCR
/end CHARACTERISTIC
/begin CHARACTERISTIC PVLDNV "LLR: P-VerstÑrkung bei stehendem Fahrzeug (Luftanteil)" CURVE 0x8156C3 ME7_GKL1 0 fak_q0p00153 0.000000 0.389099
 /begin AXIS_DESCR COM_AXIS dn nmotd_sb_q10 0 -1280.000000 1270.000000 AXIS_PTS_REF SDN06LLSB /end AXIS_DESCR
/end CHARACTERISTIC
/begin CHARACTERISTIC PZWKRA "Prozentuale HÑufigkeit der ZW-Ausgabe durch die KR wÑhrend Dynamikadaption" VALUE 0x81543A ME7_FW1 0 rel_ub_b99p6 0.000000 99.609400 EXTENDED_LIMITS 0.000000 99.609375 /end CHARACTERISTIC
/begin CHARACTERISTIC P_ZYL "Abstand zur Bestimmung des arithmet Mittelwertes - DMDLU" VALUE 0x814AC0 ME7_FW1 0 dez 0.000000 7.000000 EXTENDED_LIMITS 0.000000 255.000000 /end CHARACTERISTIC
/begin CHARACTERISTIC QUFRMN "minimaler fri-Quotient fÅr StationÑrbedingung Lambdaregler" VALUE 0x813770 ME7_FW3 0 fak_uw_b2 0.000000 1.999970 EXTENDED_LIMITS 0.000000 1.999969 /end CHARACTERISTIC
/begin CHARACTERISTIC QUFRMX "maximaler fri-Quotient fÅr StationÑrbedingung Lambdaregler" VALUE 0x813772 ME7_FW3 0 fak_uw_b2 0.000000 1.999970 EXTENDED_LIMITS 0.000000 1.999969 /end CHARACTERISTIC
/begin CHARACTERISTIC RALEZMAX "Begrenzung der Anzahl rÅckwÑrts drehender ZÑhne im Auslauf" VALUE 0x814D69 ME7_FW1 0 dez 0.000000 127.000000 EXTENDED_LIMITS 0.000000 255.000000 /end CHARACTERISTIC
/begin CHARACTERISTIC RAMPASR "Rampensteilheit bei Aufregelung des ASR-Moments" VALUE 0x81017C ME7_FW3 0 zk10msxs_uw_b655 0.010000 655.360000 /end CHARACTERISTIC
/begin CHARACTERISTIC RBEL "Belastungswiderstand fÅr Pumpstrom-Erzeugung" VALUE 0x810BB8 ME7_FW3 0 r_uw_q2 0.000000 131070.000000 /end CHARACTERISTIC
/begin CHARACTERISTIC REAC_D1_UC "" VAL_BLK 0x815C0A ME7_FWB1 0 dez 0.000000 255.000000 NUMBER 16 /end CHARACTERISTIC
/begin CHARACTERISTIC REAC_D2_UC "" VAL_BLK 0x815C1A ME7_FWB1 0 dez 0.000000 255.000000 NUMBER 16 /end CHARACTERISTIC
/begin CHARACTERISTIC REAC_T1_UC "" VALUE 0x815E11 ME7_FW1 0 t40ms_ub_b10200 0.000000 10200.000000 /end CHARACTERISTIC
/begin CHARACTERISTIC REAC_T1_UM "Fehlerzeit bei der Funktions-FehlerreaktionsÅberwachung in der FunktionsÅberw." VALUE 0x814207 ME7_FW1 0 t40ms_ub_b10200 0.000000 10200.000000 /end CHARACTERISTIC
/begin CHARACTERISTIC REAC_T2_UC "" VALUE 0x815E12 ME7_FW1 0 t40ms_ub_b10200 0.000000 10200.000000 /end CHARACTERISTIC
/begin CHARACTERISTIC REAC_T2_UM "Fehlerzeit bei der FunktionsÅberwachungs-FehlerreaktionsÅberwachung" VALUE 0x814208 ME7_FW1 0 t40ms_ub_b10200 0.000000 10200.000000 /end CHARACTERISTIC
/begin CHARACTERISTIC REDABM "Ev-Abschaltmuster fÅr Momentenreduzierung" MAP 0x81517F ME7_FKF1 0 dez 0.000000 255.000000
 /begin AXIS_DESCR FIX_AXIS evrbgn_one dez___SL 8 0.000000 7.000000 FIX_AXIS_PAR 0 0 8 /end AXIS_DESCR
 /begin AXIS_DESCR FIX_AXIS redsol_one dez___SL 8 0.000000 7.000000 FIX_AXIS_PAR 0 0 8 /end AXIS_DESCR
/end CHARACTERISTIC
/begin CHARACTERISTIC REDHYOC "Hysterese der Reduzierstufe bei grî·erer Soll-Reduzierstufe als Ist-Wert" VALUE 0x815986 ME7_FW2 0 rel_sb_q0p02 -2.560000 2.540000 /end CHARACTERISTIC
/begin CHARACTERISTIC REDHYUC "Hysterese der Reduzierstufe bei kleinerer Soll-Reduzierstufe als Ist-Wert" VALUE 0x815987 ME7_FW2 0 rel_sb_q0p02 -2.560000 2.540000 /end CHARACTERISTIC
/begin CHARACTERISTIC REDMXSA "maximale Reduzierstufe bei sequentieller Schubabschaltung" VALUE 0x815988 ME7_FW1 0 dez 0.000000 255.000000 /end CHARACTERISTIC
/begin CHARACTERISTIC REDZEM "Schwelle zwischen ZÅndeingriff und Einspritzausblendung" CURVE 0x819A1A ME7_KL97 0 dez 0.000000 255.000000
 /begin AXIS_DESCR STD_AXIS tmot temp_ub_q0p75_o48 5 -48.000000 143.250000 DEPOSIT ABSOLUTE /end AXIS_DESCR
/end CHARACTERISTIC
/begin CHARACTERISTIC REFINI "Startwert Referenzpegel bei Klopfregelung aktiv" VALUE 0x815408 ME7_FW1 0 spg_ub_b5 0.292969 1.015630 EXTENDED_LIMITS 0.000000 4.980469 /end CHARACTERISTIC
/begin CHARACTERISTIC RFLAGS_D_UC "" VAL_BLK 0x815C2A ME7_FWB1 0 dez 0.000000 255.000000 NUMBER 16 /end CHARACTERISTIC
/begin CHARACTERISTIC RINHMX "Innenwiderstand Ri der Nernstsonde hinter KAT auf Maximalwert begrenzen" VALUE 0x810BBA ME7_FW3 0 r_uw_q2 0.000000 131070.000000 /end CHARACTERISTIC
/begin CHARACTERISTIC RINVMX "Innenwiderstand Ri der Nernstsonde auf Maximalwert begrenzen" VALUE 0x810BD0 ME7_FW3 0 r_uw_q2 0.000000 131070.000000 /end CHARACTERISTIC
/begin CHARACTERISTIC RISIGRESH "Schwelle fÅr Reset Signalunterbrechung mit Ri-Diagnose hinter KAT" VALUE 0x81AD36 ME7_FW3 0 r_uw_q2 0.000000 131070.000000 /end CHARACTERISTIC
/begin CHARACTERISTIC RISIGRESV "Schwelle fÅr Reset Signalunterbrechung mit Ri-Diagnose vor KAT" VALUE 0x81AD70 ME7_FW3 0 r_uw_q2 0.000000 131070.000000 /end CHARACTERISTIC
/begin CHARACTERISTIC RKADTEVO "obere rka Schwelle fÅr passive Einschaltbedingungen Diagnose TEV" VALUE 0x81D9AA ME7_FW4 0 rel_sw_b1536 0.000000 9.984380 EXTENDED_LIMITS -1536.000000 1535.953125 /end CHARACTERISTIC
/begin CHARACTERISTIC RKADTEVU "untere rka Schwelle fÅr passive Einschaltbedingungen Diagnose TEV" VALUE 0x81D9AC ME7_FW4 0 rel_sw_b1536 -9.984380 0.000000 EXTENDED_LIMITS -1536.000000 1535.953125 /end CHARACTERISTIC
/begin CHARACTERISTIC RKAE "Delta rkat- bzw. rkaz-Schwelle fÅr Erkennung der eingeschwungenen Grundadaption" VALUE 0x81BA14 ME7_FW4 0 rel_sw_b1536 -1536.000000 1535.950000 EXTENDED_LIMITS -1536.000000 1535.953125 /end CHARACTERISTIC
/begin CHARACTERISTIC RKATDN "untere Diagnoseschwelle additive Korrektur pro Zeit" VALUE 0x81BA16 ME7_FW4 0 rel_sw_b1536 -1536.000000 1535.950000 EXTENDED_LIMITS -1536.000000 1535.953125 /end CHARACTERISTIC
/begin CHARACTERISTIC RKATDX "obere Diagnoseschwelle additive Korrektur pro Zeit" VALUE 0x81BA18 ME7_FW4 0 rel_sw_b1536 -1536.000000 1535.950000 EXTENDED_LIMITS -1536.000000 1535.953125 /end CHARACTERISTIC
/begin CHARACTERISTIC RKATMN "untere Schwelle additive Korrektur pro Zeit" VALUE 0x81B86E ME7_FW4 0 rel_sw_b1536 -1536.000000 1535.950000 EXTENDED_LIMITS -1536.000000 1535.953125 /end CHARACTERISTIC
/begin CHARACTERISTIC RKATMX "obere Schwelle additive Korrektur pro Zeit" VALUE 0x81B870 ME7_FW4 0 rel_sw_b1536 -1536.000000 1535.950000 EXTENDED_LIMITS -1536.000000 1535.953125 /end CHARACTERISTIC
/begin CHARACTERISTIC RKATRN "reduzierte untere Schwelle additive Korrektur pro Zeit" VALUE 0x81B872 ME7_FW4 0 rel_sw_b1536 -1536.000000 1535.950000 EXTENDED_LIMITS -1536.000000 1535.953125 /end CHARACTERISTIC
/begin CHARACTERISTIC RKATRX "reduzierte obere Schwelle additive Korrektur pro Zeit" VALUE 0x81B874 ME7_FW4 0 rel_sw_b1536 -1536.000000 1535.950000 EXTENDED_LIMITS -1536.000000 1535.953125 /end CHARACTERISTIC
/begin CHARACTERISTIC RKAZDN "untere Diagnoseschwelle additive Korrektur pro ZÅndung" VALUE 0x81BA1A ME7_FW4 0 rel_sw_b1536 -1536.000000 1535.950000 EXTENDED_LIMITS -1536.000000 1535.953125 /end CHARACTERISTIC
/begin CHARACTERISTIC RKAZDX "obere Diagnoseschwelle additive Korrektur pro ZÅndung" VALUE 0x81BA1C ME7_FW4 0 rel_sw_b1536 -1536.000000 1535.950000 EXTENDED_LIMITS -1536.000000 1535.953125 /end CHARACTERISTIC
/begin CHARACTERISTIC RKAZMN "untere Schwelle additive Korrektur pro ZÅndung" VALUE 0x81B876 ME7_FW4 0 rel_sw_b1536 -1536.000000 1535.950000 EXTENDED_LIMITS -1536.000000 1535.953125 /end CHARACTERISTIC
/begin CHARACTERISTIC RKAZMX "obere Schwelle additive Korrektur pro ZÅndung" VALUE 0x81B878 ME7_FW4 0 rel_sw_b1536 -1536.000000 1535.950000 EXTENDED_LIMITS -1536.000000 1535.953125 /end CHARACTERISTIC
/begin CHARACTERISTIC RKAZRN "reduzierte untere Schwelle additive Korrektur pro ZÅndung" VALUE 0x81B87A ME7_FW4 0 rel_sw_b1536 -1536.000000 1535.950000 EXTENDED_LIMITS -1536.000000 1535.953125 /end CHARACTERISTIC
/begin CHARACTERISTIC RKAZRX "reduzierte obere Schwelle additive Korrektur pro ZÅndung" VALUE 0x81B87C ME7_FW4 0 rel_sw_b1536 -1536.000000 1535.950000 EXTENDED_LIMITS -1536.000000 1535.953125 /end CHARACTERISTIC
/begin CHARACTERISTIC RKBAUM "rk-Schwelle fÅr BA-Anzeige" CURVE 0x81B97E ME7_GKL4 0 rel_sw_q0p1875 0.000000 6143.810000
 /begin AXIS_DESCR COM_AXIS tmot temp_ub_q0p75_o48 0 -48.000000 143.250000 AXIS_PTS_REF STM09ESUB /end AXIS_DESCR
 EXTENDED_LIMITS -6144.000000 6143.812500 /end CHARACTERISTIC
/begin CHARACTERISTIC RKRMX1N "Maximaler Referenzpegel fÅr Klopferkennungsschwelle Zyl.-gruppe 1" CURVE 0x819340 ME7_GKL1 0 spg_ub_b320 1.250000 318.750000
 /begin AXIS_DESCR COM_AXIS nmot nmot_ub_q40 0 0.000000 10200.000000 AXIS_PTS_REF SNM16KRUB /end AXIS_DESCR
 EXTENDED_LIMITS 0.000000 318.750000 /end CHARACTERISTIC
/begin CHARACTERISTIC RKRMX2N "Maximaler Referenzpegel fÅr Klopferkennungsschwelle Zyl.-gruppe 2" CURVE 0x819350 ME7_GKL1 0 spg_ub_b320 1.250000 318.750000
 /begin AXIS_DESCR COM_AXIS nmot nmot_ub_q40 0 0.000000 10200.000000 AXIS_PTS_REF SNM16KRUB /end AXIS_DESCR
 EXTENDED_LIMITS 0.000000 318.750000 /end CHARACTERISTIC
/begin CHARACTERISTIC RKSP "Widerstand zwischen kongurierende Spannung und Sondensignal" VALUE 0x810BBC ME7_FW3 0 r_uw_q2 0.000000 131070.000000 /end CHARACTERISTIC
/begin CHARACTERISTIC RKUKKLU "Schwelle Summe Kurz-/Langzeitanteil" VALUE 0x811FEC ME7_FW4 0 rel_sw_q0p1875 -6144.000000 6143.810000 EXTENDED_LIMITS -6144.000000 6143.812500 /end CHARACTERISTIC
/begin CHARACTERISTIC RKVAUM "rk-Schwelle fÅr VA-Anzeige" CURVE 0x81B990 ME7_GKL4 0 rel_sw_q0p1875 -6144.000000 0.000000
 /begin AXIS_DESCR COM_AXIS tmot temp_ub_q0p75_o48 0 -48.000000 143.250000 AXIS_PTS_REF STM09ESUB /end AXIS_DESCR
 EXTENDED_LIMITS -6144.000000 6143.812500 /end CHARACTERISTIC
/begin CHARACTERISTIC RL1GV "RL - Kennlinie Bergaberkennung Gang 1" CURVE 0x819C43 ME7_GKL1 0 rel_ub_q0p75 0.000000 191.250000
 /begin AXIS_DESCR COM_AXIS vfzg vfzg_ub_q1p25___UB 0 0.000000 318.750000 AXIS_PTS_REF SVF06D_UB /end AXIS_DESCR
/end CHARACTERISTIC
/begin CHARACTERISTIC RL2GV "RL - Kennlinie Bergaberkennung Gang 2" CURVE 0x819C49 ME7_GKL1 0 rel_ub_q0p75 0.000000 191.250000
 /begin AXIS_DESCR COM_AXIS vfzg vfzg_ub_q1p25___UB 0 0.000000 318.750000 AXIS_PTS_REF SVF06D_UB /end AXIS_DESCR
/end CHARACTERISTIC
/begin CHARACTERISTIC RL3GV "RL - Kennlinie Bergaberkennung Gang 3" CURVE 0x819C4F ME7_GKL1 0 rel_ub_q0p75 0.000000 191.250000
 /begin AXIS_DESCR COM_AXIS vfzg vfzg_ub_q1p25___UB 0 0.000000 318.750000 AXIS_PTS_REF SVF06D_UB /end AXIS_DESCR
/end CHARACTERISTIC
/begin CHARACTERISTIC RL4GV "RL - Kennlinie Bergaberkennung Gang 4" CURVE 0x819C55 ME7_GKL1 0 rel_ub_q0p75 0.000000 191.250000
 /begin AXIS_DESCR COM_AXIS vfzg vfzg_ub_q1p25___UB 0 0.000000 318.750000 AXIS_PTS_REF SVF06D_UB /end AXIS_DESCR
/end CHARACTERISTIC
/begin CHARACTERISTIC RL5GV "RL - Kennlinie Bergaberkennung Gang 5" CURVE 0x819C5B ME7_GKL1 0 rel_ub_q0p75 0.000000 191.250000
 /begin AXIS_DESCR COM_AXIS vfzg vfzg_ub_q1p25___UB 0 0.000000 318.750000 AXIS_PTS_REF SVF06D_UB /end AXIS_DESCR
/end CHARACTERISTIC
/begin CHARACTERISTIC RLBABMX "Begrenzung Filter Bergaberkennung" VALUE 0x81D9C8 ME7_FW3 0 rel_uw_q0p0234 0.000000 1535.980000 EXTENDED_LIMITS 0.000000 1535.976562 /end CHARACTERISTIC
/begin CHARACTERISTIC RLC_T_UM "Fehlertoleranzzeit fÅr den rl-Vergleich mit der Funktion in der FunktionsÅberw." VALUE 0x814064 ME7_FW1 0 t40ms_ub_b10200 0.000000 10200.000000 /end CHARACTERISTIC
/begin CHARACTERISTIC RLDKTOT "Obere Lastgrenze fÅr Funktionsanforderung" VALUE 0x8184E6 ME7_FW1 0 rel_ub_q0p75 0.000000 191.250000 /end CHARACTERISTIC
/begin CHARACTERISTIC RLDKTSO "Obere Lastkennlinie fÅr DKAT-aktiv" CURVE 0x814D82 ME7_GKL1 0 rel_ub_q0p75 0.000000 191.250000
 /begin AXIS_DESCR COM_AXIS nmot nmot_ub_q40 0 0.000000 10200.000000 AXIS_PTS_REF SNM05DKUB /end AXIS_DESCR
/end CHARACTERISTIC
/begin CHARACTERISTIC RLDKTSU "Untere Lastkennlinie fÅr DKAT-aktiv" CURVE 0x814D87 ME7_GKL1 0 rel_ub_q0p75 0.000000 191.250000
 /begin AXIS_DESCR COM_AXIS nmot nmot_ub_q40 0 0.000000 10200.000000 AXIS_PTS_REF SNM05DKUB /end AXIS_DESCR
/end CHARACTERISTIC
/begin CHARACTERISTIC RLDKTUT "Untere Lastgrenze fÅr Funktionsanforderung" VALUE 0x8184E7 ME7_FW1 0 rel_ub_q0p75 0.000000 191.250000 /end CHARACTERISTIC
/begin CHARACTERISTIC RLDLLR "FÅllungsschwelle fÅr Diagnose LLR" VALUE 0x81990A ME7_FW1 0 rel_ub_q0p75 0.000000 99.750000 EXTENDED_LIMITS 0.000000 191.250000 /end CHARACTERISTIC
/begin CHARACTERISTIC RLDSLMN "min. relative FÅllung fÅr Bedingung Diagnose" VALUE 0x818379 ME7_FW1 0 rel_ub_q0p75 0.000000 191.250000 /end CHARACTERISTIC
/begin CHARACTERISTIC RLDSLMX "max. relative FÅllung fÅr Bedingung Diagnose" VALUE 0x81837A ME7_FW1 0 rel_ub_q0p75 0.000000 191.250000 /end CHARACTERISTIC
/begin CHARACTERISTIC RLIPFIL_UM "Filter-Zeitkonstante fÅr verzîgerte Lastinfo rlipt_um in d. FunktionsÅberwachung" VALUE 0x814065 ME7_FW1 0 zk40ms_ub_b10200 40.629900 10200.000000 EXTENDED_LIMITS 0.156863 10200.000000 /end CHARACTERISTIC
/begin CHARACTERISTIC RLIPTV_UM "Verzugszeit fÅr Lastinformation rlip_um in der FunktionsÅberwachg" VALUE 0x814066 ME7_FW1 0 t40ms_ub_b10200 0.000000 320.000000 EXTENDED_LIMITS 0.000000 10200.000000 /end CHARACTERISTIC
/begin CHARACTERISTIC RLIP_T_UM "Fehlertoleranzzeit fÅr den rl/rlip-Vergleich in der FunktionsÅberwachg" VALUE 0x814067 ME7_FW1 0 t40ms_ub_b10200 0.000000 10200.000000 /end CHARACTERISTIC
/begin CHARACTERISTIC RLKRLDA "Rl-Schwelle fÅr langsamen LDR-Eingriff (Adaption)" CURVE 0x819697 ME7_GKL1 0 rel_ub_q0p75 0.000000 191.250000
 /begin AXIS_DESCR COM_AXIS nmot nmot_ub_q40 0 0.000000 10200.000000 AXIS_PTS_REF SNM08LDUB /end AXIS_DESCR
/end CHARACTERISTIC
/begin CHARACTERISTIC RLLDPMX "Maximale Last bei Diagnose" VALUE 0x815E71 ME7_FW1 0 rel_ub_q0p75 0.000000 191.250000 /end CHARACTERISTIC
/begin CHARACTERISTIC RLLRHON "Kennlinie Åber nmot, obere rL Regelgrenze fÅr Regler hinter KAT" CURVE 0x819D15 ME7_GKL1 0 rel_ub_q0p75 0.000000 191.250000
 /begin AXIS_DESCR COM_AXIS nmot nmot_ub_q40 0 0.000000 10200.000000 AXIS_PTS_REF SNM08LHUB /end AXIS_DESCR
/end CHARACTERISTIC
/begin CHARACTERISTIC RLLRHUN "Kennlinie Åber nmot, untere rL Regelgrenze fÅr Regler hinter KAT" CURVE 0x819D1D ME7_GKL1 0 rel_ub_q0p75 0.000000 191.250000
 /begin AXIS_DESCR COM_AXIS nmot nmot_ub_q40 0 0.000000 10200.000000 AXIS_PTS_REF SNM08LHUB /end AXIS_DESCR
/end CHARACTERISTIC
/begin CHARACTERISTIC RLLRSHB "relative Lastschwelle, Abschalten LR bei SLS, in Verbindung mit LL und NLRSHB" VALUE 0x815E8C ME7_FW1 0 rel_ub_q0p75 0.000000 191.250000 /end CHARACTERISTIC
/begin CHARACTERISTIC RLLRTMO "Kennlinie Åber tmot, obere rL Regelgrenze fÅr Regler vor KAT" CURVE 0x819C75 ME7_KL97 0 rel_ub_q0p75 0.000000 191.250000
 /begin AXIS_DESCR STD_AXIS tmot temp_ub_q0p75_o48 8 -48.000000 143.250000 DEPOSIT ABSOLUTE /end AXIS_DESCR
/end CHARACTERISTIC
/begin CHARACTERISTIC RLLRUN "Kennlinie Åber nmot, untere rL Regelgrenze fÅr Regler vor KAT" CURVE 0x819C86 ME7_KL97 0 rel_ub_q0p75 0.000000 191.250000
 /begin AXIS_DESCR STD_AXIS nmot nmot_ub_q40 8 0.000000 10200.000000 DEPOSIT ABSOLUTE /end AXIS_DESCR
/end CHARACTERISTIC
/begin CHARACTERISTIC RLNOT "Notlauf rl bei E_DK und !E_HFM" CURVE 0x8150E4 ME7_KL97 0 rel_ub_q0p75 0.000000 191.250000
 /begin AXIS_DESCR STD_AXIS nmot nmot_ub_q40 6 0.000000 10200.000000 DEPOSIT ABSOLUTE /end AXIS_DESCR
/end CHARACTERISTIC
/begin CHARACTERISTIC RLO2 "obere Lastschwelle Bereich 2" VALUE 0x818B11 ME7_FW1 0 rel_ub_q0p75 0.000000 191.250000 /end CHARACTERISTIC
/begin CHARACTERISTIC RLO3 "obere rl - Schwelle Bereich 3" VALUE 0x818B12 ME7_FW1 0 rel_ub_q0p75 0.000000 191.250000 /end CHARACTERISTIC
/begin CHARACTERISTIC RLRVAO "obere rL - Schwelle fÅr Auslîsen Sperre LR bei VA" VALUE 0x819C97 ME7_FW1 0 rel_ub_q0p75 0.000000 191.250000 /end CHARACTERISTIC
/begin CHARACTERISTIC RLSALUN "Lastschwelle zur Schuberkennung fÅr Ausblendung der Aussetzererkennung" CURVE 0x814801 ME7_GKL1 0 rel_ub_q0p75 0.000000 191.250000
 /begin AXIS_DESCR COM_AXIS nmot nmot_ub_q40 0 0.000000 10200.000000 AXIS_PTS_REF SNM08DMUB /end AXIS_DESCR
/end CHARACTERISTIC
/begin CHARACTERISTIC RLTPKTO "obere Lastschwelle fÅr Periodendauer-Kurztest" VALUE 0x814D9E ME7_FW1 0 rel_ub_q0p75 0.000000 191.250000 /end CHARACTERISTIC
/begin CHARACTERISTIC RLTPKTU "untere Lastschwelle fÅr Periodendauer-Kurztest" VALUE 0x814D9F ME7_FW1 0 rel_ub_q0p75 0.000000 191.250000 /end CHARACTERISTIC
/begin CHARACTERISTIC RLTPVKO "obere Lastschwelle fÅr PeriodendauerÅberwachung vor Kat" VALUE 0x814DA0 ME7_FW1 0 rel_ub_q0p75 0.000000 191.250000 /end CHARACTERISTIC
/begin CHARACTERISTIC RLTPVKU "untere Lastschwelle fÅr PeriodendauerÅberwachung vor Kat" VALUE 0x814DA1 ME7_FW1 0 rel_ub_q0p75 0.000000 191.250000 /end CHARACTERISTIC
/begin CHARACTERISTIC RLU2 "untere rl - Schwelle Bereich 2" VALUE 0x818B13 ME7_FW1 0 rel_ub_q0p75 0.000000 191.250000 /end CHARACTERISTIC
/begin CHARACTERISTIC RLU3 "untere rl - Schwelle Bereich 3" VALUE 0x818B14 ME7_FW1 0 rel_ub_q0p75 0.000000 191.250000 /end CHARACTERISTIC
/begin CHARACTERISTIC RLU4 "untere rl -Schwelle oberer multiplikativer Bereich" VALUE 0x818B15 ME7_FW1 0 rel_ub_q0p75 0.000000 191.250000 /end CHARACTERISTIC
/begin CHARACTERISTIC RLUKAO "obere Lastgrenze fÅr öK-Adaption" VALUE 0x8153F9 ME7_FW1 0 rel_ub_q0p75 0.000000 191.250000 /end CHARACTERISTIC
/begin CHARACTERISTIC RLUKAU "untere Lastgrenze fÅr öK-Adaption" VALUE 0x8153FA ME7_FW1 0 rel_ub_q0p75 0.000000 191.250000 /end CHARACTERISTIC
/begin CHARACTERISTIC RLVMXN "Maximaler Volumenstrom bei offener Drosselklappe" CURVE 0x81995C ME7_KL97 0 rel_ub_q0p75 0.000000 191.250000
 /begin AXIS_DESCR STD_AXIS nmot nmot_ub_q40 11 0.000000 10200.000000 DEPOSIT ABSOLUTE /end AXIS_DESCR
/end CHARACTERISTIC
/begin CHARACTERISTIC RLVSMXN "Maximaler Volumenstrom bei offener Drosselklappe und SU" CURVE 0x819973 ME7_KL97 0 rel_ub_q0p75 0.000000 191.250000
 /begin AXIS_DESCR STD_AXIS nmot nmot_ub_q40 11 0.000000 10200.000000 DEPOSIT ABSOLUTE /end AXIS_DESCR
/end CHARACTERISTIC
/begin CHARACTERISTIC RLX_AOG "oberer Grenzwert Anpassung maximaler Ladedruck" VALUE 0x81545C ME7_FW1 0 fak_ub_b1 0.000000 0.996094 /end CHARACTERISTIC
/begin CHARACTERISTIC RLX_AUG "unterer Grenzwert Anpassung maximaler Ladedruck" VALUE 0x81545D ME7_FW1 0 fak_ub_b1 0.000000 0.996094 /end CHARACTERISTIC
/begin CHARACTERISTIC RL_BO_UM "Offset fÅr Toleranzgerade f(rl_um) fÅr rlipf_um in der FunktionsÅberwachung" VALUE 0x814068 ME7_FW1 0 rel_ub_q0p75 0.000000 191.250000 /end CHARACTERISTIC
/begin CHARACTERISTIC RL_DAT_UC "" VAL_BLK 0x815C3A ME7_FWB1 0 rel_ub_q0p75 0.000000 191.250000 NUMBER 16 /end CHARACTERISTIC
/begin CHARACTERISTIC RL_MO_UM "Steigung fÅr Toleranzgerade f(rl_um) fÅr rlipf_um in der FunktionsÅberwachung" VALUE 0x814069 ME7_FW1 0 dez 0.000000 255.000000 /end CHARACTERISTIC
/begin CHARACTERISTIC RMSLADA "Diagnoseschwelle fÅr Adaption" VALUE 0x81837B ME7_FW1 0 fak_ub_b2 0.000000 1.992190 EXTENDED_LIMITS 0.000000 1.992188 /end CHARACTERISTIC
/begin CHARACTERISTIC RMSLMN "Diagnoseschwelle: verringerte SekundÑrluftmasse" VALUE 0x81837C ME7_FW1 0 fak_ub_b2 0.000000 1.992190 EXTENDED_LIMITS 0.000000 1.992188 /end CHARACTERISTIC
/begin CHARACTERISTIC RMSLTMN "Schwelle: sehr geringe SekundÑrluftmasse, ohne Offset" VALUE 0x81837D ME7_FW1 0 fak_ub_b2 0.000000 1.992190 EXTENDED_LIMITS 0.000000 1.992188 /end CHARACTERISTIC
/begin CHARACTERISTIC RMSTEVIO "Schwelle relativer Massenstrom fÅr i.O. Erkennung" VALUE 0x81D9AE ME7_FW3 0 rel_uw_b200 0.000000 199.997000 EXTENDED_LIMITS 0.000000 199.996948 /end CHARACTERISTIC
/begin CHARACTERISTIC RMSTEVMN "Minimalwert relativer Massenstrom TEV" VALUE 0x81D9B0 ME7_FW4 0 rel_sw_b200 -200.000000 199.994000 EXTENDED_LIMITS -200.000000 199.993896 /end CHARACTERISTIC
/begin CHARACTERISTIC RMSTEVMX "Maximalwert relativer Massenstrom TEV" VALUE 0x81D9B2 ME7_FW4 0 rel_sw_b200 -200.000000 199.994000 EXTENDED_LIMITS -200.000000 199.993896 /end CHARACTERISTIC
/begin CHARACTERISTIC ROMRSTA_UM "maximale Anzahl Resets bei Fehlererkennung im ROM-Check in der Initialisierung" VALUE 0x814212 ME7_FW1 0 dez 0.000000 255.000000 /end CHARACTERISTIC
/begin CHARACTERISTIC RST_TV_UM "Kennung zur Anforderung eines Reset-TastverhÑltnisses aus der FunktionsÅberwach." VALUE 0x814000 ME7_FW1 0 dez 0.000000 255.000000 /end CHARACTERISTIC
/begin CHARACTERISTIC SAFK1 "Filterkonstante 1 fÅr Lambdasonden-Signalausgabe" VALUE 0x81B5C8 ME7_FW3 0 fak_uw_b1 0.000000 0.999985 /end CHARACTERISTIC
/begin CHARACTERISTIC SAFK2 "Filterkonstante 2 fÅr Lambdasonden-Signalausgabe" VALUE 0x8188DB ME7_FW1 0 fak_ub_b1 0.000000 0.996094 /end CHARACTERISTIC
/begin RECORD_LAYOUT ME7_SST109 NO_AXIS_PTS_X 1 UWORD AXIS_PTS_X 2 UWORD INDEX_INCR DIRECT /end RECORD_LAYOUT
/begin RECORD_LAYOUT ME7_SST103 NO_AXIS_PTS_X 1 UBYTE AXIS_PTS_X 2 SBYTE INDEX_INCR DIRECT /end RECORD_LAYOUT
/begin CHARACTERISTIC SDLDRL "Mindestfuellung LDR fuer DIA LDR maximal zulaessiger Druck" VALUE 0x81974A ME7_FW1 0 rel_ub_q0p75 0.000000 191.250000 /end CHARACTERISTIC
/begin CHARACTERISTIC SDLDSUA "Schwelle fÅr dynamische Schubumluftventilsteuerung aktiv" CURVE 0x81548A ME7_FKL1 0 p_ub_q10 0.000000 2550.000000
 /begin AXIS_DESCR FIX_AXIS plsol p_ub_q10___SL 16 0.000000 2550.000000 FIX_AXIS_PAR 0 4 16 /end AXIS_DESCR
/end CHARACTERISTIC
/begin AXIS_PTS SDN06LLSB "StÅtzstellenvert. Drehzahldifferenz, 10 Sst., LL-Reg." 0x8156C9 dn ME7_SST103 0 nmotd_sb_q10 6 -1280.000000 1270.000000 DEPOSIT ABSOLUTE EXTENDED_LIMITS 0.000000 2550.000000 /end AXIS_PTS
/begin AXIS_PTS SDZ08DMUB "SST-Verteilung in DMD, 8 Drehzahl-SST" 0x814558 nmot ME7_SST97 0 nmot_ub_q40 8 0.000000 10200.000000 DEPOSIT ABSOLUTE EXTENDED_LIMITS 0.000000 2550.000000 /end AXIS_PTS
/begin AXIS_PTS SDZ08DMUB2 "" 0x814561 nmot ME7_SST97 0 nmot_ub_q40 8 0.000000 10200.000000 DEPOSIT ABSOLUTE EXTENDED_LIMITS 0.000000 2550.000000 /end AXIS_PTS
/begin CHARACTERISTIC SENZZYL0 "Klopfsensor fÅr SW-ZylinderzÑhler 0" VALUE 0x8191B5 ME7_FW1 0 dezsub1 1.000000 4.000000 EXTENDED_LIMITS 1.000000 256.000000 /end CHARACTERISTIC
/begin CHARACTERISTIC SENZZYL1 "Klopfsensor fÅr SW-ZylinderzÑhler 1" VALUE 0x8191B6 ME7_FW1 0 dezsub1 1.000000 4.000000 EXTENDED_LIMITS 1.000000 256.000000 /end CHARACTERISTIC
/begin CHARACTERISTIC SENZZYL2 "Klopfsensor fÅr SW-ZylinderzÑhler 2" VALUE 0x8191B7 ME7_FW1 0 dezsub1 1.000000 4.000000 EXTENDED_LIMITS 1.000000 256.000000 /end CHARACTERISTIC
/begin CHARACTERISTIC SENZZYL3 "Klopfsensor fÅr SW-ZylinderzÑhler 3" VALUE 0x8191B8 ME7_FW1 0 dezsub1 1.000000 4.000000 EXTENDED_LIMITS 1.000000 256.000000 /end CHARACTERISTIC
/begin CHARACTERISTIC SENZZYL4 "Klopfsensor fÅr SW-ZylinderzÑhler 4" VALUE 0x8191B9 ME7_FW1 0 dezsub1 1.000000 4.000000 EXTENDED_LIMITS 1.000000 256.000000 /end CHARACTERISTIC
/begin CHARACTERISTIC SENZZYL5 "Klopfsensor fÅr SW-ZylinderzÑhler 5" VALUE 0x8191BA ME7_FW1 0 dezsub1 1.000000 4.000000 EXTENDED_LIMITS 1.000000 256.000000 /end CHARACTERISTIC
/begin CHARACTERISTIC SENZZYL6 "Klopfsensor fÅr SW-ZylinderzÑhler 6" VALUE 0x8191BB ME7_FW1 0 dezsub1 1.000000 4.000000 EXTENDED_LIMITS 1.000000 256.000000 /end CHARACTERISTIC
/begin CHARACTERISTIC SENZZYL7 "Klopfsensor fÅr SW-ZylinderzÑhler 7" VALUE 0x8191BC ME7_FW1 0 dezsub1 1.000000 4.000000 EXTENDED_LIMITS 1.000000 256.000000 /end CHARACTERISTIC
/begin CHARACTERISTIC SFLAGS_D_UC "" VAL_BLK 0x815C4A ME7_FWB1 0 dez 0.000000 255.000000 NUMBER 16 /end CHARACTERISTIC
/begin CHARACTERISTIC SFONTM "Schwellwert tmot fÅr fuel-on Adaption aktiv" VALUE 0x81453E ME7_FW1 0 temp_ub_q0p75_o48 -48.000000 143.250000 /end CHARACTERISTIC
/begin AXIS_PTS SGA08MDUB "StÅtzstellenverteilung Ist Gang 8 Sst." 0x81437F gangi ME7_SST97 0 dez 8 0.000000 255.000000 DEPOSIT ABSOLUTE EXTENDED_LIMITS 0.000000 143.250000 /end AXIS_PTS
/begin CHARACTERISTIC SGIDB1 "BOSCH-Hardwarenummer" ASCII 0x81545E ME7_ASCII 0 NoCompuMethod 0.000000 0.000000 NUMBER 12 EXTENDED_LIMITS 0.000000 143.250000 /end CHARACTERISTIC
/begin RECORD_LAYOUT ME7_ASCII FNC_VALUES 1 UBYTE COLUMN_DIR DIRECT /end RECORD_LAYOUT
/begin CHARACTERISTIC SGIDB2 "BOSCH-Softwarenummer" ASCII 0x81546A ME7_ASCII 0 NoCompuMethod 0.000000 0.000000 NUMBER 20 EXTENDED_LIMITS 0.000000 143.250000 /end CHARACTERISTIC
/begin CHARACTERISTIC SGIDB3 "Kunden-Teilenummer" ASCII 0x81547E ME7_ASCII 0 NoCompuMethod 0.000000 0.000000 NUMBER 4 EXTENDED_LIMITS 0.000000 143.250000 /end CHARACTERISTIC
/begin CHARACTERISTIC SGIDB4 "Fertigungsdatum" ASCII 0x8144C0 ME7_ASCII 0 NoCompuMethod 0.000000 0.000000 NUMBER 10 EXTENDED_LIMITS 0.000000 143.250000 /end CHARACTERISTIC
/begin CHARACTERISTIC SGIDB5 "BOSCH-Software-Teilenummer = Typ-Teile-Nummer des Master EPROMs" ASCII 0x8144CA ME7_ASCII 0 NoCompuMethod 0.000000 0.000000 NUMBER 10 EXTENDED_LIMITS 0.000000 143.250000 /end CHARACTERISTIC
/begin CHARACTERISTIC SKA_DRHZ_UC "" VALUE 0x815E13 ME7_FW1 0 nmot_ub_q40 0.000000 10200.000000 /end CHARACTERISTIC
/begin CHARACTERISTIC SKA_DRHZ_UM "" VALUE 0x814209 ME7_FW1 0 nmot_ub_q40 0.000000 10200.000000 /end CHARACTERISTIC
/begin CHARACTERISTIC SLFOO2N "Obere Schwelle (Schwellwert-KL) fÅr Lernfilterwert bei fuel-on/-off Adaption" CURVE 0x81453F ME7_GKL1 0 dtsegn_b720divZyl___UB 0.000000 1.400760
 /begin AXIS_DESCR COM_AXIS nmot nmot_ub_q40 0 0.000000 10200.000000 AXIS_PTS_REF SDZ08DMUB2 /end AXIS_DESCR
/end CHARACTERISTIC
/begin CHARACTERISTIC SLFOON "Obere Schwelle (Schwellwert-KL) fÅr Lernfilterwert bei fuel-on/-off Adaption" CURVE 0x814547 ME7_GKL1 0 dtsegn_b720divZyl___UB 0.000000 1.400760
 /begin AXIS_DESCR COM_AXIS nmot nmot_ub_q40 0 0.000000 10200.000000 AXIS_PTS_REF SDZ08DMUB /end AXIS_DESCR
/end CHARACTERISTIC
/begin CHARACTERISTIC SLFOU "Untere Schwelle fÅr Lernfilterwert bei fuel-on/-off Adaption" VALUE 0x810190 ME7_FW4 0 dtsegn_b720divZyl 0.000000 179.995000 EXTENDED_LIMITS -180.000439 179.994946 /end CHARACTERISTIC
/begin CHARACTERISTIC SLOGIN "Login-Code fÅr Entwicklung" VALUE 0x812268 ME7_FW3 0 dez___UW 0.000000 65535.000000 /end CHARACTERISTIC
/begin AXIS_PTS SML08LHUB "" 0x8181C3 ml ME7_SST97 0 m_ub_b1020 8 0.000000 1020.000000 DEPOSIT ABSOLUTE EXTENDED_LIMITS 0.000000 65535.000000 /end AXIS_PTS
/begin CHARACTERISTIC SMLDYN "Luftmassenschwelle fÅr Sondendynamik hinter KAT" VALUE 0x81AD58 ME7_FW3 0 m_q0p00277 0.000000 182.042000 EXTENDED_LIMITS 0.000000 182.041667 /end CHARACTERISTIC
/begin AXIS_PTS SNM05DKUB "" 0x8181CC nmot ME7_SST97 0 nmot_ub_q40 5 0.000000 10200.000000 DEPOSIT ABSOLUTE EXTENDED_LIMITS 0.000000 182.041667 /end AXIS_PTS
/begin AXIS_PTS SNM06MDUW "" 0x81A0F0 nmot_w ME7_SST109 0 nmot_uw_q0p25 6 0.000000 16383.800000 DEPOSIT ABSOLUTE EXTENDED_LIMITS 0.000000 182.041667 /end AXIS_PTS
/begin AXIS_PTS SNM08DMUB "SST-Verteilung in DMD, 8 Drehzahl-SST" 0x81439B nmot ME7_SST97 0 nmot_ub_q40 8 0.000000 10200.000000 DEPOSIT ABSOLUTE EXTENDED_LIMITS 0.000000 182.041667 /end AXIS_PTS
/begin AXIS_PTS SNM08GKUB "StÅtzstellenverteilung Gemischkontrolle 8 nmot StÅtzstellen" 0x818A9C nmot ME7_SST97 0 nmot_ub_q40 8 0.000000 10200.000000 DEPOSIT ABSOLUTE EXTENDED_LIMITS 0.000000 182.041667 /end AXIS_PTS
/begin AXIS_PTS SNM08KOUB "StÅtzstellenverteilung fÅr Klimakompressorsteuerung  8  nmot" 0x816491 nmot ME7_SST97 0 nmot_ub_q40 8 0.000000 10200.000000 DEPOSIT ABSOLUTE EXTENDED_LIMITS 0.000000 182.041667 /end AXIS_PTS
/begin AXIS_PTS SNM08LDUB "" 0x8143A4 nmot ME7_SST97 0 nmot_ub_q40 8 0.000000 10200.000000 DEPOSIT ABSOLUTE EXTENDED_LIMITS 0.000000 182.041667 /end AXIS_PTS
/begin AXIS_PTS SNM08LDUW "" 0x81003E nmot_w ME7_SST109 0 nmot_uw_q0p25 8 0.000000 16383.800000 DEPOSIT ABSOLUTE EXTENDED_LIMITS 0.000000 182.041667 /end AXIS_PTS
/begin AXIS_PTS SNM08LHUB "" 0x8181F2 nmot ME7_SST97 0 nmot_ub_q40 8 0.000000 10200.000000 DEPOSIT ABSOLUTE EXTENDED_LIMITS 0.000000 182.041667 /end AXIS_PTS
/begin AXIS_PTS SNM16KRUB "StÅtzstellenverteilung Drehzahl, 16 Sst." 0x818242 nmot ME7_SST97 0 nmot_ub_q40 16 0.000000 10200.000000 DEPOSIT ABSOLUTE EXTENDED_LIMITS 0.000000 182.041667 /end AXIS_PTS
/begin AXIS_PTS SNS206LLSB "" 0x8156D0 dns ME7_SST103 0 nmotd_sb_q10 6 -1280.000000 1270.000000 DEPOSIT ABSOLUTE EXTENDED_LIMITS 0.000000 182.041667 /end AXIS_PTS
/begin CHARACTERISTIC SP12LL_UM "maximale Differenz zwischen SP1S und SP2S unterhalb der Vollgas-Schwelle" VALUE 0x81406A ME7_FW1 0 spg_ub_q0p019 0.000000 4.980470 EXTENDED_LIMITS 0.000000 4.980469 /end CHARACTERISTIC
/begin CHARACTERISTIC SP12VG_UM "maximale Differenz zwischen SP1S und SP2S oberhalb der Vollgas-Schwelle" VALUE 0x81406B ME7_FW1 0 spg_ub_q0p019 0.000000 4.980470 EXTENDED_LIMITS 0.000000 4.980469 /end CHARACTERISTIC
/begin CHARACTERISTIC SP1ADC_DIF "max. Diff. zw. Sollwertpoti1 & Sollwertpoti1 vom öberw.Modul im stationÑren Fall" VALUE 0x81420B ME7_FW1 0 spg_ub_q0p019 0.000000 4.980470 EXTENDED_LIMITS 0.000000 4.980469 /end CHARACTERISTIC
/begin CHARACTERISTIC SP1_STAT "Bandbreite fÅr die Erkennung auf sp1s stationÑr" VALUE 0x81420C ME7_FW1 0 spg_ub_q0p019 0.000000 4.980470 EXTENDED_LIMITS 0.000000 4.980469 /end CHARACTERISTIC
/begin CHARACTERISTIC SP1_STAT_T "Zeit fÅr die Erkennung auf sp1s stationÑr" VALUE 0x81420D ME7_FW1 0 t10msxs_ub_b2p55 0.000000 2.550000 /end CHARACTERISTIC
/begin CHARACTERISTIC SPSC_MIN_UM "" VALUE 0x81406C ME7_FW1 0 spg_ub_q0p019 0.000000 4.980470 EXTENDED_LIMITS 0.000000 4.980469 /end CHARACTERISTIC
/begin CHARACTERISTIC SPSC_T_UM "Fehlerzeit bei zueinander unplausiblen Sollwerten in der FunktionsÅberwachung" VALUE 0x81406D ME7_FW1 0 t40ms_ub_b10200 0.000000 10200.000000 /end CHARACTERISTIC
/begin CHARACTERISTIC SPSN_DAT_UC "" VAL_BLK 0x815C5A ME7_FWB1 0 spg_ub_q0p019 0.000000 4.980470 NUMBER 16 EXTENDED_LIMITS 0.000000 4.980469 /end CHARACTERISTIC
/begin CHARACTERISTIC SPSVG_UM "Vollgas-Sollwert-Schwelle zur Umschaltung der maximalen Differenz SP1S-SP2S" VALUE 0x81406E ME7_FW1 0 spg_ub_q0p019 0.000000 4.980470 EXTENDED_LIMITS 0.000000 4.980469 /end CHARACTERISTIC
/begin CHARACTERISTIC SRKTEVS "Saugrohrkonstante bei Schlie·en des TankentlÅftungsventil" VALUE 0x8156D7 ME7_FW1 0 t20msxs_ub_b5p1 0.020000 5.100000 EXTENDED_LIMITS 0.000000 5.100000 /end CHARACTERISTIC
/begin AXIS_PTS SRL08DMUB "SST-Verteilung in DMD, 8 Last-SST" 0x814408 rl ME7_SST97 0 rel_ub_q0p75 8 0.000000 191.250000 DEPOSIT ABSOLUTE EXTENDED_LIMITS 0.000000 5.100000 /end AXIS_PTS
/begin AXIS_PTS SRL08NXUB "StÅtzstellenverteilung relative LuftfÅllung 8 Sst." 0x818271 rl ME7_SST97 0 rel_ub_q0p75 8 0.000000 191.250000 DEPOSIT ABSOLUTE EXTENDED_LIMITS 0.000000 5.100000 /end AXIS_PTS
/begin CHARACTERISTIC SRYAGR "Schwelle fÅr Readiness-Bildung AbgasrÅckfÅhrungs-Diagnose" VALUE 0x814D5A ME7_FW1 0 dez 0.000000 255.000000 /end CHARACTERISTIC
/begin CHARACTERISTIC SRYHS "Schwelle fÅr Readiness-Bildung Sondenheizungs-Diagnose" VALUE 0x814D5B ME7_FW1 0 dez 0.000000 255.000000 /end CHARACTERISTIC
/begin CHARACTERISTIC SRYKAT "Schwelle fÅr Readiness-Bildung Katalysator-Diagnose" VALUE 0x814D5C ME7_FW1 0 dez 0.000000 255.000000 /end CHARACTERISTIC
/begin CHARACTERISTIC SRYLS "Schwelle fÅr Readiness-Bildung Lambdasonden-Diagnose" VALUE 0x814D5D ME7_FW1 0 dez 0.000000 255.000000 /end CHARACTERISTIC
/begin CHARACTERISTIC SRYSLS "Schwelle fÅr Readiness-Bildung SekundÑrluft-Diagnose" VALUE 0x814D5E ME7_FW1 0 dez 0.000000 255.000000 /end CHARACTERISTIC
/begin CHARACTERISTIC SRYTES "Schwelle fÅr Readiness-Bildung TankentlÅftungs-Diagnose" VALUE 0x814D5F ME7_FW1 0 dez 0.000000 255.000000 /end CHARACTERISTIC
/begin CHARACTERISTIC STLDIA1 "StÅtzstelle1 fÅr LDR Adaptionskennlinie" VALUE 0x8194B1 ME7_FW1 0 nmot_ub_q40 0.000000 10200.000000 /end CHARACTERISTIC
/begin CHARACTERISTIC STLDIA2 "StÅtzstelle2 fÅr LDR Adaptionskennlinie" VALUE 0x8194B2 ME7_FW1 0 nmot_ub_q40 0.000000 10200.000000 /end CHARACTERISTIC
/begin CHARACTERISTIC STLDIA3 "StÅtzstelle3 fÅr LDR Adaptionskennlinie" VALUE 0x8194B3 ME7_FW1 0 nmot_ub_q40 0.000000 10200.000000 /end CHARACTERISTIC
/begin CHARACTERISTIC STLDIA4 "StÅtzstelle4 fÅr LDR Adaptionskennlinie" VALUE 0x8194B4 ME7_FW1 0 nmot_ub_q40 0.000000 10200.000000 /end CHARACTERISTIC
/begin AXIS_PTS STM04__UB "" 0x81829E tmot ME7_SST97 0 temp_ub_q0p75_o48 4 -48.000000 143.250000 DEPOSIT ABSOLUTE EXTENDED_LIMITS 0.000000 10200.000000 /end AXIS_PTS
/begin AXIS_PTS STM05SAUB "" 0x8182A3 tmot ME7_SST97 0 temp_ub_q0p75_o48 5 -48.000000 143.250000 DEPOSIT ABSOLUTE EXTENDED_LIMITS 0.000000 10200.000000 /end AXIS_PTS
/begin AXIS_PTS STM06LLUB "StÅtzstellenverteilung Motortemperatur, 6 Sst." 0x8182AF tmot ME7_SST97 0 temp_ub_q0p75_o48 6 -48.000000 143.250000 DEPOSIT ABSOLUTE EXTENDED_LIMITS 0.000000 10200.000000 /end AXIS_PTS
/begin AXIS_PTS STM08DMUB "SST-Verteilung in DMD, 8 Temperatur-SST" 0x814458 tmot ME7_SST97 0 temp_ub_q0p75_o48 8 -48.000000 143.250000 DEPOSIT ABSOLUTE EXTENDED_LIMITS 0.000000 10200.000000 /end AXIS_PTS
/begin AXIS_PTS STM08LEUB "" 0x8182BD tmot ME7_SST97 0 temp_ub_q0p75_o48 8 -48.000000 143.250000 DEPOSIT ABSOLUTE EXTENDED_LIMITS 0.000000 10200.000000 /end AXIS_PTS
/begin AXIS_PTS STM08MDUB "" 0x8182C6 tmot ME7_SST97 0 temp_ub_q0p75_o48 8 -48.000000 143.250000 DEPOSIT ABSOLUTE EXTENDED_LIMITS 0.000000 10200.000000 /end AXIS_PTS
/begin AXIS_PTS STM09ESUB "StÅtzstellenverteilung Motortemperatur, 9 Sst." 0x8182CF tmot ME7_SST97 0 temp_ub_q0p75_o48 9 -48.000000 143.250000 DEPOSIT ABSOLUTE EXTENDED_LIMITS 0.000000 10200.000000 /end AXIS_PTS
/begin AXIS_PTS STS14ESUB "" 0x814484 tmst ME7_SST97 0 temp_ub_q0p75_o48 14 -48.000000 143.250000 DEPOSIT ABSOLUTE EXTENDED_LIMITS 0.000000 10200.000000 /end AXIS_PTS
/begin AXIS_PTS SUE08MFUB "" 0x814493 uevges ME7_SST97 0 fak_q0p1 8 0.000000 25.500000 DEPOSIT ABSOLUTE EXTENDED_LIMITS 0.000000 10200.000000 /end AXIS_PTS
/begin CHARACTERISTIC SVDLDUVS "Schwelle VerdichterdruckverhÑltnis fÅr LDR Umluftventilsteuerung" CURVE 0x81549A ME7_FKL1 0 fak_ub_b4 0.000000 3.984380
 /begin AXIS_DESCR FIX_AXIS nmot nmot_ub_q40___SL 16 0.000000 10200.000000 FIX_AXIS_PAR 0 4 16 /end AXIS_DESCR
 EXTENDED_LIMITS 0.000000 3.984375 /end CHARACTERISTIC
/begin AXIS_PTS SVF06D_UB "" 0x819C61 vfzg ME7_SST97 0 vfzg_ub_q1p25___UB 6 0.000000 318.750000 DEPOSIT ABSOLUTE EXTENDED_LIMITS 0.000000 3.984375 /end AXIS_PTS
/begin CHARACTERISTIC SZANSSM "Absteuerungsfaktorumschaltschwelle fÅr Nachstartfaktor" CURVE 0x818A0D ME7_GKL1 0 fak_ub_b1 0.000000 0.996094
 /begin AXIS_DESCR COM_AXIS tmst temp_ub_q0p75_o48 0 -48.000000 143.250000 AXIS_PTS_REF STS14ESUB /end AXIS_DESCR
/end CHARACTERISTIC
/begin CHARACTERISTIC TABGBTS "Abgastemperaturschwelle fÅr Bauteileschutz" VALUE 0x81BA32 ME7_FW3 0 temp_uw_q0p0195_o50 -50.000000 1229.980000 EXTENDED_LIMITS -50.000000 1229.980469 /end CHARACTERISTIC
/begin CHARACTERISTIC TABGMCSD "Abgastemperaturschwelle fÅr CSD-Messung" VALUE 0x814D74 ME7_FW1 0 temp_ub_q5_o50 -50.000000 1225.000000 /end CHARACTERISTIC
/begin CHARACTERISTIC TABGMEX "Abgastemperatur unterhalb der Kat-Anspringtemperatur" VALUE 0x81849B ME7_FW1 0 temp_ub_q5_o50 -50.000000 1225.000000 /end CHARACTERISTIC
/begin CHARACTERISTIC TABGMSLAD "Abgas Temperaturschwelle fÅr Auslîsung Adaption" VALUE 0x81837E ME7_FW1 0 temp_ub_q5_o50 -50.000000 1225.000000 /end CHARACTERISTIC
/begin CHARACTERISTIC TABGSTG "Abgastemperaturschwelle fÅr Dynamik-Messung" VALUE 0x8184BD ME7_FW1 0 temp_ub_q5_o50 -50.000000 1225.000000 /end CHARACTERISTIC
/begin CHARACTERISTIC TABLDOBN "Abregelzeit fÅr LDR-Overboost" CURVE 0x8194EF ME7_GKL1 0 t1sxs_ub_b255 0.000000 60.000000
 /begin AXIS_DESCR COM_AXIS nmot nmot_ub_q40 0 0.000000 10200.000000 AXIS_PTS_REF SNM08LDUB /end AXIS_DESCR
 EXTENDED_LIMITS 0.000000 255.000000 /end CHARACTERISTIC
/begin CHARACTERISTIC TABSTKH "Mindestabstellzeit fÅr Freigabe Kat-Heizen" VALUE 0x81BB6C ME7_FW3 0 t1sxs_uw_b65535 0.000000 65535.000000 /end CHARACTERISTIC
/begin CHARACTERISTIC TADE "Ersatzgrî·e Lufttemperatur im Fehlerfall" VALUE 0x818FAB ME7_FW1 0 temp_ub_q0p75_o48 -48.000000 143.250000 /end CHARACTERISTIC
/begin CHARACTERISTIC TADHMN "untere Temperaturschwelle fÅr die Heizerdiagnose" VALUE 0x8183D2 ME7_FW1 0 temp_ub_q5_o50 -50.000000 1225.000000 /end CHARACTERISTIC
/begin CHARACTERISTIC TADHMX "obere Temperaturschwelle fÅr die Heizerdiagnose" VALUE 0x8183D3 ME7_FW1 0 temp_ub_q5_o50 -50.000000 1225.000000 /end CHARACTERISTIC
/begin CHARACTERISTIC TADLLR "Ansauglufttemperaturschwelle fÅr Diagnose Leerlaufsteller" VALUE 0x81990B ME7_FW1 0 temp_ub_q0p75_o48 -48.000000 143.250000 /end CHARACTERISTIC
/begin CHARACTERISTIC TADMM "1. Stufenbreite (Zeit) fÅr Motortemperaturmodell" VALUE 0x81BABC ME7_FW3 0 t100msxs_uw_b6553p5 0.000000 6553.500000 /end CHARACTERISTIC
/begin CHARACTERISTIC TADMN "Ansauglufttemperatur min." VALUE 0x818FAC ME7_FW1 0 temp_ub_q0p75_o48 -48.000000 143.250000 /end CHARACTERISTIC
/begin CHARACTERISTIC TADMX "Ansauglufttemperatur max." VALUE 0x818FAD ME7_FW1 0 temp_ub_q0p75_o48 -48.000000 143.250000 /end CHARACTERISTIC
/begin CHARACTERISTIC TADTEAMX "Kennlinie Max. tastverhÑltnis abhÑngig vom Integral Massenstrom TE nach TE Stop" CURVE 0x819C0F ME7_KL97 0 rel_ub_b99p6 0.000000 99.609400
 /begin AXIS_DESCR STD_AXIS tdtesta t100msxs_ub_b25p5 14 0.000000 25.500000 DEPOSIT ABSOLUTE /end AXIS_DESCR
 EXTENDED_LIMITS 0.000000 99.609375 /end CHARACTERISTIC
/begin CHARACTERISTIC TADTEMX "TastverhÑltnisschwelle fÅr aktive PrÅfung" VALUE 0x819C2C ME7_FW1 0 rel_ub_b99p6 9.765630 99.609400 EXTENDED_LIMITS 0.000000 99.609375 /end CHARACTERISTIC
/begin CHARACTERISTIC TAFLDPO "Obere TANS- Schwelle fÅr Leckdiagnose bei Kurztrip" VALUE 0x819C68 ME7_FW1 0 temp_ub_q0p75_o48 -48.000000 143.250000 /end CHARACTERISTIC
/begin CHARACTERISTIC TAHLL "Ansauglufttemperaturschwelle fÅr erhîhte Solldrehzahl im Hei·-Leerlauf" VALUE 0x81556F ME7_FW1 0 temp_ub_q0p75_o48 -48.000000 143.250000 /end CHARACTERISTIC
/begin CHARACTERISTIC TALDPO "Obere Ansaugtemperaturschwelle fÅr Leckdiagnosemodul" VALUE 0x819C69 ME7_FW1 0 temp_ub_q0p75_o48 -48.000000 143.250000 /end CHARACTERISTIC
/begin CHARACTERISTIC TALDPU "Untere Ansaugtemperaturschwelle fÅr Leckdiagnosemodul" VALUE 0x819C6A ME7_FW1 0 temp_ub_q0p75_o48 -48.000000 143.250000 /end CHARACTERISTIC
/begin CHARACTERISTIC TALDUVSE "Zeit bis zur Aktivierung LDR Umluftventilsteuerung nach Startende" VALUE 0x812608 ME7_FW3 0 t50msxs_uw_b3276p75 0.000000 3276.750000 /end CHARACTERISTIC
/begin CHARACTERISTIC TALUST "Zeitdauer Ausblendung der Aussetzererkennung nach Motorstart" VALUE 0x8101B2 ME7_FW3 0 t10msxs_uw_b655p35 0.000000 655.350000 /end CHARACTERISTIC
/begin CHARACTERISTIC TAMIALU "Minimale Ansauglufttemperatur fÅr Ausblendung der Aussetzererkennung" VALUE 0x814809 ME7_FW1 0 temp_ub_q0p75_o48 -48.000000 143.250000 /end CHARACTERISTIC
/begin CHARACTERISTIC TANDSLMN "min. Ansauglufttemperatur fÅr SL- Diagnose" VALUE 0x81837F ME7_FW1 0 temp_ub_q0p75_o48 -48.000000 143.250000 /end CHARACTERISTIC
/begin CHARACTERISTIC TANDSLMX "max. Ansauglufttemperatur fÅr SL- Diagnose" VALUE 0x818380 ME7_FW1 0 temp_ub_q0p75_o48 -48.000000 143.250000 /end CHARACTERISTIC
/begin CHARACTERISTIC TANDT "Schwelle Temperaturdifferenz Ansaugluft fÅr Hei·start" CURVE 0x8152F1 ME7_KL97 0 temp_ub_b191p25 0.000000 191.250000
 /begin AXIS_DESCR STD_AXIS tansab temp_ub_q0p75_o48 8 -48.000000 143.250000 DEPOSIT ABSOLUTE /end AXIS_DESCR
/end CHARACTERISTIC
/begin CHARACTERISTIC TANSELI "Temperatur Ansaugluft-Erfassung u. Linearisierung, Inverskennlinie" CURVE 0x818FAE ME7_KL97 0 temp_ub_q0p75_o48 -48.000000 143.250000
 /begin AXIS_DESCR STD_AXIS wtans spg_ub_b5 20 0.000000 4.980470 DEPOSIT ABSOLUTE /end AXIS_DESCR
/end CHARACTERISTIC
/begin CHARACTERISTIC TANSKOB "Ansauglufttemperaturschwelle fÅt Kompressorabschaltung" VALUE 0x81649A ME7_FW1 0 temp_ub_q0p75_o48 -48.000000 143.250000 /end CHARACTERISTIC
/begin CHARACTERISTIC TANSMN "Ansauglufttemperaturschwelle zur Nachstartaufweitung" VALUE 0x815A54 ME7_FW1 0 temp_ub_q0p75_o48 -48.000000 143.250000 /end CHARACTERISTIC
/begin CHARACTERISTIC TANSMN_UM "Ansauglufttemperaturschwelle zur Nachstartaufweitung in der Fkt.-öberwachung" VALUE 0x81400A ME7_FW1 0 temp_ub_q0p75_o48 -48.000000 143.250000 /end CHARACTERISTIC
/begin CHARACTERISTIC TANW "Ansauglufttemperaturschwelle fÅr Nockenwellenverstellung" VALUE 0x8188B8 ME7_FW1 0 temp_ub_q0p75_o48 -48.000000 143.250000 /end CHARACTERISTIC
/begin CHARACTERISTIC TAPVLTM "Schwelle Abstellzeit fÅr EKP-Vorlauf" CURVE 0x813A04 ME7_KL99 0 t1sxs_uw_b65535 0.000000 65535.000000
 /begin AXIS_DESCR STD_AXIS tmotab temp_ub_q0p75_o48 12 -48.000000 143.250000 DEPOSIT ABSOLUTE /end AXIS_DESCR
/end CHARACTERISTIC
/begin CHARACTERISTIC TARA "Temperaturschwelle Ansaugluft" VALUE 0x8153E7 ME7_FW1 0 temp_ub_q0p75_o48 -48.000000 143.250000 /end CHARACTERISTIC
/begin CHARACTERISTIC TARAU "Ansauglufttemperaturschwelle fÅr Einschalten der Lambda - Regelung" VALUE 0x819C98 ME7_FW1 0 temp_ub_q0p75_o48 -48.000000 143.250000 /end CHARACTERISTIC
/begin CHARACTERISTIC TAREIN_0_A "Sperrzeit fÅr Antiruckelfunktion" VALUE 0x817284 ME7_FW1 0 t10msxs_ub_b2p55 0.000000 2.550000 /end CHARACTERISTIC
/begin CHARACTERISTIC TAREIN_1_A "Sperrzeit fÅr Antiruckelfunktion" VALUE 0x817285 ME7_FW1 0 t10msxs_ub_b2p55 0.000000 2.550000 /end CHARACTERISTIC
/begin CHARACTERISTIC TAREIN_2_A "Sperrzeit fÅr Antiruckelfunktion" VALUE 0x817286 ME7_FW1 0 t10msxs_ub_b2p55 0.000000 2.550000 /end CHARACTERISTIC
/begin CHARACTERISTIC TAREIN_3_A "Sperrzeit fÅr Antiruckelfunktion" VALUE 0x817287 ME7_FW1 0 t10msxs_ub_b2p55 0.000000 2.550000 /end CHARACTERISTIC
/begin CHARACTERISTIC TASHS "Schwelle Ansauglufttemp. fÅr Auslîsung TLRHS - Sperrzeit LR bei Hei·start" VALUE 0x819C99 ME7_FW1 0 temp_ub_q0p75_o48 -48.000000 143.250000 /end CHARACTERISTIC
/begin CHARACTERISTIC TASIG "Zeit fÅr Ausblendung von Stîrspitzen au·erhalb Band fÅr Erk. Signalunterbrechung" VALUE 0x814D75 ME7_FW1 0 t20msxs_ub_b5p1 0.000000 5.100000 /end CHARACTERISTIC
/begin CHARACTERISTIC TASLSO "obere Ansauglufttemperaturschwelle fÅr SekundÑrluftsystem" VALUE 0x818355 ME7_FW1 0 temp_ub_q0p75_o48 -48.000000 143.250000 /end CHARACTERISTIC
/begin CHARACTERISTIC TASLSU "untere Ansauglufttemperaturschwelle fÅr SekundÑrluftsystem" VALUE 0x818356 ME7_FW1 0 temp_ub_q0p75_o48 -48.000000 143.250000 /end CHARACTERISTIC
/begin CHARACTERISTIC TASTBFA "Modell-Temperatur Abgas Startwert bei B_faatm Anford. (kurze Taupunktende Zeit)" VALUE 0x81849C ME7_FW1 0 temp_ub_q5_o50 -50.000000 1225.000000 /end CHARACTERISTIC
/begin CHARACTERISTIC TATEGMX "Maximales TastverhÑltnis fÅr getakteten Betrieb." VALUE 0x815E45 ME7_FW1 0 rel_ub_b99p6 0.000000 99.609400 EXTENDED_LIMITS 0.000000 99.609375 /end CHARACTERISTIC
/begin CHARACTERISTIC TATEGRDO "Obere Schwelle TastverhÑltnis TEV zur Erkennung eines neg. Gradienten tatesoll" VALUE 0x815E46 ME7_FW1 0 rel_ub_b99p6 0.000000 99.609400 EXTENDED_LIMITS 0.000000 99.609375 /end CHARACTERISTIC
/begin CHARACTERISTIC TATEGRDU "Untere Schwelle TastverhÑltnis TEV zur Erkennung eines neg. Gradienten tatesoll" VALUE 0x815E47 ME7_FW1 0 rel_ub_b99p6 0.000000 99.609400 EXTENDED_LIMITS 0.000000 99.609375 /end CHARACTERISTIC
/begin CHARACTERISTIC TATELL "tans- Schwelle fÅr TankentlÅfung bei B_ll = 1" VALUE 0x818C6F ME7_FW1 0 temp_ub_q0p75_o48 -48.000000 143.250000 /end CHARACTERISTIC
/begin CHARACTERISTIC TATEMSN "Kennlinie TastverhÑltnis TEV abhÑngig vom gewÅnschten Massenstrom" CURVE 0x813538 ZF_KL111 0 rel_uw_b100 0.000000 99.998500
 /begin AXIS_DESCR STD_AXIS msntev_w m_uw_b25p6 10 0.000000 25.599600 DEPOSIT ABSOLUTE /end AXIS_DESCR
 EXTENDED_LIMITS 0.000000 99.998474 /end CHARACTERISTIC
/begin CHARACTERISTIC TATMKH "Abgastemperaturkorrektur bei Kat-Heizen aktiv" VALUE 0x81849D ME7_FW1 0 temp_q5___UB 0.000000 1275.000000 /end CHARACTERISTIC
/begin CHARACTERISTIC TATMKW "Abgastemperaturkorrektur bei Kat warmhalten aktiv" VALUE 0x81849E ME7_FW1 0 temp_q5___UB 0.000000 1275.000000 /end CHARACTERISTIC
/begin CHARACTERISTIC TATMSA "Abgastemperatur bei Schubabschneiden" VALUE 0x81849F ME7_FW1 0 temp_ub_q5_o50 -50.000000 1225.000000 /end CHARACTERISTIC
/begin CHARACTERISTIC TATMSTI "Initialisierungswert fÅr tabgm, tkatm Startwert bei Powerfail" VALUE 0x8184A0 ME7_FW1 0 temp_ub_q5_o50 -50.000000 1225.000000 /end CHARACTERISTIC
/begin CHARACTERISTIC TATMTMOT "Motortemperatur warmer Motor , fÅr Temperaturkorrektur beim Kaltstart" VALUE 0x8184A1 ME7_FW1 0 temp_ub_q0p75_o48 -48.000000 143.250000 /end CHARACTERISTIC
/begin CHARACTERISTIC TATMTP "Abgastaupunkttemperatur" VALUE 0x8184A2 ME7_FW1 0 temp_ub_q5_o50 -50.000000 1225.000000 /end CHARACTERISTIC
/begin CHARACTERISTIC TATMWMK "Temperaturoffset  fÅr WÑrmemengenberechnung" VALUE 0x8184A3 ME7_FW2 0 temp_q5 -640.000000 635.000000 /end CHARACTERISTIC
/begin CHARACTERISTIC TBLRH "Sperrzeit fÅr Regelung hinter Kat nach Freigabe durch Regelung vor Kat" VALUE 0x815EAF ME7_FW1 0 t100msxs_ub_b25p5 0.100000 25.500000 EXTENDED_LIMITS 0.000000 25.500000 /end CHARACTERISTIC
/begin CHARACTERISTIC TBLRH2 "Sperrzeit fÅr Regelung hinter Kat nach Freigabe durch Regelung vor Kat Bank 2" VALUE 0x815EB0 ME7_FW1 0 t100msxs_ub_b25p5 0.100000 25.500000 EXTENDED_LIMITS 0.000000 25.500000 /end CHARACTERISTIC
/begin CHARACTERISTIC TC6CSL "Mode 6: Component ID fÅr PrÅfung SekundÑrluftsystem" VALUE 0x818381 ME7_FW1 0 dez 0.000000 127.000000 EXTENDED_LIMITS 0.000000 255.000000 /end CHARACTERISTIC
/begin CHARACTERISTIC TC6CSLN "Mode 6: Component ID fÅr PrÅfung minimale SekundÑrluft in Phase 1" VALUE 0x818382 ME7_FW1 0 dez 0.000000 127.000000 EXTENDED_LIMITS 0.000000 255.000000 /end CHARACTERISTIC
/begin CHARACTERISTIC TC6CSLV "Mode 6: Component ID fÅr PrÅfung Dichtheit SL-Ventil" VALUE 0x818383 ME7_FW1 0 dez 0.000000 127.000000 EXTENDED_LIMITS 0.000000 255.000000 /end CHARACTERISTIC
/begin CHARACTERISTIC TC6LDPC "" VALUE 0x815E72 ME7_FW1 0 dez 0.000000 127.000000 EXTENDED_LIMITS 0.000000 255.000000 /end CHARACTERISTIC
/begin CHARACTERISTIC TC6LDPC2 "Mode 6 Component ID fÅr PrÅfung 'Reed-Kontakt geschlossen'" VALUE 0x815E73 ME7_FW1 0 dez 0.000000 127.000000 EXTENDED_LIMITS 0.000000 255.000000 /end CHARACTERISTIC
/begin CHARACTERISTIC TC6LDPC3 "Mode 6 Component ID fÅr PrÅfung 'Reed-Kontakt îffnet'" VALUE 0x815E74 ME7_FW1 0 dez 0.000000 127.000000 EXTENDED_LIMITS 0.000000 255.000000 /end CHARACTERISTIC
/begin CHARACTERISTIC TC6LDPC4 "Mode 6 Component ID fÅr PrÅfung 'System dicht wÑhrend InitialspÅlung'" VALUE 0x815E75 ME7_FW1 0 dez 0.000000 127.000000 EXTENDED_LIMITS 0.000000 255.000000 /end CHARACTERISTIC
/begin CHARACTERISTIC TC6TECI "Mode 6 Codewort fÅr i.O. PrÅfung des TEVs aus DLDP" VALUE 0x819C2D ME7_FW1 0 dez 0.000000 127.000000 EXTENDED_LIMITS 0.000000 255.000000 /end CHARACTERISTIC
/begin CHARACTERISTIC TC6TECL "Mode 6 Codewort fÅr i.O. PrÅfung des TEVs aus Luft-PrÅfung" VALUE 0x819C2E ME7_FW1 0 dez 0.000000 127.000000 EXTENDED_LIMITS 0.000000 255.000000 /end CHARACTERISTIC
/begin CHARACTERISTIC TC6TECNL "Mode 6 Codewort fÅr NICHT i.O. PrÅfung des TEVs aus Luft-PrÅfung" VALUE 0x819C2F ME7_FW1 0 dez 0.000000 127.000000 EXTENDED_LIMITS 0.000000 255.000000 /end CHARACTERISTIC
/begin CHARACTERISTIC TC6TECP "Mode 6 Codewort fÅr passive i.O. PrÅfung des TEVs" VALUE 0x819C30 ME7_FW1 0 dez 0.000000 127.000000 EXTENDED_LIMITS 0.000000 255.000000 /end CHARACTERISTIC
/begin CHARACTERISTIC TC6TECRF "Mode 6 Codewort fÅr i.O. PrÅfung des TEVs aus FR-Abweichung Richtung fett" VALUE 0x819C31 ME7_FW1 0 dez 0.000000 127.000000 EXTENDED_LIMITS 0.000000 255.000000 /end CHARACTERISTIC
/begin CHARACTERISTIC TC6TECRM "Mode 6 Codewort fÅr i.O. PrÅfung des TEVs aus FR-Abweichung Richtung mager" VALUE 0x819C32 ME7_FW1 0 dez 0.000000 127.000000 EXTENDED_LIMITS 0.000000 255.000000 /end CHARACTERISTIC
/begin CHARACTERISTIC TC6TECT "Mode 6 Codewort fÅr i.O. PrÅfung des TEVs aus DLDP" VALUE 0x819C33 ME7_FW1 0 dez 0.000000 127.000000 EXTENDED_LIMITS 0.000000 255.000000 /end CHARACTERISTIC
/begin CHARACTERISTIC TCRDWG "Zeit fÅr Counterreset nach LL fÅr Waste- Gate- Diagnose" VALUE 0x819754 ME7_FW1 0 t100msxs_ub_b25p5 0.000000 25.500000 /end CHARACTERISTIC
/begin CHARACTERISTIC TDDFL "Entprellzeit fÅr Fehlereintrag Drucksensor Ladedruck" VALUE 0x81860B ME7_FW1 0 t100msxs_ub_b25p5 0.000000 25.500000 /end CHARACTERISTIC
/begin CHARACTERISTIC TDDFLUGD "Entprellzeit fÅr Fehlereintrag Drucksensor Ladedruck" VALUE 0x81860C ME7_FW1 0 t100msxs_ub_b25p5 0.000000 25.500000 /end CHARACTERISTIC
/begin CHARACTERISTIC TDDFU "Entprellzeit fÅr Fehlereintrag Druckksensor Umgebung" VALUE 0x81860D ME7_FW1 0 t100msxs_ub_b25p5 0.000000 25.500000 /end CHARACTERISTIC
/begin CHARACTERISTIC TDDFUUGD "Entprellzeit fÅr Fehlereintrag Druckksensor Umgebung" VALUE 0x81860E ME7_FW1 0 t100msxs_ub_b25p5 0.000000 25.500000 /end CHARACTERISTIC
/begin CHARACTERISTIC TDDMSLIFT "Entprellzeit fÅr Erkennung Messwert mslift stabil" VALUE 0x818384 ME7_FW1 0 t100msxs_ub_b25p5 0.000000 25.500000 /end CHARACTERISTIC
/begin CHARACTERISTIC TDDNWS "Verzugszeit fÅr Freigabe Diagnose Nockenwellenverstellung in Endpositionen" VALUE 0x8188D2 ME7_FW1 0 t10msxs_ub_b2p55 0.000000 2.550000 /end CHARACTERISTIC
/begin CHARACTERISTIC TDDSLA "Dauer SekundÑrlufteinblasung fÅr Adaptionsphase" VALUE 0x818357 ME7_FW1 0 t100msxs_ub_b25p5 0.000000 25.500000 /end CHARACTERISTIC
/begin CHARACTERISTIC TDEGFEMN "Zeitverzîgerung fÅr Setzen des MIN-Fehlers" VALUE 0x818750 ME7_FW1 0 t100msxs_ub_b25p5 0.000000 25.500000 /end CHARACTERISTIC
/begin CHARACTERISTIC TDEGFEMX "Zeitverzîgerung fÅr Setzen des MAX-Fehlers" VALUE 0x818751 ME7_FW1 0 t100msxs_ub_b25p5 0.000000 25.500000 /end CHARACTERISTIC
/begin CHARACTERISTIC TDEGFENO "Zeitverzîgerung fÅr Setzen des NO-Fehlers" VALUE 0x818752 ME7_FW1 0 t100msxs_ub_b25p5 0.000000 25.500000 /end CHARACTERISTIC
/begin CHARACTERISTIC TDEGFEST "Zeitverzîgerung nach Start" VALUE 0x818753 ME7_FW1 0 t100msxs_ub_b25p5 0.000000 25.500000 /end CHARACTERISTIC
/begin CHARACTERISTIC TDFHS "Entprellzeit fÅr Heizerendstufe" VALUE 0x818589 ME7_FW1 0 t10msxs_ub_b2p55 0.000000 2.550000 /end CHARACTERISTIC
/begin CHARACTERISTIC TDFRKAD "Absteuerzeit fÅr gesteuertes Katalysator-AusrÑumen" VALUE 0x8136D0 ME7_FW3 0 zk20msxs_uw_b1310 0.019989 1310.000000 /end CHARACTERISTIC
/begin CHARACTERISTIC TDFRKAU "Aufsteuerzeit fÅr gesteuertes Katalysator-AusrÑumen" VALUE 0x8136D2 ME7_FW3 0 zk20msxs_uw_b1310 0.019989 1310.000000 /end CHARACTERISTIC
/begin CHARACTERISTIC TDKATAKT "Schwellwert Zyklus fertig wenn aktive öberwachungszeit > TDKATAKT" VALUE 0x81AD68 ME7_FW3 0 t50msxs_uw_b3276p75 0.000000 3276.750000 /end CHARACTERISTIC
/begin CHARACTERISTIC TDKATATT "Schwellwert Zyklus fertig fÅr Funktionsanforderung" VALUE 0x81AD6A ME7_FW3 0 t50msxs_uw_b3276p75 0.000000 3276.750000 /end CHARACTERISTIC
/begin CHARACTERISTIC TDKLAGDE "Zeitdelta fÅr FehlerzÑhlerlîschung bei DK-Soll-/Istvergleich" VALUE 0x814F5B ME7_FW1 0 t20msxs_ub_b5p1 0.000000 5.100000 /end CHARACTERISTIC
/begin CHARACTERISTIC TDKNLPE "Zeit bis stromlose DK in NLP einschwingt" VALUE 0x810C5E ME7_FW3 0 t100msxs_uw_b6553p5 0.000000 6553.500000 /end CHARACTERISTIC
/begin CHARACTERISTIC TDKPAW "Zeit fÅr DK-Poti-Auswahl" VALUE 0x814E85 ME7_FW1 0 t10msxs_ub_b2p55 0.010000 2.550000 EXTENDED_LIMITS 0.000000 2.550000 /end CHARACTERISTIC
/begin CHARACTERISTIC TDKUPNOG "Verzîgerungszeit nach Gangwechsel bis erneute Gangwechselerk. mîglich" VALUE 0x818599 ME7_FW1 0 t1sxs_ub_b255 0.000000 255.000000 /end CHARACTERISTIC
/begin CHARACTERISTIC TDLDPE "Entprellzeit fÅr Fehler setzen LDP-Endstufe" VALUE 0x8185E0 ME7_FW1 0 t100msxs_ub_b25p5 0.000000 25.500000 /end CHARACTERISTIC
/begin CHARACTERISTIC TDLDRA "Zeitschwelle fÅr Dia LDR - Regelabweichung" VALUE 0x81974B ME7_FW1 0 t50msxs_ub_b12p75 0.000000 12.500000 EXTENDED_LIMITS 0.000000 12.750000 /end CHARACTERISTIC
/begin CHARACTERISTIC TDLDRA2 "Zeitschwelle fÅr Dia LDR - Regelabweichung (B_mxldra)" VALUE 0x81974C ME7_FW1 0 t50msxs_ub_b12p75 0.000000 12.500000 EXTENDED_LIMITS 0.000000 12.750000 /end CHARACTERISTIC
/begin CHARACTERISTIC TDLLR "Wartezeit bis setzten der Bedingung Diagnose Leerlaufsteller" VALUE 0x81CC28 ME7_FW3 0 t200msxs_ub_b51___UW 0.000000 255.000000 EXTENDED_LIMITS 0.000000 13107.000000 /end CHARACTERISTIC
/begin CHARACTERISTIC TDLLRMN "Wartezeit bis Fehlereintrag Steller geschlossen" VALUE 0x81CC2A ME7_FW3 0 t200msxs_ub_b51___UW 0.000000 255.000000 EXTENDED_LIMITS 0.000000 13107.000000 /end CHARACTERISTIC
/begin CHARACTERISTIC TDLLRMX "Wartezeit bis Fehlereintrag Steller offen" VALUE 0x81CC2C ME7_FW3 0 t200msxs_ub_b51___UW 0.000000 255.000000 EXTENDED_LIMITS 0.000000 13107.000000 /end CHARACTERISTIC
/begin CHARACTERISTIC TDLLRNF "Wartezeit bis Meldung kein Fehler bei Leerlaufsteller" VALUE 0x81CC2E ME7_FW3 0 t200msxs_ub_b51___UW 0.000000 255.000000 EXTENDED_LIMITS 0.000000 13107.000000 /end CHARACTERISTIC
/begin CHARACTERISTIC TDLRPIDC "Zeitdelta zur Fehlerzeitdecrementierung bei DLR-StellbereichsÅberwachung" VALUE 0x810CDA ME7_FW3 0 t10msxs_uw_b655p35 0.000000 655.350000 /end CHARACTERISTIC
/begin CHARACTERISTIC TDLRPIDMX "max. Zeit fÅr PWM-TastverhÑltnis des DLR bei temp. UMA-Adapt." VALUE 0x814EC4 ME7_FW1 0 t50msxs_q0p05 0.000000 12.750000 /end CHARACTERISTIC
/begin CHARACTERISTIC TDMFBSA "Zeitkonstante PT1-Filter beim Schubabschalten" VALUE 0x81327E ME7_FW3 0 zk10msxs_uw_b655 0.010000 655.360000 /end CHARACTERISTIC
/begin CHARACTERISTIC TDMFBWE "Zeitkonstante PT1-Filter beim weichen Wiedereinsetzen" VALUE 0x813280 ME7_FW3 0 zk10msxs_uw_b655 0.010000 655.360000 /end CHARACTERISTIC
/begin CHARACTERISTIC TDMFWEMI "Filterzeitkonstante beim harten Wiedereinsetzen" CURVE 0x813282 ZF_KL111 0 zk10msxs_uw_b655 0.010001 655.360000
 /begin AXIS_DESCR STD_AXIS mivbeb_w rel_uw_b100 8 0.000000 99.998500 DEPOSIT ABSOLUTE /end AXIS_DESCR
 EXTENDED_LIMITS 0.010000 655.360000 /end CHARACTERISTIC
/begin CHARACTERISTIC TDMLHFM "Zeitverzîgerung fÅr das Setzen von B_ehfm" VALUE 0x8185F9 ME7_FW1 0 t100msxs_ub_b25p5 0.000000 0.200000 EXTENDED_LIMITS 0.000000 25.500000 /end CHARACTERISTIC
/begin CHARACTERISTIC TDMLMN "Entprellzeit HFM-(Hauptlastgeber-)Fehlererkennung Minimalwert" VALUE 0x8185FA ME7_FW1 0 t100msxs_ub_b25p5 0.000000 25.500000 /end CHARACTERISTIC
/begin CHARACTERISTIC TDMLMX "Entprellzeit HFM-(Hauptlastgeber-)Fehlererkennung Maximalwert" VALUE 0x8185FB ME7_FW1 0 t100msxs_ub_b25p5 0.000000 25.500000 /end CHARACTERISTIC
/begin CHARACTERISTIC TDMLNF "Entprellzeit HFM-(Hauptlastgeber-)Diagnose mit i.O.-Meldung" VALUE 0x8185FC ME7_FW1 0 t100msxs_ub_b25p5 0.000000 25.500000 /end CHARACTERISTIC
/begin CHARACTERISTIC TDMLSDS "Zeit nach KupplungsbetÑtigung mit verÑnderter LSD-Auslîsung" VALUE 0x815704 ME7_FW1 0 t20msxs_ub_b5p1 0.000000 5.100000 /end CHARACTERISTIC
/begin CHARACTERISTIC TDMLST "Entprellzeit HFM-(Hauptlastgeber-)Fehlererkennung im Start" VALUE 0x8185FD ME7_FW1 0 t100msxs_ub_b25p5 0.000000 25.500000 /end CHARACTERISTIC
/begin CHARACTERISTIC TDMRESLL "Sperrzeit fÅr die erhîhte Momentenreserve nach dem Start" VALUE 0x81986B ME7_FW1 0 t200msxs_ub_b51 0.000000 51.000000 /end CHARACTERISTIC
/begin CHARACTERISTIC TDMSDKS "Zeitverzîgerung bis das Bit B_fkmsdks wirksam wird" VALUE 0x8150F1 ME7_FW1 0 dez 0.000000 255.000000 /end CHARACTERISTIC
/begin CHARACTERISTIC TDMSLMN1 "Mindestme·zeit SekundÑrluftmasse, Phase 1" VALUE 0x818385 ME7_FW1 0 t100msxs_ub_b25p5 0.000000 25.500000 /end CHARACTERISTIC
/begin CHARACTERISTIC TDMSLMN4 "Mindestme·zeit SekundÑrluftmasse, Phase 4" VALUE 0x818386 ME7_FW1 0 t100msxs_ub_b25p5 0.000000 25.500000 /end CHARACTERISTIC
/begin CHARACTERISTIC TDMSLMNK "Mindestme·zeit SekundÑrluftmasse, Phase 1 bei Kurztest" VALUE 0x818387 ME7_FW1 0 t100msxs_ub_b25p5 0.000000 25.500000 /end CHARACTERISTIC
/begin CHARACTERISTIC TDMSLOF3 "Me·zeit Offset SekundÑrluftmasse, Phase 3" VALUE 0x818388 ME7_FW1 0 t100msxs_ub_b25p5 0.000000 25.500000 /end CHARACTERISTIC
/begin CHARACTERISTIC TDMSLOF5 "Me·zeit Offset sekundÑrluftmasse, Phase 5" VALUE 0x818389 ME7_FW1 0 t100msxs_ub_b25p5 0.000000 25.500000 /end CHARACTERISTIC
/begin CHARACTERISTIC TDMSLOFK "Me·zeit Offset SekundÑrluftmasse, Phase 3 bei Kurztest" VALUE 0x81838A ME7_FW1 0 t100msxs_ub_b25p5 0.000000 25.500000 /end CHARACTERISTIC
/begin CHARACTERISTIC TDMSLV "Messzeit fÅr VentildichtheitsprÅfung" VALUE 0x81838B ME7_FW1 0 t100msxs_ub_b25p5 0.000000 25.500000 /end CHARACTERISTIC
/begin CHARACTERISTIC TDMSLVK "Me·zeit fÅr VentildichtheitsprÅfung bei Kurztest" VALUE 0x81838C ME7_FW1 0 t100msxs_ub_b25p5 0.000000 25.500000 /end CHARACTERISTIC
/begin CHARACTERISTIC TDNSTA "AuspufferwÑrmzeit ab Start, fÅr TANS - Diagnose" VALUE 0x818FD7 ME7_FW1 0 t1sxs_ub_b255 0.000000 255.000000 /end CHARACTERISTIC
/begin CHARACTERISTIC TDNSUB "Batterie - Erholzeit ab Start, fÅr UBATT - Diagnose" VALUE 0x814DA4 ME7_FW1 0 t100msxs_ub_b255 0.000000 255.000000 /end CHARACTERISTIC
/begin CHARACTERISTIC TDNWSP "Zeitverzîgerung fÅr PrÅfung Nockenwellenverschiebung" VALUE 0x8183AD ME7_FW1 0 t200msxs_ub_b51 0.000000 51.000000 /end CHARACTERISTIC
/begin CHARACTERISTIC TDNX "Entprellzeit Fehlertyp max.: öberdrehzahl" VALUE 0x814D73 ME7_FW1 0 t10msxs_ub_b2p55 0.000000 2.550000 /end CHARACTERISTIC
/begin CHARACTERISTIC TDPDK "Zeitkonstante Abregelung fÅr Faktor fmvp_w" VALUE 0x81284C ME7_FW3 0 zk50msxs_uw_b3276p8 0.050001 1638.400000 EXTENDED_LIMITS 0.050001 3276.800000 /end CHARACTERISTIC
/begin CHARACTERISTIC TDPH2SLOF "Zeit Einschaltverzîgerung von Phase 2 nach Phase 3" VALUE 0x81838D ME7_FW1 0 t100msxs_ub_b25p5 0.000000 25.500000 /end CHARACTERISTIC
/begin CHARACTERISTIC TDPHSLOF "Zeit Einschaltverzîgerung Bit B_slsoff in Phase 2, 3 und 5 nach" VALUE 0x81838E ME7_FW1 0 t100msxs_ub_b25p5 0.000000 25.500000 /end CHARACTERISTIC
/begin CHARACTERISTIC TDSLKT "Dauer Kurztest SekundÑrluftdiagnose fÅr Massenmessung" VALUE 0x818358 ME7_FW1 0 t100msxs_ub_b25p5 0.000000 25.500000 /end CHARACTERISTIC
/begin CHARACTERISTIC TDSLMVBA "Einschaltverzîgerung BA-/VA-Sperre bei Bildung B_dslmes" VALUE 0x81838F ME7_FW1 0 t100msxs_ub_b25p5 0.000000 25.500000 /end CHARACTERISTIC
/begin CHARACTERISTIC TDTA "Entprellzeit Fehlererkennung TANS" VALUE 0x818FD8 ME7_FW1 0 t100msxs_ub_b25p5 0.000000 25.500000 /end CHARACTERISTIC
/begin CHARACTERISTIC TDTAL "TANS Fehlererkennung / Zeitsperre ab B_LL = 1" VALUE 0x818FD9 ME7_FW1 0 t1sxs_ub_b255 0.000000 255.000000 /end CHARACTERISTIC
/begin CHARACTERISTIC TDTEFA "Zeit fÅr Sperre DTEV ab Start bei Testeranforderung" VALUE 0x81D9B4 ME7_FW3 0 t100msxs_uw_b6553p6 20.000000 200.000000 EXTENDED_LIMITS 0.000000 6553.500000 /end CHARACTERISTIC
/begin CHARACTERISTIC TDTESZO "Zeit ab Startende fÅr schnelle SpÅlratenabsteuerung DTEV bei B_ll = TRUE inaktiv" VALUE 0x81D9B6 ME7_FW3 0 t100msxs_uw_b6553p6 0.000000 6553.500000 /end CHARACTERISTIC
/begin CHARACTERISTIC TDTESZU "Zeit ab Startende fÅr Aktivierung SpÅlratenabsteuerung DTEV bei B_ll = TRUE" VALUE 0x81D9B8 ME7_FW3 0 t100msxs_uw_b6553p6 0.000000 6553.500000 /end CHARACTERISTIC
/begin CHARACTERISTIC TDTEZAM "Zeit ab Start fÅr aktive DTEV mîglich" VALUE 0x81D9BA ME7_FW3 0 t100msxs_uw_b6553p6 0.000000 6553.500000 /end CHARACTERISTIC
/begin CHARACTERISTIC TDTM "Entprellzeit Fehlererkennung TMOT" VALUE 0x81BABE ME7_FW3 0 t100msxs_uw_b6553p5 0.000000 6553.500000 /end CHARACTERISTIC
/begin CHARACTERISTIC TDTMMA "Verzîgerungszeit Anfangswert Motortemperaturmodell" VALUE 0x81BAC0 ME7_FW3 0 t10msxs_uw_b655p35 0.000000 655.350000 /end CHARACTERISTIC
/begin CHARACTERISTIC TDUB "Wartezeit fÅr UBATT-Diagnose" VALUE 0x814DA5 ME7_FW1 0 t100msxs_ub_b25p5 0.000000 25.500000 /end CHARACTERISTIC
/begin CHARACTERISTIC TDUBHFM "Zeit fÅr HFM-Diagnose mit u < UBHFM" VALUE 0x8185FE ME7_FW1 0 t100msxs_ub_b25p5 0.000000 25.500000 /end CHARACTERISTIC
/begin CHARACTERISTIC TDV "Fehlererkennung Tachosignal / Zeitdauer fÅr Abfrage" VALUE 0x818594 ME7_FW1 0 t50msxs_ub_b12p75 0.000000 12.750000 /end CHARACTERISTIC
/begin CHARACTERISTIC TDVIVZ "Toleranzzeit bei zu gro·er Abweichung zw. Istgeschw. und Zielgeschw." VALUE 0x810CFC ME7_FW3 0 t20msxs_uw_q0p02 0.020000 1310.700000 EXTENDED_LIMITS 0.000000 1310.700000 /end CHARACTERISTIC
/begin CHARACTERISTIC TDVZVI "Toleranzzeit bei zu gro·er Abweichung zw. Zielgeschw. und Istgeschw." VALUE 0x810CFE ME7_FW3 0 t20msxs_uw_q0p02 0.020000 1310.700000 EXTENDED_LIMITS 0.000000 1310.700000 /end CHARACTERISTIC
/begin CHARACTERISTIC TDWGA "Zeit fÅr Diagnose Wast- Gate aufgesteuert" VALUE 0x819755 ME7_FW1 0 t100msxs_ub_b25p5 0.000000 25.500000 /end CHARACTERISTIC
/begin CHARACTERISTIC TDWGF "Entprellzeit Eingangsbedingungen 1 fÅr Diagnose Waste- Gate" VALUE 0x819756 ME7_FW1 0 t100msxs_ub_b25p5 0.000000 25.500000 /end CHARACTERISTIC
/begin CHARACTERISTIC TEBF "EKP Einschaltzeit fÅr ErstbefÅllung Kraftstoffsystems" VALUE 0x8164C8 ME7_FW1 0 t1sxs_ub_b255 0.000000 255.000000 /end CHARACTERISTIC
/begin CHARACTERISTIC TEMIN "minimales TE" VALUE 0x811F28 ME7_FW3 0 tinjection_sy 0.000000 209.712000 /end CHARACTERISTIC
/begin CHARACTERISTIC TEMINVA "minimales TE bei VA" VALUE 0x811F2A ME7_FW3 0 tinjection_sy 0.000000 209.712000 /end CHARACTERISTIC
/begin CHARACTERISTIC TEPBRKUP "Entprellzeit fÅr Brems- und Kupplungsschalter" VALUE 0x814F5F ME7_FW1 0 t20msxs_ub_b5p1 0.000000 5.100000 /end CHARACTERISTIC
/begin CHARACTERISTIC TEPCL "Zeit ab Motorlauf bis EPCL-Testansteuerung Ende" VALUE 0x814D60 ME7_FW1 0 t200msxs_ub_b51 0.000000 51.000000 /end CHARACTERISTIC
/begin CHARACTERISTIC TEPCLI "Zeit ab INI bis EPCL-Testansteuerung Ende" VALUE 0x814D61 ME7_FW1 0 t200msxs_ub_b51 0.000000 51.000000 /end CHARACTERISTIC
/begin CHARACTERISTIC TEPFGRH "Entprellzeit fÅr FGR-Bedienhebel" VALUE 0x81859B ME7_FW1 0 t20msxs_ub_b5p1 0.000000 5.100000 /end CHARACTERISTIC
/begin CHARACTERISTIC TEVCKMX "Maximale SpÅlzeit bei DLDP-TEV- Check" VALUE 0x8135D2 ME7_FW3 0 t10msxs_uw_b655p35 0.000000 655.350000 /end CHARACTERISTIC
/begin CHARACTERISTIC TFDLLRO "Obere Schwelle fÅr Zeitfenster fÅr DLLR" VALUE 0x81CC30 ME7_FW3 0 t100msxs_uw_b6553p5 0.000000 6553.500000 /end CHARACTERISTIC
/begin CHARACTERISTIC TFDLLRU "Untere Schwelle fÅr Zeitfenster fÅr DLLR" VALUE 0x81CC32 ME7_FW3 0 t100msxs_uw_b6553p5 0.000000 6553.500000 /end CHARACTERISTIC
/begin CHARACTERISTIC TFGRAQU "Toleranzzeit fÅr Aquaplaningerkennung im FGR-Betrieb" VALUE 0x814FED ME7_FW1 0 t20msxs_ub_b5p1 0.020000 5.100000 EXTENDED_LIMITS 0.000000 5.100000 /end CHARACTERISTIC
/begin CHARACTERISTIC TFGRARLG "Rampenlaufzeit bei langsamer FGR-Abschaltung" CURVE 0x8185CE ME7_KL97 0 t20msxs_ub_b5p1 0.000000 5.100000 /begin AXIS_DESCR STD_AXIS gangi dez 8 0.000000 255.000000 DEPOSIT ABSOLUTE /end AXIS_DESCR /end CHARACTERISTIC
/begin CHARACTERISTIC TFGRTP "Zeit fÅr Tip-Erkennung bei FGR-Bedientasten" VALUE 0x8185CD ME7_FW1 0 t20msxs_ub_b5p1 0.020000 5.100000 EXTENDED_LIMITS 0.000000 5.100000 /end CHARACTERISTIC
/begin CHARACTERISTIC TFGRUEOB "Toleranzzeit fÅr öberschreiten der oberen Beschleunigungsschwelle im FGR-Betrieb" VALUE 0x814FEE ME7_FW1 0 t20msxs_ub_b5p1 0.020000 5.100000 EXTENDED_LIMITS 0.000000 5.100000 /end CHARACTERISTIC
/begin CHARACTERISTIC TFGRUM "Toleranzzeit fÅr Erkennung FGR-Betrieb in der FunktionsÅberwachung" VALUE 0x814FEF ME7_FW1 0 t20msxs_ub_b5p1 0.020000 5.100000 EXTENDED_LIMITS 0.000000 5.100000 /end CHARACTERISTIC
/begin CHARACTERISTIC TFGRUNUB "Toleranzzeit fÅr Unterschreiten d. unteren Beschl.schwelle im FGR-Betrieb" VALUE 0x814FF0 ME7_FW1 0 t20msxs_ub_b5p1 0.020000 5.100000 EXTENDED_LIMITS 0.000000 5.100000 /end CHARACTERISTIC
/begin CHARACTERISTIC TFGRVRAB "FGR: Zeit fÅr Geschwindigkeitsabschaltung Åber vroh =0" VALUE 0x814328 ME7_FW1 0 t10msxs_ub_b2p55 0.000000 2.550000 /end CHARACTERISTIC
/begin CHARACTERISTIC TFIMSLI "Zeitkonstante fÅr msli- und msln-Filter" VALUE 0x818390 ME7_FW1 0 zk100msxs_ub_b25p5 0.100392 12.800000 EXTENDED_LIMITS 0.100392 25.600000 /end CHARACTERISTIC
/begin CHARACTERISTIC TFIMSLIK "Zeitkonstante fÅr msli- und msln-Filter bei Kurztest" VALUE 0x818391 ME7_FW1 0 zk100msxs_ub_b25p5 0.100392 12.800000 EXTENDED_LIMITS 0.100392 25.600000 /end CHARACTERISTIC
/begin CHARACTERISTIC TFIMSLO "Zeitkonstante fÅr mslo- Filter" VALUE 0x818392 ME7_FW1 0 zk100msxs_ub_b25p5 0.100392 12.800000 EXTENDED_LIMITS 0.100392 25.600000 /end CHARACTERISTIC
/begin CHARACTERISTIC TFIMSLOK "Zeitkonstante fÅr mslo- Filter bei Kurztest" VALUE 0x818393 ME7_FW1 0 zk100msxs_ub_b25p5 0.100392 12.800000 EXTENDED_LIMITS 0.100392 25.600000 /end CHARACTERISTIC
/begin CHARACTERISTIC TFIMSLV "Zeitkonstante fÅr mslv- Filter" VALUE 0x818394 ME7_FW1 0 zk100msxs_ub_b25p5 0.100392 12.800000 EXTENDED_LIMITS 0.100392 25.600000 /end CHARACTERISTIC
/begin CHARACTERISTIC TFIMSLVK "Zeitkonstante fÅr mslv- Filter bei Kurztest" VALUE 0x818395 ME7_FW1 0 zk100msxs_ub_b25p5 0.100392 12.800000 EXTENDED_LIMITS 0.100392 25.600000 /end CHARACTERISTIC
/begin CHARACTERISTIC TFMIZU "Filterzeitkonstante zur Filterung des zulÑssigen Moments" VALUE 0x81346C ME7_FW3 0 zk10msxs_uw_b655 0.010000 655.360000 /end CHARACTERISTIC
/begin CHARACTERISTIC TFPWG2 "Filterzeit zur Filterung von Poti 2 bei der Bewegungserkennung" VALUE 0x810C38 ME7_FW3 0 zk10msxs_uw_b655 0.010000 655.360000 /end CHARACTERISTIC
/begin CHARACTERISTIC TFRA "Erkennungszeit fÅr eingeschwungene Grundadaption von fra" VALUE 0x818E19 ME7_FW1 0 t200msxs_ub_b51 0.000000 51.000000 /end CHARACTERISTIC
/begin CHARACTERISTIC TFRAOZ "Verweilzeit in FRAO fÅr Zyklusflag bei nicht eingeschw. Adaption" VALUE 0x818E1A ME7_FW1 0 t200msxs_ub_b51 0.000000 51.000000 /end CHARACTERISTIC
/begin CHARACTERISTIC TFRAUZ "Verweilzeit in FRAU fÅr Zyklusflag bei nicht eingeschw. Adaption" VALUE 0x818E1B ME7_FW1 0 t200msxs_ub_b51 0.000000 51.000000 /end CHARACTERISTIC
/begin CHARACTERISTIC TFRMB "Verzîg.zeit fÅr Erkennung Mittelwert des Lambdareglers innerhalb Schwellen" VALUE 0x8184BE ME7_FW1 0 t100msxs_ub_b25p5 0.000000 25.500000 /end CHARACTERISTIC
/begin CHARACTERISTIC TFRMDTEE "Erkennungszeit fÅr eingeschwungene frm" VALUE 0x819C34 ME7_FW1 0 t100msxs_ub_b25p5 0.000000 3.000000 EXTENDED_LIMITS 0.000000 25.500000 /end CHARACTERISTIC
/begin CHARACTERISTIC TFRMST "Erkennungszeit fÅr eingeschwungene Grundadaption von frm" VALUE 0x818E1C ME7_FW1 0 t200msxs_ub_b51 0.000000 51.000000 /end CHARACTERISTIC
/begin CHARACTERISTIC TFRMZST "Verweilzeit fÅr unplausibles frm-Signal (Kurztest)" VALUE 0x818E1D ME7_FW1 0 t200msxs_ub_b51 0.000000 51.000000 /end CHARACTERISTIC
/begin CHARACTERISTIC TFTEINI "Zeit fÅr Erkennung TE Stop" VALUE 0x813536 ME7_FW3 0 t100msxs_uw_b6553p5 0.000000 6553.500000 /end CHARACTERISTIC
/begin CHARACTERISTIC TFWDKPN "Zeitkonstante fÅr Filterung der DK-Winkel vor Vergl. mit Ersatzwert aus FÅllung" CURVE 0x814E86 ME7_KL97 0 zk10msxs_ub_b2p55 0.010000 2.550000
 /begin AXIS_DESCR STD_AXIS nmot nmot_ub_q40 6 0.000000 10200.000000 DEPOSIT ABSOLUTE /end AXIS_DESCR
/end CHARACTERISTIC
/begin CHARACTERISTIC TFWPFGR "Filterzeitkonstante fÅr Berechnung wpfgr_w" VALUE 0x81B156 ME7_FW3 0 zk50msxs_uw_b3276p8 0.050001 3276.800000 /end CHARACTERISTIC
/begin CHARACTERISTIC TGGLS "Zeitdauer fÅr ADC nach Interrupt im Funktionsrechner (Asic)" VALUE 0x814D79 ME7_FW1 0 t1msxms_q1 3.000000 5.000000 EXTENDED_LIMITS 0.000000 255.000000 /end CHARACTERISTIC
/begin CHARACTERISTIC THEH "Zeit fÅr maximale Sondenheizung nach Start hinter Kat" VALUE 0x81AD78 ME7_FW3 0 t100msxs_uw_b6553p6 0.000000 6553.500000 /end CHARACTERISTIC
/begin CHARACTERISTIC THEV "Zeit fÅr maximale Sondenheizung nach Start vor Kat" VALUE 0x81AD7A ME7_FW3 0 t100msxs_uw_b6553p6 0.000000 6553.500000 /end CHARACTERISTIC
/begin CHARACTERISTIC THHA "Auszeit fÅr Reduzierung der Heizleistung Sonde hinter Kat bei 13V" VALUE 0x8184FA ME7_FW1 0 t10msxs_q0p01_o0p05 -0.050000 2.500000 /end CHARACTERISTIC
/begin CHARACTERISTIC THHA2 "Auszeit fÅr Reduzierung der Heizleistung Sonde2 hinter Kat bei 13V" VALUE 0x8184FB ME7_FW1 0 t10msxs_q0p01_o0p05 -0.050000 2.500000 /end CHARACTERISTIC
/begin CHARACTERISTIC THHAWU "Ausschaltzeit wÑhrend Leistungsreduzierung Sondenheizung hinter Kat" VALUE 0x8184FC ME7_FW1 0 t10msxs_ub_b2p55 0.000000 2.550000 /end CHARACTERISTIC
/begin CHARACTERISTIC THLDUVD "Haltezeit LDR Umluftventilsteuerung dynamisch" VALUE 0x81260A ME7_FW3 0 t50msxs_uw_b3276p75 0.000000 3276.750000 /end CHARACTERISTIC
/begin CHARACTERISTIC THOPP1 "Fehlerzeit bei HochohmigkeitsprÅfung Poti 1" VALUE 0x814DB9 ME7_FW1 0 t10msxs_ub_b2p55 0.000000 2.550000 /end CHARACTERISTIC
/begin CHARACTERISTIC THOPP2 "Fehlerzeit bei HochohmigkeitsprÅfung Poti 2" VALUE 0x814DBA ME7_FW1 0 t10msxs_ub_b2p55 0.000000 2.550000 /end CHARACTERISTIC
/begin CHARACTERISTIC THSHKTK "Kennlinie fÅr die Ausschaltdauer der Sondenheizung abh. v.d. Abgastemp. h.Kat" CURVE 0x8184FD ME7_KL97 0 t10msxs_q0p01_o0p05 -0.050000 2.500000
 /begin AXIS_DESCR STD_AXIS tkatm temp_ub_q5_o50 8 -50.000000 1225.000000 DEPOSIT ABSOLUTE /end AXIS_DESCR
/end CHARACTERISTIC
/begin CHARACTERISTIC THSRIH "Zeitverzîg. Bereitschaft der Ri-Messung nach eingesch. Sondenheizung hinter KAT" VALUE 0x810BBE ME7_FW3 0 t10msxs_uw_b655p35 0.000000 655.350000 /end CHARACTERISTIC
/begin CHARACTERISTIC THSRIV "Zeitverzîgerte Bereitschaft der Ri-Messung nach eingesch. Sondenheizung vor KAT" VALUE 0x810BD2 ME7_FW3 0 t10msxs_uw_b655p35 0.000000 655.350000 /end CHARACTERISTIC
/begin CHARACTERISTIC THSVKTA "Kennlinie fÅr die Ausschaltdauer der Sondenheizung abh. v.d. Abgastemp. vor Kat" CURVE 0x81850E ME7_KL97 0 t10msxs_q0p01_o0p05 -0.050000 2.500000
 /begin AXIS_DESCR STD_AXIS tabgm temp_ub_q5_o50 8 -50.000000 1225.000000 DEPOSIT ABSOLUTE /end AXIS_DESCR
/end CHARACTERISTIC
/begin CHARACTERISTIC THVA "Auszeit fÅr Reduzierung der Heizleistung Sonde vor Kat bei 13V" VALUE 0x81851F ME7_FW1 0 t10msxs_q0p01_o0p05 -0.050000 2.500000 /end CHARACTERISTIC
/begin CHARACTERISTIC THVA2 "Auszeit fÅr Reduzierung der Heizleistung Sonde2 vor Kat bei 13V" VALUE 0x818520 ME7_FW1 0 t10msxs_q0p01_o0p05 -0.050000 2.500000 /end CHARACTERISTIC
/begin CHARACTERISTIC THVAWU "Ausschaltzeit wÑhrend Leistungsreduzierung Sondenheizung vor Kat" VALUE 0x818521 ME7_FW1 0 t10msxs_ub_b2p55 0.000000 2.550000 /end CHARACTERISTIC
/begin CHARACTERISTIC TIDLEMAX "" VALUE 0x819459 ME7_FW1 0 t100msxs_ub_b25p5 10.000000 10.000000 EXTENDED_LIMITS 0.000000 25.500000 /end CHARACTERISTIC
/begin CHARACTERISTIC TIDLEMIN "" VALUE 0x81945A ME7_FW1 0 t100msxs_ub_b25p5 2.400000 2.400000 EXTENDED_LIMITS 0.000000 25.500000 /end CHARACTERISTIC
/begin CHARACTERISTIC TISPMN "Minimale SpÅldauer bei InitialspÅlung Leckdiagnose" VALUE 0x819C6B ME7_FW1 0 t1sxs_ub_b255 0.000000 255.000000 /end CHARACTERISTIC
/begin CHARACTERISTIC TIZUMN "Minimale Zeit fÅr TEV-zu bei InitialspÅlung Leckdiagnose" VALUE 0x819C6C ME7_FW1 0 t1sxs_ub_b255 0.000000 255.000000 /end CHARACTERISTIC
/begin CHARACTERISTIC TKATBTS "Kat-Temperaturschwelle fÅr Bauteileschutz" VALUE 0x81BA34 ME7_FW3 0 temp_uw_q0p0195_o50 -50.000000 1229.980000 EXTENDED_LIMITS -50.000000 1229.980469 /end CHARACTERISTIC
/begin CHARACTERISTIC TKATDSL "maximale Katalysatortemperatur fÅr Freigabe SLS-Diagnose" VALUE 0x818396 ME7_FW1 0 temp_ub_q5_o50 -50.000000 1225.000000 /end CHARACTERISTIC
/begin CHARACTERISTIC TKATMLRH "Einschaltschwelle Kat-Modelltemperatur  fÅr Lambdaregelung hinter Kat" VALUE 0x815EB1 ME7_FW1 0 temp_ub_q5_o50 -50.000000 1225.000000 /end CHARACTERISTIC
/begin CHARACTERISTIC TKATMLRH2 "Einschaltschwelle Kat-Modelltemperatur  fÅr Lambdaregelung hinter Kat, Bank 2" VALUE 0x815EB2 ME7_FW1 0 temp_ub_q5_o50 -50.000000 1225.000000 /end CHARACTERISTIC
/begin CHARACTERISTIC TKATMN "Katalysatortemperaturregelschwelle fÅr Kat warmhalten" VALUE 0x819088 ME7_FW1 0 temp_ub_q5_o50 -50.000000 1225.000000 /end CHARACTERISTIC
/begin CHARACTERISTIC TKATMOE "Temperaturkorrektur im Kat ohne Exotherme" VALUE 0x8184A4 ME7_FW2 0 temp_q5 -640.000000 635.000000 /end CHARACTERISTIC
/begin CHARACTERISTIC TKATSA "Katalysator-Temperaturschwelle fÅr Schubabschalten" VALUE 0x815536 ME7_FW1 0 temp_ub_q5_o50 -50.000000 1225.000000 /end CHARACTERISTIC
/begin CHARACTERISTIC TKATW "Katalysatortemperaturschwelle fÅr Kat warmhalten" VALUE 0x819089 ME7_FW1 0 temp_ub_q5_o50 -50.000000 1225.000000 /end CHARACTERISTIC
/begin CHARACTERISTIC TKD "Lernzeit fÅr Kick-Down-Position" VALUE 0x814DD5 ME7_FW1 0 t10msxs_ub_b2p55 0.000000 2.550000 /end CHARACTERISTIC
/begin CHARACTERISTIC TKHABB "Entprellzeit fÅr Abbruchbedingungen der Funktion Katheizen" VALUE 0x81908A ME7_FW1 0 t100msxs_ub_b25p5 0.000000 25.500000 /end CHARACTERISTIC
/begin CHARACTERISTIC TKHFSAB "Entprellzeit fÅr Umschaltung auf Katheizdrehzahl bei Fahrstufe" VALUE 0x81908B ME7_FW1 0 t100msxs_ub_b25p5 0.000000 25.500000 /end CHARACTERISTIC
/begin CHARACTERISTIC TKHLL "Abbruchzeit Katheizen Leerlauf" VALUE 0x81BB6E ME7_FW3 0 t100msxs_uw_b6553p5 0.000000 6553.500000 /end CHARACTERISTIC
/begin CHARACTERISTIC TKHLLAB "Entprellzeit fÅr Ende Katheizdrehzahl im LL" VALUE 0x81908C ME7_FW1 0 t100msxs_ub_b25p5 0.000000 25.500000 /end CHARACTERISTIC
/begin CHARACTERISTIC TKHLLMX "Maximale Zeit fÅr angehobene Katheiz-Drehzahl" VALUE 0x81BB70 ME7_FW3 0 t10msxs_uw_b655p35 0.000000 655.350000 /end CHARACTERISTIC
/begin CHARACTERISTIC TKHMX "Maximale Einschaltdauer der Funktion Katheizen" VALUE 0x81BB72 ME7_FW3 0 t10msxs_uw_b655p35 0.000000 655.350000 /end CHARACTERISTIC
/begin CHARACTERISTIC TKOAMAD "Kompressorssperrzeit fÅr Bedarfsadaption" VALUE 0x81649B ME7_FW1 0 t200msxs_ub_b51 0.000000 51.000000 /end CHARACTERISTIC
/begin CHARACTERISTIC TKOAMNN "Minimale Abschaltzeit des Klimakompressors" CURVE 0x81649C ME7_GKL1 0 t200msxs_ub_b51 0.000000 51.000000
 /begin AXIS_DESCR COM_AXIS nmot nmot_ub_q40 0 0.000000 10200.000000 AXIS_PTS_REF SNM08KOUB /end AXIS_DESCR
/end CHARACTERISTIC
/begin CHARACTERISTIC TKOAMNPED "minimale Abschaltzeit fÅr Kompressor bei Beschleunigung Åber B_kobped" VALUE 0x8164A4 ME7_FW1 0 t200msxs_ub_b51 0.000000 51.000000 /end CHARACTERISTIC
/begin CHARACTERISTIC TKOAMXN "Maximale Anschaltzeit des Klimakompressors" CURVE 0x8164A5 ME7_GKL1 0 t200msxs_ub_b51 0.000000 51.000000
 /begin AXIS_DESCR COM_AXIS nmot nmot_ub_q40 0 0.000000 10200.000000 AXIS_PTS_REF SNM08KOUB /end AXIS_DESCR
/end CHARACTERISTIC
/begin CHARACTERISTIC TKOEMNN "Minimale Einschaltzeit des Klimakompressors" CURVE 0x8164AD ME7_GKL1 0 t200msxs_ub_b51 0.000000 51.000000
 /begin AXIS_DESCR COM_AXIS nmot nmot_ub_q40 0 0.000000 10200.000000 AXIS_PTS_REF SNM08KOUB /end AXIS_DESCR
/end CHARACTERISTIC
/begin CHARACTERISTIC TKOKO "öberwachungzeit zur Klimatasteerkennung" VALUE 0x8164B5 ME7_FW1 0 t20msxs_ub_b5p1 0.000000 5.100000 /end CHARACTERISTIC
/begin CHARACTERISTIC TKOMBKOA "Motortemperaturschwelle aus Kombiinstrument fÅr Kompressorabschaltung" VALUE 0x8164B6 ME7_FW1 0 temp_ub_q1_o60 -60.000000 195.000000 /end CHARACTERISTIC
/begin CHARACTERISTIC TKOMBKOE "Motortemperaturschwelle aus Kombiinstrument fÅr Kompressoreinschaltung" VALUE 0x8164B7 ME7_FW1 0 temp_ub_q1_o60 -60.000000 195.000000 /end CHARACTERISTIC
/begin CHARACTERISTIC TKOVKO "öberwachungzeit  zur Klimatasteerken. nach Reset von B_kov (bidrekt. Schnittst.)" VALUE 0x8164B8 ME7_FW1 0 t20msxs_ub_b5p1 0.000000 5.100000 /end CHARACTERISTIC
/begin CHARACTERISTIC TKSTBFA "Modell-Temperatur Kat Startwert bei B_faatm Anford.    (kurze Taupunktendezeit)" VALUE 0x8184A5 ME7_FW1 0 temp_ub_q5_o50 -50.000000 1225.000000 /end CHARACTERISTIC
/begin CHARACTERISTIC TKTPVK "Abgastemperatur Kat (aus ATM) fÅr TP-öberwachung Sonde vor Kat" VALUE 0x814DA2 ME7_FW1 0 temp_ub_q5_o50 -50.000000 1225.000000 /end CHARACTERISTIC
/begin CHARACTERISTIC TLAED "Wartezeit bis Fehlerlampe aus nach Start" VALUE 0x8183AB ME7_FW1 0 t200msxs_ub_b51 0.000000 51.000000 /end CHARACTERISTIC
/begin CHARACTERISTIC TLAFA "Vezîgerungszeit bis Lambda Fahrerwunsch aktiv" VALUE 0x818CCB ME7_FW1 0 t100msxs_ub_b25p5 0.000000 25.500000 /end CHARACTERISTIC
/begin CHARACTERISTIC TLAMFAS "Vezîgerungszeit bis Lambda Fahrerwunsch in der Hîhe aktiv" VALUE 0x81B97C ME7_FW3 0 t100msxs_uw_b6553p5 0.000000 6553.500000 /end CHARACTERISTIC
/begin CHARACTERISTIC TLDIAN "Entprellzeit fÅr NachfÅhrung I-Adaption negativ" VALUE 0x8194B5 ME7_FW1 0 t50msxs_ub_b12p75 0.000000 12.750000 /end CHARACTERISTIC
/begin CHARACTERISTIC TLDIAPN "Entprellzeit fÅr NachfÅhrung I-Adaption positiv" CURVE 0x8194B6 ME7_GKL1 0 t50msxs_ub_b12p75 0.000000 12.750000
 /begin AXIS_DESCR COM_AXIS nmot nmot_ub_q40 0 0.000000 10200.000000 AXIS_PTS_REF SNM08LDUB /end AXIS_DESCR
/end CHARACTERISTIC
/begin CHARACTERISTIC TLDOBAN "Zeit fÅr LDR-Overboost aktiv" CURVE 0x8194F7 ME7_GKL1 0 t1sxs_ub_b255 0.000000 255.000000
 /begin AXIS_DESCR COM_AXIS nmot nmot_ub_q40 0 0.000000 10200.000000 AXIS_PTS_REF SNM08LDUB /end AXIS_DESCR
/end CHARACTERISTIC
/begin CHARACTERISTIC TLDOBN "Sperrzeit fÅr LDR-Overboost" CURVE 0x8194FF ME7_GKL1 0 t1sxs_ub_b255 0.000000 255.000000
 /begin AXIS_DESCR COM_AXIS nmot nmot_ub_q40 0 0.000000 10200.000000 AXIS_PTS_REF SNM08LDUB /end AXIS_DESCR
/end CHARACTERISTIC
/begin CHARACTERISTIC TLDP1SD "Zeitschwelle 1 fÅr Erkennung System dicht bei Leckdiagnosemodul" VALUE 0x8135D4 ME7_FW3 0 t10msxs_uw_b655p35 0.000000 655.350000 /end CHARACTERISTIC
/begin CHARACTERISTIC TLDP2SD "Zeitschwelle 2 fÅr Erkennung System dicht bei Leckdiagnosemodul" VALUE 0x8135D6 ME7_FW3 0 t10msxs_uw_b655p35 0.000000 655.350000 /end CHARACTERISTIC
/begin CHARACTERISTIC TLDPMN "Wartezeit nach Start fÅr Freigabe Leckdiagnose" VALUE 0x81D9CA ME7_FW3 0 t1sxs_uw_b65535 0.000000 65535.000000 /end CHARACTERISTIC
/begin CHARACTERISTIC TLDPMX "Maximale Diagnosezeit nach Start" VALUE 0x81D9CC ME7_FW3 0 t1sxs_uw_b65535 0.000000 65535.000000 /end CHARACTERISTIC
/begin CHARACTERISTIC TLDPRKL "Zeit fÅr 'Reed-Kontakt zu'-Erkennung Closed Check" VALUE 0x8135D8 ME7_FW3 0 t10msxs_uw_b655p35 0.000000 655.350000 /end CHARACTERISTIC
/begin CHARACTERISTIC TLDPRKO "Zeit fÅr 'Reed-Kontankt offen'-Erkennung bei Leckdiagnosemodul" VALUE 0x8135DA ME7_FW3 0 t10msxs_uw_b655p35 0.000000 655.350000 /end CHARACTERISTIC
/begin CHARACTERISTIC TLDPSMN "Minimale SpÅldauer vor Fortsetzung Leckdiagnose" VALUE 0x8135DC ME7_FW3 0 t10msxs_uw_b655p35 0.000000 655.350000 /end CHARACTERISTIC
/begin CHARACTERISTIC TLDPZMN "Minimale Zeit fÅr TEV-zu vor Fortsetzung Leckdiagnose" VALUE 0x8135DE ME7_FW3 0 t10msxs_uw_b655p35 0.000000 655.350000 /end CHARACTERISTIC
/begin CHARACTERISTIC TLDRA "Verzîgerungszeit fuer Dia LDR Regelabweichung Erkennung Zyklusflag" VALUE 0x81974D ME7_FW1 0 t50msxs_ub_b12p75 0.000000 12.500000 EXTENDED_LIMITS 0.000000 12.750000 /end CHARACTERISTIC
/begin CHARACTERISTIC TLKD "Maximal zulÑssige Zeit fÅr Lernen der Kick-Down-Position Åber Tester" VALUE 0x810C46 ME7_FW3 0 t10msxs_uw_b655p35 0.000000 655.350000 /end CHARACTERISTIC
/begin CHARACTERISTIC TLKRLDAB "Zeitkonstante fÅr langsame LDR-Absenkung" CURVE 0x81CB74 ME7_GKL3 0 zk50msxs_uw_b3276p8 0.050001 64.251000
 /begin AXIS_DESCR COM_AXIS nmot_w nmot_uw_q0p25 0 0.000000 16383.800000 AXIS_PTS_REF SNM08LDUW /end AXIS_DESCR
 EXTENDED_LIMITS 0.050001 3276.800000 /end CHARACTERISTIC
/begin CHARACTERISTIC TLKRLDAU "Zeitkonstante fÅr langsame LDR-Aufregelung" CURVE 0x81CB84 ME7_GKL3 0 zk50msxs_uw_b3276p8 0.050001 64.251000
 /begin AXIS_DESCR COM_AXIS nmot_w nmot_uw_q0p25 0 0.000000 16383.800000 AXIS_PTS_REF SNM08LDUW /end AXIS_DESCR
 EXTENDED_LIMITS 0.050001 3276.800000 /end CHARACTERISTIC
/begin CHARACTERISTIC TLLASH "Verzîg.zeit um lamlash_w zu sperren wenn lamsons_w ungleich lamlash_w ist" VALUE 0x8184BF ME7_FW1 0 t100msxs_ub_b25p5 0.000000 25.500000 /end CHARACTERISTIC
/begin CHARACTERISTIC TLMSSLAB "Entprellzeit fÅr Abbruch SekundÑrluftanfettung" VALUE 0x818359 ME7_FW1 0 t100msxs_ub_b25p5 0.100000 25.500000 EXTENDED_LIMITS 0.000000 25.500000 /end CHARACTERISTIC
/begin CHARACTERISTIC TLMSSLMX "Maximale Zeit fÅr SekundÑrluftanfettung im Leerlauf" VALUE 0x81835A ME7_FW1 0 t100msxs_ub_b255 0.000000 255.000000 /end CHARACTERISTIC
/begin CHARACTERISTIC TLRBAM "Sperrzeit fÅr Einschalten LR nach BA" CURVE 0x819C9A ME7_GKL1 0 t100msxs_ub_b25p5 0.000000 25.500000
 /begin AXIS_DESCR COM_AXIS tmot temp_ub_q0p75_o48 0 -48.000000 143.250000 AXIS_PTS_REF STM08LEUB /end AXIS_DESCR
/end CHARACTERISTIC
/begin CHARACTERISTIC TLRHS "Sperrzeit LR bei Hei·start, ausgelîst Åber Schwellen TASHS und TMSHS" VALUE 0x819CA2 ME7_FW1 0 t100msxs_ub_b25p5 0.000000 25.500000 /end CHARACTERISTIC
/begin CHARACTERISTIC TLRTMS "Sperrzeit LR nach Start, abhÑngig von der Motortemperatur bei Start" CURVE 0x8136A2 ME7_KL99 0 t100msxs_uw_b6553p5 0.000000 6553.500000
 /begin AXIS_DESCR STD_AXIS tmst temp_ub_q0p75_o48 5 -48.000000 143.250000 DEPOSIT ABSOLUTE /end AXIS_DESCR
/end CHARACTERISTIC
/begin CHARACTERISTIC TLRVAM "Sperrzeit fÅr Einschalten LR nach VA" CURVE 0x819CA3 ME7_GKL1 0 t100msxs_ub_b25p5 0.000000 25.500000
 /begin AXIS_DESCR COM_AXIS tmot temp_ub_q0p75_o48 0 -48.000000 143.250000 AXIS_PTS_REF STM08LEUB /end AXIS_DESCR
/end CHARACTERISTIC
/begin CHARACTERISTIC TLRZWTMS "Zeit fÅr Zwangseinschaltung LR (CARB-Forderung) nach Start" CURVE 0x8136B2 ME7_KL99 0 t100msxs_uw_b6553p5 0.000000 6553.500000
 /begin AXIS_DESCR STD_AXIS tmst temp_ub_q0p75_o48 4 -48.000000 143.250000 DEPOSIT ABSOLUTE /end AXIS_DESCR
/end CHARACTERISTIC
/begin CHARACTERISTIC TMADB0 "Motortemperaturbereich 0 fÅr Berechnung Kaltstartanreicherung" VALUE 0x815210 ME7_FW1 0 dez 0.000000 255.000000 /end CHARACTERISTIC
/begin CHARACTERISTIC TMADB1 "Motortemperaturbereich 1 fÅr Berechnung Kaltstartanreicherung" VALUE 0x815211 ME7_FW1 0 dez 0.000000 255.000000 /end CHARACTERISTIC
/begin CHARACTERISTIC TMADB2 "Motortemperaturbereich 2 fÅr Berechnung Kaltstartanreicherung" VALUE 0x815212 ME7_FW1 0 dez 0.000000 255.000000 /end CHARACTERISTIC
/begin CHARACTERISTIC TMAR_0_A "Untere tmot-Schwelle fÅr AR-Freigabe" VALUE 0x817288 ME7_FW1 0 temp_ub_q0p75_o48 -48.000000 143.250000 /end CHARACTERISTIC
/begin CHARACTERISTIC TMAR_1_A "Untere tmot-Schwelle fÅr AR-Freigabe" VALUE 0x817289 ME7_FW1 0 temp_ub_q0p75_o48 -48.000000 143.250000 /end CHARACTERISTIC
/begin CHARACTERISTIC TMAR_2_A "Untere tmot-Schwelle fÅr AR-Freigabe" VALUE 0x81728A ME7_FW1 0 temp_ub_q0p75_o48 -48.000000 143.250000 /end CHARACTERISTIC
/begin CHARACTERISTIC TMAR_3_A "Untere tmot-Schwelle fÅr AR-Freigabe" VALUE 0x81728B ME7_FW1 0 temp_ub_q0p75_o48 -48.000000 143.250000 /end CHARACTERISTIC
/begin CHARACTERISTIC TMASKIV1 "Temperaturschwelle fÅr VerlÑgerung 1. KAT-Intervall, Aussetzererkennung" VALUE 0x814AF9 ME7_FW1 0 temp_ub_q0p75_o48 -48.000000 143.250000 /end CHARACTERISTIC
/begin CHARACTERISTIC TMASO "Zeit nach Schub fÅr gemeinsame Sondenmasse offen" VALUE 0x8184F4 ME7_FW1 0 t100msxs_ub_b25p5 0.000000 25.500000 /end CHARACTERISTIC
/begin CHARACTERISTIC TMAXKAT "maximale Kat-Temperatur fÅr Kat-diagnose" VALUE 0x8184E8 ME7_FW1 0 temp_ub_q5_o50 -50.000000 1225.000000 /end CHARACTERISTIC
/begin CHARACTERISTIC TMCC650 "KR-testmode am Pin ADT des CC650" VALUE 0x8191BD ME7_FW1 0 dez 0.000000 255.000000 /end CHARACTERISTIC
/begin CHARACTERISTIC TMDLLR "Motortemperaturschwelle fÅr Diagnose Leerlaufsteller" VALUE 0x81990C ME7_FW1 0 temp_ub_q0p75_o48 -48.000000 143.250000 /end CHARACTERISTIC
/begin CHARACTERISTIC TMDMAD "Motortemperaturschwelle fÅr Freigabe der Adaption des Verlustmoments" VALUE 0x819839 ME7_FW1 0 temp_ub_q0p75_o48 -48.000000 143.250000 /end CHARACTERISTIC
/begin CHARACTERISTIC TMDMMA "Anfangstemperatur fÅr Motortemperaturmodell" VALUE 0x818FEC ME7_FW1 0 temp_ub_q0p75_o48 -48.000000 143.250000 /end CHARACTERISTIC
/begin CHARACTERISTIC TMDMMAT "Ersatztemperatur abh. Abstellzeit wÑhrend TDTMMA" CURVE 0x81BAC2 ZF_KL111 0 temp_ub_q0p75_o48___UW -48.000000 143.250000
 /begin AXIS_DESCR STD_AXIS tabst_w t1sxs_uw_q1 3 0.000000 65535.000000 DEPOSIT ABSOLUTE /end AXIS_DESCR
 EXTENDED_LIMITS -48.000000 49103.250000 /end CHARACTERISTIC
/begin CHARACTERISTIC TMDMMAU "Unterster Anfangswert aus tans fÅr Motortemperaturmodell" VALUE 0x818FED ME7_FW1 0 temp_ub_q0p75_o48 -48.000000 143.250000 /end CHARACTERISTIC
/begin CHARACTERISTIC TMDMMEE "Endtemperatur fÅr Ersatzwert Motortemperatur" VALUE 0x818FEE ME7_FW1 0 temp_ub_q0p75_o48 -48.000000 143.250000 /end CHARACTERISTIC
/begin CHARACTERISTIC TMDMMER "Endtemperatur fÅr Referenzwert Motortemperatur" VALUE 0x818FEF ME7_FW1 0 temp_ub_q0p75_o48 -48.000000 143.250000 /end CHARACTERISTIC
/begin CHARACTERISTIC TMDMN "Motortemperatur min." VALUE 0x818FF0 ME7_FW1 0 temp_ub_q0p75_o48 -48.000000 143.250000 /end CHARACTERISTIC
/begin CHARACTERISTIC TMDMX "Motortemperatur max." VALUE 0x818FF1 ME7_FW1 0 temp_ub_q0p75_o48 -48.000000 143.250000 /end CHARACTERISTIC
/begin CHARACTERISTIC TMDNW "Minimale Motortemperatur fÅr Diagnose Nockenwellensteuerung" VALUE 0x8188D3 ME7_FW1 0 temp_ub_q0p75_o48 -48.000000 143.250000 /end CHARACTERISTIC
/begin CHARACTERISTIC TMDSLAMN "min. Motortemperatur fÅr Zusatzdiagnose" VALUE 0x818397 ME7_FW1 0 temp_ub_q0p75_o48 -48.000000 143.250000 /end CHARACTERISTIC
/begin CHARACTERISTIC TMDSLMN "min. Motortemperatur fÅr DSLS" VALUE 0x818398 ME7_FW1 0 temp_ub_q0p75_o48 -48.000000 143.250000 /end CHARACTERISTIC
/begin CHARACTERISTIC TMDSLMX "max. Motortemperatur fÅr DSLS" VALUE 0x818399 ME7_FW1 0 temp_ub_q0p75_o48 -48.000000 143.250000 /end CHARACTERISTIC
/begin CHARACTERISTIC TMDTEU "Untere Motortemperaturschwelle fÅr TankentlÅftungsdiagnose" VALUE 0x819C35 ME7_FW1 0 temp_ub_q0p75_o48 27.000000 90.750000 EXTENDED_LIMITS -48.000000 143.250000 /end CHARACTERISTIC
/begin CHARACTERISTIC TMDV "Motortemperaturschwelle fÅr Freigabe Fz-Geschwindigkeits-Diagnose" VALUE 0x818595 ME7_FW1 0 temp_ub_q0p75_o48 -48.000000 143.250000 /end CHARACTERISTIC
/begin CHARACTERISTIC TMDWG "tmot- Schwelle fÅr Diagnose Wast- Gate" VALUE 0x819757 ME7_FW1 0 temp_ub_q0p75_o48 -48.000000 143.250000 /end CHARACTERISTIC
/begin CHARACTERISTIC TMDYNA "TMOT - Schwelle fÅr Lastdynamikadaption aktiv" VALUE 0x81543B ME7_FW1 0 temp_ub_q0p75_o48 -48.000000 143.250000 /end CHARACTERISTIC
/begin CHARACTERISTIC TMESP "Motortemperaturschwelle Schnellstart" VALUE 0x814FE4 ME7_FW1 0 temp_ub_q0p75_o48 -48.000000 143.250000 /end CHARACTERISTIC
/begin CHARACTERISTIC TMFASLMN "Motortemperaturschwelle Testeranforderung SekundÑrluftdiagnose" VALUE 0x81835B ME7_FW1 0 temp_ub_q0p75_o48 -48.000000 143.250000 /end CHARACTERISTIC
/begin CHARACTERISTIC TMH "Motortemperatur - Schwelle hei·" VALUE 0x815302 ME7_FW1 0 temp_ub_q0p75_o48 -48.000000 143.250000 /end CHARACTERISTIC
/begin CHARACTERISTIC TMHLL "Motortemperaturschwelle fÅr erhîhte Solldrehzahl im Hei·-Leerlauf" VALUE 0x815570 ME7_FW1 0 temp_ub_q0p75_o48 -48.000000 143.250000 /end CHARACTERISTIC
/begin CHARACTERISTIC TMHSG "Motortemperatur Hei·startgrenze" VALUE 0x815303 ME7_FW1 0 temp_ub_q0p75_o48 -48.000000 143.250000 /end CHARACTERISTIC
/begin CHARACTERISTIC TMINKAT "Minimale Kat-Temperatur fÅr öberwachung" VALUE 0x8184E9 ME7_FW1 0 temp_ub_q5_o50 -50.000000 1225.000000 /end CHARACTERISTIC
/begin CHARACTERISTIC TMK "Motortemperatur - Schwelle kalt" VALUE 0x815304 ME7_FW1 0 temp_ub_q0p75_o48 -48.000000 143.250000 /end CHARACTERISTIC
/begin CHARACTERISTIC TMKOAO "Obere Motortemperaturschwelle fÅr Kompressorabschaltung" VALUE 0x8164B9 ME7_FW1 0 temp_ub_q0p75_o48 -48.000000 143.250000 /end CHARACTERISTIC
/begin CHARACTERISTIC TMKOAU "Untere Motortemperazurschwelle fÅr Kompressorabschaltung" VALUE 0x8164BA ME7_FW1 0 temp_ub_q0p75_o48 -48.000000 143.250000 /end CHARACTERISTIC
/begin CHARACTERISTIC TMKR "Motortemperaturschwelle fÅr Klopfregelung aktiv" VALUE 0x81941D ME7_FW1 0 temp_ub_q0p75_o48 -48.000000 143.250000 /end CHARACTERISTIC
/begin CHARACTERISTIC TMKRA "Motortemperaturschwelle fÅr adaptive Klopfregelung" VALUE 0x81941E ME7_FW1 0 temp_ub_q0p75_o48 -48.000000 143.250000 /end CHARACTERISTIC
/begin CHARACTERISTIC TMKRAS "Temperaturschwelle fÅr Freigabe Schreibzugriffe auf Adaptions-KF" VALUE 0x81941F ME7_FW1 0 temp_ub_q0p75_o48 -48.000000 143.250000 /end CHARACTERISTIC
/begin CHARACTERISTIC TMLAST "Sperrzeit bis zum Auslîsen des Ini der AR beim Verzîgern" VALUE 0x815702 ME7_FW1 0 t10msxs_ub_b2p55 0.000000 2.550000 /end CHARACTERISTIC
/begin CHARACTERISTIC TMLDPO "Obere Motortemperaturschwelle fÅr Leckdiagnosemodul" VALUE 0x819C6D ME7_FW1 0 temp_ub_q0p75_o48 -48.000000 143.250000 /end CHARACTERISTIC
/begin CHARACTERISTIC TMLDPU "Untere Motortemperaturschwelle fÅr Leckdiagnosemodul" VALUE 0x819C6E ME7_FW1 0 temp_ub_q0p75_o48 -48.000000 143.250000 /end CHARACTERISTIC
/begin CHARACTERISTIC TMLIM "TMOT Schwelle fÅr  KSTAA aktiv im Nachstart" VALUE 0x815213 ME7_FW1 0 temp_ub_q0p75_o48 -48.000000 143.250000 /end CHARACTERISTIC
/begin CHARACTERISTIC TMLLX "Kochschutzschwelle" VALUE 0x819829 ME7_FW1 0 temp_ub_q0p75_o48 -48.000000 143.250000 /end CHARACTERISTIC
/begin CHARACTERISTIC TMLRTMS "Motortemperaturschwelle fÅr LR ein abh. von Starttemperatur" CURVE 0x818FF2 ME7_KL97 0 temp_ub_q0p75_o48 -48.000000 143.250000
 /begin AXIS_DESCR STD_AXIS tmst temp_ub_q0p75_o48 4 -48.000000 143.250000 DEPOSIT ABSOLUTE /end AXIS_DESCR
/end CHARACTERISTIC
/begin CHARACTERISTIC TMMXRT "max. Motortemperatur f. Retrigg. Modelle (Blockheater-Erkennung)" VALUE 0x818FFB ME7_FW1 0 temp_ub_q0p75_o48 -48.000000 143.250000 /end CHARACTERISTIC
/begin CHARACTERISTIC TMNEB "Motortemperaturschwelle fÅr Messung Nebenschlu· Sonde vor KAT" VALUE 0x8184F5 ME7_FW1 0 temp_ub_q0p75_o48 -48.000000 143.250000 /end CHARACTERISTIC
/begin CHARACTERISTIC TMNKATT "Minimale Kat-Temperatur fÅr öberwachung bei Testerbetrieb" VALUE 0x8184EA ME7_FW1 0 temp_ub_q5_o50 -50.000000 1225.000000 /end CHARACTERISTIC
/begin CHARACTERISTIC TMNSMN "Motortemperaturschwelle fÅr die Nachstartaufweitung" VALUE 0x815A55 ME7_FW1 0 temp_ub_q0p75_o48 -48.000000 143.250000 /end CHARACTERISTIC
/begin CHARACTERISTIC TMNSMN_UM "Motortemperaturschwelle fÅr die Nachstartaufweitung in der FKT.-öberwachung" VALUE 0x81400B ME7_FW1 0 temp_ub_q0p75_o48 -48.000000 143.250000 /end CHARACTERISTIC
/begin CHARACTERISTIC TMNW "Motortemperaturschwelle fÅr Nockenwellenverstellung" VALUE 0x8188B9 ME7_FW1 0 temp_ub_q0p75_o48 -48.000000 143.250000 /end CHARACTERISTIC
/begin CHARACTERISTIC TMNWWLO "obere Temperaturschwelle fÅr Nockenwellenverstellung im Warmlauf" VALUE 0x8188BA ME7_FW1 0 temp_ub_q0p75_o48 -48.000000 143.250000 /end CHARACTERISTIC
/begin CHARACTERISTIC TMNWWLU "untere Temperaturschwelle fÅr Nockenwellenverstellung im Warmlauf" VALUE 0x8188BB ME7_FW1 0 temp_ub_q0p75_o48 -48.000000 143.250000 /end CHARACTERISTIC
/begin CHARACTERISTIC TMOD8TE "Aktivzeit fÅr TE-DichtheitsprÅfung in Mode 8" VALUE 0x81AC38 ME7_FW3 0 t1sxs_uw_q1 0.000000 65535.000000 /end CHARACTERISTIC
/begin CHARACTERISTIC TMOHSMN "Minimal Motortemperatur fÅr Sondenheizung" VALUE 0x818522 ME7_FW1 0 temp_ub_q0p75_o48 -48.000000 143.250000 /end CHARACTERISTIC
/begin CHARACTERISTIC TMOTELI "Temperatur Motor Erfassung u. Linearisierung, Inverskennlinie" CURVE 0x81BAD0 ZF_KL111 0 temp_uw_q0p75_o48 -48.000000 143.997000
 /begin AXIS_DESCR STD_AXIS wtmot_w spg_uw_q0p00488 20 0.000000 319.995000 DEPOSIT ABSOLUTE /end AXIS_DESCR
 EXTENDED_LIMITS -48.000000 143.997234 /end CHARACTERISTIC
/begin CHARACTERISTIC TMOTNMX "Temperaturschwelle fÅr Aktivierung der erhîhten Drehzahlgrenze" VALUE 0x813466 ME7_FW1 0 temp_ub_q0p75_o48 -48.000000 143.250000 /end CHARACTERISTIC
/begin CHARACTERISTIC TMQSYN "Motortemperaturschwelle zur Freigabe PG-Schnellstart" VALUE 0x814D6E ME7_FW1 0 temp_ub_q0p75_o48 -48.000000 143.250000 /end CHARACTERISTIC
/begin CHARACTERISTIC TMRA1 "Ausschaltbedingung (S_LL = 0)" VALUE 0x819CAB ME7_FW1 0 temp_ub_q0p75_o48 -48.000000 143.250000 /end CHARACTERISTIC
/begin CHARACTERISTIC TMRA2 "Ausschaltbedingung (S_LL = 1)" VALUE 0x819CAC ME7_FW1 0 temp_ub_q0p75_o48 -48.000000 143.250000 /end CHARACTERISTIC
/begin CHARACTERISTIC TMRAA "Einschalttemperatur LRA" VALUE 0x8153E8 ME7_FW1 0 temp_ub_q0p75_o48 -48.000000 143.250000 /end CHARACTERISTIC
/begin CHARACTERISTIC TMRAK "Ausschaltschwelle der Lambda - Regelung bei niedriger Starttemperatur" VALUE 0x819CAD ME7_FW1 0 temp_ub_q0p75_o48 -48.000000 143.250000 /end CHARACTERISTIC
/begin CHARACTERISTIC TMRZHLL "Motortemperaturschwelle fÅr Reset des ZeitzÑhlers fÅr Hei·-Leerlauf" VALUE 0x815571 ME7_FW1 0 temp_ub_q0p75_o48 -48.000000 143.250000 /end CHARACTERISTIC
/begin CHARACTERISTIC TMSHS "Schwelle Motortemp. fÅr Auslîsung TLRHS - Sperrzeit LR bei Hei·start" VALUE 0x819CAE ME7_FW1 0 temp_ub_q0p75_o48 -48.000000 143.250000 /end CHARACTERISTIC
/begin CHARACTERISTIC TMSLOF "Motortemperaturschwelle fÅr Sperre SekundÑrluft" VALUE 0x81908D ME7_FW1 0 temp_ub_q0p75_o48 -48.000000 143.250000 /end CHARACTERISTIC
/begin CHARACTERISTIC TMSNOGA "Schwelle tms fÅr DauerspÅlen nach Fahrzyklus mit erfolgter Gemischadaption" VALUE 0x818C70 ME7_FW1 0 temp_ub_q0p75_o48 -48.000000 143.250000 /end CHARACTERISTIC
/begin CHARACTERISTIC TMSRCERR "Entprellzeit fÅr irreversible ASR/MSR-Abschaltung bei Botschaftsfehler" VALUE 0x8144F0 ME7_FW1 0 t10msxs_ub_b2p55 0.000000 2.550000 /end CHARACTERISTIC
/begin CHARACTERISTIC TMSRCNU "Entprellzeit zur BerÅcksichtigung von RasterversÑtzen im BotschaftszÑhler" VALUE 0x8144F1 ME7_FW1 0 t10msxs_ub_b2p55 0.000000 2.550000 /end CHARACTERISTIC
/begin CHARACTERISTIC TMSSLO "obere Starttemperaturschwelle fÅr SekundÑrluft" VALUE 0x81835C ME7_FW1 0 temp_ub_q0p75_o48 -48.000000 143.250000 /end CHARACTERISTIC
/begin CHARACTERISTIC TMSSLSTO "obere Temperaturschwelle fÅr SekundÑrluft im Start" VALUE 0x81835D ME7_FW1 0 temp_ub_q0p75_o48 -48.000000 143.250000 /end CHARACTERISTIC
/begin CHARACTERISTIC TMSSLSTU "untere Temperaturschwelle fÅr SekundÑrluft im Start" VALUE 0x81835E ME7_FW1 0 temp_ub_q0p75_o48 -48.000000 143.250000 /end CHARACTERISTIC
/begin CHARACTERISTIC TMSSLU "untere Starttemperaturschwelle fÅr SekundÑrluft" VALUE 0x81835F ME7_FW1 0 temp_ub_q0p75_o48 -48.000000 143.250000 /end CHARACTERISTIC
/begin CHARACTERISTIC TMSTMAD "Schwelle fÅr tmot im Start fÅr Bedarfsadaption" VALUE 0x8164BB ME7_FW1 0 temp_ub_q0p75_o48 -48.000000 143.250000 /end CHARACTERISTIC
/begin CHARACTERISTIC TMSUKTD "Minimale tmot-Start-Temperatur fÅr Katdiagnose" VALUE 0x8184EB ME7_FW1 0 temp_ub_q0p75_o48 -48.000000 143.250000 /end CHARACTERISTIC
/begin CHARACTERISTIC TMSUTMUMA "untere Tmot-Schwelle fÅr temporÑre UMA-Adaption" VALUE 0x814EC5 ME7_FW1 0 temp_ub_q0p75_o48 -48.000000 143.250000 /end CHARACTERISTIC
/begin CHARACTERISTIC TMSV "Motortemperaturschwelle fÅr Erkennung Kaltstart fÅr Messung Sonde vor KAT" VALUE 0x8184F6 ME7_FW1 0 temp_ub_q0p75_o48 -48.000000 143.250000 /end CHARACTERISTIC
/begin CHARACTERISTIC TMSVA "Motorabstelltemperaturschwelle fÅr Messung AbkÅhlung Sonde vor KAT" VALUE 0x8184F7 ME7_FW1 0 temp_ub_q0p75_o48 -48.000000 143.250000 /end CHARACTERISTIC
/begin CHARACTERISTIC TMTE "TMOT - Schwelle fÅr TankentlÅftung" VALUE 0x815E17 ME7_FW1 0 temp_ub_q0p75_o48 -48.000000 143.250000 /end CHARACTERISTIC
/begin CHARACTERISTIC TMUKAK "Temperaturbereich kalter Motor fÅr öK-Adaption" VALUE 0x8153FB ME7_FW1 0 temp_ub_q0p75_o48 -48.000000 143.250000 /end CHARACTERISTIC
/begin CHARACTERISTIC TMUKAU "untere Motortemperatur-Grenze fÅr öK-Adaption" VALUE 0x8153FC ME7_FW1 0 temp_ub_q0p75_o48 -48.000000 143.250000 /end CHARACTERISTIC
/begin CHARACTERISTIC TMUKAW "Temperaturbereich warmer Motor fÅr öK-Adaption" VALUE 0x8153FD ME7_FW1 0 temp_ub_q0p75_o48 -48.000000 143.250000 /end CHARACTERISTIC
/begin CHARACTERISTIC TMVER "Entprellzeit zur Erkennung einer dauerhaften Momentenbegrenzung" VALUE 0x81BFFC ME7_FW3 0 t1sxs_uw_b65535 0.000000 65535.000000 /end CHARACTERISTIC
/begin CHARACTERISTIC TMWAFMN "Minimale Motortemperatur fÅr Winkeladaption Nockenwelle" VALUE 0x814D64 ME7_FW1 0 temp_ub_q0p75_o48 -48.000000 143.250000 /end CHARACTERISTIC
/begin CHARACTERISTIC TMWUC "Motortemperaturschwelle fÅr ErfÅllung 'warm up cycle'" VALUE 0x814D58 ME7_FW1 0 temp_ub_q0p75_o48 -48.000000 143.250000 /end CHARACTERISTIC
/begin CHARACTERISTIC TMWUCST "max. Motortemperatur im Start fÅr ErfÅllung 'warm up cycle'" VALUE 0x814D59 ME7_FW1 0 temp_ub_q0p75_o48 -48.000000 143.250000 /end CHARACTERISTIC
/begin CHARACTERISTIC TN2FGRGA_0_A "Doppelte Nennerzeitkonstante fÅr FGR-Regler" CURVE 0x810E58 ME7_GKL3 0 t20msxs_uw_q0p02 0.000000 1310.700000
 /begin AXIS_DESCR COM_AXIS uevges fak_q0p1 0 0.000000 25.500000 AXIS_PTS_REF SUE08MFUB /end AXIS_DESCR
/end CHARACTERISTIC
/begin CHARACTERISTIC TN2FGRGA_1_A "Doppelte Nennerzeitkonstante fÅr FGR-Regler" CURVE 0x810E68 ME7_GKL3 0 t20msxs_uw_q0p02 0.000000 1310.700000
 /begin AXIS_DESCR COM_AXIS uevges fak_q0p1 0 0.000000 25.500000 AXIS_PTS_REF SUE08MFUB /end AXIS_DESCR
/end CHARACTERISTIC
/begin CHARACTERISTIC TNALU "TestphasenlÑnge nach erkanntem Aussetzer" VALUE 0x814AC1 ME7_FW1 0 dez 0.000000 255.000000 /end CHARACTERISTIC
/begin CHARACTERISTIC TNLATM "Minimale SG-Nachlaufzeit fÅr ATM - Abstellzeit" VALUE 0x81AD04 ME7_FW3 0 t1sxs_uw_q1 0.000000 65535.000000 /end CHARACTERISTIC
/begin CHARACTERISTIC TNLATMTM "bei tmot > Schwellert  SG-Nachlauf-Anforderung B_nlatm = 1" VALUE 0x8184A6 ME7_FW1 0 temp_ub_q0p75_o48 -48.000000 143.250000 /end CHARACTERISTIC
/begin CHARACTERISTIC TNLATMTU "bei tumg (tatu -ATM) > Schwellwert SG-Nachlauf-Anforderung" VALUE 0x8184A7 ME7_FW1 0 temp_ub_q0p75_o48 -48.000000 143.250000 /end CHARACTERISTIC
/begin CHARACTERISTIC TNLEKPVL "Schwelle SG-Nachlaufzeit fÅr EKP-Vorlauf" VALUE 0x8164C9 ME7_FW1 0 t1sxs_ub_b255 0.000000 255.000000 /end CHARACTERISTIC
/begin CHARACTERISTIC TNLSGM "Nachlaufzeit fÅr SG abschalten" CURVE 0x81B9D6 ZF_KL111 0 t1sxs_uw_b65535 0.000000 65535.000000
 /begin AXIS_DESCR STD_AXIS tmotab temp_ub_q0p75_o48___UW 6 -48.000000 49103.300000 DEPOSIT ABSOLUTE /end AXIS_DESCR
/end CHARACTERISTIC
/begin CHARACTERISTIC TNLSGMN "Minimale Zeit fÅr SG-Nachlauf" VALUE 0x81D34A ME7_FW3 0 t100msxs_uw_b6553p6 0.200000 6553.500000 EXTENDED_LIMITS 0.000000 6553.500000 /end CHARACTERISTIC
/begin CHARACTERISTIC TNLSGMX "Maximale Zeit fÅr SG-Nachlauf" VALUE 0x81D34C ME7_FW3 0 t100msxs_uw_b6553p6 0.000000 6553.500000 /end CHARACTERISTIC
/begin CHARACTERISTIC TNMAXP "Verweilzeit in NMAX bis zur Umschaltung der Abstimmung" VALUE 0x813468 ME7_FW3 0 t10msxs_uw_b655p35 0.000000 655.350000 /end CHARACTERISTIC
/begin CHARACTERISTIC TNMXH "Zeitdauer fÅr erhîhte Drehzahlgrenze" VALUE 0x81346A ME7_FW3 0 t10msxs_uw_b655p35 0.000000 655.350000 /end CHARACTERISTIC
/begin CHARACTERISTIC TNMXPR "Drehzahl-PrÑdiktionshorizont fÅr NMAX-Regelung" VALUE 0x815981 ME7_FW1 0 t10msxs_ub_b2p55 0.000000 2.550000 /end CHARACTERISTIC
/begin CHARACTERISTIC TNOMF2 "zulÑssige Zeit au·erhalb Me·fenster, Phase 2" VALUE 0x81839A ME7_FW1 0 t100msxs_ub_b25p5 0.000000 25.500000 /end CHARACTERISTIC
/begin CHARACTERISTIC TNOMF3 "zulÑssige Zeit au·erhalb Me·fenster, Phase 3" VALUE 0x81839B ME7_FW1 0 t100msxs_ub_b25p5 0.000000 25.500000 /end CHARACTERISTIC
/begin CHARACTERISTIC TNOMF5 "zulÑssige Zeit au·erhalb Me·fenster, Phase 5" VALUE 0x81839C ME7_FW1 0 t100msxs_ub_b25p5 0.000000 25.500000 /end CHARACTERISTIC
/begin CHARACTERISTIC TNSC "NachstartÅberwachungszeit" VALUE 0x81346E ME7_FW3 0 t20msxs_uw_q0p02 0.000000 1310.700000 /end CHARACTERISTIC
/begin CHARACTERISTIC TNSDMRKH "Zeit nach Start fÅr Drehmomentenreserve Katheizen" VALUE 0x81BB74 ME7_FW3 0 t10msxs_uw_b655p35 0.000000 655.350000 /end CHARACTERISTIC
/begin CHARACTERISTIC TNSOF "Entprellzeit zur Abschaltung der Nachstartaufweitung" VALUE 0x815A56 ME7_FW1 0 t20msxs_ub_b5p1 0.000000 5.100000 /end CHARACTERISTIC
/begin CHARACTERISTIC TNSRT "Max.-Zeit ab Start fÅr Retriggerung Berechnung Motortemperaturmodell" VALUE 0x818FFC ME7_FW1 0 t1sxs_ub_b255 0.000000 255.000000 /end CHARACTERISTIC
/begin CHARACTERISTIC TNSTDN "Zeit nach Start fÅr Diagnose Fehler Nebenschlu· (Monoflop)" VALUE 0x814D97 ME7_FW1 0 t20msxs_ub_b5p1 0.000000 5.100000 /end CHARACTERISTIC
/begin CHARACTERISTIC TNSTKO "UnterdrÅckungszeit des Kompressors nach dem Start" VALUE 0x8164BC ME7_FW1 0 t200msxs_ub_b51 0.000000 51.000000 /end CHARACTERISTIC
/begin CHARACTERISTIC TNSURLP "Zeit rl-Praediktions-Unterdrueckung im Nachstart" VALUE 0x8151C2 ME7_FW1 0 t100msxs_ub_b25p5 0.000000 25.500000 /end CHARACTERISTIC
/begin CHARACTERISTIC TNSUUK "Zeit UK-UnterdrÅckung im Nachstart" VALUE 0x8153EB ME7_FW1 0 t100msxs_ub_b25p5 0.000000 25.500000 /end CHARACTERISTIC
/begin CHARACTERISTIC TNSUUKA "Verbotszeit öK-Adaption im Nachstart" VALUE 0x812040 ME7_FW3 0 t10msxs_uw_b655p35 0.000000 655.350000 /end CHARACTERISTIC
/begin CHARACTERISTIC TPERDTE "Zeit fÅr Wiederholung DTEV bei Dauerleerlauf" VALUE 0x819C36 ME7_FW1 0 t100msxs_ub_b25p5 0.000000 25.500000 /end CHARACTERISTIC
/begin CHARACTERISTIC TPNSE "PrÅfzeit nach Startende fÅr DVE-Diagnose" VALUE 0x8185A5 ME7_FW1 0 t100msxs_ub_b25p5 0.100000 25.500000 EXTENDED_LIMITS 0.000000 25.500000 /end CHARACTERISTIC
/begin CHARACTERISTIC TPNSE1 "PrÅfzeit nach Startende fÅr PWG-Diagnose" VALUE 0x81859C ME7_FW1 0 t50msxs_ub_b12p75 0.050000 12.750000 EXTENDED_LIMITS 0.000000 12.750000 /end CHARACTERISTIC
/begin CHARACTERISTIC TPNSMD "PrÅfzeit nach Startende fÅr Diagnose Momentenbegrenzung" VALUE 0x81BFFE ME7_FW3 0 t1sxs_uw_b65535 0.000000 65535.000000 /end CHARACTERISTIC
/begin CHARACTERISTIC TPREL "Zahnentprellzeit in der Initialisierung" VALUE 0x814D6F ME7_FW1 0 t10msxs_ub_b2p55 0.000000 0.100000 EXTENDED_LIMITS 0.000000 2.550000 /end CHARACTERISTIC
/begin CHARACTERISTIC TPSSWE "Sollwert Periodendauer Schlechtwegsignal" VALUE 0x8183A7 ME7_FW1 0 t100msxs_ub_b25p5 0.000000 25.500000 /end CHARACTERISTIC
/begin CHARACTERISTIC TPSVKMN "minimale Periodendauer der Lambdasonde vor Kat, DLSSA" VALUE 0x8188DC ME7_FW1 0 t40msxs_ub_q0p04 0.000000 10.200000 /end CHARACTERISTIC
/begin CHARACTERISTIC TPSVKMX "maximale Periodendauer der Lambdasonde vor Kat, DLSSA" VALUE 0x8188DD ME7_FW1 0 t40msxs_ub_q0p04 0.000000 10.200000 /end CHARACTERISTIC
/begin CHARACTERISTIC TPTEVMN "Periodendauerschwelle bei LDP-TEV-Check" VALUE 0x8135E0 ME7_FW3 0 t10msxs_uw_b655p35 0.000000 655.350000 /end CHARACTERISTIC
/begin CHARACTERISTIC TPUKOR "Filterzeit fÅr PUKORF" VALUE 0x819C71 ME7_FW1 0 zk100msxs_ub_b25p5 0.100392 25.600000 /end CHARACTERISTIC
/begin CHARACTERISTIC TPUPH "Kennlinie fÅr die Pumpzeit abhÑngig von den vorherigen DurchlÑufen" VAL_BLK 0x8135E2 ME7_FWB3 0 t10msxs_uw_b655p35 0.000000 655.350000 NUMBER 8 /end CHARACTERISTIC
/begin CHARACTERISTIC TPVL "Zeit fÅr Pumpenvorlauf" VALUE 0x8164CA ME7_FW1 0 t10msxs_ub_b2p55 0.000000 2.550000 /end CHARACTERISTIC
/begin CHARACTERISTIC TPWMST "Zeit nach Start fÅr PWM-Signal" VALUE 0x8183A8 ME7_FW1 0 t100msxs_ub_b25p5 0.000000 25.500000 /end CHARACTERISTIC
/begin CHARACTERISTIC TPWRSV "Wartezeit bis DV-E Powersave aktiv wird" VALUE 0x810CDC ME7_FW3 0 t10msxs_uw_b655p35 0.000000 655.350000 /end CHARACTERISTIC
/begin COMPU_METHOD DEZ "1 : 1 Umrechnug (dez/hex)" RAT_FUNC "%6.2" "" COEFFS 0 1.000000 0.000000 0 0.000000 1.000000 /end COMPU_METHOD
/begin COMPU_METHOD dez "1 : 1 Umrechnug (dez/hex)" RAT_FUNC "%6.2" "" COEFFS 0 1.000000 0.000000 0 0.000000 1.000000 /end COMPU_METHOD
/begin COMPU_METHOD dezsub1 "" RAT_FUNC "%6.2" "-" COEFFS 0 1.000000 -1.000000 0 0.000000 1.000000 /end COMPU_METHOD
/begin COMPU_METHOD dez___SL "1 : 1 Umrechnug (dez/hex)" RAT_FUNC "%6.2" "" COEFFS 0 1.000000 0.000000 0 0.000000 1.000000 /end COMPU_METHOD
/begin COMPU_METHOD dez___UW "1 : 1 Umrechnug (dez/hex)" RAT_FUNC "%6.2" "" COEFFS 0 1.000000 0.000000 0 0.000000 1.000000 /end COMPU_METHOD
/begin COMPU_METHOD dtsegn_b720divZyl "" RAT_FUNC "%6.4" "grad/KW" COEFFS 0 182.044000 0.000000 0 0.000000 1.000000 /end COMPU_METHOD
/begin COMPU_METHOD dtsegn_b720divZyl___UB "" RAT_FUNC "%6.4" "grad/KW" COEFFS 0 182.044000 0.000000 0 0.000000 1.000000 /end COMPU_METHOD
/begin COMPU_METHOD fak_q0p00153 "" RAT_FUNC "%6.4" "-" COEFFS 0 256.000000 0.000000 0 0.000000 3.906250e-01 /end COMPU_METHOD
/begin COMPU_METHOD fak_q0p1 "" RAT_FUNC "%6.3" "" COEFFS 0 1.000000 0.000000 0 0.000000 1.000000e-01 /end COMPU_METHOD
/begin COMPU_METHOD fak_ub_b1 "" RAT_FUNC "%6.4" "-" COEFFS 0 256.000000 0.000000 0 0.000000 1.000000 /end COMPU_METHOD
/begin COMPU_METHOD fak_ub_b2 "" RAT_FUNC "%6.4" "-" COEFFS 0 256.000000 0.000000 0 0.000000 2.000000 /end COMPU_METHOD
/begin COMPU_METHOD fak_ub_b4 "" RAT_FUNC "%6.4" "-" COEFFS 0 256.000000 0.000000 0 0.000000 4.000000 /end COMPU_METHOD
/begin COMPU_METHOD fak_ub_b64 "" RAT_FUNC "%6.3" "-" COEFFS 0 256.000000 0.000000 0 0.000000 64.000000 /end COMPU_METHOD
/begin COMPU_METHOD fak_uw_b1 "" RAT_FUNC "%7.6" "-" COEFFS 0 6.553600e+04 0.000000 0 0.000000 1.000000 /end COMPU_METHOD
/begin COMPU_METHOD fak_uw_b16 "" RAT_FUNC "%6.5" "-" COEFFS 0 6.553600e+04 0.000000 0 0.000000 16.000000 /end COMPU_METHOD
/begin COMPU_METHOD fak_uw_b2 "" RAT_FUNC "%7.6" "-" COEFFS 0 6.553600e+04 0.000000 0 0.000000 2.000000 /end COMPU_METHOD
/begin COMPU_METHOD fak_uw_b4 "" RAT_FUNC "%7.6" "-" COEFFS 0 6.553600e+04 0.000000 0 0.000000 4.000000 /end COMPU_METHOD
/begin COMPU_METHOD kw_q0p0156 "" RAT_FUNC "%6.4" "∞KW" COEFFS 0 64.000000 0.000000 0 0.000000 1.000000 /end COMPU_METHOD
/begin COMPU_METHOD kw_q6 "" RAT_FUNC "%6.2" "∞KW" COEFFS 0 1.000000 0.000000 0 0.000000 6.000000 /end COMPU_METHOD
/begin COMPU_METHOD luquant "Umrechnung Laufunruhe in DMD" RAT_FUNC "%6.3" "(Umdr./sec)^2" COEFFS 0 1.583300 0.000000 0 0.000000 1.000000 /end COMPU_METHOD
/begin COMPU_METHOD luquant___UB "Umrechnung Laufunruhe in DMD" RAT_FUNC "%6.3" "(Umdr./sec)^2" COEFFS 0 1.583300 0.000000 0 0.000000 1.000000 /end COMPU_METHOD
/begin COMPU_METHOD mdt_sw_b2556 "" RAT_FUNC "%6.4" "Nms" COEFFS 0 6.553600e+04 0.000000 0 0.000000 5112.000000 /end COMPU_METHOD
/begin COMPU_METHOD md_ub_q10 "" RAT_FUNC "%6.1" "Nm" COEFFS 0 1.000000 0.000000 0 0.000000 10.000000 /end COMPU_METHOD
/begin COMPU_METHOD m_q0p00277 "" RAT_FUNC "%6.4" "g" COEFFS 0 360.000000 0.000000 0 0.000000 1.000000 /end COMPU_METHOD
/begin COMPU_METHOD m_q0p00355 "" RAT_FUNC "%6.4" "kg" COEFFS 0 1125.000000 0.000000 0 0.000000 4.000000 /end COMPU_METHOD
/begin COMPU_METHOD m_q0p1___UW "" RAT_FUNC "%6.3" "kg/h" COEFFS 0 10.000000 0.000000 0 0.000000 1.000000 /end COMPU_METHOD
/begin COMPU_METHOD m_q0p4 "" RAT_FUNC "%6.3" "kg/h" COEFFS 0 1.000000 0.000000 0 0.000000 4.000000e-01 /end COMPU_METHOD
/begin COMPU_METHOD m_ub_b1020 "" RAT_FUNC "%6.2" "kg/h" COEFFS 0 1.000000 0.000000 0 0.000000 4.000000 /end COMPU_METHOD
/begin COMPU_METHOD m_ub_b5p8 "" RAT_FUNC "%6.4" "kg" COEFFS 0 5625.000000 0.000000 0 0.000000 128.000000 /end COMPU_METHOD
/begin COMPU_METHOD m_ub_q0p1 "" RAT_FUNC "%6.3" "kg/h" COEFFS 0 256.000000 0.000000 0 0.000000 25.600000 /end COMPU_METHOD
/begin COMPU_METHOD m_ub_q0p4 "" RAT_FUNC "%6.3" "kg" COEFFS 0 1.000000 0.000000 0 0.000000 4.000000e-01 /end COMPU_METHOD
/begin COMPU_METHOD m_uw_b25p6 "" RAT_FUNC "%6.5" "kg/h" COEFFS 0 6.553600e+04 0.000000 0 0.000000 25.600000 /end COMPU_METHOD
/begin COMPU_METHOD m_uw_b6553p5 "" RAT_FUNC "%6.3" "kg/h" COEFFS 0 1.000000 0.000000 0 0.000000 1.000000e-01 /end COMPU_METHOD
/begin COMPU_METHOD m_uw_b7281 "" RAT_FUNC "%6.3" "g" COEFFS 0 9.000000 0.000000 0 0.000000 1.000000 /end COMPU_METHOD
/begin COMPU_METHOD nmotd_sb_q10 "" RAT_FUNC "%6.1" "U/min" COEFFS 0 1.000000 0.000000 0 0.000000 10.000000 /end COMPU_METHOD
/begin COMPU_METHOD nmotg_sb_q100 "" RAT_FUNC "%6.0" "U/min/s" COEFFS 0 1.000000 0.000000 0 0.000000 100.000000 /end COMPU_METHOD
/begin COMPU_METHOD nmotg_sw_q0p15625 "" RAT_FUNC "%6.3" "U/min/s" COEFFS 0 1.000000 0.000000 0 0.000000 1.562500e-01 /end COMPU_METHOD
/begin COMPU_METHOD nmotg_sw_q0p39 "" RAT_FUNC "%6.3" "U/min/s" COEFFS 0 1.000000 0.000000 0 0.000000 3.906300e-01 /end COMPU_METHOD
/begin COMPU_METHOD nmotg_sw_q0p39___UW "" RAT_FUNC "%6.3" "U/min/s" COEFFS 0 1.000000 0.000000 0 0.000000 3.906300e-01 /end COMPU_METHOD
/begin COMPU_METHOD nmotg_ub_q100 "" RAT_FUNC "%6.0" "U/min/s" COEFFS 0 1.000000 0.000000 0 0.000000 100.000000 /end COMPU_METHOD
/begin COMPU_METHOD nmot_q10 "" RAT_FUNC "%6.1" "" COEFFS 0 1.000000 0.000000 0 0.000000 10.000000 /end COMPU_METHOD
/begin COMPU_METHOD nmot_sw_q0p25 "" RAT_FUNC "%6.3" "U/min" COEFFS 0 1.000000 0.000000 0 0.000000 2.500000e-01 /end COMPU_METHOD
/begin COMPU_METHOD nmot_ub_q10 "" RAT_FUNC "%6.1" "U/min" COEFFS 0 1.000000 0.000000 0 0.000000 10.000000 /end COMPU_METHOD
/begin COMPU_METHOD nmot_ub_q40 "" RAT_FUNC "%6.1" "Upm" COEFFS 0 1.000000 0.000000 0 0.000000 40.000000 /end COMPU_METHOD
/begin COMPU_METHOD nmot_ub_q40___SL "" RAT_FUNC "%6.1" "Upm" COEFFS 0 1.000000 0.000000 0 0.000000 40.000000 /end COMPU_METHOD
/begin COMPU_METHOD nmot_uw_q0p25 "" RAT_FUNC "%6.3" "U/min" COEFFS 0 1.000000 0.000000 0 0.000000 2.500000e-01 /end COMPU_METHOD
/begin COMPU_METHOD p_ub_q10 "" RAT_FUNC "%6.1" "hPa" COEFFS 0 1.000000 0.000000 0 0.000000 10.000000 /end COMPU_METHOD
/begin COMPU_METHOD p_ub_q10___SL "" RAT_FUNC "%6.1" "hPa" COEFFS 0 1.000000 0.000000 0 0.000000 10.000000 /end COMPU_METHOD
/begin COMPU_METHOD p_ub_q5 "" RAT_FUNC "%6.2" "hPa" COEFFS 0 1.000000 0.000000 0 0.000000 5.000000 /end COMPU_METHOD
/begin COMPU_METHOD p_uw_q0p039 "" RAT_FUNC "%6.4" "hPa" COEFFS 0 256.000000 0.000000 0 0.000000 10.000000 /end COMPU_METHOD
/begin COMPU_METHOD qnv_uw_b512 "" RAT_FUNC "%6.4" "(U/min)/(km/h)" COEFFS 0 6.553600e+04 0.000000 0 0.000000 512.000000 /end COMPU_METHOD
/begin COMPU_METHOD relnmot_q0p0039 "" RAT_FUNC "%6.4" "%/(U/min)" COEFFS 0 256.000000 0.000000 0 0.000000 1.000000 /end COMPU_METHOD
/begin COMPU_METHOD relPED_ub_b100 "" RAT_FUNC "%6.3" "% PED" COEFFS 0 255.000000 0.000000 0 0.000000 100.000000 /end COMPU_METHOD
/begin COMPU_METHOD rel_q0p1957___SB "" RAT_FUNC "%6.3" "%" COEFFS 0 511.000000 0.000000 0 0.000000 100.000000 /end COMPU_METHOD
/begin COMPU_METHOD rel_sb_b100 "" RAT_FUNC "%6.3" "%" COEFFS 0 128.000000 0.000000 0 0.000000 100.000000 /end COMPU_METHOD
/begin COMPU_METHOD rel_sb_q0p02 "" RAT_FUNC "%6.4" "%" COEFFS 0 50.000000 0.000000 0 0.000000 1.000000 /end COMPU_METHOD
/begin COMPU_METHOD rel_sb_q0p78 "" RAT_FUNC "%6.3" "%" COEFFS 0 1.000000 0.000000 0 0.000000 7.800000e-01 /end COMPU_METHOD
/begin COMPU_METHOD rel_sw_b100 "" RAT_FUNC "%6.4" "%" COEFFS 0 3.276800e+04 0.000000 0 0.000000 100.000000 /end COMPU_METHOD
/begin COMPU_METHOD rel_sw_b1536 "" RAT_FUNC "%6.4" "%" COEFFS 0 6.553600e+04 0.000000 0 0.000000 3072.000000 /end COMPU_METHOD
/begin COMPU_METHOD rel_sw_b200 "" RAT_FUNC "%6.4" "%" COEFFS 0 6.553600e+04 0.000000 0 0.000000 400.000000 /end COMPU_METHOD
/begin COMPU_METHOD rel_sw_q0p1875 "" RAT_FUNC "%6.3" "%" COEFFS 0 6.553600e+04 0.000000 0 0.000000 12288.000000 /end COMPU_METHOD
/begin COMPU_METHOD rel_ub_b200 "" RAT_FUNC "%6.3" "%" COEFFS 0 256.000000 0.000000 0 0.000000 200.000000 /end COMPU_METHOD
/begin COMPU_METHOD rel_ub_b24p9 "" RAT_FUNC "%6.3" "%" COEFFS 0 255.000000 0.000000 0 0.000000 24.900000 /end COMPU_METHOD
/begin COMPU_METHOD rel_ub_b25 "" RAT_FUNC "%6.3" "%" COEFFS 0 256.000000 0.000000 0 0.000000 25.000000 /end COMPU_METHOD
/begin COMPU_METHOD rel_ub_b49p725 "" RAT_FUNC "%6.3" "%" COEFFS 0 255.000000 0.000000 0 0.000000 49.725000 /end COMPU_METHOD
/begin COMPU_METHOD rel_ub_b99p6 "" RAT_FUNC "%6.3" "%" COEFFS 0 256.000000 0.000000 0 0.000000 100.000000 /end COMPU_METHOD
/begin COMPU_METHOD rel_ub_q0p00153 "" RAT_FUNC "%6.4" "%" COEFFS 0 256.000000 0.000000 0 0.000000 3.906000e-01 /end COMPU_METHOD
/begin COMPU_METHOD rel_ub_q0p3906___UB "" RAT_FUNC "%6.3" "%" COEFFS 0 256.000000 0.000000 0 0.000000 100.000000 /end COMPU_METHOD
/begin COMPU_METHOD rel_ub_q0p75 "" RAT_FUNC "%6.3" "%" COEFFS 0 1.000000 0.000000 0 0.000000 7.500000e-01 /end COMPU_METHOD
/begin COMPU_METHOD rel_uw_b100 "" RAT_FUNC "%6.4" "%" COEFFS 0 6.553600e+04 0.000000 0 0.000000 100.000000 /end COMPU_METHOD
/begin COMPU_METHOD rel_uw_b200 "" RAT_FUNC "%6.4" "%" COEFFS 0 6.553600e+04 0.000000 0 0.000000 200.000000 /end COMPU_METHOD
/begin COMPU_METHOD rel_uw_q0p0234 "" RAT_FUNC "%6.4" "%" COEFFS 0 32.000000 0.000000 0 0.000000 7.500000e-01 /end COMPU_METHOD
/begin COMPU_METHOD r_uw_q2 "" RAT_FUNC "%6.2" "Ohm" COEFFS 0 1.000000 0.000000 0 0.000000 2.000000 /end COMPU_METHOD
/begin COMPU_METHOD spg_ubatt "" RAT_FUNC "%6.4" "V" COEFFS 0 1.000000 0.000000 0 0.000000 7.040000e-02 /end COMPU_METHOD
/begin COMPU_METHOD spg_ub_b320 "" RAT_FUNC "%6.2" "V" COEFFS 0 1.000000 0.000000 0 0.000000 1.250000 /end COMPU_METHOD
/begin COMPU_METHOD spg_ub_b5 "" RAT_FUNC "%6.4" "V" COEFFS 0 256.000000 0.000000 0 0.000000 5.000000 /end COMPU_METHOD
/begin COMPU_METHOD spg_ub_q0p019 "" RAT_FUNC "%6.4" "V" COEFFS 0 256.000000 0.000000 0 0.000000 5.000000 /end COMPU_METHOD
/begin COMPU_METHOD spg_uw_q0p00488 "" RAT_FUNC "%6.4" "V" COEFFS 0 1024.000000 0.000000 0 0.000000 5.000000 /end COMPU_METHOD
/begin COMPU_METHOD spg_uw_q0p00488___SL "" RAT_FUNC "%6.4" "V" COEFFS 0 1024.000000 0.000000 0 0.000000 5.000000 /end COMPU_METHOD
/begin COMPU_METHOD t100msxs_sb_q0p01 "" RAT_FUNC "%6.4" "s" COEFFS 0 1.000000 0.000000 0 0.000000 1.000000e-02 /end COMPU_METHOD
/begin COMPU_METHOD t100msxs_ub_b255 "" RAT_FUNC "%6.2" "s" COEFFS 0 1.000000 0.000000 0 0.000000 1.000000 /end COMPU_METHOD
/begin COMPU_METHOD t100msxs_ub_b25p5 "" RAT_FUNC "%6.3" "s" COEFFS 0 1.000000 0.000000 0 0.000000 1.000000e-01 /end COMPU_METHOD
/begin COMPU_METHOD t100msxs_uw_b6553p5 "" RAT_FUNC "%6.3" "s" COEFFS 0 1.000000 0.000000 0 0.000000 1.000000e-01 /end COMPU_METHOD
/begin COMPU_METHOD t100msxs_uw_b6553p6 "" RAT_FUNC "%6.3" "s" COEFFS 0 10.000000 0.000000 0 0.000000 1.000000 /end COMPU_METHOD
/begin COMPU_METHOD t10msxs_q0p01_o0p05 "" RAT_FUNC "%6.4" "s" COEFFS 0 1.000000 5.000000e-02 0 0.000000 1.000000e-02 /end COMPU_METHOD
/begin COMPU_METHOD t10msxs_ub_b2p55 "" RAT_FUNC "%6.4" "s" COEFFS 0 1.000000 0.000000 0 0.000000 1.000000e-02 /end COMPU_METHOD
/begin COMPU_METHOD t10msxs_uw_b655p35 "" RAT_FUNC "%6.4" "s" COEFFS 0 1.000000 0.000000 0 0.000000 1.000000e-02 /end COMPU_METHOD
/begin COMPU_METHOD t1msxms_q1 "" RAT_FUNC "%6.2" "ms" COEFFS 0 1.000000 0.000000 0 0.000000 1.000000 /end COMPU_METHOD
/begin COMPU_METHOD t1sxs_ub_b255 "" RAT_FUNC "%6.2" "s" COEFFS 0 1.000000 0.000000 0 0.000000 1.000000 /end COMPU_METHOD
/begin COMPU_METHOD t1sxs_uw_b65535 "" RAT_FUNC "%6.2" "s" COEFFS 0 1.000000 0.000000 0 0.000000 1.000000 /end COMPU_METHOD
/begin COMPU_METHOD t1sxs_uw_q1 "" RAT_FUNC "%6.2" "s" COEFFS 0 1.000000 0.000000 0 0.000000 1.000000 /end COMPU_METHOD
/begin COMPU_METHOD t200msxs_ub_b51 "" RAT_FUNC "%6.3" "s" COEFFS 0 1.000000 0.000000 0 0.000000 2.000000e-01 /end COMPU_METHOD
/begin COMPU_METHOD t200msxs_ub_b51___UW "" RAT_FUNC "%6.3" "s" COEFFS 0 1.000000 0.000000 0 0.000000 2.000000e-01 /end COMPU_METHOD
/begin COMPU_METHOD t20msxs_ub_b5p1 "" RAT_FUNC "%6.4" "s" COEFFS 0 1.000000 0.000000 0 0.000000 2.000000e-02 /end COMPU_METHOD
/begin COMPU_METHOD t20msxs_uw_q0p02 "" RAT_FUNC "%6.4" "s" COEFFS 0 1.000000 0.000000 0 0.000000 2.000000e-02 /end COMPU_METHOD
/begin COMPU_METHOD t40msxs_ub_q0p04 "" RAT_FUNC "%6.4" "s" COEFFS 0 1.000000 0.000000 0 0.000000 4.000000e-02 /end COMPU_METHOD
/begin COMPU_METHOD t40msxs_uw_q0p04 "" RAT_FUNC "%6.4" "s" COEFFS 0 1.000000 0.000000 0 0.000000 4.000000e-02 /end COMPU_METHOD
/begin COMPU_METHOD t40ms_ub_b10200 "" RAT_FUNC "%7.2" "ms" COEFFS 0 1.000000 0.000000 0 0.000000 40.000000 /end COMPU_METHOD
/begin COMPU_METHOD t50msxs_q0p05 "" RAT_FUNC "%6.4" "s" COEFFS 0 1.000000 0.000000 0 0.000000 5.000000e-02 /end COMPU_METHOD
/begin COMPU_METHOD t50msxs_ub_b12p75 "" RAT_FUNC "%6.4" "s" COEFFS 0 1.000000 0.000000 0 0.000000 5.000000e-02 /end COMPU_METHOD
/begin COMPU_METHOD t50msxs_uw_b3276p75 "" RAT_FUNC "%6.4" "s" COEFFS 0 1.000000 0.000000 0 0.000000 5.000000e-02 /end COMPU_METHOD
/begin COMPU_METHOD temp_q5 "" RAT_FUNC "%6.2" "Grad C" COEFFS 0 1.000000 0.000000 0 0.000000 5.000000 /end COMPU_METHOD
/begin COMPU_METHOD temp_q5___UB "" RAT_FUNC "%6.2" "Grad C" COEFFS 0 1.000000 0.000000 0 0.000000 5.000000 /end COMPU_METHOD
/begin COMPU_METHOD temp_ub_b191p25 "" RAT_FUNC "%6.3" "Grad C" COEFFS 0 1.000000 0.000000 0 0.000000 7.500000e-01 /end COMPU_METHOD
/begin COMPU_METHOD temp_ub_q0p75_o48 "" RAT_FUNC "%6.2" "Grad C" COEFFS 0 1.000000 48.000000 0 0.000000 7.500000e-01 /end COMPU_METHOD
/begin COMPU_METHOD temp_ub_q0p75_o48___UW "" RAT_FUNC "%6.2" "Grad C" COEFFS 0 1.000000 48.000000 0 0.000000 7.500000e-01 /end COMPU_METHOD
/begin COMPU_METHOD temp_ub_q1_o60 "" RAT_FUNC "%6.2" "Grad C" COEFFS 0 1.000000 60.000000 0 0.000000 1.000000 /end COMPU_METHOD
/begin COMPU_METHOD temp_ub_q5_o50 "" RAT_FUNC "%6.2" "Grad C" COEFFS 0 1.000000 50.000000 0 0.000000 5.000000 /end COMPU_METHOD
/begin COMPU_METHOD temp_uw_q0p0195_o50 "" RAT_FUNC "%6.2" "Grad C" COEFFS 0 256.000000 12800.000000 0 0.000000 5.000000 /end COMPU_METHOD
/begin COMPU_METHOD temp_uw_q0p75_o48 "" RAT_FUNC "%6.2" "Grad C" COEFFS 0 1.000000 48.000000 0 0.000000 2.929690e-03 /end COMPU_METHOD
/begin COMPU_METHOD tinjection_sy "" RAT_FUNC "%6.4" "ms" COEFFS 0 312.500000 0.000000 0 0.000000 1.000000 /end COMPU_METHOD
/begin COMPU_METHOD vfzg_ub_q1p25___UB "" RAT_FUNC "%6.2" "km/h" COEFFS 0 1.000000 0.000000 0 0.000000 1.250000 /end COMPU_METHOD
/begin COMPU_METHOD vfzg_uw_b512 "" RAT_FUNC "%6.4" "km/h" COEFFS 0 6.553600e+04 0.000000 0 0.000000 512.000000 /end COMPU_METHOD
/begin COMPU_METHOD zk100msxs_ub_b25p5 "" RAT_FUNC "%6.3" "s" COEFFS 0 0.000000 256.000000 0 10.000000 0.000000 /end COMPU_METHOD
/begin COMPU_METHOD zk10msxs_ub_b2p55 "" RAT_FUNC "%6.4" "s" COEFFS 0 0.000000 255.000000 0 100.000000 0.000000 /end COMPU_METHOD
/begin COMPU_METHOD zk10msxs_uw_b655 "" RAT_FUNC "%10.4" "s" COEFFS 0 0.000000 6.553600e+04 0 100.000000 0.000000 /end COMPU_METHOD
/begin COMPU_METHOD zk20msxs_uw_b1310 "" RAT_FUNC "%10.3" "s" COEFFS 0 0.000000 1310.000000 0 1.000000 0.000000 /end COMPU_METHOD
/begin COMPU_METHOD zk40ms_ub_b10200 "" RAT_FUNC "%6.1" "ms" COEFFS 0 0.000000 10240.000000 0 1.000000 40.000000 /end COMPU_METHOD
/begin COMPU_METHOD zk50msxs_uw_b3276p8 "" RAT_FUNC "%6.1" "s" COEFFS 0 0.000000 6.553600e+04 0 20.000000 0.000000 /end COMPU_METHOD
/begin COMPU_METHOD NoCompuMethod "" RAT_FUNC "%4.0" "" COEFFS 0 1 0 0 0 1 /end COMPU_METHOD
/end MODULE
/end PROJECT
