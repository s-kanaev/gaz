ASAP2_VERSION 1 21
/begin PROJECT Pro4017 "R4 1.8l 5V T lÑngs FR5ROM F5051"
/begin HEADER "" PROJECT_NO Pro4017 VERSION "PrV = F21dc mit 00" /end HEADER
/begin MODULE DIM " "
/begin MOD_COMMON " " S_REC_LAYOUT ME7 BYTE_ORDER MSB_LAST /end MOD_COMMON
/begin CHARACTERISTIC A0_0_A "öbertragungsfunktionskoeffizient" VALUE 0x812A9C ME7_FW4 0 fak_sw_b0p0625 -0.062500 0.062498 /end CHARACTERISTIC
/begin RECORD_LAYOUT ME7_FW4 FNC_VALUES 1 SWORD COLUMN_DIR DIRECT /end RECORD_LAYOUT
/begin CHARACTERISTIC A0_1_A "öbertragungsfunktionskoeffizient" VALUE 0x812A9E ME7_FW4 0 fak_sw_b0p0625 -0.062500 0.062498 /end CHARACTERISTIC
/begin CHARACTERISTIC A0_2_A "öbertragungsfunktionskoeffizient" VALUE 0x812AA0 ME7_FW4 0 fak_sw_b0p0625 -0.062500 0.062498 /end CHARACTERISTIC
/begin CHARACTERISTIC A0_3_A "öbertragungsfunktionskoeffizient" VALUE 0x812AA2 ME7_FW4 0 fak_sw_b0p0625 -0.062500 0.062498 /end CHARACTERISTIC
/begin CHARACTERISTIC A1_0_A "öbertragungsfunktionskoeffizient" VALUE 0x812AA4 ME7_FW4 0 fak_sw_b0p0625 -0.062500 0.062498 /end CHARACTERISTIC
/begin CHARACTERISTIC A1_1_A "öbertragungsfunktionskoeffizient" VALUE 0x812AA6 ME7_FW4 0 fak_sw_b0p0625 -0.062500 0.062498 /end CHARACTERISTIC
/begin CHARACTERISTIC A1_2_A "öbertragungsfunktionskoeffizient" VALUE 0x812AA8 ME7_FW4 0 fak_sw_b0p0625 -0.062500 0.062498 /end CHARACTERISTIC
/begin CHARACTERISTIC A1_3_A "öbertragungsfunktionskoeffizient" VALUE 0x812AAA ME7_FW4 0 fak_sw_b0p0625 -0.062500 0.062498 /end CHARACTERISTIC
/begin CHARACTERISTIC A2_0_A "öbertragungsfunktionskoeffizient" VALUE 0x812AAC ME7_FW4 0 fak_sw_b0p0625 -0.062500 0.062498 /end CHARACTERISTIC
/begin CHARACTERISTIC A2_1_A "öbertragungsfunktionskoeffizient" VALUE 0x812AAE ME7_FW4 0 fak_sw_b0p0625 -0.062500 0.062498 /end CHARACTERISTIC
/begin CHARACTERISTIC A2_2_A "öbertragungsfunktionskoeffizient" VALUE 0x812AB0 ME7_FW4 0 fak_sw_b0p0625 -0.062500 0.062498 /end CHARACTERISTIC
/begin CHARACTERISTIC A2_3_A "öbertragungsfunktionskoeffizient" VALUE 0x812AB2 ME7_FW4 0 fak_sw_b0p0625 -0.062500 0.062498 /end CHARACTERISTIC
/begin CHARACTERISTIC ABAOVMX "Max. Anzahl BeschleunigungsvorgÑnge ohne AdaptionswertrÅckstellung" VALUE 0x8153ED ME7_FW1 0 dez 1.000000 255.000000 EXTENDED_LIMITS 0.000000 255.000000 /end CHARACTERISTIC
/begin RECORD_LAYOUT ME7_FW1 FNC_VALUES 1 UBYTE COLUMN_DIR DIRECT /end RECORD_LAYOUT
/begin CHARACTERISTIC ABGMSIGH "Abgastemperaturschwelle fÅr Signalunterbrechung mit Ri-Diagnose hinter KAT" VALUE 0x8184AB ME7_FW1 0 temp_ub_q5_o50 -50.000000 1225.000000 /end CHARACTERISTIC
/begin CHARACTERISTIC ABGMSIGV "Abgastemperaturschwelle fÅr Signalunterbrechung mit Ri-Diagnose vor KAT" VALUE 0x814D95 ME7_FW1 0 temp_ub_q5_o50 -50.000000 1225.000000 /end CHARACTERISTIC
/begin CHARACTERISTIC ADCC_T_UM "Fehlerzeit bei zueinander unplausiblen ADC-Werten fÅr sp1s" VALUE 0x81420A ME7_FW1 0 t10msxs_ub_b2p55 0.000000 2.550000 /end CHARACTERISTIC
/begin CHARACTERISTIC ADEWG "Max. Anzahl vollstÑndiger DiagnosedurchlÑufe Waste- Gate" VALUE 0x819750 ME7_FW1 0 dez 0.000000 255.000000 /end CHARACTERISTIC
/begin CHARACTERISTIC ADKATNF "Normierungsfaktor fÅr Signalamplitude der Sonde bzw. Katbelastung" VALUE 0x8184CA ME7_FW1 0 spg_ub_b24 0.000000 23.873100 /end CHARACTERISTIC
/begin CHARACTERISTIC ADRONLOGIN "Logincode zum Aktivieren ADR" VALUE 0x812260 ME7_FW3 0 dez___UW 0.000000 65535.000000 /end CHARACTERISTIC
/begin RECORD_LAYOUT ME7_FW3 FNC_VALUES 1 UWORD COLUMN_DIR DIRECT /end RECORD_LAYOUT
/begin CHARACTERISTIC ADSWG "Max. Anzahl Diagnosestarts Waste- Gate" VALUE 0x819751 ME7_FW1 0 dez 0.000000 255.000000 /end CHARACTERISTIC
/begin CHARACTERISTIC AFNTOL "Toleranz zur Verkleinerung des Aussetzerfenster bzgl. Drehzahl" VALUE 0x814AC2 ME7_FW1 0 nmot_ub_q40 0.000000 10200.000000 /end CHARACTERISTIC
/begin CHARACTERISTIC AGANGW "Anzahl Gangwechsel fÅr Diagnose Kupplungsschalter" VALUE 0x818597 ME7_FW1 0 dez 0.000000 255.000000 /end CHARACTERISTIC
/begin CHARACTERISTIC AGRPMN "minimaler AGR-Partialdruck" VALUE 0x8118A8 ME7_FW3 0 p_uw_q0p039 0.000000 2559.960000 EXTENDED_LIMITS 0.000000 2559.960938 /end CHARACTERISTIC
/begin CHARACTERISTIC AGRPMX "maximaler AGR-Partialdruck" VALUE 0x8118AA ME7_FW3 0 p_uw_q0p039 0.000000 2559.960000 EXTENDED_LIMITS 0.000000 2559.960938 /end CHARACTERISTIC
/begin CHARACTERISTIC AGRRMAX "maximal mîgliche AGR-Rate" VALUE 0x81570C ME7_FW1 0 rel_ub_b99p6 0.000000 99.609400 EXTENDED_LIMITS 0.000000 99.609375 /end CHARACTERISTIC
/begin CHARACTERISTIC AGR_AOG "oberer Grenzwert Anpassung AGR-Rate" VALUE 0x815443 ME7_FW1 0 fak_ub_b2 0.000000 1.992190 EXTENDED_LIMITS 0.000000 1.992188 /end CHARACTERISTIC
/begin CHARACTERISTIC AGR_AUG "unterer Grenzwert Anpassung AGR-Rate" VALUE 0x815444 ME7_FW1 0 fak_ub_b2 0.000000 1.992190 EXTENDED_LIMITS 0.000000 1.992188 /end CHARACTERISTIC
/begin CHARACTERISTIC AHEAGW "AussetzerhÑufigkeit zum Erreichen der gesetzlichen Abgaslimits" VALUE 0x8101B4 ME7_FW3 0 dez___UW 0.000000 65535.000000 /end CHARACTERISTIC
/begin CHARACTERISTIC AHEARV "AussetzerhÑufigkeit zum Erreichen der Ausblendung weiterer Funktionen" VALUE 0x8101B6 ME7_FW3 0 dez___UW 0.000000 65535.000000 /end CHARACTERISTIC
/begin CHARACTERISTIC AHEKA "AussetzerhÑufigkeit zum Erreichen einer Kraftstoffabschaltung" VALUE 0x8101B8 ME7_FW3 0 dez___UW 0.000000 65535.000000 /end CHARACTERISTIC
/begin CHARACTERISTIC AHEKS "AussetzerhÑufigkeit zum Erreichen einer KatalysatorschÑdigung" VALUE 0x8101BA ME7_FW3 0 dez___UW 0.000000 65535.000000 /end CHARACTERISTIC
/begin CHARACTERISTIC AHEKS1 "AussetzerhÑufigkeit zum Erreichen einer KatschÑdigung im 1. Intervall nach Start" VALUE 0x8101BC ME7_FW3 0 dez___UW 0.000000 65535.000000 /end CHARACTERISTIC
/begin CHARACTERISTIC AHKATMN "Schwellwert Katalysator gut,  AHKAT < AHKATMN" VALUE 0x8184CB ME7_FW1 0 fak_ub_b1 0.000000 0.996094 /end CHARACTERISTIC
/begin CHARACTERISTIC AHKATMX "Schwellwert Katalysator defekt,  AHKAT > AHKATMX" VALUE 0x8184CC ME7_FW1 0 fak_ub_b1 0.000000 0.996094 /end CHARACTERISTIC
/begin CHARACTERISTIC AHKATS "Schwellwert fÅr Summe AHKAT,AHKAT2 (Stereo )" VALUE 0x8184CD ME7_FW1 0 fak_ub_b2 0.000000 1.992190 EXTENDED_LIMITS 0.000000 1.992188 /end CHARACTERISTIC
/begin CHARACTERISTIC AHKATSB "Schwellwert fÅr Summenbereichfehler (Stereo)" VALUE 0x8184CE ME7_FW1 0 fak_ub_b1 0.000000 0.996094 /end CHARACTERISTIC
/begin CHARACTERISTIC AHKTMXT "Schwellwert Katalysator defekt bei Testerbetrieb" VALUE 0x8184CF ME7_FW1 0 fak_ub_b1 0.000000 0.996094 /end CHARACTERISTIC
/begin CHARACTERISTIC AHKTTSW "Setztwert fÅr Zeitgeber in Signalauswertung" VALUE 0x81AD62 ME7_FW3 0 t50msxs_uw_b3276p75 0.000000 3276.750000 /end CHARACTERISTIC
/begin CHARACTERISTIC AIMRU "Anzahl Impulse pro Radumdrehung" VALUE 0x814327 ME7_FW1 0 dez 1.000000 254.000000 EXTENDED_LIMITS 0.000000 255.000000 /end CHARACTERISTIC
/begin CHARACTERISTIC AIMVM "Anzahl Geschwindigkeitsimpulse pro m fÅr Normierung v-Signal" VALUE 0x810002 ME7_FW3 0 fak_uw_q0p001 0.001000 10.000000 EXTENDED_LIMITS 0.000000 65.535000 /end CHARACTERISTIC
/begin CHARACTERISTIC AINTKA "Anzahl Intervalle mit KatschÑdigung fÅr Ti-Abschaltung" VALUE 0x8101BE ME7_FW3 0 dez___UW 0.000000 65535.000000 /end CHARACTERISTIC
/begin CHARACTERISTIC AKUPPLB "Anzahl Kupplung betÑtigt fÅr Diagnose Kupplungsschalter" VALUE 0x818598 ME7_FW1 0 dez 0.000000 255.000000 /end CHARACTERISTIC
/begin CHARACTERISTIC ALFO "Anfangswert fÅr Lernfilter bei fuel-on/fuel-off Adaption" VALUE 0x810186 ME7_FW3 0 dtsegn_b720divZyl___UW 0.000000 359.995000 EXTENDED_LIMITS 0.000000 359.995386 /end CHARACTERISTIC
/begin CHARACTERISTIC AMNUUKA "Minimalanzahl SondensprÅnge zwischen 2 AdaptionsvorgÑngen (öK-Adaption)" VALUE 0x8153EE ME7_FW1 0 dez 2.000000 255.000000 EXTENDED_LIMITS 0.000000 255.000000 /end CHARACTERISTIC
/begin CHARACTERISTIC ANALUN "Anzahl Verbrennungen fÅr Ausblendungen nach erkanntem Auss., drehzahlabhÑngig" CURVE 0x81480A ME7_GKL1 0 dez 0.000000 255.000000
 /begin AXIS_DESCR COM_AXIS nmot nmot_ub_q40 0 0.000000 10200.000000 AXIS_PTS_REF SNM08DMUB /end AXIS_DESCR
/end CHARACTERISTIC
/begin RECORD_LAYOUT ME7_GKL1 FNC_VALUES 1 UBYTE COLUMN_DIR DIRECT /end RECORD_LAYOUT
/begin CHARACTERISTIC ANRZUEMX "ZÅndungszÑhler-Schwelle bis zu der STADAP aktiv" VALUE 0x8151CB ME7_FW1 0 dez 0.000000 255.000000 /end CHARACTERISTIC
/begin CHARACTERISTIC ANWFOHE "Anzahl NW-Umdr. fÅr Heilung" VALUE 0x8144F9 ME7_FW1 0 dez 0.000000 255.000000 /end CHARACTERISTIC
/begin CHARACTERISTIC ANWFOST "Anzahl NW-Umdr. fÅr Reaktivierung fuel-on/-off Adaption nach Ausblendung" VALUE 0x8144FA ME7_FW1 0 dez 0.000000 255.000000 /end CHARACTERISTIC
/begin CHARACTERISTIC ANZDPVK "Anzahl der Perioden fÅr Ready-Flag der Usvk-PeriodenÅberwachung" VALUE 0x814D98 ME7_FW1 0 dez 0.000000 255.000000 /end CHARACTERISTIC
/begin CHARACTERISTIC ANZDYNSH "Anzahl der Dynamikmessungen fÅr SchwingungsprÅfung Sonde hinter KAT" VALUE 0x8184B1 ME7_FW1 0 dez 0.000000 255.000000 /end CHARACTERISTIC
/begin CHARACTERISTIC ANZERDYH "Anzahl der Error-Messungen fÅr Sondendynamik im Schub hinter KAT" VALUE 0x8184B2 ME7_FW1 0 dez 0.000000 255.000000 /end CHARACTERISTIC
/begin CHARACTERISTIC ANZERSCH "Anzahl der Error-Messungen fÅr Sondenspannung im Schub hinter KAT" VALUE 0x8184B3 ME7_FW1 0 dez 0.000000 255.000000 /end CHARACTERISTIC
/begin CHARACTERISTIC ANZERTP "Anzahl der Error-Messungen fÅr Periodendauer" VALUE 0x818529 ME7_FW1 0 dez 0.000000 255.000000 /end CHARACTERISTIC
/begin CHARACTERISTIC ANZERTV "Anzahl der Error-Messungen fÅr ATV" VALUE 0x81852A ME7_FW1 0 dez 0.000000 255.000000 /end CHARACTERISTIC
/begin CHARACTERISTIC ANZGEM "Anzahl der Gemischfehler" VALUE 0x814D96 ME7_FW1 0 dez 0.000000 255.000000 /end CHARACTERISTIC
/begin CHARACTERISTIC ANZRIBEH "Anzahl der Ri-Berechnungen hinter KAT" VALUE 0x814D77 ME7_FW1 0 dez 0.000000 255.000000 /end CHARACTERISTIC
/begin CHARACTERISTIC ANZRIBEV "Anzahl der Ri-Berechnungen vor KAT" VALUE 0x814D7B ME7_FW1 0 dez 0.000000 255.000000 /end CHARACTERISTIC
/begin CHARACTERISTIC ANZTIBMX "Begrenzung ti-EinspritzzÑhler 'anztib_w'" VALUE 0x811DA0 ME7_FW3 0 dez___UW 0.000000 50176.000000 EXTENDED_LIMITS 0.000000 65535.000000 /end CHARACTERISTIC
/begin CHARACTERISTIC ANZTP "Anzahl auszublendender Perioden fÅr PeriodendauerÅberwachung" VALUE 0x814D99 ME7_FW1 0 dez 0.000000 255.000000 /end CHARACTERISTIC
/begin CHARACTERISTIC ANZTPMX "Maximale Anzahl von hintereinander erlaubten Tips" VALUE 0x8185B8 ME7_FW1 0 dez 0.000000 255.000000 /end CHARACTERISTIC
/begin CHARACTERISTIC APDTEFRE "Anzahl Vergleiche Gradient fr fÅr Erkennen fr-eingeschwungen in DTEV" VALUE 0x819BCD ME7_FW1 0 dez 0.000000 50.000000 EXTENDED_LIMITS 0.000000 255.000000 /end CHARACTERISTIC
/begin CHARACTERISTIC APDTEVX "max. Anzahl PrÅfungen bei erkanntem Fehler" VALUE 0x819BCE ME7_FW1 0 dez 0.000000 10.000000 EXTENDED_LIMITS 0.000000 255.000000 /end CHARACTERISTIC
/begin CHARACTERISTIC APEKTDX "max. Anzahl FehlerprÅfungen bei Kat-Diagnose" VALUE 0x8184D0 ME7_FW1 0 dez 0.000000 255.000000 /end CHARACTERISTIC
/begin CHARACTERISTIC ASPUUKA "Anzahl SondensprÅnge fÅr Verbot der öK-Adaption" VALUE 0x8153EF ME7_FW1 0 dez 2.000000 255.000000 EXTENDED_LIMITS 0.000000 255.000000 /end CHARACTERISTIC
/begin CHARACTERISTIC ASRL_DAT_UC "" VAL_BLK 0x815A6A ME7_FWB1 0 rel_ub_q0p3906___UB 0.000000 99.609400 NUMBER 16 EXTENDED_LIMITS 0.000000 99.609375 /end CHARACTERISTIC
/begin RECORD_LAYOUT ME7_FWB1 FNC_VALUES 1 UBYTE COLUMN_DIR DIRECT /end RECORD_LAYOUT
/begin CHARACTERISTIC ASRS_DAT_UC "" VAL_BLK 0x815A7A ME7_FWB1 0 rel_ub_q0p3906___UB 0.000000 99.609400 NUMBER 16 EXTENDED_LIMITS 0.000000 99.609375 /end CHARACTERISTIC
/begin CHARACTERISTIC ASUADWG "Max. Anzahl Schubumluftventilansteuerungen nach LL fÅr Diagn. Wast- Gate" VALUE 0x819752 ME7_FW1 0 dez 0.000000 255.000000 /end CHARACTERISTIC
/begin CHARACTERISTIC ATISLATM "Anzti-Schwelle zur Umschaltung von lamns_w auf lamwl_w" CURVE 0x81B886 ME7_GKL3 0 dez___UW 0.000000 50176.000000
 /begin AXIS_DESCR COM_AXIS tmst temp_ub_q0p75_o48 0 -48.000000 143.250000 AXIS_PTS_REF STS12ESUB /end AXIS_DESCR
 EXTENDED_LIMITS 0.000000 65535.000000 /end CHARACTERISTIC
/begin RECORD_LAYOUT ME7_GKL3 FNC_VALUES 1 UWORD COLUMN_DIR DIRECT /end RECORD_LAYOUT
/begin CHARACTERISTIC ATIWKSTM "Anzti-Schwelle zur Umschaltung von lamns_w auf lamwl_w bei Wiederholkaltstart" CURVE 0x81B89E ME7_GKL3 0 dez___UW 0.000000 50176.000000
 /begin AXIS_DESCR COM_AXIS tmst temp_ub_q0p75_o48 0 -48.000000 143.250000 AXIS_PTS_REF STS12ESUB /end AXIS_DESCR
 EXTENDED_LIMITS 0.000000 65535.000000 /end CHARACTERISTIC
/begin CHARACTERISTIC ATMABKA "Faktor fÅr Abgastemperaturabnahme = f(Abstellzeit)" CURVE 0x8183D6 ME7_GKL1 0 fak_ub_b1 0.000000 0.996094
 /begin AXIS_DESCR COM_AXIS tabstatm_w t1sxs_uw_q1 0 0.000000 65535.000000 AXIS_PTS_REF STS06TMUW /end AXIS_DESCR
/end CHARACTERISTIC
/begin CHARACTERISTIC ATMABKK "Faktor fÅr Abnahme der Katalysatortemperatur = f(Abstellzeit)" CURVE 0x8183DC ME7_GKL1 0 fak_ub_b1 0.000000 0.996094
 /begin AXIS_DESCR COM_AXIS tabstatm_w t1sxs_uw_q1 0 0.000000 65535.000000 AXIS_PTS_REF STS06TMUW /end AXIS_DESCR
/end CHARACTERISTIC
/begin CHARACTERISTIC ATMTANS "Temperaturkorrektur der Abgas-Modell-Temperatur" CURVE 0x81AC62 ME7_KL98 0 temp_q5 -640.000000 635.000000
 /begin AXIS_DESCR STD_AXIS tatu temp_ub_q0p75_o48 3 -48.000000 143.250000 DEPOSIT ABSOLUTE /end AXIS_DESCR
/end CHARACTERISTIC
/begin RECORD_LAYOUT ME7_KL98 NO_AXIS_PTS_X 1 UBYTE AXIS_PTS_X 2 UBYTE INDEX_INCR DIRECT FNC_VALUES 3 SBYTE COLUMN_DIR DIRECT /end RECORD_LAYOUT
/begin CHARACTERISTIC ATVFETTO "obere Grenze fÅr atvfett, CARB-Tester, DLSSA" VALUE 0x8188D7 ME7_FW1 0 t40msxs_ub_q0p04 0.000000 10.200000 /end CHARACTERISTIC
/begin CHARACTERISTIC ATVFETTU "untere Grenze fÅr atvfett, CARB-Tester, DLSSA" VALUE 0x8188D8 ME7_FW1 0 t40msxs_ub_q0p04 0.000000 10.200000 /end CHARACTERISTIC
/begin CHARACTERISTIC ATVINI "Initialisierungswert fÅr Stellgrî·e atv, Aktivieren Åber Codewort NOATV" VALUE 0x815E97 ME7_FW2 0 t100msxs_sb_q0p01 -1.280000 1.270000 /end CHARACTERISTIC
/begin RECORD_LAYOUT ME7_FW2 FNC_VALUES 1 SBYTE COLUMN_DIR DIRECT /end RECORD_LAYOUT
/begin CHARACTERISTIC ATVINI2 "Initialisierungswert fÅr Stellgrî·e atv, Bank 2, Aktivieren Åber Codewort NOATV" VALUE 0x815E98 ME7_FW2 0 t100msxs_sb_q0p01 -1.280000 1.270000 /end CHARACTERISTIC
/begin CHARACTERISTIC ATVMAGO "obere Grenze fÅr atvmager, CARB-Tester, DLSSA" VALUE 0x8188D9 ME7_FW1 0 t40msxs_ub_q0p04 0.000000 10.200000 /end CHARACTERISTIC
/begin CHARACTERISTIC ATVMAGU "untere Grenze fÅr atvmager, CARB-Tester, DLSSA" VALUE 0x8188DA ME7_FW1 0 t40msxs_ub_q0p04 0.000000 10.200000 /end CHARACTERISTIC
/begin CHARACTERISTIC ATVMN "untere Regelbereichsgrenze fÅr Stellgrî·e atv" VALUE 0x815E99 ME7_FW2 0 t100msxs_sb_q0p01 -1.280000 1.270000 /end CHARACTERISTIC
/begin CHARACTERISTIC ATVMX "obere Regelbereichsgrenze fÅr Stellgrî·e atv" VALUE 0x815E9A ME7_FW2 0 t100msxs_sb_q0p01 -1.280000 1.270000 /end CHARACTERISTIC
/begin CHARACTERISTIC AUFW100M "" VALUE 0x815A66 ME7_FW1 0 t20usxus_q20 0.000000 5100.000000 /end CHARACTERISTIC
/begin CHARACTERISTIC AUFW10MS "" VALUE 0x815A67 ME7_FW1 0 t20usxus_q20 0.000000 5100.000000 /end CHARACTERISTIC
/begin CHARACTERISTIC AUFW20MS "" VALUE 0x815A68 ME7_FW1 0 t20usxus_q20 0.000000 5100.000000 /end CHARACTERISTIC
/begin CHARACTERISTIC AUFWSYNC "" VALUE 0x815A69 ME7_FW1 0 t20usxus_q20 0.000000 5100.000000 /end CHARACTERISTIC
/begin CHARACTERISTIC AUSGH_T_UM "Heilungszeit fÅr Fehler in der zyklischen RAM-PrÅfung der FunktionsÅberwachung" VALUE 0x81420E ME7_FW1 0 t40ms_ub_b10200 0.000000 10200.000000 /end CHARACTERISTIC
/begin CHARACTERISTIC AUSG_T_UM "Fehlertoleranzschwelle fÅr zyklische RAM-PrÅfung in der FunktionsÅberwachung" VALUE 0x81420F ME7_FW1 0 dezsub1 1.000000 256.000000 /end CHARACTERISTIC
/begin CHARACTERISTIC AUSZH_T_UM "Heilungszeit fÅr Fehler in der zyklischen ROM-PrÅfung der FunktionsÅberwachung" VALUE 0x814210 ME7_FW1 0 t40ms_ub_b10200 0.000000 10200.000000 /end CHARACTERISTIC
/begin CHARACTERISTIC AUSZ_T_UM "Fehlertoleranzschwelle fÅr zyklische ROM-PrÅfung in der FunktionsÅberwachung" VALUE 0x814211 ME7_FW1 0 dezsub1 1.000000 256.000000 /end CHARACTERISTIC
/begin CHARACTERISTIC AVAOVMX "Max. Anzahl VerzîgerungsvorgÑnge ohne AdaptionswertrÅckstellung" VALUE 0x8153F0 ME7_FW1 0 dez 1.000000 255.000000 EXTENDED_LIMITS 0.000000 255.000000 /end CHARACTERISTIC
/begin CHARACTERISTIC AVDTEVX "max. Anzahl PrÅfversuche DTEV" VALUE 0x819BCF ME7_FW1 0 dez 0.000000 20.000000 EXTENDED_LIMITS 0.000000 255.000000 /end CHARACTERISTIC
/begin CHARACTERISTIC AVKATFS "Setztwert fÅr AVKATF wenn Powerfail" VALUE 0x8184D1 ME7_FW1 0 fak_ub_b1 0.000000 0.996094 /end CHARACTERISTIC
/begin CHARACTERISTIC AVRALU "Anzahl NW-Umdr./Verbrenng. f. Reaktivierung Aussetzererkennung nach Ausblendung" VALUE 0x8147FD ME7_FW1 0 dez 1.000000 255.000000 EXTENDED_LIMITS 0.000000 255.000000 /end CHARACTERISTIC
/begin CHARACTERISTIC AZKELDYN "ZÅndungen pro Zylinder bei KR-Lastdynamik => Klopferkennung" CURVE 0x819420 ME7_GKL1 0 dez 1.000000 255.000000
 /begin AXIS_DESCR COM_AXIS nmot nmot_ub_q40 0 0.000000 10200.000000 AXIS_PTS_REF SNM16KRUB /end AXIS_DESCR
 EXTENDED_LIMITS 0.000000 255.000000 /end CHARACTERISTIC
/begin CHARACTERISTIC AZKRLDYN "Anzahl ZÅndungen pro Zyl. bei KR-Lastdynamik" CURVE 0x819430 ME7_GKL1 0 dez 1.000000 255.000000
 /begin AXIS_DESCR COM_AXIS nmot nmot_ub_q40 0 0.000000 10200.000000 AXIS_PTS_REF SNM16KRUB /end AXIS_DESCR
 EXTENDED_LIMITS 0.000000 255.000000 /end CHARACTERISTIC
/begin CHARACTERISTIC AZKRNDYN "Anzahl ZÅndungen fÅr KR-Drehzahldynamik" CURVE 0x819440 ME7_GKL1 0 dez 1.000000 255.000000
 /begin AXIS_DESCR COM_AXIS nmot nmot_ub_q40 0 0.000000 10200.000000 AXIS_PTS_REF SNM16KRUB /end AXIS_DESCR
 EXTENDED_LIMITS 0.000000 255.000000 /end CHARACTERISTIC
/begin CHARACTERISTIC AZYTIAB "Maximale Anzahl von Zylindern mit Ti-Abschaltung aufgrund von Aussetzern" VALUE 0x814AC3 ME7_FW1 0 dez 0.000000 255.000000 /end CHARACTERISTIC
/begin CHARACTERISTIC B1_0_A "öbertragungsfunktionskoeffizient" VALUE 0x812AB4 ME7_FW4 0 fak_sw_b2 -2.000000 1.999940 EXTENDED_LIMITS -2.000000 1.999939 /end CHARACTERISTIC
/begin CHARACTERISTIC B1_1_A "öbertragungsfunktionskoeffizient" VALUE 0x812AB6 ME7_FW4 0 fak_sw_b2 -2.000000 1.999940 EXTENDED_LIMITS -2.000000 1.999939 /end CHARACTERISTIC
/begin CHARACTERISTIC B1_2_A "öbertragungsfunktionskoeffizient" VALUE 0x812AB8 ME7_FW4 0 fak_sw_b2 -2.000000 1.999940 EXTENDED_LIMITS -2.000000 1.999939 /end CHARACTERISTIC
/begin CHARACTERISTIC B1_3_A "öbertragungsfunktionskoeffizient" VALUE 0x812ABA ME7_FW4 0 fak_sw_b2 -2.000000 1.999940 EXTENDED_LIMITS -2.000000 1.999939 /end CHARACTERISTIC
/begin CHARACTERISTIC B2_0_A "öbertragungsfunktionskoeffizient" VALUE 0x812ABC ME7_FW4 0 fak_sw_b2 -2.000000 1.999940 EXTENDED_LIMITS -2.000000 1.999939 /end CHARACTERISTIC
/begin CHARACTERISTIC B2_1_A "öbertragungsfunktionskoeffizient" VALUE 0x812ABE ME7_FW4 0 fak_sw_b2 -2.000000 1.999940 EXTENDED_LIMITS -2.000000 1.999939 /end CHARACTERISTIC
/begin CHARACTERISTIC B2_2_A "öbertragungsfunktionskoeffizient" VALUE 0x812AC0 ME7_FW4 0 fak_sw_b2 -2.000000 1.999940 EXTENDED_LIMITS -2.000000 1.999939 /end CHARACTERISTIC
/begin CHARACTERISTIC B2_3_A "öbertragungsfunktionskoeffizient" VALUE 0x812AC2 ME7_FW4 0 fak_sw_b2 -2.000000 1.999940 EXTENDED_LIMITS -2.000000 1.999939 /end CHARACTERISTIC
/begin CHARACTERISTIC BFGRO "Obere Schwelle fÅr Beschleunigung im FGR-Regelbetrieb" VALUE 0x814FE9 ME7_FW2 0 bfzg_sb_q0p217 -27.776000 27.559000 /end CHARACTERISTIC
/begin CHARACTERISTIC BFGRU "Untere Schwelle fÅr Beschleunigung im FGR-Betrieb" VALUE 0x814FEA ME7_FW2 0 bfzg_sb_q0p217 -27.776000 27.559000 /end CHARACTERISTIC
/begin CHARACTERISTIC BFGR_DAT_UC "" VAL_BLK 0x815A8A ME7_FWB1 0 dez 0.000000 255.000000 NUMBER 16 /end CHARACTERISTIC
/begin CHARACTERISTIC BMFA "Anzahl BM-Fehler (ZÑhler-Anfangswert)" VALUE 0x810B6C ME7_FW3 0 dez___UW 0.000000 65535.000000 /end CHARACTERISTIC
/begin CHARACTERISTIC BMFMX "ZÑhler Maximalwert fÅr BM-Fehler" VALUE 0x810B6E ME7_FW3 0 dez___UW 0.000000 65000.000000 EXTENDED_LIMITS 0.000000 65535.000000 /end CHARACTERISTIC
/begin CHARACTERISTIC BNOMSR_DAT_UC "" VAL_BLK 0x815A9A ME7_FWB1 0 dez 0.000000 255.000000 NUMBER 16 /end CHARACTERISTIC
/begin CHARACTERISTIC BRABEVI_0_A "Beschleunigung bei Rampe Beschleunigen" CURVE 0x81ADAE ZF_KL111 0 bfzg_uw_q0p1085 0.000000 7110.550000
 /begin AXIS_DESCR STD_AXIS vfzg_w vfzg_uw_b512 8 0.000000 511.992000 DEPOSIT ABSOLUTE /end AXIS_DESCR
 EXTENDED_LIMITS 0.000000 7110.547500 /end CHARACTERISTIC
/begin RECORD_LAYOUT ZF_KL111 NO_AXIS_PTS_X 1 UWORD AXIS_PTS_X 2 UWORD INDEX_INCR DIRECT FNC_VALUES 3 UWORD ROW_DIR DIRECT /end RECORD_LAYOUT
/begin CHARACTERISTIC BRABEVI_1_A "Beschleunigung bei Rampe Beschleunigen" CURVE 0x81ADD0 ZF_KL111 0 bfzg_uw_q0p1085 0.000000 7110.550000
 /begin AXIS_DESCR STD_AXIS vfzg_w vfzg_uw_b512 8 0.000000 511.992000 DEPOSIT ABSOLUTE /end AXIS_DESCR
 EXTENDED_LIMITS 0.000000 7110.547500 /end CHARACTERISTIC
/begin CHARACTERISTIC BRATD "Beschleunigung (Betrag) bei Rampe Tip-Down" VALUE 0x8185B9 ME7_FW1 0 bfzg_ub_b27p67 0.000000 27.561900 EXTENDED_LIMITS 0.000000 27.561914 /end CHARACTERISTIC
/begin CHARACTERISTIC BRATU "Beschleunigung bei Rampe Tip-Up" VALUE 0x8185BA ME7_FW1 0 bfzg_ub_b27p67 0.000000 27.561900 EXTENDED_LIMITS 0.000000 27.561914 /end CHARACTERISTIC
/begin CHARACTERISTIC BRAWA1GA_0_A "Beschleunigung Rampe Wiederaufnahme im Lande-Mode Bereich 1" CURVE 0x81ADF2 ZF_KL111 0 bfzg_uw_q0p1085 0.000000 7110.550000
 /begin AXIS_DESCR STD_AXIS vfzg_w vfzg_uw_b512 8 0.000000 511.992000 DEPOSIT ABSOLUTE /end AXIS_DESCR
 EXTENDED_LIMITS 0.000000 7110.547500 /end CHARACTERISTIC
/begin CHARACTERISTIC BRAWA1GA_1_A "Beschleunigung Rampe Wiederaufnahme im Lande-Mode Bereich 1" CURVE 0x81AE14 ZF_KL111 0 bfzg_uw_q0p1085 0.000000 7110.550000
 /begin AXIS_DESCR STD_AXIS vfzg_w vfzg_uw_b512 8 0.000000 511.992000 DEPOSIT ABSOLUTE /end AXIS_DESCR
 EXTENDED_LIMITS 0.000000 7110.547500 /end CHARACTERISTIC
/begin CHARACTERISTIC BRAWA2GA_0_A "Beschleunigung Rampe Wiederaufnahme im Lande-Mode Bereich 2" CURVE 0x81AE36 ZF_KL111 0 bfzg_uw_q0p1085 0.000000 7110.550000
 /begin AXIS_DESCR STD_AXIS vfzg_w vfzg_uw_b512 8 0.000000 511.992000 DEPOSIT ABSOLUTE /end AXIS_DESCR
 EXTENDED_LIMITS 0.000000 7110.547500 /end CHARACTERISTIC
/begin CHARACTERISTIC BRAWA2GA_1_A "Beschleunigung Rampe Wiederaufnahme im Lande-Mode Bereich 2" CURVE 0x81AE58 ZF_KL111 0 bfzg_uw_q0p1085 0.000000 7110.550000
 /begin AXIS_DESCR STD_AXIS vfzg_w vfzg_uw_b512 8 0.000000 511.992000 DEPOSIT ABSOLUTE /end AXIS_DESCR
 EXTENDED_LIMITS 0.000000 7110.547500 /end CHARACTERISTIC
/begin CHARACTERISTIC BRAWA3GA_0_A "Beschleunigung Rampe Wiederaufnahme im Lande-Mode Bereich 3" CURVE 0x81AE7A ZF_KL111 0 bfzg_uw_q0p1085 0.000000 7110.550000
 /begin AXIS_DESCR STD_AXIS vfzg_w vfzg_uw_b512 8 0.000000 511.992000 DEPOSIT ABSOLUTE /end AXIS_DESCR
 EXTENDED_LIMITS 0.000000 7110.547500 /end CHARACTERISTIC
/begin CHARACTERISTIC BRAWA3GA_1_A "Beschleunigung Rampe Wiederaufnahme im Lande-Mode Bereich 3" CURVE 0x81AE9C ZF_KL111 0 bfzg_uw_q0p1085 0.000000 7110.550000
 /begin AXIS_DESCR STD_AXIS vfzg_w vfzg_uw_b512 8 0.000000 511.992000 DEPOSIT ABSOLUTE /end AXIS_DESCR
 EXTENDED_LIMITS 0.000000 7110.547500 /end CHARACTERISTIC
/begin CHARACTERISTIC BRAWAVI_0_A "Beschleunigung Rampe Wiederaufnahme" CURVE 0x81AEBE ZF_KL111 0 bfzg_uw_q0p1085 0.000000 7110.550000
 /begin AXIS_DESCR STD_AXIS vfzg_w vfzg_uw_b512 8 0.000000 511.992000 DEPOSIT ABSOLUTE /end AXIS_DESCR
 EXTENDED_LIMITS 0.000000 7110.547500 /end CHARACTERISTIC
/begin CHARACTERISTIC BRAWAVI_1_A "Beschleunigung Rampe Wiederaufnahme" CURVE 0x81AEE0 ZF_KL111 0 bfzg_uw_q0p1085 0.000000 7110.550000
 /begin AXIS_DESCR STD_AXIS vfzg_w vfzg_uw_b512 8 0.000000 511.992000 DEPOSIT ABSOLUTE /end AXIS_DESCR
 EXTENDED_LIMITS 0.000000 7110.547500 /end CHARACTERISTIC
/begin CHARACTERISTIC BREMS_T_UM "Entprellzeit fÅr betÑtigte Bremse in der FunktionsÅberwachung" VALUE 0x814003 ME7_FW1 0 t40ms_ub_b10200 0.000000 10200.000000 /end CHARACTERISTIC
/begin CHARACTERISTIC BTRKHTMS "Kennline zur Freigabe B_trkh" CURVE 0x819008 ME7_KL97 0 dez 0.000000 255.000000
 /begin AXIS_DESCR STD_AXIS tmst temp_ub_q0p75_o48 8 -48.000000 143.250000 DEPOSIT ABSOLUTE /end AXIS_DESCR
/end CHARACTERISTIC
/begin RECORD_LAYOUT ME7_KL97 NO_AXIS_PTS_X 1 UBYTE AXIS_PTS_X 2 UBYTE INDEX_INCR DIRECT FNC_VALUES 3 UBYTE COLUMN_DIR DIRECT /end RECORD_LAYOUT
/begin CHARACTERISTIC BUSOFFCTR "ZÑhler fÅr Bus-off-Flanken bis Fehlerspeichereintrag" VALUE 0x8144D5 ME7_FW1 0 DEZ 0.000000 255.000000 /end CHARACTERISTIC
/begin CHARACTERISTIC BUSOFFTIME "Entprellzeit zum RÅcksetzen von Bus-off-Fehler" VALUE 0x8144D6 ME7_FW1 0 t10msxs_ub_b2p55 0.000000 2.550000 /end CHARACTERISTIC
/begin CHARACTERISTIC BZMSRA_DAT_UC "" VAL_BLK 0x815AAA ME7_FWB1 0 dez 0.000000 255.000000 NUMBER 16 /end CHARACTERISTIC
/begin CHARACTERISTIC BZMSR_DAT_UC "" VAL_BLK 0x815ABA ME7_FWB1 0 dez 0.000000 255.000000 NUMBER 16 /end CHARACTERISTIC
/begin CHARACTERISTIC BZ_MSR_UC "" VALUE 0x815C7A ME7_FW1 0 dez 0.000000 255.000000 /end CHARACTERISTIC
/begin CHARACTERISTIC BZ_MSR_UM "" VALUE 0x81406F ME7_FW1 0 dez 0.000000 255.000000 /end CHARACTERISTIC
/begin CHARACTERISTIC CANVERS "CAN-Versionsbezeichnung" VALUE 0x8144D7 ME7_FW1 0 DEZ 0.000000 255.000000 /end CHARACTERISTIC
/begin CHARACTERISTIC CBGRLP "Codewort Konfiguration Funktion BGRLP" VALUE 0x8151BF ME7_FW1 0 dez 0.000000 255.000000 /end CHARACTERISTIC
/begin CHARACTERISTIC CBIT_DAT_UC "" VAL_BLK 0x815ACA ME7_FWB1 0 dez 0.000000 255.000000 NUMBER 16 /end CHARACTERISTIC
/begin CHARACTERISTIC CDADLCK "Codewort: RichtungsabhÑngige Adaptionssperre" VALUE 0x8151CC ME7_FW1 0 dez 0.000000 255.000000 /end CHARACTERISTIC
/begin CHARACTERISTIC CDAGR "Codewort DAGR abschalten (EURO-Codierung), CD..=0 -> keine Diagnose" VALUE 0x814300 ME7_FW1 0 dez 0.000000 255.000000 /end CHARACTERISTIC
/begin CHARACTERISTIC CDAGRL "Codewort Diagnose Lagesensor abschalten (EURO-Codierung), CD..=0 -> keine Diag." VALUE 0x814301 ME7_FW1 0 dez 0.000000 255.000000 /end CHARACTERISTIC
/begin CHARACTERISTIC CDATR "Konfigurationsbyte Diagnose Abgastemperaturregelung" VALUE 0x814302 ME7_FW1 0 dez 0.000000 255.000000 /end CHARACTERISTIC
/begin CHARACTERISTIC CDATS "Konfigurationsbyte Diagnose Abgastemperatursensor" VALUE 0x814303 ME7_FW1 0 dez 0.000000 255.000000 /end CHARACTERISTIC
/begin CHARACTERISTIC CDCAAA "Dummy: Tabellenanfang" VAL_BLK 0x8101C2 ME7_FWB3 0 dez___UW 0.000000 65535.000000 NUMBER 4 /end CHARACTERISTIC
/begin RECORD_LAYOUT ME7_FWB3 FNC_VALUES 1 UWORD COLUMN_DIR DIRECT /end RECORD_LAYOUT
/begin CHARACTERISTIC CDCAAVE "Codewort CARB: Absperrventil Aktivkohlefilter (Endstufe)" VAL_BLK 0x8101CA ME7_FWB3 0 dez___UW 0.000000 65535.000000 NUMBER 4 /end CHARACTERISTIC
/begin CHARACTERISTIC CDCAGRE "Codewort CARB:	öberwachung AGR-Endstufe" VAL_BLK 0x8101D2 ME7_FWB3 0 dez___UW 0.000000 65535.000000 NUMBER 4 /end CHARACTERISTIC
/begin CHARACTERISTIC CDCAGRF "Codewort CARB: öberwachung AGR-FLOW" VAL_BLK 0x8101DA ME7_FWB3 0 dez___UW 0.000000 65535.000000 NUMBER 4 /end CHARACTERISTIC
/begin CHARACTERISTIC CDCBM "Codewort CARB: Bezugsmarkengeber" VAL_BLK 0x8101E2 ME7_FWB3 0 dez___UW 0.000000 65535.000000 NUMBER 4 /end CHARACTERISTIC
/begin CHARACTERISTIC CDCBREMS "Codewort CARB: Bremspedalgeber" VAL_BLK 0x8101EA ME7_FWB3 0 dez___UW 0.000000 65535.000000 NUMBER 4 /end CHARACTERISTIC
/begin CHARACTERISTIC CDCBWF "Codewort CARB: PWG Bewegung" VAL_BLK 0x8101F2 ME7_FWB3 0 dez___UW 0.000000 65535.000000 NUMBER 4 /end CHARACTERISTIC
/begin CHARACTERISTIC CDCCADR "Codewort CARB: CAN- Timeout ADR" VAL_BLK 0x8101FA ME7_FWB3 0 dez___UW 0.000000 65535.000000 NUMBER 4 /end CHARACTERISTIC
/begin CHARACTERISTIC CDCCAS "Codewort CARB: CAN-Schnittstelle, Timeout ASC" VAL_BLK 0x810202 ME7_FWB3 0 dez___UW 0.000000 65535.000000 NUMBER 4 /end CHARACTERISTIC
/begin CHARACTERISTIC CDCCAT "Codewort CARB: CAN-Schnittstelle, Timeout ASR" VAL_BLK 0x81020A ME7_FWB3 0 dez___UW 0.000000 65535.000000 NUMBER 4 /end CHARACTERISTIC
/begin CHARACTERISTIC CDCCGE "Codewort CARB: CAN-Schnittstelle, Timeout EGS" VAL_BLK 0x810212 ME7_FWB3 0 dez___UW 0.000000 65535.000000 NUMBER 4 /end CHARACTERISTIC
/begin CHARACTERISTIC CDCCIF "Codewort CARB: CAN-Schnittstelle, interner Fehler" VAL_BLK 0x81021A ME7_FWB3 0 dez___UW 0.000000 65535.000000 NUMBER 4 /end CHARACTERISTIC
/begin CHARACTERISTIC CDCCINS "Codewort CARB: CAN-Schnittstelle, Timeout Instrument" VAL_BLK 0x810222 ME7_FWB3 0 dez___UW 0.000000 65535.000000 NUMBER 4 /end CHARACTERISTIC
/begin CHARACTERISTIC CDCCLWS "Codewort CARB: CAN-Schnittstelle, Timeout Botschaft Lenkwinkelsensor" VAL_BLK 0x81022A ME7_FWB3 0 dez___UW 0.000000 65535.000000 NUMBER 4 /end CHARACTERISTIC
/begin CHARACTERISTIC CDCDK "Codewort CARB:	DK - Potentiometer" VAL_BLK 0x810232 ME7_FWB3 0 dez___UW 0.000000 65535.000000 NUMBER 4 /end CHARACTERISTIC
/begin CHARACTERISTIC CDCDK1P "Codewort CARB: Drosselklappe 1. Poti" VAL_BLK 0x81023A ME7_FWB3 0 dez___UW 0.000000 65535.000000 NUMBER 4 /end CHARACTERISTIC
/begin CHARACTERISTIC CDCDK2P "Codewort CARB: Drosselklappe 2. Poti" VAL_BLK 0x810242 ME7_FWB3 0 dez___UW 0.000000 65535.000000 NUMBER 4 /end CHARACTERISTIC
/begin CHARACTERISTIC CDCDPL "Codewort CARB:	Dauerplus" VAL_BLK 0x81024A ME7_FWB3 0 dez___UW 0.000000 65535.000000 NUMBER 4 /end CHARACTERISTIC
/begin CHARACTERISTIC CDCDSL "Codewort CARB: Drucksensor Ladedruck" VAL_BLK 0x810252 ME7_FWB3 0 dez___UW 0.000000 65535.000000 NUMBER 4 /end CHARACTERISTIC
/begin CHARACTERISTIC CDCDSS "Codewort CARB: Saugrohr-Drucksensor" VAL_BLK 0x81025A ME7_FWB3 0 dez___UW 0.000000 65535.000000 NUMBER 4 /end CHARACTERISTIC
/begin CHARACTERISTIC CDCDSU "Codewort CARB: Drucksensor Umgebung" VAL_BLK 0x810262 ME7_FWB3 0 dez___UW 0.000000 65535.000000 NUMBER 4 /end CHARACTERISTIC
/begin CHARACTERISTIC CDCDSVLU "" VAL_BLK 0x81026A ME7_FWB3 0 dez___UW 0.000000 65535.000000 NUMBER 4 /end CHARACTERISTIC
/begin CHARACTERISTIC CDCDVEE "Codewort CARB: DV-E Endstufe" VAL_BLK 0x810272 ME7_FWB3 0 dez___UW 0.000000 65535.000000 NUMBER 4 /end CHARACTERISTIC
/begin CHARACTERISTIC CDCDVEF "Codewort CARB: DV-E Fehler bei FederprÅfung" VAL_BLK 0x81027A ME7_FWB3 0 dez___UW 0.000000 65535.000000 NUMBER 4 /end CHARACTERISTIC
/begin CHARACTERISTIC CDCDVEFO "" VAL_BLK 0x810282 ME7_FWB3 0 dez___UW 0.000000 65535.000000 NUMBER 4 /end CHARACTERISTIC
/begin CHARACTERISTIC CDCDVEL "Codewort CARB: DV-E Lageabweichung" VAL_BLK 0x81028A ME7_FWB3 0 dez___UW 0.000000 65535.000000 NUMBER 4 /end CHARACTERISTIC
/begin CHARACTERISTIC CDCDVEN "Codewort CARB: DV-E Fehler bei PrÅfung Notluftposition" VAL_BLK 0x810292 ME7_FWB3 0 dez___UW 0.000000 65535.000000 NUMBER 4 /end CHARACTERISTIC
/begin CHARACTERISTIC CDCDVER "Codewort CARB: DV-E Regelbereich" VAL_BLK 0x81029A ME7_FWB3 0 dez___UW 0.000000 65535.000000 NUMBER 4 /end CHARACTERISTIC
/begin CHARACTERISTIC CDCDVET "" VAL_BLK 0x8102A2 ME7_FWB3 0 dez___UW 0.000000 65535.000000 NUMBER 4 /end CHARACTERISTIC
/begin CHARACTERISTIC CDCDVEU "Codewort CARB: DV-E Fehler beim UMA-Lernen" VAL_BLK 0x8102AA ME7_FWB3 0 dez___UW 0.000000 65535.000000 NUMBER 4 /end CHARACTERISTIC
/begin CHARACTERISTIC CDCDVEUB "" VAL_BLK 0x8102B2 ME7_FWB3 0 dez___UW 0.000000 65535.000000 NUMBER 4 /end CHARACTERISTIC
/begin CHARACTERISTIC CDCDVEUW "" VAL_BLK 0x8102BA ME7_FWB3 0 dez___UW 0.000000 65535.000000 NUMBER 4 /end CHARACTERISTIC
/begin CHARACTERISTIC CDCDVEV "Codewort CARB: DV-E Fehler bei VerstÑrkerabgleich" VAL_BLK 0x8102C2 ME7_FWB3 0 dez___UW 0.000000 65535.000000 NUMBER 4 /end CHARACTERISTIC
/begin CHARACTERISTIC CDCEGFE "" VAL_BLK 0x8102CA ME7_FWB3 0 dez___UW 0.000000 65535.000000 NUMBER 4 /end CHARACTERISTIC
/begin CHARACTERISTIC CDCEPCLE "Codewort CARB: Fahrverhaltens- Fehlerlampe ( Endstufe )" VAL_BLK 0x8102D2 ME7_FWB3 0 dez___UW 0.000000 65535.000000 NUMBER 4 /end CHARACTERISTIC
/begin CHARACTERISTIC CDCETSE "Codewort CARB: Elektrisches Thermostat Endstufe" VAL_BLK 0x8102DA ME7_FWB3 0 dez___UW 0.000000 65535.000000 NUMBER 4 /end CHARACTERISTIC
/begin CHARACTERISTIC CDCEV1 "Codewort CARB: EV von Zyl. 1" VAL_BLK 0x8102E2 ME7_FWB3 0 dez___UW 0.000000 65535.000000 NUMBER 4 /end CHARACTERISTIC
/begin CHARACTERISTIC CDCEV2 "Codewort CARB: EV von Zyl. 2" VAL_BLK 0x8102EA ME7_FWB3 0 dez___UW 0.000000 65535.000000 NUMBER 4 /end CHARACTERISTIC
/begin CHARACTERISTIC CDCEV3 "Codewort CARB: EV von Zyl. 3" VAL_BLK 0x8102F2 ME7_FWB3 0 dez___UW 0.000000 65535.000000 NUMBER 4 /end CHARACTERISTIC
/begin CHARACTERISTIC CDCEV4 "Codewort CARB: EV von Zyl. 4" VAL_BLK 0x8102FA ME7_FWB3 0 dez___UW 0.000000 65535.000000 NUMBER 4 /end CHARACTERISTIC
/begin CHARACTERISTIC CDCEV5 "Codewort CARB: EV von Zyl. 5" VAL_BLK 0x810302 ME7_FWB3 0 dez___UW 0.000000 65535.000000 NUMBER 4 /end CHARACTERISTIC
/begin CHARACTERISTIC CDCEV6 "Codewort CARB: EV von Zyl. 6" VAL_BLK 0x81030A ME7_FWB3 0 dez___UW 0.000000 65535.000000 NUMBER 4 /end CHARACTERISTIC
/begin CHARACTERISTIC CDCEV7 "Codewort CARB: EV von Zyl. 7" VAL_BLK 0x810312 ME7_FWB3 0 dez___UW 0.000000 65535.000000 NUMBER 4 /end CHARACTERISTIC
/begin CHARACTERISTIC CDCEV8 "Codewort CARB: EV von Zyl. 8" VAL_BLK 0x81031A ME7_FWB3 0 dez___UW 0.000000 65535.000000 NUMBER 4 /end CHARACTERISTIC
/begin CHARACTERISTIC CDCFP1P "Codewort CARB: Poti 1, Fahrpedal" VAL_BLK 0x810322 ME7_FWB3 0 dez___UW 0.000000 65535.000000 NUMBER 4 /end CHARACTERISTIC
/begin CHARACTERISTIC CDCFP2P "Codewort CARB: Poti 2, Fahrpedal" VAL_BLK 0x81032A ME7_FWB3 0 dez___UW 0.000000 65535.000000 NUMBER 4 /end CHARACTERISTIC
/begin CHARACTERISTIC CDCFPP "Codewort CARB: Fahrpedalpoti" VAL_BLK 0x810332 ME7_FWB3 0 dez___UW 0.000000 65535.000000 NUMBER 4 /end CHARACTERISTIC
/begin CHARACTERISTIC CDCFRAO "Codewort CARB: LR-Adaption obere multiplikativ" VAL_BLK 0x81033A ME7_FWB3 0 dez___UW 0.000000 65535.000000 NUMBER 4 /end CHARACTERISTIC
/begin CHARACTERISTIC CDCFRAU "Codewort CARB: LR-Adaption untere multiplikativ" VAL_BLK 0x810342 ME7_FWB3 0 dez___UW 0.000000 65535.000000 NUMBER 4 /end CHARACTERISTIC
/begin CHARACTERISTIC CDCFRST "Codewort CARB: LR-Abweichung" VAL_BLK 0x81034A ME7_FWB3 0 dez___UW 0.000000 65535.000000 NUMBER 4 /end CHARACTERISTIC
/begin CHARACTERISTIC CDCGECOD "" VAL_BLK 0x810352 ME7_FWB3 0 dez___UW 0.000000 65535.000000 NUMBER 4 /end CHARACTERISTIC
/begin CHARACTERISTIC CDCGRBH "Codewort CARB: GRA Bedienhebelfehler" VAL_BLK 0x81035A ME7_FWB3 0 dez___UW 0.000000 65535.000000 NUMBER 4 /end CHARACTERISTIC
/begin CHARACTERISTIC CDCHSH "Codewort CARB:	Lambdasonden-Heizung hinter Katalysator" VAL_BLK 0x810362 ME7_FWB3 0 dez___UW 0.000000 65535.000000 NUMBER 4 /end CHARACTERISTIC
/begin CHARACTERISTIC CDCHSHE "Codewort CARB: Endstufe Heizung Sonde hinter Kat." VAL_BLK 0x81036A ME7_FWB3 0 dez___UW 0.000000 65535.000000 NUMBER 4 /end CHARACTERISTIC
/begin CHARACTERISTIC CDCHSHE2 "Codewort CARB: Endstufe Heizung Sonde Hinter Kat. Bank 2" VAL_BLK 0x810372 ME7_FWB3 0 dez___UW 0.000000 65535.000000 NUMBER 4 /end CHARACTERISTIC
/begin CHARACTERISTIC CDCHSV "Codewort CARB:	Lambdasonden-Heizung vor Katalysator" VAL_BLK 0x81037A ME7_FWB3 0 dez___UW 0.000000 65535.000000 NUMBER 4 /end CHARACTERISTIC
/begin CHARACTERISTIC CDCHSV2 "Codewort CARB:	Lambdasonden-Heizung vor Katalysator; (Bank2)" VAL_BLK 0x810382 ME7_FWB3 0 dez___UW 0.000000 65535.000000 NUMBER 4 /end CHARACTERISTIC
/begin CHARACTERISTIC CDCKAT "Codewort CARB:	Katalysator-Konvertierung" VAL_BLK 0x81038A ME7_FWB3 0 dez___UW 0.000000 65535.000000 NUMBER 4 /end CHARACTERISTIC
/begin CHARACTERISTIC CDCKPE "Codewort CARB: EKP-Relais Endstufe" VAL_BLK 0x810392 ME7_FWB3 0 dez___UW 0.000000 65535.000000 NUMBER 4 /end CHARACTERISTIC
/begin CHARACTERISTIC CDCKRA01 "Codewort CARB: Klopfregelanschlag Zylinder 1" VAL_BLK 0x81039A ME7_FWB3 0 dez___UW 0.000000 65535.000000 NUMBER 4 /end CHARACTERISTIC
/begin CHARACTERISTIC CDCKRA02 "Codewort CARB: Klopfregelanschlag Zylinder 2" VAL_BLK 0x8103A2 ME7_FWB3 0 dez___UW 0.000000 65535.000000 NUMBER 4 /end CHARACTERISTIC
/begin CHARACTERISTIC CDCKRA03 "Codewort CARB: Klopfregelanschlag Zylinder 3" VAL_BLK 0x8103AA ME7_FWB3 0 dez___UW 0.000000 65535.000000 NUMBER 4 /end CHARACTERISTIC
/begin CHARACTERISTIC CDCKRA04 "Codewort CARB: Klopfregelanschlag Zylinder 4" VAL_BLK 0x8103B2 ME7_FWB3 0 dez___UW 0.000000 65535.000000 NUMBER 4 /end CHARACTERISTIC
/begin CHARACTERISTIC CDCKRA05 "Codewort CARB: Klopfregelanschlag Zylinder 5" VAL_BLK 0x8103BA ME7_FWB3 0 dez___UW 0.000000 65535.000000 NUMBER 4 /end CHARACTERISTIC
/begin CHARACTERISTIC CDCKRA06 "Codewort CARB: Klopfregelanschlag Zylinder 6" VAL_BLK 0x8103C2 ME7_FWB3 0 dez___UW 0.000000 65535.000000 NUMBER 4 /end CHARACTERISTIC
/begin CHARACTERISTIC CDCKRA07 "Codewort CARB: Klopfregelanschlag Zylinder 7" VAL_BLK 0x8103CA ME7_FWB3 0 dez___UW 0.000000 65535.000000 NUMBER 4 /end CHARACTERISTIC
/begin CHARACTERISTIC CDCKRA08 "Codewort CARB: Klopfregelanschlag Zylinder 8" VAL_BLK 0x8103D2 ME7_FWB3 0 dez___UW 0.000000 65535.000000 NUMBER 4 /end CHARACTERISTIC
/begin CHARACTERISTIC CDCKRNT "Codewort CARB:	Klopfregelung Nulltest" VAL_BLK 0x8103DA ME7_FWB3 0 dez___UW 0.000000 65535.000000 NUMBER 4 /end CHARACTERISTIC
/begin CHARACTERISTIC CDCKROF "Codewort CARB:	Klopfregelung Offset" VAL_BLK 0x8103E2 ME7_FWB3 0 dez___UW 0.000000 65535.000000 NUMBER 4 /end CHARACTERISTIC
/begin CHARACTERISTIC CDCKRTP "Codewort CARB: Klopfregelung Testimpulse" VAL_BLK 0x8103EA ME7_FWB3 0 dez___UW 0.000000 65535.000000 NUMBER 4 /end CHARACTERISTIC
/begin CHARACTERISTIC CDCKS1 "Codewort CARB:	Klopfsensor 1" VAL_BLK 0x8103F2 ME7_FWB3 0 dez___UW 0.000000 65535.000000 NUMBER 4 /end CHARACTERISTIC
/begin CHARACTERISTIC CDCKS2 "Codewort CARB:	Klopfsensor 2" VAL_BLK 0x8103FA ME7_FWB3 0 dez___UW 0.000000 65535.000000 NUMBER 4 /end CHARACTERISTIC
/begin CHARACTERISTIC CDCKS3 "Codewort CARB:	Klopfsensor 3" VAL_BLK 0x810402 ME7_FWB3 0 dez___UW 0.000000 65535.000000 NUMBER 4 /end CHARACTERISTIC
/begin CHARACTERISTIC CDCKS4 "Codewort CARB:	Klopfsensor 4" VAL_BLK 0x81040A ME7_FWB3 0 dez___UW 0.000000 65535.000000 NUMBER 4 /end CHARACTERISTIC
/begin CHARACTERISTIC CDCKUPPL "Codewort CARB: Kupplungspedalwertgeber" VAL_BLK 0x810412 ME7_FWB3 0 dez___UW 0.000000 65535.000000 NUMBER 4 /end CHARACTERISTIC
/begin CHARACTERISTIC CDCLASH "Codewort CARB:	Lambda-Sondenalterung hinter Kat." VAL_BLK 0x81041A ME7_FWB3 0 dez___UW 0.000000 65535.000000 NUMBER 4 /end CHARACTERISTIC
/begin CHARACTERISTIC CDCLASH2 "Codewort CARB:	Lambda-Sondenalterung hinter Kat. (Bank 2)" VAL_BLK 0x810422 ME7_FWB3 0 dez___UW 0.000000 65535.000000 NUMBER 4 /end CHARACTERISTIC
/begin CHARACTERISTIC CDCLATP "Codewort CARB:	Lambda-Sondenalterung TP" VAL_BLK 0x81042A ME7_FWB3 0 dez___UW 0.000000 65535.000000 NUMBER 4 /end CHARACTERISTIC
/begin CHARACTERISTIC CDCLATP2 "Codewort CARB:	Lambda-Sondenalterung TP (Bank 2)" VAL_BLK 0x810432 ME7_FWB3 0 dez___UW 0.000000 65535.000000 NUMBER 4 /end CHARACTERISTIC
/begin CHARACTERISTIC CDCLATV "Codewort CARB:	Lambda-Sondenalterung TV" VAL_BLK 0x81043A ME7_FWB3 0 dez___UW 0.000000 65535.000000 NUMBER 4 /end CHARACTERISTIC
/begin CHARACTERISTIC CDCLATV2 "Codewort CARB:	Lambda-Sondenalterung TV (Bank 2)" VAL_BLK 0x810442 ME7_FWB3 0 dez___UW 0.000000 65535.000000 NUMBER 4 /end CHARACTERISTIC
/begin CHARACTERISTIC CDCLDE "Codewort CARB: Ladedrucksteuerventil (Endstufe)" VAL_BLK 0x81044A ME7_FWB3 0 dez___UW 0.000000 65535.000000 NUMBER 4 /end CHARACTERISTIC
/begin CHARACTERISTIC CDCLDO "Codewort CARB:	Ladedruckkennlinie; oberer Wert Åberschritten" VAL_BLK 0x810452 ME7_FWB3 0 dez___UW 0.000000 65535.000000 NUMBER 4 /end CHARACTERISTIC
/begin CHARACTERISTIC CDCLDP "Codewort CARB: Leckdiagnosepumpe" VAL_BLK 0x81045A ME7_FWB3 0 dez___UW 0.000000 65535.000000 NUMBER 4 /end CHARACTERISTIC
/begin CHARACTERISTIC CDCLDPE "Codewort CARB: Leckdiagnosepumpe Endstufe" VAL_BLK 0x810462 ME7_FWB3 0 dez___UW 0.000000 65535.000000 NUMBER 4 /end CHARACTERISTIC
/begin CHARACTERISTIC CDCLDRA "Codewort CARB:	Ladedruckregelabweichung" VAL_BLK 0x81046A ME7_FWB3 0 dez___UW 0.000000 65535.000000 NUMBER 4 /end CHARACTERISTIC
/begin CHARACTERISTIC CDCLLR "Codewort CARB: Leerlaufregelung am Anschlag" VAL_BLK 0x810472 ME7_FWB3 0 dez___UW 0.000000 65535.000000 NUMBER 4 /end CHARACTERISTIC
/begin CHARACTERISTIC CDCLM "Codewort CARB:	LMM/HLM/HFM" VAL_BLK 0x81047A ME7_FWB3 0 dez___UW 0.000000 65535.000000 NUMBER 4 /end CHARACTERISTIC
/begin CHARACTERISTIC CDCLSH "Codewort CARB:	Lambda-Sonde hinter Kat" VAL_BLK 0x810482 ME7_FWB3 0 dez___UW 0.000000 65535.000000 NUMBER 4 /end CHARACTERISTIC
/begin CHARACTERISTIC CDCLSV "Codewort CARB:	Lambda-Sonde vor Kat" VAL_BLK 0x81048A ME7_FWB3 0 dez___UW 0.000000 65535.000000 NUMBER 4 /end CHARACTERISTIC
/begin CHARACTERISTIC CDCMD "Codewort CARB: Aussetzer, Summenfehler (multiple)" VAL_BLK 0x810492 ME7_FWB3 0 dez___UW 0.000000 65535.000000 NUMBER 4 /end CHARACTERISTIC
/begin CHARACTERISTIC CDCMD01 "Codewort CARB: Aussetzer Zyl. 1" VAL_BLK 0x81049A ME7_FWB3 0 dez___UW 0.000000 65535.000000 NUMBER 4 /end CHARACTERISTIC
/begin CHARACTERISTIC CDCMD02 "Codewort CARB: Aussetzer Zylinder 2" VAL_BLK 0x8104A2 ME7_FWB3 0 dez___UW 0.000000 65535.000000 NUMBER 4 /end CHARACTERISTIC
/begin CHARACTERISTIC CDCMD03 "Codewort CARB: Aussetzer Zylinder 3" VAL_BLK 0x8104AA ME7_FWB3 0 dez___UW 0.000000 65535.000000 NUMBER 4 /end CHARACTERISTIC
/begin CHARACTERISTIC CDCMD04 "Codewort CARB: Aussetzer Zylinder 4" VAL_BLK 0x8104B2 ME7_FWB3 0 dez___UW 0.000000 65535.000000 NUMBER 4 /end CHARACTERISTIC
/begin CHARACTERISTIC CDCMDB "Codewort CARB: Momentbegrenzung Sollmoment" VAL_BLK 0x8104BA ME7_FWB3 0 dez___UW 0.000000 65535.000000 NUMBER 4 /end CHARACTERISTIC
/begin CHARACTERISTIC CDCMDK "Codewort CARB: Aussetzer, Summenfehler - multiple, kundendienstrelevant" VAL_BLK 0x8104C2 ME7_FWB3 0 dez___UW 0.000000 65535.000000 NUMBER 4 /end CHARACTERISTIC
/begin CHARACTERISTIC CDCMDK01 "Codewort CARB: Aussetzer, Zylinder 1, kundendienstrelevant" VAL_BLK 0x8104CA ME7_FWB3 0 dez___UW 0.000000 65535.000000 NUMBER 4 /end CHARACTERISTIC
/begin CHARACTERISTIC CDCMDK02 "Codewort CARB: Aussetzer, Zylinder 2, kundendienstrelevant" VAL_BLK 0x8104D2 ME7_FWB3 0 dez___UW 0.000000 65535.000000 NUMBER 4 /end CHARACTERISTIC
/begin CHARACTERISTIC CDCMDK03 "Codewort CARB: Aussetzer, Zylinder 3, kundendienstrelevant" VAL_BLK 0x8104DA ME7_FWB3 0 dez___UW 0.000000 65535.000000 NUMBER 4 /end CHARACTERISTIC
/begin CHARACTERISTIC CDCMDK04 "Codewort CARB: Aussetzer, Zylinder 4, kundendienstrelevant" VAL_BLK 0x8104E2 ME7_FWB3 0 dez___UW 0.000000 65535.000000 NUMBER 4 /end CHARACTERISTIC
/begin CHARACTERISTIC CDCMILE "Codewort CARB: MIL-Endstufe" VAL_BLK 0x8104EA ME7_FWB3 0 dez___UW 0.000000 65535.000000 NUMBER 4 /end CHARACTERISTIC
/begin CHARACTERISTIC CDCN "Codewort CARB: Drehzahlsignalgeber" VAL_BLK 0x8104F2 ME7_FWB3 0 dez___UW 0.000000 65535.000000 NUMBER 4 /end CHARACTERISTIC
/begin CHARACTERISTIC CDCNWKW "Codewort CARB: Zuordnung Nockenwelle zu Kurbelwelle" VAL_BLK 0x8104FA ME7_FWB3 0 dez___UW 0.000000 65535.000000 NUMBER 4 /end CHARACTERISTIC
/begin CHARACTERISTIC CDCNWKW2 "Codewort CARB: Zuordnung Nockenwelle 2 zu Kurbelwelle" VAL_BLK 0x810502 ME7_FWB3 0 dez___UW 0.000000 65535.000000 NUMBER 4 /end CHARACTERISTIC
/begin CHARACTERISTIC CDCNWS "Codewort CARB: Nockenwellensteuerung" VAL_BLK 0x81050A ME7_FWB3 0 dez___UW 0.000000 65535.000000 NUMBER 4 /end CHARACTERISTIC
/begin CHARACTERISTIC CDCNWS2 "Codewort CARB: Nockenwellensteuerung Bank2" VAL_BLK 0x810512 ME7_FWB3 0 dez___UW 0.000000 65535.000000 NUMBER 4 /end CHARACTERISTIC
/begin CHARACTERISTIC CDCNWSE "Codewort CARB: Nockenwellensteuerungsventil Endstufe" VAL_BLK 0x81051A ME7_FWB3 0 dez___UW 0.000000 65535.000000 NUMBER 4 /end CHARACTERISTIC
/begin CHARACTERISTIC CDCNX "Codewort CARB:	NMAX - öberschreitung" VAL_BLK 0x810522 ME7_FWB3 0 dez___UW 0.000000 65535.000000 NUMBER 4 /end CHARACTERISTIC
/begin CHARACTERISTIC CDCPH "Codewort CARB: Phasensensor" VAL_BLK 0x81052A ME7_FWB3 0 dez___UW 0.000000 65535.000000 NUMBER 4 /end CHARACTERISTIC
/begin CHARACTERISTIC CDCPWM "" VAL_BLK 0x810532 ME7_FWB3 0 dez___UW 0.000000 65535.000000 NUMBER 4 /end CHARACTERISTIC
/begin CHARACTERISTIC CDCRKAT "Codewort CARB: LR-Adaption QL-additiv" VAL_BLK 0x81053A ME7_FWB3 0 dez___UW 0.000000 65535.000000 NUMBER 4 /end CHARACTERISTIC
/begin CHARACTERISTIC CDCRKAZ "Codewort CARB: LR-Adaption ti-additiv" VAL_BLK 0x810542 ME7_FWB3 0 dez___UW 0.000000 65535.000000 NUMBER 4 /end CHARACTERISTIC
/begin CHARACTERISTIC CDCSGEEW "Codewort CARB: SteuergerÑt defekt (EEPROM WFS-Bereich)" VAL_BLK 0x81054A ME7_FWB3 0 dez___UW 0.000000 65535.000000 NUMBER 4 /end CHARACTERISTIC
/begin CHARACTERISTIC CDCSLPE "Codewort CARB: SekundÑrluftpumpe (Endstufe)" VAL_BLK 0x810552 ME7_FWB3 0 dez___UW 0.000000 65535.000000 NUMBER 4 /end CHARACTERISTIC
/begin CHARACTERISTIC CDCSLS "Codewort CARB: SekundÑrluft-System" VAL_BLK 0x81055A ME7_FWB3 0 dez___UW 0.000000 65535.000000 NUMBER 4 /end CHARACTERISTIC
/begin CHARACTERISTIC CDCSLV "Codewort CARB: SekundÑrluftventil" VAL_BLK 0x810562 ME7_FWB3 0 dez___UW 0.000000 65535.000000 NUMBER 4 /end CHARACTERISTIC
/begin CHARACTERISTIC CDCSLVE "Codewort CARB: SekundÑrluftventil (Endstufe)" VAL_BLK 0x81056A ME7_FWB3 0 dez___UW 0.000000 65535.000000 NUMBER 4 /end CHARACTERISTIC
/begin CHARACTERISTIC CDCSLWG "Codewort CARB: Wastegate Ansteuerung" VAL_BLK 0x810572 ME7_FWB3 0 dez___UW 0.000000 65535.000000 NUMBER 4 /end CHARACTERISTIC
/begin CHARACTERISTIC CDCSUE "Codewort Carb: Endstufe Saugrohrumschaltung" VAL_BLK 0x81057A ME7_FWB3 0 dez___UW 0.000000 65535.000000 NUMBER 4 /end CHARACTERISTIC
/begin CHARACTERISTIC CDCSWE "Codewort CARB:	Beschleunigungssensor der Schlechtwegeerkennung" VAL_BLK 0x810582 ME7_FWB3 0 dez___UW 0.000000 65535.000000 NUMBER 4 /end CHARACTERISTIC
/begin CHARACTERISTIC CDCTA "Codewort CARB: TANS" VAL_BLK 0x81058A ME7_FWB3 0 dez___UW 0.000000 65535.000000 NUMBER 4 /end CHARACTERISTIC
/begin CHARACTERISTIC CDCTANKL "Codewort CARB: OBDII Fehler auf Grund eines leeren Tanks" VAL_BLK 0x810592 ME7_FWB3 0 dez___UW 0.000000 65535.000000 NUMBER 4 /end CHARACTERISTIC
/begin CHARACTERISTIC CDCTES "Codewort CARB: TankentlÅftungssystem" VAL_BLK 0x81059A ME7_FWB3 0 dez___UW 0.000000 65535.000000 NUMBER 4 /end CHARACTERISTIC
/begin CHARACTERISTIC CDCTESF "Codewort CARB: TankentlÅftungssystem Feinleck" VAL_BLK 0x8105A2 ME7_FWB3 0 dez___UW 0.000000 65535.000000 NUMBER 4 /end CHARACTERISTIC
/begin CHARACTERISTIC CDCTESG "Codewort CARB: TankentlÅftungssystem Grobleck" VAL_BLK 0x8105AA ME7_FWB3 0 dez___UW 0.000000 65535.000000 NUMBER 4 /end CHARACTERISTIC
/begin CHARACTERISTIC CDCTEVE "Codewort CARB:	TankentlÅftungsventil Endstufe" VAL_BLK 0x8105B2 ME7_FWB3 0 dez___UW 0.000000 65535.000000 NUMBER 4 /end CHARACTERISTIC
/begin CHARACTERISTIC CDCTEVE2 "Codewort CARB:	TankentlÅftungsventil Endstufe  Bank2" VAL_BLK 0x8105BA ME7_FWB3 0 dez___UW 0.000000 65535.000000 NUMBER 4 /end CHARACTERISTIC
/begin CHARACTERISTIC CDCTM "Codewort CARB: Motortemperatur TMOT" VAL_BLK 0x8105C2 ME7_FWB3 0 dez___UW 0.000000 65535.000000 NUMBER 4 /end CHARACTERISTIC
/begin CHARACTERISTIC CDCTOL "Codewort CARB: ôltemperatur" VAL_BLK 0x8105CA ME7_FWB3 0 dez___UW 0.000000 65535.000000 NUMBER 4 /end CHARACTERISTIC
/begin CHARACTERISTIC CDCTUM "Codewort CARB: Umgebungs(-luft)-Temperatur TUM" VAL_BLK 0x8105D2 ME7_FWB3 0 dez___UW 0.000000 65535.000000 NUMBER 4 /end CHARACTERISTIC
/begin CHARACTERISTIC CDCTUN "Codewort CARB: Tuningschutz" VAL_BLK 0x8105DA ME7_FWB3 0 dez___UW 0.000000 65535.000000 NUMBER 4 /end CHARACTERISTIC
/begin CHARACTERISTIC CDCUB "Codewort CARB: Batteriespannung UB (Bordnetz)" VAL_BLK 0x8105E2 ME7_FWB3 0 dez___UW 0.000000 65535.000000 NUMBER 4 /end CHARACTERISTIC
/begin CHARACTERISTIC CDCUFMV "Codewort CARB: FunktionsÅberwachung: Momentenvergleich" VAL_BLK 0x8105EA ME7_FWB3 0 dez___UW 0.000000 65535.000000 NUMBER 4 /end CHARACTERISTIC
/begin CHARACTERISTIC CDCUFSKA "Codewort CARB: FunktionsÅberwachung: Sicherheits-Kraftstoff-Abschaltung" VAL_BLK 0x8105F2 ME7_FWB3 0 dez___UW 0.000000 65535.000000 NUMBER 4 /end CHARACTERISTIC
/begin CHARACTERISTIC CDCURRAM "Codewort CARB: RechnerÅberwachung: RAM" VAL_BLK 0x8105FA ME7_FWB3 0 dez___UW 0.000000 65535.000000 NUMBER 4 /end CHARACTERISTIC
/begin CHARACTERISTIC CDCURROM "Codewort CARB: RechnerÅberwachung: ROM" VAL_BLK 0x810602 ME7_FWB3 0 dez___UW 0.000000 65535.000000 NUMBER 4 /end CHARACTERISTIC
/begin CHARACTERISTIC CDCURRST "Codewort CARB: RechnerÅberwachung: Reset" VAL_BLK 0x81060A ME7_FWB3 0 dez___UW 0.000000 65535.000000 NUMBER 4 /end CHARACTERISTIC
/begin CHARACTERISTIC CDCUVSE "Codewort CARB: Umluftventil-Steuerung Endstufe" VAL_BLK 0x810612 ME7_FWB3 0 dez___UW 0.000000 65535.000000 NUMBER 4 /end CHARACTERISTIC
/begin CHARACTERISTIC CDCVFZ "Codewort CARB: Fahrzeug-Geschwindigkeit" VAL_BLK 0x81061A ME7_FWB3 0 dez___UW 0.000000 65535.000000 NUMBER 4 /end CHARACTERISTIC
/begin CHARACTERISTIC CDCWFS "Codewort CARB: Wegfahrsperre" VAL_BLK 0x810622 ME7_FWB3 0 dez___UW 0.000000 65535.000000 NUMBER 4 /end CHARACTERISTIC
/begin CHARACTERISTIC CDCWFSRC "" VAL_BLK 0x81062A ME7_FWB3 0 dez___UW 0.000000 65535.000000 NUMBER 4 /end CHARACTERISTIC
/begin CHARACTERISTIC CDCZET1 "" VAL_BLK 0x810632 ME7_FWB3 0 dez___UW 0.000000 65535.000000 NUMBER 4 /end CHARACTERISTIC
/begin CHARACTERISTIC CDCZET2 "" VAL_BLK 0x81063A ME7_FWB3 0 dez___UW 0.000000 65535.000000 NUMBER 4 /end CHARACTERISTIC
/begin CHARACTERISTIC CDCZET3 "" VAL_BLK 0x810642 ME7_FWB3 0 dez___UW 0.000000 65535.000000 NUMBER 4 /end CHARACTERISTIC
/begin CHARACTERISTIC CDCZET4 "" VAL_BLK 0x81064A ME7_FWB3 0 dez___UW 0.000000 65535.000000 NUMBER 4 /end CHARACTERISTIC
/begin CHARACTERISTIC CDCZET5 "" VAL_BLK 0x810652 ME7_FWB3 0 dez___UW 0.000000 65535.000000 NUMBER 4 /end CHARACTERISTIC
/begin CHARACTERISTIC CDCZET6 "" VAL_BLK 0x81065A ME7_FWB3 0 dez___UW 0.000000 65535.000000 NUMBER 4 /end CHARACTERISTIC
/begin CHARACTERISTIC CDCZET7 "" VAL_BLK 0x810662 ME7_FWB3 0 dez___UW 0.000000 65535.000000 NUMBER 4 /end CHARACTERISTIC
/begin CHARACTERISTIC CDCZET8 "" VAL_BLK 0x81066A ME7_FWB3 0 dez___UW 0.000000 65535.000000 NUMBER 4 /end CHARACTERISTIC
/begin CHARACTERISTIC CDCZZZ "Dummy: Tabellenende" VAL_BLK 0x810672 ME7_FWB3 0 dez___UW 0.000000 65535.000000 NUMBER 4 /end CHARACTERISTIC
/begin CHARACTERISTIC CDDST "Codewort Tankdrucksensor-Diagnose abschalten (EURO-Codierung)" VALUE 0x814304 ME7_FW1 0 dez 0.000000 255.000000 /end CHARACTERISTIC
/begin CHARACTERISTIC CDFO "Codewort zum Ausschalten und RÅcksetzen der Adaption" VALUE 0x8144FB ME7_FW1 0 dez 0.000000 255.000000 /end CHARACTERISTIC
/begin CHARACTERISTIC CDHSH "Codewort Heizerdiagnose hinter Kat (CDHSH = 0  => keine Diagnose)" VALUE 0x814305 ME7_FW1 0 dez 0.000000 255.000000 /end CHARACTERISTIC
/begin CHARACTERISTIC CDHSHE "Eurobit fÅr Diagnose Entstufe Lambdasondenheizung hinter Kat" VALUE 0x814306 ME7_FW1 0 dez 0.000000 255.000000 /end CHARACTERISTIC
/begin CHARACTERISTIC CDHSV "Codewort Heizerdiagnose vor Kat im (CDHSV = 0  => keine Diagnose)" VALUE 0x814307 ME7_FW1 0 dez 0.000000 255.000000 /end CHARACTERISTIC
/begin CHARACTERISTIC CDHSVE "Codewort DHLSE Heizer Endstufe diagnose vor Kat" VALUE 0x814308 ME7_FW1 0 dez 0.000000 255.000000 /end CHARACTERISTIC
/begin CHARACTERISTIC CDKAAA "Dummy: Tabellenanfang" VALUE 0x81067A ME7_FW3 0 dez___UW 0.000000 65535.000000 /end CHARACTERISTIC
/begin CHARACTERISTIC CDKAAVE "Codewort Kunde: Absperrventil Aktivkohlefilter (Endstufe)" VALUE 0x81067C ME7_FW3 0 dez___UW 0.000000 65535.000000 /end CHARACTERISTIC
/begin CHARACTERISTIC CDKAGRE "Codewort Kunde: öberwachung AGR-Endstufe" VALUE 0x81067E ME7_FW3 0 dez___UW 0.000000 65535.000000 /end CHARACTERISTIC
/begin CHARACTERISTIC CDKAGRF "Codewort Kunde: öberwachung AGR-FLOW" VALUE 0x810680 ME7_FW3 0 dez___UW 0.000000 65535.000000 /end CHARACTERISTIC
/begin CHARACTERISTIC CDKAT "Codewort Katalysator-Diagnose im OBDII-Mode (invers: Europa-Mode)" VALUE 0x814309 ME7_FW1 0 dez 0.000000 255.000000 /end CHARACTERISTIC
/begin CHARACTERISTIC CDKATLK "Codewort fÅr B_lrka aktiv" VALUE 0x8184D2 ME7_FW1 0 dez 0.000000 255.000000 /end CHARACTERISTIC
/begin CHARACTERISTIC CDKBM "Codewort Kunde: Bezugsmarkengeber" VALUE 0x810682 ME7_FW3 0 dez___UW 0.000000 65535.000000 /end CHARACTERISTIC
/begin CHARACTERISTIC CDKBREMS "Codewort Kunde: BREMS (Bremsschalter)" VALUE 0x810684 ME7_FW3 0 dez___UW 0.000000 65535.000000 /end CHARACTERISTIC
/begin CHARACTERISTIC CDKBWF "Codewort Kunde: PWG Bewegung" VALUE 0x810686 ME7_FW3 0 dez___UW 0.000000 65535.000000 /end CHARACTERISTIC
/begin CHARACTERISTIC CDKCADR "Codewort Kunde: CAN- Timeout ADR" VALUE 0x810688 ME7_FW3 0 dez___UW 0.000000 65535.000000 /end CHARACTERISTIC
/begin CHARACTERISTIC CDKCAS "Codewort Kunde: CAN-Schnittstelle, Timeout ASC" VALUE 0x81068A ME7_FW3 0 dez___UW 0.000000 65535.000000 /end CHARACTERISTIC
/begin CHARACTERISTIC CDKCAT "Codewort Kunde: CAN-Schnittstelle, Timeout ASR" VALUE 0x81068C ME7_FW3 0 dez___UW 0.000000 65535.000000 /end CHARACTERISTIC
/begin CHARACTERISTIC CDKCGE "Codewort Kunde: CAN-Schnittstelle, Timeout EGS" VALUE 0x81068E ME7_FW3 0 dez___UW 0.000000 65535.000000 /end CHARACTERISTIC
/begin CHARACTERISTIC CDKCIF "Codewort Kunde: CAN-Schnittstelle, interner Fehler" VALUE 0x810690 ME7_FW3 0 dez___UW 0.000000 65535.000000 /end CHARACTERISTIC
/begin CHARACTERISTIC CDKCINS "Codewort Kunde: CAN- timeout, Instrumente" VALUE 0x810692 ME7_FW3 0 dez___UW 0.000000 65535.000000 /end CHARACTERISTIC
/begin CHARACTERISTIC CDKCLWS "Codewort Kunde: CAN-Schnittstelle, Timeout Botschaft Lenkwinkelsensor" VALUE 0x810694 ME7_FW3 0 dez___UW 0.000000 65535.000000 /end CHARACTERISTIC
/begin CHARACTERISTIC CDKDK "Codewort Kunde: DK - Potentiometer" VALUE 0x810696 ME7_FW3 0 dez___UW 0.000000 65535.000000 /end CHARACTERISTIC
/begin CHARACTERISTIC CDKDK1P "Codewort Kunde: Drosselklappe 1. Poti" VALUE 0x810698 ME7_FW3 0 dez___UW 0.000000 65535.000000 /end CHARACTERISTIC
/begin CHARACTERISTIC CDKDK2P "Codewort Kunde: Drosselklappenpotentiometer 2" VALUE 0x81069A ME7_FW3 0 dez___UW 0.000000 65535.000000 /end CHARACTERISTIC
/begin CHARACTERISTIC CDKDPL "Codewort Kunde: Dauerplus" VALUE 0x81069C ME7_FW3 0 dez___UW 0.000000 65535.000000 /end CHARACTERISTIC
/begin CHARACTERISTIC CDKDSL "Codewort Kunde: Drucksensor Ladedruck" VALUE 0x81069E ME7_FW3 0 dez___UW 0.000000 65535.000000 /end CHARACTERISTIC
/begin CHARACTERISTIC CDKDSS "Codewort Kunde: Saugrohr-Drucksensor" VALUE 0x8106A0 ME7_FW3 0 dez___UW 0.000000 65535.000000 /end CHARACTERISTIC
/begin CHARACTERISTIC CDKDSU "Codewort Kunde: Drucksensor Umgebung" VALUE 0x8106A2 ME7_FW3 0 dez___UW 0.000000 65535.000000 /end CHARACTERISTIC
/begin CHARACTERISTIC CDKDSVLU "" VALUE 0x8106A4 ME7_FW3 0 dez___UW 0.000000 65535.000000 /end CHARACTERISTIC
/begin CHARACTERISTIC CDKDVEE "Codewort Kunde: DV-E Endstufe" VALUE 0x8106A6 ME7_FW3 0 dez___UW 0.000000 65535.000000 /end CHARACTERISTIC
/begin CHARACTERISTIC CDKDVEF "Codewort Kunde: DV-E Fehler bei FederprÅfung" VALUE 0x8106A8 ME7_FW3 0 dez___UW 0.000000 65535.000000 /end CHARACTERISTIC
/begin CHARACTERISTIC CDKDVEFO "" VALUE 0x8106AA ME7_FW3 0 dez___UW 0.000000 65535.000000 /end CHARACTERISTIC
/begin CHARACTERISTIC CDKDVEL "Codewort Kunde: DV-E Lageabweichung" VALUE 0x8106AC ME7_FW3 0 dez___UW 0.000000 65535.000000 /end CHARACTERISTIC
/begin CHARACTERISTIC CDKDVEN "Codewort Kunde: DV-E Fehler bei PrÅfung Notlufposition" VALUE 0x8106AE ME7_FW3 0 dez___UW 0.000000 65535.000000 /end CHARACTERISTIC
/begin CHARACTERISTIC CDKDVER "Codewort Kunde: DV-E Regelbereich" VALUE 0x8106B0 ME7_FW3 0 dez___UW 0.000000 65535.000000 /end CHARACTERISTIC
/begin CHARACTERISTIC CDKDVET "" VALUE 0x8106B2 ME7_FW3 0 dez___UW 0.000000 65535.000000 /end CHARACTERISTIC
/begin CHARACTERISTIC CDKDVEU "Codewort Kunde: DV-E Fehler beim UMA-Lernen" VALUE 0x8106B4 ME7_FW3 0 dez___UW 0.000000 65535.000000 /end CHARACTERISTIC
/begin CHARACTERISTIC CDKDVEUB "" VALUE 0x8106B6 ME7_FW3 0 dez___UW 0.000000 65535.000000 /end CHARACTERISTIC
/begin CHARACTERISTIC CDKDVEUW "" VALUE 0x8106B8 ME7_FW3 0 dez___UW 0.000000 65535.000000 /end CHARACTERISTIC
/begin CHARACTERISTIC CDKDVEV "Codewort Kunde: DV-E Fehler bei VerstÑrkerabgleich" VALUE 0x8106BA ME7_FW3 0 dez___UW 0.000000 65535.000000 /end CHARACTERISTIC
/begin CHARACTERISTIC CDKEGFE "" VALUE 0x8106BC ME7_FW3 0 dez___UW 0.000000 65535.000000 /end CHARACTERISTIC
/begin CHARACTERISTIC CDKEPCLE "Codewort Kunde: Fahrverhaltens- Fehlerlampe ( Endstufe )" VALUE 0x8106BE ME7_FW3 0 dez___UW 0.000000 65535.000000 /end CHARACTERISTIC
/begin CHARACTERISTIC CDKETSE "Codewort Kunde: Elektrisches Thermostat Endstufe" VALUE 0x8106C0 ME7_FW3 0 dez___UW 0.000000 65535.000000 /end CHARACTERISTIC
/begin CHARACTERISTIC CDKEV1 "Codewort Kunde: EV von Zyl. 1" VALUE 0x8106C2 ME7_FW3 0 dez___UW 0.000000 65535.000000 /end CHARACTERISTIC
/begin CHARACTERISTIC CDKEV2 "Codewort Kunde: EV von Zyl. 2" VALUE 0x8106C4 ME7_FW3 0 dez___UW 0.000000 65535.000000 /end CHARACTERISTIC
/begin CHARACTERISTIC CDKEV3 "Codewort Kunde: EV von Zyl. 3" VALUE 0x8106C6 ME7_FW3 0 dez___UW 0.000000 65535.000000 /end CHARACTERISTIC
/begin CHARACTERISTIC CDKEV4 "Codewort Kunde: EV von Zyl. 4" VALUE 0x8106C8 ME7_FW3 0 dez___UW 0.000000 65535.000000 /end CHARACTERISTIC
/begin CHARACTERISTIC CDKEV5 "Codewort Kunde: EV von Zyl. 5" VALUE 0x8106CA ME7_FW3 0 dez___UW 0.000000 65535.000000 /end CHARACTERISTIC
/begin CHARACTERISTIC CDKEV6 "Codewort Kunde: EV von Zyl. 6" VALUE 0x8106CC ME7_FW3 0 dez___UW 0.000000 65535.000000 /end CHARACTERISTIC
/begin CHARACTERISTIC CDKEV7 "Codewort Kunde: EV von Zyl. 7" VALUE 0x8106CE ME7_FW3 0 dez___UW 0.000000 65535.000000 /end CHARACTERISTIC
/begin CHARACTERISTIC CDKEV8 "Codewort Kunde: EV von Zyl. 8" VALUE 0x8106D0 ME7_FW3 0 dez___UW 0.000000 65535.000000 /end CHARACTERISTIC
/begin CHARACTERISTIC CDKFP1P "Codewort Kunde: Poti 1, Fahrpedal" VALUE 0x8106D2 ME7_FW3 0 dez___UW 0.000000 65535.000000 /end CHARACTERISTIC
/begin CHARACTERISTIC CDKFP2P "Codewort Kunde: Poti 2, Fahrpedal" VALUE 0x8106D4 ME7_FW3 0 dez___UW 0.000000 65535.000000 /end CHARACTERISTIC
/begin CHARACTERISTIC CDKFPP "Codewort Kunde: Poti Fahrpedal" VALUE 0x8106D6 ME7_FW3 0 dez___UW 0.000000 65535.000000 /end CHARACTERISTIC
/begin CHARACTERISTIC CDKFRAO "Codewort Kunde: LR- Adaption multi. obere Schwelle" VALUE 0x8106D8 ME7_FW3 0 dez___UW 0.000000 65535.000000 /end CHARACTERISTIC
/begin CHARACTERISTIC CDKFRAU "Codewort Kunde: LR- Adaption multi. untere Schwelle" VALUE 0x8106DA ME7_FW3 0 dez___UW 0.000000 65535.000000 /end CHARACTERISTIC
/begin CHARACTERISTIC CDKFRST "Codewort Kunde: LR- Abweichung" VALUE 0x8106DC ME7_FW3 0 dez___UW 0.000000 65535.000000 /end CHARACTERISTIC
/begin CHARACTERISTIC CDKGECOD "" VALUE 0x8106DE ME7_FW3 0 dez___UW 0.000000 65535.000000 /end CHARACTERISTIC
/begin CHARACTERISTIC CDKGRBH "Codewort Kunde: GRA Bedienhebelfehler" VALUE 0x8106E0 ME7_FW3 0 dez___UW 0.000000 65535.000000 /end CHARACTERISTIC
/begin CHARACTERISTIC CDKHSH "Codewort Kunde:	Lambdasonden-Heizung hinter Katalysator" VALUE 0x8106E2 ME7_FW3 0 dez___UW 0.000000 65535.000000 /end CHARACTERISTIC
/begin CHARACTERISTIC CDKHSHE "Codewort Kunde: Endstufe Heizung Sonde hinter Kat." VALUE 0x8106E4 ME7_FW3 0 dez___UW 0.000000 65535.000000 /end CHARACTERISTIC
/begin CHARACTERISTIC CDKHSHE2 "Codewort Kunde: Enstufe Heizung Sonde Hinter Kat. Bank 2" VALUE 0x8106E6 ME7_FW3 0 dez___UW 0.000000 65535.000000 /end CHARACTERISTIC
/begin CHARACTERISTIC CDKHSV "Codewort Kunde: Lambdasonden-Heizung vor Katalysator" VALUE 0x8106E8 ME7_FW3 0 dez___UW 0.000000 65535.000000 /end CHARACTERISTIC
/begin CHARACTERISTIC CDKHSV2 "Codewort Kunde:	Lambdasonden-Heizung vor Katalysator, Bank 2" VALUE 0x8106EA ME7_FW3 0 dez___UW 0.000000 65535.000000 /end CHARACTERISTIC
/begin CHARACTERISTIC CDKKAT "Codewort Kunde:	Katalysator-Konvertierung" VALUE 0x8106EC ME7_FW3 0 dez___UW 0.000000 65535.000000 /end CHARACTERISTIC
/begin CHARACTERISTIC CDKKPE "Codewort Kunde: EKP-Relais Endstufe" VALUE 0x8106EE ME7_FW3 0 dez___UW 0.000000 65535.000000 /end CHARACTERISTIC
/begin CHARACTERISTIC CDKKRA01 "Codewort Kunde: Klopfregelanschlag Zylinder 1" VALUE 0x8106F0 ME7_FW3 0 dez___UW 0.000000 65535.000000 /end CHARACTERISTIC
/begin CHARACTERISTIC CDKKRA02 "Codewort Kunde: Klopfregelanschlag Zylinder 2" VALUE 0x8106F2 ME7_FW3 0 dez___UW 0.000000 65535.000000 /end CHARACTERISTIC
/begin CHARACTERISTIC CDKKRA03 "Codewort Kunde: Klopfregelanschlag Zylinder 3" VALUE 0x8106F4 ME7_FW3 0 dez___UW 0.000000 65535.000000 /end CHARACTERISTIC
/begin CHARACTERISTIC CDKKRA04 "Codewort Kunde: Klopfregelanschlag Zylinder 4" VALUE 0x8106F6 ME7_FW3 0 dez___UW 0.000000 65535.000000 /end CHARACTERISTIC
/begin CHARACTERISTIC CDKKRA05 "Codewort Kunde: Klopfregelanschlag Zylinder 5" VALUE 0x8106F8 ME7_FW3 0 dez___UW 0.000000 65535.000000 /end CHARACTERISTIC
/begin CHARACTERISTIC CDKKRA06 "Codewort Kunde: Klopfregelanschlag Zylinder 6" VALUE 0x8106FA ME7_FW3 0 dez___UW 0.000000 65535.000000 /end CHARACTERISTIC
/begin CHARACTERISTIC CDKKRA07 "Codewort Kunde: Klopfregelanschlag Zylinder 7" VALUE 0x8106FC ME7_FW3 0 dez___UW 0.000000 65535.000000 /end CHARACTERISTIC
/begin CHARACTERISTIC CDKKRA08 "Codewort Kunde: Klopfregelanschlag Zylinder 8" VALUE 0x8106FE ME7_FW3 0 dez___UW 0.000000 65535.000000 /end CHARACTERISTIC
/begin CHARACTERISTIC CDKKRNT "Codewort Kunde:	Klopfregelung Nulltest" VALUE 0x810700 ME7_FW3 0 dez___UW 0.000000 65535.000000 /end CHARACTERISTIC
/begin CHARACTERISTIC CDKKROF "Codewort Kunde:	Klopfregelung Offset" VALUE 0x810702 ME7_FW3 0 dez___UW 0.000000 65535.000000 /end CHARACTERISTIC
/begin CHARACTERISTIC CDKKRTP "Codewort Kunde: Klopfregelung Testimpuls" VALUE 0x810704 ME7_FW3 0 dez___UW 0.000000 65535.000000 /end CHARACTERISTIC
/begin CHARACTERISTIC CDKKS1 "Codewort Kunde:	Klopfsensor 1" VALUE 0x810706 ME7_FW3 0 dez___UW 0.000000 65535.000000 /end CHARACTERISTIC
/begin CHARACTERISTIC CDKKS2 "Codewort Kunde:	Klopfsensor 2" VALUE 0x810708 ME7_FW3 0 dez___UW 0.000000 65535.000000 /end CHARACTERISTIC
/begin CHARACTERISTIC CDKKS3 "Codewort Kunde:	Klopfsensor 3" VALUE 0x81070A ME7_FW3 0 dez___UW 0.000000 65535.000000 /end CHARACTERISTIC
/begin CHARACTERISTIC CDKKS4 "Codewort Kunde:	Klopfsensor 4" VALUE 0x81070C ME7_FW3 0 dez___UW 0.000000 65535.000000 /end CHARACTERISTIC
/begin CHARACTERISTIC CDKKUPPL "Codewort Kunde: Pedalwertgeber Kupplung" VALUE 0x81070E ME7_FW3 0 dez___UW 0.000000 65535.000000 /end CHARACTERISTIC
/begin CHARACTERISTIC CDKLASH "Codewort Kunde:	Lambda-Sondenalterung hinter Kat." VALUE 0x810710 ME7_FW3 0 dez___UW 0.000000 65535.000000 /end CHARACTERISTIC
/begin CHARACTERISTIC CDKLASH2 "Codewort Kunde:	Lambda-Sondenalterung hinter Kat. (Bank 2)" VALUE 0x810712 ME7_FW3 0 dez___UW 0.000000 65535.000000 /end CHARACTERISTIC
/begin CHARACTERISTIC CDKLATP "Codewort Kunde:	Lambda-Sondenalterung TP" VALUE 0x810714 ME7_FW3 0 dez___UW 0.000000 65535.000000 /end CHARACTERISTIC
/begin CHARACTERISTIC CDKLATP2 "Codewort Kunde:	Lambda-Sondenalterung TP (Bank 2)" VALUE 0x810716 ME7_FW3 0 dez___UW 0.000000 65535.000000 /end CHARACTERISTIC
/begin CHARACTERISTIC CDKLATV "Codewort Kunde:	Lambda-Sondenalterung TV" VALUE 0x810718 ME7_FW3 0 dez___UW 0.000000 65535.000000 /end CHARACTERISTIC
/begin CHARACTERISTIC CDKLATV2 "Codewort Kunde:	Lambda-Sondenalterung TV (Bank 2)" VALUE 0x81071A ME7_FW3 0 dez___UW 0.000000 65535.000000 /end CHARACTERISTIC
/begin CHARACTERISTIC CDKLDE "Codeword Kunde: Ladedrucksteuerventil (Endstufe)" VALUE 0x81071C ME7_FW3 0 dez___UW 0.000000 65535.000000 /end CHARACTERISTIC
/begin CHARACTERISTIC CDKLDO "Codewort Kunde:	Ladedruckkennlinie; oberer Wert Åberschritten" VALUE 0x81071E ME7_FW3 0 dez___UW 0.000000 65535.000000 /end CHARACTERISTIC
/begin CHARACTERISTIC CDKLDP "Codewort Kunde: Leckdiagnosepumpe" VALUE 0x810720 ME7_FW3 0 dez___UW 0.000000 65535.000000 /end CHARACTERISTIC
/begin CHARACTERISTIC CDKLDPE "Codewort Kunde: Leckdiagnosepumpe Endstufe" VALUE 0x810722 ME7_FW3 0 dez___UW 0.000000 65535.000000 /end CHARACTERISTIC
/begin CHARACTERISTIC CDKLDRA "Codewort Kunde:	Ladedruckregelabweichung" VALUE 0x810724 ME7_FW3 0 dez___UW 0.000000 65535.000000 /end CHARACTERISTIC
/begin CHARACTERISTIC CDKLLR "Codewort Kunde: Leerlaufregelung am Anschlag" VALUE 0x810726 ME7_FW3 0 dez___UW 0.000000 65535.000000 /end CHARACTERISTIC
/begin CHARACTERISTIC CDKLM "Codewort Kunde:	LMM/HLM/HFM" VALUE 0x810728 ME7_FW3 0 dez___UW 0.000000 65535.000000 /end CHARACTERISTIC
/begin CHARACTERISTIC CDKLSH "Codewort Kunde:	Lambda-Sonde hinter Kat" VALUE 0x81072A ME7_FW3 0 dez___UW 0.000000 65535.000000 /end CHARACTERISTIC
/begin CHARACTERISTIC CDKLSV "Codewort Kunde:	Lambda-Sonde vor Kat" VALUE 0x81072C ME7_FW3 0 dez___UW 0.000000 65535.000000 /end CHARACTERISTIC
/begin CHARACTERISTIC CDKMD "Codewort Kunde: Aussetzer, Summenfehler (multiple)" VALUE 0x81072E ME7_FW3 0 dez___UW 0.000000 65535.000000 /end CHARACTERISTIC
/begin CHARACTERISTIC CDKMD01 "Codewort Kunde: Aussetzer Zyl. 1" VALUE 0x810730 ME7_FW3 0 dez___UW 0.000000 65535.000000 /end CHARACTERISTIC
/begin CHARACTERISTIC CDKMD02 "Codewort Kunde: Aussetzer Zylinder 2" VALUE 0x810732 ME7_FW3 0 dez___UW 0.000000 65535.000000 /end CHARACTERISTIC
/begin CHARACTERISTIC CDKMD03 "Codewort Kunde: Aussetzer Zylinder 3" VALUE 0x810734 ME7_FW3 0 dez___UW 0.000000 65535.000000 /end CHARACTERISTIC
/begin CHARACTERISTIC CDKMD04 "Codewort Kunde: Aussetzer Zylinder 4" VALUE 0x810736 ME7_FW3 0 dez___UW 0.000000 65535.000000 /end CHARACTERISTIC
/begin CHARACTERISTIC CDKMDB "Codewort Kunde: Momentbegrenzung Sollmoment" VALUE 0x810738 ME7_FW3 0 dez___UW 0.000000 65535.000000 /end CHARACTERISTIC
/begin CHARACTERISTIC CDKMDK "Codewort Kunde: Aussetzer, Summenfehler - multiple, kundendienstrelevant" VALUE 0x81073A ME7_FW3 0 dez___UW 0.000000 65535.000000 /end CHARACTERISTIC
/begin CHARACTERISTIC CDKMDK01 "Codewort Kunde: Aussetzer, Zylinder 1, kundendienstrelevant" VALUE 0x81073C ME7_FW3 0 dez___UW 0.000000 65535.000000 /end CHARACTERISTIC
/begin CHARACTERISTIC CDKMDK02 "Codewort Kunde: Aussetzer, Zylinder 2, kundendienstrelevant" VALUE 0x81073E ME7_FW3 0 dez___UW 0.000000 65535.000000 /end CHARACTERISTIC
/begin CHARACTERISTIC CDKMDK03 "Codewort Kunde: Aussetzer, Zylinder 3, kundendienstrelevant" VALUE 0x810740 ME7_FW3 0 dez___UW 0.000000 65535.000000 /end CHARACTERISTIC
/begin CHARACTERISTIC CDKMDK04 "Codewort Kunde: Aussetzer, Zylinder 4, kundendienstrelevant" VALUE 0x810742 ME7_FW3 0 dez___UW 0.000000 65535.000000 /end CHARACTERISTIC
/begin CHARACTERISTIC CDKMILE "Codewort Kunde: MIL-Endstufe" VALUE 0x810744 ME7_FW3 0 dez___UW 0.000000 65535.000000 /end CHARACTERISTIC
/begin CHARACTERISTIC CDKN "Codewort Kunde: Drehzahlsignalgeber" VALUE 0x810746 ME7_FW3 0 dez___UW 0.000000 65535.000000 /end CHARACTERISTIC
/begin CHARACTERISTIC CDKNWKW "Codewort Kunde: Zuordnung Nockwelle zu Kurbelwelle" VALUE 0x810748 ME7_FW3 0 dez___UW 0.000000 65535.000000 /end CHARACTERISTIC
/begin CHARACTERISTIC CDKNWKW2 "Codewort Kunde: Zuordnung Nockwelle 2 zu Kurbelwelle" VALUE 0x81074A ME7_FW3 0 dez___UW 0.000000 65535.000000 /end CHARACTERISTIC
/begin CHARACTERISTIC CDKNWS "Codewort Kunde: Nockenwellensteuerung" VALUE 0x81074C ME7_FW3 0 dez___UW 0.000000 65535.000000 /end CHARACTERISTIC
/begin CHARACTERISTIC CDKNWS2 "Codewort Kunde: Nockenwellensteuerung (Bank 2)" VALUE 0x81074E ME7_FW3 0 dez___UW 0.000000 65535.000000 /end CHARACTERISTIC
/begin CHARACTERISTIC CDKNWSE "Codewort Kunde: Nockenwellensteuerungsventil Endstufe" VALUE 0x810750 ME7_FW3 0 dez___UW 0.000000 65535.000000 /end CHARACTERISTIC
/begin CHARACTERISTIC CDKNX "Codewort Kunde:	NMAX - öberschreitung" VALUE 0x810752 ME7_FW3 0 dez___UW 0.000000 65535.000000 /end CHARACTERISTIC
/begin CHARACTERISTIC CDKPH "Codewort Kunde: Phasensensor" VALUE 0x810754 ME7_FW3 0 dez___UW 0.000000 65535.000000 /end CHARACTERISTIC
/begin CHARACTERISTIC CDKPWM "" VALUE 0x810756 ME7_FW3 0 dez___UW 0.000000 65535.000000 /end CHARACTERISTIC
/begin CHARACTERISTIC CDKRKAT "Codewort Kunde: LR- Adaption pro Zeit" VALUE 0x810758 ME7_FW3 0 dez___UW 0.000000 65535.000000 /end CHARACTERISTIC
/begin CHARACTERISTIC CDKRKAZ "Codewort Kunde: LR- Adaption additiv pro ZÅndung" VALUE 0x81075A ME7_FW3 0 dez___UW 0.000000 65535.000000 /end CHARACTERISTIC
/begin CHARACTERISTIC CDKRNT "Codewort: KR-Diagnose Integratorsteigung" VALUE 0x81543C ME7_FW1 0 dez 0.000000 255.000000 /end CHARACTERISTIC
/begin CHARACTERISTIC CDKROF "Codewort: KR-Diagnose Resetwert" VALUE 0x81543D ME7_FW1 0 dez 0.000000 255.000000 /end CHARACTERISTIC
/begin CHARACTERISTIC CDKRTP "Codewort: KR-Diagnose Testimpuls" VALUE 0x815441 ME7_FW1 0 dez 0.000000 255.000000 /end CHARACTERISTIC
/begin CHARACTERISTIC CDKSGEEW "Codewort Kunde: SteuergerÑt defekt (EEPROM WFS-Bereich)" VALUE 0x81075C ME7_FW3 0 dez___UW 0.000000 65535.000000 /end CHARACTERISTIC
/begin CHARACTERISTIC CDKSLPE "Codewort Kunde: SekundÑrluftpumpe  (Endstufe)" VALUE 0x81075E ME7_FW3 0 dez___UW 0.000000 65535.000000 /end CHARACTERISTIC
/begin CHARACTERISTIC CDKSLS "Codewort Kunde: SekundÑrluft-System" VALUE 0x810760 ME7_FW3 0 dez___UW 0.000000 65535.000000 /end CHARACTERISTIC
/begin CHARACTERISTIC CDKSLV "Codewort Kunde:	SekundÑrluftventil" VALUE 0x810762 ME7_FW3 0 dez___UW 0.000000 65535.000000 /end CHARACTERISTIC
/begin CHARACTERISTIC CDKSLVE "Codewort Kunde:	SekundÑrluftventil (Endstufe)" VALUE 0x810764 ME7_FW3 0 dez___UW 0.000000 65535.000000 /end CHARACTERISTIC
/begin CHARACTERISTIC CDKSLWG "Codewort Kunde: Waste- Gate- Ansteurung" VALUE 0x810766 ME7_FW3 0 dez___UW 0.000000 65535.000000 /end CHARACTERISTIC
/begin CHARACTERISTIC CDKSUE "Codewort Kunde: Endstufe Saugrohrumschaltung" VALUE 0x810768 ME7_FW3 0 dez___UW 0.000000 65535.000000 /end CHARACTERISTIC
/begin CHARACTERISTIC CDKSWE "Codewort Kunde:	Beschleunigungssensor der Schlechtwegeerkennung" VALUE 0x81076A ME7_FW3 0 dez___UW 0.000000 65535.000000 /end CHARACTERISTIC
/begin CHARACTERISTIC CDKTA "Codewort Kunde:	TANS" VALUE 0x81076C ME7_FW3 0 dez___UW 0.000000 65535.000000 /end CHARACTERISTIC
/begin CHARACTERISTIC CDKTANKL "Codewort Kunde: OBDII Fehler auf Grund eines leeren Tanks" VALUE 0x81076E ME7_FW3 0 dez___UW 0.000000 65535.000000 /end CHARACTERISTIC
/begin CHARACTERISTIC CDKTES "Codewort Kunde: TankentlÅftungssystem" VALUE 0x810770 ME7_FW3 0 dez___UW 0.000000 65535.000000 /end CHARACTERISTIC
/begin CHARACTERISTIC CDKTESF "Codewort Kunde: TankentlÅftungssystem Feinleck" VALUE 0x810772 ME7_FW3 0 dez___UW 0.000000 65535.000000 /end CHARACTERISTIC
/begin CHARACTERISTIC CDKTESG "Codewort Kunde:	TankentlÅftungssystem Grobleck" VALUE 0x810774 ME7_FW3 0 dez___UW 0.000000 65535.000000 /end CHARACTERISTIC
/begin CHARACTERISTIC CDKTEVE "Codewort Kunde:	TankentlÅftungsventil Endstufe" VALUE 0x810776 ME7_FW3 0 dez___UW 0.000000 65535.000000 /end CHARACTERISTIC
/begin CHARACTERISTIC CDKTEVE2 "Codewort Kunde: TankentlÅftungsventil Endstufe Bank 2" VALUE 0x810778 ME7_FW3 0 dez___UW 0.000000 65535.000000 /end CHARACTERISTIC
/begin CHARACTERISTIC CDKTM "Codewort Kunde:	TMOT" VALUE 0x81077A ME7_FW3 0 dez___UW 0.000000 65535.000000 /end CHARACTERISTIC
/begin CHARACTERISTIC CDKTOL "Codewort Kunde:	ôltemperatur" VALUE 0x81077C ME7_FW3 0 dez___UW 0.000000 65535.000000 /end CHARACTERISTIC
/begin CHARACTERISTIC CDKTUM "Codewort Kunde: Umgebungstemperatur" VALUE 0x81077E ME7_FW3 0 dez___UW 0.000000 65535.000000 /end CHARACTERISTIC
/begin CHARACTERISTIC CDKTUN "Codewort Kunde: Tuningschutz" VALUE 0x810780 ME7_FW3 0 dez___UW 0.000000 65535.000000 /end CHARACTERISTIC
/begin CHARACTERISTIC CDKUB "Codewort Kunde:	UB" VALUE 0x810782 ME7_FW3 0 dez___UW 0.000000 65535.000000 /end CHARACTERISTIC
/begin CHARACTERISTIC CDKUFMV "Codewort Kunde: FunktionsÅberwachung: Momentenvergleich" VALUE 0x810784 ME7_FW3 0 dez___UW 0.000000 65535.000000 /end CHARACTERISTIC
/begin CHARACTERISTIC CDKUFSKA "Codewort Kunde: FunktionsÅberwachung: Sicherheits-Kraftstoff-Abschaltung" VALUE 0x810786 ME7_FW3 0 dez___UW 0.000000 65535.000000 /end CHARACTERISTIC
/begin CHARACTERISTIC CDKURRAM "Codewort Kunde: RechnerÅberwachung: RAM" VALUE 0x810788 ME7_FW3 0 dez___UW 0.000000 65535.000000 /end CHARACTERISTIC
/begin CHARACTERISTIC CDKURROM "Codewort Kunde: RechnerÅberwachung: ROM" VALUE 0x81078A ME7_FW3 0 dez___UW 0.000000 65535.000000 /end CHARACTERISTIC
/begin CHARACTERISTIC CDKURRST "Codewort Kunde: RechnerÅberwachung: Reset" VALUE 0x81078C ME7_FW3 0 dez___UW 0.000000 65535.000000 /end CHARACTERISTIC
/begin CHARACTERISTIC CDKUVSE "Codeword Kunde: Endstufe Umluftventil turbo" VALUE 0x81078E ME7_FW3 0 dez___UW 0.000000 65535.000000 /end CHARACTERISTIC
/begin CHARACTERISTIC CDKVFZ "Codewort Kunde:	Fahrzeug-Geschwindigkeit" VALUE 0x810790 ME7_FW3 0 dez___UW 0.000000 65535.000000 /end CHARACTERISTIC
/begin CHARACTERISTIC CDKVS "Codeword DKVS aktiv/inaktiv, CD..=0 -> keine Diagnose" VALUE 0x81430A ME7_FW1 0 dez 0.000000 255.000000 /end CHARACTERISTIC
/begin CHARACTERISTIC CDKWFS "Codewort Kunde: Wegfahrsperre" VALUE 0x810792 ME7_FW3 0 dez___UW 0.000000 65535.000000 /end CHARACTERISTIC
/begin CHARACTERISTIC CDKWFSRC "" VALUE 0x810794 ME7_FW3 0 dez___UW 0.000000 65535.000000 /end CHARACTERISTIC
/begin CHARACTERISTIC CDKZET1 "" VALUE 0x810796 ME7_FW3 0 dez___UW 0.000000 65535.000000 /end CHARACTERISTIC
/begin CHARACTERISTIC CDKZET2 "" VALUE 0x810798 ME7_FW3 0 dez___UW 0.000000 65535.000000 /end CHARACTERISTIC
/begin CHARACTERISTIC CDKZET3 "" VALUE 0x81079A ME7_FW3 0 dez___UW 0.000000 65535.000000 /end CHARACTERISTIC
/begin CHARACTERISTIC CDKZET4 "" VALUE 0x81079C ME7_FW3 0 dez___UW 0.000000 65535.000000 /end CHARACTERISTIC
/begin CHARACTERISTIC CDKZET5 "" VALUE 0x81079E ME7_FW3 0 dez___UW 0.000000 65535.000000 /end CHARACTERISTIC
/begin CHARACTERISTIC CDKZET6 "" VALUE 0x8107A0 ME7_FW3 0 dez___UW 0.000000 65535.000000 /end CHARACTERISTIC
/begin CHARACTERISTIC CDKZET7 "" VALUE 0x8107A2 ME7_FW3 0 dez___UW 0.000000 65535.000000 /end CHARACTERISTIC
/begin CHARACTERISTIC CDKZET8 "" VALUE 0x8107A4 ME7_FW3 0 dez___UW 0.000000 65535.000000 /end CHARACTERISTIC
/begin CHARACTERISTIC CDKZZZ "Dummy: Tabellenendeng" VALUE 0x8107A6 ME7_FW3 0 dez___UW 0.000000 65535.000000 /end CHARACTERISTIC
/begin CHARACTERISTIC CDLASH "Codewort Lambdasondenalterungsdiagnose (SHK) im OBDII-Mode (invers: Europa-Mode)" VALUE 0x81430B ME7_FW1 0 dez 0.000000 255.000000 /end CHARACTERISTIC
/begin CHARACTERISTIC CDLATP "Codewort Lambdasondenalterungsdiagnose (TP) im OBDII-Mode (invers: Europa-Mode)" VALUE 0x81430C ME7_FW1 0 dez 0.000000 255.000000 /end CHARACTERISTIC
/begin CHARACTERISTIC CDLATV "Codewort Lambdasondenalterungsdiagnose (tv) im OBDII-Mode (invers: Europa-Mode)" VALUE 0x81430D ME7_FW1 0 dez 0.000000 255.000000 /end CHARACTERISTIC
/begin CHARACTERISTIC CDLDP "Codewort LDP-Diagnose im OBDII-Modus (invers: Europa-Modus), CD..=0 -> keine Dia" VALUE 0x81430E ME7_FW1 0 dez 0.000000 255.000000 /end CHARACTERISTIC
/begin CHARACTERISTIC CDLLR "Codewort DLLR abschalten (EURO-Codierung), CD..=0 -> keine Diagnose" VALUE 0x81430F ME7_FW1 0 dez 0.000000 255.000000 /end CHARACTERISTIC
/begin CHARACTERISTIC CDLSA "Codewort Lambdasondenalterungsdiagnose, Konfig.-byte, fÅr Applikationszwecke" VALUE 0x814310 ME7_FW1 0 dez 0.000000 255.000000 /end CHARACTERISTIC
/begin CHARACTERISTIC CDLSH "Codewort Sondendiagnose hinter Kat im OBDII-Mode (invers: Europa-Mode)" VALUE 0x814311 ME7_FW1 0 dez 0.000000 255.000000 /end CHARACTERISTIC
/begin CHARACTERISTIC CDLSV "Codewort Sondendiagnose vor KAT im OBDII-Mode" VALUE 0x814312 ME7_FW1 0 dez 0.000000 255.000000 /end CHARACTERISTIC
/begin CHARACTERISTIC CDMD "Codewort DMD abschalten (EURO-Codierung), CD..=0 -> keine Diagnose" VALUE 0x814313 ME7_FW1 0 dez 0.000000 255.000000 /end CHARACTERISTIC
/begin CHARACTERISTIC CDNWS "Codewort DNWS abschalten (EURO-Codierung), CD..=0 -> keine Diagnose" VALUE 0x814314 ME7_FW1 0 dez 0.000000 255.000000 /end CHARACTERISTIC
/begin CHARACTERISTIC CDSLS "Euro-Byte fÅr Diagnose SekundÑrluft-System" VALUE 0x814315 ME7_FW1 0 dez 0.000000 255.000000 /end CHARACTERISTIC
/begin CHARACTERISTIC CDSLSE "Euro-Byte fÅr Diagnose Endstufe SekundÑrluft-Ventil/Pumpe" VALUE 0x814316 ME7_FW1 0 dez 0.000000 255.000000 /end CHARACTERISTIC
/begin CHARACTERISTIC CDSWE_0_A "Codewort DSWE abschalten (EURO-Codierung), CD..=0 -> keine Diagnose" VALUE 0x8164CE ME7_FW1 0 dez 0.000000 255.000000 /end CHARACTERISTIC
/begin CHARACTERISTIC CDSWE_1_A "Codewort DSWE abschalten (EURO-Codierung), CD..=0 -> keine Diagnose" VALUE 0x8164CF ME7_FW1 0 dez 0.000000 255.000000 /end CHARACTERISTIC
/begin CHARACTERISTIC CDSWE_2_A "Codewort DSWE abschalten (EURO-Codierung), CD..=0 -> keine Diagnose" VALUE 0x8164D0 ME7_FW1 0 dez 0.000000 255.000000 /end CHARACTERISTIC
/begin CHARACTERISTIC CDSWE_3_A "Codewort DSWE abschalten (EURO-Codierung), CD..=0 -> keine Diagnose" VALUE 0x8164D1 ME7_FW1 0 dez 0.000000 255.000000 /end CHARACTERISTIC
/begin CHARACTERISTIC CDTAAA "" VALUE 0x8107A8 ME7_FW3 0 dez___UW 0.000000 65535.000000 /end CHARACTERISTIC
/begin CHARACTERISTIC CDTAAVE "Codewort Tester: Absperrventil Aktivkohlefilter (Endst.)" VALUE 0x8107AA ME7_FW3 0 dez___UW 0.000000 65535.000000 /end CHARACTERISTIC
/begin CHARACTERISTIC CDTAGRE "Codewort Tester: öberwachung AGR-Endstufe" VALUE 0x8107AC ME7_FW3 0 dez___UW 0.000000 65535.000000 /end CHARACTERISTIC
/begin CHARACTERISTIC CDTAGRF "Codewort Tester: öberwachung AGR-FLOW" VALUE 0x8107AE ME7_FW3 0 dez___UW 0.000000 65535.000000 /end CHARACTERISTIC
/begin CHARACTERISTIC CDTANKL "Codewort DTANKL abschalten (EURO-Codierung), CD..=0 -> keine Diagnose" VALUE 0x814317 ME7_FW1 0 dez 0.000000 255.000000 /end CHARACTERISTIC
/begin CHARACTERISTIC CDTBM "Codewort Tester: Bezugsmarkengeber" VALUE 0x8107B0 ME7_FW3 0 dez___UW 0.000000 65535.000000 /end CHARACTERISTIC
/begin CHARACTERISTIC CDTBREMS "Fehlerpfadcode: BREMS (Bremsschalter)" VALUE 0x8107B2 ME7_FW3 0 dez___UW 0.000000 65535.000000 /end CHARACTERISTIC
/begin CHARACTERISTIC CDTBWF "Codewort Tester: PWG Bewegung" VALUE 0x8107B4 ME7_FW3 0 dez___UW 0.000000 65535.000000 /end CHARACTERISTIC
/begin CHARACTERISTIC CDTCADR "Codewort Tester: CAN- Timeout ADR" VALUE 0x8107B6 ME7_FW3 0 dez___UW 0.000000 65535.000000 /end CHARACTERISTIC
/begin CHARACTERISTIC CDTCAS "Codewort Tester: CAN-Schnittstelle, Timeout ASC" VALUE 0x8107B8 ME7_FW3 0 dez___UW 0.000000 65535.000000 /end CHARACTERISTIC
/begin CHARACTERISTIC CDTCAT "" VALUE 0x8107BA ME7_FW3 0 dez___UW 0.000000 65535.000000 /end CHARACTERISTIC
/begin CHARACTERISTIC CDTCGE "Codewort Tester: CAN-Schnittstelle, Timeout EGS" VALUE 0x8107BC ME7_FW3 0 dez___UW 0.000000 65535.000000 /end CHARACTERISTIC
/begin CHARACTERISTIC CDTCIF "Codewort Tester: CAN-Schnittstelle, interner Fehler" VALUE 0x8107BE ME7_FW3 0 dez___UW 0.000000 65535.000000 /end CHARACTERISTIC
/begin CHARACTERISTIC CDTCINS "Codewort Tester: CAN-Timeout, Instrumente" VALUE 0x8107C0 ME7_FW3 0 dez___UW 0.000000 65535.000000 /end CHARACTERISTIC
/begin CHARACTERISTIC CDTCLWS "" VALUE 0x8107C2 ME7_FW3 0 dez___UW 0.000000 65535.000000 /end CHARACTERISTIC
/begin CHARACTERISTIC CDTDK "Codewort Tester: DK - Potentiometer" VALUE 0x8107C4 ME7_FW3 0 dez___UW 0.000000 65535.000000 /end CHARACTERISTIC
/begin CHARACTERISTIC CDTDK1P "Codewort Tester: Drosselklappe 1. Poti" VALUE 0x8107C6 ME7_FW3 0 dez___UW 0.000000 65535.000000 /end CHARACTERISTIC
/begin CHARACTERISTIC CDTDK2P "Codewort Tester: Drosselklappenpotentiometer 2" VALUE 0x8107C8 ME7_FW3 0 dez___UW 0.000000 65535.000000 /end CHARACTERISTIC
/begin CHARACTERISTIC CDTDPL "Codewort Tester: Dauerplus" VALUE 0x8107CA ME7_FW3 0 dez___UW 0.000000 65535.000000 /end CHARACTERISTIC
/begin CHARACTERISTIC CDTDSL "Codewort Tester: Drucksensor Ladedruck" VALUE 0x8107CC ME7_FW3 0 dez___UW 0.000000 65535.000000 /end CHARACTERISTIC
/begin CHARACTERISTIC CDTDSS "Codewort Tester: Saugrohr-Drucksensor" VALUE 0x8107CE ME7_FW3 0 dez___UW 0.000000 65535.000000 /end CHARACTERISTIC
/begin CHARACTERISTIC CDTDSU "Codewort Tester: Drucksensor Umgebung" VALUE 0x8107D0 ME7_FW3 0 dez___UW 0.000000 65535.000000 /end CHARACTERISTIC
/begin CHARACTERISTIC CDTDSVLU "" VALUE 0x8107D2 ME7_FW3 0 dez___UW 0.000000 65535.000000 /end CHARACTERISTIC
/begin CHARACTERISTIC CDTDVEE "Codewort Tester: DV-E Endstufe" VALUE 0x8107D4 ME7_FW3 0 dez___UW 0.000000 65535.000000 /end CHARACTERISTIC
/begin CHARACTERISTIC CDTDVEF "Codewort Tester: DV-E Fehler bei FederprÅfung" VALUE 0x8107D6 ME7_FW3 0 dez___UW 0.000000 65535.000000 /end CHARACTERISTIC
/begin CHARACTERISTIC CDTDVEFO "" VALUE 0x8107D8 ME7_FW3 0 dez___UW 0.000000 65535.000000 /end CHARACTERISTIC
/begin CHARACTERISTIC CDTDVEL "Codewort Tester: DV-E Lageabweichung" VALUE 0x8107DA ME7_FW3 0 dez___UW 0.000000 65535.000000 /end CHARACTERISTIC
/begin CHARACTERISTIC CDTDVEN "Codewort Tester: DV-E Fehler bei PrÅfung Notlufposition" VALUE 0x8107DC ME7_FW3 0 dez___UW 0.000000 65535.000000 /end CHARACTERISTIC
/begin CHARACTERISTIC CDTDVER "Codewort Tester: DV-E Regelbereich" VALUE 0x8107DE ME7_FW3 0 dez___UW 0.000000 65535.000000 /end CHARACTERISTIC
/begin CHARACTERISTIC CDTDVET "" VALUE 0x8107E0 ME7_FW3 0 dez___UW 0.000000 65535.000000 /end CHARACTERISTIC
/begin CHARACTERISTIC CDTDVEU "Codewort Tester: DV-E Fehler beim UMA-Lernen" VALUE 0x8107E2 ME7_FW3 0 dez___UW 0.000000 65535.000000 /end CHARACTERISTIC
/begin CHARACTERISTIC CDTDVEUB "" VALUE 0x8107E4 ME7_FW3 0 dez___UW 0.000000 65535.000000 /end CHARACTERISTIC
/begin CHARACTERISTIC CDTDVEUW "" VALUE 0x8107E6 ME7_FW3 0 dez___UW 0.000000 65535.000000 /end CHARACTERISTIC
/begin CHARACTERISTIC CDTDVEV "Codewort Tester: DV-E Fehler bei VerstÑrkerabgleich" VALUE 0x8107E8 ME7_FW3 0 dez___UW 0.000000 65535.000000 /end CHARACTERISTIC
/begin CHARACTERISTIC CDTEGFE "" VALUE 0x8107EA ME7_FW3 0 dez___UW 0.000000 65535.000000 /end CHARACTERISTIC
/begin CHARACTERISTIC CDTEPCLE "Codewort Tester: Fahrverhaltens- Fehllampe ( Endstufe )" VALUE 0x8107EC ME7_FW3 0 dez___UW 0.000000 65535.000000 /end CHARACTERISTIC
/begin CHARACTERISTIC CDTES "Codewort TankentlÅftungsdiagnose abschalten (EURO-Codierung), CD..=0 ->keine Dia" VALUE 0x814318 ME7_FW1 0 dez 0.000000 255.000000 /end CHARACTERISTIC
/begin CHARACTERISTIC CDTETSE "Codewort Tester: Elektrisches Thermostat Endstufe" VALUE 0x8107EE ME7_FW3 0 dez___UW 0.000000 65535.000000 /end CHARACTERISTIC
/begin CHARACTERISTIC CDTEV1 "Codewort Tester: EV von Zyl. 1" VALUE 0x8107F0 ME7_FW3 0 dez___UW 0.000000 65535.000000 /end CHARACTERISTIC
/begin CHARACTERISTIC CDTEV2 "Codewort Tester: EV von Zyl. 2" VALUE 0x8107F2 ME7_FW3 0 dez___UW 0.000000 65535.000000 /end CHARACTERISTIC
/begin CHARACTERISTIC CDTEV3 "Codewort Tester: EV von Zyl. 3" VALUE 0x8107F4 ME7_FW3 0 dez___UW 0.000000 65535.000000 /end CHARACTERISTIC
/begin CHARACTERISTIC CDTEV4 "Codewort Tester: EV von Zyl. 4" VALUE 0x8107F6 ME7_FW3 0 dez___UW 0.000000 65535.000000 /end CHARACTERISTIC
/begin CHARACTERISTIC CDTEV5 "Codewort Tester: EV von Zyl. 5" VALUE 0x8107F8 ME7_FW3 0 dez___UW 0.000000 65535.000000 /end CHARACTERISTIC
/begin CHARACTERISTIC CDTEV6 "Codewort Tester: EV von Zyl. 6" VALUE 0x8107FA ME7_FW3 0 dez___UW 0.000000 65535.000000 /end CHARACTERISTIC
/begin CHARACTERISTIC CDTEV7 "Codewort Tester: EV von Zyl. 7" VALUE 0x8107FC ME7_FW3 0 dez___UW 0.000000 65535.000000 /end CHARACTERISTIC
/begin CHARACTERISTIC CDTEV8 "Codewort Tester: EV von Zyl. 8" VALUE 0x8107FE ME7_FW3 0 dez___UW 0.000000 65535.000000 /end CHARACTERISTIC
/begin CHARACTERISTIC CDTFP1P "Codewort Tester: Poti 1, Fahrpedal" VALUE 0x810800 ME7_FW3 0 dez___UW 0.000000 65535.000000 /end CHARACTERISTIC
/begin CHARACTERISTIC CDTFP2P "Codewort Tester: Poti 2, Fahrpedal" VALUE 0x810802 ME7_FW3 0 dez___UW 0.000000 65535.000000 /end CHARACTERISTIC
/begin CHARACTERISTIC CDTFPP "Codewort Tester: Poti Fahrpedal" VALUE 0x810804 ME7_FW3 0 dez___UW 0.000000 65535.000000 /end CHARACTERISTIC
/begin CHARACTERISTIC CDTFRAO "Codewort Tester: LR-Adaption multiplikativ obere Schwelle" VALUE 0x810806 ME7_FW3 0 dez___UW 0.000000 65535.000000 /end CHARACTERISTIC
/begin CHARACTERISTIC CDTFRAU "Codewort Tester: LR-Adaption multiplikativ untere Schwelle" VALUE 0x810808 ME7_FW3 0 dez___UW 0.000000 65535.000000 /end CHARACTERISTIC
/begin CHARACTERISTIC CDTFRST "Codewort Tester: LR-Abweichung" VALUE 0x81080A ME7_FW3 0 dez___UW 0.000000 65535.000000 /end CHARACTERISTIC
/begin CHARACTERISTIC CDTGECOD "" VALUE 0x81080C ME7_FW3 0 dez___UW 0.000000 65535.000000 /end CHARACTERISTIC
/begin CHARACTERISTIC CDTGRBH "Codewort Tester: GRA Bedienhebel" VALUE 0x81080E ME7_FW3 0 dez___UW 0.000000 65535.000000 /end CHARACTERISTIC
/begin CHARACTERISTIC CDTHSH "Codewort Tester: Lambdasonden-Heizung hinter Katalysator" VALUE 0x810810 ME7_FW3 0 dez___UW 0.000000 65535.000000 /end CHARACTERISTIC
/begin CHARACTERISTIC CDTHSHE "Codewort Tester: Endstufe Lambdasonden-Heizung hinter Katalysator" VALUE 0x810812 ME7_FW3 0 dez___UW 0.000000 65535.000000 /end CHARACTERISTIC
/begin CHARACTERISTIC CDTHSHE2 "Codewort Tester: Endstufe Lambdasonden-Heizung2 hinter Katalysator" VALUE 0x810814 ME7_FW3 0 dez___UW 0.000000 65535.000000 /end CHARACTERISTIC
/begin CHARACTERISTIC CDTHSV "Codewort Tester: Lambdasonden-Heizung vor Katalysator" VALUE 0x810816 ME7_FW3 0 dez___UW 0.000000 65535.000000 /end CHARACTERISTIC
/begin CHARACTERISTIC CDTHSV2 "Codewort Tester: Lambdasonden-Heizung vor Kat., Bank 2" VALUE 0x810818 ME7_FW3 0 dez___UW 0.000000 65535.000000 /end CHARACTERISTIC
/begin CHARACTERISTIC CDTKAT "Codewort Tester: Katalysator-Konvertierung" VALUE 0x81081A ME7_FW3 0 dez___UW 0.000000 65535.000000 /end CHARACTERISTIC
/begin CHARACTERISTIC CDTKPE "Codewort Tester: EKP-Relais Endstufe" VALUE 0x81081C ME7_FW3 0 dez___UW 0.000000 65535.000000 /end CHARACTERISTIC
/begin CHARACTERISTIC CDTKRA01 "" VALUE 0x81081E ME7_FW3 0 dez___UW 0.000000 65535.000000 /end CHARACTERISTIC
/begin CHARACTERISTIC CDTKRA02 "" VALUE 0x810820 ME7_FW3 0 dez___UW 0.000000 65535.000000 /end CHARACTERISTIC
/begin CHARACTERISTIC CDTKRA03 "" VALUE 0x810822 ME7_FW3 0 dez___UW 0.000000 65535.000000 /end CHARACTERISTIC
/begin CHARACTERISTIC CDTKRA04 "" VALUE 0x810824 ME7_FW3 0 dez___UW 0.000000 65535.000000 /end CHARACTERISTIC
/begin CHARACTERISTIC CDTKRA05 "" VALUE 0x810826 ME7_FW3 0 dez___UW 0.000000 65535.000000 /end CHARACTERISTIC
/begin CHARACTERISTIC CDTKRA06 "" VALUE 0x810828 ME7_FW3 0 dez___UW 0.000000 65535.000000 /end CHARACTERISTIC
/begin CHARACTERISTIC CDTKRA07 "" VALUE 0x81082A ME7_FW3 0 dez___UW 0.000000 65535.000000 /end CHARACTERISTIC
/begin CHARACTERISTIC CDTKRA08 "" VALUE 0x81082C ME7_FW3 0 dez___UW 0.000000 65535.000000 /end CHARACTERISTIC
/begin CHARACTERISTIC CDTKRNT "Codewort Tester: Klopfregelung Nulltest" VALUE 0x81082E ME7_FW3 0 dez___UW 0.000000 65535.000000 /end CHARACTERISTIC
/begin CHARACTERISTIC CDTKROF "Codewort Tester: Klopfregelung Offset" VALUE 0x810830 ME7_FW3 0 dez___UW 0.000000 65535.000000 /end CHARACTERISTIC
/begin RECORD_LAYOUT ME7_SST97 NO_AXIS_PTS_X 1 UBYTE AXIS_PTS_X 2 UBYTE INDEX_INCR DIRECT /end RECORD_LAYOUT
/begin RECORD_LAYOUT ME7_SST109 NO_AXIS_PTS_X 1 UWORD AXIS_PTS_X 2 UWORD INDEX_INCR DIRECT /end RECORD_LAYOUT
/begin AXIS_PTS SNM08DMUB "SST-Verteilung in DMD, 8 Drehzahl-SST" 0x81439B nmot ME7_SST97 0 nmot_ub_q40 8 0.000000 10200.000000 DEPOSIT ABSOLUTE EXTENDED_LIMITS 0.000000 182.041667 /end AXIS_PTS
/begin AXIS_PTS SNM16KRUB "StÅtzstellenverteilung Drehzahl, 16 Sst." 0x818242 nmot ME7_SST97 0 nmot_ub_q40 16 0.000000 10200.000000 DEPOSIT ABSOLUTE EXTENDED_LIMITS 0.000000 182.041667 /end AXIS_PTS
/begin AXIS_PTS STS06TMUW "" 0x81ACF6 tabstatm_w ME7_SST109 0 t1sxs_uw_q1 6 0.000000 65535.000000 DEPOSIT ABSOLUTE EXTENDED_LIMITS 0.000000 10200.000000 /end AXIS_PTS
/begin AXIS_PTS STS12ESUB "SST-Verteilung fÅr Motorstarttemperatur" 0x814477 tmst ME7_SST97 0 temp_ub_q0p75_o48 12 -48.000000 143.250000 DEPOSIT ABSOLUTE EXTENDED_LIMITS 0.000000 10200.000000 /end AXIS_PTS
/begin COMPU_METHOD bfzg_sb_q0p217 "" RAT_FUNC "%6.3" "m/s^2" COEFFS 0 1.000000 0.000000 0 0.000000 2.170000e-01 /end COMPU_METHOD
/begin COMPU_METHOD bfzg_ub_b27p67 "" RAT_FUNC "%6.3" "m/s^2" COEFFS 0 256.000000 0.000000 0 0.000000 27.670000 /end COMPU_METHOD
/begin COMPU_METHOD bfzg_uw_q0p1085 "" RAT_FUNC "%6.3" "m/s^2" COEFFS 0 1.000000 0.000000 0 0.000000 1.085000e-01 /end COMPU_METHOD
/begin COMPU_METHOD B_TRUE "boolsche ZustÑnde, positive Logik" TAB_VERB "%6.3" "" COMPU_TAB_REF B_TRUE /end COMPU_METHOD
/begin COMPU_METHOD B_TRUE___UW "boolsche ZustÑnde, positive Logik" TAB_VERB "%6.3" "" COMPU_TAB_REF B_TRUE /end COMPU_METHOD
/begin COMPU_METHOD DEZ "1 : 1 Umrechnug (dez/hex)" RAT_FUNC "%6.2" "" COEFFS 0 1.000000 0.000000 0 0.000000 1.000000 /end COMPU_METHOD
/begin COMPU_METHOD dez "1 : 1 Umrechnug (dez/hex)" RAT_FUNC "%6.2" "" COEFFS 0 1.000000 0.000000 0 0.000000 1.000000 /end COMPU_METHOD
/begin COMPU_METHOD DEZL "Dezimalzahl in 16-Bit-Hexzahl" RAT_FUNC "%6.2" "" COEFFS 0 1.000000 0.000000 0 0.000000 1.000000 /end COMPU_METHOD
/begin COMPU_METHOD dezsub1 "" RAT_FUNC "%6.2" "-" COEFFS 0 1.000000 -1.000000 0 0.000000 1.000000 /end COMPU_METHOD
/begin COMPU_METHOD dez___SW "1 : 1 Umrechnug (dez/hex)" RAT_FUNC "%6.2" "" COEFFS 0 1.000000 0.000000 0 0.000000 1.000000 /end COMPU_METHOD
/begin COMPU_METHOD DEZ___UW "1 : 1 Umrechnug (dez/hex)" RAT_FUNC "%6.2" "" COEFFS 0 1.000000 0.000000 0 0.000000 1.000000 /end COMPU_METHOD
/begin COMPU_METHOD dez___UW "1 : 1 Umrechnug (dez/hex)" RAT_FUNC "%6.2" "" COEFFS 0 1.000000 0.000000 0 0.000000 1.000000 /end COMPU_METHOD
/begin COMPU_METHOD dtsegn_b720divZyl___UW "" RAT_FUNC "%6.4" "grad/KW" COEFFS 0 182.044000 0.000000 0 0.000000 1.000000 /end COMPU_METHOD
/begin COMPU_METHOD fak_sw_b0p0625 "" RAT_FUNC "%8.7" "-" COEFFS 0 6.553600e+04 0.000000 0 0.000000 1.250000e-01 /end COMPU_METHOD
/begin COMPU_METHOD fak_sw_b2 "" RAT_FUNC "%7.6" "-" COEFFS 0 6.553600e+04 0.000000 0 0.000000 4.000000 /end COMPU_METHOD
/begin COMPU_METHOD fak_ub_b1 "" RAT_FUNC "%6.4" "-" COEFFS 0 256.000000 0.000000 0 0.000000 1.000000 /end COMPU_METHOD
/begin COMPU_METHOD fak_ub_b16___SB "" RAT_FUNC "%6.4" "-" COEFFS 0 256.000000 0.000000 0 0.000000 16.000000 /end COMPU_METHOD
/begin COMPU_METHOD fak_ub_b1p25_o0p75 "" RAT_FUNC "%6.3" "-" COEFFS 0 1.000000 -7.500000e-01 0 0.000000 1.953130e-03 /end COMPU_METHOD
/begin COMPU_METHOD fak_ub_b2 "" RAT_FUNC "%6.4" "-" COEFFS 0 256.000000 0.000000 0 0.000000 2.000000 /end COMPU_METHOD
/begin COMPU_METHOD fak_ub_b8 "" RAT_FUNC "%6.4" "-" COEFFS 0 256.000000 0.000000 0 0.000000 8.000000 /end COMPU_METHOD
/begin COMPU_METHOD fak_uw_q0p001 "" RAT_FUNC "%6.4" "" COEFFS 0 6.553600e+04 0.000000 0 0.000000 65.536000 /end COMPU_METHOD
/begin COMPU_METHOD kw_q0p0039___UW "" RAT_FUNC "%6.4" "∞KW" COEFFS 0 256.000000 0.000000 0 0.000000 1.000000 /end COMPU_METHOD
/begin COMPU_METHOD kw_q0p0156___UW "" RAT_FUNC "%6.4" "∞KW" COEFFS 0 64.000000 0.000000 0 0.000000 1.000000 /end COMPU_METHOD
/begin COMPU_METHOD kw_sw_b128 "" RAT_FUNC "%6.4" "∞KW" COEFFS 0 6.553600e+04 0.000000 0 0.000000 256.000000 /end COMPU_METHOD
/begin COMPU_METHOD kw_ub_q0p5 "" RAT_FUNC "%6.3" "∞KW" COEFFS 0 256.000000 0.000000 0 0.000000 128.000000 /end COMPU_METHOD
/begin COMPU_METHOD m_ub_b1020 "" RAT_FUNC "%6.2" "kg/h" COEFFS 0 1.000000 0.000000 0 0.000000 4.000000 /end COMPU_METHOD
/begin COMPU_METHOD nmotg_sb_q100 "" RAT_FUNC "%6.0" "U/min/s" COEFFS 0 1.000000 0.000000 0 0.000000 100.000000 /end COMPU_METHOD
/begin COMPU_METHOD nmotg_sw_q0p39 "" RAT_FUNC "%6.3" "U/min/s" COEFFS 0 1.000000 0.000000 0 0.000000 3.906300e-01 /end COMPU_METHOD
/begin COMPU_METHOD nmot_ub_q10 "" RAT_FUNC "%6.1" "U/min" COEFFS 0 1.000000 0.000000 0 0.000000 10.000000 /end COMPU_METHOD
/begin COMPU_METHOD nmot_ub_q40 "" RAT_FUNC "%6.1" "Upm" COEFFS 0 1.000000 0.000000 0 0.000000 40.000000 /end COMPU_METHOD
/begin COMPU_METHOD nmot_uw_q0p25 "" RAT_FUNC "%6.3" "U/min" COEFFS 0 1.000000 0.000000 0 0.000000 2.500000e-01 /end COMPU_METHOD
/begin COMPU_METHOD p_uw_q0p039 "" RAT_FUNC "%6.4" "hPa" COEFFS 0 256.000000 0.000000 0 0.000000 10.000000 /end COMPU_METHOD
/begin COMPU_METHOD rel_sb_q0p75 "" RAT_FUNC "%6.3" "%" COEFFS 0 1.000000 0.000000 0 0.000000 7.500000e-01 /end COMPU_METHOD
/begin COMPU_METHOD rel_sb_q0p78 "" RAT_FUNC "%6.3" "%" COEFFS 0 1.000000 0.000000 0 0.000000 7.800000e-01 /end COMPU_METHOD
/begin COMPU_METHOD rel_sw_b100 "" RAT_FUNC "%6.4" "%" COEFFS 0 3.276800e+04 0.000000 0 0.000000 100.000000 /end COMPU_METHOD
/begin COMPU_METHOD rel_sw_q0p0234 "" RAT_FUNC "%6.4" "%/seg" COEFFS 0 32.000000 0.000000 0 0.000000 7.500000e-01 /end COMPU_METHOD
/begin COMPU_METHOD rel_ub_b127p5 "" RAT_FUNC "%6.3" "%" COEFFS 0 2.000000 0.000000 0 0.000000 1.000000 /end COMPU_METHOD
/begin COMPU_METHOD rel_ub_b99p6 "" RAT_FUNC "%6.3" "%" COEFFS 0 256.000000 0.000000 0 0.000000 100.000000 /end COMPU_METHOD
/begin COMPU_METHOD rel_ub_q0p00153 "" RAT_FUNC "%6.4" "%" COEFFS 0 256.000000 0.000000 0 0.000000 3.906000e-01 /end COMPU_METHOD
/begin COMPU_METHOD rel_ub_q0p0029 "" RAT_FUNC "%6.4" "%" COEFFS 0 256.000000 0.000000 0 0.000000 7.500000e-01 /end COMPU_METHOD
/begin COMPU_METHOD rel_ub_q0p3906 "" RAT_FUNC "%6.3" "%" COEFFS 0 256.000000 0.000000 0 0.000000 100.000000 /end COMPU_METHOD
/begin COMPU_METHOD rel_ub_q0p3906___UB "" RAT_FUNC "%6.3" "%" COEFFS 0 256.000000 0.000000 0 0.000000 100.000000 /end COMPU_METHOD
/begin COMPU_METHOD rel_ub_q0p75 "" RAT_FUNC "%6.3" "%" COEFFS 0 1.000000 0.000000 0 0.000000 7.500000e-01 /end COMPU_METHOD
/begin COMPU_METHOD rel_uw_b100 "" RAT_FUNC "%6.4" "%" COEFFS 0 6.553600e+04 0.000000 0 0.000000 100.000000 /end COMPU_METHOD
/begin COMPU_METHOD rel_uw_q0p0234 "" RAT_FUNC "%6.4" "%" COEFFS 0 32.000000 0.000000 0 0.000000 7.500000e-01 /end COMPU_METHOD
/begin COMPU_METHOD spg_ubatt "" RAT_FUNC "%6.4" "V" COEFFS 0 1.000000 0.000000 0 0.000000 7.040000e-02 /end COMPU_METHOD
/begin COMPU_METHOD spg_ub_b24 "" RAT_FUNC "%6.3" "1/V" COEFFS 0 1.000000 0.000000 0 0.000000 9.362000e-02 /end COMPU_METHOD
/begin COMPU_METHOD spg_ub_b5 "" RAT_FUNC "%6.4" "V" COEFFS 0 256.000000 0.000000 0 0.000000 5.000000 /end COMPU_METHOD
/begin COMPU_METHOD spg_ub_q0p0098 "" RAT_FUNC "%6.4" "V" COEFFS 0 256.000000 0.000000 0 0.000000 2.500000 /end COMPU_METHOD
/begin COMPU_METHOD spg_ub_q0p019 "" RAT_FUNC "%6.4" "V" COEFFS 0 256.000000 0.000000 0 0.000000 5.000000 /end COMPU_METHOD
/begin COMPU_METHOD t100msxs_sb_q0p01 "" RAT_FUNC "%6.4" "s" COEFFS 0 1.000000 0.000000 0 0.000000 1.000000e-02 /end COMPU_METHOD
/begin COMPU_METHOD t10msxs_ub_b2p55 "" RAT_FUNC "%6.4" "s" COEFFS 0 1.000000 0.000000 0 0.000000 1.000000e-02 /end COMPU_METHOD
/begin COMPU_METHOD t1sxs_uw_q1 "" RAT_FUNC "%6.2" "s" COEFFS 0 1.000000 0.000000 0 0.000000 1.000000 /end COMPU_METHOD
/begin COMPU_METHOD t20usxus_q20 "" RAT_FUNC "%6.1" "us" COEFFS 0 1.000000 0.000000 0 0.000000 20.000000 /end COMPU_METHOD
/begin COMPU_METHOD t40msxs_ub_q0p04 "" RAT_FUNC "%6.4" "s" COEFFS 0 1.000000 0.000000 0 0.000000 4.000000e-02 /end COMPU_METHOD
/begin COMPU_METHOD t40msxs_uw_q0p04 "" RAT_FUNC "%6.4" "s" COEFFS 0 1.000000 0.000000 0 0.000000 4.000000e-02 /end COMPU_METHOD
/begin COMPU_METHOD t40ms_ub_b10200 "" RAT_FUNC "%7.2" "ms" COEFFS 0 1.000000 0.000000 0 0.000000 40.000000 /end COMPU_METHOD
/begin COMPU_METHOD t50msxs_uw_b3276p75 "" RAT_FUNC "%6.4" "s" COEFFS 0 1.000000 0.000000 0 0.000000 5.000000e-02 /end COMPU_METHOD
/begin COMPU_METHOD temp_q5 "" RAT_FUNC "%6.2" "Grad C" COEFFS 0 1.000000 0.000000 0 0.000000 5.000000 /end COMPU_METHOD
/begin COMPU_METHOD temp_ub_q0p75_o48 "" RAT_FUNC "%6.2" "Grad C" COEFFS 0 1.000000 48.000000 0 0.000000 7.500000e-01 /end COMPU_METHOD
/begin COMPU_METHOD temp_ub_q5_o50 "" RAT_FUNC "%6.2" "Grad C" COEFFS 0 1.000000 50.000000 0 0.000000 5.000000 /end COMPU_METHOD
/begin COMPU_METHOD tv_ub_b100 "" RAT_FUNC "%6.3" "%" COEFFS 0 256.000000 0.000000 0 0.000000 100.000000 /end COMPU_METHOD
/begin COMPU_METHOD txms_ub_q0p1 "" RAT_FUNC "%6.3" "ms" COEFFS 0 10.000000 0.000000 0 0.000000 1.000000 /end COMPU_METHOD
/begin COMPU_METHOD txms_uw_q0p1 "" RAT_FUNC "%6.3" "ms" COEFFS 0 10.000000 0.000000 0 0.000000 1.000000 /end COMPU_METHOD
/begin COMPU_METHOD t_wdt_high "" RAT_FUNC "%6.2" "ms" COEFFS 0 6.103520e-01 0.000000 0 0.000000 1.000000 /end COMPU_METHOD
/begin COMPU_METHOD vfzg_q1p0___SB "" RAT_FUNC "%6.2" "km/h" COEFFS 0 1.000000 0.000000 0 0.000000 1.000000 /end COMPU_METHOD
/begin COMPU_METHOD vfzg_sw_q0p00781 "" RAT_FUNC "%6.4" "km/h" COEFFS 0 1.000000 0.000000 0 0.000000 7.812500e-03 /end COMPU_METHOD
/begin COMPU_METHOD vfzg_uw_b512 "" RAT_FUNC "%6.4" "km/h" COEFFS 0 6.553600e+04 0.000000 0 0.000000 512.000000 /end COMPU_METHOD
/begin COMPU_METHOD vfzg_uw_q0p00781 "" RAT_FUNC "%6.4" "km/h" COEFFS 0 1.000000 0.000000 0 0.000000 7.812500e-03 /end COMPU_METHOD
/begin COMPU_METHOD wkw_ub_q0p25 "" RAT_FUNC "%6.3" "∞ KW" COEFFS 0 100.000000 0.000000 0 0.000000 25.000000 /end COMPU_METHOD
/begin COMPU_METHOD zw_sb_q0p75 "" RAT_FUNC "%6.3" "grad KW" COEFFS 0 255.000000 0.000000 0 0.000000 191.250000 /end COMPU_METHOD
/begin COMPU_METHOD zw_sb_q6 "" RAT_FUNC "%6.2" "Grad KW" COEFFS 0 1.000000 0.000000 0 0.000000 6.000000 /end COMPU_METHOD
/begin COMPU_METHOD zw_ub_q0p75 "" RAT_FUNC "%6.3" "Grad KW" COEFFS 0 255.000000 0.000000 0 0.000000 191.250000 /end COMPU_METHOD
/begin COMPU_METHOD zw_ub_qn0p75 "" RAT_FUNC "%6.4" "grad KW" COEFFS 0 1.000000 0.000000 0 0.000000 -7.500000e-01 /end COMPU_METHOD
/begin COMPU_VTAB B_TRUE "" TAB_VERB 2 0 "----" 1 "TRUE" /end COMPU_VTAB
/begin MEASUREMENT tmot "Motor-Temperatur" UBYTE temp_ub_q0p75_o48 0 0 -48.000000 143.250000 /begin IF_DATA ASAP1B_ETK KP_BLOB 0x380B61 1 1 /end IF_DATA BIT_MASK 0xFF /end MEASUREMENT
/begin MEASUREMENT rl "relative LuftfÅllung" UBYTE rel_ub_q0p75 0 0 0.000000 191.250000 /begin IF_DATA ASAP1B_ETK KP_BLOB 0xF997 0 1 /end IF_DATA BIT_MASK 0xFF /end MEASUREMENT
/begin MEASUREMENT nmot "Motordrehzahl" UBYTE nmot_ub_q40 0 0 0.000000 10200.000000 /begin IF_DATA ASAP1B_ETK KP_BLOB 0xF876 0 1 /end IF_DATA BIT_MASK 0xFF /end MEASUREMENT
/begin MEASUREMENT tans "Ansauglufttemperatur" UBYTE temp_ub_q0p75_o48 0 0 -48.000000 143.250000 /begin IF_DATA ASAP1B_ETK KP_BLOB 0x380B59 1 1 /end IF_DATA BIT_MASK 0xFF /end MEASUREMENT
/begin MEASUREMENT nmot_w "Motordrehzahl" UWORD nmot_uw_q0p25 0 0 0.000000 16383.750000 /begin IF_DATA ASAP1B_ETK KP_BLOB 0xF878 0 2 /end IF_DATA BIT_MASK 0xFFFF /end MEASUREMENT
/begin MEASUREMENT ml "Luftmassenflu·" UBYTE m_ub_b1020 0 0 0.000000 1020.000000 /begin IF_DATA ASAP1B_ETK KP_BLOB 0xF996 0 1 /end IF_DATA BIT_MASK 0xFF /end MEASUREMENT
/begin MEASUREMENT ngfil "gefilterter Drehzahlgradient" SBYTE nmotg_sb_q100 0 0 -12800.000000 12700.000000 /begin IF_DATA ASAP1B_ETK KP_BLOB 0x380A53 1 1 /end IF_DATA BIT_MASK 0xFF /end MEASUREMENT
/begin MEASUREMENT tmst "Motorstarttemperatur" UBYTE temp_ub_q0p75_o48 0 0 -48.000000 143.250000 /begin IF_DATA ASAP1B_ETK KP_BLOB 0x380B5F 1 1 /end IF_DATA BIT_MASK 0xFF /end MEASUREMENT
/begin MEASUREMENT rl_w "relative LuftfÅllung (Word)" UWORD rel_uw_q0p0234 0 0 0.000000 1535.976562 /begin IF_DATA ASAP1B_ETK KP_BLOB 0xF99C 0 2 /end IF_DATA BIT_MASK 0xFFFF /end MEASUREMENT
/begin MEASUREMENT bfzglf "FahrzeuglÑngsbeschleunigung gefiltert" SBYTE bfzg_sb_q0p217 0 0 -27.776000 27.559000 /begin IF_DATA ASAP1B_ETK KP_BLOB 0x380C55 1 1 /end IF_DATA BIT_MASK 0xFF /end MEASUREMENT
/begin MEASUREMENT spsn_um "nach unten auf Leerlauf begrenzter Pedalwert (8 Bit) in der FunktionsÅberwachung" UBYTE spg_ub_q0p019 0 0 0.000000 4.980469 /begin IF_DATA ASAP1B_ETK KP_BLOB 0x380923 1 1 /end IF_DATA BIT_MASK 0xFF /end MEASUREMENT
/begin MEASUREMENT rl_um "relative LuftfÅllung in der FunktionsÅberwachung" UBYTE rel_ub_q0p75 0 0 0.000000 191.250000 /begin IF_DATA ASAP1B_ETK KP_BLOB 0x38091F 1 1 /end IF_DATA BIT_MASK 0xFF /end MEASUREMENT
/begin MEASUREMENT nmot_um "Motordrehzahl in der FunktionsÅberwachung" UBYTE nmot_ub_q40 0 0 0.000000 10200.000000 /begin IF_DATA ASAP1B_ETK KP_BLOB 0x38090A 1 1 /end IF_DATA BIT_MASK 0xFF /end MEASUREMENT
/begin MEASUREMENT mzmax_um "zulÑssiges Moment aus der Maximalauswahl in der FunktionsÅberwachung" UBYTE rel_ub_b99p6 0 0 0.000000 99.609375 /begin IF_DATA ASAP1B_ETK KP_BLOB 0x380C68 1 1 /end IF_DATA BIT_MASK 0xFF /end MEASUREMENT
/begin MEASUREMENT spsn_uc "" UBYTE spg_ub_q0p019 0 0 0.000000 4.980469 /begin IF_DATA ASAP1B_ETK KP_BLOB 0x380C73 1 1 /end IF_DATA BIT_MASK 0xFF /end MEASUREMENT
/begin MEASUREMENT rl_uc "relative LuftfÅllung im Befehlstest" UBYTE rel_ub_q0p75 0 0 0.000000 191.250000 /begin IF_DATA ASAP1B_ETK KP_BLOB 0x380C72 1 1 /end IF_DATA BIT_MASK 0xFF /end MEASUREMENT
/begin MEASUREMENT nmot_uc "Motordrehzahl im Befehlstest" UBYTE nmot_ub_q40 0 0 0.000000 10200.000000 /begin IF_DATA ASAP1B_ETK KP_BLOB 0x380C71 1 1 /end IF_DATA BIT_MASK 0xFF /end MEASUREMENT
/begin MEASUREMENT mzmax_uc "" UBYTE rel_ub_b99p6 0 0 0.000000 99.609375 /begin IF_DATA ASAP1B_ETK KP_BLOB 0x380C80 1 1 /end IF_DATA BIT_MASK 0xFF /end MEASUREMENT
/begin MEASUREMENT vfzg_w "Fahrzeuggeschwindigkeit, gefiltert" UWORD vfzg_uw_b512 0 0 0.000000 511.992188 /begin IF_DATA ASAP1B_ETK KP_BLOB 0x380DA6 1 2 /end IF_DATA BIT_MASK 0xFFFF /end MEASUREMENT
/begin MEASUREMENT wnwue "Winkel Nockenwellenueberschneidung" UBYTE kw_ub_q0p5 0 0 0.000000 127.500000 /begin IF_DATA ASAP1B_ETK KP_BLOB 0x380B00 1 1 /end IF_DATA BIT_MASK 0xFF /end MEASUREMENT
/begin MEASUREMENT ub "Batteriespannung" UBYTE spg_ubatt 0 0 0.000000 17.952000 /begin IF_DATA ASAP1B_ETK KP_BLOB 0x380AB1 1 1 /end IF_DATA BIT_MASK 0xFF /end MEASUREMENT
/begin MEASUREMENT lambas "Basis-Lambda" UBYTE fak_ub_b2 0 0 0.000000 1.992188 /begin IF_DATA ASAP1B_ETK KP_BLOB 0x380B2E 1 1 /end IF_DATA BIT_MASK 0xFF /end MEASUREMENT
/begin MEASUREMENT dzw_kge "Eingang Delta-ZÅndwinkel fÅr mehrfach verwendete Kenngrî·en" SBYTE zw_sb_q0p75 0 0 -96.000000 95.250000 /begin IF_DATA ASAP1B_ETK KP_BLOB 0x380C42 1 1 /end IF_DATA BIT_MASK 0xFF /end MEASUREMENT
/begin MEASUREMENT ipsn_um "aktive DK-Istwertpoti-Info ohne unteren Anschlag fÅr die FunktionsÅberwachung" UBYTE spg_ub_q0p019 0 0 0.000000 4.980469 /begin IF_DATA ASAP1B_ETK KP_BLOB 0x380910 1 1 /end IF_DATA BIT_MASK 0xFF /end MEASUREMENT
/begin MEASUREMENT dzw_um "Delta ZÅndwinkel zwischen zwopt und zwout in der FunktionsÅberwachung" UBYTE zw_ub_q0p75 0 0 0.000000 191.250000 /begin IF_DATA ASAP1B_ETK KP_BLOB 0x380928 1 1 /end IF_DATA BIT_MASK 0xFF /end MEASUREMENT
/begin MEASUREMENT x_uc "" UBYTE dez 0 0 0.000000 255.000000 /begin IF_DATA ASAP1B_ETK KP_BLOB 0x380C74 1 1 /end IF_DATA BIT_MASK 0xFF /end MEASUREMENT
/begin MEASUREMENT y_uc "" UBYTE dez 0 0 0.000000 255.000000 /begin IF_DATA ASAP1B_ETK KP_BLOB 0x380C75 1 1 /end IF_DATA BIT_MASK 0xFF /end MEASUREMENT
/begin MEASUREMENT dzw_uc "" UBYTE zw_ub_q0p75 0 0 0.000000 191.250000 /begin IF_DATA ASAP1B_ETK KP_BLOB 0x380C7A 1 1 /end IF_DATA BIT_MASK 0xFF /end MEASUREMENT
/begin MEASUREMENT ngfil_w "gefilterter Drehzahlgradient" SWORD nmotg_sw_q0p39 0 0 -12800.163840 12799.773210 /begin IF_DATA ASAP1B_ETK KP_BLOB 0x381A9E 1 2 /end IF_DATA BIT_MASK 0xFFFF /end MEASUREMENT
/begin MEASUREMENT tsdrlmx_w "max. drlsolf fÅr Lastdynamik" SWORD rel_sw_q0p0234 0 0 -768.000000 767.976562 /begin IF_DATA ASAP1B_ETK KP_BLOB 0x3828F8 1 2 /end IF_DATA BIT_MASK 0xFFFF /end MEASUREMENT
/begin MEASUREMENT uzue "" UBYTE spg_ubatt 0 0 0.000000 17.952000 /begin IF_DATA ASAP1B_ETK KP_BLOB 0x380D29 1 1 /end IF_DATA BIT_MASK 0xFF /end MEASUREMENT
/begin MEASUREMENT tsrldyn "Last- und Dynamikkorrigierte Schlie·zeit" UBYTE txms_ub_q0p1 0 0 0.000000 25.500000 /begin IF_DATA ASAP1B_ETK KP_BLOB 0x380D27 1 1 /end IF_DATA BIT_MASK 0xFF /end MEASUREMENT
/begin MEASUREMENT adcc_c_um "FehlerzÑhler bei zueinander unplausiblen ADC-Werten fÅr sp1s" UBYTE t10msxs_ub_b2p55 0 0 0.000000 2.550000 /begin IF_DATA ASAP1B_ETK KP_BLOB 0x38093C 1 1 /end IF_DATA BIT_MASK 0xFF /end MEASUREMENT
/begin MEASUREMENT ausgh_c_um "HeilungszÑhler fÅr Fehler in der zyklischen RAM-PrÅfung der FunktionsÅberwachung" UBYTE t40ms_ub_b10200 0 0 0.000000 10200.000000 /begin IF_DATA ASAP1B_ETK KP_BLOB 0x380941 1 1 /end IF_DATA BIT_MASK 0xFF /end MEASUREMENT
/begin MEASUREMENT ausg_c_um "FehlerzÑhler fÅr zyklische RAM-PrÅfung in der FunktionsÅberwachung" UBYTE dezsub1 0 0 1.000000 256.000000 /begin IF_DATA ASAP1B_ETK KP_BLOB 0x380942 1 1 /end IF_DATA BIT_MASK 0xFF /end MEASUREMENT
/begin MEASUREMENT auszh_c_um "HeilungszÑhler fÅr Fehler in der zyklischen ROM-PrÅfung der FunktionsÅberwachung" UBYTE t40ms_ub_b10200 0 0 0.000000 10200.000000 /begin IF_DATA ASAP1B_ETK KP_BLOB 0x380943 1 1 /end IF_DATA BIT_MASK 0xFF /end MEASUREMENT
/begin MEASUREMENT ausz_c_um "FehlerzÑhler fÅr zyklische ROM-PrÅfung in der FunktionsÅberwachung" UBYTE dezsub1 0 0 1.000000 256.000000 /begin IF_DATA ASAP1B_ETK KP_BLOB 0x380944 1 1 /end IF_DATA BIT_MASK 0xFF /end MEASUREMENT
/begin MEASUREMENT bfzgl_b "FahrzeuglÑngsbeschleunigung" SBYTE bfzg_sb_q0p217 0 0 -27.776000 27.559000 /begin IF_DATA ASAP1B_ETK KP_BLOB 0x380983 1 1 /end IF_DATA BIT_MASK 0xFF /end MEASUREMENT
/begin MEASUREMENT brems_c_um "EntprellzÑhler fÅr betÑtigte Bremse in der FunktionsÅberwachung" UBYTE t40ms_ub_b10200 0 0 0.000000 10200.000000 /begin IF_DATA ASAP1B_ETK KP_BLOB 0x380908 1 1 /end IF_DATA BIT_MASK 0xFF /end MEASUREMENT
/begin MEASUREMENT bzmsr_a_uc "" UBYTE dez 0 0 0.000000 255.000000 /begin IF_DATA ASAP1B_ETK KP_BLOB 0x380C6C 1 1 /end IF_DATA BIT_MASK 0xFF /end MEASUREMENT
/begin MEASUREMENT bzmsr_a_um "alter MSR-BotschaftszÑhler" UBYTE dez 0 0 0.000000 255.000000 /begin IF_DATA ASAP1B_ETK KP_BLOB 0x380925 1 1 /end IF_DATA BIT_MASK 0xFF /end MEASUREMENT
/begin MEASUREMENT bz_msr "MSR-BotschaftszÑhler" UBYTE DEZ 0 0 0.000000 255.000000 /begin IF_DATA ASAP1B_ETK KP_BLOB 0x3809C0 1 1 /end IF_DATA BIT_MASK 0xFF /end MEASUREMENT
/begin MEASUREMENT bz_msr_uc "" UBYTE dez 0 0 0.000000 255.000000 /begin IF_DATA ASAP1B_ETK KP_BLOB 0x380C6D 1 1 /end IF_DATA BIT_MASK 0xFF /end MEASUREMENT
/begin MEASUREMENT B_bl "Bedingung Bremslichtschalter betÑtigt" UWORD B_TRUE___UW 0 0 0.000000 0.000000 /begin IF_DATA ASAP1B_ETK KP_BLOB 0xFD48 0 2 /end IF_DATA BIT_MASK 0x1 /end MEASUREMENT
/begin MEASUREMENT B_bm "Bedingung Bezugsmarke erkannt" UWORD B_TRUE___UW 0 0 0.000000 0.000000 /begin IF_DATA ASAP1B_ETK KP_BLOB 0xFD1E 0 2 /end IF_DATA BIT_MASK 0x20 /end MEASUREMENT
/begin MEASUREMENT B_brems_um "Bedingung Bremse getreten fÅr die FunktionsÅberwachung" UBYTE B_TRUE 0 0 0.000000 0.000000 /begin IF_DATA ASAP1B_ETK KP_BLOB 0x380902 1 1 /end IF_DATA BIT_MASK 0x1 /end MEASUREMENT
/begin MEASUREMENT B_bsl_um "erkannter Low-Pegel am FGR-Bedienhebelschalter Beschleunigen in FunktionsÅberw." UBYTE B_TRUE 0 0 0.000000 0.000000 /begin IF_DATA ASAP1B_ETK KP_BLOB 0x380902 1 1 /end IF_DATA BIT_MASK 0x10 /end MEASUREMENT
/begin MEASUREMENT B_dcdis_um "Fehlerreaktions-Info der FunktionsÅberwachung (Abschaltung der DK-Steller-ES)" UBYTE B_TRUE 0 0 0.000000 0.000000 /begin IF_DATA ASAP1B_ETK KP_BLOB 0x380901 1 1 /end IF_DATA BIT_MASK 0x1 /end MEASUREMENT
/begin MEASUREMENT B_ehfs "Bedingung Ersatzwert HauptfÅllungssensor" UWORD B_TRUE___UW 0 0 0.000000 0.000000 /begin IF_DATA ASAP1B_ETK KP_BLOB 0xFD56 0 2 /end IF_DATA BIT_MASK 0x20 /end MEASUREMENT
/begin MEASUREMENT B_fgr "Bedingung FGR (Tempomat) aktiv" UWORD B_TRUE___UW 0 0 0.000000 0.000000 /begin IF_DATA ASAP1B_ETK KP_BLOB 0xFD7E 0 2 /end IF_DATA BIT_MASK 0x400 /end MEASUREMENT
/begin MEASUREMENT B_fgrab "FGR-/ACC-Abschaltung aus der Funktion" UWORD B_TRUE___UW 0 0 0.000000 0.000000 /begin IF_DATA ASAP1B_ETK KP_BLOB 0xFD4C 0 2 /end IF_DATA BIT_MASK 0x4000 /end MEASUREMENT
/begin MEASUREMENT B_fgren_um "FGR-/ACC-Einschaltung aus Bedienhebel gÅltig in der FunktionsÅberwachung" UBYTE B_TRUE 0 0 0.000000 0.000000 /begin IF_DATA ASAP1B_ETK KP_BLOB 0x380902 1 1 /end IF_DATA BIT_MASK 0x4 /end MEASUREMENT
/begin MEASUREMENT B_fgrfr_uc "FGR-/ACC-Momenteneingriff erlaubt im Befehlstest" UWORD B_TRUE___UW 0 0 0.000000 0.000000 /begin IF_DATA ASAP1B_ETK KP_BLOB 0xFD86 0 2 /end IF_DATA BIT_MASK 0x400 /end MEASUREMENT
/begin MEASUREMENT B_fgr_uc "" UWORD B_TRUE___UW 0 0 0.000000 0.000000 /begin IF_DATA ASAP1B_ETK KP_BLOB 0xFD86 0 2 /end IF_DATA BIT_MASK 0x1000 /end MEASUREMENT
/begin MEASUREMENT B_fgr_um "FGR-/ACC-Momenteneingriff in der FunktionsÅberwachung erlaubt" UWORD B_TRUE___UW 0 0 0.000000 0.000000 /begin IF_DATA ASAP1B_ETK KP_BLOB 0xFD86 0 2 /end IF_DATA BIT_MASK 0x8 /end MEASUREMENT
/begin MEASUREMENT B_i_ska "Funktions-Fehlerreaktion irreversible SKA (Sicherheits-Kraftstoffabschaltung)" UBYTE B_TRUE 0 0 0.000000 0.000000 /begin IF_DATA ASAP1B_ETK KP_BLOB 0x380901 1 1 /end IF_DATA BIT_MASK 0x4 /end MEASUREMENT
/begin MEASUREMENT B_i_ska_fr "irrev. Sicherheitskraftstoffabschaltung vom FR" UWORD B_TRUE___UW 0 0 0.000000 0.000000 /begin IF_DATA ASAP1B_ETK KP_BLOB 0xFD46 0 2 /end IF_DATA BIT_MASK 0x4000 /end MEASUREMENT
/begin MEASUREMENT B_i_ska_uc "" UWORD B_TRUE___UW 0 0 0.000000 0.000000 /begin IF_DATA ASAP1B_ETK KP_BLOB 0xFD88 0 2 /end IF_DATA BIT_MASK 0x1 /end MEASUREMENT
/begin MEASUREMENT B_i_ska_um "Fehlerreaktion irrev. SKA (Sicherheitskraftstoffabschaltg) vom öberwachungsmodul" UWORD B_TRUE___UW 0 0 0.000000 0.000000 /begin IF_DATA ASAP1B_ETK KP_BLOB 0xFD84 0 2 /end IF_DATA BIT_MASK 0x400 /end MEASUREMENT
/begin MEASUREMENT B_kfzk "Bedingung Kennfeld Klopfschutz" UWORD B_TRUE___UW 0 0 0.000000 0.000000 /begin IF_DATA ASAP1B_ETK KP_BLOB 0xFDA0 0 2 /end IF_DATA BIT_MASK 0x1 /end MEASUREMENT
/begin MEASUREMENT B_kh "Bedingung Kat-Heizung" UWORD B_TRUE___UW 0 0 0.000000 0.000000 /begin IF_DATA ASAP1B_ETK KP_BLOB 0xFD6E 0 2 /end IF_DATA BIT_MASK 0x1 /end MEASUREMENT
/begin MEASUREMENT B_kkl_um "erkannter Low-Pegel am FGR-Bedienhebelschalter Kontrollkontakt in FunktionsÅberw" UBYTE B_TRUE 0 0 0.000000 0.000000 /begin IF_DATA ASAP1B_ETK KP_BLOB 0x380902 1 1 /end IF_DATA BIT_MASK 0x40 /end MEASUREMENT
/begin MEASUREMENT B_krdws "Bedingung Klopfregelung SicherheitsspÑtverstellung" UWORD B_TRUE___UW 0 0 0.000000 0.000000 /begin IF_DATA ASAP1B_ETK KP_BLOB 0xFD70 0 2 /end IF_DATA BIT_MASK 0x200 /end MEASUREMENT
/begin MEASUREMENT B_kw "Bedingung Kat warmhalten" UWORD B_TRUE___UW 0 0 0.000000 0.000000 /begin IF_DATA ASAP1B_ETK KP_BLOB 0xFD6E 0 2 /end IF_DATA BIT_MASK 0x8 /end MEASUREMENT
/begin MEASUREMENT B_ll "Bedingung Leerlauf" UWORD B_TRUE___UW 0 0 0.000000 0.000000 /begin IF_DATA ASAP1B_ETK KP_BLOB 0xFD7E 0 2 /end IF_DATA BIT_MASK 0x2000 /end MEASUREMENT
/begin MEASUREMENT B_llrein "Bedingung LLR ist aktiv" UWORD B_TRUE___UW 0 0 0.000000 0.000000 /begin IF_DATA ASAP1B_ETK KP_BLOB 0xFD7C 0 2 /end IF_DATA BIT_MASK 0x8 /end MEASUREMENT
/begin MEASUREMENT B_lsd "Bedingung: Pos. LastschlagdÑmpfung aktiv" UWORD B_TRUE___UW 0 0 0.000000 0.000000 /begin IF_DATA ASAP1B_ETK KP_BLOB 0xFD7E 0 2 /end IF_DATA BIT_MASK 0x8000 /end MEASUREMENT
/begin MEASUREMENT B_mcacti "Bedingung McMESS aktiv" UWORD B_TRUE___UW 0 0 0.000000 0.000000 /begin IF_DATA ASAP1B_ETK KP_BLOB 0xFD0C 0 2 /end IF_DATA BIT_MASK 0x80 /end MEASUREMENT
/begin MEASUREMENT B_mzns_um "Nachstartaufweitung des zul. Moments aktiv fÅr die Fkt.-öberwachung" UWORD B_TRUE___UW 0 0 0.000000 0.000000 /begin IF_DATA ASAP1B_ETK KP_BLOB 0xFD84 0 2 /end IF_DATA BIT_MASK 0x1000 /end MEASUREMENT
/begin MEASUREMENT B_nachl "Steuerung SG-Nachlauf" UWORD B_TRUE___UW 0 0 0.000000 0.000000 /begin IF_DATA ASAP1B_ETK KP_BLOB 0x383CCE 1 2 /end IF_DATA BIT_MASK 0x8000 /end MEASUREMENT
/begin MEASUREMENT B_nkons_uc "" UWORD B_TRUE___UW 0 0 0.000000 0.000000 /begin IF_DATA ASAP1B_ETK KP_BLOB 0xFD86 0 2 /end IF_DATA BIT_MASK 0x2000 /end MEASUREMENT
/begin MEASUREMENT B_nkons_um "Bedingung MSR-Botschaft ist nicht konsistent" UWORD B_TRUE___UW 0 0 0.000000 0.000000 /begin IF_DATA ASAP1B_ETK KP_BLOB 0xFD86 0 2 /end IF_DATA BIT_MASK 0x10 /end MEASUREMENT
/begin MEASUREMENT B_nldg "Bedingung Drehzahlgeber-Notlauf" UWORD B_TRUE___UW 0 0 0.000000 0.000000 /begin IF_DATA ASAP1B_ETK KP_BLOB 0xFD22 0 2 /end IF_DATA BIT_MASK 0x1 /end MEASUREMENT
/begin MEASUREMENT B_nlsiko "Bedingung Nachlauf EGAS-öberwachung" UWORD B_TRUE___UW 0 0 0.000000 0.000000 /begin IF_DATA ASAP1B_ETK KP_BLOB 0x383CCE 1 2 /end IF_DATA BIT_MASK 0x80 /end MEASUREMENT
/begin MEASUREMENT B_nomsrfr_uc "" UWORD B_TRUE___UW 0 0 0.000000 0.000000 /begin IF_DATA ASAP1B_ETK KP_BLOB 0xFD86 0 2 /end IF_DATA BIT_MASK 0x800 /end MEASUREMENT
/begin MEASUREMENT B_nomsr_fr "kein ASR-/MSR-Eingriff vom FR" UWORD B_TRUE___UW 0 0 0.000000 0.000000 /begin IF_DATA ASAP1B_ETK KP_BLOB 0xFD12 0 2 /end IF_DATA BIT_MASK 0x40 /end MEASUREMENT
/begin MEASUREMENT B_nomsr_uc "" UWORD B_TRUE___UW 0 0 0.000000 0.000000 /begin IF_DATA ASAP1B_ETK KP_BLOB 0xFD86 0 2 /end IF_DATA BIT_MASK 0x4000 /end MEASUREMENT
/begin MEASUREMENT B_nomsr_um "MSR-Momentenvorgabe in der FunktionsÅberwachung nicht Åbernommen" UWORD B_TRUE___UW 0 0 0.000000 0.000000 /begin IF_DATA ASAP1B_ETK KP_BLOB 0xFD86 0 2 /end IF_DATA BIT_MASK 0x20 /end MEASUREMENT
/begin MEASUREMENT B_notlu "Anforderung Notluftfahren aus der Funktion" UBYTE B_TRUE 0 0 0.000000 0.000000 /begin IF_DATA ASAP1B_ETK KP_BLOB 0x380901 1 1 /end IF_DATA BIT_MASK 0x8 /end MEASUREMENT
/begin MEASUREMENT B_notlu_fr "Notluftfahren vom FR" UWORD B_TRUE___UW 0 0 0.000000 0.000000 /begin IF_DATA ASAP1B_ETK KP_BLOB 0xFD46 0 2 /end IF_DATA BIT_MASK 0x8000 /end MEASUREMENT
/begin MEASUREMENT B_nozwe "Bedingung kein ZÅndwinkeleingriff der Drehmomentstruktur" UWORD B_TRUE___UW 0 0 0.000000 0.000000 /begin IF_DATA ASAP1B_ETK KP_BLOB 0xFD9E 0 2 /end IF_DATA BIT_MASK 0x1000 /end MEASUREMENT
/begin MEASUREMENT b_nsakt_um "Nachstart aktiv fÅr die Fkt.-öberwachung" UBYTE B_TRUE 0 0 0.000000 0.000000 /begin IF_DATA ASAP1B_ETK KP_BLOB 0x380900 1 1 /end IF_DATA BIT_MASK 0x4 /end MEASUREMENT
/begin MEASUREMENT b_nsend_um "NachstartÅberwachungszeit abgelaufen fÅr die Fkt.-öberwachung" UBYTE B_TRUE 0 0 0.000000 0.000000 /begin IF_DATA ASAP1B_ETK KP_BLOB 0x380900 1 1 /end IF_DATA BIT_MASK 0x1 /end MEASUREMENT
/begin MEASUREMENT B_phad "Adaption Kurbel/Nockenwelle erfolgt" UBYTE B_TRUE 0 0 0.000000 0.000000 /begin IF_DATA ASAP1B_ETK KP_BLOB 0x383314 1 1 /end IF_DATA BIT_MASK 0x1 /end MEASUREMENT
/begin MEASUREMENT B_pwf "Bedingung Powerfail" UWORD B_TRUE___UW 0 0 0.000000 0.000000 /begin IF_DATA ASAP1B_ETK KP_BLOB 0xFD88 0 2 /end IF_DATA BIT_MASK 0x10 /end MEASUREMENT
/begin MEASUREMENT B_pwgnotfr "FR-Fehlerreaktion PWG-Notfahren" UWORD B_TRUE___UW 0 0 0.000000 0.000000 /begin IF_DATA ASAP1B_ETK KP_BLOB 0xFD3C 0 2 /end IF_DATA BIT_MASK 0x100 /end MEASUREMENT
/begin MEASUREMENT B_pwgnotum "= b_pwgnot_um FunktionsÅberwachungs-Fehlerreaktion PWG-Leerlauf (= b_pwgnot_sr)" UWORD B_TRUE___UW 0 0 0.000000 0.000000 /begin IF_DATA ASAP1B_ETK KP_BLOB 0xFD86 0 2 /end IF_DATA BIT_MASK 0x2 /end MEASUREMENT
/begin MEASUREMENT B_sa "Schubabschaltung" UWORD B_TRUE___UW 0 0 0.000000 0.000000 /begin IF_DATA ASAP1B_ETK KP_BLOB 0xFD84 0 2 /end IF_DATA BIT_MASK 0x2 /end MEASUREMENT
/begin MEASUREMENT B_slsfz "Bedingung SLS in Fahrzeug eingebaut" UWORD B_TRUE___UW 0 0 0.000000 0.000000 /begin IF_DATA ASAP1B_ETK KP_BLOB 0xFD02 0 2 /end IF_DATA BIT_MASK 0x4000 /end MEASUREMENT
/begin MEASUREMENT B_sp1s "Mitteilung an SR: SP1S ist FÅhrungsgrî·e." UWORD B_TRUE___UW 0 0 0.000000 0.000000 /begin IF_DATA ASAP1B_ETK KP_BLOB 0xFD3C 0 2 /end IF_DATA BIT_MASK 0x200 /end MEASUREMENT
/begin MEASUREMENT B_sp2s "Mitteilung an SR:Poti2 SP2S FÅhrungsgrî·e,Poti1 Ober-oder Untergrenze Åberschr." UWORD B_TRUE___UW 0 0 0.000000 0.000000 /begin IF_DATA ASAP1B_ETK KP_BLOB 0xFD3C 0 2 /end IF_DATA BIT_MASK 0x400 /end MEASUREMENT
/begin MEASUREMENT B_spsa "Bedingung Winkeladaption Kurbel- zu Nockenwelle zulÑssig" UWORD B_TRUE___UW 0 0 0.000000 0.000000 /begin IF_DATA ASAP1B_ETK KP_BLOB 0xFD1C 0 2 /end IF_DATA BIT_MASK 0x80 /end MEASUREMENT
/begin MEASUREMENT B_spsmin "Mitteilung an SR: '1'= PWG-Notfahren mit SPSMIN" UWORD B_TRUE___UW 0 0 0.000000 0.000000 /begin IF_DATA ASAP1B_ETK KP_BLOB 0xFD3C 0 2 /end IF_DATA BIT_MASK 0x800 /end MEASUREMENT
/begin MEASUREMENT B_st "Bedingung Start" UWORD B_TRUE___UW 0 0 0.000000 0.000000 /begin IF_DATA ASAP1B_ETK KP_BLOB 0xFD88 0 2 /end IF_DATA BIT_MASK 0x20 /end MEASUREMENT
/begin MEASUREMENT B_stend "1 = Startende erkannt" UWORD B_TRUE___UW 0 0 0.000000 0.000000 /begin IF_DATA ASAP1B_ETK KP_BLOB 0xFD88 0 2 /end IF_DATA BIT_MASK 0x40 /end MEASUREMENT
/begin MEASUREMENT B_swdy "Bedingung Lastdynamik bei Schlie·zeitberechnung" UWORD B_TRUE___UW 0 0 0.000000 0.000000 /begin IF_DATA ASAP1B_ETK KP_BLOB 0xFDA0 0 2 /end IF_DATA BIT_MASK 0x2 /end MEASUREMENT
/begin MEASUREMENT B_syn "Bedingung Synchronisation erfolgt" UWORD B_TRUE___UW 0 0 0.000000 0.000000 /begin IF_DATA ASAP1B_ETK KP_BLOB 0xFD20 0 2 /end IF_DATA BIT_MASK 0x20 /end MEASUREMENT
/begin MEASUREMENT B_synnldg "Bedingung: Motorposition im Notlauf DG aus PG-Signal erkannt" UWORD B_TRUE___UW 0 0 0.000000 0.000000 /begin IF_DATA ASAP1B_ETK KP_BLOB 0xFD22 0 2 /end IF_DATA BIT_MASK 0x4 /end MEASUREMENT
/begin MEASUREMENT B_trev_inc "" UWORD B_TRUE___UW 0 0 0.000000 0.000000 /begin IF_DATA ASAP1B_ETK KP_BLOB 0xFD04 0 2 /end IF_DATA BIT_MASK 0x100 /end MEASUREMENT
/begin MEASUREMENT B_ub_ok "1 = Batteriespannung ok" UWORD B_TRUE___UW 0 0 0.000000 0.000000 /begin IF_DATA ASAP1B_ETK KP_BLOB 0xFD46 0 2 /end IF_DATA BIT_MASK 0x20 /end MEASUREMENT
/begin MEASUREMENT B_ub_ska "Batteriespannung nicht o.k., Unterspannungsabschaltung aktiv" UBYTE B_TRUE 0 0 0.000000 0.000000 /begin IF_DATA ASAP1B_ETK KP_BLOB 0x380901 1 1 /end IF_DATA BIT_MASK 0x2 /end MEASUREMENT
/begin MEASUREMENT B_vmax "Flag VMAX-Begrenzung aktiv" UWORD dez___UW 0 0 0.000000 65535.000000 /begin IF_DATA ASAP1B_ETK KP_BLOB 0xFD84 0 2 /end IF_DATA BIT_MASK 0x20 /end MEASUREMENT
/begin MEASUREMENT B_vzl_um "erkannter Low-Pegel am FGR-Bedienhebelschalter Verzîgern in der FunktionsÅberw." UBYTE B_TRUE 0 0 0.000000 0.000000 /begin IF_DATA ASAP1B_ETK KP_BLOB 0x380902 1 1 /end IF_DATA BIT_MASK 0x8 /end MEASUREMENT
/begin MEASUREMENT B_wal_um "erkannter Low-Pegel am FGR-Bedienhebelschalter Wiederaufnahme in FunktionsÅberw." UBYTE B_TRUE 0 0 0.000000 0.000000 /begin IF_DATA ASAP1B_ETK KP_BLOB 0x380902 1 1 /end IF_DATA BIT_MASK 0x20 /end MEASUREMENT
/begin MEASUREMENT B_wdk2sel "Bedingung DK-Winkel-Berechnung fÅr Lageregler aus Poti 2" UWORD B_TRUE___UW 0 0 0.000000 0.000000 /begin IF_DATA ASAP1B_ETK KP_BLOB 0xFD40 0 2 /end IF_DATA BIT_MASK 0x4 /end MEASUREMENT
/begin MEASUREMENT B_wnwiout "Bedingung: Winkeldifferenz wnwi_ad_w nicht plausibel" UWORD B_TRUE___UW 0 0 0.000000 0.000000 /begin IF_DATA ASAP1B_ETK KP_BLOB 0xFD1C 0 2 /end IF_DATA BIT_MASK 0x100 /end MEASUREMENT
/begin MEASUREMENT B_z1 "Bedingung ZÅndbereich 1 aktiv" UWORD B_TRUE___UW 0 0 0.000000 0.000000 /begin IF_DATA ASAP1B_ETK KP_BLOB 0xFD06 0 2 /end IF_DATA BIT_MASK 0x10 /end MEASUREMENT
/begin MEASUREMENT B_zwappl "Bedingung ZÅndwinkelapplikation ohne Drehmomenteingriffe" UWORD B_TRUE___UW 0 0 0.000000 0.000000 /begin IF_DATA ASAP1B_ETK KP_BLOB 0xFD04 0 2 /end IF_DATA BIT_MASK 0x8 /end MEASUREMENT
/begin MEASUREMENT B_zwkra "Bedingung: ZÅndwinkel der KR wird ausgegeben" UWORD B_TRUE___UW 0 0 0.000000 0.000000 /begin IF_DATA ASAP1B_ETK KP_BLOB 0xFD9E 0 2 /end IF_DATA BIT_MASK 0x400 /end MEASUREMENT
/begin MEASUREMENT B_zwmnste "Bedingung Abregelung der ZÅndwinkelspÑtbegrenzung erfÅllt" UWORD B_TRUE___UW 0 0 0.000000 0.000000 /begin IF_DATA ASAP1B_ETK KP_BLOB 0xFD9E 0 2 /end IF_DATA BIT_MASK 0x4000 /end MEASUREMENT
/begin MEASUREMENT B_zwms "Bedingung Motorschutz-ZÅndwinkelbegrenzung" UWORD B_TRUE___UW 0 0 0.000000 0.000000 /begin IF_DATA ASAP1B_ETK KP_BLOB 0xFD9E 0 2 /end IF_DATA BIT_MASK 0x8000 /end MEASUREMENT
/begin MEASUREMENT B_zwspae "Bedingung: ZÅndwinkel zwspae bei Schubabschaltung wird ausgegeben" UWORD B_TRUE___UW 0 0 0.000000 0.000000 /begin IF_DATA ASAP1B_ETK KP_BLOB 0xFD9E 0 2 /end IF_DATA BIT_MASK 0x800 /end MEASUREMENT
/begin MEASUREMENT B_zztab "Bedingung: Zahnzeitentabelle gÅltig" UWORD B_TRUE___UW 0 0 0.000000 0.000000 /begin IF_DATA ASAP1B_ETK KP_BLOB 0xFD20 0 2 /end IF_DATA BIT_MASK 0x100 /end MEASUREMENT
/begin MEASUREMENT delayedTime_w "" UWORD t_wdt_high 0 0 0.000000 107372.467035 /begin IF_DATA ASAP1B_ETK KP_BLOB 0x383CD4 1 2 /end IF_DATA BIT_MASK 0xFFFF /end MEASUREMENT
/begin MEASUREMENT dmvmxi_w "Drehmoment I-Anteil bei VMAX-Regelung" SWORD rel_sw_b100 0 0 -100.000000 99.996948 /begin IF_DATA ASAP1B_ETK KP_BLOB 0x3824DE 1 2 /end IF_DATA BIT_MASK 0xFFFF /end MEASUREMENT
/begin MEASUREMENT dmvmxp_w "Drehmoment P-Anteil bei VMAX-Regelung" SWORD rel_sw_b100 0 0 -100.000000 99.996948 /begin IF_DATA ASAP1B_ETK KP_BLOB 0x3824E0 1 2 /end IF_DATA BIT_MASK 0xFFFF /end MEASUREMENT
/begin MEASUREMENT drlsolf_w "gefilterte énderung SollfÅllung" SWORD rel_sw_q0p0234 0 0 -768.000000 767.976562 /begin IF_DATA ASAP1B_ETK KP_BLOB 0x381F46 1 2 /end IF_DATA BIT_MASK 0xFFFF /end MEASUREMENT
/begin MEASUREMENT dvprae_w "PrÑdizierter Geschwindigkeitsanteil" UWORD vfzg_uw_q0p00781 0 0 0.000000 511.992188 /begin IF_DATA ASAP1B_ETK KP_BLOB 0x3824E2 1 2 /end IF_DATA BIT_MASK 0xFFFF /end MEASUREMENT
/begin MEASUREMENT dvsi_w "Differenz zwischen Soll- und prÑdizierter Fahrzeuggeschwindigkeit" SWORD vfzg_sw_q0p00781 0 0 -256.000000 255.992188 /begin IF_DATA ASAP1B_ETK KP_BLOB 0x3824E4 1 2 /end IF_DATA BIT_MASK 0xFFFF /end MEASUREMENT
/begin MEASUREMENT dwkrz_0_A "zyl.ind. ZW-SpÑtverstellung inkl. Dyn.vorhalt" SBYTE zw_sb_q0p75 0 0 -96.000000 95.250000 /begin IF_DATA ASAP1B_ETK KP_BLOB 0x380BBA 1 1 /end IF_DATA BIT_MASK 0xFF /end MEASUREMENT
/begin MEASUREMENT dwkrz_1_A "zyl.ind. ZW-SpÑtverstellung inkl. Dyn.vorhalt" SBYTE zw_sb_q0p75 0 0 -96.000000 95.250000 /begin IF_DATA ASAP1B_ETK KP_BLOB 0x380BBB 1 1 /end IF_DATA BIT_MASK 0xFF /end MEASUREMENT
/begin MEASUREMENT dwkrz_2_A "zyl.ind. ZW-SpÑtverstellung inkl. Dyn.vorhalt" SBYTE zw_sb_q0p75 0 0 -96.000000 95.250000 /begin IF_DATA ASAP1B_ETK KP_BLOB 0x380BBC 1 1 /end IF_DATA BIT_MASK 0xFF /end MEASUREMENT
/begin MEASUREMENT dwkrz_3_A "zyl.ind. ZW-SpÑtverstellung inkl. Dyn.vorhalt" SBYTE zw_sb_q0p75 0 0 -96.000000 95.250000 /begin IF_DATA ASAP1B_ETK KP_BLOB 0x380BBD 1 1 /end IF_DATA BIT_MASK 0xFF /end MEASUREMENT
/begin MEASUREMENT dwkrz_4_A "zyl.ind. ZW-SpÑtverstellung inkl. Dyn.vorhalt" SBYTE zw_sb_q0p75 0 0 -96.000000 95.250000 /begin IF_DATA ASAP1B_ETK KP_BLOB 0x380BBE 1 1 /end IF_DATA BIT_MASK 0xFF /end MEASUREMENT
/begin MEASUREMENT dwkrz_5_A "zyl.ind. ZW-SpÑtverstellung inkl. Dyn.vorhalt" SBYTE zw_sb_q0p75 0 0 -96.000000 95.250000 /begin IF_DATA ASAP1B_ETK KP_BLOB 0x380BBF 1 1 /end IF_DATA BIT_MASK 0xFF /end MEASUREMENT
/begin MEASUREMENT dwkrz_6_A "zyl.ind. ZW-SpÑtverstellung inkl. Dyn.vorhalt" SBYTE zw_sb_q0p75 0 0 -96.000000 95.250000 /begin IF_DATA ASAP1B_ETK KP_BLOB 0x380BC0 1 1 /end IF_DATA BIT_MASK 0xFF /end MEASUREMENT
/begin MEASUREMENT dwkrz_7_A "zyl.ind. ZW-SpÑtverstellung inkl. Dyn.vorhalt" SBYTE zw_sb_q0p75 0 0 -96.000000 95.250000 /begin IF_DATA ASAP1B_ETK KP_BLOB 0x380BC1 1 1 /end IF_DATA BIT_MASK 0xFF /end MEASUREMENT
/begin MEASUREMENT dzwkg "Delta-ZÅndwinkel Verschiebung Klopfgrenze" SBYTE zw_sb_q0p75 0 0 -96.000000 95.250000 /begin IF_DATA ASAP1B_ETK KP_BLOB 0x380D1C 1 1 /end IF_DATA BIT_MASK 0xFF /end MEASUREMENT
/begin MEASUREMENT dzwmna "Delta-ZÅndwinkel Minimum" SBYTE zw_sb_q0p75 0 0 -96.000000 95.250000 /begin IF_DATA ASAP1B_ETK KP_BLOB 0x380D17 1 1 /end IF_DATA BIT_MASK 0xFF /end MEASUREMENT
/begin MEASUREMENT dzwnwsu "" SBYTE zw_sb_q0p75 0 0 -96.000000 95.250000 /begin IF_DATA ASAP1B_ETK KP_BLOB 0x380D1D 1 1 /end IF_DATA BIT_MASK 0xFF /end MEASUREMENT
/begin MEASUREMENT dzwoag "abgasrÅckfÅhrratenabh. ZÅndwinkelkorrektur des optimalen ZW" SBYTE zw_sb_q0p75 0 0 -96.000000 95.250000 /begin IF_DATA ASAP1B_ETK KP_BLOB 0x380C3F 1 1 /end IF_DATA BIT_MASK 0xFF /end MEASUREMENT
/begin MEASUREMENT dzwol "lambdaabh. ZÅndwinkelkorrektur des optimalen ZW" SBYTE zw_sb_q0p75 0 0 -96.000000 95.250000 /begin IF_DATA ASAP1B_ETK KP_BLOB 0x380C40 1 1 /end IF_DATA BIT_MASK 0xFF /end MEASUREMENT
/begin MEASUREMENT dzwspae "Korrektur-ZÅndwinkel fÅr den spÑtest erlaubten ZÅndwinkel" SBYTE zw_sb_q0p75 0 0 -96.000000 95.250000 /begin IF_DATA ASAP1B_ETK KP_BLOB 0x380D18 1 1 /end IF_DATA BIT_MASK 0xFF /end MEASUREMENT
/begin MEASUREMENT dzwwl "Delta Zuendwinkel aus Warmlauf" SBYTE zw_sb_q0p75 0 0 -96.000000 95.250000 /begin IF_DATA ASAP1B_ETK KP_BLOB 0x380D21 1 1 /end IF_DATA BIT_MASK 0xFF /end MEASUREMENT
/begin MEASUREMENT dzwzk "delta ZÅndwinkel bei Dauerklopfen" SBYTE zw_sb_q0p75 0 0 -96.000000 95.250000 /begin IF_DATA ASAP1B_ETK KP_BLOB 0x380D1E 1 1 /end IF_DATA BIT_MASK 0xFF /end MEASUREMENT
/begin MEASUREMENT ei_adcc_um "irreversibles Fehlerbit bei der AD-Wandler-öberwachung" UWORD B_TRUE___UW 0 0 0.000000 0.000000 /begin IF_DATA ASAP1B_ETK KP_BLOB 0xFD86 0 2 /end IF_DATA BIT_MASK 0x200 /end MEASUREMENT
/begin MEASUREMENT ei_ipa_um "irrev. Fehlerbit fÅr unterer DK-Anschlag im ungÅltigen Bereich in der Fkt-öberw." UWORD B_TRUE___UW 0 0 0.000000 0.000000 /begin IF_DATA ASAP1B_ETK KP_BLOB 0xFD84 0 2 /end IF_DATA BIT_MASK 0x4000 /end MEASUREMENT
/begin MEASUREMENT ei_msrc_uc "" UWORD B_TRUE___UW 0 0 0.000000 0.000000 /begin IF_DATA ASAP1B_ETK KP_BLOB 0xFD86 0 2 /end IF_DATA BIT_MASK 0x8000 /end MEASUREMENT
/begin MEASUREMENT ei_msrc_um "irreversibles Fehlerbit bei der MSR-öberwachung der FunktionsÅberwachung" UWORD B_TRUE___UW 0 0 0.000000 0.000000 /begin IF_DATA ASAP1B_ETK KP_BLOB 0xFD86 0 2 /end IF_DATA BIT_MASK 0x40 /end MEASUREMENT
/begin MEASUREMENT ei_mver_uc "" UWORD B_TRUE___UW 0 0 0.000000 0.000000 /begin IF_DATA ASAP1B_ETK KP_BLOB 0xFD88 0 2 /end IF_DATA BIT_MASK 0x2 /end MEASUREMENT
/begin MEASUREMENT ei_mver_um "irreversibles Fehlerbit beim Momentenvergleich der FunktionsÅberwachung" UWORD B_TRUE___UW 0 0 0.000000 0.000000 /begin IF_DATA ASAP1B_ETK KP_BLOB 0xFD86 0 2 /end IF_DATA BIT_MASK 0x80 /end MEASUREMENT
/begin MEASUREMENT ei_nc_um "irreversibles Fehlerbit beim Drehzahlvergleich der FunktionsÅberwachung" UWORD B_TRUE___UW 0 0 0.000000 0.000000 /begin IF_DATA ASAP1B_ETK KP_BLOB 0xFD84 0 2 /end IF_DATA BIT_MASK 0x800 /end MEASUREMENT
/begin MEASUREMENT ei_reac_uc "" UWORD B_TRUE___UW 0 0 0.000000 0.000000 /begin IF_DATA ASAP1B_ETK KP_BLOB 0xFD88 0 2 /end IF_DATA BIT_MASK 0x4 /end MEASUREMENT
/begin MEASUREMENT ei_reac_um "irreversibles Fehlerbit der FehlerreaktionsÅberwachung der FunktionsÅberwachung" UWORD B_TRUE___UW 0 0 0.000000 0.000000 /begin IF_DATA ASAP1B_ETK KP_BLOB 0xFD86 0 2 /end IF_DATA BIT_MASK 0x100 /end MEASUREMENT
/begin MEASUREMENT ei_rlc_um "irreversibles Fehlerbit beim rl-Vergleich mit der Funktion in der FunktionsÅberw" UWORD B_TRUE___UW 0 0 0.000000 0.000000 /begin IF_DATA ASAP1B_ETK KP_BLOB 0xFD84 0 2 /end IF_DATA BIT_MASK 0x8000 /end MEASUREMENT
/begin MEASUREMENT ei_rlip_um "irreversibles Fehlerbit beim rl/rlip-Vergleich der FunktionsÅberwachung" UWORD B_TRUE___UW 0 0 0.000000 0.000000 /begin IF_DATA ASAP1B_ETK KP_BLOB 0xFD86 0 2 /end IF_DATA BIT_MASK 0x1 /end MEASUREMENT
/begin MEASUREMENT ei_spsc_um "irreversibles Fehlerbit bei d. Sollwertplausibilisierung d. FunktionsÅberwachung" UWORD B_TRUE___UW 0 0 0.000000 0.000000 /begin IF_DATA ASAP1B_ETK KP_BLOB 0xFD86 0 2 /end IF_DATA BIT_MASK 0x4 /end MEASUREMENT
/begin MEASUREMENT ei_zwc_um "irreversibles Fehlerbit bei der ZÅndwinkelÅberwachung der FunktionsÅberwachung" UWORD B_TRUE___UW 0 0 0.000000 0.000000 /begin IF_DATA ASAP1B_ETK KP_BLOB 0xFD84 0 2 /end IF_DATA BIT_MASK 0x2000 /end MEASUREMENT
/begin MEASUREMENT esst_sbf02mfsb "" UWORD dez___UW 0 0 0.000000 65535.000000 /begin IF_DATA ASAP1B_ETK KP_BLOB 0x3824E6 1 2 /end IF_DATA BIT_MASK 0xFFFF /end MEASUREMENT
/begin MEASUREMENT esst_snm08__ub "" UWORD dez___UW 0 0 0.000000 65535.000000 /begin IF_DATA ASAP1B_ETK KP_BLOB 0x380E2C 1 2 /end IF_DATA BIT_MASK 0xFFFF /end MEASUREMENT
/begin MEASUREMENT esst_snm12esub "" UWORD dez___UW 0 0 0.000000 65535.000000 /begin IF_DATA ASAP1B_ETK KP_BLOB 0x380E74 1 2 /end IF_DATA BIT_MASK 0xFFFF /end MEASUREMENT
/begin MEASUREMENT esst_snm16zuub "" UWORD dez___UW 0 0 0.000000 65535.000000 /begin IF_DATA ASAP1B_ETK KP_BLOB 0x380E80 1 2 /end IF_DATA BIT_MASK 0xFFFF /end MEASUREMENT
/begin MEASUREMENT esst_srl03mfuw "" UWORD dez___UW 0 0 0.000000 65535.000000 /begin IF_DATA ASAP1B_ETK KP_BLOB 0x3824E8 1 2 /end IF_DATA BIT_MASK 0xFFFF /end MEASUREMENT
/begin MEASUREMENT esst_srl06esub "" UWORD dez___UW 0 0 0.000000 65535.000000 /begin IF_DATA ASAP1B_ETK KP_BLOB 0x380E88 1 2 /end IF_DATA BIT_MASK 0xFFFF /end MEASUREMENT
/begin MEASUREMENT esst_srl12zuub "" UWORD dez___UW 0 0 0.000000 65535.000000 /begin IF_DATA ASAP1B_ETK KP_BLOB 0x380E8E 1 2 /end IF_DATA BIT_MASK 0xFFFF /end MEASUREMENT
/begin MEASUREMENT esst_sta12wlub "" UWORD dez___UW 0 0 0.000000 65535.000000 /begin IF_DATA ASAP1B_ETK KP_BLOB 0x380E96 1 2 /end IF_DATA BIT_MASK 0xFFFF /end MEASUREMENT
/begin MEASUREMENT esst_stm06__ub "" UWORD dez___UW 0 0 0.000000 65535.000000 /begin IF_DATA ASAP1B_ETK KP_BLOB 0x380E54 1 2 /end IF_DATA BIT_MASK 0xFFFF /end MEASUREMENT
/begin MEASUREMENT esst_stm12esub "" UWORD dez___UW 0 0 0.000000 65535.000000 /begin IF_DATA ASAP1B_ETK KP_BLOB 0x380EA0 1 2 /end IF_DATA BIT_MASK 0xFFFF /end MEASUREMENT
/begin MEASUREMENT etazwmn "Minimum-ZÅndwinkelwirkungsgrad" UBYTE rel_ub_b127p5 0 0 0.000000 127.500000 /begin IF_DATA ASAP1B_ETK KP_BLOB 0xF9FA 0 1 /end IF_DATA BIT_MASK 0xFF /end MEASUREMENT
/begin MEASUREMENT etazw_uc "" UBYTE rel_ub_b127p5 0 0 0.000000 127.500000 /begin IF_DATA ASAP1B_ETK KP_BLOB 0x380C7B 1 1 /end IF_DATA BIT_MASK 0xFF /end MEASUREMENT
/begin MEASUREMENT etazw_um "Ist-ZÅndwinkelwirkungsgrad in der FunktionsÅberwachung" UBYTE rel_ub_b127p5 0 0 0.000000 127.500000 /begin IF_DATA ASAP1B_ETK KP_BLOB 0x380C64 1 1 /end IF_DATA BIT_MASK 0xFF /end MEASUREMENT
/begin MEASUREMENT evz_austot "Einspritzausblendmuster total" UBYTE dez 0 0 0.000000 255.000000 /begin IF_DATA ASAP1B_ETK KP_BLOB 0x380B1E 1 1 /end IF_DATA BIT_MASK 0xFF /end MEASUREMENT
/begin MEASUREMENT evz_aus_uc "Einspritzausblendmuster im Befehlstest" UBYTE dez 0 0 0.000000 255.000000 /begin IF_DATA ASAP1B_ETK KP_BLOB 0x380C6E 1 1 /end IF_DATA BIT_MASK 0xFF /end MEASUREMENT
/begin MEASUREMENT evz_aus_um "Einspritzausblendmuster in der FunktionsÅberwachung" UBYTE dez 0 0 0.000000 255.000000 /begin IF_DATA ASAP1B_ETK KP_BLOB 0x380903 1 1 /end IF_DATA BIT_MASK 0xFF /end MEASUREMENT
/begin MEASUREMENT E_dk "Errorflag: DK - Potentiometer" UWORD B_TRUE___UW 0 0 0.000000 0.000000 /begin IF_DATA ASAP1B_ETK KP_BLOB 0x383B0A 1 2 /end IF_DATA BIT_MASK 0x1 /end MEASUREMENT
/begin MEASUREMENT E_lm "Errorflag: Hauptlastsensor" UWORD B_TRUE___UW 0 0 0.000000 0.000000 /begin IF_DATA ASAP1B_ETK KP_BLOB 0x383B9C 1 2 /end IF_DATA BIT_MASK 0x1 /end MEASUREMENT
/begin MEASUREMENT fnwue "Gewichtungsfaktor NockenwellenÅberschneidung (Einla·)" UBYTE fak_ub_b1 0 0 0.000000 0.996094 /begin IF_DATA ASAP1B_ETK KP_BLOB 0x380AFB 1 1 /end IF_DATA BIT_MASK 0xFF /end MEASUREMENT
/begin MEASUREMENT ftsdrl "Faktor Lastdynamik zur Schlie·zeitberechnung" UBYTE fak_ub_b8 0 0 0.000000 7.968750 /begin IF_DATA ASAP1B_ETK KP_BLOB 0x380D23 1 1 /end IF_DATA BIT_MASK 0xFF /end MEASUREMENT
/begin MEASUREMENT ftsdyn "Faktor Drehzahldynamik zur Schlie·zeitberechnung" UBYTE fak_ub_b8 0 0 0.000000 7.968750 /begin IF_DATA ASAP1B_ETK KP_BLOB 0x380D24 1 1 /end IF_DATA BIT_MASK 0xFF /end MEASUREMENT
/begin MEASUREMENT ftsub "Faktor BatterieabhÑngigkeit bei Schlie·zeitberechnung" UBYTE fak_ub_b8 0 0 0.000000 7.968750 /begin IF_DATA ASAP1B_ETK KP_BLOB 0x380D25 1 1 /end IF_DATA BIT_MASK 0xFF /end MEASUREMENT
/begin MEASUREMENT ipa_c_um "FehlerzÑhler fÅr unterer DK-Anschlag im ungÅltigen Bereich f. d. FunktionsÅberw." UBYTE t40ms_ub_b10200 0 0 0.000000 10200.000000 /begin IF_DATA ASAP1B_ETK KP_BLOB 0x38090F 1 1 /end IF_DATA BIT_MASK 0xFF /end MEASUREMENT
/begin MEASUREMENT iUipoti1_w "" UWORD DEZ___UW 0 0 0.000000 65535.000000 /begin IF_DATA ASAP1B_ETK KP_BLOB 0xF7FA 0 2 /end IF_DATA BIT_MASK 0xFFFF /end MEASUREMENT
/begin MEASUREMENT iUipoti2_w "" UWORD DEZ___UW 0 0 0.000000 65535.000000 /begin IF_DATA ASAP1B_ETK KP_BLOB 0xF7F6 0 2 /end IF_DATA BIT_MASK 0xFFFF /end MEASUREMENT
/begin MEASUREMENT iUspoti1_w "" UWORD DEZ___UW 0 0 0.000000 65535.000000 /begin IF_DATA ASAP1B_ETK KP_BLOB 0xF7EC 0 2 /end IF_DATA BIT_MASK 0xFFFF /end MEASUREMENT
/begin MEASUREMENT iUspoti2_w "" UWORD DEZ___UW 0 0 0.000000 65535.000000 /begin IF_DATA ASAP1B_ETK KP_BLOB 0xF7EA 0 2 /end IF_DATA BIT_MASK 0xFFFF /end MEASUREMENT
/begin MEASUREMENT ivmax "Initialisierungswert Integrator fÅr VMAX-Regelung" SBYTE rel_sb_q0p78 0 0 -99.840000 99.060000 /begin IF_DATA ASAP1B_ETK KP_BLOB 0x380C56 1 1 /end IF_DATA BIT_MASK 0xFF /end MEASUREMENT
/begin MEASUREMENT mdif_w_uc "" SWORD rel_ub_q0p3906 0 0 -12800.000000 12799.609375 /begin IF_DATA ASAP1B_ETK KP_BLOB 0x38261C 1 2 /end IF_DATA BIT_MASK 0xFFFF /end MEASUREMENT
/begin MEASUREMENT mdif_w_um "Differenz zwischen zulÑssigem und Ist-Moment in der FunktionsÅberwachung" SWORD rel_ub_q0p3906 0 0 -12800.000000 12799.609375 /begin IF_DATA ASAP1B_ETK KP_BLOB 0x3825F6 1 2 /end IF_DATA BIT_MASK 0xFFFF /end MEASUREMENT
/begin MEASUREMENT mdst08_uc "" UWORD dez___UW 0 0 0.000000 65535.000000 /begin IF_DATA ASAP1B_ETK KP_BLOB 0x38261A 1 2 /end IF_DATA BIT_MASK 0xFFFF /end MEASUREMENT
/begin MEASUREMENT mdst08_um "" UWORD dez___UW 0 0 0.000000 65535.000000 /begin IF_DATA ASAP1B_ETK KP_BLOB 0x38095A 1 2 /end IF_DATA BIT_MASK 0xFFFF /end MEASUREMENT
/begin MEASUREMENT mfgr_uc "Momentenwunsch aus der Fahrgeschwindigkeitsregelung im Befehlstest" UBYTE rel_ub_q0p3906___UB 0 0 0.000000 99.609375 /begin IF_DATA ASAP1B_ETK KP_BLOB 0x380C77 1 1 /end IF_DATA BIT_MASK 0xFF /end MEASUREMENT
/begin MEASUREMENT mfgr_um "Momentenwunsch aus der Fahrgeschwindigkeitsregelung fÅr die FunktionsÅberwachung" UBYTE rel_ub_q0p3906___UB 0 0 0.000000 99.609375 /begin IF_DATA ASAP1B_ETK KP_BLOB 0x380924 1 1 /end IF_DATA BIT_MASK 0xFF /end MEASUREMENT
/begin MEASUREMENT mifa "indiziertes Motormoment Fahrerwunsch" UBYTE rel_ub_b99p6 0 0 0.000000 99.609375 /begin IF_DATA ASAP1B_ETK KP_BLOB 0x380C3C 1 1 /end IF_DATA BIT_MASK 0xFF /end MEASUREMENT
/begin MEASUREMENT mifab_w "begrenztes indiziertes Motormoment Fahrerwunsch" UWORD rel_uw_b100 0 0 0.000000 99.998474 /begin IF_DATA ASAP1B_ETK KP_BLOB 0x382480 1 2 /end IF_DATA BIT_MASK 0xFFFF /end MEASUREMENT
/begin MEASUREMENT mifa_uc "FGR-/ACC- oder Fahrerwunschmoment der Funktion im Befehlstest" UBYTE rel_ub_q0p3906___UB 0 0 0.000000 99.609375 /begin IF_DATA ASAP1B_ETK KP_BLOB 0x380C6F 1 1 /end IF_DATA BIT_MASK 0xFF /end MEASUREMENT
/begin MEASUREMENT mifa_um "FGR-/ACC- oder Fahrerwunschmoment der Funktion fÅr die FunktionsÅberwachung" UBYTE rel_ub_q0p3906___UB 0 0 0.000000 99.609375 /begin IF_DATA ASAP1B_ETK KP_BLOB 0x380904 1 1 /end IF_DATA BIT_MASK 0xFF /end MEASUREMENT
/begin MEASUREMENT migs_w "Indiziertes Soll-Motormoment GS fÅr schnellen Eingriff" UWORD rel_uw_b100 0 0 0.000000 99.998474 /begin IF_DATA ASAP1B_ETK KP_BLOB 0x380FFC 1 2 /end IF_DATA BIT_MASK 0xFFFF /end MEASUREMENT
/begin MEASUREMENT miist_w "indiziertes Motormoment Hochdruckphase Istwert" UWORD rel_uw_b100 0 0 0.000000 99.998474 /begin IF_DATA ASAP1B_ETK KP_BLOB 0x3824A6 1 2 /end IF_DATA BIT_MASK 0xFFFF /end MEASUREMENT
/begin MEASUREMENT milsol_uc "Fahrermomentenwunsch fÅr FÅllung im Befehlstest" UBYTE rel_ub_q0p3906___UB 0 0 0.000000 99.609375 /begin IF_DATA ASAP1B_ETK KP_BLOB 0x380C70 1 1 /end IF_DATA BIT_MASK 0xFF /end MEASUREMENT
/begin MEASUREMENT milsol_um "Fahrermomentenwunsch fÅr FÅllung fÅr die FunktionsÅberwachung" UBYTE rel_ub_q0p3906___UB 0 0 0.000000 99.609375 /begin IF_DATA ASAP1B_ETK KP_BLOB 0x380905 1 1 /end IF_DATA BIT_MASK 0xFF /end MEASUREMENT
/begin MEASUREMENT milsol_w "Fahrermomentenwunsch fÅr FÅllung" UWORD rel_uw_b100 0 0 0.000000 99.998474 /begin IF_DATA ASAP1B_ETK KP_BLOB 0x382490 1 2 /end IF_DATA BIT_MASK 0xFFFF /end MEASUREMENT
/begin MEASUREMENT miopt_uc "" UBYTE rel_ub_b99p6 0 0 0.000000 99.609375 /begin IF_DATA ASAP1B_ETK KP_BLOB 0x380C7C 1 1 /end IF_DATA BIT_MASK 0xFF /end MEASUREMENT
/begin MEASUREMENT miopt_um "optimales indiziertes Moment in der FunktionsÅberwachung" UBYTE rel_ub_b99p6 0 0 0.000000 99.609375 /begin IF_DATA ASAP1B_ETK KP_BLOB 0x380C65 1 1 /end IF_DATA BIT_MASK 0xFF /end MEASUREMENT
/begin MEASUREMENT mired "indiziertes Reduktionsmoment zur VMAX-Regelung" UBYTE rel_ub_b99p6 0 0 0.000000 99.609375 /begin IF_DATA ASAP1B_ETK KP_BLOB 0x380C57 1 1 /end IF_DATA BIT_MASK 0xFF /end MEASUREMENT
/begin MEASUREMENT misolv_w "Indiziertes resultierendes Sollmoment vor Momentenbegrenzung" UWORD rel_uw_b100 0 0 0.000000 99.998474 /begin IF_DATA ASAP1B_ETK KP_BLOB 0x382482 1 2 /end IF_DATA BIT_MASK 0xFFFF /end MEASUREMENT
/begin MEASUREMENT misol_w "Indiziertes resultierendes Sollmoment" UWORD rel_uw_b100 0 0 0.000000 99.998474 /begin IF_DATA ASAP1B_ETK KP_BLOB 0xF9D0 0 2 /end IF_DATA BIT_MASK 0xFFFF /end MEASUREMENT
/begin MEASUREMENT mivmxs "ind. Soll-Motormoment zur Integratorinitialisierung VMAX-Regelung" SBYTE rel_sb_q0p78 0 0 -99.840000 99.060000 /begin IF_DATA ASAP1B_ETK KP_BLOB 0x380C58 1 1 /end IF_DATA BIT_MASK 0xFF /end MEASUREMENT
/begin MEASUREMENT mivmx_w "indiziertes Soll-Moment fÅr VMAX-Begrenzung" UWORD rel_uw_b100 0 0 0.000000 99.998474 /begin IF_DATA ASAP1B_ETK KP_BLOB 0x3824EA 1 2 /end IF_DATA BIT_MASK 0xFFFF /end MEASUREMENT
/begin MEASUREMENT mi_uc "Berechnetes Ist-Moment im Befehlstest" UBYTE rel_ub_b99p6 0 0 0.000000 99.609375 /begin IF_DATA ASAP1B_ETK KP_BLOB 0x380C7D 1 1 /end IF_DATA BIT_MASK 0xFF /end MEASUREMENT
/begin MEASUREMENT mi_um "Berechnetes Ist-Moment in der FunktionsÅberwachung" UBYTE rel_ub_b99p6 0 0 0.000000 99.609375 /begin IF_DATA ASAP1B_ETK KP_BLOB 0x380929 1 1 /end IF_DATA BIT_MASK 0xFF /end MEASUREMENT
/begin MEASUREMENT mmsr_uc "" UBYTE rel_ub_q0p3906___UB 0 0 0.000000 99.609375 /begin IF_DATA ASAP1B_ETK KP_BLOB 0x380C78 1 1 /end IF_DATA BIT_MASK 0xFF /end MEASUREMENT
/begin MEASUREMENT mmsr_um "zulÑssiger MSR-Momentenwunsch fÅr die FunktionsÅberwachung" UBYTE rel_ub_q0p3906___UB 0 0 0.000000 99.609375 /begin IF_DATA ASAP1B_ETK KP_BLOB 0x380926 1 1 /end IF_DATA BIT_MASK 0xFF /end MEASUREMENT
/begin MEASUREMENT mped_uc "zulÑssiges indiziertes Moment aus Fahrpedal im Befehlstest" UBYTE rel_ub_b99p6 0 0 0.000000 99.609375 /begin IF_DATA ASAP1B_ETK KP_BLOB 0x380C7F 1 1 /end IF_DATA BIT_MASK 0xFF /end MEASUREMENT
/begin MEASUREMENT mped_um "zulÑssiges indiziertes Moment aus Fahrpedal in der FunktionsÅberwachung" UBYTE rel_ub_b99p6 0 0 0.000000 99.609375 /begin IF_DATA ASAP1B_ETK KP_BLOB 0x380C67 1 1 /end IF_DATA BIT_MASK 0xFF /end MEASUREMENT
/begin MEASUREMENT msrc_c_uc "" UBYTE t40ms_ub_b10200 0 0 0.000000 10200.000000 /begin IF_DATA ASAP1B_ETK KP_BLOB 0x380C79 1 1 /end IF_DATA BIT_MASK 0xFF /end MEASUREMENT
/begin MEASUREMENT msrc_c_um "FehlerzÑhler fÅr MSR-Eingriff-öberwachung der FunktionsÅberwachung" UBYTE t40ms_ub_b10200 0 0 0.000000 10200.000000 /begin IF_DATA ASAP1B_ETK KP_BLOB 0x380927 1 1 /end IF_DATA BIT_MASK 0xFF /end MEASUREMENT
/begin MEASUREMENT mver_c_uc "FehlerzÑhler fÅr Momentenvergleich im Befehlstest" UBYTE t40ms_ub_b10200 0 0 0.000000 10200.000000 /begin IF_DATA ASAP1B_ETK KP_BLOB 0x380C8E 1 1 /end IF_DATA BIT_MASK 0xFF /end MEASUREMENT
/begin MEASUREMENT mver_c_um "FehlerzÑhler fÅr Momentenvergleich der FunktionsÅberwachung" UBYTE t40ms_ub_b10200 0 0 0.000000 10200.000000 /begin IF_DATA ASAP1B_ETK KP_BLOB 0x380937 1 1 /end IF_DATA BIT_MASK 0xFF /end MEASUREMENT
/begin MEASUREMENT mzfo_uc "Gefiltertes zulÑssiges Moment inclusive Offset im Befehlstest" UBYTE rel_ub_q0p3906___UB 0 0 0.000000 99.609375 /begin IF_DATA ASAP1B_ETK KP_BLOB 0x380C8F 1 1 /end IF_DATA BIT_MASK 0xFF /end MEASUREMENT
/begin MEASUREMENT mzfo_um "gefiltertes zulÑssiges Moment inclusive Offset in der FunktionsÅberwachung" UBYTE rel_ub_q0p3906___UB 0 0 0.000000 99.609375 /begin IF_DATA ASAP1B_ETK KP_BLOB 0x380938 1 1 /end IF_DATA BIT_MASK 0xFF /end MEASUREMENT
/begin MEASUREMENT mzf_low_uc "" UBYTE rel_ub_q0p00153 0 0 0.000000 0.389074 /begin IF_DATA ASAP1B_ETK KP_BLOB 0x380C83 1 1 /end IF_DATA BIT_MASK 0xFF /end MEASUREMENT
/begin MEASUREMENT mzf_low_um "Nachkommastellen fÅr gefiltertes zulÑssiges Moment der FunktionsÅberwachung" UBYTE rel_ub_q0p00153 0 0 0.000000 0.389074 /begin IF_DATA ASAP1B_ETK KP_BLOB 0x38092C 1 1 /end IF_DATA BIT_MASK 0xFF /end MEASUREMENT
/begin MEASUREMENT mzf_ptr_uc "" UBYTE dez 0 0 0.000000 255.000000 /begin IF_DATA ASAP1B_ETK KP_BLOB 0x380C84 1 1 /end IF_DATA BIT_MASK 0xFF /end MEASUREMENT
/begin MEASUREMENT mzf_ptr_um "" UBYTE dez 0 0 0.000000 255.000000 /begin IF_DATA ASAP1B_ETK KP_BLOB 0x38092D 1 1 /end IF_DATA BIT_MASK 0xFF /end MEASUREMENT
/begin MEASUREMENT mzf_reg_uc_0___A "" UBYTE rel_ub_q0p3906___UB 0 0 0.000000 99.609375 /begin IF_DATA ASAP1B_ETK KP_BLOB 0x380C85 1 1 /end IF_DATA BIT_MASK 0xFF /end MEASUREMENT
/begin MEASUREMENT mzf_reg_uc_1___A "" UBYTE rel_ub_q0p3906___UB 0 0 0.000000 99.609375 /begin IF_DATA ASAP1B_ETK KP_BLOB 0x380C86 1 1 /end IF_DATA BIT_MASK 0xFF /end MEASUREMENT
/begin MEASUREMENT mzf_reg_uc_2___A "" UBYTE rel_ub_q0p3906___UB 0 0 0.000000 99.609375 /begin IF_DATA ASAP1B_ETK KP_BLOB 0x380C87 1 1 /end IF_DATA BIT_MASK 0xFF /end MEASUREMENT
/begin MEASUREMENT mzf_reg_uc_3___A "" UBYTE rel_ub_q0p3906___UB 0 0 0.000000 99.609375 /begin IF_DATA ASAP1B_ETK KP_BLOB 0x380C88 1 1 /end IF_DATA BIT_MASK 0xFF /end MEASUREMENT
/begin MEASUREMENT mzf_reg_uc_4___A "" UBYTE rel_ub_q0p3906___UB 0 0 0.000000 99.609375 /begin IF_DATA ASAP1B_ETK KP_BLOB 0x380C89 1 1 /end IF_DATA BIT_MASK 0xFF /end MEASUREMENT
/begin MEASUREMENT mzf_reg_uc_5___A "" UBYTE rel_ub_q0p3906___UB 0 0 0.000000 99.609375 /begin IF_DATA ASAP1B_ETK KP_BLOB 0x380C8A 1 1 /end IF_DATA BIT_MASK 0xFF /end MEASUREMENT
/begin MEASUREMENT mzf_reg_uc_6___A "" UBYTE rel_ub_q0p3906___UB 0 0 0.000000 99.609375 /begin IF_DATA ASAP1B_ETK KP_BLOB 0x380C8B 1 1 /end IF_DATA BIT_MASK 0xFF /end MEASUREMENT
/begin MEASUREMENT mzf_reg_uc_7___A "" UBYTE rel_ub_q0p3906___UB 0 0 0.000000 99.609375 /begin IF_DATA ASAP1B_ETK KP_BLOB 0x380C8C 1 1 /end IF_DATA BIT_MASK 0xFF /end MEASUREMENT
/begin MEASUREMENT mzf_reg_um_0___A "" UBYTE rel_ub_q0p3906___UB 0 0 0.000000 99.609375 /begin IF_DATA ASAP1B_ETK KP_BLOB 0x38092E 1 1 /end IF_DATA BIT_MASK 0xFF /end MEASUREMENT
/begin MEASUREMENT mzf_reg_um_1___A "" UBYTE rel_ub_q0p3906___UB 0 0 0.000000 99.609375 /begin IF_DATA ASAP1B_ETK KP_BLOB 0x38092F 1 1 /end IF_DATA BIT_MASK 0xFF /end MEASUREMENT
/begin MEASUREMENT mzf_reg_um_2___A "" UBYTE rel_ub_q0p3906___UB 0 0 0.000000 99.609375 /begin IF_DATA ASAP1B_ETK KP_BLOB 0x380930 1 1 /end IF_DATA BIT_MASK 0xFF /end MEASUREMENT
/begin MEASUREMENT mzf_reg_um_3___A "" UBYTE rel_ub_q0p3906___UB 0 0 0.000000 99.609375 /begin IF_DATA ASAP1B_ETK KP_BLOB 0x380931 1 1 /end IF_DATA BIT_MASK 0xFF /end MEASUREMENT
/begin MEASUREMENT mzf_reg_um_4___A "" UBYTE rel_ub_q0p3906___UB 0 0 0.000000 99.609375 /begin IF_DATA ASAP1B_ETK KP_BLOB 0x380932 1 1 /end IF_DATA BIT_MASK 0xFF /end MEASUREMENT
/begin MEASUREMENT mzf_reg_um_5___A "" UBYTE rel_ub_q0p3906___UB 0 0 0.000000 99.609375 /begin IF_DATA ASAP1B_ETK KP_BLOB 0x380933 1 1 /end IF_DATA BIT_MASK 0xFF /end MEASUREMENT
/begin MEASUREMENT mzf_reg_um_6___A "" UBYTE rel_ub_q0p3906___UB 0 0 0.000000 99.609375 /begin IF_DATA ASAP1B_ETK KP_BLOB 0x380934 1 1 /end IF_DATA BIT_MASK 0xFF /end MEASUREMENT
/begin MEASUREMENT mzf_reg_um_7___A "" UBYTE rel_ub_q0p3906___UB 0 0 0.000000 99.609375 /begin IF_DATA ASAP1B_ETK KP_BLOB 0x380935 1 1 /end IF_DATA BIT_MASK 0xFF /end MEASUREMENT
/begin MEASUREMENT mzf_uc "" UBYTE rel_ub_q0p3906___UB 0 0 0.000000 99.609375 /begin IF_DATA ASAP1B_ETK KP_BLOB 0x380C8D 1 1 /end IF_DATA BIT_MASK 0xFF /end MEASUREMENT
/begin MEASUREMENT mzf_um "gefiltertes zulÑssiges Moment der FunktionsÅberwachung" UBYTE rel_ub_q0p3906___UB 0 0 0.000000 99.609375 /begin IF_DATA ASAP1B_ETK KP_BLOB 0x380936 1 1 /end IF_DATA BIT_MASK 0xFF /end MEASUREMENT
/begin MEASUREMENT mzo_uc "" UBYTE rel_ub_b99p6 0 0 0.000000 99.609375 /begin IF_DATA ASAP1B_ETK KP_BLOB 0x380C81 1 1 /end IF_DATA BIT_MASK 0xFF /end MEASUREMENT
/begin MEASUREMENT mzo_um "Toleranz-Offset fÅrs zulÑssige Moment in der FunktionsÅberwachung" UBYTE rel_ub_b99p6 0 0 0.000000 99.609375 /begin IF_DATA ASAP1B_ETK KP_BLOB 0x38092A 1 1 /end IF_DATA BIT_MASK 0xFF /end MEASUREMENT
/begin MEASUREMENT mz_uc "" UBYTE rel_ub_b99p6 0 0 0.000000 99.609375 /begin IF_DATA ASAP1B_ETK KP_BLOB 0x380C82 1 1 /end IF_DATA BIT_MASK 0xFF /end MEASUREMENT
/begin MEASUREMENT mz_um "resultierendes zulÑssiges Moment aus der Koordination der FunktionsÅberwachung" UBYTE rel_ub_b99p6 0 0 0.000000 99.609375 /begin IF_DATA ASAP1B_ETK KP_BLOB 0x38092B 1 1 /end IF_DATA BIT_MASK 0xFF /end MEASUREMENT
/begin MEASUREMENT nc_c_um "FehlerzÑhler fÅr Motordrehzahlvergleich fÅr die FunktionsÅberwachung" UBYTE t40ms_ub_b10200 0 0 0.000000 10200.000000 /begin IF_DATA ASAP1B_ETK KP_BLOB 0x380909 1 1 /end IF_DATA BIT_MASK 0xFF /end MEASUREMENT
/begin MEASUREMENT nmst08_uc "" UWORD dez___UW 0 0 0.000000 65535.000000 /begin IF_DATA ASAP1B_ETK KP_BLOB 0x382612 1 2 /end IF_DATA BIT_MASK 0xFFFF /end MEASUREMENT
/begin MEASUREMENT nmst08_um "StÅtzstelle fÅr Motordrehzahl in der FunktionsÅberwachung (NMOT_UM)" UWORD dez___UW 0 0 0.000000 65535.000000 /begin IF_DATA ASAP1B_ETK KP_BLOB 0x380952 1 2 /end IF_DATA BIT_MASK 0xFFFF /end MEASUREMENT
/begin MEASUREMENT nsc_c_um "NachstartÅberwachungszeitzÑhler fÅr die FunktionsÅberwachung     |" UWORD t40msxs_uw_q0p04 0 0 0.000000 2621.400000 /begin IF_DATA ASAP1B_ETK KP_BLOB 0x380950 1 2 /end IF_DATA BIT_MASK 0xFFFF /end MEASUREMENT
/begin MEASUREMENT nska_uc "" UBYTE nmot_ub_q40 0 0 0.000000 10200.000000 /begin IF_DATA ASAP1B_ETK KP_BLOB 0x380C90 1 1 /end IF_DATA BIT_MASK 0xFF /end MEASUREMENT
/begin MEASUREMENT nska_um "Grenzdrehzahl bei aktiver Fehlerreaktion in der FunktionsÅberwachung" UBYTE nmot_ub_q40 0 0 0.000000 10200.000000 /begin IF_DATA ASAP1B_ETK KP_BLOB 0x380939 1 1 /end IF_DATA BIT_MASK 0xFF /end MEASUREMENT
/begin MEASUREMENT nsof_c_um "ZÑller Entprellzeit fÅr Abschaltung der Nachstartaufweitung" UBYTE t40ms_ub_b10200 0 0 0.000000 10200.000000 /begin IF_DATA ASAP1B_ETK KP_BLOB 0x38090C 1 1 /end IF_DATA BIT_MASK 0xFF /end MEASUREMENT
/begin MEASUREMENT nzwst08_uc "" UWORD dez___UW 0 0 0.000000 65535.000000 /begin IF_DATA ASAP1B_ETK KP_BLOB 0x382614 1 2 /end IF_DATA BIT_MASK 0xFFFF /end MEASUREMENT
/begin MEASUREMENT nzwst08_um "" UWORD dez___UW 0 0 0.000000 65535.000000 /begin IF_DATA ASAP1B_ETK KP_BLOB 0x380954 1 2 /end IF_DATA BIT_MASK 0xFFFF /end MEASUREMENT
/begin MEASUREMENT nz_um "Motordrehzahl aus ZahnzÑhlerdifferenz pro Zeit in der FunktionsÅberwachung" UBYTE nmot_ub_q40 0 0 0.000000 10200.000000 /begin IF_DATA ASAP1B_ETK KP_BLOB 0x38090B 1 1 /end IF_DATA BIT_MASK 0xFF /end MEASUREMENT
/begin MEASUREMENT n_flags_uc "" UBYTE dez 0 0 0.000000 255.000000 /begin IF_DATA ASAP1B_ETK KP_BLOB 0x380C69 1 1 /end IF_DATA BIT_MASK 0xFF /end MEASUREMENT
/begin MEASUREMENT n_flags_um "" UBYTE dez 0 0 0.000000 255.000000 /begin IF_DATA ASAP1B_ETK KP_BLOB 0x380900 1 1 /end IF_DATA BIT_MASK 0xFF /end MEASUREMENT
/begin MEASUREMENT pmcod_w "" UWORD dez___UW 0 0 0.000000 65535.000000 /begin IF_DATA ASAP1B_ETK KP_BLOB 0x3827E2 1 2 /end IF_DATA BIT_MASK 0xFFFF /end MEASUREMENT
/begin MEASUREMENT ram_c_um "FehlerzÑhler im Dauer-RAM fÅr RAM-Konsistenz-PrÅfung (Diagnose) in der Fkt-öberw" UBYTE dez 0 0 0.000000 255.000000 /begin IF_DATA ASAP1B_ETK KP_BLOB 0x383411 1 1 /end IF_DATA BIT_MASK 0xFF /end MEASUREMENT
/begin MEASUREMENT reac_c1_uc "FehlerzÑhler 1 fÅr FehlerreaktionsÅberwachung im Befehlstest" UBYTE t40ms_ub_b10200 0 0 0.000000 10200.000000 /begin IF_DATA ASAP1B_ETK KP_BLOB 0x380C91 1 1 /end IF_DATA BIT_MASK 0xFF /end MEASUREMENT
/begin MEASUREMENT reac_c1_um "FehlerzÑhler 1 fÅr FehlerreaktionsÅberwachung bei Funktions-Fehlerreaktion" UBYTE t40ms_ub_b10200 0 0 0.000000 10200.000000 /begin IF_DATA ASAP1B_ETK KP_BLOB 0x38093A 1 1 /end IF_DATA BIT_MASK 0xFF /end MEASUREMENT
/begin MEASUREMENT reac_c2_uc "FehlerzÑhler 2 fÅr FehlerreaktionsÅberwachung im Befehlstest" UBYTE t40ms_ub_b10200 0 0 0.000000 10200.000000 /begin IF_DATA ASAP1B_ETK KP_BLOB 0x380C92 1 1 /end IF_DATA BIT_MASK 0xFF /end MEASUREMENT
/begin MEASUREMENT reac_c2_um "FehlerzÑhler 2 fÅr FehlerreaktionsÅberwachung bei FunktionsÅberwachungs-Reaktion" UBYTE t40ms_ub_b10200 0 0 0.000000 10200.000000 /begin IF_DATA ASAP1B_ETK KP_BLOB 0x38093B 1 1 /end IF_DATA BIT_MASK 0xFF /end MEASUREMENT
/begin MEASUREMENT reac_c_um "FehlerzÑhler im Dauer-RAM fÅr FehlerreaktionsÅberwachung (Diagnose) in der FU" UBYTE dez 0 0 0.000000 255.000000 /begin IF_DATA ASAP1B_ETK KP_BLOB 0x383412 1 1 /end IF_DATA BIT_MASK 0xFF /end MEASUREMENT
/begin MEASUREMENT redist "Ist-Reduzierstufe" UBYTE dez 0 0 0.000000 255.000000 /begin IF_DATA ASAP1B_ETK KP_BLOB 0x380B20 1 1 /end IF_DATA BIT_MASK 0xFF /end MEASUREMENT
/begin MEASUREMENT reset_indication_um "" UWORD dez___UW 0 0 0.000000 65535.000000 /begin IF_DATA ASAP1B_ETK KP_BLOB 0x383CD2 1 2 /end IF_DATA BIT_MASK 0xFFFF /end MEASUREMENT
/begin MEASUREMENT rlc_c_um "FehlerzÑhler fÅr rl-Vergleich mit der Funktion in der FunktionsÅberwachung" UBYTE t40ms_ub_b10200 0 0 0.000000 10200.000000 /begin IF_DATA ASAP1B_ETK KP_BLOB 0x380911 1 1 /end IF_DATA BIT_MASK 0xFF /end MEASUREMENT
/begin MEASUREMENT rlf_ptr_um "" UBYTE dez 0 0 0.000000 255.000000 /begin IF_DATA ASAP1B_ETK KP_BLOB 0x380912 1 1 /end IF_DATA BIT_MASK 0xFF /end MEASUREMENT
/begin MEASUREMENT rlf_reg_um_0___A "" UBYTE rel_ub_q0p75 0 0 0.000000 191.250000 /begin IF_DATA ASAP1B_ETK KP_BLOB 0x380913 1 1 /end IF_DATA BIT_MASK 0xFF /end MEASUREMENT
/begin MEASUREMENT rlf_reg_um_1___A "" UBYTE rel_ub_q0p75 0 0 0.000000 191.250000 /begin IF_DATA ASAP1B_ETK KP_BLOB 0x380914 1 1 /end IF_DATA BIT_MASK 0xFF /end MEASUREMENT
/begin MEASUREMENT rlf_reg_um_2___A "" UBYTE rel_ub_q0p75 0 0 0.000000 191.250000 /begin IF_DATA ASAP1B_ETK KP_BLOB 0x380915 1 1 /end IF_DATA BIT_MASK 0xFF /end MEASUREMENT
/begin MEASUREMENT rlf_reg_um_3___A "" UBYTE rel_ub_q0p75 0 0 0.000000 191.250000 /begin IF_DATA ASAP1B_ETK KP_BLOB 0x380916 1 1 /end IF_DATA BIT_MASK 0xFF /end MEASUREMENT
/begin MEASUREMENT rlf_reg_um_4___A "" UBYTE rel_ub_q0p75 0 0 0.000000 191.250000 /begin IF_DATA ASAP1B_ETK KP_BLOB 0x380917 1 1 /end IF_DATA BIT_MASK 0xFF /end MEASUREMENT
/begin MEASUREMENT rlf_reg_um_5___A "" UBYTE rel_ub_q0p75 0 0 0.000000 191.250000 /begin IF_DATA ASAP1B_ETK KP_BLOB 0x380918 1 1 /end IF_DATA BIT_MASK 0xFF /end MEASUREMENT
/begin MEASUREMENT rlf_reg_um_6___A "" UBYTE rel_ub_q0p75 0 0 0.000000 191.250000 /begin IF_DATA ASAP1B_ETK KP_BLOB 0x380919 1 1 /end IF_DATA BIT_MASK 0xFF /end MEASUREMENT
/begin MEASUREMENT rlf_reg_um_7___A "" UBYTE rel_ub_q0p75 0 0 0.000000 191.250000 /begin IF_DATA ASAP1B_ETK KP_BLOB 0x38091A 1 1 /end IF_DATA BIT_MASK 0xFF /end MEASUREMENT
/begin MEASUREMENT rlipf_low_um "" UBYTE rel_ub_q0p0029 0 0 0.000000 0.747070 /begin IF_DATA ASAP1B_ETK KP_BLOB 0x38091B 1 1 /end IF_DATA BIT_MASK 0xFF /end MEASUREMENT
/begin MEASUREMENT rlipf_um "relative LuftfÅllung aus Nebenlastsignal hinter Tiefpa· in der FunktionsÅberw." UBYTE rel_ub_q0p75 0 0 0.000000 191.250000 /begin IF_DATA ASAP1B_ETK KP_BLOB 0x38091C 1 1 /end IF_DATA BIT_MASK 0xFF /end MEASUREMENT
/begin MEASUREMENT rlip_c_um "FehlerzÑhler fÅr rl/rlip-Vergleich in der FunktionsÅberwachung" UBYTE t40ms_ub_b10200 0 0 0.000000 10200.000000 /begin IF_DATA ASAP1B_ETK KP_BLOB 0x38091D 1 1 /end IF_DATA BIT_MASK 0xFF /end MEASUREMENT
/begin MEASUREMENT rlip_um "relative LuftfÅllung aus Nebenlastsignal fÅr die FunktionsÅberwachung" UBYTE rel_ub_q0p75 0 0 0.000000 191.250000 /begin IF_DATA ASAP1B_ETK KP_BLOB 0x38091E 1 1 /end IF_DATA BIT_MASK 0xFF /end MEASUREMENT
/begin MEASUREMENT rlst08_uc "" UWORD dez___UW 0 0 0.000000 65535.000000 /begin IF_DATA ASAP1B_ETK KP_BLOB 0x382616 1 2 /end IF_DATA BIT_MASK 0xFFFF /end MEASUREMENT
/begin MEASUREMENT rlst08_um "" UWORD dez___UW 0 0 0.000000 65535.000000 /begin IF_DATA ASAP1B_ETK KP_BLOB 0x380956 1 2 /end IF_DATA BIT_MASK 0xFFFF /end MEASUREMENT
/begin MEASUREMENT rlzo_um "obere Toleranzgrenze fÅr rl aus Nebenlastsignal in der FunktionsÅberwachung" UBYTE rel_ub_q0p75 0 0 0.000000 191.250000 /begin IF_DATA ASAP1B_ETK KP_BLOB 0x380C63 1 1 /end IF_DATA BIT_MASK 0xFF /end MEASUREMENT
/begin MEASUREMENT rl_w_um "relative LuftfÅllung (Word) in der FunktionsÅberwachung" UWORD rel_uw_q0p0234 0 0 0.000000 1535.976562 /begin IF_DATA ASAP1B_ETK KP_BLOB 0x3825C0 1 2 /end IF_DATA BIT_MASK 0xFFFF /end MEASUREMENT
/begin MEASUREMENT romErrPage "" UBYTE dez 0 0 0.000000 255.000000 /begin IF_DATA ASAP1B_ETK KP_BLOB 0x383413 1 1 /end IF_DATA BIT_MASK 0xFF /end MEASUREMENT
/begin MEASUREMENT romRstC_um "ZÑhler fÅr Resets bei Fehlererkennung im ROM-Check in der Initialisierung" UBYTE dez 0 0 0.000000 255.000000 /begin IF_DATA ASAP1B_ETK KP_BLOB 0x38341A 1 1 /end IF_DATA BIT_MASK 0xFF /end MEASUREMENT
/begin MEASUREMENT romz_c_um "FehlerzÑhler im Dauer-RAM fÅr ROM-PrÅfung (Diagnose) in der FunktionsÅberwachung" UBYTE dez 0 0 0.000000 255.000000 /begin IF_DATA ASAP1B_ETK KP_BLOB 0x383414 1 1 /end IF_DATA BIT_MASK 0xFF /end MEASUREMENT
/begin MEASUREMENT rst_tv "Variable im Dauer-RAM zur Anforderung Reset-TastverhÑltnis aus der Fkt-öberwach." UBYTE dez 0 0 0.000000 255.000000 /begin IF_DATA ASAP1B_ETK KP_BLOB 0x383415 1 1 /end IF_DATA BIT_MASK 0xFF /end MEASUREMENT
/begin MEASUREMENT rst_tv_active "" UBYTE dez 0 0 0.000000 255.000000 /begin IF_DATA ASAP1B_ETK KP_BLOB 0x383419 1 1 /end IF_DATA BIT_MASK 0xFF /end MEASUREMENT
/begin MEASUREMENT r_flags_uc "" UBYTE dez 0 0 0.000000 255.000000 /begin IF_DATA ASAP1B_ETK KP_BLOB 0x380C6A 1 1 /end IF_DATA BIT_MASK 0xFF /end MEASUREMENT
/begin MEASUREMENT r_flags_um "" UBYTE dez 0 0 0.000000 255.000000 /begin IF_DATA ASAP1B_ETK KP_BLOB 0x380901 1 1 /end IF_DATA BIT_MASK 0xFF /end MEASUREMENT
/begin MEASUREMENT sp1p_a_um "10ms alter Wert f. Sollwert-Poti 1 (PWG) vom öberwachungsmodul fÅr den ADC-Test" UBYTE spg_ub_q0p019 0 0 0.000000 4.980469 /begin IF_DATA ASAP1B_ETK KP_BLOB 0x38093D 1 1 /end IF_DATA BIT_MASK 0xFF /end MEASUREMENT
/begin MEASUREMENT sp1p_st_um "StationÑrzÑhler fÅr Sollwertpoti 1 vom öberwachungsmodul" UBYTE t10msxs_ub_b2p55 0 0 0.000000 2.550000 /begin IF_DATA ASAP1B_ETK KP_BLOB 0x38093E 1 1 /end IF_DATA BIT_MASK 0xFF /end MEASUREMENT
/begin MEASUREMENT sp1s_a_um "10ms alter Wert f. Sollwert-Poti 1 (PWG) fÅr die FunktionsÅberwachung" UBYTE spg_ub_q0p019 0 0 0.000000 4.980469 /begin IF_DATA ASAP1B_ETK KP_BLOB 0x38093F 1 1 /end IF_DATA BIT_MASK 0xFF /end MEASUREMENT
/begin MEASUREMENT sp1s_st_um "StationÑrzÑhler fÅr Sollwertpoti 1" UBYTE t10msxs_ub_b2p55 0 0 0.000000 2.550000 /begin IF_DATA ASAP1B_ETK KP_BLOB 0x380940 1 1 /end IF_DATA BIT_MASK 0xFF /end MEASUREMENT
/begin MEASUREMENT sp1s_um "aktueller Wert fÅr Sollwert-Poti 1 (PWG) fÅr die FunktionsÅberwachung" UBYTE spg_ub_q0p019 0 0 0.000000 4.980469 /begin IF_DATA ASAP1B_ETK KP_BLOB 0x380920 1 1 /end IF_DATA BIT_MASK 0xFF /end MEASUREMENT
/begin MEASUREMENT sp2s_um "aktueller Wert fÅr Sollwert-Poti 2 (PWG) fÅr die FunktionsÅberwachung" UBYTE spg_ub_q0p0098 0 0 0.000000 2.490234 /begin IF_DATA ASAP1B_ETK KP_BLOB 0x380921 1 1 /end IF_DATA BIT_MASK 0xFF /end MEASUREMENT
/begin MEASUREMENT spsc_c_um "FehlerzÑhler bei zueinander unplausiblen Sollwerten in der FunktionsÅberwachung" UBYTE t40ms_ub_b10200 0 0 0.000000 10200.000000 /begin IF_DATA ASAP1B_ETK KP_BLOB 0x380922 1 1 /end IF_DATA BIT_MASK 0xFF /end MEASUREMENT
/begin MEASUREMENT spsnst08_uc "" UWORD dez___UW 0 0 0.000000 65535.000000 /begin IF_DATA ASAP1B_ETK KP_BLOB 0x382618 1 2 /end IF_DATA BIT_MASK 0xFFFF /end MEASUREMENT
/begin MEASUREMENT spsnst08_um "" UWORD dez___UW 0 0 0.000000 65535.000000 /begin IF_DATA ASAP1B_ETK KP_BLOB 0x380958 1 2 /end IF_DATA BIT_MASK 0xFFFF /end MEASUREMENT
/begin MEASUREMENT srst_c_um "ZÑhler im Dauer-RAM fÅr Software-Reset (Diagnose) aus der FunktionsÅberwachung" UBYTE dez 0 0 0.000000 255.000000 /begin IF_DATA ASAP1B_ETK KP_BLOB 0x383416 1 1 /end IF_DATA BIT_MASK 0xFF /end MEASUREMENT
/begin MEASUREMENT swOffDlBits "" UWORD dez___UW 0 0 0.000000 65535.000000 /begin IF_DATA ASAP1B_ETK KP_BLOB 0x383CCE 1 2 /end IF_DATA BIT_MASK 0xFFFF /end MEASUREMENT
/begin MEASUREMENT szout_w "Schlie·zeitausgabe" UWORD txms_uw_q0p1 0 0 0.000000 6553.500000 /begin IF_DATA ASAP1B_ETK KP_BLOB 0x3828F2 1 2 /end IF_DATA BIT_MASK 0xFFFF /end MEASUREMENT
/begin MEASUREMENT szrl_w "korrigierte Schlie·zeit zur Winkelausgabe" UWORD txms_uw_q0p1 0 0 0.000000 6553.500000 /begin IF_DATA ASAP1B_ETK KP_BLOB 0x3828F4 1 2 /end IF_DATA BIT_MASK 0xFFFF /end MEASUREMENT
/begin MEASUREMENT sztcalc_w "Schliesszeit in Timer 1 Inkrementen" UWORD DEZL 0 0 0.000000 65535.000000 /begin IF_DATA ASAP1B_ETK KP_BLOB 0x3828F6 1 2 /end IF_DATA BIT_MASK 0xFFFF /end MEASUREMENT
/begin MEASUREMENT S_fgrat "Schalter Aus-Tip am FGR-Bedienhebelschalter" UWORD B_TRUE___UW 0 0 0.000000 0.000000 /begin IF_DATA ASAP1B_ETK KP_BLOB 0xFD0C 0 2 /end IF_DATA BIT_MASK 0x200 /end MEASUREMENT
/begin MEASUREMENT S_fgrhs "Hauptschalter am FGR-Bedienhebel" UWORD B_TRUE___UW 0 0 0.000000 0.000000 /begin IF_DATA ASAP1B_ETK KP_BLOB 0xFD0C 0 2 /end IF_DATA BIT_MASK 0x400 /end MEASUREMENT
/begin MEASUREMENT s_flags_uc "" UBYTE dez 0 0 0.000000 255.000000 /begin IF_DATA ASAP1B_ETK KP_BLOB 0x380C6B 1 1 /end IF_DATA BIT_MASK 0xFF /end MEASUREMENT
/begin MEASUREMENT s_flags_um "Bits fÅr Statusinformationen der FunktionsÅberwachung" UBYTE dez 0 0 0.000000 255.000000 /begin IF_DATA ASAP1B_ETK KP_BLOB 0x380902 1 1 /end IF_DATA BIT_MASK 0xFF /end MEASUREMENT
/begin MEASUREMENT talt_um "Timerwert des vorhergehenden Berechnungszeitpunkts im 40ms-Raster" UWORD dez___UW 0 0 0.000000 65535.000000 /begin IF_DATA ASAP1B_ETK KP_BLOB 0x380948 1 2 /end IF_DATA BIT_MASK 0xFFFF /end MEASUREMENT
/begin MEASUREMENT tans_um "Ansauglufttemperatur der FunktionsÅberwachung" UBYTE temp_ub_q0p75_o48 0 0 -48.000000 143.250000 /begin IF_DATA ASAP1B_ETK KP_BLOB 0x380906 1 1 /end IF_DATA BIT_MASK 0xFF /end MEASUREMENT
/begin MEASUREMENT tcap_um "Timerwert des aktuellen Berechnungszeitpunkts im 40ms-Raster" UWORD dez___UW 0 0 0.000000 65535.000000 /begin IF_DATA ASAP1B_ETK KP_BLOB 0x38094A 1 2 /end IF_DATA BIT_MASK 0xFFFF /end MEASUREMENT
/begin MEASUREMENT tmot_um "Motortemperatur in der FunktionsÅberwachung" UBYTE temp_ub_q0p75_o48 0 0 -48.000000 143.250000 /begin IF_DATA ASAP1B_ETK KP_BLOB 0x380907 1 1 /end IF_DATA BIT_MASK 0xFF /end MEASUREMENT
/begin MEASUREMENT trevovCtr "" UWORD dez___UW 0 0 0.000000 65535.000000 /begin IF_DATA ASAP1B_ETK KP_BLOB 0xF7AA 0 2 /end IF_DATA BIT_MASK 0xFFFF /end MEASUREMENT
/begin MEASUREMENT tsrl "lastabhÑngige Schlie·zeit" UBYTE txms_ub_q0p1 0 0 0.000000 25.500000 /begin IF_DATA ASAP1B_ETK KP_BLOB 0x380D26 1 1 /end IF_DATA BIT_MASK 0xFF /end MEASUREMENT
/begin MEASUREMENT tzsCtr "" UBYTE dez 0 0 0.000000 255.000000 /begin IF_DATA ASAP1B_ETK KP_BLOB 0x380D28 1 1 /end IF_DATA BIT_MASK 0xFF /end MEASUREMENT
/begin MEASUREMENT udkp1a "Spannung Drosselklappen-Poti 1 am (unteren) Anschlag" UBYTE spg_ub_b5 0 0 0.000000 4.980469 /begin IF_DATA ASAP1B_ETK KP_BLOB 0x380ADB 1 1 /end IF_DATA BIT_MASK 0xFF /end MEASUREMENT
/begin MEASUREMENT udkp2a "Spannung Drosselklappen-Poti 2 am (unteren) Anschlag" UBYTE spg_ub_b5 0 0 0.000000 4.980469 /begin IF_DATA ASAP1B_ETK KP_BLOB 0x380ADD 1 1 /end IF_DATA BIT_MASK 0xFF /end MEASUREMENT
/begin MEASUREMENT uma2_res "Antwortbeitrag des Befehlstests" SWORD dez___SW 0 0 -32768.000000 32767.000000 /begin IF_DATA ASAP1B_ETK KP_BLOB 0x382584 1 2 /end IF_DATA BIT_MASK 0xFFFF /end MEASUREMENT
/begin MEASUREMENT umErrorCtrFr "" UBYTE dez 0 0 0.000000 255.000000 /begin IF_DATA ASAP1B_ETK KP_BLOB 0x380C61 1 1 /end IF_DATA BIT_MASK 0xFF /end MEASUREMENT
/begin MEASUREMENT umrst_c_um "ZÑhler im Dauer-RAM fÅr Software-Reset (Diagnose) aus %UMKOM" UBYTE dez 0 0 0.000000 255.000000 /begin IF_DATA ASAP1B_ETK KP_BLOB 0x383417 1 1 /end IF_DATA BIT_MASK 0xFF /end MEASUREMENT
/begin MEASUREMENT vfzgpr_w "PrÑdizierte Fahrzeuggeschwindigkeit" UWORD vfzg_uw_q0p00781 0 0 0.000000 511.992188 /begin IF_DATA ASAP1B_ETK KP_BLOB 0x3824EC 1 2 /end IF_DATA BIT_MASK 0xFFFF /end MEASUREMENT
/begin MEASUREMENT vfzg_uc "Fahrzeuggeschwindigkeit im Befehlstest" UWORD vfzg_uw_q0p00781 0 0 0.000000 511.992188 /begin IF_DATA ASAP1B_ETK KP_BLOB 0x382606 1 2 /end IF_DATA BIT_MASK 0xFFFF /end MEASUREMENT
/begin MEASUREMENT vfzg_um "Fahrzeuggeschwindigkeit in der FunktionsÅberwachung" UWORD vfzg_uw_q0p00781 0 0 0.000000 511.992188 /begin IF_DATA ASAP1B_ETK KP_BLOB 0x380946 1 2 /end IF_DATA BIT_MASK 0xFFFF /end MEASUREMENT
/begin MEASUREMENT vkAbgas "" UBYTE dez 0 0 0.000000 255.000000 /begin IF_DATA ASAP1B_ETK KP_BLOB 0xF9F0 0 1 /end IF_DATA BIT_MASK 0xFF /end MEASUREMENT
/begin MEASUREMENT vkAntrieb "" UBYTE dez 0 0 0.000000 255.000000 /begin IF_DATA ASAP1B_ETK KP_BLOB 0xF9F1 0 1 /end IF_DATA BIT_MASK 0xFF /end MEASUREMENT
/begin MEASUREMENT vkASR "" UBYTE dez 0 0 0.000000 255.000000 /begin IF_DATA ASAP1B_ETK KP_BLOB 0xF9F2 0 1 /end IF_DATA BIT_MASK 0xFF /end MEASUREMENT
/begin MEASUREMENT vkASRAntrieb "" UBYTE dez 0 0 0.000000 255.000000 /begin IF_DATA ASAP1B_ETK KP_BLOB 0xF9F3 0 1 /end IF_DATA BIT_MASK 0xFF /end MEASUREMENT
/begin MEASUREMENT vkFzgtyp "" UBYTE dez 0 0 0.000000 255.000000 /begin IF_DATA ASAP1B_ETK KP_BLOB 0xF9F4 0 1 /end IF_DATA BIT_MASK 0xFF /end MEASUREMENT
/begin MEASUREMENT vsdmr "Vorgabe Drehmomentreserve Åber Verstellsystem VSxy" UBYTE rel_ub_q0p3906___UB 0 0 0.000000 99.609375 /begin IF_DATA ASAP1B_ETK KP_BLOB 0x3809A5 1 1 /end IF_DATA BIT_MASK 0xFF /end MEASUREMENT
/begin MEASUREMENT vsfpses "Faktor zur Verstellung Saugrohrdruck zur Applikation Einspritzung" UBYTE fak_ub_b2 0 0 0.000000 1.992188 /begin IF_DATA ASAP1B_ETK KP_BLOB 0x3809A6 1 1 /end IF_DATA BIT_MASK 0xFF /end MEASUREMENT
/begin MEASUREMENT vsfrk "Korrektur der relativen Kraftstoffmasse Åber Verstellsysteme" UBYTE fak_ub_b1p25_o0p75 0 0 0.750000 1.248048 /begin IF_DATA ASAP1B_ETK KP_BLOB 0x3809A7 1 1 /end IF_DATA BIT_MASK 0xFF /end MEASUREMENT
/begin MEASUREMENT vske "verstellbarer Offset fÅr Klopferkennungsschwelle Åber VS20" SBYTE fak_ub_b16___SB 0 0 -8.000000 7.937500 /begin IF_DATA ASAP1B_ETK KP_BLOB 0x3809A8 1 1 /end IF_DATA BIT_MASK 0xFF /end MEASUREMENT
/begin MEASUREMENT vsldtv "Verstellgrî·e LDR-TastverhÑltnis vom VSx-System zur Applikation" UBYTE tv_ub_b100 0 0 0.000000 99.609375 /begin IF_DATA ASAP1B_ETK KP_BLOB 0x3809A9 1 1 /end IF_DATA BIT_MASK 0xFF /end MEASUREMENT
/begin MEASUREMENT vsns "énderung der Solldrehzahl Åber Verstellsystem VSxy" UBYTE nmot_ub_q10 0 0 0.000000 2550.000000 /begin IF_DATA ASAP1B_ETK KP_BLOB 0x3809AA 1 1 /end IF_DATA BIT_MASK 0xFF /end MEASUREMENT
/begin MEASUREMENT vsrlmx "Additive FÅllungskorrektur fÅr rlmx vom Verstellsystem" SBYTE rel_sb_q0p75 0 0 -96.000000 95.250000 /begin IF_DATA ASAP1B_ETK KP_BLOB 0x3809AB 1 1 /end IF_DATA BIT_MASK 0xFF /end MEASUREMENT
/begin MEASUREMENT vstdzw "Anpassung ZÅndwinkel additiv" SBYTE zw_sb_q0p75 0 0 -96.000000 95.250000 /begin IF_DATA ASAP1B_ETK KP_BLOB 0x380BF2 1 1 /end IF_DATA BIT_MASK 0xFF /end MEASUREMENT
/begin MEASUREMENT vstvvr "Geschwindigkeitsoffset zur VMAX-Regelung" SBYTE vfzg_q1p0___SB 0 0 -128.000000 127.000000 /begin IF_DATA ASAP1B_ETK KP_BLOB 0x380BFD 1 1 /end IF_DATA BIT_MASK 0xFF /end MEASUREMENT
/begin MEASUREMENT vsvw "énderung Einspritzvorlagerungswinkel Åber Verstellsystem" SBYTE zw_sb_q6 0 0 -768.000000 762.000000 /begin IF_DATA ASAP1B_ETK KP_BLOB 0x3809AC 1 1 /end IF_DATA BIT_MASK 0xFF /end MEASUREMENT
/begin MEASUREMENT vswnws "énderung der Winkel Nockenwelle (VANOS) Åber Verstellsystem VSxy" UBYTE wkw_ub_q0p25 0 0 0.000000 63.750000 /begin IF_DATA ASAP1B_ETK KP_BLOB 0x3809AD 1 1 /end IF_DATA BIT_MASK 0xFF /end MEASUREMENT
/begin MEASUREMENT vszw "ZÅndwinkelkorrektur durch Verstellsystem" SBYTE zw_sb_q0p75 0 0 -96.000000 95.250000 /begin IF_DATA ASAP1B_ETK KP_BLOB 0x3809AE 1 1 /end IF_DATA BIT_MASK 0xFF /end MEASUREMENT
/begin MEASUREMENT vszwkr_0_A "Zylinderindividuelle ZW-Verstellung durch Verstellsystem" SBYTE zw_sb_q0p75 0 0 -96.000000 95.250000 /begin IF_DATA ASAP1B_ETK KP_BLOB 0x3809AF 1 1 /end IF_DATA BIT_MASK 0xFF /end MEASUREMENT
/begin MEASUREMENT vszwkr_1_A "Zylinderindividuelle ZW-Verstellung durch Verstellsystem" SBYTE zw_sb_q0p75 0 0 -96.000000 95.250000 /begin IF_DATA ASAP1B_ETK KP_BLOB 0x3809B0 1 1 /end IF_DATA BIT_MASK 0xFF /end MEASUREMENT
/begin MEASUREMENT vszwkr_2_A "Zylinderindividuelle ZW-Verstellung durch Verstellsystem" SBYTE zw_sb_q0p75 0 0 -96.000000 95.250000 /begin IF_DATA ASAP1B_ETK KP_BLOB 0x3809B1 1 1 /end IF_DATA BIT_MASK 0xFF /end MEASUREMENT
/begin MEASUREMENT vszwkr_3_A "Zylinderindividuelle ZW-Verstellung durch Verstellsystem" SBYTE zw_sb_q0p75 0 0 -96.000000 95.250000 /begin IF_DATA ASAP1B_ETK KP_BLOB 0x3809B2 1 1 /end IF_DATA BIT_MASK 0xFF /end MEASUREMENT
/begin MEASUREMENT vszwkr_4_A "Zylinderindividuelle ZW-Verstellung durch Verstellsystem" SBYTE zw_sb_q0p75 0 0 -96.000000 95.250000 /begin IF_DATA ASAP1B_ETK KP_BLOB 0x3809B3 1 1 /end IF_DATA BIT_MASK 0xFF /end MEASUREMENT
/begin MEASUREMENT vszwkr_5_A "Zylinderindividuelle ZW-Verstellung durch Verstellsystem" SBYTE zw_sb_q0p75 0 0 -96.000000 95.250000 /begin IF_DATA ASAP1B_ETK KP_BLOB 0x3809B4 1 1 /end IF_DATA BIT_MASK 0xFF /end MEASUREMENT
/begin MEASUREMENT vszwkr_6_A "Zylinderindividuelle ZW-Verstellung durch Verstellsystem" SBYTE zw_sb_q0p75 0 0 -96.000000 95.250000 /begin IF_DATA ASAP1B_ETK KP_BLOB 0x3809B5 1 1 /end IF_DATA BIT_MASK 0xFF /end MEASUREMENT
/begin MEASUREMENT vszwkr_7_A "Zylinderindividuelle ZW-Verstellung durch Verstellsystem" SBYTE zw_sb_q0p75 0 0 -96.000000 95.250000 /begin IF_DATA ASAP1B_ETK KP_BLOB 0x3809B6 1 1 /end IF_DATA BIT_MASK 0xFF /end MEASUREMENT
/begin MEASUREMENT wanwkwNvBits "" UBYTE dez 0 0 0.000000 255.000000 /begin IF_DATA ASAP1B_ETK KP_BLOB 0x383314 1 1 /end IF_DATA BIT_MASK 0xFF /end MEASUREMENT
/begin MEASUREMENT wkrdy "ZÅndwinkelspÑtverstellung bei KR-Dynamik" UBYTE zw_ub_qn0p75 0 0 -191.250000 0.000000 /begin IF_DATA ASAP1B_ETK KP_BLOB 0xF9C4 0 1 /end IF_DATA BIT_MASK 0xFF /end MEASUREMENT
/begin MEASUREMENT wkrma "Mittelwert der ZW-SpÑtverstellungen KR, allgemein (im Notlauf mit Sicherheit)" UBYTE zw_ub_qn0p75 0 0 -191.250000 0.000000 /begin IF_DATA ASAP1B_ETK KP_BLOB 0xF9C3 0 1 /end IF_DATA BIT_MASK 0xFF /end MEASUREMENT
/begin MEASUREMENT wnwim_w "Mittelwert Abweichung Adaption Nocken-/Kurbelwelle" UWORD kw_q0p0039___UW 0 0 0.000000 255.996094 /begin IF_DATA ASAP1B_ETK KP_BLOB 0x383C24 1 2 /end IF_DATA BIT_MASK 0xFFFF /end MEASUREMENT
/begin MEASUREMENT wnwi_ad_w "Winkeldifferenz zwischen adaptierter und aktueller Phasenflanke (word)" SWORD kw_sw_b128 0 0 -128.000000 127.996094 /begin IF_DATA ASAP1B_ETK KP_BLOB 0x381AB0 1 2 /end IF_DATA BIT_MASK 0xFFFF /end MEASUREMENT
/begin MEASUREMENT wnwkwas_w "Winkel Nockenwelle zur Kurbelwelle im Arbeitsspiel" UWORD kw_q0p0156___UW 0 0 0.000000 1023.984375 /begin IF_DATA ASAP1B_ETK KP_BLOB 0x381AB2 1 2 /end IF_DATA BIT_MASK 0xFFFF /end MEASUREMENT
/begin MEASUREMENT wnwspas_w "Adaptionswinkel der Nockenwellenflanken im Arbeitsspiel (Referenzposition)" UWORD kw_q0p0156___UW 0 0 0.000000 1023.984375 /begin IF_DATA ASAP1B_ETK KP_BLOB 0x381AB4 1 2 /end IF_DATA BIT_MASK 0xFFFF /end MEASUREMENT
/begin MEASUREMENT wnwsp_w_0__A "Adaptionswinkel Nockenwelle (SpÑtanschlag)" UWORD kw_q0p0156___UW 0 0 0.000000 1023.984375 /begin IF_DATA ASAP1B_ETK KP_BLOB 0x383C26 1 2 /end IF_DATA BIT_MASK 0xFFFF /end MEASUREMENT
/begin MEASUREMENT wnwsp_w_1__A "Adaptionswinkel Nockenwelle (SpÑtanschlag)" UWORD kw_q0p0156___UW 0 0 0.000000 1023.984375 /begin IF_DATA ASAP1B_ETK KP_BLOB 0x383C28 1 2 /end IF_DATA BIT_MASK 0xFFFF /end MEASUREMENT
/begin MEASUREMENT wnwsp_w_2__A "Adaptionswinkel Nockenwelle (SpÑtanschlag)" UWORD kw_q0p0156___UW 0 0 0.000000 1023.984375 /begin IF_DATA ASAP1B_ETK KP_BLOB 0x383C2A 1 2 /end IF_DATA BIT_MASK 0xFFFF /end MEASUREMENT
/begin MEASUREMENT wnwsp_w_3__A "Adaptionswinkel Nockenwelle (SpÑtanschlag)" UWORD kw_q0p0156___UW 0 0 0.000000 1023.984375 /begin IF_DATA ASAP1B_ETK KP_BLOB 0x383C2C 1 2 /end IF_DATA BIT_MASK 0xFFFF /end MEASUREMENT
/begin MEASUREMENT wphg "ZÅndwinkel DG-Phasenkorrektur" SBYTE zw_sb_q0p75 0 0 -96.000000 95.250000 /begin IF_DATA ASAP1B_ETK KP_BLOB 0x380D09 1 1 /end IF_DATA BIT_MASK 0xFF /end MEASUREMENT
/begin MEASUREMENT wri_c_um "FehlerzÑhler im Dauer-RAM fÅr RAM-Beschreibbarkeits-PrÅfung (Diagnose) in der FU" UBYTE dez 0 0 0.000000 255.000000 /begin IF_DATA ASAP1B_ETK KP_BLOB 0x383418 1 1 /end IF_DATA BIT_MASK 0xFF /end MEASUREMENT
/begin MEASUREMENT zalt_um "ZahnzÑhlerwert des vorhergehenden Berechnungszeitpunkts im 40ms-Raster" UWORD dez___UW 0 0 0.000000 65535.000000 /begin IF_DATA ASAP1B_ETK KP_BLOB 0x38094C 1 2 /end IF_DATA BIT_MASK 0xFFFF /end MEASUREMENT
/begin MEASUREMENT zcap_um "ZahnzÑhlerwert des aktuellen Berechnungszeitpunkts im 40ms-Raster" UWORD dez___UW 0 0 0.000000 65535.000000 /begin IF_DATA ASAP1B_ETK KP_BLOB 0x38094E 1 2 /end IF_DATA BIT_MASK 0xFFFF /end MEASUREMENT
/begin MEASUREMENT zphfl "ZÑhler Ñquidistante Phasenflanken" UBYTE dez 0 0 0.000000 255.000000 /begin IF_DATA ASAP1B_ETK KP_BLOB 0x380A54 1 1 /end IF_DATA BIT_MASK 0xFF /end MEASUREMENT
/begin MEASUREMENT zphflsyn "PhasenflankenzÑhler bei Erkennen der Motorposition im Notlauf DG" UBYTE dez 0 0 0.000000 255.000000 /begin IF_DATA ASAP1B_ETK KP_BLOB 0x380A62 1 1 /end IF_DATA BIT_MASK 0xFF /end MEASUREMENT
/begin MEASUREMENT zsync_um "Kennung fÅr Synchronisation in der FunktionsÅberwachung" UBYTE dez 0 0 0.000000 255.000000 /begin IF_DATA ASAP1B_ETK KP_BLOB 0x380C62 1 1 /end IF_DATA BIT_MASK 0xFF /end MEASUREMENT
/begin MEASUREMENT zwbas "BasiszÅndwinkel" SBYTE zw_sb_q0p75 0 0 -96.000000 95.250000 /begin IF_DATA ASAP1B_ETK KP_BLOB 0xF9F6 0 1 /end IF_DATA BIT_MASK 0xFF /end MEASUREMENT
/begin MEASUREMENT zwbasar_0_A "BasiszÅndwinkelarray" SBYTE zw_sb_q0p75 0 0 -96.000000 95.250000 /begin IF_DATA ASAP1B_ETK KP_BLOB 0x380D0A 1 1 /end IF_DATA BIT_MASK 0xFF /end MEASUREMENT
/begin MEASUREMENT zwbasar_1_A "BasiszÅndwinkelarray" SBYTE zw_sb_q0p75 0 0 -96.000000 95.250000 /begin IF_DATA ASAP1B_ETK KP_BLOB 0x380D0B 1 1 /end IF_DATA BIT_MASK 0xFF /end MEASUREMENT
/begin MEASUREMENT zwbasar_2_A "BasiszÅndwinkelarray" SBYTE zw_sb_q0p75 0 0 -96.000000 95.250000 /begin IF_DATA ASAP1B_ETK KP_BLOB 0x380D0C 1 1 /end IF_DATA BIT_MASK 0xFF /end MEASUREMENT
/begin MEASUREMENT zwbasar_3_A "BasiszÅndwinkelarray" SBYTE zw_sb_q0p75 0 0 -96.000000 95.250000 /begin IF_DATA ASAP1B_ETK KP_BLOB 0x380D0D 1 1 /end IF_DATA BIT_MASK 0xFF /end MEASUREMENT
/begin MEASUREMENT zwc_c_um "FehlerzÑhler fÅr ZÅndwinkelÅberwachung in der FunktionsÅberwachung" UBYTE dez 0 0 0.000000 255.000000 /begin IF_DATA ASAP1B_ETK KP_BLOB 0x38090D 1 1 /end IF_DATA BIT_MASK 0xFF /end MEASUREMENT
/begin MEASUREMENT zwgru "GrundzÅndwinkel" SBYTE zw_sb_q0p75 0 0 -96.000000 95.250000 /begin IF_DATA ASAP1B_ETK KP_BLOB 0x380D1F 1 1 /end IF_DATA BIT_MASK 0xFF /end MEASUREMENT
/begin MEASUREMENT zwist "Ist-ZÅndwinkel" SBYTE zw_sb_q0p75 0 0 -96.000000 95.250000 /begin IF_DATA ASAP1B_ETK KP_BLOB 0xF9F7 0 1 /end IF_DATA BIT_MASK 0xFF /end MEASUREMENT
/begin MEASUREMENT zwkrafld "Bitmuster des zyl.ind. abgelegten B_zwkra" UBYTE dez 0 0 0.000000 255.000000 /begin IF_DATA ASAP1B_ETK KP_BLOB 0xF9F8 0 1 /end IF_DATA BIT_MASK 0xFF /end MEASUREMENT
/begin MEASUREMENT zwmnd "dynamisch spÑtest zulÑssiger ZÅndwinkel" SBYTE zw_sb_q0p75 0 0 -96.000000 95.250000 /begin IF_DATA ASAP1B_ETK KP_BLOB 0x380D19 1 1 /end IF_DATA BIT_MASK 0xFF /end MEASUREMENT
/begin MEASUREMENT zwmnms "dauerhaft spÑtest mîglicher ZÅndwinkel" SBYTE zw_sb_q0p75 0 0 -96.000000 95.250000 /begin IF_DATA ASAP1B_ETK KP_BLOB 0x380D1A 1 1 /end IF_DATA BIT_MASK 0xFF /end MEASUREMENT
/begin MEASUREMENT zwnws "GrundzÅndwinkel mit BerÅcksichtigung von Nockenwellensteuerung" SBYTE zw_sb_q0p75 0 0 -96.000000 95.250000 /begin IF_DATA ASAP1B_ETK KP_BLOB 0x380D20 1 1 /end IF_DATA BIT_MASK 0xFF /end MEASUREMENT
/begin MEASUREMENT zwopt "optimaler ZÅndwinkel" SBYTE zw_sb_q0p75 0 0 -96.000000 95.250000 /begin IF_DATA ASAP1B_ETK KP_BLOB 0x380C47 1 1 /end IF_DATA BIT_MASK 0xFF /end MEASUREMENT
/begin MEASUREMENT zwopt_uc "" SBYTE zw_sb_q0p75 0 0 -96.000000 95.250000 /begin IF_DATA ASAP1B_ETK KP_BLOB 0x380C7E 1 1 /end IF_DATA BIT_MASK 0xFF /end MEASUREMENT
/begin MEASUREMENT zwopt_um "optimaler ZÅndwinkel in der FunktionsÅberwachung" SBYTE zw_sb_q0p75 0 0 -96.000000 95.250000 /begin IF_DATA ASAP1B_ETK KP_BLOB 0x380C66 1 1 /end IF_DATA BIT_MASK 0xFF /end MEASUREMENT
/begin MEASUREMENT zwout "ZÅndwinkel-Ausgabe" SBYTE zw_sb_q0p75 0 0 -96.000000 95.250000 /begin IF_DATA ASAP1B_ETK KP_BLOB 0xF9F9 0 1 /end IF_DATA BIT_MASK 0xFF /end MEASUREMENT
/begin MEASUREMENT zwoutar_0_A "ZÅndwinkel-Ausgabe Array" SBYTE zw_sb_q0p75 0 0 -96.000000 95.250000 /begin IF_DATA ASAP1B_ETK KP_BLOB 0x380D0E 1 1 /end IF_DATA BIT_MASK 0xFF /end MEASUREMENT
/begin MEASUREMENT zwoutar_1_A "ZÅndwinkel-Ausgabe Array" SBYTE zw_sb_q0p75 0 0 -96.000000 95.250000 /begin IF_DATA ASAP1B_ETK KP_BLOB 0x380D0F 1 1 /end IF_DATA BIT_MASK 0xFF /end MEASUREMENT
/begin MEASUREMENT zwoutar_2_A "ZÅndwinkel-Ausgabe Array" SBYTE zw_sb_q0p75 0 0 -96.000000 95.250000 /begin IF_DATA ASAP1B_ETK KP_BLOB 0x380D10 1 1 /end IF_DATA BIT_MASK 0xFF /end MEASUREMENT
/begin MEASUREMENT zwoutar_3_A "ZÅndwinkel-Ausgabe Array" SBYTE zw_sb_q0p75 0 0 -96.000000 95.250000 /begin IF_DATA ASAP1B_ETK KP_BLOB 0x380D11 1 1 /end IF_DATA BIT_MASK 0xFF /end MEASUREMENT
/begin MEASUREMENT zwoutcpl "Einerkomplement des ZÅndwinkels fÅr die FunktionsÅberwachung" SBYTE zw_sb_q0p75 0 0 -96.000000 95.250000 /begin IF_DATA ASAP1B_ETK KP_BLOB 0x380D12 1 1 /end IF_DATA BIT_MASK 0xFF /end MEASUREMENT
/begin MEASUREMENT zwout_uc "Ausgabe-ZÅndwinkel im Befehlstest" SBYTE zw_sb_q0p75 0 0 -96.000000 95.250000 /begin IF_DATA ASAP1B_ETK KP_BLOB 0x380C76 1 1 /end IF_DATA BIT_MASK 0xFF /end MEASUREMENT
/begin MEASUREMENT zwout_um "Ausgabe-ZÅndwinkel fÅr die FunktionsÅberwachung" SBYTE zw_sb_q0p75 0 0 -96.000000 95.250000 /begin IF_DATA ASAP1B_ETK KP_BLOB 0x38090E 1 1 /end IF_DATA BIT_MASK 0xFF /end MEASUREMENT
/begin MEASUREMENT zwsol "Soll-ZÅndwinkel aus Momenteneingriff" SBYTE zw_sb_q0p75 0 0 -96.000000 95.250000 /begin IF_DATA ASAP1B_ETK KP_BLOB 0x380D16 1 1 /end IF_DATA BIT_MASK 0xFF /end MEASUREMENT
/begin MEASUREMENT zwspae "SpÑtester ZÅndwinkel" SBYTE zw_sb_q0p75 0 0 -96.000000 95.250000 /begin IF_DATA ASAP1B_ETK KP_BLOB 0x380D1B 1 1 /end IF_DATA BIT_MASK 0xFF /end MEASUREMENT
/begin MEASUREMENT zwstt "ZÅndwinkel im Start" SBYTE zw_sb_q0p75 0 0 -96.000000 95.250000 /begin IF_DATA ASAP1B_ETK KP_BLOB 0x380D22 1 1 /end IF_DATA BIT_MASK 0xFF /end MEASUREMENT
/begin MEASUREMENT zwzyl1 "ZÅndwinkel Zylinder 1" SBYTE zw_sb_q0p75 0 0 -96.000000 95.250000 /begin IF_DATA ASAP1B_ETK KP_BLOB 0x380D13 1 1 /end IF_DATA BIT_MASK 0xFF /end MEASUREMENT
/begin MEASUREMENT zzyl "SW-ZylinderzÑhler" UBYTE dez 0 0 0.000000 255.000000 /begin IF_DATA ASAP1B_ETK KP_BLOB 0xF89A 0 1 /end IF_DATA BIT_MASK 0xFF /end MEASUREMENT
/begin MEASUREMENT zzylzue "SW-ZylinderzÑhler fÅr ZÅndungsberechnung" UBYTE dez 0 0 0.000000 255.000000 /begin IF_DATA ASAP1B_ETK KP_BLOB 0x380985 1 1 /end IF_DATA BIT_MASK 0xFF /end MEASUREMENT
/begin FUNCTION TKSTA "3.50      Testerkommunikation; Stellgliedansteuerung" /begin REF_CHARACTERISTIC CWSTAKD /end REF_CHARACTERISTIC /begin LOC_MEASUREMENT nmot_w B_slsfz /end LOC_MEASUREMENT /end FUNCTION
/begin FUNCTION TN "3.10      Drehzahlmesser Signal" /begin LOC_MEASUREMENT zzyl B_syn /end LOC_MEASUREMENT /end FUNCTION
/begin FUNCTION TNOT "" /end FUNCTION
/begin FUNCTION TREV_OV "" /begin LOC_MEASUREMENT trevovCtr B_trev_inc /end LOC_MEASUREMENT /end FUNCTION
/begin FUNCTION TUNING "1.10      Tuningschutz" /begin LOC_MEASUREMENT B_pwf /end LOC_MEASUREMENT /end FUNCTION
/begin FUNCTION UFEING "5.10      EGAS öberwachungskonzept: Eing.sig.Åbern. fÅr FunktionsÅberwachung" /begin REF_CHARACTERISTIC MDIMX_UM /end REF_CHARACTERISTIC
 /begin LOC_MEASUREMENT vfzg_w vfzg_um tmot_um tmot tans_um tans milsol_w milsol_um mifa_um mifa evz_aus_um evz_austot B_ub_ok B_notlu_fr B_i_ska_fr /end LOC_MEASUREMENT
/end FUNCTION
/begin FUNCTION UFEINS "" /begin REF_CHARACTERISTIC SPSNV08_UM RLV08_UM NZWV08_UM NMV08_UM /end REF_CHARACTERISTIC
 /begin LOC_MEASUREMENT spsn_um spsnst08_um rl_um rlst08_um nzwst08_um nmst08_um nmot_um /end LOC_MEASUREMENT
/end FUNCTION
/begin FUNCTION UFFGRC "1.30      EGAS öberwachungskonzept: FGR-öberwachung der FunktionsÅberwachung" /begin REF_CHARACTERISTIC VMIN_UM /end REF_CHARACTERISTIC /begin LOC_MEASUREMENT vfzg_um mifa_um mfgr_um B_fgr_um B_fgr /end LOC_MEASUREMENT /end FUNCTION
/begin FUNCTION UFFGRE "1.20      EGAS öberwachungskonzept: FGR-Eingangsinfos fÅr die FunktionsÅberwachung" /begin REF_CHARACTERISTIC BREMS_T_UM /end REF_CHARACTERISTIC /begin LOC_MEASUREMENT S_fgrhs S_fgrat B_fgrab B_bl brems_c_um /end LOC_MEASUREMENT /end FUNCTION
/begin FUNCTION UFMIST "2.10      EGAS öberwachungskonzept: Ist-Moment der FunktionsÅberwachung" /begin REF_CHARACTERISTIC RLV08_UM NZWV08_UM KLETAZW_UM KFZW_UM KFMI_UM /end REF_CHARACTERISTIC
 /begin LOC_MEASUREMENT zwout_um zwopt_um rl_um rlst08_um nzwst08_um nmot_um mi_um miopt_um etazw_um dzw_um /end LOC_MEASUREMENT
/end FUNCTION
/begin FUNCTION UFMSRC "5.10      EGAS öberwachungskonzept: MSR-Eingriff-öberwachung fÅr die FunktionsÅberwachung" /begin REF_CHARACTERISTIC NOASR_UM MSRC_T_UM DBZ_MX_UM DBZ_MN_UM BZ_MSR_UM /end REF_CHARACTERISTIC
 /begin LOC_MEASUREMENT msrc_c_um mmsr_um ei_msrc_um B_nomsr_um B_nomsr_fr B_nkons_um bz_msr bzmsr_a_um /end LOC_MEASUREMENT
/end FUNCTION
/begin FUNCTION UFMVER "2.10      EGAS öberwachungskonzept: Momentenvergleich der FunktionsÅberwachung" /begin REF_CHARACTERISTIC MVER_T_UM /end REF_CHARACTERISTIC
 /begin LOC_MEASUREMENT mzo_um mzf_um mzfo_um mver_c_um mi_um mdif_w_um ei_mver_um B_i_ska_um /end LOC_MEASUREMENT
/end FUNCTION
/begin FUNCTION UFMZF "1.10      EGAS öberwachungskonzept: Momentenfilter fÅr die FunktionsÅberwachung" /begin REF_CHARACTERISTIC MZFTV_UM MZFFIL_UM /end REF_CHARACTERISTIC
 /begin LOC_MEASUREMENT mz_um mzf_um mzf_reg_um_7___A mzf_reg_um_6___A mzf_reg_um_5___A mzf_reg_um_4___A mzf_reg_um_3___A mzf_reg_um_2___A mzf_reg_um_1___A mzf_reg_um_0___A mzf_ptr_um mzf_low_um /end LOC_MEASUREMENT
/end FUNCTION
/begin FUNCTION UFMZUL "5.10      EGAS öberwachungskonzept: zulÑssiges Moment der FunktionsÅberwachung"
 /begin REF_CHARACTERISTIC SPSNV08_UM NMV08_UM MDV08_UM KFMPNS_UM KFMPED_UM KFMDZOF_UM /end REF_CHARACTERISTIC
 /begin LOC_MEASUREMENT spsn_um spsnst08_um nmst08_um nmot_um mz_um mzo_um mzmax_um mped_um mmsr_um milsol_um mfgr_um mdst08_um /end LOC_MEASUREMENT
/end FUNCTION
/begin FUNCTION UFNC "3.10      EGAS öberwachungskonzept: N-öberwachung fÅr die FunktionsÅberwachung" /begin REF_CHARACTERISTIC TZTOL_UM NMIN_UM NDIF_UM NC_T_UM /end REF_CHARACTERISTIC
 /begin LOC_MEASUREMENT zsync_um zcap_um zalt_um tcap_um talt_um nz_um nmot_um nmot nc_c_um ei_nc_um B_i_ska_um /end LOC_MEASUREMENT
/end FUNCTION
/begin FUNCTION UFNSC "2.10      EGAS öberwachungskonzept: NachstartÅberwachung fÅr die FunktionsÅberwachung"
 /begin REF_CHARACTERISTIC TMNSMN_UM TANSMN_UM N_STEND_UM N_START_UM NSOF_T_UM NSC_T_UM /end REF_CHARACTERISTIC
 /begin LOC_MEASUREMENT tmot_um tans_um nsof_c_um nsc_c_um nmot_um B_mzns_um /end LOC_MEASUREMENT
/end FUNCTION
/begin FUNCTION UFREAC "4.30      EGAS öberwachungskonzept: FehlerreaktionsÅberw.d.FunktionsÅberwachung" /begin REF_CHARACTERISTIC SKA_DRHZ_UM REAC_T2_UM REAC_T1_UM NOREA_UM KLNPED_UM /end REF_CHARACTERISTIC
 /begin LOC_MEASUREMENT spsn_um reac_c2_um reac_c1_um nska_um nmot_um evz_aus_um ei_reac_um B_i_ska_um /end LOC_MEASUREMENT
/end FUNCTION
/begin FUNCTION UFRLC "5.10      EGAS öberwachungskonzept: LastsignalÅberw. fÅr FunktionsÅberwachung"
 /begin REF_CHARACTERISTIC RL_MO_UM RL_BO_UM RLIP_T_UM RLIPTV_UM RLIPFIL_UM RLC_T_UM NRLIP_UM KFRLIP_UM IPA_T_UM IP2A_MN_UM IP1A_MX_UM /end REF_CHARACTERISTIC
 /begin LOC_MEASUREMENT udkp2a udkp1a rl_w_um rl_w rl_um rlzo_um rlip_um rlip_c_um rlipf_um rlipf_low_um rlf_reg_um_7___A rlf_reg_um_6___A rlf_reg_um_5___A rlf_reg_um_4___A rlf_reg_um_3___A rlf_reg_um_2___A rlf_reg_um_1___A rlf_reg_um_0___A rlf_ptr_um rlc_c_um rl nmot_um iUipoti2_w iUipoti1_w ipsn_um ipa_c_um ei_rlip_um ei_rlc_um ei_ipa_um B_wdk2sel B_i_ska_um B_ehfs /end LOC_MEASUREMENT
/end FUNCTION
/begin FUNCTION UFSPSC "2.30      EGAS öberwachungskonzept: Pedal-Sollwert-ö. fÅr FunktionsÅberwachung" /begin REF_CHARACTERISTIC SPSVG_UM SPSC_T_UM SPSC_MIN_UM SP12VG_UM SP12LL_UM /end REF_CHARACTERISTIC
 /begin LOC_MEASUREMENT spsn_um spsc_c_um sp2s_um sp1s_um iUspoti2_w iUspoti1_w ei_spsc_um B_spsmin B_sp2s B_sp1s B_pwgnotum B_pwgnotfr B_i_ska_um /end LOC_MEASUREMENT
/end FUNCTION
/begin FUNCTION UFURAM "" /begin REF_CHARACTERISTIC WAIT_T_UM UMRST_TV_UM RST_TV_UM /end REF_CHARACTERISTIC
 /begin LOC_MEASUREMENT wri_c_um umrst_c_um s_flags_um srst_c_um r_flags_um rst_tv romz_c_um romErrPage reset_indication_um reac_c_um ram_c_um n_flags_um B_wal_um B_vzl_um B_ub_ska b_nsend_um b_nsakt_um B_notlu B_kkl_um B_i_ska_um B_i_ska B_fgren_um B_dcdis_um B_bsl_um B_brems_um /end LOC_MEASUREMENT
/end FUNCTION
/begin FUNCTION UFZWC "2.20      EGAS öberwachungskonzept: ZW-öberwachung fÅr FunktionsÅberwachung" /begin REF_CHARACTERISTIC ZYLANZ_UM ZWC_T_UM /end REF_CHARACTERISTIC /begin LOC_MEASUREMENT zwout_um zwoutcpl zwout zwc_c_um ei_zwc_um B_i_ska_um /end LOC_MEASUREMENT /end FUNCTION
/begin FUNCTION UMKOM "1.10      EGAS öberwachungskonzept: Frage/Antwort-Kommunikation zw. UM und FR" /begin LOC_MEASUREMENT umErrorCtrFr uma2_res nmot /end LOC_MEASUREMENT /end FUNCTION
/begin FUNCTION URADCC "2.2       EGAS öberwachungskonzept: AD-Wandler-Test" /begin REF_CHARACTERISTIC SP1_STAT_T SP1_STAT SP1ADC_DIF ADCC_T_UM /end REF_CHARACTERISTIC
 /begin LOC_MEASUREMENT sp1s_st_um sp1s_a_um sp1p_st_um sp1p_a_um iUspoti1_w ei_adcc_um B_pwgnotum B_notlu_fr B_i_ska_um B_i_ska_fr adcc_c_um /end LOC_MEASUREMENT
/end FUNCTION
/begin FUNCTION URAUSG "" /begin REF_CHARACTERISTIC AUSZ_T_UM AUSZH_T_UM AUSG_T_UM AUSGH_T_UM /end REF_CHARACTERISTIC /begin LOC_MEASUREMENT ausz_c_um auszh_c_um ausg_c_um ausgh_c_um /end LOC_MEASUREMENT /end FUNCTION
/begin FUNCTION URCAUS ""
 /begin LOC_MEASUREMENT uma2_res reac_c2_uc reac_c1_uc mzfo_uc mver_c_uc mped_uc mmsr_uc mi_uc mfgr_uc ei_reac_uc ei_mver_uc ei_msrc_uc B_i_ska_uc /end LOC_MEASUREMENT
/end FUNCTION
/begin FUNCTION URCEIN ""
 /begin REF_CHARACTERISTIC ZWOUT_DAT_UC VFZG_DAT_UC SPSN_DAT_UC SFLAGS_D_UC RL_DAT_UC RFLAGS_D_UC REAC_D2_UC REAC_D1_UC NMOT_DAT_UC NFLAGS_D_UC MZL_DAT_UC MZF_DAT_UC MZFREG_DAT_UC MZFPTR_DAT_UC MVER_D_UC MSRC_D_UC MILSOL_DAT_UC MIFA_DAT_UC EVZ_DAT_UC CMSR_DAT_UC CBIT_DAT_UC BZMSR_DAT_UC BZMSRA_DAT_UC BNOMSR_DAT_UC BFGR_DAT_UC ASRS_DAT_UC ASRL_DAT_UC /end REF_CHARACTERISTIC
 /begin LOC_MEASUREMENT zwout_uc y_uc x_uc vfzg_uc spsn_uc rl_uc nmot_uc milsol_uc mifa_uc evz_aus_uc B_nomsrfr_uc B_fgrfr_uc bz_msr_uc bzmsr_a_uc /end LOC_MEASUREMENT
/end FUNCTION
/begin FUNCTION URCEINS "" /begin REF_CHARACTERISTIC SPSNV08_UC RLV08_UC NZWV08_UC NMV08_UC /end REF_CHARACTERISTIC
 /begin LOC_MEASUREMENT spsn_uc spsnst08_uc rl_uc rlst08_uc nzwst08_uc nmst08_uc nmot_uc /end LOC_MEASUREMENT
/end FUNCTION
/begin FUNCTION URCFGRC "" /begin REF_CHARACTERISTIC VMIN_UC /end REF_CHARACTERISTIC /begin LOC_MEASUREMENT vfzg_uc mifa_uc mfgr_uc B_fgr_uc B_fgrfr_uc /end LOC_MEASUREMENT /end FUNCTION
/begin FUNCTION URCMIST "" /begin REF_CHARACTERISTIC RLV08_UC NZWV08_UC KLETAZW_UC KFZW_UC KFMI_UC /end REF_CHARACTERISTIC
 /begin LOC_MEASUREMENT zwout_uc zwopt_uc rl_uc rlst08_uc nzwst08_uc nmot_uc mi_uc miopt_uc etazw_uc dzw_uc /end LOC_MEASUREMENT
/end FUNCTION
/begin FUNCTION URCMSRC "" /begin REF_CHARACTERISTIC NOASR_UC MSRC_T_UC DBZ_MX_UC DBZ_MN_UC BZ_MSR_UC /end REF_CHARACTERISTIC
 /begin LOC_MEASUREMENT msrc_c_uc mmsr_uc ei_msrc_uc B_nomsr_uc B_nomsrfr_uc B_nkons_uc bz_msr_uc bzmsr_a_uc /end LOC_MEASUREMENT
/end FUNCTION
/begin FUNCTION URCMVER "" /begin REF_CHARACTERISTIC MVER_T_UC /end REF_CHARACTERISTIC
 /begin LOC_MEASUREMENT mzo_uc mzf_uc mzfo_uc mver_c_uc mi_uc mdif_w_uc ei_mver_uc B_i_ska_uc /end LOC_MEASUREMENT
/end FUNCTION
/begin FUNCTION URCMZF "" /begin REF_CHARACTERISTIC MZFTV_UC MZFFIL_UC /end REF_CHARACTERISTIC
 /begin LOC_MEASUREMENT mz_uc mzf_uc mzf_reg_uc_7___A mzf_reg_uc_6___A mzf_reg_uc_5___A mzf_reg_uc_4___A mzf_reg_uc_3___A mzf_reg_uc_2___A mzf_reg_uc_1___A mzf_reg_uc_0___A mzf_ptr_uc mzf_low_uc /end LOC_MEASUREMENT
/end FUNCTION
/begin FUNCTION URCMZUL ""
 /begin REF_CHARACTERISTIC SPSNV08_UC NMV08_UC MDV08_UC KFMPNS_UC KFMPED_UC KFMDZOF_UC /end REF_CHARACTERISTIC
 /begin LOC_MEASUREMENT spsn_uc spsnst08_uc nmst08_uc nmot_uc mz_uc mzo_uc mzmax_uc mped_uc mmsr_uc milsol_uc mfgr_uc mdst08_uc /end LOC_MEASUREMENT
/end FUNCTION
/begin FUNCTION URCRAM "" /begin LOC_MEASUREMENT s_flags_uc r_flags_uc n_flags_uc /end LOC_MEASUREMENT /end FUNCTION
/begin FUNCTION URCREAC "" /begin REF_CHARACTERISTIC SKA_DRHZ_UC REAC_T2_UC REAC_T1_UC KLNPED_UC /end REF_CHARACTERISTIC
 /begin LOC_MEASUREMENT spsn_uc reac_c2_uc reac_c1_uc nska_uc nmot_uc evz_aus_uc ei_reac_uc B_i_ska_uc /end LOC_MEASUREMENT
/end FUNCTION
/begin FUNCTION URCREF "" /begin REF_CHARACTERISTIC MZFTV_UC /end REF_CHARACTERISTIC
 /begin LOC_MEASUREMENT reac_c2_uc reac_c1_uc mzf_uc mzf_reg_uc_7___A mzf_reg_uc_6___A mzf_reg_uc_5___A mzf_reg_uc_4___A mzf_reg_uc_3___A mzf_reg_uc_2___A mzf_reg_uc_1___A mzf_reg_uc_0___A mzf_ptr_uc mzf_low_uc mver_c_uc msrc_c_uc /end LOC_MEASUREMENT
/end FUNCTION
/begin FUNCTION URDELAY "" /begin REF_CHARACTERISTIC WAIT_T_UM RST_TV_UM NOREA_UM /end REF_CHARACTERISTIC /begin LOC_MEASUREMENT rst_tv_active rst_tv delayedTime_w /end LOC_MEASUREMENT /end FUNCTION
/begin FUNCTION URROM "2.10      EGAS öberwachungskonzept: ROM-Test" /begin REF_CHARACTERISTIC ROMRSTA_UM CW_NOROMCHKRESET /end REF_CHARACTERISTIC /begin LOC_MEASUREMENT swOffDlBits romRstC_um B_nlsiko /end LOC_MEASUREMENT /end FUNCTION
/begin FUNCTION VAR "290.50    Variantencodierung" /begin REF_CHARACTERISTIC VARTAB VARDEF /end REF_CHARACTERISTIC /begin LOC_MEASUREMENT vkFzgtyp vkASRAntrieb vkASR vkAntrieb vkAbgas pmcod_w /end LOC_MEASUREMENT /end FUNCTION
/begin FUNCTION VMAXMD "1.30      Drehmomentanforderung von VMAX-Regelung"
 /begin REF_CHARACTERISTIC ZIVMAX ZBFIL VVORH VMAXP VMAXO VHYST VABSCH TVMXPR SRL03MFUW SBF02MFSB NMINVMX MDIMX KFMIRED CWDVMX /end REF_CHARACTERISTIC
 /begin LOC_MEASUREMENT vstvvr vfzg_w vfzgpr_w rl_w nmot mivmx_w mivmxs mired miist_w mifab_w ivmax esst_srl03mfuw esst_sbf02mfsb dvsi_w dvprae_w dmvmxp_w dmvmxi_w B_vmax bfzgl_b bfzglf /end LOC_MEASUREMENT
/end FUNCTION
/begin FUNCTION VS_VERST "2.40      Verstellparameter fÅr McMess" /begin REF_CHARACTERISTIC CWVSV /end REF_CHARACTERISTIC
 /begin LOC_MEASUREMENT vszwkr_7_A vszwkr_6_A vszwkr_5_A vszwkr_4_A vszwkr_3_A vszwkr_2_A vszwkr_1_A vszwkr_0_A vszw vswnws vsvw vsrlmx vsns vsldtv vske vsfrk vsfpses vsdmr B_mcacti /end LOC_MEASUREMENT
/end FUNCTION
/begin FUNCTION WANWKW "13.30     Winkeladaption der Nockenwelle zur Kurbelwelle"
 /begin REF_CHARACTERISTIC ZNWSP WNWSPS_3 WNWSPS_2 WNWSPS_1 WNWSPS_0 WNWSPS2_3 WNWSPS2_2 WNWSPS2_1 WNWSPS2_0 WNWASMX WNWAFMX TMWAFMN NWAFMX NWAFMN /end REF_CHARACTERISTIC
 /begin LOC_MEASUREMENT zzyl zphflsyn zphfl wnwsp_w_3__A wnwsp_w_2__A wnwsp_w_1__A wnwsp_w_0__A wnwspas_w wnwkwas_w wnwi_ad_w wnwim_w wanwkwNvBits tmot swOffDlBits nmot B_zztab B_wnwiout B_synnldg B_syn B_st B_spsa B_pwf B_phad B_nldg B_nachl B_ll B_bm /end LOC_MEASUREMENT
/end FUNCTION
/begin FUNCTION ZUE "282.101   Grundfunktion - ZÅndung" /begin REF_CHARACTERISTIC ZWAPPL WPHN SNM08__UB KLZWBSMN /end REF_CHARACTERISTIC
 /begin LOC_MEASUREMENT zzylzue zwzyl1 zwstt zwspae zwsol zwoutcpl zwoutar_3_A zwoutar_2_A zwoutar_1_A zwoutar_0_A zwout zwkrafld zwist zwgru zwbasar_3_A zwbasar_2_A zwbasar_1_A zwbasar_0_A zwbas wphg wkrdy vszw vstdzw redist nmot esst_snm08__ub dzwzk dzwwl dwkrz_7_A dwkrz_6_A dwkrz_5_A dwkrz_4_A dwkrz_3_A dwkrz_2_A dwkrz_1_A dwkrz_0_A B_zwspae B_zwkra B_zwappl B_sa B_nozwe B_llrein /end LOC_MEASUREMENT
/end FUNCTION
/begin FUNCTION ZUESZ "3.30      ZÅndung, Berechnung Schlie·zeit"
 /begin REF_CHARACTERISTIC TZSUDYN TSMX KFTSRL KFTSDYN KFSZT KFSZDUB FTSLWSDN FTSDRLW FTOMN FSZTM DUBZS DTSDRL /end REF_CHARACTERISTIC
 /begin LOC_MEASUREMENT uzue ub tzsCtr tsrldyn tsrl tsdrlmx_w tmot sztcalc_w szrl_w szout_w rl nmot_w nmot ngfil_w ngfil ftsub ftsdyn ftsdrl E_lm E_dk drlsolf_w B_z1 B_swdy B_lsd /end LOC_MEASUREMENT
/end FUNCTION
/begin FUNCTION ZWGRU "23.80     GrundzÅndwinkel"
 /begin REF_CHARACTERISTIC TSWKR SRL12ZUUB SNM16ZUUB KFZW2 KFZW KFSWKFZK KFDZWKG KFDZK DZWNWSUE CNOKT /end REF_CHARACTERISTIC
 /begin LOC_MEASUREMENT zwnws zwgru wnwue wkrma rl nmot lambas fnwue esst_srl12zuub esst_snm16zuub dzwzk dzwol dzwoag dzwnwsu dzwkg B_krdws B_kfzk /end LOC_MEASUREMENT
/end FUNCTION
/begin FUNCTION ZWMIN "3.60      Berechnung des spÑtest erlaubten ZÅndwinkels"
 /begin REF_CHARACTERISTIC TVZWMSE TVZWMSA STM06__UB SRL12ZUUB SNM16ZUUB KLZZWMNST KFZWMS KFZWMNST KFZWMN ETADZW DZWSPM DZWAML /end REF_CHARACTERISTIC
 /begin LOC_MEASUREMENT zwspae zwopt zwmnms zwmnd zwist tmst tmot rl nmot ml misol_w misolv_w migs_w etazwmn esst_stm06__ub esst_srl12zuub esst_snm16zuub dzw_kge dzwspae dzwmna B_zwms B_zwmnste B_st B_sa B_kw B_kh /end LOC_MEASUREMENT
/end FUNCTION
/begin FUNCTION ZWSTT "4.10      ZÅndung im Start" /begin REF_CHARACTERISTIC FZWSTTM FZWSTNM DZWSTTA /end REF_CHARACTERISTIC /begin LOC_MEASUREMENT zwstt tmst tans nmot B_stend /end LOC_MEASUREMENT /end FUNCTION
/begin FUNCTION ZWWL "5.40      Warmlauf ZÅndwinkel"
 /begin REF_CHARACTERISTIC STM12ESUB STA12WLUB SRL06ESUB SNM12ESUB KFZWWLRL KFZWWLNM FZWWLRLN /end REF_CHARACTERISTIC
 /begin LOC_MEASUREMENT tmot tans rl nmot esst_stm12esub esst_sta12wlub esst_srl06esub esst_snm12esub dzwwl /end LOC_MEASUREMENT
/end FUNCTION
/begin FUNCTION _MCMESS "" /begin REF_CHARACTERISTIC CWVSV /end REF_CHARACTERISTIC /end FUNCTION
/end MODULE
/end PROJECT
