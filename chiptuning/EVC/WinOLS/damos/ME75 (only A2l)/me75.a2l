ASAP2_VERSION 1 21
/begin PROJECT Pro4017 "R4 1.8l 5V T lÑngs FR5ROM F5051"
/begin HEADER "" PROJECT_NO Pro4017 VERSION "PrV = F21dc mit 00" /end HEADER
/begin MODULE DIM " "
/begin MOD_COMMON " " S_REC_LAYOUT ME7 BYTE_ORDER MSB_LAST /end MOD_COMMON
/begin COMPU_METHOD B_TRUE "boolsche ZustÑnde, positive Logik" TAB_VERB "%6.3" "" COMPU_TAB_REF B_TRUE /end COMPU_METHOD
/begin COMPU_METHOD B_TRUE___UW "boolsche ZustÑnde, positive Logik" TAB_VERB "%6.3" "" COMPU_TAB_REF B_TRUE /end COMPU_METHOD
/begin COMPU_METHOD DEZ "1 : 1 Umrechnug (dez/hex)" RAT_FUNC "%6.2" "" COEFFS 0 1.000000 0.000000 0 0.000000 1.000000 /end COMPU_METHOD
/begin COMPU_METHOD dez "1 : 1 Umrechnug (dez/hex)" RAT_FUNC "%6.2" "" COEFFS 0 1.000000 0.000000 0 0.000000 1.000000 /end COMPU_METHOD
/begin COMPU_METHOD dez___UW "1 : 1 Umrechnug (dez/hex)" RAT_FUNC "%6.2" "" COEFFS 0 1.000000 0.000000 0 0.000000 1.000000 /end COMPU_METHOD
/begin COMPU_METHOD fak_ub_b4 "" RAT_FUNC "%6.4" "-" COEFFS 0 256.000000 0.000000 0 0.000000 4.000000 /end COMPU_METHOD
/begin COMPU_METHOD fak_uw_b16 "" RAT_FUNC "%6.5" "-" COEFFS 0 6.553600e+04 0.000000 0 0.000000 16.000000 /end COMPU_METHOD
/begin COMPU_METHOD fak_uw_b2 "" RAT_FUNC "%7.6" "-" COEFFS 0 6.553600e+04 0.000000 0 0.000000 2.000000 /end COMPU_METHOD
/begin COMPU_METHOD luquant "Umrechnung Laufunruhe in DMD" RAT_FUNC "%6.3" "(Umdr./sec)^2" COEFFS 0 1.583300 0.000000 0 0.000000 1.000000 /end COMPU_METHOD
/begin COMPU_METHOD m_q0p00277 "" RAT_FUNC "%6.4" "g" COEFFS 0 360.000000 0.000000 0 0.000000 1.000000 /end COMPU_METHOD
/begin COMPU_METHOD m_q0p00355 "" RAT_FUNC "%6.4" "kg" COEFFS 0 1125.000000 0.000000 0 0.000000 4.000000 /end COMPU_METHOD
/begin COMPU_METHOD m_ub_b1020 "" RAT_FUNC "%6.2" "kg/h" COEFFS 0 1.000000 0.000000 0 0.000000 4.000000 /end COMPU_METHOD
/begin COMPU_METHOD m_uw_b6553p5 "" RAT_FUNC "%6.3" "kg/h" COEFFS 0 1.000000 0.000000 0 0.000000 1.000000e-01 /end COMPU_METHOD
/begin COMPU_METHOD nmotd_sb_q10 "" RAT_FUNC "%6.1" "U/min" COEFFS 0 1.000000 0.000000 0 0.000000 10.000000 /end COMPU_METHOD
/begin COMPU_METHOD nmot_ub_q40 "" RAT_FUNC "%6.1" "Upm" COEFFS 0 1.000000 0.000000 0 0.000000 40.000000 /end COMPU_METHOD
/begin COMPU_METHOD p_sb_q10 "" RAT_FUNC "%6.1" "hPa" COEFFS 0 1.000000 0.000000 0 0.000000 10.000000 /end COMPU_METHOD
/begin COMPU_METHOD p_ub_q10 "" RAT_FUNC "%6.1" "hPa" COEFFS 0 1.000000 0.000000 0 0.000000 10.000000 /end COMPU_METHOD
/begin COMPU_METHOD p_ub_q5 "" RAT_FUNC "%6.2" "hPa" COEFFS 0 1.000000 0.000000 0 0.000000 5.000000 /end COMPU_METHOD
/begin COMPU_METHOD p_uw_q0p039 "" RAT_FUNC "%6.4" "hPa" COEFFS 0 256.000000 0.000000 0 0.000000 10.000000 /end COMPU_METHOD
/begin COMPU_METHOD relDK_ub_b100 "" RAT_FUNC "%6.3" "% DK" COEFFS 0 255.000000 0.000000 0 0.000000 100.000000 /end COMPU_METHOD
/begin COMPU_METHOD rel_sw_b100 "" RAT_FUNC "%6.4" "%" COEFFS 0 3.276800e+04 0.000000 0 0.000000 100.000000 /end COMPU_METHOD
/begin COMPU_METHOD rel_sw_b1536 "" RAT_FUNC "%6.4" "%" COEFFS 0 6.553600e+04 0.000000 0 0.000000 3072.000000 /end COMPU_METHOD
/begin COMPU_METHOD rel_ub_b99p6 "" RAT_FUNC "%6.3" "%" COEFFS 0 256.000000 0.000000 0 0.000000 100.000000 /end COMPU_METHOD
/begin COMPU_METHOD rel_ub_q0p75 "" RAT_FUNC "%6.3" "%" COEFFS 0 1.000000 0.000000 0 0.000000 7.500000e-01 /end COMPU_METHOD
/begin COMPU_METHOD rel_uw_b100 "" RAT_FUNC "%6.4" "%" COEFFS 0 6.553600e+04 0.000000 0 0.000000 100.000000 /end COMPU_METHOD
/begin COMPU_METHOD rel_uw_q0p0234 "" RAT_FUNC "%6.4" "%" COEFFS 0 32.000000 0.000000 0 0.000000 7.500000e-01 /end COMPU_METHOD
/begin COMPU_METHOD r_uw_q2 "" RAT_FUNC "%6.2" "Ohm" COEFFS 0 1.000000 0.000000 0 0.000000 2.000000 /end COMPU_METHOD
/begin COMPU_METHOD spgg_q0p52 "" RAT_FUNC "%6.3" "mV/ms" COEFFS 0 1.000000 0.000000 0 0.000000 5.200000e-01 /end COMPU_METHOD
/begin COMPU_METHOD spg_ubatt "" RAT_FUNC "%6.4" "V" COEFFS 0 1.000000 0.000000 0 0.000000 7.040000e-02 /end COMPU_METHOD
/begin COMPU_METHOD spg_ub_b1p33 "" RAT_FUNC "%6.4" "V" COEFFS 0 255.000000 0.000000 0 0.000000 1.330000 /end COMPU_METHOD
/begin COMPU_METHOD spg_ub_q0p0052_o0p2 "" RAT_FUNC "%6.3" "V" COEFFS 0 255.000000 51.000000 0 0.000000 1.330000 /end COMPU_METHOD
/begin COMPU_METHOD spg_ub_q0p019 "" RAT_FUNC "%6.4" "V" COEFFS 0 256.000000 0.000000 0 0.000000 5.000000 /end COMPU_METHOD
/begin COMPU_METHOD spg_uw_b1p33 "" RAT_FUNC "%7.6" "V" COEFFS 0 65535.000000 0.000000 0 0.000000 1.330000 /end COMPU_METHOD
/begin COMPU_METHOD spg_uw_q0p00488_o1 "" RAT_FUNC "%6.3" "V" COEFFS 0 1024.000000 1024.000000 0 0.000000 5.000000 /end COMPU_METHOD
/begin COMPU_METHOD t100msxs_sb_q0p01 "" RAT_FUNC "%6.4" "s" COEFFS 0 1.000000 0.000000 0 0.000000 1.000000e-02 /end COMPU_METHOD
/begin COMPU_METHOD t100msxs_ub_b25p5 "" RAT_FUNC "%6.3" "s" COEFFS 0 1.000000 0.000000 0 0.000000 1.000000e-01 /end COMPU_METHOD
/begin COMPU_METHOD t100msxs_ub_b2p55 "" RAT_FUNC "%6.4" "s" COEFFS 0 1.000000 0.000000 0 0.000000 1.000000e-02 /end COMPU_METHOD
/begin COMPU_METHOD t100msxs_uw_b6553p5 "" RAT_FUNC "%6.3" "s" COEFFS 0 1.000000 0.000000 0 0.000000 1.000000e-01 /end COMPU_METHOD
/begin COMPU_METHOD t10msxs_ub_b2p55 "" RAT_FUNC "%6.4" "s" COEFFS 0 1.000000 0.000000 0 0.000000 1.000000e-02 /end COMPU_METHOD
/begin COMPU_METHOD t10msxs_uw_b655p35 "" RAT_FUNC "%6.4" "s" COEFFS 0 1.000000 0.000000 0 0.000000 1.000000e-02 /end COMPU_METHOD
/begin COMPU_METHOD t1sxs_ub_b255 "" RAT_FUNC "%6.2" "s" COEFFS 0 1.000000 0.000000 0 0.000000 1.000000 /end COMPU_METHOD
/begin COMPU_METHOD t1sxs_uw_b65535 "" RAT_FUNC "%6.2" "s" COEFFS 0 1.000000 0.000000 0 0.000000 1.000000 /end COMPU_METHOD
/begin COMPU_METHOD t40msxs_ub_q0p04 "" RAT_FUNC "%6.4" "s" COEFFS 0 1.000000 0.000000 0 0.000000 4.000000e-02 /end COMPU_METHOD
/begin COMPU_METHOD t50msxs_uw_b3276p75 "" RAT_FUNC "%6.4" "s" COEFFS 0 1.000000 0.000000 0 0.000000 5.000000e-02 /end COMPU_METHOD
/begin COMPU_METHOD temp_sb_q0p75 "" RAT_FUNC "%6.3" "Grad C" COEFFS 0 1.000000 0.000000 0 0.000000 7.500000e-01 /end COMPU_METHOD
/begin COMPU_METHOD temp_ub_q0p75_o48 "" RAT_FUNC "%6.2" "Grad C" COEFFS 0 1.000000 48.000000 0 0.000000 7.500000e-01 /end COMPU_METHOD
/begin COMPU_METHOD temp_ub_q5_o50 "" RAT_FUNC "%6.2" "Grad C" COEFFS 0 1.000000 50.000000 0 0.000000 5.000000 /end COMPU_METHOD
/begin COMPU_METHOD tv_sw_q0p005 "" RAT_FUNC "%6.4" "%" COEFFS 0 1.000000 0.000000 0 0.000000 5.000000e-03 /end COMPU_METHOD
/begin COMPU_METHOD tv_ub_b100 "" RAT_FUNC "%6.3" "%" COEFFS 0 256.000000 0.000000 0 0.000000 100.000000 /end COMPU_METHOD
/begin COMPU_METHOD vfzg_ub_q1p25 "" RAT_FUNC "%6.2" "km/h" COEFFS 0 1.000000 0.000000 0 0.000000 1.250000 /end COMPU_METHOD
/begin COMPU_METHOD vfzg_ub_q1p25___UB "" RAT_FUNC "%6.2" "km/h" COEFFS 0 1.000000 0.000000 0 0.000000 1.250000 /end COMPU_METHOD
/begin COMPU_VTAB B_TRUE "" TAB_VERB 2 0 "----" 1 "TRUE" /end COMPU_VTAB
/begin MEASUREMENT tmot "Motor-Temperatur" UBYTE temp_ub_q0p75_o48 0 0 -48.000000 143.250000 /begin IF_DATA ASAP1B_ETK KP_BLOB 0x380B61 1 1 /end IF_DATA BIT_MASK 0xFF /end MEASUREMENT
/begin MEASUREMENT rl "relative LuftfÅllung" UBYTE rel_ub_q0p75 0 0 0.000000 191.250000 /begin IF_DATA ASAP1B_ETK KP_BLOB 0xF997 0 1 /end IF_DATA BIT_MASK 0xFF /end MEASUREMENT
/begin MEASUREMENT nmot "Motordrehzahl" UBYTE nmot_ub_q40 0 0 0.000000 10200.000000 /begin IF_DATA ASAP1B_ETK KP_BLOB 0xF876 0 1 /end IF_DATA BIT_MASK 0xFF /end MEASUREMENT
/begin MEASUREMENT tans "Ansauglufttemperatur" UBYTE temp_ub_q0p75_o48 0 0 -48.000000 143.250000 /begin IF_DATA ASAP1B_ETK KP_BLOB 0x380B59 1 1 /end IF_DATA BIT_MASK 0xFF /end MEASUREMENT
/begin MEASUREMENT fho "Korrekturfaktor Hîhe" UBYTE fak_ub_b4 0 0 0.000000 3.984375 /begin IF_DATA ASAP1B_ETK KP_BLOB 0x380AEB 1 1 /end IF_DATA BIT_MASK 0xFF /end MEASUREMENT
/begin MEASUREMENT ml "Luftmassenflu·" UBYTE m_ub_b1020 0 0 0.000000 1020.000000 /begin IF_DATA ASAP1B_ETK KP_BLOB 0xF996 0 1 /end IF_DATA BIT_MASK 0xFF /end MEASUREMENT
/begin MEASUREMENT lde "LDR-Regelabweichung (Sollwert - Istwert)" SBYTE p_sb_q10 0 0 -1280.000000 1270.000000 /begin IF_DATA ASAP1B_ETK KP_BLOB 0x380C01 1 1 /end IF_DATA BIT_MASK 0xFF /end MEASUREMENT
/begin MEASUREMENT pu "Umgebungsdruck" UBYTE p_ub_q5 0 0 0.000000 1275.000000 /begin IF_DATA ASAP1B_ETK KP_BLOB 0x380AEC 1 1 /end IF_DATA BIT_MASK 0xFF /end MEASUREMENT
/begin MEASUREMENT wdkba "Drosselklappenwinkel bezogen auf unteren Anschlag" UBYTE relDK_ub_b100 0 0 0.000000 100.000000 /begin IF_DATA ASAP1B_ETK KP_BLOB 0x380ACB 1 1 /end IF_DATA BIT_MASK 0xFF /end MEASUREMENT
/begin MEASUREMENT gangi "Ist-Gang" UBYTE dez 0 0 0.000000 255.000000 /begin IF_DATA ASAP1B_ETK KP_BLOB 0x380AB5 1 1 /end IF_DATA BIT_MASK 0xFF /end MEASUREMENT
/begin MEASUREMENT ml_w "Luftmassenflu· gefiltert (Word)" UWORD m_uw_b6553p5 0 0 0.000000 6553.500000 /begin IF_DATA ASAP1B_ETK KP_BLOB 0xF998 0 2 /end IF_DATA BIT_MASK 0xFFFF /end MEASUREMENT
/begin MEASUREMENT dns "LLR: Drehzahlabweichung zur stationÑren Solldrehzahl" SBYTE nmotd_sb_q10 0 0 -1280.000000 1270.000000 /begin IF_DATA ASAP1B_ETK KP_BLOB 0x380C19 1 1 /end IF_DATA BIT_MASK 0xFF /end MEASUREMENT
/begin MEASUREMENT rl_w "relative LuftfÅllung (Word)" UWORD rel_uw_q0p0234 0 0 0.000000 1535.976562 /begin IF_DATA ASAP1B_ETK KP_BLOB 0xF99C 0 2 /end IF_DATA BIT_MASK 0xFFFF /end MEASUREMENT
/begin MEASUREMENT vfzg "Fahrzeuggeschwindigkeit" UBYTE vfzg_ub_q1p25___UB 0 0 0.000000 318.750000 /begin IF_DATA ASAP1B_ETK KP_BLOB 0x380982 1 1 /end IF_DATA BIT_MASK 0xFF /end MEASUREMENT
/begin MEASUREMENT tkatm "Katalysatortemperatur aus Modell" UBYTE temp_ub_q5_o50 0 0 -50.000000 1225.000000 /begin IF_DATA ASAP1B_ETK KP_BLOB 0x380A6D 1 1 /end IF_DATA BIT_MASK 0xFF /end MEASUREMENT
/begin MEASUREMENT tabgm "Abgastemperatur vor Kat aus Modell" UBYTE temp_ub_q5_o50 0 0 -50.000000 1225.000000 /begin IF_DATA ASAP1B_ETK KP_BLOB 0x380A68 1 1 /end IF_DATA BIT_MASK 0xFF /end MEASUREMENT
/begin MEASUREMENT pspvds_w "Quotient Saugrohrdruck/Druck vor DK" UWORD fak_uw_b2 0 0 0.000000 1.999969 /begin IF_DATA ASAP1B_ETK KP_BLOB 0x381E7A 1 2 /end IF_DATA BIT_MASK 0xFFFF /end MEASUREMENT
/begin MEASUREMENT lditv_w "LDR, TastverhÑltnis vom I-Regler (word)" SWORD tv_sw_q0p005 0 0 -163.840000 163.835000 /begin IF_DATA ASAP1B_ETK KP_BLOB 0x3822A8 1 2 /end IF_DATA BIT_MASK 0xFFFF /end MEASUREMENT
/begin MEASUREMENT tmotab "Motortemperatur beim Abstellen" UBYTE temp_ub_q0p75_o48 0 0 -48.000000 143.250000 /begin IF_DATA ASAP1B_ETK KP_BLOB 0x38335E 1 1 /end IF_DATA BIT_MASK 0xFF /end MEASUREMENT
/begin MEASUREMENT ub "Batteriespannung" UBYTE spg_ubatt 0 0 0.000000 17.952000 /begin IF_DATA ASAP1B_ETK KP_BLOB 0x380AB1 1 1 /end IF_DATA BIT_MASK 0xFF /end MEASUREMENT
/begin MEASUREMENT plsol "Soll-Ladedruck" UBYTE p_ub_q10 0 0 0.000000 2550.000000 /begin IF_DATA ASAP1B_ETK KP_BLOB 0x380AF9 1 1 /end IF_DATA BIT_MASK 0xFF /end MEASUREMENT
/begin MEASUREMENT tfpg "Timer Fast Pulse Gesamtdauer" UBYTE t1sxs_ub_b255 0 0 0.000000 255.000000 /begin IF_DATA ASAP1B_ETK KP_BLOB 0x380CD1 1 1 /end IF_DATA BIT_MASK 0xFF /end MEASUREMENT
/begin MEASUREMENT pukor_w "Umgebungsdruckwerte nach additiver Staudruckkorrektur" UWORD p_uw_q0p039 0 0 0.000000 2559.960938 /begin IF_DATA ASAP1B_ETK KP_BLOB 0x3827AE 1 2 /end IF_DATA BIT_MASK 0xFFFF /end MEASUREMENT
/begin MEASUREMENT ushk_w "Spannung Lambdasonde (4.88mV/LSB) hinter Katalysator" UWORD spg_uw_q0p00488_o1 0 0 -1.000000 318.995117 /begin IF_DATA ASAP1B_ETK KP_BLOB 0x381B4E 1 2 /end IF_DATA BIT_MASK 0xFFFF /end MEASUREMENT
/begin MEASUREMENT usrhk "aktuelle Regelschwelle Lambdasignal h.K." UBYTE spg_ub_q0p0052_o0p2 0 0 -0.200000 1.130000 /begin IF_DATA ASAP1B_ETK KP_BLOB 0x380CF0 1 1 /end IF_DATA BIT_MASK 0xFF /end MEASUREMENT
/begin MEASUREMENT atv "LRHK: aktueller Lernkennfeld-Integratorwert der Regelung h.K." SBYTE t100msxs_sb_q0p01 0 0 -1.280000 1.270000 /begin IF_DATA ASAP1B_ETK KP_BLOB 0x38343F 1 1 /end IF_DATA BIT_MASK 0xFF /end MEASUREMENT
/begin MEASUREMENT atv2 "LRHK (Bank2): aktueller Lernkennfeld-Integratorwert der Regelung h.K." SBYTE t100msxs_sb_q0p01 0 0 -1.280000 1.270000 /begin IF_DATA ASAP1B_ETK KP_BLOB 0x383440 1 1 /end IF_DATA BIT_MASK 0xFF /end MEASUREMENT
/begin MEASUREMENT atvfett "atv-Verschiebung nach FETT, DLSSA" UBYTE t40msxs_ub_q0p04 0 0 0.000000 10.200000 /begin IF_DATA ASAP1B_ETK KP_BLOB 0x380B05 1 1 /end IF_DATA BIT_MASK 0xFF /end MEASUREMENT
/begin MEASUREMENT atvmager "atv-Verschiebung nach MAGER, DLSSA" UBYTE t40msxs_ub_q0p04 0 0 0.000000 10.200000 /begin IF_DATA ASAP1B_ETK KP_BLOB 0x380B06 1 1 /end IF_DATA BIT_MASK 0xFF /end MEASUREMENT
/begin MEASUREMENT B_aav "Bedingung AAV wird angesteuert erfÅllt" UWORD B_TRUE___UW 0 0 0.000000 0.000000 /begin IF_DATA ASAP1B_ETK KP_BLOB 0xFD6A 0 2 /end IF_DATA BIT_MASK 0x800 /end MEASUREMENT
/begin MEASUREMENT B_abgstg "Bedingung ml is innerhalb den Schwellen" UBYTE B_TRUE 0 0 0.000000 0.000000 /begin IF_DATA ASAP1B_ETK KP_BLOB 0x380A78 1 1 /end IF_DATA BIT_MASK 0x2 /end MEASUREMENT
/begin MEASUREMENT B_abgstg2 "Bedingung tkatm liegt oberhalb Schwelle Bank2" UBYTE B_TRUE 0 0 0.000000 0.000000 /begin IF_DATA ASAP1B_ETK KP_BLOB 0x380A78 1 1 /end IF_DATA BIT_MASK 0x4 /end MEASUREMENT
/begin MEASUREMENT B_acsdh "Bedingung fÅr PrÅfung Adernschlu· und CSD hinter Kat" UWORD B_TRUE___UW 0 0 0.000000 0.000000 /begin IF_DATA ASAP1B_ETK KP_BLOB 0xFD22 0 2 /end IF_DATA BIT_MASK 0x200 /end MEASUREMENT
/begin MEASUREMENT B_adcsd "Bedingung fÅr PrÅfung Adernschlu· und CSD" UWORD B_TRUE___UW 0 0 0.000000 0.000000 /begin IF_DATA ASAP1B_ETK KP_BLOB 0xFD30 0 2 /end IF_DATA BIT_MASK 0x2000 /end MEASUREMENT
/begin MEASUREMENT B_adde "Bedingung Adernschlu· oder defekte Sonde mit begrenztem Spannungshub" UWORD B_TRUE___UW 0 0 0.000000 0.000000 /begin IF_DATA ASAP1B_ETK KP_BLOB 0xFD30 0 2 /end IF_DATA BIT_MASK 0x4000 /end MEASUREMENT
/begin MEASUREMENT B_adsh "Bedingung Adernschlu· bei Lambdasonden hinter Kat" UBYTE B_TRUE 0 0 0.000000 0.000000 /begin IF_DATA ASAP1B_ETK KP_BLOB 0x38331E 1 1 /end IF_DATA BIT_MASK 0x1 /end MEASUREMENT
/begin MEASUREMENT B_adshs "Bedingung Adernschlu· 'setzen' bei Lambdasonden hinter Kat" UBYTE B_TRUE 0 0 0.000000 0.000000 /begin IF_DATA ASAP1B_ETK KP_BLOB 0x380A70 1 1 /end IF_DATA BIT_MASK 0x40 /end MEASUREMENT
/begin MEASUREMENT B_adsvb "Verbot Betriebsbereitschaft wegen Adernschlu·" UWORD B_TRUE___UW 0 0 0.000000 0.000000 /begin IF_DATA ASAP1B_ETK KP_BLOB 0x383C34 1 2 /end IF_DATA BIT_MASK 0x100 /end MEASUREMENT
/begin MEASUREMENT B_anztp "Bedingung Anzahl der Periodendauermessungen erreicht" UWORD B_TRUE___UW 0 0 0.000000 0.000000 /begin IF_DATA ASAP1B_ETK KP_BLOB 0xFD34 0 2 /end IF_DATA BIT_MASK 0x80 /end MEASUREMENT
/begin MEASUREMENT B_anztp2 "Bedingung Anzahl der Periodendauermessungen erreicht Bank2" UWORD B_TRUE___UW 0 0 0.000000 0.000000 /begin IF_DATA ASAP1B_ETK KP_BLOB 0xFD34 0 2 /end IF_DATA BIT_MASK 0x100 /end MEASUREMENT
/begin MEASUREMENT B_atmtpa "Bedingung Taupunkt vor Kat ueberschritten" UWORD B_TRUE___UW 0 0 0.000000 0.000000 /begin IF_DATA ASAP1B_ETK KP_BLOB 0xFD22 0 2 /end IF_DATA BIT_MASK 0x40 /end MEASUREMENT
/begin MEASUREMENT B_atmtpk "Bedingung Taupunkt hinter Kat ueberschritten" UWORD B_TRUE___UW 0 0 0.000000 0.000000 /begin IF_DATA ASAP1B_ETK KP_BLOB 0xFD22 0 2 /end IF_DATA BIT_MASK 0x80 /end MEASUREMENT
/begin MEASUREMENT B_bergab "Bedingung Bergabfahrt erkannt" UWORD B_TRUE___UW 0 0 0.000000 0.000000 /begin IF_DATA ASAP1B_ETK KP_BLOB 0x382778 1 2 /end IF_DATA BIT_MASK 0x100 /end MEASUREMENT
/begin MEASUREMENT B_cdkvs "Funktion Åber Codewort CDKVS freigegeben" UWORD B_TRUE___UW 0 0 0.000000 0.000000 /begin IF_DATA ASAP1B_ETK KP_BLOB 0x380D30 1 2 /end IF_DATA BIT_MASK 0x800 /end MEASUREMENT
/begin MEASUREMENT B_cdlash "Funktion Åber Codewort CDLASH freigegeben" UWORD B_TRUE___UW 0 0 0.000000 0.000000 /begin IF_DATA ASAP1B_ETK KP_BLOB 0x380D32 1 2 /end IF_DATA BIT_MASK 0x40 /end MEASUREMENT
/begin MEASUREMENT B_cdlatp "Funktion Åber Codewort CDLATP freigegeben" UWORD B_TRUE___UW 0 0 0.000000 0.000000 /begin IF_DATA ASAP1B_ETK KP_BLOB 0x380D32 1 2 /end IF_DATA BIT_MASK 0x10 /end MEASUREMENT
/begin MEASUREMENT B_cdlatv "Funktion Åber Codewort CDLATV freigeben" UWORD B_TRUE___UW 0 0 0.000000 0.000000 /begin IF_DATA ASAP1B_ETK KP_BLOB 0x380D32 1 2 /end IF_DATA BIT_MASK 0x20 /end MEASUREMENT
/begin MEASUREMENT B_cdldp "Funktion Åber Codewort CDLDP freigegeben" UWORD B_TRUE___UW 0 0 0.000000 0.000000 /begin IF_DATA ASAP1B_ETK KP_BLOB 0x380D30 1 2 /end IF_DATA BIT_MASK 0x4000 /end MEASUREMENT
/begin MEASUREMENT B_cdllr "Funktion Åber Codewort CDLLR freigegeben" UWORD B_TRUE___UW 0 0 0.000000 0.000000 /begin IF_DATA ASAP1B_ETK KP_BLOB 0x380D32 1 2 /end IF_DATA BIT_MASK 0x8 /end MEASUREMENT
/begin MEASUREMENT B_cdlsh "Funktion Åber Codewort CDLSH freigegeben" UWORD B_TRUE___UW 0 0 0.000000 0.000000 /begin IF_DATA ASAP1B_ETK KP_BLOB 0x380D30 1 2 /end IF_DATA BIT_MASK 0x10 /end MEASUREMENT
/begin MEASUREMENT B_cdlsv "Funktion Åber Codewort CDLSV freigegeben" UWORD B_TRUE___UW 0 0 0.000000 0.000000 /begin IF_DATA ASAP1B_ETK KP_BLOB 0x380D30 1 2 /end IF_DATA BIT_MASK 0x8 /end MEASUREMENT
/begin MEASUREMENT B_cwlshdyn "Beding. Abschaltung fÅr Teilfunktion DynamikprÅfung Sonde hinter KAT in %DLSAHK" UWORD B_TRUE___UW 0 0 0.000000 0.000000 /begin IF_DATA ASAP1B_ETK KP_BLOB 0xFD00 0 2 /end IF_DATA BIT_MASK 0x40 /end MEASUREMENT
/begin MEASUREMENT B_cwlshsch "Bedingung Abschaltung fÅr Teilfunktion im Schub Sonde hinter KAT in %DLSAHK" UWORD B_TRUE___UW 0 0 0.000000 0.000000 /begin IF_DATA ASAP1B_ETK KP_BLOB 0xFD00 0 2 /end IF_DATA BIT_MASK 0x80 /end MEASUREMENT
/begin MEASUREMENT B_ddylash "Bedingung Sonde hinter KAT dynamisch langsam `dynamisch`" UWORD B_TRUE___UW 0 0 0.000000 0.000000 /begin IF_DATA ASAP1B_ETK KP_BLOB 0xFD24 0 2 /end IF_DATA BIT_MASK 0x8000 /end MEASUREMENT
/begin MEASUREMENT B_ddylash2 "Bedingung Sonde hinter KAT dynamisch langsam `dynamisch` Bank2" UWORD B_TRUE___UW 0 0 0.000000 0.000000 /begin IF_DATA ASAP1B_ETK KP_BLOB 0xFD26 0 2 /end IF_DATA BIT_MASK 0x1 /end MEASUREMENT
/begin MEASUREMENT B_desee "Diagnose Endstufe: Eingangsbedingungen erfÅllt" UWORD B_TRUE___UW 0 0 0.000000 0.000000 /begin IF_DATA ASAP1B_ETK KP_BLOB 0xFD54 0 2 /end IF_DATA BIT_MASK 0x100 /end MEASUREMENT
/begin MEASUREMENT B_didysch "Bedingung disable Dynamikmessung und Me·werte fÅr Mode6 bereitstellen" UWORD B_TRUE___UW 0 0 0.000000 0.000000 /begin IF_DATA ASAP1B_ETK KP_BLOB 0xFD26 0 2 /end IF_DATA BIT_MASK 0x2 /end MEASUREMENT
/begin MEASUREMENT B_didysch2 "Bedingung disable Dynamikmessung und Me·werte fÅr Mode6 bereitstellen Bank2" UWORD B_TRUE___UW 0 0 0.000000 0.000000 /begin IF_DATA ASAP1B_ETK KP_BLOB 0xFD26 0 2 /end IF_DATA BIT_MASK 0x4 /end MEASUREMENT
/begin MEASUREMENT B_disch "Bedingung disable Schubmessung und Me·werte fÅr Mode6 bereitstellen" UWORD B_TRUE___UW 0 0 0.000000 0.000000 /begin IF_DATA ASAP1B_ETK KP_BLOB 0xFD26 0 2 /end IF_DATA BIT_MASK 0x8 /end MEASUREMENT
/begin MEASUREMENT B_disch2 "Bedingung disable Schubmessung und Me·werte fÅr Mode6 bereitstellen Bank2" UWORD B_TRUE___UW 0 0 0.000000 0.000000 /begin IF_DATA ASAP1B_ETK KP_BLOB 0xFD26 0 2 /end IF_DATA BIT_MASK 0x10 /end MEASUREMENT
/begin MEASUREMENT B_distp "Bedingung disable Periodendauer-Diag. und Me·werte fÅr Mode6 bereitstellen" UWORD B_TRUE___UW 0 0 0.000000 0.000000 /begin IF_DATA ASAP1B_ETK KP_BLOB 0xFD34 0 2 /end IF_DATA BIT_MASK 0x200 /end MEASUREMENT
/begin MEASUREMENT B_distp2 "Bedingung disable Periodendauer-Diag. und Me·werte fÅr Mode6 bereitstellen Bank2" UWORD B_TRUE___UW 0 0 0.000000 0.000000 /begin IF_DATA ASAP1B_ETK KP_BLOB 0xFD34 0 2 /end IF_DATA BIT_MASK 0x400 /end MEASUREMENT
/begin MEASUREMENT B_distv "Bedingung disable atv-Diagnose" UWORD B_TRUE___UW 0 0 0.000000 0.000000 /begin IF_DATA ASAP1B_ETK KP_BLOB 0xFD34 0 2 /end IF_DATA BIT_MASK 0x800 /end MEASUREMENT
/begin MEASUREMENT B_distv2 "Bedingung disable atv-Diagnose  Bank2" UWORD B_TRUE___UW 0 0 0.000000 0.000000 /begin IF_DATA ASAP1B_ETK KP_BLOB 0xFD34 0 2 /end IF_DATA BIT_MASK 0x1000 /end MEASUREMENT
/begin MEASUREMENT B_dknolu "Bedingung Drosselklappensteller stromlos" UWORD B_TRUE___UW 0 0 0.000000 0.000000 /begin IF_DATA ASAP1B_ETK KP_BLOB 0xFD46 0 2 /end IF_DATA BIT_MASK 0x100 /end MEASUREMENT
/begin MEASUREMENT B_dkpu "Bedingung Sicherheitskraftstoffabschaltung (SKA)" UWORD B_TRUE___UW 0 0 0.000000 0.000000 /begin IF_DATA ASAP1B_ETK KP_BLOB 0xFD46 0 2 /end IF_DATA BIT_MASK 0x1000 /end MEASUREMENT
/begin MEASUREMENT B_dkvsf "Bedingung: Freigabe des Fehlers" UWORD B_TRUE___UW 0 0 0.000000 0.000000 /begin IF_DATA ASAP1B_ETK KP_BLOB 0xFD64 0 2 /end IF_DATA BIT_MASK 0x1000 /end MEASUREMENT
/begin MEASUREMENT B_dkvsfm "Bedingung: Freigabe des Fehlers (Flipflop Ausgang)" UBYTE B_TRUE 0 0 0.000000 0.000000 /begin IF_DATA ASAP1B_ETK KP_BLOB 0x38335B 1 1 /end IF_DATA BIT_MASK 0x1 /end MEASUREMENT
/begin MEASUREMENT B_dkvstr "Bedingung: Integrator bei Tankleer zurÅcksetzen" UWORD B_TRUE___UW 0 0 0.000000 0.000000 /begin IF_DATA ASAP1B_ETK KP_BLOB 0xFD64 0 2 /end IF_DATA BIT_MASK 0x2000 /end MEASUREMENT
/begin MEASUREMENT B_dlaff "Anzahl der gÅltigen Tp-Messungen erreicht seit B_dlatp=1" UWORD B_TRUE___UW 0 0 0.000000 0.000000 /begin IF_DATA ASAP1B_ETK KP_BLOB 0xFD34 0 2 /end IF_DATA BIT_MASK 0x2000 /end MEASUREMENT
/begin MEASUREMENT B_dlaff2 "Anzahl der gÅltigen Tp-Messungen erreicht seit B_dlatp2=1 Bank2" UWORD B_TRUE___UW 0 0 0.000000 0.000000 /begin IF_DATA ASAP1B_ETK KP_BLOB 0xFD34 0 2 /end IF_DATA BIT_MASK 0x4000 /end MEASUREMENT
/begin MEASUREMENT B_dlash "Aktive Diagnose:	Lambda-Sondenalterung hinter Kat." UWORD B_TRUE___UW 0 0 0.000000 0.000000 /begin IF_DATA ASAP1B_ETK KP_BLOB 0xFD26 0 2 /end IF_DATA BIT_MASK 0x20 /end MEASUREMENT
/begin MEASUREMENT B_dlash2 "Aktive Diagnose:	Lambda-Sondenalterung hinter Kat. (Bank 2)" UWORD B_TRUE___UW 0 0 0.000000 0.000000 /begin IF_DATA ASAP1B_ETK KP_BLOB 0xFD26 0 2 /end IF_DATA BIT_MASK 0x40 /end MEASUREMENT
/begin MEASUREMENT B_dlatp "Aktive Diagnose:	Lambda-Sondenalterung TP" UWORD B_TRUE___UW 0 0 0.000000 0.000000 /begin IF_DATA ASAP1B_ETK KP_BLOB 0xFD34 0 2 /end IF_DATA BIT_MASK 0x8000 /end MEASUREMENT
/begin MEASUREMENT B_dlatp2 "Aktive Diagnose:	Lambda-Sondenalterung TP (Bank 2)" UWORD B_TRUE___UW 0 0 0.000000 0.000000 /begin IF_DATA ASAP1B_ETK KP_BLOB 0xFD36 0 2 /end IF_DATA BIT_MASK 0x1 /end MEASUREMENT
/begin MEASUREMENT B_dlatv "Aktive Diagnose:	Lambda-Sondenalterung TV" UWORD B_TRUE___UW 0 0 0.000000 0.000000 /begin IF_DATA ASAP1B_ETK KP_BLOB 0xFD36 0 2 /end IF_DATA BIT_MASK 0x2 /end MEASUREMENT
/begin MEASUREMENT B_dlatv2 "Aktive Diagnose:	Lambda-Sondenalterung TV (Bank 2)" UWORD B_TRUE___UW 0 0 0.000000 0.000000 /begin IF_DATA ASAP1B_ETK KP_BLOB 0xFD36 0 2 /end IF_DATA BIT_MASK 0x4 /end MEASUREMENT
/begin MEASUREMENT B_dldp "Aktive Diagnose: Leckdiagnosemodul" UWORD B_TRUE___UW 0 0 0.000000 0.000000 /begin IF_DATA ASAP1B_ETK KP_BLOB 0x382778 1 2 /end IF_DATA BIT_MASK 0x200 /end MEASUREMENT
/begin MEASUREMENT B_dldpf "Flag DLDP ist prinzipiell freigegeben" UWORD B_TRUE___UW 0 0 0.000000 0.000000 /begin IF_DATA ASAP1B_ETK KP_BLOB 0x382778 1 2 /end IF_DATA BIT_MASK 0x400 /end MEASUREMENT
/begin MEASUREMENT B_dldpte "Anforderung TEV schlie·en aus TankentlÅftungsdiagnose" UWORD B_TRUE___UW 0 0 0.000000 0.000000 /begin IF_DATA ASAP1B_ETK KP_BLOB 0xFD92 0 2 /end IF_DATA BIT_MASK 0x100 /end MEASUREMENT
/begin MEASUREMENT B_dllr "Aktive diagnose: Leerlaufstellerdiagnose" UWORD B_TRUE___UW 0 0 0.000000 0.000000 /begin IF_DATA ASAP1B_ETK KP_BLOB 0xFD7C 0 2 /end IF_DATA BIT_MASK 0x800 /end MEASUREMENT
/begin MEASUREMENT B_dllra "Bedingung DLLR Anforderung" UWORD B_TRUE___UW 0 0 0.000000 0.000000 /begin IF_DATA ASAP1B_ETK KP_BLOB 0xFD7C 0 2 /end IF_DATA BIT_MASK 0x1000 /end MEASUREMENT
/begin MEASUREMENT B_dluerk_m "Monitor, Aussetzer erkannt in DMDDLU" UBYTE B_TRUE 0 0 0.000000 0.000000 /begin IF_DATA ASAP1B_ETK KP_BLOB 0xE3DB 0 1 /end IF_DATA BIT_MASK 0x1 /end MEASUREMENT
/begin MEASUREMENT B_dmaso "Bedingung gemeinsame Sondenmasse offen 'dynamisch'" UWORD B_TRUE___UW 0 0 0.000000 0.000000 /begin IF_DATA ASAP1B_ETK KP_BLOB 0xFD30 0 2 /end IF_DATA BIT_MASK 0x8000 /end MEASUREMENT
/begin MEASUREMENT B_dpumn "Bedingung minimale Differenz Umgebungsdruck - Saugrohrdruck" UWORD B_TRUE___UW 0 0 0.000000 0.000000 /begin IF_DATA ASAP1B_ETK KP_BLOB 0x382778 1 2 /end IF_DATA BIT_MASK 0x8000 /end MEASUREMENT
/begin MEASUREMENT B_dshen "Bedingung Freigabe Sondendiagnose hinter KAT" UWORD B_TRUE___UW 0 0 0.000000 0.000000 /begin IF_DATA ASAP1B_ETK KP_BLOB 0xFD22 0 2 /end IF_DATA BIT_MASK 0x400 /end MEASUREMENT
/begin MEASUREMENT B_dshk "Bedingung Diagnosefunktion in %DLSH und %DHLS mit i.O.-Meldung h. KAT beendet." UWORD B_TRUE___UW 0 0 0.000000 0.000000 /begin IF_DATA ASAP1B_ETK KP_BLOB 0xFD26 0 2 /end IF_DATA BIT_MASK 0x80 /end MEASUREMENT
/begin MEASUREMENT B_dshk2 "Bed. Diagnosefunktion in %DLSH u.%DHLS mit i.O.-Meldung h. KAT beendet. Bank2" UWORD B_TRUE___UW 0 0 0.000000 0.000000 /begin IF_DATA ASAP1B_ETK KP_BLOB 0xFD26 0 2 /end IF_DATA BIT_MASK 0x100 /end MEASUREMENT
/begin MEASUREMENT B_dsls "Aktive Diagnose: SekundÑrluft-System" UWORD B_TRUE___UW 0 0 0.000000 0.000000 /begin IF_DATA ASAP1B_ETK KP_BLOB 0xFD0C 0 2 /end IF_DATA BIT_MASK 0x2 /end MEASUREMENT
/begin MEASUREMENT B_dsven "Bedingung Freigabe Sondendiagnose vor KAT" UWORD B_TRUE___UW 0 0 0.000000 0.000000 /begin IF_DATA ASAP1B_ETK KP_BLOB 0xFD32 0 2 /end IF_DATA BIT_MASK 0x1 /end MEASUREMENT
/begin MEASUREMENT B_dtes "Aktive Diagnose: TankentlÅftungssystem" UWORD B_TRUE___UW 0 0 0.000000 0.000000 /begin IF_DATA ASAP1B_ETK KP_BLOB 0xFD8C 0 2 /end IF_DATA BIT_MASK 0x800 /end MEASUREMENT
/begin MEASUREMENT B_dtest "Start fÅr TEV-Ansteuerung" UWORD B_TRUE___UW 0 0 0.000000 0.000000 /begin IF_DATA ASAP1B_ETK KP_BLOB 0xFD8C 0 2 /end IF_DATA BIT_MASK 0x1000 /end MEASUREMENT
/begin MEASUREMENT B_dteven "Bedingung Freigabe DLDP-TEV- Check" UWORD B_TRUE___UW 0 0 0.000000 0.000000 /begin IF_DATA ASAP1B_ETK KP_BLOB 0x38277A 1 2 /end IF_DATA BIT_MASK 0x2 /end MEASUREMENT
/begin MEASUREMENT B_dushsch "Bed. Schwelle fÅr Sonde h. KAT im Schub nicht unterschritten `dynamisch`" UWORD B_TRUE___UW 0 0 0.000000 0.000000 /begin IF_DATA ASAP1B_ETK KP_BLOB 0xFD26 0 2 /end IF_DATA BIT_MASK 0x200 /end MEASUREMENT
/begin MEASUREMENT B_dushsch2 "Bed. Schwelle fÅr Sonde h. KAT im Schub nicht unterschritten `dynamisch` Bank2" UWORD B_TRUE___UW 0 0 0.000000 0.000000 /begin IF_DATA ASAP1B_ETK KP_BLOB 0xFD26 0 2 /end IF_DATA BIT_MASK 0x400 /end MEASUREMENT
/begin MEASUREMENT B_dylash "Bedingung Sonde hinter KAT dynamisch langsam `statisch`" UBYTE B_TRUE 0 0 0.000000 0.000000 /begin IF_DATA ASAP1B_ETK KP_BLOB 0x383337 1 1 /end IF_DATA BIT_MASK 0x1 /end MEASUREMENT
/begin MEASUREMENT B_dylash2 "Bedingung Sonde hinter KAT dynamisch langsam `statisch` Bank2" UBYTE B_TRUE 0 0 0.000000 0.000000 /begin IF_DATA ASAP1B_ETK KP_BLOB 0x383337 1 1 /end IF_DATA BIT_MASK 0x2 /end MEASUREMENT
/begin MEASUREMENT B_edkvs "Bedingung Adaptionsfehlerschwellen aktuell Åberschritten" UWORD B_TRUE___UW 0 0 0.000000 0.000000 /begin IF_DATA ASAP1B_ETK KP_BLOB 0xFD64 0 2 /end IF_DATA BIT_MASK 0x4000 /end MEASUREMENT
/begin MEASUREMENT B_efrao "Bedingung Diagnoseschwellen obere multipl. Korrektur aktuell Åberschritten" UWORD B_TRUE___UW 0 0 0.000000 0.000000 /begin IF_DATA ASAP1B_ETK KP_BLOB 0xFD64 0 2 /end IF_DATA BIT_MASK 0x8000 /end MEASUREMENT
/begin MEASUREMENT B_efrau "Bedingung Diagnoseschwellen untere multipl. Korrektur aktuell Åberschritten" UWORD B_TRUE___UW 0 0 0.000000 0.000000 /begin IF_DATA ASAP1B_ETK KP_BLOB 0xFD66 0 2 /end IF_DATA BIT_MASK 0x1 /end MEASUREMENT
/begin MEASUREMENT B_enfmst "Bedingung Enable fÅr Filter; Maximum der Steigung Åbernehmen" UWORD B_TRUE___UW 0 0 0.000000 0.000000 /begin IF_DATA ASAP1B_ETK KP_BLOB 0xFD26 0 2 /end IF_DATA BIT_MASK 0x800 /end MEASUREMENT
/begin MEASUREMENT B_enfmst2 "Bedingung Enable fÅr Filter Maximum der Steigung Åbernehmen Bank2" UWORD B_TRUE___UW 0 0 0.000000 0.000000 /begin IF_DATA ASAP1B_ETK KP_BLOB 0xFD26 0 2 /end IF_DATA BIT_MASK 0x1000 /end MEASUREMENT
/begin MEASUREMENT B_enlash "Bedingung Test fÅr SchwingungsprÅfung abgeschlossen, Freigabe Zyklusbit" UWORD B_TRUE___UW 0 0 0.000000 0.000000 /begin IF_DATA ASAP1B_ETK KP_BLOB 0xFD26 0 2 /end IF_DATA BIT_MASK 0x2000 /end MEASUREMENT
/begin MEASUREMENT B_enlash2 "Bedingung Test fÅr SchwingungsprÅfung abgeschlossen, Freigabe Zyklusbit Bank2" UWORD B_TRUE___UW 0 0 0.000000 0.000000 /begin IF_DATA ASAP1B_ETK KP_BLOB 0xFD26 0 2 /end IF_DATA BIT_MASK 0x4000 /end MEASUREMENT
/begin MEASUREMENT B_entest "Bedingung Wartezeit abgeschlossen fÅr Test-öberprÅfung Sonde hinter KAT" UWORD B_TRUE___UW 0 0 0.000000 0.000000 /begin IF_DATA ASAP1B_ETK KP_BLOB 0xFD26 0 2 /end IF_DATA BIT_MASK 0x8000 /end MEASUREMENT
/begin MEASUREMENT B_entest2 "Bedingung Wartezeit abgeschlossen fÅr Test-öberprÅfung Sonde hinter KAT Bank2" UWORD B_TRUE___UW 0 0 0.000000 0.000000 /begin IF_DATA ASAP1B_ETK KP_BLOB 0xFD28 0 2 /end IF_DATA BIT_MASK 0x1 /end MEASUREMENT
/begin MEASUREMENT B_enws "Bedingung Fehler Nockenwellenansteuerung liegt vor" UBYTE B_TRUE 0 0 0.000000 0.000000 /begin IF_DATA ASAP1B_ETK KP_BLOB 0x380B01 1 1 /end IF_DATA BIT_MASK 0x1 /end MEASUREMENT
/begin MEASUREMENT B_erkat "Bedingung Diagnoseschwellen additive Korr. pro Zeit aktuell Åberschritten" UWORD B_TRUE___UW 0 0 0.000000 0.000000 /begin IF_DATA ASAP1B_ETK KP_BLOB 0xFD66 0 2 /end IF_DATA BIT_MASK 0x2 /end MEASUREMENT
/begin MEASUREMENT B_erkaz "Bedingung Diagnoseschwellen additive Korr. pro Einspr.  aktuell Åberschritten" UWORD B_TRUE___UW 0 0 0.000000 0.000000 /begin IF_DATA ASAP1B_ETK KP_BLOB 0xFD66 0 2 /end IF_DATA BIT_MASK 0x4 /end MEASUREMENT
/begin MEASUREMENT B_erl "Bedingung fÅr Errorpfad ldo vom rl check" UWORD B_TRUE___UW 0 0 0.000000 0.000000 /begin IF_DATA ASAP1B_ETK KP_BLOB 0xFD7A 0 2 /end IF_DATA BIT_MASK 0x10 /end MEASUREMENT
/begin MEASUREMENT B_errldp "Bedingung Fehlerbit erfÅllt" UWORD B_TRUE___UW 0 0 0.000000 0.000000 /begin IF_DATA ASAP1B_ETK KP_BLOB 0x382778 1 2 /end IF_DATA BIT_MASK 0x800 /end MEASUREMENT
/begin MEASUREMENT B_esls "Bedingung Falschluft durch Fehler im SekundÑrluftsystem" UWORD B_TRUE___UW 0 0 0.000000 0.000000 /begin IF_DATA ASAP1B_ETK KP_BLOB 0xFD0C 0 2 /end IF_DATA BIT_MASK 0x10 /end MEASUREMENT
/begin MEASUREMENT B_evloc "Status alle lokalen Einspritzventile werden angesteuert, = B_EVTOT bei einen SG" UWORD B_TRUE___UW 0 0 0.000000 0.000000 /begin IF_DATA ASAP1B_ETK KP_BLOB 0xFD5C 0 2 /end IF_DATA BIT_MASK 0x40 /end MEASUREMENT
/begin MEASUREMENT B_extaav "Bedingung elektrisches AAV vorhanden" UWORD B_TRUE___UW 0 0 0.000000 0.000000 /begin IF_DATA ASAP1B_ETK KP_BLOB 0x38277A 1 2 /end IF_DATA BIT_MASK 0x10 /end MEASUREMENT
/begin MEASUREMENT B_fa "Bedingung Funktionsanforderung allgemein" UWORD B_TRUE___UW 0 0 0.000000 0.000000 /begin IF_DATA ASAP1B_ETK KP_BLOB 0xFD74 0 2 /end IF_DATA BIT_MASK 0x100 /end MEASUREMENT
/begin MEASUREMENT B_fakvs "Funktionsaufforderung Diagnose Kraftstoffsystem fÅr Schnelltest" UWORD B_TRUE___UW 0 0 0.000000 0.000000 /begin IF_DATA ASAP1B_ETK KP_BLOB 0xFD76 0 2 /end IF_DATA BIT_MASK 0x1 /end MEASUREMENT
/begin MEASUREMENT B_faldp "Bedingung Funktionsanforderung Leckdiagnosepumpe" UWORD B_TRUE___UW 0 0 0.000000 0.000000 /begin IF_DATA ASAP1B_ETK KP_BLOB 0xFD76 0 2 /end IF_DATA BIT_MASK 0x2 /end MEASUREMENT
/begin MEASUREMENT B_faldpa "" UWORD B_TRUE___UW 0 0 0.000000 0.000000 /begin IF_DATA ASAP1B_ETK KP_BLOB 0x382778 1 2 /end IF_DATA BIT_MASK 0x2 /end MEASUREMENT
/begin MEASUREMENT B_falsh "Bedingung Funktionsanforderung Lambda-Sonde hinter KAT" UWORD B_TRUE___UW 0 0 0.000000 0.000000 /begin IF_DATA ASAP1B_ETK KP_BLOB 0xFD76 0 2 /end IF_DATA BIT_MASK 0x4 /end MEASUREMENT
/begin MEASUREMENT B_fash "Bedingung Funktionsanforderung SchwingungsprÅfung" UWORD B_TRUE___UW 0 0 0.000000 0.000000 /begin IF_DATA ASAP1B_ETK KP_BLOB 0xFD76 0 2 /end IF_DATA BIT_MASK 0x20 /end MEASUREMENT
/begin MEASUREMENT B_fash2 "Bedingung Funktionsanforderung SchwingungsprÅfung Bank2" UWORD B_TRUE___UW 0 0 0.000000 0.000000 /begin IF_DATA ASAP1B_ETK KP_BLOB 0xFD76 0 2 /end IF_DATA BIT_MASK 0x40 /end MEASUREMENT
/begin MEASUREMENT B_fatp "Bedingung Funktionsanforderung TP-öberwachung" UWORD B_TRUE___UW 0 0 0.000000 0.000000 /begin IF_DATA ASAP1B_ETK KP_BLOB 0xFD76 0 2 /end IF_DATA BIT_MASK 0x200 /end MEASUREMENT
/begin MEASUREMENT B_fatp2 "Bedingung Funktionsanforderung TP-öberwachung Bank2" UWORD B_TRUE___UW 0 0 0.000000 0.000000 /begin IF_DATA ASAP1B_ETK KP_BLOB 0xFD76 0 2 /end IF_DATA BIT_MASK 0x400 /end MEASUREMENT
/begin MEASUREMENT B_fatv "Bedingung Funktionsanforderung TV-öberwachung" UWORD B_TRUE___UW 0 0 0.000000 0.000000 /begin IF_DATA ASAP1B_ETK KP_BLOB 0xFD76 0 2 /end IF_DATA BIT_MASK 0x800 /end MEASUREMENT
/begin MEASUREMENT B_fatv2 "Bedingung Funktionsanforderung TV-öberwachung Bank2" UWORD B_TRUE___UW 0 0 0.000000 0.000000 /begin IF_DATA ASAP1B_ETK KP_BLOB 0xFD76 0 2 /end IF_DATA BIT_MASK 0x1000 /end MEASUREMENT
/begin MEASUREMENT B_fev1 "Bedingung Ansaugluft<Minimalwert erkannt" UWORD B_TRUE___UW 0 0 0.000000 0.000000 /begin IF_DATA ASAP1B_ETK KP_BLOB 0x38277E 1 2 /end IF_DATA BIT_MASK 0x1 /end MEASUREMENT
/begin MEASUREMENT B_fev10 "Bedingung kurze LastÅberschreitung rl Åber Maxwert" UWORD B_TRUE___UW 0 0 0.000000 0.000000 /begin IF_DATA ASAP1B_ETK KP_BLOB 0x38277E 1 2 /end IF_DATA BIT_MASK 0x200 /end MEASUREMENT
/begin MEASUREMENT B_fev11 "Bedingung TEV nicht erfÅllt" UWORD B_TRUE___UW 0 0 0.000000 0.000000 /begin IF_DATA ASAP1B_ETK KP_BLOB 0x38277E 1 2 /end IF_DATA BIT_MASK 0x400 /end MEASUREMENT
/begin MEASUREMENT B_fev12 "Bedingung Reedkontakt îffnet in der Fast Pulse Phase" UWORD B_TRUE___UW 0 0 0.000000 0.000000 /begin IF_DATA ASAP1B_ETK KP_BLOB 0x38277E 1 2 /end IF_DATA BIT_MASK 0x800 /end MEASUREMENT
/begin MEASUREMENT B_fev2 "Bedingung Ansaugluft>Maximalwert erkannt" UWORD B_TRUE___UW 0 0 0.000000 0.000000 /begin IF_DATA ASAP1B_ETK KP_BLOB 0x38277E 1 2 /end IF_DATA BIT_MASK 0x2 /end MEASUREMENT
/begin MEASUREMENT B_fev3 "Bedingung Motortemperatur<Minimalwert erkannt" UWORD B_TRUE___UW 0 0 0.000000 0.000000 /begin IF_DATA ASAP1B_ETK KP_BLOB 0x38277E 1 2 /end IF_DATA BIT_MASK 0x4 /end MEASUREMENT
/begin MEASUREMENT B_fev4 "Bedingung Motortemperatur>Maximalwert erkannt" UWORD B_TRUE___UW 0 0 0.000000 0.000000 /begin IF_DATA ASAP1B_ETK KP_BLOB 0x38277E 1 2 /end IF_DATA BIT_MASK 0x8 /end MEASUREMENT
/begin MEASUREMENT B_fev5 "Bedingung Differenz zwischen Motorabstell- und Motorstarttemperatur erkannt" UWORD B_TRUE___UW 0 0 0.000000 0.000000 /begin IF_DATA ASAP1B_ETK KP_BLOB 0x38277E 1 2 /end IF_DATA BIT_MASK 0x10 /end MEASUREMENT
/begin MEASUREMENT B_fev6 "Bedingung Hîhe>Maximalwert erkannt" UWORD B_TRUE___UW 0 0 0.000000 0.000000 /begin IF_DATA ASAP1B_ETK KP_BLOB 0x38277E 1 2 /end IF_DATA BIT_MASK 0x20 /end MEASUREMENT
/begin MEASUREMENT B_fev7 "Bedingung Fahrzeuggeschwindigkeit<Minimalwert erfÅllt" UWORD B_TRUE___UW 0 0 0.000000 0.000000 /begin IF_DATA ASAP1B_ETK KP_BLOB 0x38277E 1 2 /end IF_DATA BIT_MASK 0x40 /end MEASUREMENT
/begin MEASUREMENT B_fev8 "Bedingung Bergabfahrt erkannt" UWORD B_TRUE___UW 0 0 0.000000 0.000000 /begin IF_DATA ASAP1B_ETK KP_BLOB 0x38277E 1 2 /end IF_DATA BIT_MASK 0x80 /end MEASUREMENT
/begin MEASUREMENT B_fev9 "Bedingung lange LastÅberschreitung rl Åber Maxwert" UWORD B_TRUE___UW 0 0 0.000000 0.000000 /begin IF_DATA ASAP1B_ETK KP_BLOB 0x38277E 1 2 /end IF_DATA BIT_MASK 0x100 /end MEASUREMENT
/begin MEASUREMENT B_fpchk "Bedingung PrÅfung auf Abbruch Fast Pulse" UWORD B_TRUE___UW 0 0 0.000000 0.000000 /begin IF_DATA ASAP1B_ETK KP_BLOB 0x382778 1 2 /end IF_DATA BIT_MASK 0x1000 /end MEASUREMENT
/begin MEASUREMENT B_frao "Einschaltbedingung fÅr Adaption von frao" UWORD B_TRUE___UW 0 0 0.000000 0.000000 /begin IF_DATA ASAP1B_ETK KP_BLOB 0xFD5E 0 2 /end IF_DATA BIT_MASK 0x40 /end MEASUREMENT
/begin MEASUREMENT B_frau "Einschaltbedingung fÅr Adaption von frau" UWORD B_TRUE___UW 0 0 0.000000 0.000000 /begin IF_DATA ASAP1B_ETK KP_BLOB 0xFD5E 0 2 /end IF_DATA BIT_MASK 0x100 /end MEASUREMENT
/begin MEASUREMENT B_fraur "Bedingung frau-Integrator au·erhalb reduzierter Bereich" UWORD B_TRUE___UW 0 0 0.000000 0.000000 /begin IF_DATA ASAP1B_ETK KP_BLOB 0xFD5E 0 2 /end IF_DATA BIT_MASK 0x200 /end MEASUREMENT
/begin MEASUREMENT B_frmlash "Bedingung Mittelwert des Lambdaregelfaktors innerhalb den Schwellen" UWORD B_TRUE___UW 0 0 0.000000 0.000000 /begin IF_DATA ASAP1B_ETK KP_BLOB 0xFD28 0 2 /end IF_DATA BIT_MASK 0x2 /end MEASUREMENT
/begin MEASUREMENT B_frmlash2 "Bedingung Mittelwert des Lambdaregelfaktors innerhalb den Schwellen Bank2" UWORD B_TRUE___UW 0 0 0.000000 0.000000 /begin IF_DATA ASAP1B_ETK KP_BLOB 0xFD28 0 2 /end IF_DATA BIT_MASK 0x4 /end MEASUREMENT
/begin MEASUREMENT B_frste "Bedingung frm_w eingeschwungen (Kurztest)" UWORD B_TRUE___UW 0 0 0.000000 0.000000 /begin IF_DATA ASAP1B_ETK KP_BLOB 0xFD66 0 2 /end IF_DATA BIT_MASK 0x8 /end MEASUREMENT
/begin MEASUREMENT B_gae "Bedingung Grundadaption eingeschwungen" UWORD B_TRUE___UW 0 0 0.000000 0.000000 /begin IF_DATA ASAP1B_ETK KP_BLOB 0xFD66 0 2 /end IF_DATA BIT_MASK 0x10 /end MEASUREMENT
/begin MEASUREMENT B_gaefra "Bedingung Grundadaption (fra-Integrator) eingeschwungen" UWORD B_TRUE___UW 0 0 0.000000 0.000000 /begin IF_DATA ASAP1B_ETK KP_BLOB 0xFD66 0 2 /end IF_DATA BIT_MASK 0x20 /end MEASUREMENT
/begin MEASUREMENT B_gaefra2 "Bedingung Grundadaption (fra2-Integrator) eingeschwungen" UWORD B_TRUE___UW 0 0 0.000000 0.000000 /begin IF_DATA ASAP1B_ETK KP_BLOB 0xFD66 0 2 /end IF_DATA BIT_MASK 0x40 /end MEASUREMENT
/begin MEASUREMENT B_gaeing "Bedingung Grundadaption Bank 1 eingeschwungen" UWORD B_TRUE___UW 0 0 0.000000 0.000000 /begin IF_DATA ASAP1B_ETK KP_BLOB 0xFD66 0 2 /end IF_DATA BIT_MASK 0x80 /end MEASUREMENT
/begin MEASUREMENT B_gaeing2 "Bedingung Grundadaption Bank 2 eingeschwungenen" UWORD B_TRUE___UW 0 0 0.000000 0.000000 /begin IF_DATA ASAP1B_ETK KP_BLOB 0xFD66 0 2 /end IF_DATA BIT_MASK 0x100 /end MEASUREMENT
/begin MEASUREMENT B_gasp "; 1 = Gemischadaption gesperrt" UWORD B_TRUE___UW 0 0 0.000000 0.000000 /begin IF_DATA ASAP1B_ETK KP_BLOB 0xFD62 0 2 /end IF_DATA BIT_MASK 0x200 /end MEASUREMENT
/begin MEASUREMENT B_hshe "Bedingung Endstufe Sondenheizung hinter Kat angesteuert" UWORD B_TRUE___UW 0 0 0.000000 0.000000 /begin IF_DATA ASAP1B_ETK KP_BLOB 0xFD32 0 2 /end IF_DATA BIT_MASK 0x1000 /end MEASUREMENT
/begin MEASUREMENT B_hsve "Bedingung Endstufe Sondenheizung vor Kat angesteuert" UWORD B_TRUE___UW 0 0 0.000000 0.000000 /begin IF_DATA ASAP1B_ETK KP_BLOB 0xFD34 0 2 /end IF_DATA BIT_MASK 0x4 /end MEASUREMENT
/begin MEASUREMENT B_imlkvse "Bedingung Luftmassenintegral RÅcksetzen" UBYTE B_TRUE 0 0 0.000000 0.000000 /begin IF_DATA ASAP1B_ETK KP_BLOB 0x38335B 1 1 /end IF_DATA BIT_MASK 0x2 /end MEASUREMENT
/begin MEASUREMENT B_ispuel "Flag InitialspÅlung ist erfolgt" UWORD B_TRUE___UW 0 0 0.000000 0.000000 /begin IF_DATA ASAP1B_ETK KP_BLOB 0x382778 1 2 /end IF_DATA BIT_MASK 0x1 /end MEASUREMENT
/begin MEASUREMENT B_kl15 "Bedingung Klemme 15" UWORD B_TRUE___UW 0 0 0.000000 0.000000 /begin IF_DATA ASAP1B_ETK KP_BLOB 0xFD84 0 2 /end IF_DATA BIT_MASK 0x80 /end MEASUREMENT
/begin MEASUREMENT B_kvsffl "Bedingung: Freigabe des Fehlers trotz Tank leer" UWORD B_TRUE___UW 0 0 0.000000 0.000000 /begin IF_DATA ASAP1B_ETK KP_BLOB 0xFD66 0 2 /end IF_DATA BIT_MASK 0x200 /end MEASUREMENT
/begin MEASUREMENT B_lamend "Bedingung Ende der Lambdaverstellung in %LAMKO" UWORD B_TRUE___UW 0 0 0.000000 0.000000 /begin IF_DATA ASAP1B_ETK KP_BLOB 0xFD28 0 2 /end IF_DATA BIT_MASK 0x8 /end MEASUREMENT
/begin MEASUREMENT B_lamend2 "Bedingung Ende der Lambdaverstellung in %LAMKO Bank2" UWORD B_TRUE___UW 0 0 0.000000 0.000000 /begin IF_DATA ASAP1B_ETK KP_BLOB 0xFD28 0 2 /end IF_DATA BIT_MASK 0x10 /end MEASUREMENT
/begin MEASUREMENT B_lamlash "Bedingung fÅr Abmagern in %LAMKO" UWORD B_TRUE___UW 0 0 0.000000 0.000000 /begin IF_DATA ASAP1B_ETK KP_BLOB 0xFD28 0 2 /end IF_DATA BIT_MASK 0x20 /end MEASUREMENT
/begin MEASUREMENT B_lamlash2 "Bedingung fÅr Abmagern in %LAMKO Bank2" UWORD B_TRUE___UW 0 0 0.000000 0.000000 /begin IF_DATA ASAP1B_ETK KP_BLOB 0xFD28 0 2 /end IF_DATA BIT_MASK 0x40 /end MEASUREMENT
/begin MEASUREMENT B_lamverg "Bedingung Vergleich Lambdasoll in %DLSAHK mit %LAMKO Åbereinstimmend" UWORD B_TRUE___UW 0 0 0.000000 0.000000 /begin IF_DATA ASAP1B_ETK KP_BLOB 0xFD28 0 2 /end IF_DATA BIT_MASK 0x80 /end MEASUREMENT
/begin MEASUREMENT B_lamverg2 "Bedingung Vergleich Lambdasoll in %DLSAHK mit %LAMKO Åbereinstimmend Bank2" UWORD B_TRUE___UW 0 0 0.000000 0.000000 /begin IF_DATA ASAP1B_ETK KP_BLOB 0xFD28 0 2 /end IF_DATA BIT_MASK 0x100 /end MEASUREMENT
/begin MEASUREMENT B_ldob "Bedingung: Overboost aktiv" UWORD B_TRUE___UW 0 0 0.000000 0.000000 /begin IF_DATA ASAP1B_ETK KP_BLOB 0xFD7A 0 2 /end IF_DATA BIT_MASK 0x2 /end MEASUREMENT
/begin MEASUREMENT B_ldp "Bedingung LDP wird angesteuert erfÅllt" UWORD B_TRUE___UW 0 0 0.000000 0.000000 /begin IF_DATA ASAP1B_ETK KP_BLOB 0xFD6A 0 2 /end IF_DATA BIT_MASK 0x2000 /end MEASUREMENT
/begin MEASUREMENT B_ldpabb "Flag DLDP-Abbruch" UWORD B_TRUE___UW 0 0 0.000000 0.000000 /begin IF_DATA ASAP1B_ETK KP_BLOB 0x382778 1 2 /end IF_DATA BIT_MASK 0x4 /end MEASUREMENT
/begin MEASUREMENT B_ldpe "Bedingung LDP-Endstufe angesteuert (eingeschaltet)" UWORD B_TRUE___UW 0 0 0.000000 0.000000 /begin IF_DATA ASAP1B_ETK KP_BLOB 0xFD54 0 2 /end IF_DATA BIT_MASK 0x4000 /end MEASUREMENT
/begin MEASUREMENT B_ldpelok "" UWORD B_TRUE___UW 0 0 0.000000 0.000000 /begin IF_DATA ASAP1B_ETK KP_BLOB 0xFD54 0 2 /end IF_DATA BIT_MASK 0x8000 /end MEASUREMENT
/begin MEASUREMENT B_ldpf1 "Fehler fault_1" UWORD B_TRUE___UW 0 0 0.000000 0.000000 /begin IF_DATA ASAP1B_ETK KP_BLOB 0x382778 1 2 /end IF_DATA BIT_MASK 0x8 /end MEASUREMENT
/begin MEASUREMENT B_ldpf2 "Fehler fault_2" UWORD B_TRUE___UW 0 0 0.000000 0.000000 /begin IF_DATA ASAP1B_ETK KP_BLOB 0x382778 1 2 /end IF_DATA BIT_MASK 0x10 /end MEASUREMENT
/begin MEASUREMENT B_ldpf5 "Fehler fault_5" UWORD B_TRUE___UW 0 0 0.000000 0.000000 /begin IF_DATA ASAP1B_ETK KP_BLOB 0x382778 1 2 /end IF_DATA BIT_MASK 0x20 /end MEASUREMENT
/begin MEASUREMENT B_ldpf6 "Fehler fault_6" UWORD B_TRUE___UW 0 0 0.000000 0.000000 /begin IF_DATA ASAP1B_ETK KP_BLOB 0x382778 1 2 /end IF_DATA BIT_MASK 0x40 /end MEASUREMENT
/begin MEASUREMENT B_ldpflv "Bedingung Feinleckverifikation der DLDP aktiv" UWORD B_TRUE___UW 0 0 0.000000 0.000000 /begin IF_DATA ASAP1B_ETK KP_BLOB 0x38277A 1 2 /end IF_DATA BIT_MASK 0x1 /end MEASUREMENT
/begin MEASUREMENT B_ldpglv "Grobleckverifikation der DLDP aktiv" UWORD B_TRUE___UW 0 0 0.000000 0.000000 /begin IF_DATA ASAP1B_ETK KP_BLOB 0x38277A 1 2 /end IF_DATA BIT_MASK 0x8 /end MEASUREMENT
/begin MEASUREMENT B_ldpi "Bedingung Reed-Kontakt Leckdiagnosepumpe" UWORD B_TRUE___UW 0 0 0.000000 0.000000 /begin IF_DATA ASAP1B_ETK KP_BLOB 0xFD6A 0 2 /end IF_DATA BIT_MASK 0x4000 /end MEASUREMENT
/begin MEASUREMENT B_ldr "Flag fÅr Bedingung LDR aktiv" UWORD B_TRUE___UW 0 0 0.000000 0.000000 /begin IF_DATA ASAP1B_ETK KP_BLOB 0xFD78 0 2 /end IF_DATA BIT_MASK 0x100 /end MEASUREMENT
/begin MEASUREMENT B_ldra "Bedingung fÅr Ersatzma·nahme bei E_ldra" UWORD B_TRUE___UW 0 0 0.000000 0.000000 /begin IF_DATA ASAP1B_ETK KP_BLOB 0xFD7A 0 2 /end IF_DATA BIT_MASK 0x20 /end MEASUREMENT
/begin MEASUREMENT B_ldsua "Bedingung LDR Schubumluftventil aktiv (offen)" UWORD B_TRUE___UW 0 0 0.000000 0.000000 /begin IF_DATA ASAP1B_ETK KP_BLOB 0xFD78 0 2 /end IF_DATA BIT_MASK 0x2 /end MEASUREMENT
/begin MEASUREMENT B_ll "Bedingung Leerlauf" UWORD B_TRUE___UW 0 0 0.000000 0.000000 /begin IF_DATA ASAP1B_ETK KP_BLOB 0xFD7E 0 2 /end IF_DATA BIT_MASK 0x2000 /end MEASUREMENT
/begin MEASUREMENT B_lldia "Diagnose Leerlaufregelung freigegeben" UWORD B_TRUE___UW 0 0 0.000000 0.000000 /begin IF_DATA ASAP1B_ETK KP_BLOB 0xFD7C 0 2 /end IF_DATA BIT_MASK 0x2000 /end MEASUREMENT
/begin MEASUREMENT B_llr "Bedingung Leerlaufregelung" UWORD B_TRUE___UW 0 0 0.000000 0.000000 /begin IF_DATA ASAP1B_ETK KP_BLOB 0xFD7C 0 2 /end IF_DATA BIT_MASK 0x4 /end MEASUREMENT
/begin MEASUREMENT B_lr "LREB: Bedingung Lambdaregelung (vor Kat); (Bank 1)" UWORD B_TRUE___UW 0 0 0.000000 0.000000 /begin IF_DATA ASAP1B_ETK KP_BLOB 0xFD94 0 2 /end IF_DATA BIT_MASK 0x2 /end MEASUREMENT
/begin MEASUREMENT B_lr2 "Bedingung Lambdaregelung (vor Kat); Bank 2" UWORD B_TRUE___UW 0 0 0.000000 0.000000 /begin IF_DATA ASAP1B_ETK KP_BLOB 0xFD94 0 2 /end IF_DATA BIT_MASK 0x4 /end MEASUREMENT
/begin MEASUREMENT B_lra " 1 = LRA enable" UWORD B_TRUE___UW 0 0 0.000000 0.000000 /begin IF_DATA ASAP1B_ETK KP_BLOB 0xFD62 0 2 /end IF_DATA BIT_MASK 0x400 /end MEASUREMENT
/begin MEASUREMENT B_lrar "Bedingung reduzierte Korrekturbereiche in der LRA" UWORD B_TRUE___UW 0 0 0.000000 0.000000 /begin IF_DATA ASAP1B_ETK KP_BLOB 0xFD88 0 2 /end IF_DATA BIT_MASK 0x2000 /end MEASUREMENT
/begin MEASUREMENT B_lrare "Bedingung Reset LRA" UWORD B_TRUE___UW 0 0 0.000000 0.000000 /begin IF_DATA ASAP1B_ETK KP_BLOB 0xFD5E 0 2 /end IF_DATA BIT_MASK 0x400 /end MEASUREMENT
/begin MEASUREMENT B_lrhk "LRHK: Bedingung Lambdaregelung hinter Kat (Bank 1)" UWORD B_TRUE___UW 0 0 0.000000 0.000000 /begin IF_DATA ASAP1B_ETK KP_BLOB 0xFD9A 0 2 /end IF_DATA BIT_MASK 0x1 /end MEASUREMENT
/begin MEASUREMENT B_lrhk2 "Bedingung Lambdaregelung hinter Kat (Bank 2)" UWORD B_TRUE___UW 0 0 0.000000 0.000000 /begin IF_DATA ASAP1B_ETK KP_BLOB 0xFD9A 0 2 /end IF_DATA BIT_MASK 0x2 /end MEASUREMENT
/begin MEASUREMENT B_lrtpp "Periodendauer gÅltig, Bed. LR arbeitet stationÑr (Amplitude/Periode) erfÅllt" UWORD B_TRUE___UW 0 0 0.000000 0.000000 /begin IF_DATA ASAP1B_ETK KP_BLOB 0xFD9C 0 2 /end IF_DATA BIT_MASK 0x400 /end MEASUREMENT
/begin MEASUREMENT B_lrtpp2 "Bedingung Lambdaregler arbeitet stationÑr (Amplitude/Periode) Bank2" UWORD B_TRUE___UW 0 0 0.000000 0.000000 /begin IF_DATA ASAP1B_ETK KP_BLOB 0xFD9C 0 2 /end IF_DATA BIT_MASK 0x800 /end MEASUREMENT
/begin MEASUREMENT B_lsads "Bedingung Sonde hat Adernschlu·" UWORD B_TRUE___UW 0 0 0.000000 0.000000 /begin IF_DATA ASAP1B_ETK KP_BLOB 0x383C34 1 2 /end IF_DATA BIT_MASK 0x400 /end MEASUREMENT
/begin MEASUREMENT B_lsafkn "Bedingung Sondenspannung v.K. au·erhalb vom Fenster, kein Nebenschlu·" UWORD B_TRUE___UW 0 0 0.000000 0.000000 /begin IF_DATA ASAP1B_ETK KP_BLOB 0xFD32 0 2 /end IF_DATA BIT_MASK 0x2 /end MEASUREMENT
/begin MEASUREMENT B_lsahksp "allgemeine Stop-Bedingungen fÅr die DLSAHK" UWORD B_TRUE___UW 0 0 0.000000 0.000000 /begin IF_DATA ASAP1B_ETK KP_BLOB 0xFD28 0 2 /end IF_DATA BIT_MASK 0x200 /end MEASUREMENT
/begin MEASUREMENT B_lsahksp2 "allgemeine Stop-Bedingungen fÅr die DLSAHK Bank2" UWORD B_TRUE___UW 0 0 0.000000 0.000000 /begin IF_DATA ASAP1B_ETK KP_BLOB 0xFD28 0 2 /end IF_DATA BIT_MASK 0x400 /end MEASUREMENT
/begin MEASUREMENT B_lsastp "allgemeine Stop-Bedingungen fÅr die DLSA" UWORD B_TRUE___UW 0 0 0.000000 0.000000 /begin IF_DATA ASAP1B_ETK KP_BLOB 0xFD36 0 2 /end IF_DATA BIT_MASK 0x8 /end MEASUREMENT
/begin MEASUREMENT B_lsastp2 "allgemeine Stop-Bedingungen fÅr die DLSA  Bank2" UWORD B_TRUE___UW 0 0 0.000000 0.000000 /begin IF_DATA ASAP1B_ETK KP_BLOB 0xFD36 0 2 /end IF_DATA BIT_MASK 0x10 /end MEASUREMENT
/begin MEASUREMENT B_lsfet "Bedingung Sondenspannung hat Nebenschlu· nach Ubatt" UWORD B_TRUE___UW 0 0 0.000000 0.000000 /begin IF_DATA ASAP1B_ETK KP_BLOB 0x383C34 1 2 /end IF_DATA BIT_MASK 0x4 /end MEASUREMENT
/begin MEASUREMENT B_lshub "Bedingung Sonde begrenzter Spannungshub" UWORD B_TRUE___UW 0 0 0.000000 0.000000 /begin IF_DATA ASAP1B_ETK KP_BLOB 0x383C34 1 2 /end IF_DATA BIT_MASK 0x40 /end MEASUREMENT
/begin MEASUREMENT B_lsvklt "Bedingung Lambdasonde vor Kat kalt" UWORD B_TRUE___UW 0 0 0.000000 0.000000 /begin IF_DATA ASAP1B_ETK KP_BLOB 0xFD32 0 2 /end IF_DATA BIT_MASK 0x4 /end MEASUREMENT
/begin MEASUREMENT B_lsvn "Bedingung Nebenschlu· bei kalter Sonde vor Kat" UWORD B_TRUE___UW 0 0 0.000000 0.000000 /begin IF_DATA ASAP1B_ETK KP_BLOB 0x383C34 1 2 /end IF_DATA BIT_MASK 0x1 /end MEASUREMENT
/begin MEASUREMENT B_m8te "Bedingung Fkt-Anforderung TankentlÅftung nach SAE J1979 Mode 8 TID $01" UBYTE B_TRUE 0 0 0.000000 0.000000 /begin IF_DATA ASAP1B_ETK KP_BLOB 0x380A37 1 1 /end IF_DATA BIT_MASK 0x1 /end MEASUREMENT
/begin MEASUREMENT B_maso "Bedingung gemeinsame Sondenmasse offen" UWORD B_TRUE___UW 0 0 0.000000 0.000000 /begin IF_DATA ASAP1B_ETK KP_BLOB 0x383C34 1 2 /end IF_DATA BIT_MASK 0x10 /end MEASUREMENT
/begin MEASUREMENT B_maxflsh "Kurzsschlu· nach UBatt bei Sonde hinter KAT erkannt" UBYTE B_TRUE 0 0 0.000000 0.000000 /begin IF_DATA ASAP1B_ETK KP_BLOB 0x380A6F 1 1 /end IF_DATA BIT_MASK 0x1 /end MEASUREMENT
/begin MEASUREMENT B_maxflsv "Kurzsschlu· nach UBatt bei Sonde vor KAT erkannt" UBYTE B_TRUE 0 0 0.000000 0.000000 /begin IF_DATA ASAP1B_ETK KP_BLOB 0x380A94 1 1 /end IF_DATA BIT_MASK 0x1 /end MEASUREMENT
/begin MEASUREMENT B_maxlash "Maximalwert fÅr Schwingungs-PrÅfung hinter KAT erkannt" UWORD B_TRUE___UW 0 0 0.000000 0.000000 /begin IF_DATA ASAP1B_ETK KP_BLOB 0xFD28 0 2 /end IF_DATA BIT_MASK 0x800 /end MEASUREMENT
/begin MEASUREMENT B_maxlash2 "Maximalwert fÅr Schwingungs-PrÅfung hinter KAT erkannt Bank2" UWORD B_TRUE___UW 0 0 0.000000 0.000000 /begin IF_DATA ASAP1B_ETK KP_BLOB 0xFD28 0 2 /end IF_DATA BIT_MASK 0x1000 /end MEASUREMENT
/begin MEASUREMENT B_maxlatp "Fehlertyp 'Maximalwert' fÅr Periodendauer-PrÅfung vor KAT erkannt 'dynamisch'" UWORD B_TRUE___UW 0 0 0.000000 0.000000 /begin IF_DATA ASAP1B_ETK KP_BLOB 0xFD36 0 2 /end IF_DATA BIT_MASK 0x20 /end MEASUREMENT
/begin MEASUREMENT B_maxlatp2 "Fehlertyp 'Maximalwert' fÅr Periodendauer-PrÅfung vor KAT erkannt 'dyn.' Bank2" UWORD B_TRUE___UW 0 0 0.000000 0.000000 /begin IF_DATA ASAP1B_ETK KP_BLOB 0xFD36 0 2 /end IF_DATA BIT_MASK 0x40 /end MEASUREMENT
/begin MEASUREMENT B_maxlatv "Fehlertyp 'Maximalwert' fÅr ATV-PrÅfung vor KAT erkannt `dynamisch'" UWORD B_TRUE___UW 0 0 0.000000 0.000000 /begin IF_DATA ASAP1B_ETK KP_BLOB 0xFD36 0 2 /end IF_DATA BIT_MASK 0x80 /end MEASUREMENT
/begin MEASUREMENT B_maxlatv2 "Fehlertyp 'Maximalwert' fÅr ATV-PrÅfung vor KAT erkannt `dynamisch' Bank2" UWORD B_TRUE___UW 0 0 0.000000 0.000000 /begin IF_DATA ASAP1B_ETK KP_BLOB 0xFD36 0 2 /end IF_DATA BIT_MASK 0x100 /end MEASUREMENT
/begin MEASUREMENT B_mdarv "kritische Aussetzerrate vorhanden" UWORD B_TRUE___UW 0 0 0.000000 0.000000 /begin IF_DATA ASAP1B_ETK KP_BLOB 0xFD1A 0 2 /end IF_DATA BIT_MASK 0x4 /end MEASUREMENT
/begin MEASUREMENT B_messe "Flag Periodendauermessung (Stage 5) beendet" UWORD B_TRUE___UW 0 0 0.000000 0.000000 /begin IF_DATA ASAP1B_ETK KP_BLOB 0x382778 1 2 /end IF_DATA BIT_MASK 0x80 /end MEASUREMENT
/begin MEASUREMENT B_minflsh "Abgesenkte Sondenkennlinie (CSD) bei Sonde hinter KAT erkannt" UBYTE B_TRUE 0 0 0.000000 0.000000 /begin IF_DATA ASAP1B_ETK KP_BLOB 0x380A6F 1 1 /end IF_DATA BIT_MASK 0x4 /end MEASUREMENT
/begin MEASUREMENT B_minflsv "" UBYTE B_TRUE 0 0 0.000000 0.000000 /begin IF_DATA ASAP1B_ETK KP_BLOB 0x380A94 1 1 /end IF_DATA BIT_MASK 0x4 /end MEASUREMENT
/begin MEASUREMENT B_minlash "Minimalwert fÅr SchwingungsprÅfung hinter KAT erkannt" UWORD B_TRUE___UW 0 0 0.000000 0.000000 /begin IF_DATA ASAP1B_ETK KP_BLOB 0xFD28 0 2 /end IF_DATA BIT_MASK 0x2000 /end MEASUREMENT
/begin MEASUREMENT B_minlash2 "Minimalwert fÅr SchwingungsprÅfung hinter KAT erkannt Bank2" UWORD B_TRUE___UW 0 0 0.000000 0.000000 /begin IF_DATA ASAP1B_ETK KP_BLOB 0xFD28 0 2 /end IF_DATA BIT_MASK 0x4000 /end MEASUREMENT
/begin MEASUREMENT B_minlatp "Fehlertyp 'Minimalwert' fÅr Perioden-Dauer vor KAT erkannt 'dynamisch'" UWORD B_TRUE___UW 0 0 0.000000 0.000000 /begin IF_DATA ASAP1B_ETK KP_BLOB 0xFD36 0 2 /end IF_DATA BIT_MASK 0x200 /end MEASUREMENT
/begin MEASUREMENT B_minlatp2 "Fehlertyp 'Minimalwert' fÅr Perioden-Dauer vor KAT erkannt 'dynamisch' Bank2" UWORD B_TRUE___UW 0 0 0.000000 0.000000 /begin IF_DATA ASAP1B_ETK KP_BLOB 0xFD36 0 2 /end IF_DATA BIT_MASK 0x400 /end MEASUREMENT
/begin MEASUREMENT B_minlatv "Fehlertyp 'Minimalwert' fÅr ATV-PrÅfung vor KAT erkannt 'dynamisch'" UWORD B_TRUE___UW 0 0 0.000000 0.000000 /begin IF_DATA ASAP1B_ETK KP_BLOB 0xFD36 0 2 /end IF_DATA BIT_MASK 0x800 /end MEASUREMENT
/begin MEASUREMENT B_minlatv2 "Fehlertyp 'Minimalwert' fÅr ATV-PrÅfung vor KAT erkannt 'dynamisch' Bank2" UWORD B_TRUE___UW 0 0 0.000000 0.000000 /begin IF_DATA ASAP1B_ETK KP_BLOB 0xFD36 0 2 /end IF_DATA BIT_MASK 0x1000 /end MEASUREMENT
/begin MEASUREMENT B_mldyn "Bedingung erforderliche Luftmasse im Schubbetrieb fÅr Dynamikmessung erreicht" UWORD B_TRUE___UW 0 0 0.000000 0.000000 /begin IF_DATA ASAP1B_ETK KP_BLOB 0xFD28 0 2 /end IF_DATA BIT_MASK 0x8000 /end MEASUREMENT
/begin MEASUREMENT B_mlustest "Bedingung ml is innerhalb den Schwellen" UBYTE B_TRUE 0 0 0.000000 0.000000 /begin IF_DATA ASAP1B_ETK KP_BLOB 0x380A78 1 1 /end IF_DATA BIT_MASK 0x1 /end MEASUREMENT
/begin MEASUREMENT B_mnld "Fehlertype: Kurzschlu· nach Masse LDP-Endstufe (aktuell)" UWORD B_TRUE___UW 0 0 0.000000 0.000000 /begin IF_DATA ASAP1B_ETK KP_BLOB 0xFD56 0 2 /end IF_DATA BIT_MASK 0x1 /end MEASUREMENT
/begin MEASUREMENT B_mxaok "Bedingung Fehlerpfad ldra o.k." UWORD B_TRUE___UW 0 0 0.000000 0.000000 /begin IF_DATA ASAP1B_ETK KP_BLOB 0xFD7A 0 2 /end IF_DATA BIT_MASK 0x40 /end MEASUREMENT
/begin MEASUREMENT B_mxld "Fehlertype: Kurzschlu· nach Ubatt Endstufe LDP (aktuell)" UWORD B_TRUE___UW 0 0 0.000000 0.000000 /begin IF_DATA ASAP1B_ETK KP_BLOB 0xFD56 0 2 /end IF_DATA BIT_MASK 0x2 /end MEASUREMENT
/begin MEASUREMENT B_ndylash "Bedingung kein Dynamik-Fehler (no Error) im Schub fÅr Sonde hinter KAT" UWORD B_TRUE___UW 0 0 0.000000 0.000000 /begin IF_DATA ASAP1B_ETK KP_BLOB 0xFD2A 0 2 /end IF_DATA BIT_MASK 0x1 /end MEASUREMENT
/begin MEASUREMENT B_ndylash2 "Bedingung kein Dynamik-Fehler (no Error) im Schub fÅr Sonde hinter KAT Bank2" UWORD B_TRUE___UW 0 0 0.000000 0.000000 /begin IF_DATA ASAP1B_ETK KP_BLOB 0xFD2A 0 2 /end IF_DATA BIT_MASK 0x2 /end MEASUREMENT
/begin MEASUREMENT B_nesch "Bedingung Sondenspannung keinen Fehler (no Error) im Schub" UWORD B_TRUE___UW 0 0 0.000000 0.000000 /begin IF_DATA ASAP1B_ETK KP_BLOB 0xFD2A 0 2 /end IF_DATA BIT_MASK 0x4 /end MEASUREMENT
/begin MEASUREMENT B_nesch2 "Bedingung Sondenspannung keinen Fehler (no Error) im Schub Bank2" UWORD B_TRUE___UW 0 0 0.000000 0.000000 /begin IF_DATA ASAP1B_ETK KP_BLOB 0xFD2A 0 2 /end IF_DATA BIT_MASK 0x8 /end MEASUREMENT
/begin MEASUREMENT B_nmot "Bedingung Motordrehzahl: n > NMIN" UWORD B_TRUE___UW 0 0 0.000000 0.000000 /begin IF_DATA ASAP1B_ETK KP_BLOB 0xFD1E 0 2 /end IF_DATA BIT_MASK 0x800 /end MEASUREMENT
/begin MEASUREMENT B_nofra "Bedingung Sperren der multiplikativen Gemischkorrektur" UWORD B_TRUE___UW 0 0 0.000000 0.000000 /begin IF_DATA ASAP1B_ETK KP_BLOB 0xFD5E 0 2 /end IF_DATA BIT_MASK 0x2000 /end MEASUREMENT
/begin MEASUREMENT B_nolash "Bedingung Diagnosefunktion Schwingungs-PrÅfung. i.O.-Meldung beendet." UWORD B_TRUE___UW 0 0 0.000000 0.000000 /begin IF_DATA ASAP1B_ETK KP_BLOB 0xFD2A 0 2 /end IF_DATA BIT_MASK 0x10 /end MEASUREMENT
/begin MEASUREMENT B_nolash2 "Bedingung Diagnosefunktion Schwingungs-PrÅfung. i.O.-Meldung beendet. Bank2" UWORD B_TRUE___UW 0 0 0.000000 0.000000 /begin IF_DATA ASAP1B_ETK KP_BLOB 0xFD2A 0 2 /end IF_DATA BIT_MASK 0x20 /end MEASUREMENT
/begin MEASUREMENT B_nolatp "Bedingung Diagnosefunktion Perioden-Dauer mit i.O.-Meldung beendet." UWORD B_TRUE___UW 0 0 0.000000 0.000000 /begin IF_DATA ASAP1B_ETK KP_BLOB 0xFD36 0 2 /end IF_DATA BIT_MASK 0x2000 /end MEASUREMENT
/begin MEASUREMENT B_nolatp2 "Bedingung Diagnosefunktion Perioden-Dauer mit i.O.-Meldung beendet. Bank2" UWORD B_TRUE___UW 0 0 0.000000 0.000000 /begin IF_DATA ASAP1B_ETK KP_BLOB 0xFD36 0 2 /end IF_DATA BIT_MASK 0x4000 /end MEASUREMENT
/begin MEASUREMENT B_nolatv "Bedingung Diagnosefunktion ATV-PrÅfung mit i.O.-Meldung beendet." UWORD B_TRUE___UW 0 0 0.000000 0.000000 /begin IF_DATA ASAP1B_ETK KP_BLOB 0xFD36 0 2 /end IF_DATA BIT_MASK 0x8000 /end MEASUREMENT
/begin MEASUREMENT B_nolatv2 "Bedingung Diagnosefunktion ATV-PrÅfung mit i.O.-Meldung beendet. Bank2" UWORD B_TRUE___UW 0 0 0.000000 0.000000 /begin IF_DATA ASAP1B_ETK KP_BLOB 0xFD38 0 2 /end IF_DATA BIT_MASK 0x1 /end MEASUREMENT
/begin MEASUREMENT B_nollrflr "Bedingung LLR-Diagnosefunktion mit i.O.-Meldung beendet." UWORD B_TRUE___UW 0 0 0.000000 0.000000 /begin IF_DATA ASAP1B_ETK KP_BLOB 0xFD7C 0 2 /end IF_DATA BIT_MASK 0x4000 /end MEASUREMENT
/begin MEASUREMENT B_nolsh "Bedingung Diagnosefunktion mit i.O.-Meldung hinter KAT beendet." UWORD B_TRUE___UW 0 0 0.000000 0.000000 /begin IF_DATA ASAP1B_ETK KP_BLOB 0xFD22 0 2 /end IF_DATA BIT_MASK 0x800 /end MEASUREMENT
/begin MEASUREMENT B_nolsv "Bedingung Diagnosefunktion mit i.O.-Meldung vor KAT beendet." UWORD B_TRUE___UW 0 0 0.000000 0.000000 /begin IF_DATA ASAP1B_ETK KP_BLOB 0xFD32 0 2 /end IF_DATA BIT_MASK 0x8 /end MEASUREMENT
/begin MEASUREMENT B_norkam "Bedingung additive Korrektur der Adaption pro Zeit oder ZÅndung abgeschaltet" UWORD B_TRUE___UW 0 0 0.000000 0.000000 /begin IF_DATA ASAP1B_ETK KP_BLOB 0xFD66 0 2 /end IF_DATA BIT_MASK 0x400 /end MEASUREMENT
/begin MEASUREMENT B_norkat "Bedingung additive Korrektur der Gemischadaption pro Zeit abgeschaltet" UWORD B_TRUE___UW 0 0 0.000000 0.000000 /begin IF_DATA ASAP1B_ETK KP_BLOB 0xFD5E 0 2 /end IF_DATA BIT_MASK 0x4000 /end MEASUREMENT
/begin MEASUREMENT B_norkaz "Bedingung additive Korrektur der Gemischadaption pro ZÅndung abgeschaltet" UWORD B_TRUE___UW 0 0 0.000000 0.000000 /begin IF_DATA ASAP1B_ETK KP_BLOB 0xFD5E 0 2 /end IF_DATA BIT_MASK 0x8000 /end MEASUREMENT
/begin MEASUREMENT B_nplflsh "Adernschlu· bei Sonde hinter KAT erkannt" UBYTE B_TRUE 0 0 0.000000 0.000000 /begin IF_DATA ASAP1B_ETK KP_BLOB 0x380A6F 1 1 /end IF_DATA BIT_MASK 0x40 /end MEASUREMENT
/begin MEASUREMENT B_nplflsv "Adernschlu· bei Sonde vor KAT erkannt" UBYTE B_TRUE 0 0 0.000000 0.000000 /begin IF_DATA ASAP1B_ETK KP_BLOB 0x380A94 1 1 /end IF_DATA BIT_MASK 0x40 /end MEASUREMENT
/begin MEASUREMENT B_nswo1 "Bedingung Drehzahl > NSWO1" UWORD B_TRUE___UW 0 0 0.000000 0.000000 /begin IF_DATA ASAP1B_ETK KP_BLOB 0xFD02 0 2 /end IF_DATA BIT_MASK 0x1000 /end MEASUREMENT
/begin MEASUREMENT B_plra "Bedingung fÅr Umschaltung DKVS von HFM- auf P-System" UWORD B_TRUE___UW 0 0 0.000000 0.000000 /begin IF_DATA ASAP1B_ETK KP_BLOB 0xFD66 0 2 /end IF_DATA BIT_MASK 0x800 /end MEASUREMENT
/begin MEASUREMENT B_puerr "Bedingung Fehler  korrigiertes Umgebungsdrucksignal fÅr Bergabfahrterkennung" UBYTE B_TRUE 0 0 0.000000 0.000000 /begin IF_DATA ASAP1B_ETK KP_BLOB 0x380CD3 1 1 /end IF_DATA BIT_MASK 0x1 /end MEASUREMENT
/begin MEASUREMENT B_pwf "Bedingung Powerfail" UWORD B_TRUE___UW 0 0 0.000000 0.000000 /begin IF_DATA ASAP1B_ETK KP_BLOB 0xFD88 0 2 /end IF_DATA BIT_MASK 0x10 /end MEASUREMENT
/begin MEASUREMENT B_refmax "Beding. Sondenspg. im plausiblen Bereich zwischen USREF und USMAX vor KAT" UWORD B_TRUE___UW 0 0 0.000000 0.000000 /begin IF_DATA ASAP1B_ETK KP_BLOB 0xFD32 0 2 /end IF_DATA BIT_MASK 0x10 /end MEASUREMENT
/begin MEASUREMENT B_risigh "Bedingung Signalunterbrechung Sondenmasse mit Ri-Diagnose hinter KAT" UWORD B_TRUE___UW 0 0 0.000000 0.000000 /begin IF_DATA ASAP1B_ETK KP_BLOB 0xFD22 0 2 /end IF_DATA BIT_MASK 0x1000 /end MEASUREMENT
/begin MEASUREMENT B_risigv "Bedingung Signalunterbrechung Sondenmasse mit Ri-Diagnose vor KAT" UWORD B_TRUE___UW 0 0 0.000000 0.000000 /begin IF_DATA ASAP1B_ETK KP_BLOB 0xFD32 0 2 /end IF_DATA BIT_MASK 0x20 /end MEASUREMENT
/begin MEASUREMENT B_rkack "Bedingung öberwachung Reedkontakt auf aktiv" UWORD B_TRUE___UW 0 0 0.000000 0.000000 /begin IF_DATA ASAP1B_ETK KP_BLOB 0x382778 1 2 /end IF_DATA BIT_MASK 0x2000 /end MEASUREMENT
/begin MEASUREMENT B_rkam "Bedingung einer der beiden additiven Bereiche aktiv" UWORD B_TRUE___UW 0 0 0.000000 0.000000 /begin IF_DATA ASAP1B_ETK KP_BLOB 0xFD66 0 2 /end IF_DATA BIT_MASK 0x1000 /end MEASUREMENT
/begin MEASUREMENT B_rkamr "Bedingung rkat oder rkaz au·erhalb reduzierter Schwellen" UWORD B_TRUE___UW 0 0 0.000000 0.000000 /begin IF_DATA ASAP1B_ETK KP_BLOB 0xFD66 0 2 /end IF_DATA BIT_MASK 0x2000 /end MEASUREMENT
/begin MEASUREMENT B_rkat "Bedingung Lernbereich additive Korrektur pro Zeit aktiv" UWORD B_TRUE___UW 0 0 0.000000 0.000000 /begin IF_DATA ASAP1B_ETK KP_BLOB 0xFD60 0 2 /end IF_DATA BIT_MASK 0x1 /end MEASUREMENT
/begin MEASUREMENT B_rkatr "Bedingung rkat-Integrator au·erhalb reduzierten Bereich" UWORD B_TRUE___UW 0 0 0.000000 0.000000 /begin IF_DATA ASAP1B_ETK KP_BLOB 0xFD60 0 2 /end IF_DATA BIT_MASK 0x2 /end MEASUREMENT
/begin MEASUREMENT B_rkaz "Bedingung Lernbereich additive Korrektur pro ZÅndung aktiv" UWORD B_TRUE___UW 0 0 0.000000 0.000000 /begin IF_DATA ASAP1B_ETK KP_BLOB 0xFD60 0 2 /end IF_DATA BIT_MASK 0x4 /end MEASUREMENT
/begin MEASUREMENT B_rkazr "Bedingung rkaz-Integrator au·erhalb reduzierten Bereich" UWORD B_TRUE___UW 0 0 0.000000 0.000000 /begin IF_DATA ASAP1B_ETK KP_BLOB 0xFD60 0 2 /end IF_DATA BIT_MASK 0x8 /end MEASUREMENT
/begin MEASUREMENT B_rkcke "KomponentenprÅfung ist abgeschlossen" UWORD B_TRUE___UW 0 0 0.000000 0.000000 /begin IF_DATA ASAP1B_ETK KP_BLOB 0x38277A 1 2 /end IF_DATA BIT_MASK 0x4 /end MEASUREMENT
/begin MEASUREMENT B_rkzck "Bedingung öberwachung Reedkontakt zu aktiv" UWORD B_TRUE___UW 0 0 0.000000 0.000000 /begin IF_DATA ASAP1B_ETK KP_BLOB 0x382778 1 2 /end IF_DATA BIT_MASK 0x4000 /end MEASUREMENT
/begin MEASUREMENT B_sa "Schubabschaltung" UWORD B_TRUE___UW 0 0 0.000000 0.000000 /begin IF_DATA ASAP1B_ETK KP_BLOB 0xFD84 0 2 /end IF_DATA BIT_MASK 0x2 /end MEASUREMENT
/begin MEASUREMENT B_sbbhk "Bedingung Sonde betriebsbereit hinter Kat" UWORD B_TRUE___UW 0 0 0.000000 0.000000 /begin IF_DATA ASAP1B_ETK KP_BLOB 0xFD22 0 2 /end IF_DATA BIT_MASK 0x2000 /end MEASUREMENT
/begin MEASUREMENT B_sbbvk "Bedingung Sonde betriebsbereit vor Kat" UWORD B_TRUE___UW 0 0 0.000000 0.000000 /begin IF_DATA ASAP1B_ETK KP_BLOB 0xFD32 0 2 /end IF_DATA BIT_MASK 0x40 /end MEASUREMENT
/begin MEASUREMENT B_sigflsh "Signalunterbrechung (Kabelbruch) Bei Sonde hinter KAT erkannt" UBYTE B_TRUE 0 0 0.000000 0.000000 /begin IF_DATA ASAP1B_ETK KP_BLOB 0x380A6F 1 1 /end IF_DATA BIT_MASK 0x10 /end MEASUREMENT
/begin MEASUREMENT B_sigflsv "Signalunterbrechung (Kabelbruch) bei Sonde vor KAT erkannt" UBYTE B_TRUE 0 0 0.000000 0.000000 /begin IF_DATA ASAP1B_ETK KP_BLOB 0x380A94 1 1 /end IF_DATA BIT_MASK 0x10 /end MEASUREMENT
/begin MEASUREMENT B_sild "Fehlertype: Leitungsabfall Endstufe Leckage Pumpe (aktuell)" UWORD B_TRUE___UW 0 0 0.000000 0.000000 /begin IF_DATA ASAP1B_ETK KP_BLOB 0xFD56 0 2 /end IF_DATA BIT_MASK 0x4 /end MEASUREMENT
/begin MEASUREMENT B_sls "Bedingung SekundÑrluft aktiv" UWORD B_TRUE___UW 0 0 0.000000 0.000000 /begin IF_DATA ASAP1B_ETK KP_BLOB 0xFD0A 0 2 /end IF_DATA BIT_MASK 0x800 /end MEASUREMENT
/begin MEASUREMENT B_st "Bedingung Start" UWORD B_TRUE___UW 0 0 0.000000 0.000000 /begin IF_DATA ASAP1B_ETK KP_BLOB 0xFD88 0 2 /end IF_DATA BIT_MASK 0x20 /end MEASUREMENT
/begin MEASUREMENT B_steigm "Bedingung Steigung des Sondensignals messen" UWORD B_TRUE___UW 0 0 0.000000 0.000000 /begin IF_DATA ASAP1B_ETK KP_BLOB 0xFD2A 0 2 /end IF_DATA BIT_MASK 0x40 /end MEASUREMENT
/begin MEASUREMENT B_steigm2 "Bedingung Steigung des Sondensignals messen Bank2" UWORD B_TRUE___UW 0 0 0.000000 0.000000 /begin IF_DATA ASAP1B_ETK KP_BLOB 0xFD2A 0 2 /end IF_DATA BIT_MASK 0x80 /end MEASUREMENT
/begin MEASUREMENT B_stend "1 = Startende erkannt" UWORD B_TRUE___UW 0 0 0.000000 0.000000 /begin IF_DATA ASAP1B_ETK KP_BLOB 0xFD88 0 2 /end IF_DATA BIT_MASK 0x40 /end MEASUREMENT
/begin MEASUREMENT B_tal "Bedingung Tank leer bzw. Reserve" UBYTE B_TRUE 0 0 0.000000 0.000000 /begin IF_DATA ASAP1B_ETK KP_BLOB 0x383348 1 1 /end IF_DATA BIT_MASK 0x1 /end MEASUREMENT
/begin MEASUREMENT B_talval "Bedingung : Bit Tank leer gÅltig" UWORD B_TRUE___UW 0 0 0.000000 0.000000 /begin IF_DATA ASAP1B_ETK KP_BLOB 0xFD3A 0 2 /end IF_DATA BIT_MASK 0x20 /end MEASUREMENT
/begin MEASUREMENT B_te "TankentlÅftung aktiv" UWORD B_TRUE___UW 0 0 0.000000 0.000000 /begin IF_DATA ASAP1B_ETK KP_BLOB 0xFD88 0 2 /end IF_DATA BIT_MASK 0x100 /end MEASUREMENT
/begin MEASUREMENT B_tef "Bedingung TankentlÅftung prinzipiell freigegeben" UWORD B_TRUE___UW 0 0 0.000000 0.000000 /begin IF_DATA ASAP1B_ETK KP_BLOB 0xFD88 0 2 /end IF_DATA BIT_MASK 0x200 /end MEASUREMENT
/begin MEASUREMENT B_tehb "Bedingung TankentlÅftung mit hoher Beladung" UWORD B_TRUE___UW 0 0 0.000000 0.000000 /begin IF_DATA ASAP1B_ETK KP_BLOB 0xFD8A 0 2 /end IF_DATA BIT_MASK 0x1 /end MEASUREMENT
/begin MEASUREMENT B_tep "Bedingung TankentlÅftungsphase" UWORD B_TRUE___UW 0 0 0.000000 0.000000 /begin IF_DATA ASAP1B_ETK KP_BLOB 0xFD62 0 2 /end IF_DATA BIT_MASK 0x1 /end MEASUREMENT
/begin MEASUREMENT B_tepldp "Bedingung SpÅlphase und prinzipielle Freigabe TEB" UWORD B_TRUE___UW 0 0 0.000000 0.000000 /begin IF_DATA ASAP1B_ETK KP_BLOB 0x38277A 1 2 /end IF_DATA BIT_MASK 0x20 /end MEASUREMENT
/begin MEASUREMENT B_teslash "Bedingung Test ausfÅhren fÅr öberprÅfung Sonde hinter KAT" UWORD B_TRUE___UW 0 0 0.000000 0.000000 /begin IF_DATA ASAP1B_ETK KP_BLOB 0xFD2A 0 2 /end IF_DATA BIT_MASK 0x100 /end MEASUREMENT
/begin MEASUREMENT B_teslash2 "Bedingung Test ausfÅhren fÅr öberprÅfung Sonde hinter KAT Bank2" UWORD B_TRUE___UW 0 0 0.000000 0.000000 /begin IF_DATA ASAP1B_ETK KP_BLOB 0xFD2A 0 2 /end IF_DATA BIT_MASK 0x200 /end MEASUREMENT
/begin MEASUREMENT B_tevioi "Bedingung TEV durch DLDP (InitialspÅlung) als i.O. erkannt." UWORD B_TRUE___UW 0 0 0.000000 0.000000 /begin IF_DATA ASAP1B_ETK KP_BLOB 0xFD92 0 2 /end IF_DATA BIT_MASK 0x200 /end MEASUREMENT
/begin MEASUREMENT B_teviot "Bedingung TEV durch DLDP (Abfallzeiterhîhung) als i.O. erkannt." UWORD B_TRUE___UW 0 0 0.000000 0.000000 /begin IF_DATA ASAP1B_ETK KP_BLOB 0xFD92 0 2 /end IF_DATA BIT_MASK 0x400 /end MEASUREMENT
/begin MEASUREMENT B_teza "Bedingung TankentlÅftung zwangsaktiv" UWORD B_TRUE___UW 0 0 0.000000 0.000000 /begin IF_DATA ASAP1B_ETK KP_BLOB 0xFD92 0 2 /end IF_DATA BIT_MASK 0x800 /end MEASUREMENT
/begin MEASUREMENT B_trfash "Bedingung Kurztrip einleiten fÅr SchwingungsprÅfung Sonde hinter KAT" UWORD B_TRUE___UW 0 0 0.000000 0.000000 /begin IF_DATA ASAP1B_ETK KP_BLOB 0xFD2A 0 2 /end IF_DATA BIT_MASK 0x400 /end MEASUREMENT
/begin MEASUREMENT B_trfash2 "Bedingung Kurztrip einleiten fÅr SchwingungsprÅfung Sonde hinter KAT Bank2" UWORD B_TRUE___UW 0 0 0.000000 0.000000 /begin IF_DATA ASAP1B_ETK KP_BLOB 0xFD2A 0 2 /end IF_DATA BIT_MASK 0x800 /end MEASUREMENT
/begin MEASUREMENT B_trsa "Bedingung Kabelbruch fÅr Sonde vor KAT" UBYTE B_TRUE 0 0 0.000000 0.000000 /begin IF_DATA ASAP1B_ETK KP_BLOB 0x380A95 1 1 /end IF_DATA BIT_MASK 0x4 /end MEASUREMENT
/begin MEASUREMENT B_trsah "Bedingung Kabelbruch fÅr Sonde hinter KAT" UBYTE B_TRUE 0 0 0.000000 0.000000 /begin IF_DATA ASAP1B_ETK KP_BLOB 0x380A70 1 1 /end IF_DATA BIT_MASK 0x10 /end MEASUREMENT
/begin MEASUREMENT B_ttbmh "Bedingung theoretische Sondenbetriebsbereitschaft mit Heizung" UWORD B_TRUE___UW 0 0 0.000000 0.000000 /begin IF_DATA ASAP1B_ETK KP_BLOB 0xFD32 0 2 /end IF_DATA BIT_MASK 0x80 /end MEASUREMENT
/begin MEASUREMENT B_ttbmhh "Bedingung theoretische Sondenbetriebsbereitschaft hinter KAT mit Heizung" UWORD B_TRUE___UW 0 0 0.000000 0.000000 /begin IF_DATA ASAP1B_ETK KP_BLOB 0xFD22 0 2 /end IF_DATA BIT_MASK 0x4000 /end MEASUREMENT
/begin MEASUREMENT B_tuspn "Bedingung fÅr öbernahme der Halbperiode (Zeit zw. pos. und neg. Flanke)" UBYTE B_TRUE 0 0 0.000000 0.000000 /begin IF_DATA ASAP1B_ETK KP_BLOB 0x380B0E 1 1 /end IF_DATA BIT_MASK 0x1 /end MEASUREMENT
/begin MEASUREMENT B_tusre "Bedingung Resultat fÅr gefilterte Halbperiode fÅr Sonde vor KAT" UBYTE B_TRUE 0 0 0.000000 0.000000 /begin IF_DATA ASAP1B_ETK KP_BLOB 0x380B0E 1 1 /end IF_DATA BIT_MASK 0x2 /end MEASUREMENT
/begin MEASUREMENT B_twdtv "Bedingung atv-Me·zeit TWDDTV erreicht" UWORD B_TRUE___UW 0 0 0.000000 0.000000 /begin IF_DATA ASAP1B_ETK KP_BLOB 0xFD38 0 2 /end IF_DATA BIT_MASK 0x2 /end MEASUREMENT
/begin MEASUREMENT B_twdtv2 "Bedingung atv-Me·zeit TWDDTV erreicht Bank2" UWORD B_TRUE___UW 0 0 0.000000 0.000000 /begin IF_DATA ASAP1B_ETK KP_BLOB 0xFD38 0 2 /end IF_DATA BIT_MASK 0x4 /end MEASUREMENT
/begin MEASUREMENT B_ueinh "Beding. Vorbereitung z. Einsch. d. Sondenbetriebsbereitschaft hinter KAT" UBYTE B_TRUE 0 0 0.000000 0.000000 /begin IF_DATA ASAP1B_ETK KP_BLOB 0x380A70 1 1 /end IF_DATA BIT_MASK 0x1 /end MEASUREMENT
/begin MEASUREMENT B_ueinv "Bedingung Vorbereitung zur Einschaltung der Sondenbetriebsbereitschaft vor KAT" UWORD B_TRUE___UW 0 0 0.000000 0.000000 /begin IF_DATA ASAP1B_ETK KP_BLOB 0xFD32 0 2 /end IF_DATA BIT_MASK 0x100 /end MEASUREMENT
/begin MEASUREMENT B_uhsig "Bedingung Sondenspannung hinter KAT im Spannungsband fÅr Signalunterbrechung" UBYTE B_TRUE 0 0 0.000000 0.000000 /begin IF_DATA ASAP1B_ETK KP_BLOB 0x380A70 1 1 /end IF_DATA BIT_MASK 0x4 /end MEASUREMENT
/begin MEASUREMENT B_ushkf "Bedingung Sondenspannung hinter KAT FETT (Sollwert Åberschritten)" UWORD B_TRUE___UW 0 0 0.000000 0.000000 /begin IF_DATA ASAP1B_ETK KP_BLOB 0xFD2A 0 2 /end IF_DATA BIT_MASK 0x1000 /end MEASUREMENT
/begin MEASUREMENT B_ushkf2 "Bedingung Sondenspannung hinter KAT FETT (Sollwert Åberschritten) Bank2" UWORD B_TRUE___UW 0 0 0.000000 0.000000 /begin IF_DATA ASAP1B_ETK KP_BLOB 0xFD2A 0 2 /end IF_DATA BIT_MASK 0x2000 /end MEASUREMENT
/begin MEASUREMENT B_ushkm "Bedingung Sondenspannung hinter KAT Mager (Sollwert unterschritten)" UWORD B_TRUE___UW 0 0 0.000000 0.000000 /begin IF_DATA ASAP1B_ETK KP_BLOB 0xFD2A 0 2 /end IF_DATA BIT_MASK 0x4000 /end MEASUREMENT
/begin MEASUREMENT B_ushkm2 "Bedingung Sondenspannung hinter KAT Mager (Sollwert unterschritten) Bank2" UWORD B_TRUE___UW 0 0 0.000000 0.000000 /begin IF_DATA ASAP1B_ETK KP_BLOB 0xFD2A 0 2 /end IF_DATA BIT_MASK 0x8000 /end MEASUREMENT
/begin MEASUREMENT B_ushsch "Bed. Schwelle fÅr Sonde h. KAT im Schub nicht unterschritten `dynamisch`" UBYTE B_TRUE 0 0 0.000000 0.000000 /begin IF_DATA ASAP1B_ETK KP_BLOB 0x383337 1 1 /end IF_DATA BIT_MASK 0x4 /end MEASUREMENT
/begin MEASUREMENT B_ushsch2 "Bed. Schwelle fÅr Sonde h. KAT im Schub nicht unterschritten `dynamisch` Bank2" UBYTE B_TRUE 0 0 0.000000 0.000000 /begin IF_DATA ASAP1B_ETK KP_BLOB 0x383337 1 1 /end IF_DATA BIT_MASK 0x8 /end MEASUREMENT
/begin MEASUREMENT B_uvsig "Bedingung Sondenspannung vor KAT im Spannungsband fÅr Signalunterbrechung" UBYTE B_TRUE 0 0 0.000000 0.000000 /begin IF_DATA ASAP1B_ETK KP_BLOB 0x380A95 1 1 /end IF_DATA BIT_MASK 0x1 /end MEASUREMENT
/begin MEASUREMENT B_vadge "Bedingung Verdacht auf Adernschlu· oder Gemischfehler" UWORD B_TRUE___UW 0 0 0.000000 0.000000 /begin IF_DATA ASAP1B_ETK KP_BLOB 0xFD32 0 2 /end IF_DATA BIT_MASK 0x200 /end MEASUREMENT
/begin MEASUREMENT B_vgeflr "Bedingung Verdacht auf Gemischfehler" UWORD B_TRUE___UW 0 0 0.000000 0.000000 /begin IF_DATA ASAP1B_ETK KP_BLOB 0x383C34 1 2 /end IF_DATA BIT_MASK 0x1000 /end MEASUREMENT
/begin MEASUREMENT cd_bits1_w "" UWORD dez___UW 0 0 0.000000 65535.000000 /begin IF_DATA ASAP1B_ETK KP_BLOB 0x380D30 1 2 /end IF_DATA BIT_MASK 0xFFFF /end MEASUREMENT
/begin MEASUREMENT cd_bits2_w "" UWORD dez___UW 0 0 0.000000 65535.000000 /begin IF_DATA ASAP1B_ETK KP_BLOB 0x380D32 1 2 /end IF_DATA BIT_MASK 0xFFFF /end MEASUREMENT
/begin MEASUREMENT DKVSbits "" UBYTE dez 0 0 0.000000 255.000000 /begin IF_DATA ASAP1B_ETK KP_BLOB 0x38335B 1 1 /end IF_DATA BIT_MASK 0xFF /end MEASUREMENT
/begin MEASUREMENT DLSHbits "" UBYTE dez 0 0 0.000000 255.000000 /begin IF_DATA ASAP1B_ETK KP_BLOB 0x38331E 1 1 /end IF_DATA BIT_MASK 0xFF /end MEASUREMENT
/begin MEASUREMENT DLSHerrors "" UBYTE dez 0 0 0.000000 255.000000 /begin IF_DATA ASAP1B_ETK KP_BLOB 0x380A6F 1 1 /end IF_DATA BIT_MASK 0xFF /end MEASUREMENT
/begin MEASUREMENT DLSHintbits "" UBYTE dez 0 0 0.000000 255.000000 /begin IF_DATA ASAP1B_ETK KP_BLOB 0x380A70 1 1 /end IF_DATA BIT_MASK 0xFF /end MEASUREMENT
/begin MEASUREMENT dlssabits "" UBYTE dez 0 0 0.000000 255.000000 /begin IF_DATA ASAP1B_ETK KP_BLOB 0x380B0E 1 1 /end IF_DATA BIT_MASK 0xFF /end MEASUREMENT
/begin MEASUREMENT DLSVbits "" UWORD dez___UW 0 0 0.000000 65535.000000 /begin IF_DATA ASAP1B_ETK KP_BLOB 0x383C34 1 2 /end IF_DATA BIT_MASK 0xFFFF /end MEASUREMENT
/begin MEASUREMENT DLSVerrors "" UBYTE dez 0 0 0.000000 255.000000 /begin IF_DATA ASAP1B_ETK KP_BLOB 0x380A94 1 1 /end IF_DATA BIT_MASK 0xFF /end MEASUREMENT
/begin MEASUREMENT DLSVintbits "" UBYTE dez 0 0 0.000000 255.000000 /begin IF_DATA ASAP1B_ETK KP_BLOB 0x380A95 1 1 /end IF_DATA BIT_MASK 0xFF /end MEASUREMENT
/begin MEASUREMENT dlurs "Laufunruhedifferenz-Referenzwert, signed" SBYTE luquant 0 0 -80.843807 80.212215 /begin IF_DATA ASAP1B_ETK KP_BLOB 0x380A14 1 1 /end IF_DATA BIT_MASK 0xFF /end MEASUREMENT
/begin MEASUREMENT dlurs_m "Monitor, Laufunruhedifferenz-Referenzwert, signed, verzîgerte Ausgabe" SBYTE luquant 0 0 -80.843807 80.212215 /begin IF_DATA ASAP1B_ETK KP_BLOB 0xE3D9 0 1 /end IF_DATA BIT_MASK 0xFF /end MEASUREMENT
/begin MEASUREMENT dluts "Laufunruhedifferenz-Testgrî·e, signed" SBYTE luquant 0 0 -80.843807 80.212215 /begin IF_DATA ASAP1B_ETK KP_BLOB 0x3809F7 1 1 /end IF_DATA BIT_MASK 0xFF /end MEASUREMENT
/begin MEASUREMENT dluts1 "Differenz Laufunruhe-Testgrî·e, signed" SBYTE luquant 0 0 -80.843807 80.212215 /begin IF_DATA ASAP1B_ETK KP_BLOB 0x3809F8 1 1 /end IF_DATA BIT_MASK 0xFF /end MEASUREMENT
/begin MEASUREMENT dluts2 "Differenz Laufunruhe-Testgrî·e, signed" SBYTE luquant 0 0 -80.843807 80.212215 /begin IF_DATA ASAP1B_ETK KP_BLOB 0x3809F9 1 1 /end IF_DATA BIT_MASK 0xFF /end MEASUREMENT
/begin MEASUREMENT dluts3 "Differenz Laufunruhe-Testgrî·e, signed" SBYTE luquant 0 0 -80.843807 80.212215 /begin IF_DATA ASAP1B_ETK KP_BLOB 0x3809FA 1 1 /end IF_DATA BIT_MASK 0xFF /end MEASUREMENT
/begin MEASUREMENT dluts4 "Differenz Laufunruhe-Testgrî·e, signed" SBYTE luquant 0 0 -80.843807 80.212215 /begin IF_DATA ASAP1B_ETK KP_BLOB 0x3809FB 1 1 /end IF_DATA BIT_MASK 0xFF /end MEASUREMENT
/begin MEASUREMENT dluts5 "Differenz Laufunruhe-Testgrî·e, signed" SBYTE luquant 0 0 -80.843807 80.212215 /begin IF_DATA ASAP1B_ETK KP_BLOB 0x3809FC 1 1 /end IF_DATA BIT_MASK 0xFF /end MEASUREMENT
/begin MEASUREMENT dluts6 "Differenz Laufunruhe-Testgrî·e, signed" SBYTE luquant 0 0 -80.843807 80.212215 /begin IF_DATA ASAP1B_ETK KP_BLOB 0x3809FD 1 1 /end IF_DATA BIT_MASK 0xFF /end MEASUREMENT
/begin MEASUREMENT dluts7 "Differenz Laufunruhe-Testgrî·e, signed" SBYTE luquant 0 0 -80.843807 80.212215 /begin IF_DATA ASAP1B_ETK KP_BLOB 0x3809FE 1 1 /end IF_DATA BIT_MASK 0xFF /end MEASUREMENT
/begin MEASUREMENT dluts8 "Differenz Laufunruhe-Testgrî·e, signed" SBYTE luquant 0 0 -80.843807 80.212215 /begin IF_DATA ASAP1B_ETK KP_BLOB 0x3809FF 1 1 /end IF_DATA BIT_MASK 0xFF /end MEASUREMENT
/begin MEASUREMENT dluts_m "Monitor, Laufunruhedifferenz-Testgrî·e, signed, verzîgerte Ausgabe" SBYTE luquant 0 0 -80.843807 80.212215 /begin IF_DATA ASAP1B_ETK KP_BLOB 0xE3D8 0 1 /end IF_DATA BIT_MASK 0xFF /end MEASUREMENT
/begin MEASUREMENT dmllri_w "geforderte DrehmomentÑnderung von der LLR (I-Anteil)" SWORD rel_sw_b100 0 0 -100.000000 99.996948 /begin IF_DATA ASAP1B_ETK KP_BLOB 0x382368 1 2 /end IF_DATA BIT_MASK 0xFFFF /end MEASUREMENT
/begin MEASUREMENT dmrlash_w "Momenten-Reserve fÅr Lambdasonden-AlterungsÅberwachung hinter Kat" UWORD rel_uw_b100 0 0 0.000000 99.998474 /begin IF_DATA ASAP1B_ETK KP_BLOB 0x381B82 1 2 /end IF_DATA BIT_MASK 0xFFFF /end MEASUREMENT
/begin MEASUREMENT dmrlsh_w "Momenten-Reserve fÅr Sondendiagnose hinter Kat" UWORD rel_uw_b100 0 0 0.000000 99.998474 /begin IF_DATA ASAP1B_ETK KP_BLOB 0x381B2E 1 2 /end IF_DATA BIT_MASK 0xFFFF /end MEASUREMENT
/begin MEASUREMENT dpu_w "Druckdifferenz Umgebungsdruck - Saugrohrdruck" UWORD p_uw_q0p039 0 0 0.000000 2559.960938 /begin IF_DATA ASAP1B_ETK KP_BLOB 0x382776 1 2 /end IF_DATA BIT_MASK 0xFFFF /end MEASUREMENT
/begin MEASUREMENT dtmast "MotortemperaturÑnderung zwischen letztem Abstellen und aktuellem Start" UBYTE temp_sb_q0p75 0 0 0.000000 191.250000 /begin IF_DATA ASAP1B_ETK KP_BLOB 0x380CC5 1 1 /end IF_DATA BIT_MASK 0xFF /end MEASUREMENT
/begin MEASUREMENT dvbab "Fahrzeuggeschwindigkeitsdifferenzbei Bergaberkennung" SBYTE vfzg_ub_q1p25 0 0 -160.000000 158.750000 /begin IF_DATA ASAP1B_ETK KP_BLOB 0x380CC6 1 1 /end IF_DATA BIT_MASK 0xFF /end MEASUREMENT
/begin MEASUREMENT esst_snm08dmub "" UWORD dez___UW 0 0 0.000000 65535.000000 /begin IF_DATA ASAP1B_ETK KP_BLOB 0x380E6C 1 2 /end IF_DATA BIT_MASK 0xFFFF /end MEASUREMENT
/begin MEASUREMENT esst_srl08dmub "" UWORD dez___UW 0 0 0.000000 65535.000000 /begin IF_DATA ASAP1B_ETK KP_BLOB 0x380E8A 1 2 /end IF_DATA BIT_MASK 0xFFFF /end MEASUREMENT
/begin MEASUREMENT esst_svf06d_ub "" UWORD dez___UW 0 0 0.000000 65535.000000 /begin IF_DATA ASAP1B_ETK KP_BLOB 0x38276A 1 2 /end IF_DATA BIT_MASK 0xFFFF /end MEASUREMENT
/begin MEASUREMENT fdmd_m "Statusflag diagnose misfire detection, Monitor, verzîgerte Ausgabe" UBYTE DEZ 0 0 0.000000 255.000000 /begin IF_DATA ASAP1B_ETK KP_BLOB 0xE3DB 0 1 /end IF_DATA BIT_MASK 0xFF /end MEASUREMENT
/begin MEASUREMENT flgdldp "Flagregister 1 der DLDP" UWORD dez___UW 0 0 0.000000 65535.000000 /begin IF_DATA ASAP1B_ETK KP_BLOB 0x382778 1 2 /end IF_DATA BIT_MASK 0xFFFF /end MEASUREMENT
/begin MEASUREMENT flgdldp2 "Flagregister 2 der DLDP" UWORD dez___UW 0 0 0.000000 65535.000000 /begin IF_DATA ASAP1B_ETK KP_BLOB 0x38277A 1 2 /end IF_DATA BIT_MASK 0xFFFF /end MEASUREMENT
/begin MEASUREMENT flg_m "Monitor Status Laufunruhe-Berechnung" UBYTE DEZ 0 0 0.000000 255.000000 /begin IF_DATA ASAP1B_ETK KP_BLOB 0xE3F8 0 1 /end IF_DATA BIT_MASK 0xFF /end MEASUREMENT
/begin MEASUREMENT fppcnt "ZÑhler Pumpphasen bei Fast Pulse" UBYTE dez 0 0 0.000000 255.000000 /begin IF_DATA ASAP1B_ETK KP_BLOB 0x380CCB 1 1 /end IF_DATA BIT_MASK 0xFF /end MEASUREMENT
/begin MEASUREMENT fpper "Aktuelle Periodendauer Fast Pulse" UBYTE t10msxs_ub_b2p55 0 0 0.000000 2.550000 /begin IF_DATA ASAP1B_ETK KP_BLOB 0x380CCC 1 1 /end IF_DATA BIT_MASK 0xFF /end MEASUREMENT
/begin MEASUREMENT fpuls "Pulsdauer fÅr Fast Pulse" UWORD t10msxs_uw_b655p35 0 0 0.000000 655.350000 /begin IF_DATA ASAP1B_ETK KP_BLOB 0x38277C 1 2 /end IF_DATA BIT_MASK 0xFFFF /end MEASUREMENT
/begin MEASUREMENT frao_w "multiplikativer Gemischadaptionsfaktor oberer Lastbereich (Word)" UWORD fak_uw_b2 0 0 0.000000 1.999969 /begin IF_DATA ASAP1B_ETK KP_BLOB 0x383C64 1 2 /end IF_DATA BIT_MASK 0xFFFF /end MEASUREMENT
/begin MEASUREMENT frauzs_w "multiplikativer Gemischadaptionsfaktor unterer mult. Bereich (alter Wert)" UWORD fak_uw_b2 0 0 0.000000 1.999969 /begin IF_DATA ASAP1B_ETK KP_BLOB 0x38208C 1 2 /end IF_DATA BIT_MASK 0xFFFF /end MEASUREMENT
/begin MEASUREMENT frau_w "multiplikativer Gemischadaptionsfaktor unterer mult. Bereich (Word)" UWORD fak_uw_b2 0 0 0.000000 1.999969 /begin IF_DATA ASAP1B_ETK KP_BLOB 0x383C68 1 2 /end IF_DATA BIT_MASK 0xFFFF /end MEASUREMENT
/begin MEASUREMENT frm2_w "schneller Mittelwert des Lambdaregelfaktors Bank 2(Word)" UWORD fak_uw_b2 0 0 0.000000 1.999969 /begin IF_DATA ASAP1B_ETK KP_BLOB 0x382898 1 2 /end IF_DATA BIT_MASK 0xFFFF /end MEASUREMENT
/begin MEASUREMENT frmtrip2_w "Mittelwert des Lambdaregelfaktors fÅr Kurztrip SchwingungsprÅfung h. KAT Bank2" UWORD fak_uw_b2 0 0 0.000000 1.999969 /begin IF_DATA ASAP1B_ETK KP_BLOB 0x381B84 1 2 /end IF_DATA BIT_MASK 0xFFFF /end MEASUREMENT
/begin MEASUREMENT frmtrip_w "Mittelwert des Lambdaregelfaktors fÅr Kurztrip SchwingungsprÅfung hinter KAT" UWORD fak_uw_b2 0 0 0.000000 1.999969 /begin IF_DATA ASAP1B_ETK KP_BLOB 0x381B86 1 2 /end IF_DATA BIT_MASK 0xFFFF /end MEASUREMENT
/begin MEASUREMENT frm_w "schneller Mittelwert des Lambdaregelfaktors (Word)" UWORD fak_uw_b2 0 0 0.000000 1.999969 /begin IF_DATA ASAP1B_ETK KP_BLOB 0x3828A2 1 2 /end IF_DATA BIT_MASK 0xFFFF /end MEASUREMENT
/begin MEASUREMENT fvdldp "" UWORD dez___UW 0 0 0.000000 65535.000000 /begin IF_DATA ASAP1B_ETK KP_BLOB 0x38277E 1 2 /end IF_DATA BIT_MASK 0xFFFF /end MEASUREMENT
/begin MEASUREMENT GGFSTbits "" UBYTE dez 0 0 0.000000 255.000000 /begin IF_DATA ASAP1B_ETK KP_BLOB 0x383348 1 1 /end IF_DATA BIT_MASK 0xFF /end MEASUREMENT
/begin MEASUREMENT imlkvszs_w "Zwischenspeicher: Luftmasse nach Auftreten eines DKVS Fehles bei leerem Tank" UWORD m_q0p00355 0 0 0.000000 233.013333 /begin IF_DATA ASAP1B_ETK KP_BLOB 0x383C94 1 2 /end IF_DATA BIT_MASK 0xFFFF /end MEASUREMENT
/begin MEASUREMENT imlkvs_w "Luftmasse nach Auftreten eines DKVS Fehles bei leerem Tank" UWORD m_q0p00355 0 0 0.000000 233.013333 /begin IF_DATA ASAP1B_ETK KP_BLOB 0x38208E 1 2 /end IF_DATA BIT_MASK 0xFFFF /end MEASUREMENT
/begin MEASUREMENT lamelsh_w "Lambdasoll fÅr elektrische Sondendiagnose hinter KAT (Kurztrip)" UWORD fak_uw_b16 0 0 0.000000 15.999756 /begin IF_DATA ASAP1B_ETK KP_BLOB 0x381B30 1 2 /end IF_DATA BIT_MASK 0xFFFF /end MEASUREMENT
/begin MEASUREMENT lamfrm2_w "Lambdaabweichung aus Mittelwert Lambdaregelfaktor Bank2" UWORD fak_uw_b16 0 0 0.000000 15.999756 /begin IF_DATA ASAP1B_ETK KP_BLOB 0x381B88 1 2 /end IF_DATA BIT_MASK 0xFFFF /end MEASUREMENT
/begin MEASUREMENT lamfrm_w "Lambdaabweichung aus Mittelwert Lambdaregelfaktor" UWORD fak_uw_b16 0 0 0.000000 15.999756 /begin IF_DATA ASAP1B_ETK KP_BLOB 0x381B8A 1 2 /end IF_DATA BIT_MASK 0xFFFF /end MEASUREMENT
/begin MEASUREMENT lamlash2_w "Lambdasoll fÅr Test SchwingungsprÅfung hinter KAT Bank2" UWORD fak_uw_b16 0 0 0.000000 15.999756 /begin IF_DATA ASAP1B_ETK KP_BLOB 0x381B8C 1 2 /end IF_DATA BIT_MASK 0xFFFF /end MEASUREMENT
/begin MEASUREMENT lamlash_w "Lambdasoll fÅr Test SchwingungsprÅfung hinter KAT" UWORD fak_uw_b16 0 0 0.000000 15.999756 /begin IF_DATA ASAP1B_ETK KP_BLOB 0x381B8E 1 2 /end IF_DATA BIT_MASK 0xFFFF /end MEASUREMENT
/begin MEASUREMENT lamsons_w "Lambda-Sollwert bezogen auf Einbauort Lambda-Sensor" UWORD fak_uw_b16 0 0 0.000000 15.999756 /begin IF_DATA ASAP1B_ETK KP_BLOB 0x381FE4 1 2 /end IF_DATA BIT_MASK 0xFFFF /end MEASUREMENT
/begin MEASUREMENT ldtvm "LDR TastverhÑltnis , moduliert (Endergebnis)" UBYTE tv_ub_b100 0 0 0.000000 99.609375 /begin IF_DATA ASAP1B_ETK KP_BLOB 0x380C0D 1 1 /end IF_DATA BIT_MASK 0xFF /end MEASUREMENT
/begin MEASUREMENT limax_w "LLR-Integrator-Maximalwert" SWORD rel_sw_b100 0 0 -100.000000 99.996948 /begin IF_DATA ASAP1B_ETK KP_BLOB 0x382378 1 2 /end IF_DATA BIT_MASK 0xFFFF /end MEASUREMENT
/begin MEASUREMENT limin_w "LLR-Integrator-Minimalwert" SWORD rel_sw_b100 0 0 -100.000000 99.996948 /begin IF_DATA ASAP1B_ETK KP_BLOB 0x38237A 1 2 /end IF_DATA BIT_MASK 0xFFFF /end MEASUREMENT
/begin MEASUREMENT LokBits1 "" UBYTE dez 0 0 0.000000 255.000000 /begin IF_DATA ASAP1B_ETK KP_BLOB 0x380A78 1 1 /end IF_DATA BIT_MASK 0xFF /end MEASUREMENT
/begin MEASUREMENT m6catv "Mode 6 - Speicher: Component ID fÅr PrÅfung Lambda-Sondenalterung TV" UBYTE dez 0 0 0.000000 255.000000 /begin IF_DATA ASAP1B_ETK KP_BLOB 0x383340 1 1 /end IF_DATA BIT_MASK 0xFF /end MEASUREMENT
/begin MEASUREMENT m6catv2 "Mode 6 - Speicher: Component ID fÅr PrÅfung Lambda-Sondenalterung TV bei Bank 2" UBYTE dez 0 0 0.000000 255.000000 /begin IF_DATA ASAP1B_ETK KP_BLOB 0x383341 1 1 /end IF_DATA BIT_MASK 0xFF /end MEASUREMENT
/begin MEASUREMENT m6clsch "Mode 6 - Speicher: Component ID Sondenspannung im Schub hinter KAT" UBYTE dez 0 0 0.000000 255.000000 /begin IF_DATA ASAP1B_ETK KP_BLOB 0x38331F 1 1 /end IF_DATA BIT_MASK 0xFF /end MEASUREMENT
/begin MEASUREMENT m6clsch2 "Mode 6 - Speicher: Component ID Sondenspannung im Schub hinter KAT Bank2" UBYTE dez 0 0 0.000000 255.000000 /begin IF_DATA ASAP1B_ETK KP_BLOB 0x383320 1 1 /end IF_DATA BIT_MASK 0xFF /end MEASUREMENT
/begin MEASUREMENT m6clsdy "Mode 6 - Speicher: Component ID Dynamik-Messung fÅr Sonde hinter KAT" UBYTE dez 0 0 0.000000 255.000000 /begin IF_DATA ASAP1B_ETK KP_BLOB 0x383321 1 1 /end IF_DATA BIT_MASK 0xFF /end MEASUREMENT
/begin MEASUREMENT m6clsdy2 "Mode 6 - Speicher: Component ID Dynamik-Messung fÅr Sonde hinter KAT Bank2" UBYTE dez 0 0 0.000000 255.000000 /begin IF_DATA ASAP1B_ETK KP_BLOB 0x383322 1 1 /end IF_DATA BIT_MASK 0xFF /end MEASUREMENT
/begin MEASUREMENT m6cshkf "Mode 6 - Speicher: Component ID Fettspannung fÅr Sonde hinter KAT (Schwingpr.)" UBYTE dez 0 0 0.000000 255.000000 /begin IF_DATA ASAP1B_ETK KP_BLOB 0x383323 1 1 /end IF_DATA BIT_MASK 0xFF /end MEASUREMENT
/begin MEASUREMENT m6cshkf2 "Mode 6 - Speicher: Component ID Fettspg. fÅr Sonde hinter KAT (Schwingpr.) Bank2" UBYTE dez 0 0 0.000000 255.000000 /begin IF_DATA ASAP1B_ETK KP_BLOB 0x383324 1 1 /end IF_DATA BIT_MASK 0xFF /end MEASUREMENT
/begin MEASUREMENT m6cshkm "Mode 6 - Speicher: Component ID Magerspannung fÅr Sonde hinter KAT (Schwingpr.)" UBYTE dez 0 0 0.000000 255.000000 /begin IF_DATA ASAP1B_ETK KP_BLOB 0x383325 1 1 /end IF_DATA BIT_MASK 0xFF /end MEASUREMENT
/begin MEASUREMENT m6cshkm2 "Mode 6 - Speicher: Component ID Magerspg. fÅr Sonde hint. KAT (Schwingpr.) Bank2" UBYTE dez 0 0 0.000000 255.000000 /begin IF_DATA ASAP1B_ETK KP_BLOB 0x383326 1 1 /end IF_DATA BIT_MASK 0xFF /end MEASUREMENT
/begin MEASUREMENT m6ctp "Mode 6 - Speicher: Component ID fÅr PrÅfung Lambda-Sondenalterung TP" UBYTE dez 0 0 0.000000 255.000000 /begin IF_DATA ASAP1B_ETK KP_BLOB 0x383342 1 1 /end IF_DATA BIT_MASK 0xFF /end MEASUREMENT
/begin MEASUREMENT m6ctp2 "Mode 6 - Speicher: Component ID fÅr PrÅfung Lambda-Sondenalterung Tp bei Bank 2" UBYTE dez 0 0 0.000000 255.000000 /begin IF_DATA ASAP1B_ETK KP_BLOB 0x383343 1 1 /end IF_DATA BIT_MASK 0xFF /end MEASUREMENT
/begin MEASUREMENT m6satv "Mode 6 - Speicher: Schwellwert bei Lambda-Sondenalterung TV" UBYTE t100msxs_ub_b2p55 0 0 0.000000 2.550000 /begin IF_DATA ASAP1B_ETK KP_BLOB 0x383344 1 1 /end IF_DATA BIT_MASK 0xFF /end MEASUREMENT
/begin MEASUREMENT m6satv2 "Mode 6 - Speicher: Schwellwert bei Lambda-Sondenalterung TV bei Bank 2" UBYTE t100msxs_ub_b2p55 0 0 0.000000 2.550000 /begin IF_DATA ASAP1B_ETK KP_BLOB 0x383345 1 1 /end IF_DATA BIT_MASK 0xFF /end MEASUREMENT
/begin MEASUREMENT m6slsch "Mode 6 - Speicher: Schwelle Sondenspannung im Schub hinter KAT" UBYTE spg_ub_q0p0052_o0p2 0 0 -0.200000 1.130000 /begin IF_DATA ASAP1B_ETK KP_BLOB 0x383327 1 1 /end IF_DATA BIT_MASK 0xFF /end MEASUREMENT
/begin MEASUREMENT m6slsch2 "Mode 6 - Speicher: Schwelle Sondenspannung im Schub hinter KAT Bank2" UBYTE spg_ub_q0p0052_o0p2 0 0 -0.200000 1.130000 /begin IF_DATA ASAP1B_ETK KP_BLOB 0x383328 1 1 /end IF_DATA BIT_MASK 0xFF /end MEASUREMENT
/begin MEASUREMENT m6slsdy "Mode 6 - Speicher: Schwelle Dynamik-Messung fÅr Sonde hinter KAT" UBYTE spgg_q0p52 0 0 0.000000 132.600000 /begin IF_DATA ASAP1B_ETK KP_BLOB 0x383329 1 1 /end IF_DATA BIT_MASK 0xFF /end MEASUREMENT
/begin MEASUREMENT m6slsdy2 "Mode 6 - Speicher: Schwelle Dynamik-Messung fÅr Sonde hinter KAT Bank2" UBYTE spgg_q0p52 0 0 0.000000 132.600000 /begin IF_DATA ASAP1B_ETK KP_BLOB 0x38332A 1 1 /end IF_DATA BIT_MASK 0xFF /end MEASUREMENT
/begin MEASUREMENT m6sshkf "Mode 6 - Speicher: Schwelle Fettspannung fÅr Sonde hinter KAT (Schwingpr.)" UBYTE spg_ub_q0p0052_o0p2 0 0 -0.200000 1.130000 /begin IF_DATA ASAP1B_ETK KP_BLOB 0x38332B 1 1 /end IF_DATA BIT_MASK 0xFF /end MEASUREMENT
/begin MEASUREMENT m6sshkf2 "Mode 6 - Speicher: Schwelle Fettspannung fÅr Sonde hinter KAT (Schwingpr.) Bank2" UBYTE spg_ub_q0p0052_o0p2 0 0 -0.200000 1.130000 /begin IF_DATA ASAP1B_ETK KP_BLOB 0x38332C 1 1 /end IF_DATA BIT_MASK 0xFF /end MEASUREMENT
/begin MEASUREMENT m6sshkm "Mode 6 - Speicher: Schwelle Magerspannung fÅr Sonde hinter KAT (Schwingpr.)" UBYTE spg_ub_q0p0052_o0p2 0 0 -0.200000 1.130000 /begin IF_DATA ASAP1B_ETK KP_BLOB 0x38332D 1 1 /end IF_DATA BIT_MASK 0xFF /end MEASUREMENT
/begin MEASUREMENT m6sshkm2 "Mode 6 - Speicher: Schwelle Magerspannung fÅr Sonde hint. KAT (Schwingpr.) Bank2" UBYTE spg_ub_q0p0052_o0p2 0 0 -0.200000 1.130000 /begin IF_DATA ASAP1B_ETK KP_BLOB 0x38332E 1 1 /end IF_DATA BIT_MASK 0xFF /end MEASUREMENT
/begin MEASUREMENT m6stp2_w "Mode 6 - Speicher: Schwellwert bei Lambda-Sondenalterung TP bei Bank 2" UWORD t10msxs_uw_b655p35 0 0 0.000000 655.350000 /begin IF_DATA ASAP1B_ETK KP_BLOB 0x383C36 1 2 /end IF_DATA BIT_MASK 0xFFFF /end MEASUREMENT
/begin MEASUREMENT m6stp_w "Mode 6 - Speicher: Schwellwert bei Lambda-Sondenalterung TP" UWORD t10msxs_uw_b655p35 0 0 0.000000 655.350000 /begin IF_DATA ASAP1B_ETK KP_BLOB 0x383C38 1 2 /end IF_DATA BIT_MASK 0xFFFF /end MEASUREMENT
/begin MEASUREMENT m6watv "Mode 6 - Speicher: Messwert Lambda-Sondenalterung TV" UBYTE t100msxs_ub_b2p55 0 0 0.000000 2.550000 /begin IF_DATA ASAP1B_ETK KP_BLOB 0x383346 1 1 /end IF_DATA BIT_MASK 0xFF /end MEASUREMENT
/begin MEASUREMENT m6watv2 "Mode 6 - Speicher: Messwert Lambda-Sondenalterung TV bei Bank 2" UBYTE t100msxs_ub_b2p55 0 0 0.000000 2.550000 /begin IF_DATA ASAP1B_ETK KP_BLOB 0x383347 1 1 /end IF_DATA BIT_MASK 0xFF /end MEASUREMENT
/begin MEASUREMENT m6wlsch "Mode 6 - Speicher: Messwert Sondenspannung im Schub hinter KAT" UBYTE spg_ub_q0p0052_o0p2 0 0 -0.200000 1.130000 /begin IF_DATA ASAP1B_ETK KP_BLOB 0x38332F 1 1 /end IF_DATA BIT_MASK 0xFF /end MEASUREMENT
/begin MEASUREMENT m6wlsch2 "Mode 6 - Speicher: Messwert Sondenspannung im Schub hinter KAT Bank2" UBYTE spg_ub_q0p0052_o0p2 0 0 -0.200000 1.130000 /begin IF_DATA ASAP1B_ETK KP_BLOB 0x383330 1 1 /end IF_DATA BIT_MASK 0xFF /end MEASUREMENT
/begin MEASUREMENT m6wlsdy "Mode 6 - Speicher: Messwert Dynamik-Messung fÅr Sonde hinter KAT" UBYTE spgg_q0p52 0 0 0.000000 132.600000 /begin IF_DATA ASAP1B_ETK KP_BLOB 0x383331 1 1 /end IF_DATA BIT_MASK 0xFF /end MEASUREMENT
/begin MEASUREMENT m6wlsdy2 "Mode 6 - Speicher: Messwert Dynamik-Messung fÅr Sonde hinter KAT Bank2" UBYTE spgg_q0p52 0 0 0.000000 132.600000 /begin IF_DATA ASAP1B_ETK KP_BLOB 0x383332 1 1 /end IF_DATA BIT_MASK 0xFF /end MEASUREMENT
/begin MEASUREMENT m6wshkf "Mode 6 - Speicher: Messwert Fettspannung fÅr Sonde hinter KAT (Schwingpr.)" UBYTE spg_ub_q0p0052_o0p2 0 0 -0.200000 1.130000 /begin IF_DATA ASAP1B_ETK KP_BLOB 0x383333 1 1 /end IF_DATA BIT_MASK 0xFF /end MEASUREMENT
/begin MEASUREMENT m6wshkf2 "Mode 6 - Speicher: Messwert Fettspannung fÅr Sonde hinter KAT (Schwingpr.) Bank2" UBYTE spg_ub_q0p0052_o0p2 0 0 -0.200000 1.130000 /begin IF_DATA ASAP1B_ETK KP_BLOB 0x383334 1 1 /end IF_DATA BIT_MASK 0xFF /end MEASUREMENT
/begin MEASUREMENT m6wshkm "Mode 6 - Speicher: Me·wert Magerspannung fÅr Sonde hint. KAT (Schwingpr.)" UBYTE spg_ub_q0p0052_o0p2 0 0 -0.200000 1.130000 /begin IF_DATA ASAP1B_ETK KP_BLOB 0x383335 1 1 /end IF_DATA BIT_MASK 0xFF /end MEASUREMENT
/begin MEASUREMENT m6wshkm2 "Mode 6 - Speicher: Me·wert Magerspannung fÅr Sonde hint. KAT (Schwingpr.) Bank2" UBYTE spg_ub_q0p0052_o0p2 0 0 -0.200000 1.130000 /begin IF_DATA ASAP1B_ETK KP_BLOB 0x383336 1 1 /end IF_DATA BIT_MASK 0xFF /end MEASUREMENT
/begin MEASUREMENT m6wtp2_w "Mode 6 - Speicher: Messwert Lambda-Sondenalterung TP bei Bank 2" UWORD t10msxs_uw_b655p35 0 0 0.000000 655.350000 /begin IF_DATA ASAP1B_ETK KP_BLOB 0x383C3A 1 2 /end IF_DATA BIT_MASK 0xFFFF /end MEASUREMENT
/begin MEASUREMENT m6wtp_w "Mode 6 - Speicher: Messwert Lambda-Sondenalterung TP" UWORD t10msxs_uw_b655p35 0 0 0.000000 655.350000 /begin IF_DATA ASAP1B_ETK KP_BLOB 0x383C3C 1 2 /end IF_DATA BIT_MASK 0xFFFF /end MEASUREMENT
/begin MEASUREMENT mldyn_w "Luftmassenintegral im Schubbetrieb" UWORD m_q0p00277 0 0 0.000000 182.041667 /begin IF_DATA ASAP1B_ETK KP_BLOB 0x381B90 1 2 /end IF_DATA BIT_MASK 0xFFFF /end MEASUREMENT
/begin MEASUREMENT modeldp "" UBYTE dez 0 0 0.000000 255.000000 /begin IF_DATA ASAP1B_ETK KP_BLOB 0x380CCD 1 1 /end IF_DATA BIT_MASK 0xFF /end MEASUREMENT
/begin MEASUREMENT modeldp_old "" UBYTE dez 0 0 0.000000 255.000000 /begin IF_DATA ASAP1B_ETK KP_BLOB 0x380CCE 1 1 /end IF_DATA BIT_MASK 0xFF /end MEASUREMENT
/begin MEASUREMENT NovBits "" UBYTE dez 0 0 0.000000 255.000000 /begin IF_DATA ASAP1B_ETK KP_BLOB 0x383337 1 1 /end IF_DATA BIT_MASK 0xFF /end MEASUREMENT
/begin MEASUREMENT ps_w "Saugrohr-Absolutdruck (Word)" UWORD p_uw_q0p039 0 0 0.000000 2559.960938 /begin IF_DATA ASAP1B_ETK KP_BLOB 0xF99A 0 2 /end IF_DATA BIT_MASK 0xFFFF /end MEASUREMENT
/begin MEASUREMENT pumem_w "Korrigierter Umgebungsdruck zu Beginn der Pump-Phase" UWORD p_uw_q0p039 0 0 0.000000 2559.960938 /begin IF_DATA ASAP1B_ETK KP_BLOB 0x382780 1 2 /end IF_DATA BIT_MASK 0xFFFF /end MEASUREMENT
/begin MEASUREMENT pu_w "Umgebungsdruck 16-Bit" UWORD p_uw_q0p039 0 0 0.000000 2559.960938 /begin IF_DATA ASAP1B_ETK KP_BLOB 0x381EA2 1 2 /end IF_DATA BIT_MASK 0xFFFF /end MEASUREMENT
/begin MEASUREMENT rinh_w "Istwert (word) Innenwiderstand Ri-Nernstzelle der Lambdasonde hinter KAT" UWORD r_uw_q2 0 0 0.000000 131070.000000 /begin IF_DATA ASAP1B_ETK KP_BLOB 0x381B42 1 2 /end IF_DATA BIT_MASK 0xFFFF /end MEASUREMENT
/begin MEASUREMENT rinv_w "Istwert (word) Innenwiderstand Ri-Nernstzelle der Lambdasonde vor KAT" UWORD r_uw_q2 0 0 0.000000 131070.000000 /begin IF_DATA ASAP1B_ETK KP_BLOB 0x381BB6 1 2 /end IF_DATA BIT_MASK 0xFFFF /end MEASUREMENT
/begin MEASUREMENT rkamzs_w "additive Gemischkorrektur (pro Zeit oder ZÅndung); alter Wert" SWORD rel_sw_b1536 0 0 -1536.000000 1535.953125 /begin IF_DATA ASAP1B_ETK KP_BLOB 0x382090 1 2 /end IF_DATA BIT_MASK 0xFFFF /end MEASUREMENT
/begin MEASUREMENT rkam_w "Auswahl additive Gemischkorrektur der Gemischadaption fÅr Bestimmung B_gae" SWORD rel_sw_b1536 0 0 -1536.000000 1535.953125 /begin IF_DATA ASAP1B_ETK KP_BLOB 0x382092 1 2 /end IF_DATA BIT_MASK 0xFFFF /end MEASUREMENT
/begin MEASUREMENT rkat_w "additive Gemischkorrektur (pro Zeit) der Gemischdaption (Word)" SWORD rel_sw_b1536 0 0 -1536.000000 1535.953125 /begin IF_DATA ASAP1B_ETK KP_BLOB 0x383C6C 1 2 /end IF_DATA BIT_MASK 0xFFFF /end MEASUREMENT
/begin MEASUREMENT rkaz_w "additive Gemischkorrektur (pro ZÅndung) der Gemischadaption" SWORD rel_sw_b1536 0 0 -1536.000000 1535.953125 /begin IF_DATA ASAP1B_ETK KP_BLOB 0x383C70 1 2 /end IF_DATA BIT_MASK 0xFFFF /end MEASUREMENT
/begin MEASUREMENT rlbab "Aktuelle RL-Schwelle bei Bergaberkennung" UBYTE rel_ub_q0p75 0 0 0.000000 191.250000 /begin IF_DATA ASAP1B_ETK KP_BLOB 0x380CC7 1 1 /end IF_DATA BIT_MASK 0xFF /end MEASUREMENT
/begin MEASUREMENT rlf "Tiefpa·gefiltertes RL bei Bergaberkennung" UBYTE rel_ub_q0p75 0 0 0.000000 191.250000 /begin IF_DATA ASAP1B_ETK KP_BLOB 0x380CC8 1 1 /end IF_DATA BIT_MASK 0xFF /end MEASUREMENT
/begin MEASUREMENT rsmcnt "ZÑhler Wiederholversuche nach Unterbrechung bei erkanntem Leck" UBYTE dez 0 0 0.000000 255.000000 /begin IF_DATA ASAP1B_ETK KP_BLOB 0x380CCF 1 1 /end IF_DATA BIT_MASK 0xFF /end MEASUREMENT
/begin MEASUREMENT stptr "Zustandspointer der DLSP" UBYTE dez 0 0 0.000000 255.000000 /begin IF_DATA ASAP1B_ETK KP_BLOB 0x380CD0 1 1 /end IF_DATA BIT_MASK 0xFF /end MEASUREMENT
/begin MEASUREMENT tateout "ausgegebenes TastverhÑltnis fÅr TankentlÅftungsventil" UBYTE rel_ub_b99p6 0 0 0.000000 99.609375 /begin IF_DATA ASAP1B_ETK KP_BLOB 0x380CB3 1 1 /end IF_DATA BIT_MASK 0xFF /end MEASUREMENT
/begin MEASUREMENT tc6ldpc "Ausgabe Code SCAN-Tool Mode 6 aus LDP-Diagnose" UBYTE dez 0 0 0.000000 255.000000 /begin IF_DATA ASAP1B_ETK KP_BLOB 0x38343E 1 1 /end IF_DATA BIT_MASK 0xFF /end MEASUREMENT
/begin MEASUREMENT tc6ldps "Ausgabe Schwellwert SCAN-Tool Mode 6 aus LDP-Diagnose" UWORD dez___UW 0 0 0.000000 65535.000000 /begin IF_DATA ASAP1B_ETK KP_BLOB 0x383E42 1 2 /end IF_DATA BIT_MASK 0xFFFF /end MEASUREMENT
/begin MEASUREMENT tc6ldpw "Ausgabe PrÅfwert SCAN-Tool Mode 6 aus LDP-Diagnose" UWORD dez___UW 0 0 0.000000 65535.000000 /begin IF_DATA ASAP1B_ETK KP_BLOB 0x383E44 1 2 /end IF_DATA BIT_MASK 0xFFFF /end MEASUREMENT
/begin MEASUREMENT tdaufp "Bereitstellung Zeitdauer Fast Pulse" UWORD t10msxs_uw_b655p35 0 0 0.000000 655.350000 /begin IF_DATA ASAP1B_ETK KP_BLOB 0x382782 1 2 /end IF_DATA BIT_MASK 0xFFFF /end MEASUREMENT
/begin MEASUREMENT tfrn2_w "Zeitdauer Lambdaregler I-Anteil negative Steigung, Bank 2" UWORD t10msxs_uw_b655p35 0 0 0.000000 655.350000 /begin IF_DATA ASAP1B_ETK KP_BLOB 0x3828AA 1 2 /end IF_DATA BIT_MASK 0xFFFF /end MEASUREMENT
/begin MEASUREMENT tfrn_w "Zeitdauer Lambdaregler I-Anteil negative Steigung" UWORD t10msxs_uw_b655p35 0 0 0.000000 655.350000 /begin IF_DATA ASAP1B_ETK KP_BLOB 0x3828B0 1 2 /end IF_DATA BIT_MASK 0xFFFF /end MEASUREMENT
/begin MEASUREMENT tfrp2_w "Zeitdauer Lambdaregler I-Anteil positive Steigung, Bank2" UWORD t10msxs_uw_b655p35 0 0 0.000000 655.350000 /begin IF_DATA ASAP1B_ETK KP_BLOB 0x3828B2 1 2 /end IF_DATA BIT_MASK 0xFFFF /end MEASUREMENT
/begin MEASUREMENT tfrp_w "Zeitdauer Lambdaregler I-Anteil positive Steigung" UWORD t10msxs_uw_b655p35 0 0 0.000000 655.350000 /begin IF_DATA ASAP1B_ETK KP_BLOB 0x3828B8 1 2 /end IF_DATA BIT_MASK 0xFFFF /end MEASUREMENT
/begin MEASUREMENT timaldp "" UWORD t10msxs_uw_b655p35 0 0 0.000000 655.350000 /begin IF_DATA ASAP1B_ETK KP_BLOB 0x382784 1 2 /end IF_DATA BIT_MASK 0xFFFF /end MEASUREMENT
/begin MEASUREMENT timfp "Timer fÅr Zeitdauer Fast Pulse" UWORD t10msxs_uw_b655p35 0 0 0.000000 655.350000 /begin IF_DATA ASAP1B_ETK KP_BLOB 0x382786 1 2 /end IF_DATA BIT_MASK 0xFFFF /end MEASUREMENT
/begin MEASUREMENT timldp "Timer fÅr maximale Diagnosezeit DLDP" UWORD t1sxs_uw_b65535 0 0 0.000000 65535.000000 /begin IF_DATA ASAP1B_ETK KP_BLOB 0x38276C 1 2 /end IF_DATA BIT_MASK 0xFFFF /end MEASUREMENT
/begin MEASUREMENT timrs "Timer fÅr Reed-Switch Closed Check" UWORD t10msxs_uw_b655p35 0 0 0.000000 655.350000 /begin IF_DATA ASAP1B_ETK KP_BLOB 0x382788 1 2 /end IF_DATA BIT_MASK 0xFFFF /end MEASUREMENT
/begin MEASUREMENT timtev "" UWORD t10msxs_uw_b655p35 0 0 0.000000 655.350000 /begin IF_DATA ASAP1B_ETK KP_BLOB 0x38278A 1 2 /end IF_DATA BIT_MASK 0xFFFF /end MEASUREMENT
/begin MEASUREMENT timzldp "" UWORD t10msxs_uw_b655p35 0 0 0.000000 655.350000 /begin IF_DATA ASAP1B_ETK KP_BLOB 0x38278C 1 2 /end IF_DATA BIT_MASK 0xFFFF /end MEASUREMENT
/begin MEASUREMENT tispldpx_w "Schwelle fÅr Zeit fÅr InitialspÅlung bis LDP-Membran abgefallen ist" UWORD dez___UW 0 0 0.000000 65535.000000 /begin IF_DATA ASAP1B_ETK KP_BLOB 0x38276E 1 2 /end IF_DATA BIT_MASK 0xFFFF /end MEASUREMENT
/begin MEASUREMENT tispldp_w "Zeit fÅr InitialspÅlung bis LDP-Membran abgefallen ist" UWORD dez___UW 0 0 0.000000 65535.000000 /begin IF_DATA ASAP1B_ETK KP_BLOB 0x382770 1 2 /end IF_DATA BIT_MASK 0xFFFF /end MEASUREMENT
/begin MEASUREMENT tispuel "" UBYTE t1sxs_ub_b255 0 0 0.000000 255.000000 /begin IF_DATA ASAP1B_ETK KP_BLOB 0x380CC9 1 1 /end IF_DATA BIT_MASK 0xFF /end MEASUREMENT
/begin MEASUREMENT tldktim "Timer öberwachungszeit öberschreitung der tL-/wdkbl- Schwelle" UWORD t10msxs_uw_b655p35 0 0 0.000000 655.350000 /begin IF_DATA ASAP1B_ETK KP_BLOB 0x38278E 1 2 /end IF_DATA BIT_MASK 0xFFFF /end MEASUREMENT
/begin MEASUREMENT tldpein "" UWORD t10msxs_uw_b655p35 0 0 0.000000 655.350000 /begin IF_DATA ASAP1B_ETK KP_BLOB 0x382790 1 2 /end IF_DATA BIT_MASK 0xFFFF /end MEASUREMENT
/begin MEASUREMENT tldppmw "Gleitender Mittelwert Periodendauer bei Leckdiagnose" UWORD t10msxs_uw_b655p35 0 0 0.000000 655.350000 /begin IF_DATA ASAP1B_ETK KP_BLOB 0x382792 1 2 /end IF_DATA BIT_MASK 0xFFFF /end MEASUREMENT
/begin MEASUREMENT tnse_w "ZeitzÑhler ab Startende (16bit)" UWORD t100msxs_uw_b6553p5 0 0 0.000000 6553.500000 /begin IF_DATA ASAP1B_ETK KP_BLOB 0x382670 1 2 /end IF_DATA BIT_MASK 0xFFFF /end MEASUREMENT
/begin MEASUREMENT tpfifo_0_A "FIFO-Speicher fÅr Periodendauer" UWORD t10msxs_uw_b655p35 0 0 0.000000 655.350000 /begin IF_DATA ASAP1B_ETK KP_BLOB 0x382794 1 2 /end IF_DATA BIT_MASK 0xFFFF /end MEASUREMENT
/begin MEASUREMENT tpfifo_1_A "FIFO-Speicher fÅr Periodendauer" UWORD t10msxs_uw_b655p35 0 0 0.000000 655.350000 /begin IF_DATA ASAP1B_ETK KP_BLOB 0x382796 1 2 /end IF_DATA BIT_MASK 0xFFFF /end MEASUREMENT
/begin MEASUREMENT tpfifo_2_A "FIFO-Speicher fÅr Periodendauer" UWORD t10msxs_uw_b655p35 0 0 0.000000 655.350000 /begin IF_DATA ASAP1B_ETK KP_BLOB 0x382798 1 2 /end IF_DATA BIT_MASK 0xFFFF /end MEASUREMENT
/begin MEASUREMENT tpfifo_3_A "FIFO-Speicher fÅr Periodendauer" UWORD t10msxs_uw_b655p35 0 0 0.000000 655.350000 /begin IF_DATA ASAP1B_ETK KP_BLOB 0x38279A 1 2 /end IF_DATA BIT_MASK 0xFFFF /end MEASUREMENT
/begin MEASUREMENT tpldptcx_w "Schwelle Zeit fÅr bis LDP-Membran abgefallen ist nachdem TEV geîffnet wurde" UWORD dez___UW 0 0 0.000000 65535.000000 /begin IF_DATA ASAP1B_ETK KP_BLOB 0x382772 1 2 /end IF_DATA BIT_MASK 0xFFFF /end MEASUREMENT
/begin MEASUREMENT tpldptc_w "Zeit fÅr bis LDP-Membran abgefallen ist nachdem TEV geîffnet wurde" UWORD dez___UW 0 0 0.000000 65535.000000 /begin IF_DATA ASAP1B_ETK KP_BLOB 0x382774 1 2 /end IF_DATA BIT_MASK 0xFFFF /end MEASUREMENT
/begin MEASUREMENT tplrvk2_w "Periodendauerwert Rohwert der Sonde vor Kat, ermittelt in %LR, Bank 2" UWORD t10msxs_uw_b655p35 0 0 0.000000 655.350000 /begin IF_DATA ASAP1B_ETK KP_BLOB 0x3828BA 1 2 /end IF_DATA BIT_MASK 0xFFFF /end MEASUREMENT
/begin MEASUREMENT tplrvk_w "Periodendauerwert Rohwert der Sonde vor Kat, ermittelt in %LR" UWORD t10msxs_uw_b655p35 0 0 0.000000 655.350000 /begin IF_DATA ASAP1B_ETK KP_BLOB 0x3828BC 1 2 /end IF_DATA BIT_MASK 0xFFFF /end MEASUREMENT
/begin MEASUREMENT tpotv2_w "Periodendauerwert fÅr Sonde vor KAT ohne TV-Wert Bank2" UWORD t10msxs_uw_b655p35 0 0 0.000000 655.350000 /begin IF_DATA ASAP1B_ETK KP_BLOB 0x381C6A 1 2 /end IF_DATA BIT_MASK 0xFFFF /end MEASUREMENT
/begin MEASUREMENT tpotv_w "Periodendauerwert fÅr Sonde vor KAT ohne TV-Wert" UWORD t10msxs_uw_b655p35 0 0 0.000000 655.350000 /begin IF_DATA ASAP1B_ETK KP_BLOB 0x381C6C 1 2 /end IF_DATA BIT_MASK 0xFFFF /end MEASUREMENT
/begin MEASUREMENT tpsvkmf2_w "gefilterter Periodendauerwert des Sondensignals vor Kat, Bank2 (Word)" UWORD t10msxs_uw_b655p35 0 0 0.000000 655.350000 /begin IF_DATA ASAP1B_ETK KP_BLOB 0x383C3E 1 2 /end IF_DATA BIT_MASK 0xFFFF /end MEASUREMENT
/begin MEASUREMENT tpsvkmf_w "gefilterter Periodendauerwert des Sondensignals vor Kat. (Word)" UWORD t10msxs_uw_b655p35 0 0 0.000000 655.350000 /begin IF_DATA ASAP1B_ETK KP_BLOB 0x383C40 1 2 /end IF_DATA BIT_MASK 0xFFFF /end MEASUREMENT
/begin MEASUREMENT tpsvkof2_w "gemessener Periodendauerwert der Sonde vor Kat., Bank2, ohne Filter" UWORD t10msxs_uw_b655p35 0 0 0.000000 655.350000 /begin IF_DATA ASAP1B_ETK KP_BLOB 0x381C6E 1 2 /end IF_DATA BIT_MASK 0xFFFF /end MEASUREMENT
/begin MEASUREMENT tpsvkof_w "gemessener Periodendauerwert der Sonde vor Kat., ohne Filter" UWORD t10msxs_uw_b655p35 0 0 0.000000 655.350000 /begin IF_DATA ASAP1B_ETK KP_BLOB 0x381C70 1 2 /end IF_DATA BIT_MASK 0xFFFF /end MEASUREMENT
/begin MEASUREMENT tpsvlssa "Periodendauer (Sondensignal vor Kat) fÅr DLSSA" UBYTE t40msxs_ub_q0p04 0 0 0.000000 10.200000 /begin IF_DATA ASAP1B_ETK KP_BLOB 0x38334E 1 1 /end IF_DATA BIT_MASK 0xFF /end MEASUREMENT
/begin MEASUREMENT trklow "Timer zur öberwachung Reedkontakt îffnet wÑhrend Fast Pulse" UWORD t10msxs_uw_b655p35 0 0 0.000000 655.350000 /begin IF_DATA ASAP1B_ETK KP_BLOB 0x38279C 1 2 /end IF_DATA BIT_MASK 0xFFFF /end MEASUREMENT
/begin MEASUREMENT tuspnf "gefilterte Zeit zw. pos. und neg. usvk-Flanke, DLSSA" UBYTE t40msxs_ub_q0p04 0 0 0.000000 10.200000 /begin IF_DATA ASAP1B_ETK KP_BLOB 0x38334F 1 1 /end IF_DATA BIT_MASK 0xFF /end MEASUREMENT
/begin MEASUREMENT tvfzctr "" UBYTE t100msxs_ub_b25p5 0 0 0.000000 25.500000 /begin IF_DATA ASAP1B_ETK KP_BLOB 0x380CCA 1 1 /end IF_DATA BIT_MASK 0xFF /end MEASUREMENT
/begin MEASUREMENT twdlssa_w "Timer fÅr MindestprÅfzeit fÅr DLSSA-Extremwertbestimmung" UWORD t50msxs_uw_b3276p75 0 0 0.000000 3276.750000 /begin IF_DATA ASAP1B_ETK KP_BLOB 0x381F7E 1 2 /end IF_DATA BIT_MASK 0xFFFF /end MEASUREMENT
/begin MEASUREMENT twdlssh_w "Timer fÅr MindestprÅfzeit fÅr DLSSA-Extremwertbestimmung hinter KAT" UWORD t50msxs_uw_b3276p75 0 0 0.000000 3276.750000 /begin IF_DATA ASAP1B_ETK KP_BLOB 0x381F80 1 2 /end IF_DATA BIT_MASK 0xFFFF /end MEASUREMENT
/begin MEASUREMENT tzlsatv2_w "" UWORD t1sxs_uw_b65535 0 0 0.000000 65535.000000 /begin IF_DATA ASAP1B_ETK KP_BLOB 0x381C66 1 2 /end IF_DATA BIT_MASK 0xFFFF /end MEASUREMENT
/begin MEASUREMENT tzlsatv_w "" UWORD t1sxs_uw_b65535 0 0 0.000000 65535.000000 /begin IF_DATA ASAP1B_ETK KP_BLOB 0x381C68 1 2 /end IF_DATA BIT_MASK 0xFFFF /end MEASUREMENT
/begin MEASUREMENT uldpe "Ausgangsspannung der LDP-Endstufe" UBYTE spg_ub_q0p019 0 0 0.000000 4.980469 /begin IF_DATA ASAP1B_ETK KP_BLOB 0x3809B9 1 1 /end IF_DATA BIT_MASK 0xFF /end MEASUREMENT
/begin MEASUREMENT ushfmxstg "Gefilterte maximale Steigung der Sondenspannung hinter KAT" UBYTE spgg_q0p52 0 0 0.000000 132.600000 /begin IF_DATA ASAP1B_ETK KP_BLOB 0x383338 1 1 /end IF_DATA BIT_MASK 0xFF /end MEASUREMENT
/begin MEASUREMENT ushfmxstg2 "Gefilterte maximale Steigung der Sondenspannung hinter KAT Bank2" UBYTE spgg_q0p52 0 0 0.000000 132.600000 /begin IF_DATA ASAP1B_ETK KP_BLOB 0x383339 1 1 /end IF_DATA BIT_MASK 0xFF /end MEASUREMENT
/begin MEASUREMENT ushk "Spannung Lambdasonde hinter Katalysator" UBYTE spg_ub_q0p0052_o0p2 0 0 -0.200000 1.130000 /begin IF_DATA ASAP1B_ETK KP_BLOB 0x380A71 1 1 /end IF_DATA BIT_MASK 0xFF /end MEASUREMENT
/begin MEASUREMENT ushk2 "Spannung Lambdasonde hinter Katalysator 2" UBYTE spg_ub_q0p0052_o0p2 0 0 -0.200000 1.130000 /begin IF_DATA ASAP1B_ETK KP_BLOB 0x380A72 1 1 /end IF_DATA BIT_MASK 0xFF /end MEASUREMENT
/begin MEASUREMENT ushkj "Spannung Lambdasonde hinter Kat, ohne Offset, DLSSA, Bank 1" UBYTE spg_ub_b1p33 0 0 0.000000 1.330000 /begin IF_DATA ASAP1B_ETK KP_BLOB 0x380B07 1 1 /end IF_DATA BIT_MASK 0xFF /end MEASUREMENT
/begin MEASUREMENT ushkjf_w "Gefilterte Spannung Lambdasonde hinter Kat, ohne Offset, DLSSA" UWORD spg_uw_b1p33 0 0 0.000000 1.330000 /begin IF_DATA ASAP1B_ETK KP_BLOB 0x381F82 1 2 /end IF_DATA BIT_MASK 0xFFFF /end MEASUREMENT
/begin MEASUREMENT ushkmxstg "Maximale Steigung der Sondenspannung hinter KAT" UBYTE spgg_q0p52 0 0 0.000000 132.600000 /begin IF_DATA ASAP1B_ETK KP_BLOB 0x380A79 1 1 /end IF_DATA BIT_MASK 0xFF /end MEASUREMENT
/begin MEASUREMENT ushkmxstg2 "Maximale Steigung der Sondenspannung hinter KAT Bank2" UBYTE spgg_q0p52 0 0 0.000000 132.600000 /begin IF_DATA ASAP1B_ETK KP_BLOB 0x380A7A 1 1 /end IF_DATA BIT_MASK 0xFF /end MEASUREMENT
/begin MEASUREMENT ushksteig "Steigung der Sondenspannung hinter KAT" UBYTE spgg_q0p52 0 0 0.000000 132.600000 /begin IF_DATA ASAP1B_ETK KP_BLOB 0x380A7B 1 1 /end IF_DATA BIT_MASK 0xFF /end MEASUREMENT
/begin MEASUREMENT ushksteig2 "Steigung der Sondenspannung hinter KAT Bank2" UBYTE spgg_q0p52 0 0 0.000000 132.600000 /begin IF_DATA ASAP1B_ETK KP_BLOB 0x380A7C 1 1 /end IF_DATA BIT_MASK 0xFF /end MEASUREMENT
/begin MEASUREMENT usmnsaa "minimal erkannter Sondenspannungswert v.K. (alt), DLSSA, Bank 1" UBYTE spg_ub_b1p33 0 0 0.000000 1.330000 /begin IF_DATA ASAP1B_ETK KP_BLOB 0x380B08 1 1 /end IF_DATA BIT_MASK 0xFF /end MEASUREMENT
/begin MEASUREMENT usmnsan "minimal erkannter Sondenspannungswert v.K. (neu), DLSSA" UBYTE spg_ub_b1p33 0 0 0.000000 1.330000 /begin IF_DATA ASAP1B_ETK KP_BLOB 0x383350 1 1 /end IF_DATA BIT_MASK 0xFF /end MEASUREMENT
/begin MEASUREMENT usmnsha "minimal erkannter Sondenspannungswert h.K. (alt), DLSSA, Bank 1" UBYTE spg_ub_b1p33 0 0 0.000000 1.330000 /begin IF_DATA ASAP1B_ETK KP_BLOB 0x380B09 1 1 /end IF_DATA BIT_MASK 0xFF /end MEASUREMENT
/begin MEASUREMENT usmnshn "minimal erkannter Sondenspannungswert h.K. (neu), DLSSA" UBYTE spg_ub_b1p33 0 0 0.000000 1.330000 /begin IF_DATA ASAP1B_ETK KP_BLOB 0x383351 1 1 /end IF_DATA BIT_MASK 0xFF /end MEASUREMENT
/begin MEASUREMENT usmxsaa "maximal erkannter Sondenspannungswert v.K. (alt), DLSSA, Bank1" UBYTE spg_ub_b1p33 0 0 0.000000 1.330000 /begin IF_DATA ASAP1B_ETK KP_BLOB 0x380B0A 1 1 /end IF_DATA BIT_MASK 0xFF /end MEASUREMENT
/begin MEASUREMENT usmxsan "maximal erkannter Sondenspannungswert v.K. (neu), DLSSA" UBYTE spg_ub_b1p33 0 0 0.000000 1.330000 /begin IF_DATA ASAP1B_ETK KP_BLOB 0x383352 1 1 /end IF_DATA BIT_MASK 0xFF /end MEASUREMENT
/begin MEASUREMENT usmxsha "maximal erkannter Sondenspannungswert h.K. (alt), DLSSA, Bank 1" UBYTE spg_ub_b1p33 0 0 0.000000 1.330000 /begin IF_DATA ASAP1B_ETK KP_BLOB 0x380B0B 1 1 /end IF_DATA BIT_MASK 0xFF /end MEASUREMENT
/begin MEASUREMENT usmxshn "maximal erkannter Sondenspannungswert h.K. (neu), DLSSA" UBYTE spg_ub_b1p33 0 0 0.000000 1.330000 /begin IF_DATA ASAP1B_ETK KP_BLOB 0x383353 1 1 /end IF_DATA BIT_MASK 0xFF /end MEASUREMENT
/begin MEASUREMENT usrhk2 "aktuelle Regelschwelle Lambdasignal h.K., Bank 2" UBYTE spg_ub_q0p0052_o0p2 0 0 -0.200000 1.130000 /begin IF_DATA ASAP1B_ETK KP_BLOB 0x380CF1 1 1 /end IF_DATA BIT_MASK 0xFF /end MEASUREMENT
/begin MEASUREMENT usrj "Regelschwelle der Lambdaregelung, ohne Offset, DLSSA" UBYTE spg_ub_b1p33 0 0 0.000000 1.330000 /begin IF_DATA ASAP1B_ETK KP_BLOB 0x380B0C 1 1 /end IF_DATA BIT_MASK 0xFF /end MEASUREMENT
/begin MEASUREMENT usvk "Spannung Lambdasonde vor Kat" UBYTE spg_ub_q0p0052_o0p2 0 0 -0.200000 1.130000 /begin IF_DATA ASAP1B_ETK KP_BLOB 0x380A81 1 1 /end IF_DATA BIT_MASK 0xFF /end MEASUREMENT
/begin MEASUREMENT usvkj "Spannung Lambdasonde vor Kat, ohne Offset, DLSSA" UBYTE spg_ub_b1p33 0 0 0.000000 1.330000 /begin IF_DATA ASAP1B_ETK KP_BLOB 0x380B0D 1 1 /end IF_DATA BIT_MASK 0xFF /end MEASUREMENT
/begin MEASUREMENT usvkjf_w "Gefilterte Spannung Lambdasonde vor Kat, ohne Offset, DLSSA" UWORD spg_uw_b1p33 0 0 0.000000 1.330000 /begin IF_DATA ASAP1B_ETK KP_BLOB 0x381F84 1 2 /end IF_DATA BIT_MASK 0xFFFF /end MEASUREMENT
/begin MEASUREMENT usvk_w "Spannung Lambdasonde (4.88mV/LSB) vor Kat" UWORD spg_uw_q0p00488_o1 0 0 -1.000000 318.995117 /begin IF_DATA ASAP1B_ETK KP_BLOB 0x381BCA 1 2 /end IF_DATA BIT_MASK 0xFFFF /end MEASUREMENT
/begin MEASUREMENT wzcto "ZÑhler Wiederholversuche Close to Open Check" UBYTE dez 0 0 0.000000 255.000000 /begin IF_DATA ASAP1B_ETK KP_BLOB 0x380CD2 1 1 /end IF_DATA BIT_MASK 0xFF /end MEASUREMENT
/begin MEASUREMENT zerdysh "ZÑhler fÅr Error der Dynamikmessungen im Schub" UBYTE dez 0 0 0.000000 255.000000 /begin IF_DATA ASAP1B_ETK KP_BLOB 0x380A7D 1 1 /end IF_DATA BIT_MASK 0xFF /end MEASUREMENT
/begin MEASUREMENT zerdysh2 "ZÑhler fÅr Error der Dynamikmessungen im Schub Bank2" UBYTE dez 0 0 0.000000 255.000000 /begin IF_DATA ASAP1B_ETK KP_BLOB 0x380A7E 1 1 /end IF_DATA BIT_MASK 0xFF /end MEASUREMENT
/begin MEASUREMENT zerlatp "ZÑhler fÅr Errormessungen der Periodendauer" UBYTE dez 0 0 0.000000 255.000000 /begin IF_DATA ASAP1B_ETK KP_BLOB 0x380AA2 1 1 /end IF_DATA BIT_MASK 0xFF /end MEASUREMENT
/begin MEASUREMENT zerlatp2 "ZÑhler fÅr Errormessungen der Periodendauer Bank2" UBYTE dez 0 0 0.000000 255.000000 /begin IF_DATA ASAP1B_ETK KP_BLOB 0x380AA3 1 1 /end IF_DATA BIT_MASK 0xFF /end MEASUREMENT
/begin MEASUREMENT zerlatv "ZÑhler fÅr Error der atv-Messungen" UBYTE dez 0 0 0.000000 255.000000 /begin IF_DATA ASAP1B_ETK KP_BLOB 0x380AA4 1 1 /end IF_DATA BIT_MASK 0xFF /end MEASUREMENT
/begin MEASUREMENT zerlatv2 "ZÑhler fÅr Error der atv-Messungen Bank2" UBYTE dez 0 0 0.000000 255.000000 /begin IF_DATA ASAP1B_ETK KP_BLOB 0x380AA5 1 1 /end IF_DATA BIT_MASK 0xFF /end MEASUREMENT
/begin MEASUREMENT zersch "ZÑhler fÅr Errormessungen (Sondenspg. Schwelle nicht unterschritten) im Schub" UBYTE dez 0 0 0.000000 255.000000 /begin IF_DATA ASAP1B_ETK KP_BLOB 0x380A7F 1 1 /end IF_DATA BIT_MASK 0xFF /end MEASUREMENT
/begin MEASUREMENT zersch2 "ZÑhler fÅr Errormessungen (Sondenspg. Schwelle nicht unterschr.) im Schub Bank2" UBYTE dez 0 0 0.000000 255.000000 /begin IF_DATA ASAP1B_ETK KP_BLOB 0x380A80 1 1 /end IF_DATA BIT_MASK 0xFF /end MEASUREMENT
/begin MEASUREMENT zlash2_w "ZeitzÑhler fÅr Sondenspannung hinter KAT ober/unterhalb des Sollwertes" UWORD t100msxs_uw_b6553p5 0 0 0.000000 6553.500000 /begin IF_DATA ASAP1B_ETK KP_BLOB 0x381B92 1 2 /end IF_DATA BIT_MASK 0xFFFF /end MEASUREMENT
/begin MEASUREMENT zlash_w "ZeitzÑhler fÅr Sondenspannung hinter KAT ober/unterhalb des Sollwertes" UWORD t100msxs_uw_b6553p5 0 0 0.000000 6553.500000 /begin IF_DATA ASAP1B_ETK KP_BLOB 0x381B94 1 2 /end IF_DATA BIT_MASK 0xFFFF /end MEASUREMENT
/begin MEASUREMENT zlsatp "aktueller PeriodenzÑhler fÅr Ready-Flag der PeriodendauerÅberwachung" UBYTE dez 0 0 0.000000 255.000000 /begin IF_DATA ASAP1B_ETK KP_BLOB 0x380AA6 1 1 /end IF_DATA BIT_MASK 0xFF /end MEASUREMENT
/begin MEASUREMENT zlsatp2 "aktueller PeriodenzÑhler fÅr Ready-Flag der PeriodendauerÅberwachung, Bank2" UBYTE dez 0 0 0.000000 255.000000 /begin IF_DATA ASAP1B_ETK KP_BLOB 0x380AA7 1 1 /end IF_DATA BIT_MASK 0xFF /end MEASUREMENT
/begin MEASUREMENT zwdynsh "ZÑhler fÅr Anzahl der Dynamikmessungen fÅr Sonde hinter KAT" UBYTE dez 0 0 0.000000 255.000000 /begin IF_DATA ASAP1B_ETK KP_BLOB 0x380A76 1 1 /end IF_DATA BIT_MASK 0xFF /end MEASUREMENT
/begin MEASUREMENT zwdynsh2 "ZÑhler fÅr Anzahl der Dynamikmessungen fÅr Sonde hinter KAT Bank2" UBYTE dez 0 0 0.000000 255.000000 /begin IF_DATA ASAP1B_ETK KP_BLOB 0x380A77 1 1 /end IF_DATA BIT_MASK 0xFF /end MEASUREMENT
/begin MEASUREMENT zwgeflr "ZÑhlerwert Gemischfehler" UBYTE dez 0 0 0.000000 255.000000 /begin IF_DATA ASAP1B_ETK KP_BLOB 0x38333F 1 1 /end IF_DATA BIT_MASK 0xFF /end MEASUREMENT
/begin MEASUREMENT zwpvk "Warteperiodenzaehler Periodendauerueberwachung" UBYTE dez 0 0 0.000000 255.000000 /begin IF_DATA ASAP1B_ETK KP_BLOB 0x380AA8 1 1 /end IF_DATA BIT_MASK 0xFF /end MEASUREMENT
/begin MEASUREMENT zwpvk2 "Warteperiodenzaehler Periodendauerueberwachung, Bank 2" UBYTE dez 0 0 0.000000 255.000000 /begin IF_DATA ASAP1B_ETK KP_BLOB 0x380AA9 1 1 /end IF_DATA BIT_MASK 0xFF /end MEASUREMENT
/begin FUNCTION DKVS "17.60     Diagnose; PlausibilitÑtsprÅfung Kraftstoffversorgungssysteme"
 /begin REF_CHARACTERISTIC ZFRMST TRKAZZ TRKATZ TRKA TFRMZST TFRMST TFRAUZ TFRAOZ TFRA RKAZDX RKAZDN RKATDX RKATDN RKAE MLDKVSG MLDKVSF IMLKVSMX FRMSTDX FRMSTDN FRAUDX FRAUDN FRAODX FRAODN FRAE DFRMST CPLRA /end REF_CHARACTERISTIC
 /begin LOC_MEASUREMENT rkaz_w rkat_w rkam_w rkamzs_w ml imlkvs_w imlkvszs_w GGFSTbits frm_w frau_w frauzs_w frao_w DKVSbits cd_bits1_w B_te B_talval B_tal B_sa B_rkazr B_rkaz B_rkatr B_rkat B_rkamr B_rkam B_pwf B_plra B_norkaz B_norkat B_norkam B_nofra B_lrare B_lra B_lr B_kvsffl B_imlkvse B_gaeing2 B_gaeing B_gaefra2 B_gaefra B_gae B_frste B_fraur B_frau B_frao B_fakvs B_fa B_erkaz B_erkat B_efrau B_efrao B_edkvs B_dkvstr B_dkvsfm B_dkvsf B_cdkvs /end LOC_MEASUREMENT
/end FUNCTION
/begin FUNCTION DLDE "7.10      Diagnose LDR-Endstufe" /begin LOC_MEASUREMENT ldtvm B_desee /end LOC_MEASUREMENT /end FUNCTION
/begin FUNCTION DLDP "17.100    OBD II, TankentlÅftungsdiagnosemodul"
 /begin REF_CHARACTERISTIC ZRLBAB WZLDPRO WZLDPMX VLDPMN VALDPMN TVTEVMN TVLDPT TVLDPMN TVFZDIF TTOTLDP TSTZUMN TSRFPAB TRKAUF TPUPH TPTEVMN TMLDPU TMLDPO TLDPZMN TLDPSMN TLDPRKO TLDPRKL TLDPMX TLDPMN TLDP2SD TLDP1SD TIZUMN TISPMN TEVCKMX TC6LDPC4 TC6LDPC3 TC6LDPC2 TC6LDPC TALDPU TALDPO TAFLDPO SVF06D_UB RLLDPMX RLBABMX RL5GV RL4GV RL3GV RL2GV RL1GV KFGLTA KFFLTA HLDPU FPUPT DVFZBAB DTPLDP DTMLDP DPUFVSMN DPUFVMN DPUBABMX DKTLMT DKLDPN CWBAESEL CLDPTVC CLDPAAV /end REF_CHARACTERISTIC
 /begin LOC_MEASUREMENT wzcto wdkba vfzg tvfzctr trklow tpldptc_w tpldptcx_w tpfifo_3_A tpfifo_2_A tpfifo_1_A tpfifo_0_A tmotab tmot tldppmw tldpein tldktim tispuel tispldp_w tispldpx_w timzldp timtev timrs timldp timfp timaldp tfpg tdaufp tc6ldpw tc6ldps tc6ldpc tateout tans stptr rsmcnt rl_w rlf rlbab rl pu_w pumem_w pukor_w ps_w nmot modeldp_old modeldp gangi fvdldp fpuls fpper fppcnt flgdldp2 flgdldp fho esst_svf06d_ub dvbab dtmast dpu_w cd_bits1_w B_teza B_teviot B_tevioi B_tepldp B_tep B_tef B_stend B_st B_rkzck B_rkcke B_rkack B_pwf B_puerr B_messe B_m8te B_lrar B_ldpi B_ldpglv B_ldpflv B_ldpf6 B_ldpf5 B_ldpf2 B_ldpf1 B_ldpabb B_ldp B_ispuel B_fpchk B_fev9 B_fev8 B_fev7 B_fev6 B_fev5 B_fev4 B_fev3 B_fev2 B_fev12 B_fev11 B_fev10 B_fev1 B_faldpa B_faldp B_fa B_extaav B_errldp B_dteven B_dtes B_dpumn B_dldpte B_dldpf B_dldp B_cdldp B_bergab B_aav /end LOC_MEASUREMENT
/end FUNCTION
/begin FUNCTION DLDPE "5.40      Endstufendiagnose; öberdruckpumpe der Tank-Leck-Diagnose"
 /begin REF_CHARACTERISTIC ZKDXLDPE ULDPEMX ULDPEMN UBDULDPE UBDOLDPE TWLDPE TWDLDPE TDLDPE /end REF_CHARACTERISTIC
 /begin LOC_MEASUREMENT uldpe ub B_stend B_sild B_nmot B_mxld B_mnld B_ldpelok B_ldpe B_ldp B_kl15 /end LOC_MEASUREMENT
/end FUNCTION
/begin FUNCTION DLDR "2.70      Diagnose LDR"
 /begin REF_CHARACTERISTIC TVLDMX TULV3 TULV1 TLDRA TDLDRA2 TDLDRA SDLDRL NDLDRAPU KFVPDKLD KFDLULS EDLDRP DLUL /end REF_CHARACTERISTIC
 /begin LOC_MEASUREMENT wdkba rl_w pu pspvds_w plsol nmot lditv_w lde B_mxaok B_ldra B_ldr B_ldob B_erl /end LOC_MEASUREMENT
/end FUNCTION
/begin FUNCTION DLDUVSE "2.10      Diagnose Endstufe Umluftventil Turbo" /begin LOC_MEASUREMENT B_ldsua B_desee /end LOC_MEASUREMENT /end FUNCTION
/begin FUNCTION DLLR "30.10     Diagnose: Leerlaufregelung Erkennung blockierter Steller"
 /begin REF_CHARACTERISTIC TMDLLR TFDLLRU TFDLLRO TDLLRNF TDLLRMX TDLLRMN TDLLR TADLLR RLDLLR FHDLLR DNDLLRU DNDLLRO DASA /end REF_CHARACTERISTIC
 /begin LOC_MEASUREMENT vfzg tnse_w tmot tans rl limin_w limax_w fho dns dmllri_w cd_bits2_w B_tehb B_st B_sa B_nswo1 B_nollrflr B_nmot B_llr B_lldia B_ll B_dtes B_dsls B_dllra B_dllr B_dkpu B_dknolu B_cdllr /end LOC_MEASUREMENT
/end FUNCTION
/begin FUNCTION DLSA "44.10     LambdasondenalterungsÅberwachung, OBDII"
 /begin REF_CHARACTERISTIC ZFTSVK TWDDTV TVLRHMX2 TVLRHMX TVLRHMN2 TVLRHMN TSVKU TSVKO TSVKKTU TSVKKTO TSTEAA TKTPVK RLTPVKU RLTPVKO RLTPKTU RLTPKTO NTPVKU NTPVKO NTPKTU NTPKTO KFTPKOR CWDLSA CIDTP2 CIDTP CIDATV2 CIDATV ANZTP ANZERTV ANZERTP ANZDPVK /end REF_CHARACTERISTIC
 /begin LOC_MEASUREMENT zwpvk2 zwpvk zlsatp2 zlsatp zerlatv2 zerlatv zerlatp2 zerlatp tzlsatv_w tzlsatv2_w tpsvkof_w tpsvkof2_w tpsvkmf_w tpsvkmf2_w tpotv_w tpotv2_w tplrvk_w tplrvk2_w tfrp_w tfrp2_w tfrn_w tfrn2_w tabgm rl nmot m6wtp_w m6wtp2_w m6watv2 m6watv m6stp_w m6stp2_w m6satv2 m6satv m6ctp2 m6ctp m6catv2 m6catv cd_bits2_w B_twdtv2 B_twdtv B_tehb B_te B_nolatv2 B_nolatv B_nolatp2 B_nolatp B_minlatv2 B_minlatv B_minlatp2 B_minlatp B_mdarv B_maxlatv2 B_maxlatv B_maxlatp2 B_maxlatp B_lsastp2 B_lsastp B_lrtpp2 B_lrtpp B_lrhk2 B_lrhk B_lr2 B_lr B_gasp B_fatv2 B_fatv B_fatp2 B_fatp B_fa B_enws B_edkvs B_dtest B_dsls B_dlatv2 B_dlatv B_dlatp2 B_dlatp B_dlaff2 B_dlaff B_distv2 B_distv B_distp2 B_distp B_cdlatv B_cdlatp B_anztp2 B_anztp atv2 atv /end LOC_MEASUREMENT
/end FUNCTION
/begin FUNCTION DLSAHK "6.50      LambdasondenalterungsÅberwachung hinter KAT"
 /begin REF_CHARACTERISTIC USSCHUB USHSTSOLL USHSTGMX USHRICH USHLEAN TUSSA TUSLASH TUSHSMIN TUSENLASH TUSCHUB TTLASH TSALASH TRIPFASH TLLASH TFRMB TABGSTG SMLDYN MLUSTEST MLUSSTG MLOSTEST MLLASH KMXSTG FRMLASHU FRMLASHO DMRLASH DLAMLASHM DLAMLASHF CWDLSAHK CIDSHKM2 CIDSHKM CIDSHKF2 CIDSHKF CIDLSDY2 CIDLSDY CIDLSCH2 CIDLSCH ANZERSCH ANZERDYH ANZDYNSH /end REF_CHARACTERISTIC
 /begin LOC_MEASUREMENT zwdynsh2 zwdynsh zlash_w zlash2_w zersch2 zersch zerdysh2 zerdysh usrhk2 usrhk ushksteig2 ushksteig ushkmxstg2 ushkmxstg ushk2 ushk ushfmxstg2 ushfmxstg tkatm NovBits ml_w mldyn_w m6wshkm2 m6wshkm m6wshkf2 m6wshkf m6wlsdy2 m6wlsdy m6wlsch2 m6wlsch m6sshkm2 m6sshkm m6sshkf2 m6sshkf m6slsdy2 m6slsdy m6slsch2 m6slsch m6cshkm2 m6cshkm m6cshkf2 m6cshkf m6clsdy2 m6clsdy m6clsch2 m6clsch LokBits1 lamsons_w lamlash_w lamlash2_w lamfrm_w lamfrm2_w frm_w frmtrip_w frmtrip2_w frm2_w dmrlash_w cd_bits2_w B_ushsch2 B_ushsch B_ushkm2 B_ushkm B_ushkf2 B_ushkf B_trfash2 B_trfash B_teslash2 B_teslash B_tehb B_steigm2 B_steigm B_sbbhk B_sa B_pwf B_nolash2 B_nolash B_nesch2 B_nesch B_ndylash2 B_ndylash B_mlustest B_mldyn B_minlash2 B_minlash B_mdarv B_maxlash2 B_maxlash B_lsahksp2 B_lsahksp B_lrhk2 B_lrhk B_lr2 B_lr B_lamverg2 B_lamverg B_lamlash2 B_lamlash B_lamend2 B_lamend B_gaeing2 B_gaeing B_frmlash2 B_frmlash B_fash2 B_fash B_fa B_evloc B_entest2 B_entest B_enlash2 B_enlash B_enfmst2 B_enfmst B_edkvs B_dylash2 B_dylash B_dushsch2 B_dushsch B_dtest B_dsls B_dshk2 B_dshk B_dlash2 B_dlash B_disch2 B_disch B_didysch2 B_didysch B_ddylash2 B_ddylash B_cwlshsch B_cwlshdyn B_cdlash B_abgstg2 B_abgstg /end LOC_MEASUREMENT
/end FUNCTION
/begin FUNCTION DLSH "26.30     Diagnose; Sondenbetriebsbereitschaft hinter Kat"
 /begin REF_CHARACTERISTIC USREMH USREFH USMIN USMAX UBDLS TUSTAL TUSMAX TUSKS TUSEINH TUSDUH TUSDUFA TTBMH TRSE TRSAH TRSAFA TASIG TABGMCSD RISIGRESH DRISIGH DMRLSH DLAMELSH ABGMSIGH /end REF_CHARACTERISTIC
 /begin LOC_MEASUREMENT ushk_w ub tkatm rinh_w lamsons_w lamelsh_w dmrlsh_w DLSHintbits DLSHerrors DLSHbits cd_bits1_w B_uhsig B_ueinh B_ttbmhh B_trsah B_talval B_tal B_sls B_sigflsh B_sbbhk B_risigh B_pwf B_nplflsh B_nolsh B_nmot B_minflsh B_maxflsh B_lrhk B_hshe B_falsh B_fa B_esls B_dtes B_dsls B_dshen B_cdlsh B_atmtpk B_adshs B_adsh B_acsdh /end LOC_MEASUREMENT
/end FUNCTION
/begin FUNCTION DLSSA "14.60     Signalausgabe Lambdasonden"
 /begin REF_CHARACTERISTIC USRHKSHJ USR USMXSHMX USMXSHMN USMXSAMX USMXSAMN USMNSHMX USMNSHMN USMNSAMX USMNSAMN TWDLSSA TUSPNMX TUSPNMN TPSVKMX TPSVKMN SAFK2 SAFK1 ATVMAGU ATVMAGO ATVFETTU ATVFETTO /end REF_CHARACTERISTIC
 /begin LOC_MEASUREMENT usvkjf_w usvkj usvk usrj usmxshn usmxsha usmxsan usmxsaa usmnshn usmnsha usmnsan usmnsaa ushkjf_w ushkj ushk twdlssh_w twdlssa_w tuspnf tpsvlssa tpsvkmf_w tfrn_w dlssabits B_tusre B_tuspn B_pwf B_lrtpp B_lrhk B_dlatp atvmager atvfett atv /end LOC_MEASUREMENT
/end FUNCTION
/begin FUNCTION DLSV "32.30     Diagnose; Sondenbetriebsbereitschaft vor Kat"
 /begin REF_CHARACTERISTIC USREM USREF USMIN USMHK USMAX USMASO USFHK USDBU USDBO UBDLS TUSMAX TUSKS TUSFETT TUSEINV TUSDUC TUSDU TTBMH TRSE TRSA TNSTDN TMSVA TMSV TMNEB TMASO TASIG TABGMCSD RISIGRESV DRISIGV ANZGEM ABGMSIGV /end REF_CHARACTERISTIC
 /begin LOC_MEASUREMENT zwgeflr usvk_w ushk_w ub tmotab tmot tabgm rinv_w lamsons_w DLSVintbits DLSVerrors DLSVbits cd_bits1_w B_vgeflr B_vadge B_uvsig B_ueinv B_ttbmh B_trsa B_st B_sls B_sigflsv B_sbbvk B_sa B_risigv B_refmax B_pwf B_nplflsv B_nolsv B_nmot B_minflsv B_maxflsv B_maso B_lsvn B_lsvklt B_lshub B_lsfet B_lsafkn B_lsads B_lr B_hsve B_esls B_dtes B_dsven B_dsls B_dmaso B_cdlsv B_cdlsh B_atmtpa B_adsvb B_adde B_adcsd /end LOC_MEASUREMENT
/end FUNCTION
/begin FUNCTION DMDDLU "7.20      Diagnose Misfire Detection Differenzbildung der Laufunruhe"
 /begin REF_CHARACTERISTIC SRL08DMUB SNM08DMUB NMIDLU KFDLUR_1_A KFDLUR_0_A KFDLURZ KFDLUR2 KFDLUR1 DMXRDL DLURMIN /end REF_CHARACTERISTIC
 /begin LOC_MEASUREMENT rl nmot flg_m fdmd_m esst_srl08dmub esst_snm08dmub dluts_m dluts8 dluts7 dluts6 dluts5 dluts4 dluts3 dluts2 dluts1 dluts dlurs_m dlurs B_dluerk_m /end LOC_MEASUREMENT
/end FUNCTION
/end MODULE
/end PROJECT
