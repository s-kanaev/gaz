ASAP2_VERSION 1 21
/begin PROJECT Pro4017 "R4 1.8l 5V T lÑngs FR5ROM F5051"
/begin HEADER "" PROJECT_NO Pro4017 VERSION "PrV = F21dc mit 00" /end HEADER
/begin MODULE DIM " "
/begin MOD_COMMON " " S_REC_LAYOUT ME7 BYTE_ORDER MSB_LAST /end MOD_COMMON
/begin COMPU_METHOD B_TRUE "boolsche ZustÑnde, positive Logik" TAB_VERB "%6.3" "" COMPU_TAB_REF B_TRUE /end COMPU_METHOD
/begin COMPU_METHOD B_TRUE___UW "boolsche ZustÑnde, positive Logik" TAB_VERB "%6.3" "" COMPU_TAB_REF B_TRUE /end COMPU_METHOD
/begin COMPU_METHOD dez "1 : 1 Umrechnug (dez/hex)" RAT_FUNC "%6.2" "" COEFFS 0 1.000000 0.000000 0 0.000000 1.000000 /end COMPU_METHOD
/begin COMPU_METHOD dez___UW "1 : 1 Umrechnug (dez/hex)" RAT_FUNC "%6.2" "" COEFFS 0 1.000000 0.000000 0 0.000000 1.000000 /end COMPU_METHOD
/begin COMPU_METHOD dtsegno_b11p25divZyl "" RAT_FUNC "%6.5" "grad/KW" COEFFS 0 45.511100 128.000000 0 0.000000 1.000000 /end COMPU_METHOD
/begin COMPU_METHOD dtsegn_b11p25divZyl "" RAT_FUNC "%6.4" "grad/KW" COEFFS 0 45.511100 0.000000 0 0.000000 1.000000 /end COMPU_METHOD
/begin COMPU_METHOD dtsegn_b720divZyl "" RAT_FUNC "%6.4" "grad/KW" COEFFS 0 182.044000 0.000000 0 0.000000 1.000000 /end COMPU_METHOD
/begin COMPU_METHOD dtsegn_b720divZylP5 "" RAT_FUNC "%6.1" "grad/KW" COEFFS 0 182.044000 3.276800e+04 0 0.000000 1.000000 /end COMPU_METHOD
/begin COMPU_METHOD dtsegn_b720divZyl___UW "" RAT_FUNC "%6.4" "grad/KW" COEFFS 0 182.044000 0.000000 0 0.000000 1.000000 /end COMPU_METHOD
/begin COMPU_METHOD fak_ub_b1 "" RAT_FUNC "%6.4" "-" COEFFS 0 256.000000 0.000000 0 0.000000 1.000000 /end COMPU_METHOD
/begin COMPU_METHOD luquant "Umrechnung Laufunruhe in DMD" RAT_FUNC "%6.3" "(Umdr./sec)^2" COEFFS 0 1.583300 0.000000 0 0.000000 1.000000 /end COMPU_METHOD
/begin COMPU_METHOD luquant___UB "Umrechnung Laufunruhe in DMD" RAT_FUNC "%6.3" "(Umdr./sec)^2" COEFFS 0 1.583300 0.000000 0 0.000000 1.000000 /end COMPU_METHOD
/begin COMPU_METHOD luquant_w "Umrechnung Laufunruhe Word-Grî·en in DMD" RAT_FUNC "%6.4" "(Umdr./sec)^2" COEFFS 0 405.324000 0.000000 0 0.000000 1.000000 /end COMPU_METHOD
/begin COMPU_METHOD nmot_ub_q40 "" RAT_FUNC "%6.1" "Upm" COEFFS 0 1.000000 0.000000 0 0.000000 40.000000 /end COMPU_METHOD
/begin COMPU_METHOD rel_ub_q0p75 "" RAT_FUNC "%6.3" "%" COEFFS 0 1.000000 0.000000 0 0.000000 7.500000e-01 /end COMPU_METHOD
/begin COMPU_METHOD temp_ub_q0p75_o48 "" RAT_FUNC "%6.2" "Grad C" COEFFS 0 1.000000 48.000000 0 0.000000 7.500000e-01 /end COMPU_METHOD
/begin COMPU_METHOD tsquant "Umrechnung Segmentzeit in DMD" RAT_FUNC "%6.2" "us" COEFFS 0 8.333330e-01 0.000000 0 0.000000 1.000000 /end COMPU_METHOD
/begin COMPU_METHOD vfzg_ub_q1p25___UB "" RAT_FUNC "%6.2" "km/h" COEFFS 0 1.000000 0.000000 0 0.000000 1.250000 /end COMPU_METHOD
/begin COMPU_VTAB B_TRUE "" TAB_VERB 2 0 "----" 1 "TRUE" /end COMPU_VTAB
/begin MEASUREMENT tmot "Motor-Temperatur" UBYTE temp_ub_q0p75_o48 0 0 -48.000000 143.250000 /begin IF_DATA ASAP1B_ETK KP_BLOB 0x380B61 1 1 /end IF_DATA BIT_MASK 0xFF /end MEASUREMENT
/begin MEASUREMENT rl "relative LuftfÅllung" UBYTE rel_ub_q0p75 0 0 0.000000 191.250000 /begin IF_DATA ASAP1B_ETK KP_BLOB 0xF997 0 1 /end IF_DATA BIT_MASK 0xFF /end MEASUREMENT
/begin MEASUREMENT nmot "Motordrehzahl" UBYTE nmot_ub_q40 0 0 0.000000 10200.000000 /begin IF_DATA ASAP1B_ETK KP_BLOB 0xF876 0 1 /end IF_DATA BIT_MASK 0xFF /end MEASUREMENT
/begin MEASUREMENT vfzg "Fahrzeuggeschwindigkeit" UBYTE vfzg_ub_q1p25___UB 0 0 0.000000 318.750000 /begin IF_DATA ASAP1B_ETK KP_BLOB 0x380982 1 1 /end IF_DATA BIT_MASK 0xFF /end MEASUREMENT
/begin MEASUREMENT anwfoh "zÑhlt Anzahl der NW-Umdr. fÅr Heilung der fuel-on/-off Adaption" UBYTE dez 0 0 0.000000 255.000000 /begin IF_DATA ASAP1B_ETK KP_BLOB 0x380A0F 1 1 /end IF_DATA BIT_MASK 0xFF /end MEASUREMENT
/begin MEASUREMENT anwfos "zÑhlt Anzahl der NW-Umdr. von Bedingungen fÅr Adaption erfÅllt bis Lernbeginn" UBYTE dez 0 0 0.000000 255.000000 /begin IF_DATA ASAP1B_ETK KP_BLOB 0x380A0E 1 1 /end IF_DATA BIT_MASK 0xFF /end MEASUREMENT
/begin MEASUREMENT B_analu_m "Monitor, Ausblendung nach dem ersten erkannten Aussetzer" UBYTE B_TRUE 0 0 0.000000 0.000000 /begin IF_DATA ASAP1B_ETK KP_BLOB 0xE3DB 0 1 /end IF_DATA BIT_MASK 0x4 /end MEASUREMENT
/begin MEASUREMENT B_autget "Bedingung Automatikgetriebe" UWORD B_TRUE___UW 0 0 0.000000 0.000000 /begin IF_DATA ASAP1B_ETK KP_BLOB 0xFD00 0 2 /end IF_DATA BIT_MASK 0x8 /end MEASUREMENT
/begin MEASUREMENT B_cdmd "Funktion Åber Codewort CDMD freigegeben" UWORD B_TRUE___UW 0 0 0.000000 0.000000 /begin IF_DATA ASAP1B_ETK KP_BLOB 0x380D30 1 2 /end IF_DATA BIT_MASK 0x1 /end MEASUREMENT
/begin MEASUREMENT B_dmd_reset "" UWORD B_TRUE___UW 0 0 0.000000 0.000000 /begin IF_DATA ASAP1B_ETK KP_BLOB 0xFDAE 0 2 /end IF_DATA BIT_MASK 0x10 /end MEASUREMENT
/begin MEASUREMENT B_fodo "Bedingung fuel-on/-off adaption in dominantem Bereich aktiv" UBYTE B_TRUE 0 0 0.000000 0.000000 /begin IF_DATA ASAP1B_ETK KP_BLOB 0x38324D 1 1 /end IF_DATA BIT_MASK 0x2 /end MEASUREMENT
/begin MEASUREMENT B_fodon "Bedingung fuel-on Adaption in drehzahldominantem Bereich aktiv" UBYTE B_TRUE 0 0 0.000000 0.000000 /begin IF_DATA ASAP1B_ETK KP_BLOB 0x38324D 1 1 /end IF_DATA BIT_MASK 0x8 /end MEASUREMENT
/begin MEASUREMENT B_fof_m "Monitor, Bedingung fuel-off Adaption aktiv" UBYTE B_TRUE 0 0 0.000000 0.000000 /begin IF_DATA ASAP1B_ETK KP_BLOB 0xE3F8 0 1 /end IF_DATA BIT_MASK 0x40 /end MEASUREMENT
/begin MEASUREMENT B_fohe "aktueller Bereich ist ein Heilbereich" UBYTE B_TRUE 0 0 0.000000 0.000000 /begin IF_DATA ASAP1B_ETK KP_BLOB 0x38324D 1 1 /end IF_DATA BIT_MASK 0x80 /end MEASUREMENT
/begin MEASUREMENT B_fohold "fuel-on Adaption angehalten" UBYTE B_TRUE 0 0 0.000000 0.000000 /begin IF_DATA ASAP1B_ETK KP_BLOB 0x38324E 1 1 /end IF_DATA BIT_MASK 0x4 /end MEASUREMENT
/begin MEASUREMENT B_fontm "Motortemperatur genÅgend hoch fÅr fuel-on-Adaption" UWORD B_TRUE___UW 0 0 0.000000 0.000000 /begin IF_DATA ASAP1B_ETK KP_BLOB 0xFDAA 0 2 /end IF_DATA BIT_MASK 0x20 /end MEASUREMENT
/begin MEASUREMENT B_fon_m "Monitor, Bedingung fuel-on Adaption aktiv" UBYTE B_TRUE 0 0 0.000000 0.000000 /begin IF_DATA ASAP1B_ETK KP_BLOB 0xE3F8 0 1 /end IF_DATA BIT_MASK 0x1 /end MEASUREMENT
/begin MEASUREMENT B_for11 "KF-Bereich 11 fertig gelernt (ready)" UBYTE B_TRUE 0 0 0.000000 0.000000 /begin IF_DATA ASAP1B_ETK KP_BLOB 0x383251 1 1 /end IF_DATA BIT_MASK 0x1 /end MEASUREMENT
/begin MEASUREMENT B_for12 "KF-Bereich 12 fertig gelernt (ready)" UBYTE B_TRUE 0 0 0.000000 0.000000 /begin IF_DATA ASAP1B_ETK KP_BLOB 0x383252 1 1 /end IF_DATA BIT_MASK 0x1 /end MEASUREMENT
/begin MEASUREMENT B_for13 "KF-Bereich 13 fertig gelernt (ready)" UBYTE B_TRUE 0 0 0.000000 0.000000 /begin IF_DATA ASAP1B_ETK KP_BLOB 0x383253 1 1 /end IF_DATA BIT_MASK 0x1 /end MEASUREMENT
/begin MEASUREMENT B_for21 "KF-Bereich 21 fertig gelernt (ready)" UBYTE B_TRUE 0 0 0.000000 0.000000 /begin IF_DATA ASAP1B_ETK KP_BLOB 0x383251 1 1 /end IF_DATA BIT_MASK 0x2 /end MEASUREMENT
/begin MEASUREMENT B_for22 "KF-Bereich 22 fertig gelernt (ready)" UBYTE B_TRUE 0 0 0.000000 0.000000 /begin IF_DATA ASAP1B_ETK KP_BLOB 0x383252 1 1 /end IF_DATA BIT_MASK 0x2 /end MEASUREMENT
/begin MEASUREMENT B_for23 "KF-Bereich 23 fertig gelernt (ready)" UBYTE B_TRUE 0 0 0.000000 0.000000 /begin IF_DATA ASAP1B_ETK KP_BLOB 0x383253 1 1 /end IF_DATA BIT_MASK 0x2 /end MEASUREMENT
/begin MEASUREMENT B_for31 "KF-Bereich 31 fertig gelernt" UBYTE B_TRUE 0 0 0.000000 0.000000 /begin IF_DATA ASAP1B_ETK KP_BLOB 0x383251 1 1 /end IF_DATA BIT_MASK 0x4 /end MEASUREMENT
/begin MEASUREMENT B_for32 "KF-Bereich 32 fertig gelernt" UBYTE B_TRUE 0 0 0.000000 0.000000 /begin IF_DATA ASAP1B_ETK KP_BLOB 0x383252 1 1 /end IF_DATA BIT_MASK 0x4 /end MEASUREMENT
/begin MEASUREMENT B_for33 "KF-Bereich 33 fertig gelernt" UBYTE B_TRUE 0 0 0.000000 0.000000 /begin IF_DATA ASAP1B_ETK KP_BLOB 0x383253 1 1 /end IF_DATA BIT_MASK 0x4 /end MEASUREMENT
/begin MEASUREMENT B_for41 "KF-Bereich 41 fertig gelernt" UBYTE B_TRUE 0 0 0.000000 0.000000 /begin IF_DATA ASAP1B_ETK KP_BLOB 0x383251 1 1 /end IF_DATA BIT_MASK 0x8 /end MEASUREMENT
/begin MEASUREMENT B_for42 "KF-Bereich 42 fertig gelernt" UBYTE B_TRUE 0 0 0.000000 0.000000 /begin IF_DATA ASAP1B_ETK KP_BLOB 0x383252 1 1 /end IF_DATA BIT_MASK 0x8 /end MEASUREMENT
/begin MEASUREMENT B_for43 "KF-Bereich 43 fertig gelernt" UBYTE B_TRUE 0 0 0.000000 0.000000 /begin IF_DATA ASAP1B_ETK KP_BLOB 0x383253 1 1 /end IF_DATA BIT_MASK 0x8 /end MEASUREMENT
/begin MEASUREMENT B_for51 "KF-Bereich 51 fertig gelernt" UBYTE B_TRUE 0 0 0.000000 0.000000 /begin IF_DATA ASAP1B_ETK KP_BLOB 0x383251 1 1 /end IF_DATA BIT_MASK 0x10 /end MEASUREMENT
/begin MEASUREMENT B_for52 "KF-Bereich 52 fertig gelernt" UBYTE B_TRUE 0 0 0.000000 0.000000 /begin IF_DATA ASAP1B_ETK KP_BLOB 0x383252 1 1 /end IF_DATA BIT_MASK 0x10 /end MEASUREMENT
/begin MEASUREMENT B_for53 "KF-Bereich 53 fertig gelernt" UBYTE B_TRUE 0 0 0.000000 0.000000 /begin IF_DATA ASAP1B_ETK KP_BLOB 0x383253 1 1 /end IF_DATA BIT_MASK 0x10 /end MEASUREMENT
/begin MEASUREMENT B_for61 "KF-Bereich 61 fertig gelernt" UBYTE B_TRUE 0 0 0.000000 0.000000 /begin IF_DATA ASAP1B_ETK KP_BLOB 0x383251 1 1 /end IF_DATA BIT_MASK 0x20 /end MEASUREMENT
/begin MEASUREMENT B_for62 "KF-Bereich 62 fertig gelernt" UBYTE B_TRUE 0 0 0.000000 0.000000 /begin IF_DATA ASAP1B_ETK KP_BLOB 0x383252 1 1 /end IF_DATA BIT_MASK 0x20 /end MEASUREMENT
/begin MEASUREMENT B_for63 "KF-Bereich 63 fertig gelernt" UBYTE B_TRUE 0 0 0.000000 0.000000 /begin IF_DATA ASAP1B_ETK KP_BLOB 0x383253 1 1 /end IF_DATA BIT_MASK 0x20 /end MEASUREMENT
/begin MEASUREMENT B_for71 "KF-Bereich 71 fertig gelernt" UBYTE B_TRUE 0 0 0.000000 0.000000 /begin IF_DATA ASAP1B_ETK KP_BLOB 0x383251 1 1 /end IF_DATA BIT_MASK 0x40 /end MEASUREMENT
/begin MEASUREMENT B_for72 "KF-Bereich 72 fertig gelernt" UBYTE B_TRUE 0 0 0.000000 0.000000 /begin IF_DATA ASAP1B_ETK KP_BLOB 0x383252 1 1 /end IF_DATA BIT_MASK 0x40 /end MEASUREMENT
/begin MEASUREMENT B_for73 "KF-Bereich 73 fertig gelernt" UBYTE B_TRUE 0 0 0.000000 0.000000 /begin IF_DATA ASAP1B_ETK KP_BLOB 0x383253 1 1 /end IF_DATA BIT_MASK 0x40 /end MEASUREMENT
/begin MEASUREMENT B_for81 "KF-Bereich 81 fertig gelernt" UBYTE B_TRUE 0 0 0.000000 0.000000 /begin IF_DATA ASAP1B_ETK KP_BLOB 0x383251 1 1 /end IF_DATA BIT_MASK 0x80 /end MEASUREMENT
/begin MEASUREMENT B_for82 "KF-Bereich 82 fertig gelernt" UBYTE B_TRUE 0 0 0.000000 0.000000 /begin IF_DATA ASAP1B_ETK KP_BLOB 0x383252 1 1 /end IF_DATA BIT_MASK 0x80 /end MEASUREMENT
/begin MEASUREMENT B_for83 "KF-Bereich 83 fertig gelernt" UBYTE B_TRUE 0 0 0.000000 0.000000 /begin IF_DATA ASAP1B_ETK KP_BLOB 0x383253 1 1 /end IF_DATA BIT_MASK 0x80 /end MEASUREMENT
/begin MEASUREMENT B_fordo_m "Monitor, Bedingung Adaption in mind. einem dominanten Bereich ready" UBYTE B_TRUE 0 0 0.000000 0.000000 /begin IF_DATA ASAP1B_ETK KP_BLOB 0xE3DB 0 1 /end IF_DATA BIT_MASK 0x20 /end MEASUREMENT
/begin MEASUREMENT B_forn01 "mindestens ein Bereich im Drehzahlbereich 01 hat fertig gelernt" UBYTE B_TRUE 0 0 0.000000 0.000000 /begin IF_DATA ASAP1B_ETK KP_BLOB 0x38324F 1 1 /end IF_DATA BIT_MASK 0x1 /end MEASUREMENT
/begin MEASUREMENT B_forn02 "mindestens ein Bereich im Drehzahlbereich 02 hat fertig gelernt" UBYTE B_TRUE 0 0 0.000000 0.000000 /begin IF_DATA ASAP1B_ETK KP_BLOB 0x38324F 1 1 /end IF_DATA BIT_MASK 0x2 /end MEASUREMENT
/begin MEASUREMENT B_forn03 "mindestens ein Bereich im Drehzahlbereich 03 hat fertig gelernt" UBYTE B_TRUE 0 0 0.000000 0.000000 /begin IF_DATA ASAP1B_ETK KP_BLOB 0x38324F 1 1 /end IF_DATA BIT_MASK 0x4 /end MEASUREMENT
/begin MEASUREMENT B_forn04 "mindestens ein Bereich im Drehzahlbereich 04 hat fertig gelernt" UBYTE B_TRUE 0 0 0.000000 0.000000 /begin IF_DATA ASAP1B_ETK KP_BLOB 0x38324F 1 1 /end IF_DATA BIT_MASK 0x8 /end MEASUREMENT
/begin MEASUREMENT B_forn05 "mindestens ein Bereich im Drehzahlbereich 05 hat fertig gelernt" UBYTE B_TRUE 0 0 0.000000 0.000000 /begin IF_DATA ASAP1B_ETK KP_BLOB 0x38324F 1 1 /end IF_DATA BIT_MASK 0x10 /end MEASUREMENT
/begin MEASUREMENT B_forn06 "mindestens ein Bereich im Drehzahlbereich 06 hat fertig gelernt" UBYTE B_TRUE 0 0 0.000000 0.000000 /begin IF_DATA ASAP1B_ETK KP_BLOB 0x38324F 1 1 /end IF_DATA BIT_MASK 0x20 /end MEASUREMENT
/begin MEASUREMENT B_forn07 "mindestens ein Bereich im Drehzahlbereich 07 hat fertig gelernt" UBYTE B_TRUE 0 0 0.000000 0.000000 /begin IF_DATA ASAP1B_ETK KP_BLOB 0x38324F 1 1 /end IF_DATA BIT_MASK 0x40 /end MEASUREMENT
/begin MEASUREMENT B_forn08 "mindestens ein Bereich im Drehzahlbereich 08 hat fertig gelernt" UBYTE B_TRUE 0 0 0.000000 0.000000 /begin IF_DATA ASAP1B_ETK KP_BLOB 0x38324F 1 1 /end IF_DATA BIT_MASK 0x80 /end MEASUREMENT
/begin MEASUREMENT B_forn_m "Monitor, Bedingung Adaption im aktuellen Drehzahlbereich ready" UBYTE B_TRUE 0 0 0.000000 0.000000 /begin IF_DATA ASAP1B_ETK KP_BLOB 0xE3DB 0 1 /end IF_DATA BIT_MASK 0x40 /end MEASUREMENT
/begin MEASUREMENT B_forset "Reset der fuel-on/-off Adaption" UWORD B_TRUE___UW 0 0 0.000000 0.000000 /begin IF_DATA ASAP1B_ETK KP_BLOB 0xFDAA 0 2 /end IF_DATA BIT_MASK 0x4000 /end MEASUREMENT
/begin MEASUREMENT B_forun "Status fuel-on/-off Adaption aktiv" UBYTE B_TRUE 0 0 0.000000 0.000000 /begin IF_DATA ASAP1B_ETK KP_BLOB 0x38324E 1 1 /end IF_DATA BIT_MASK 0x10 /end MEASUREMENT
/begin MEASUREMENT B_for_m "Monitor, Bedingung Adaption im aktuellen Bereich ready" UBYTE B_TRUE 0 0 0.000000 0.000000 /begin IF_DATA ASAP1B_ETK KP_BLOB 0xE3DB 0 1 /end IF_DATA BIT_MASK 0x10 /end MEASUREMENT
/begin MEASUREMENT B_fos "Bedingung fuel-on/-off aktueller Bereich ist ein Schubbereich" UBYTE B_TRUE 0 0 0.000000 0.000000 /begin IF_DATA ASAP1B_ETK KP_BLOB 0x38324D 1 1 /end IF_DATA BIT_MASK 0x4 /end MEASUREMENT
/begin MEASUREMENT B_foxfg "Bedingung fuel-on/-off freigegeben" UBYTE B_TRUE 0 0 0.000000 0.000000 /begin IF_DATA ASAP1B_ETK KP_BLOB 0x38324E 1 1 /end IF_DATA BIT_MASK 0x8 /end MEASUREMENT
/begin MEASUREMENT B_ll "Bedingung Leerlauf" UWORD B_TRUE___UW 0 0 0.000000 0.000000 /begin IF_DATA ASAP1B_ETK KP_BLOB 0xFD7E 0 2 /end IF_DATA BIT_MASK 0x2000 /end MEASUREMENT
/begin MEASUREMENT B_luaerk_m "Monitor, Aussetzer erkannt in DMDLUA" UBYTE B_TRUE 0 0 0.000000 0.000000 /begin IF_DATA ASAP1B_ETK KP_BLOB 0xE3DB 0 1 /end IF_DATA BIT_MASK 0x2 /end MEASUREMENT
/begin MEASUREMENT B_luerk_m "Monitor, Aussetzer erkannt in DMDLU" UBYTE B_TRUE 0 0 0.000000 0.000000 /begin IF_DATA ASAP1B_ETK KP_BLOB 0xE3F8 0 1 /end IF_DATA BIT_MASK 0x4 /end MEASUREMENT
/begin MEASUREMENT B_lustop_m "Laufunruhe-Berechnung gesperrt, Monitor-Grî·e" UBYTE B_TRUE 0 0 0.000000 0.000000 /begin IF_DATA ASAP1B_ETK KP_BLOB 0xE3F8 0 1 /end IF_DATA BIT_MASK 0x8 /end MEASUREMENT
/begin MEASUREMENT B_mderk "Aussetzer erkannt, VerknÅpfung mehrerer Funktionen" UWORD B_TRUE___UW 0 0 0.000000 0.000000 /begin IF_DATA ASAP1B_ETK KP_BLOB 0xFDAA 0 2 /end IF_DATA BIT_MASK 0x10 /end MEASUREMENT
/begin MEASUREMENT B_mdstim_m "Monitor, ZÅndungsaussetzer eingestellt, Stimuli-Signal vom Aussetzergenerator" UBYTE B_TRUE 0 0 0.000000 0.000000 /begin IF_DATA ASAP1B_ETK KP_BLOB 0xE3F8 0 1 /end IF_DATA BIT_MASK 0x2 /end MEASUREMENT
/begin MEASUREMENT B_mdzyl1_m "Monitor, Zylinder-1-Kennung" UBYTE B_TRUE 0 0 0.000000 0.000000 /begin IF_DATA ASAP1B_ETK KP_BLOB 0xE3F8 0 1 /end IF_DATA BIT_MASK 0x10 /end MEASUREMENT
/begin MEASUREMENT B_plok "PlausibilitÑt der FSE-Werte in allen Drehzahlbereichen gegeben" UWORD B_TRUE___UW 0 0 0.000000 0.000000 /begin IF_DATA ASAP1B_ETK KP_BLOB 0xFD18 0 2 /end IF_DATA BIT_MASK 0x400 /end MEASUREMENT
/begin MEASUREMENT B_plok01 "PlausibilitÑt der FSE-Werte im Drehzahlbereich 01 gegeben" UBYTE B_TRUE 0 0 0.000000 0.000000 /begin IF_DATA ASAP1B_ETK KP_BLOB 0x383250 1 1 /end IF_DATA BIT_MASK 0x1 /end MEASUREMENT
/begin MEASUREMENT B_plok02 "PlausibilitÑt der FSE-Werte im Drehzahlbereich 02 gegeben" UBYTE B_TRUE 0 0 0.000000 0.000000 /begin IF_DATA ASAP1B_ETK KP_BLOB 0x383250 1 1 /end IF_DATA BIT_MASK 0x2 /end MEASUREMENT
/begin MEASUREMENT B_plok03 "PlausibilitÑt der FSE-Werte im Drehzahlbereich 03 gegeben" UBYTE B_TRUE 0 0 0.000000 0.000000 /begin IF_DATA ASAP1B_ETK KP_BLOB 0x383250 1 1 /end IF_DATA BIT_MASK 0x4 /end MEASUREMENT
/begin MEASUREMENT B_plok04 "PlausibilitÑt der FSE-Werte im Drehzahlbereich 04 gegeben" UBYTE B_TRUE 0 0 0.000000 0.000000 /begin IF_DATA ASAP1B_ETK KP_BLOB 0x383250 1 1 /end IF_DATA BIT_MASK 0x8 /end MEASUREMENT
/begin MEASUREMENT B_plok05 "PlausibilitÑt der FSE-Werte im Drehzahlbereich 05 gegeben" UBYTE B_TRUE 0 0 0.000000 0.000000 /begin IF_DATA ASAP1B_ETK KP_BLOB 0x383250 1 1 /end IF_DATA BIT_MASK 0x10 /end MEASUREMENT
/begin MEASUREMENT B_plok06 "PlausibilitÑt der FSE-Werte im Drehzahlbereich 06 gegeben" UBYTE B_TRUE 0 0 0.000000 0.000000 /begin IF_DATA ASAP1B_ETK KP_BLOB 0x383250 1 1 /end IF_DATA BIT_MASK 0x20 /end MEASUREMENT
/begin MEASUREMENT B_plok07 "PlausibilitÑt der FSE-Werte im Drehzahlbereich 07 gegeben" UBYTE B_TRUE 0 0 0.000000 0.000000 /begin IF_DATA ASAP1B_ETK KP_BLOB 0x383250 1 1 /end IF_DATA BIT_MASK 0x40 /end MEASUREMENT
/begin MEASUREMENT B_plok08 "PlausibilitÑt der FSE-Werte im Drehzahlbereich 08 gegeben" UBYTE B_TRUE 0 0 0.000000 0.000000 /begin IF_DATA ASAP1B_ETK KP_BLOB 0x383250 1 1 /end IF_DATA BIT_MASK 0x80 /end MEASUREMENT
/begin MEASUREMENT B_plokn_m "Monitor, PlausibilitÑt der FSE-Werte im aktuellen Drehzahlbereich gegeben" UBYTE B_TRUE 0 0 0.000000 0.000000 /begin IF_DATA ASAP1B_ETK KP_BLOB 0xE3DB 0 1 /end IF_DATA BIT_MASK 0x80 /end MEASUREMENT
/begin MEASUREMENT B_tnalu_m "Monitor, Testphase nach erkanntem Aussetzer" UBYTE B_TRUE 0 0 0.000000 0.000000 /begin IF_DATA ASAP1B_ETK KP_BLOB 0xE3DB 0 1 /end IF_DATA BIT_MASK 0x8 /end MEASUREMENT
/begin MEASUREMENT B_tsroov_m "Monitor, Bedingung Segmentzeit-Wordoverflow" UBYTE B_TRUE 0 0 0.000000 0.000000 /begin IF_DATA ASAP1B_ETK KP_BLOB 0xE3F8 0 1 /end IF_DATA BIT_MASK 0x20 /end MEASUREMENT
/begin MEASUREMENT cd_bits1_w "" UWORD dez___UW 0 0 0.000000 65535.000000 /begin IF_DATA ASAP1B_ETK KP_BLOB 0x380D30 1 2 /end IF_DATA BIT_MASK 0xFFFF /end MEASUREMENT
/begin MEASUREMENT cfoxx "zeigt die Eigenschaften des aktuellen KF-Bereiches der Fuel-on/-off Adaption" UBYTE dez 0 0 0.000000 255.000000 /begin IF_DATA ASAP1B_ETK KP_BLOB 0x38324D 1 1 /end IF_DATA BIT_MASK 0xFF /end MEASUREMENT
/begin MEASUREMENT dfse01 "Status PlausibilitÑtsprÅfung der fuel-on/-off Adaption im Drehzahlber.01 erfÅllt" SBYTE dtsegn_b11p25divZyl 0 0 -2.812501 2.790528 /begin IF_DATA ASAP1B_ETK KP_BLOB 0x3809EB 1 1 /end IF_DATA BIT_MASK 0xFF /end MEASUREMENT
/begin MEASUREMENT dfse02 "Status PlausibilitÑtsprÅfung der fuel-on/-off Adaption im Drehzahlber.02erfÅllt" SBYTE dtsegn_b11p25divZyl 0 0 -2.812501 2.790528 /begin IF_DATA ASAP1B_ETK KP_BLOB 0x3809EC 1 1 /end IF_DATA BIT_MASK 0xFF /end MEASUREMENT
/begin MEASUREMENT dfse03 "Status PlausibilitÑtsprÅfung der fuel-on/-off Adaption im Drehzahlber.3 erfÅllt" SBYTE dtsegn_b11p25divZyl 0 0 -2.812501 2.790528 /begin IF_DATA ASAP1B_ETK KP_BLOB 0x3809ED 1 1 /end IF_DATA BIT_MASK 0xFF /end MEASUREMENT
/begin MEASUREMENT dfse04 "Status PlausibilitÑtsprÅfung der fuel-on/-off Adaption im Drehzahlber.4 erfÅllt" SBYTE dtsegn_b11p25divZyl 0 0 -2.812501 2.790528 /begin IF_DATA ASAP1B_ETK KP_BLOB 0x3809EE 1 1 /end IF_DATA BIT_MASK 0xFF /end MEASUREMENT
/begin MEASUREMENT dfse05 "Status PlausibilitÑtsprÅfung der fuel-on/-off Adaption im Drehzahlber.5 erfÅllt" SBYTE dtsegn_b11p25divZyl 0 0 -2.812501 2.790528 /begin IF_DATA ASAP1B_ETK KP_BLOB 0x3809EF 1 1 /end IF_DATA BIT_MASK 0xFF /end MEASUREMENT
/begin MEASUREMENT dfse06 "Status PlausibilitÑtsprÅfung der fuel-on/-off Adaption im Drehzahlber.6 erfÅllt" SBYTE dtsegn_b11p25divZyl 0 0 -2.812501 2.790528 /begin IF_DATA ASAP1B_ETK KP_BLOB 0x3809F0 1 1 /end IF_DATA BIT_MASK 0xFF /end MEASUREMENT
/begin MEASUREMENT dfse07 "Status PlausibilitÑtsprÅfung der fuel-on/-off Adaption im Drehzahlber.7 erfÅllt" SBYTE dtsegn_b11p25divZyl 0 0 -2.812501 2.790528 /begin IF_DATA ASAP1B_ETK KP_BLOB 0x3809F1 1 1 /end IF_DATA BIT_MASK 0xFF /end MEASUREMENT
/begin MEASUREMENT dfse08 "Status PlausibilitÑtsprÅfung der fuel-on/-off Adaption im Drehzahlber.8 erfÅllt" SBYTE dtsegn_b11p25divZyl 0 0 -2.812501 2.790528 /begin IF_DATA ASAP1B_ETK KP_BLOB 0x3809F2 1 1 /end IF_DATA BIT_MASK 0xFF /end MEASUREMENT
/begin MEASUREMENT dfsen "Differenz der FSE-Werte im Normalbetrieb im aktuellen n-Bereich" SBYTE dtsegn_b11p25divZyl 0 0 -2.812501 2.790528 /begin IF_DATA ASAP1B_ETK KP_BLOB 0x3809F3 1 1 /end IF_DATA BIT_MASK 0xFF /end MEASUREMENT
/begin MEASUREMENT dfseresz "ResetzÑhler PlausibilitÑtsprÅfung FSE" UWORD dez___UW 0 0 0.000000 65535.000000 /begin IF_DATA ASAP1B_ETK KP_BLOB 0x38383C 1 2 /end IF_DATA BIT_MASK 0xFFFF /end MEASUREMENT
/begin MEASUREMENT esst_sdz03dmub "" UWORD dez___UW 0 0 0.000000 65535.000000 /begin IF_DATA ASAP1B_ETK KP_BLOB 0x381030 1 2 /end IF_DATA BIT_MASK 0xFFFF /end MEASUREMENT
/begin MEASUREMENT esst_sdz08dmub "" UWORD dez___UW 0 0 0.000000 65535.000000 /begin IF_DATA ASAP1B_ETK KP_BLOB 0x381032 1 2 /end IF_DATA BIT_MASK 0xFFFF /end MEASUREMENT
/begin MEASUREMENT esst_snm08dmub "" UWORD dez___UW 0 0 0.000000 65535.000000 /begin IF_DATA ASAP1B_ETK KP_BLOB 0x380E6C 1 2 /end IF_DATA BIT_MASK 0xFFFF /end MEASUREMENT
/begin MEASUREMENT esst_srl08dmub "" UWORD dez___UW 0 0 0.000000 65535.000000 /begin IF_DATA ASAP1B_ETK KP_BLOB 0x380E8A 1 2 /end IF_DATA BIT_MASK 0xFFFF /end MEASUREMENT
/begin MEASUREMENT esst_stm08dmub "" UWORD dez___UW 0 0 0.000000 65535.000000 /begin IF_DATA ASAP1B_ETK KP_BLOB 0x380E9C 1 2 /end IF_DATA BIT_MASK 0xFFFF /end MEASUREMENT
/begin MEASUREMENT famal "Faktor zur Absenkung des LUR-Wertes bei Mehrfachaussetzern, aus KFFAMALU" UBYTE fak_ub_b1 0 0 0.000000 0.996094 /begin IF_DATA ASAP1B_ETK KP_BLOB 0x3809E9 1 1 /end IF_DATA BIT_MASK 0xFF /end MEASUREMENT
/begin MEASUREMENT fflutn "Filterfaktor Åber n fÅr Filterung der Laufunruhe" UBYTE fak_ub_b1 0 0 0.000000 0.996094 /begin IF_DATA ASAP1B_ETK KP_BLOB 0x380A00 1 1 /end IF_DATA BIT_MASK 0xFF /end MEASUREMENT
/begin MEASUREMENT ffon "Statusbyte öbersicht fuel-on Adaption" UBYTE dez 0 0 0.000000 255.000000 /begin IF_DATA ASAP1B_ETK KP_BLOB 0x38324E 1 1 /end IF_DATA BIT_MASK 0xFF /end MEASUREMENT
/begin MEASUREMENT ffonn1 "Statusbyte fuel-on/-off Adaption (KF-Bereiche fertig gelernt)" UBYTE dez 0 0 0.000000 255.000000 /begin IF_DATA ASAP1B_ETK KP_BLOB 0x383251 1 1 /end IF_DATA BIT_MASK 0xFF /end MEASUREMENT
/begin MEASUREMENT ffonn2 "Statusbyte fuel-on/-off Adaption (KF-Bereiche fertig gelernt)" UBYTE dez 0 0 0.000000 255.000000 /begin IF_DATA ASAP1B_ETK KP_BLOB 0x383252 1 1 /end IF_DATA BIT_MASK 0xFF /end MEASUREMENT
/begin MEASUREMENT ffonn3 "Statusbyte fuel-on/-off Adaption (KF-Bereiche fertig gelernt)" UBYTE dez 0 0 0.000000 255.000000 /begin IF_DATA ASAP1B_ETK KP_BLOB 0x383253 1 1 /end IF_DATA BIT_MASK 0xFF /end MEASUREMENT
/begin MEASUREMENT fforn1 "Statusbyte fuel-on/-off Adaption (n-Bereiche fertig gelernt)" UBYTE dez 0 0 0.000000 255.000000 /begin IF_DATA ASAP1B_ETK KP_BLOB 0x38324F 1 1 /end IF_DATA BIT_MASK 0xFF /end MEASUREMENT
/begin MEASUREMENT ffpl1 "Statusbyte der fuel-on/-off Adaption (FSE-Werte der Drz.-Bereiche plausibel I)" UBYTE dez 0 0 0.000000 255.000000 /begin IF_DATA ASAP1B_ETK KP_BLOB 0x383250 1 1 /end IF_DATA BIT_MASK 0xFF /end MEASUREMENT
/begin MEASUREMENT flmx "aktuell maximaler Lernfilterwert" SWORD dtsegn_b720divZyl 0 0 -180.000439 179.994946 /begin IF_DATA ASAP1B_ETK KP_BLOB 0x381686 1 2 /end IF_DATA BIT_MASK 0xFFFF /end MEASUREMENT
/begin MEASUREMENT flmxresz "ResetzÑhler Lernfilterwert weggelaufen" UWORD dez___UW 0 0 0.000000 65535.000000 /begin IF_DATA ASAP1B_ETK KP_BLOB 0x38383E 1 2 /end IF_DATA BIT_MASK 0xFFFF /end MEASUREMENT
/begin MEASUREMENT fln11_02 "Lernfilterwert, negativ, Betriebsbereich 11, Zylinder 2" SWORD dtsegn_b720divZyl 0 0 -180.000439 179.994946 /begin IF_DATA ASAP1B_ETK KP_BLOB 0x38344C 1 2 /end IF_DATA BIT_MASK 0xFFFF /end MEASUREMENT
/begin MEASUREMENT fln11_03 "Lernfilterwert, negativ" SWORD dtsegn_b720divZyl 0 0 -180.000439 179.994946 /begin IF_DATA ASAP1B_ETK KP_BLOB 0x38347C 1 2 /end IF_DATA BIT_MASK 0xFFFF /end MEASUREMENT
/begin MEASUREMENT fln11_04 "Lernfilterwert, negativ" SWORD dtsegn_b720divZyl 0 0 -180.000439 179.994946 /begin IF_DATA ASAP1B_ETK KP_BLOB 0x3834AC 1 2 /end IF_DATA BIT_MASK 0xFFFF /end MEASUREMENT
/begin MEASUREMENT fln11_05 "Lernfilterwert, negativ" SWORD dtsegn_b720divZyl 0 0 -180.000439 179.994946 /begin IF_DATA ASAP1B_ETK KP_BLOB 0x3834DC 1 2 /end IF_DATA BIT_MASK 0xFFFF /end MEASUREMENT
/begin MEASUREMENT fln11_06 "Lernfilterwert, negativ" SWORD dtsegn_b720divZyl 0 0 -180.000439 179.994946 /begin IF_DATA ASAP1B_ETK KP_BLOB 0x38350C 1 2 /end IF_DATA BIT_MASK 0xFFFF /end MEASUREMENT
/begin MEASUREMENT fln11_07 "Lernfilterwert, negativ" SWORD dtsegn_b720divZyl 0 0 -180.000439 179.994946 /begin IF_DATA ASAP1B_ETK KP_BLOB 0x38353C 1 2 /end IF_DATA BIT_MASK 0xFFFF /end MEASUREMENT
/begin MEASUREMENT fln11_08 "Lernfilterwert, negativ" SWORD dtsegn_b720divZyl 0 0 -180.000439 179.994946 /begin IF_DATA ASAP1B_ETK KP_BLOB 0x38356C 1 2 /end IF_DATA BIT_MASK 0xFFFF /end MEASUREMENT
/begin MEASUREMENT fln12_02 "Lernfilterwert, negativ" SWORD dtsegn_b720divZyl 0 0 -180.000439 179.994946 /begin IF_DATA ASAP1B_ETK KP_BLOB 0x38345C 1 2 /end IF_DATA BIT_MASK 0xFFFF /end MEASUREMENT
/begin MEASUREMENT fln12_03 "Lernfilterwert, negativ" SWORD dtsegn_b720divZyl 0 0 -180.000439 179.994946 /begin IF_DATA ASAP1B_ETK KP_BLOB 0x38348C 1 2 /end IF_DATA BIT_MASK 0xFFFF /end MEASUREMENT
/begin MEASUREMENT fln12_04 "Lernfilterwert, negativ" SWORD dtsegn_b720divZyl 0 0 -180.000439 179.994946 /begin IF_DATA ASAP1B_ETK KP_BLOB 0x3834BC 1 2 /end IF_DATA BIT_MASK 0xFFFF /end MEASUREMENT
/begin MEASUREMENT fln12_05 "Lernfilterwert, negativ" SWORD dtsegn_b720divZyl 0 0 -180.000439 179.994946 /begin IF_DATA ASAP1B_ETK KP_BLOB 0x3834EC 1 2 /end IF_DATA BIT_MASK 0xFFFF /end MEASUREMENT
/begin MEASUREMENT fln12_06 "Lernfilterwert, negativ" SWORD dtsegn_b720divZyl 0 0 -180.000439 179.994946 /begin IF_DATA ASAP1B_ETK KP_BLOB 0x38351C 1 2 /end IF_DATA BIT_MASK 0xFFFF /end MEASUREMENT
/begin MEASUREMENT fln12_07 "Lernfilterwert, negativ" SWORD dtsegn_b720divZyl 0 0 -180.000439 179.994946 /begin IF_DATA ASAP1B_ETK KP_BLOB 0x38354C 1 2 /end IF_DATA BIT_MASK 0xFFFF /end MEASUREMENT
/begin MEASUREMENT fln12_08 "Lernfilterwert, negativ" SWORD dtsegn_b720divZyl 0 0 -180.000439 179.994946 /begin IF_DATA ASAP1B_ETK KP_BLOB 0x38357C 1 2 /end IF_DATA BIT_MASK 0xFFFF /end MEASUREMENT
/begin MEASUREMENT fln13_02 "Lernfilterwert, negativ" SWORD dtsegn_b720divZyl 0 0 -180.000439 179.994946 /begin IF_DATA ASAP1B_ETK KP_BLOB 0x38346C 1 2 /end IF_DATA BIT_MASK 0xFFFF /end MEASUREMENT
/begin MEASUREMENT fln13_03 "Lernfilterwert, negativ" SWORD dtsegn_b720divZyl 0 0 -180.000439 179.994946 /begin IF_DATA ASAP1B_ETK KP_BLOB 0x38349C 1 2 /end IF_DATA BIT_MASK 0xFFFF /end MEASUREMENT
/begin MEASUREMENT fln13_04 "Lernfilterwert, negativ" SWORD dtsegn_b720divZyl 0 0 -180.000439 179.994946 /begin IF_DATA ASAP1B_ETK KP_BLOB 0x3834CC 1 2 /end IF_DATA BIT_MASK 0xFFFF /end MEASUREMENT
/begin MEASUREMENT fln13_05 "Lernfilterwert, negativ" SWORD dtsegn_b720divZyl 0 0 -180.000439 179.994946 /begin IF_DATA ASAP1B_ETK KP_BLOB 0x3834FC 1 2 /end IF_DATA BIT_MASK 0xFFFF /end MEASUREMENT
/begin MEASUREMENT fln13_06 "Lernfilterwert, negativ" SWORD dtsegn_b720divZyl 0 0 -180.000439 179.994946 /begin IF_DATA ASAP1B_ETK KP_BLOB 0x38352C 1 2 /end IF_DATA BIT_MASK 0xFFFF /end MEASUREMENT
/begin MEASUREMENT fln13_07 "Lernfilterwert, negativ" SWORD dtsegn_b720divZyl 0 0 -180.000439 179.994946 /begin IF_DATA ASAP1B_ETK KP_BLOB 0x38355C 1 2 /end IF_DATA BIT_MASK 0xFFFF /end MEASUREMENT
/begin MEASUREMENT fln13_08 "Lernfilterwert, negativ" SWORD dtsegn_b720divZyl 0 0 -180.000439 179.994946 /begin IF_DATA ASAP1B_ETK KP_BLOB 0x38358C 1 2 /end IF_DATA BIT_MASK 0xFFFF /end MEASUREMENT
/begin MEASUREMENT fln21_02 "Lernfilterwert, negativ" SWORD dtsegn_b720divZyl 0 0 -180.000439 179.994946 /begin IF_DATA ASAP1B_ETK KP_BLOB 0x38344E 1 2 /end IF_DATA BIT_MASK 0xFFFF /end MEASUREMENT
/begin MEASUREMENT fln21_03 "Lernfilterwert, negativ" SWORD dtsegn_b720divZyl 0 0 -180.000439 179.994946 /begin IF_DATA ASAP1B_ETK KP_BLOB 0x38347E 1 2 /end IF_DATA BIT_MASK 0xFFFF /end MEASUREMENT
/begin MEASUREMENT fln21_04 "Lernfilterwert, negativ" SWORD dtsegn_b720divZyl 0 0 -180.000439 179.994946 /begin IF_DATA ASAP1B_ETK KP_BLOB 0x3834AE 1 2 /end IF_DATA BIT_MASK 0xFFFF /end MEASUREMENT
/begin MEASUREMENT fln21_05 "Lernfilterwert, negativ" SWORD dtsegn_b720divZyl 0 0 -180.000439 179.994946 /begin IF_DATA ASAP1B_ETK KP_BLOB 0x3834DE 1 2 /end IF_DATA BIT_MASK 0xFFFF /end MEASUREMENT
/begin MEASUREMENT fln21_06 "Lernfilterwert, negativ" SWORD dtsegn_b720divZyl 0 0 -180.000439 179.994946 /begin IF_DATA ASAP1B_ETK KP_BLOB 0x38350E 1 2 /end IF_DATA BIT_MASK 0xFFFF /end MEASUREMENT
/begin MEASUREMENT fln21_07 "Lernfilterwert, negativ" SWORD dtsegn_b720divZyl 0 0 -180.000439 179.994946 /begin IF_DATA ASAP1B_ETK KP_BLOB 0x38353E 1 2 /end IF_DATA BIT_MASK 0xFFFF /end MEASUREMENT
/begin MEASUREMENT fln21_08 "Lernfilterwert, negativ" SWORD dtsegn_b720divZyl 0 0 -180.000439 179.994946 /begin IF_DATA ASAP1B_ETK KP_BLOB 0x38356E 1 2 /end IF_DATA BIT_MASK 0xFFFF /end MEASUREMENT
/begin MEASUREMENT fln22_02 "Lernfilterwert, negativ" SWORD dtsegn_b720divZyl 0 0 -180.000439 179.994946 /begin IF_DATA ASAP1B_ETK KP_BLOB 0x38345E 1 2 /end IF_DATA BIT_MASK 0xFFFF /end MEASUREMENT
/begin MEASUREMENT fln22_03 "Lernfilterwert, negativ" SWORD dtsegn_b720divZyl 0 0 -180.000439 179.994946 /begin IF_DATA ASAP1B_ETK KP_BLOB 0x38348E 1 2 /end IF_DATA BIT_MASK 0xFFFF /end MEASUREMENT
/begin MEASUREMENT fln22_04 "Lernfilterwert, negativ" SWORD dtsegn_b720divZyl 0 0 -180.000439 179.994946 /begin IF_DATA ASAP1B_ETK KP_BLOB 0x3834BE 1 2 /end IF_DATA BIT_MASK 0xFFFF /end MEASUREMENT
/begin MEASUREMENT fln22_05 "Lernfilterwert, negativ" SWORD dtsegn_b720divZyl 0 0 -180.000439 179.994946 /begin IF_DATA ASAP1B_ETK KP_BLOB 0x3834EE 1 2 /end IF_DATA BIT_MASK 0xFFFF /end MEASUREMENT
/begin MEASUREMENT fln22_06 "Lernfilterwert, negativ" SWORD dtsegn_b720divZyl 0 0 -180.000439 179.994946 /begin IF_DATA ASAP1B_ETK KP_BLOB 0x38351E 1 2 /end IF_DATA BIT_MASK 0xFFFF /end MEASUREMENT
/begin MEASUREMENT fln22_07 "Lernfilterwert, negativ" SWORD dtsegn_b720divZyl 0 0 -180.000439 179.994946 /begin IF_DATA ASAP1B_ETK KP_BLOB 0x38354E 1 2 /end IF_DATA BIT_MASK 0xFFFF /end MEASUREMENT
/begin MEASUREMENT fln22_08 "Lernfilterwert, negativ" SWORD dtsegn_b720divZyl 0 0 -180.000439 179.994946 /begin IF_DATA ASAP1B_ETK KP_BLOB 0x38357E 1 2 /end IF_DATA BIT_MASK 0xFFFF /end MEASUREMENT
/begin MEASUREMENT fln23_02 "Lernfilterwert, negativ" SWORD dtsegn_b720divZyl 0 0 -180.000439 179.994946 /begin IF_DATA ASAP1B_ETK KP_BLOB 0x38346E 1 2 /end IF_DATA BIT_MASK 0xFFFF /end MEASUREMENT
/begin MEASUREMENT fln23_03 "Lernfilterwert, negativ" SWORD dtsegn_b720divZyl 0 0 -180.000439 179.994946 /begin IF_DATA ASAP1B_ETK KP_BLOB 0x38349E 1 2 /end IF_DATA BIT_MASK 0xFFFF /end MEASUREMENT
/begin MEASUREMENT fln23_04 "Lernfilterwert, negativ" SWORD dtsegn_b720divZyl 0 0 -180.000439 179.994946 /begin IF_DATA ASAP1B_ETK KP_BLOB 0x3834CE 1 2 /end IF_DATA BIT_MASK 0xFFFF /end MEASUREMENT
/begin MEASUREMENT fln23_05 "Lernfilterwert, negativ" SWORD dtsegn_b720divZyl 0 0 -180.000439 179.994946 /begin IF_DATA ASAP1B_ETK KP_BLOB 0x3834FE 1 2 /end IF_DATA BIT_MASK 0xFFFF /end MEASUREMENT
/begin MEASUREMENT fln23_06 "Lernfilterwert, negativ" SWORD dtsegn_b720divZyl 0 0 -180.000439 179.994946 /begin IF_DATA ASAP1B_ETK KP_BLOB 0x38352E 1 2 /end IF_DATA BIT_MASK 0xFFFF /end MEASUREMENT
/begin MEASUREMENT fln23_07 "Lernfilterwert, negativ" SWORD dtsegn_b720divZyl 0 0 -180.000439 179.994946 /begin IF_DATA ASAP1B_ETK KP_BLOB 0x38355E 1 2 /end IF_DATA BIT_MASK 0xFFFF /end MEASUREMENT
/begin MEASUREMENT fln23_08 "Lernfilterwert, negativ" SWORD dtsegn_b720divZyl 0 0 -180.000439 179.994946 /begin IF_DATA ASAP1B_ETK KP_BLOB 0x38358E 1 2 /end IF_DATA BIT_MASK 0xFFFF /end MEASUREMENT
/begin MEASUREMENT fln31_02 "Lernfilterwert, negativ" SWORD dtsegn_b720divZyl 0 0 -180.000439 179.994946 /begin IF_DATA ASAP1B_ETK KP_BLOB 0x383450 1 2 /end IF_DATA BIT_MASK 0xFFFF /end MEASUREMENT
/begin MEASUREMENT fln31_03 "Lernfilterwert, negativ" SWORD dtsegn_b720divZyl 0 0 -180.000439 179.994946 /begin IF_DATA ASAP1B_ETK KP_BLOB 0x383480 1 2 /end IF_DATA BIT_MASK 0xFFFF /end MEASUREMENT
/begin MEASUREMENT fln31_04 "Lernfilterwert, negativ" SWORD dtsegn_b720divZyl 0 0 -180.000439 179.994946 /begin IF_DATA ASAP1B_ETK KP_BLOB 0x3834B0 1 2 /end IF_DATA BIT_MASK 0xFFFF /end MEASUREMENT
/begin MEASUREMENT fln31_05 "Lernfilterwert, negativ" SWORD dtsegn_b720divZyl 0 0 -180.000439 179.994946 /begin IF_DATA ASAP1B_ETK KP_BLOB 0x3834E0 1 2 /end IF_DATA BIT_MASK 0xFFFF /end MEASUREMENT
/begin MEASUREMENT fln31_06 "Lernfilterwert, negativ" SWORD dtsegn_b720divZyl 0 0 -180.000439 179.994946 /begin IF_DATA ASAP1B_ETK KP_BLOB 0x383510 1 2 /end IF_DATA BIT_MASK 0xFFFF /end MEASUREMENT
/begin MEASUREMENT fln31_07 "Lernfilterwert, negativ" SWORD dtsegn_b720divZyl 0 0 -180.000439 179.994946 /begin IF_DATA ASAP1B_ETK KP_BLOB 0x383540 1 2 /end IF_DATA BIT_MASK 0xFFFF /end MEASUREMENT
/begin MEASUREMENT fln31_08 "Lernfilterwert, negativ" SWORD dtsegn_b720divZyl 0 0 -180.000439 179.994946 /begin IF_DATA ASAP1B_ETK KP_BLOB 0x383570 1 2 /end IF_DATA BIT_MASK 0xFFFF /end MEASUREMENT
/begin MEASUREMENT fln32_02 "Lernfilterwert, negativ" SWORD dtsegn_b720divZyl 0 0 -180.000439 179.994946 /begin IF_DATA ASAP1B_ETK KP_BLOB 0x383460 1 2 /end IF_DATA BIT_MASK 0xFFFF /end MEASUREMENT
/begin MEASUREMENT fln32_03 "Lernfilterwert, negativ" SWORD dtsegn_b720divZyl 0 0 -180.000439 179.994946 /begin IF_DATA ASAP1B_ETK KP_BLOB 0x383490 1 2 /end IF_DATA BIT_MASK 0xFFFF /end MEASUREMENT
/begin MEASUREMENT fln32_04 "Lernfilterwert, negativ" SWORD dtsegn_b720divZyl 0 0 -180.000439 179.994946 /begin IF_DATA ASAP1B_ETK KP_BLOB 0x3834C0 1 2 /end IF_DATA BIT_MASK 0xFFFF /end MEASUREMENT
/begin MEASUREMENT fln32_05 "Lernfilterwert, negativ" SWORD dtsegn_b720divZyl 0 0 -180.000439 179.994946 /begin IF_DATA ASAP1B_ETK KP_BLOB 0x3834F0 1 2 /end IF_DATA BIT_MASK 0xFFFF /end MEASUREMENT
/begin MEASUREMENT fln32_06 "Lernfilterwert, negativ" SWORD dtsegn_b720divZyl 0 0 -180.000439 179.994946 /begin IF_DATA ASAP1B_ETK KP_BLOB 0x383520 1 2 /end IF_DATA BIT_MASK 0xFFFF /end MEASUREMENT
/begin MEASUREMENT fln32_07 "Lernfilterwert, negativ" SWORD dtsegn_b720divZyl 0 0 -180.000439 179.994946 /begin IF_DATA ASAP1B_ETK KP_BLOB 0x383550 1 2 /end IF_DATA BIT_MASK 0xFFFF /end MEASUREMENT
/begin MEASUREMENT fln32_08 "Lernfilterwert, negativ" SWORD dtsegn_b720divZyl 0 0 -180.000439 179.994946 /begin IF_DATA ASAP1B_ETK KP_BLOB 0x383580 1 2 /end IF_DATA BIT_MASK 0xFFFF /end MEASUREMENT
/begin MEASUREMENT fln33_02 "Lernfilterwert, negativ" SWORD dtsegn_b720divZyl 0 0 -180.000439 179.994946 /begin IF_DATA ASAP1B_ETK KP_BLOB 0x383470 1 2 /end IF_DATA BIT_MASK 0xFFFF /end MEASUREMENT
/begin MEASUREMENT fln33_03 "Lernfilterwert, negativ" SWORD dtsegn_b720divZyl 0 0 -180.000439 179.994946 /begin IF_DATA ASAP1B_ETK KP_BLOB 0x3834A0 1 2 /end IF_DATA BIT_MASK 0xFFFF /end MEASUREMENT
/begin MEASUREMENT fln33_04 "Lernfilterwert, negativ" SWORD dtsegn_b720divZyl 0 0 -180.000439 179.994946 /begin IF_DATA ASAP1B_ETK KP_BLOB 0x3834D0 1 2 /end IF_DATA BIT_MASK 0xFFFF /end MEASUREMENT
/begin MEASUREMENT fln33_05 "Lernfilterwert, negativ" SWORD dtsegn_b720divZyl 0 0 -180.000439 179.994946 /begin IF_DATA ASAP1B_ETK KP_BLOB 0x383500 1 2 /end IF_DATA BIT_MASK 0xFFFF /end MEASUREMENT
/begin MEASUREMENT fln33_06 "Lernfilterwert, negativ" SWORD dtsegn_b720divZyl 0 0 -180.000439 179.994946 /begin IF_DATA ASAP1B_ETK KP_BLOB 0x383530 1 2 /end IF_DATA BIT_MASK 0xFFFF /end MEASUREMENT
/begin MEASUREMENT fln33_07 "Lernfilterwert, negativ" SWORD dtsegn_b720divZyl 0 0 -180.000439 179.994946 /begin IF_DATA ASAP1B_ETK KP_BLOB 0x383560 1 2 /end IF_DATA BIT_MASK 0xFFFF /end MEASUREMENT
/begin MEASUREMENT fln33_08 "Lernfilterwert, negativ" SWORD dtsegn_b720divZyl 0 0 -180.000439 179.994946 /begin IF_DATA ASAP1B_ETK KP_BLOB 0x383590 1 2 /end IF_DATA BIT_MASK 0xFFFF /end MEASUREMENT
/begin MEASUREMENT fln41_02 "Lernfilterwert, negativ" SWORD dtsegn_b720divZyl 0 0 -180.000439 179.994946 /begin IF_DATA ASAP1B_ETK KP_BLOB 0x383452 1 2 /end IF_DATA BIT_MASK 0xFFFF /end MEASUREMENT
/begin MEASUREMENT fln41_03 "Lernfilterwert, negativ" SWORD dtsegn_b720divZyl 0 0 -180.000439 179.994946 /begin IF_DATA ASAP1B_ETK KP_BLOB 0x383482 1 2 /end IF_DATA BIT_MASK 0xFFFF /end MEASUREMENT
/begin MEASUREMENT fln41_04 "Lernfilterwert, negativ" SWORD dtsegn_b720divZyl 0 0 -180.000439 179.994946 /begin IF_DATA ASAP1B_ETK KP_BLOB 0x3834B2 1 2 /end IF_DATA BIT_MASK 0xFFFF /end MEASUREMENT
/begin MEASUREMENT fln41_05 "Lernfilterwert, negativ" SWORD dtsegn_b720divZyl 0 0 -180.000439 179.994946 /begin IF_DATA ASAP1B_ETK KP_BLOB 0x3834E2 1 2 /end IF_DATA BIT_MASK 0xFFFF /end MEASUREMENT
/begin MEASUREMENT fln41_06 "Lernfilterwert, negativ" SWORD dtsegn_b720divZyl 0 0 -180.000439 179.994946 /begin IF_DATA ASAP1B_ETK KP_BLOB 0x383512 1 2 /end IF_DATA BIT_MASK 0xFFFF /end MEASUREMENT
/begin MEASUREMENT fln41_07 "Lernfilterwert, negativ" SWORD dtsegn_b720divZyl 0 0 -180.000439 179.994946 /begin IF_DATA ASAP1B_ETK KP_BLOB 0x383542 1 2 /end IF_DATA BIT_MASK 0xFFFF /end MEASUREMENT
/begin MEASUREMENT fln41_08 "Lernfilterwert, negativ" SWORD dtsegn_b720divZyl 0 0 -180.000439 179.994946 /begin IF_DATA ASAP1B_ETK KP_BLOB 0x383572 1 2 /end IF_DATA BIT_MASK 0xFFFF /end MEASUREMENT
/begin MEASUREMENT fln42_02 "Lernfilterwert, negativ" SWORD dtsegn_b720divZyl 0 0 -180.000439 179.994946 /begin IF_DATA ASAP1B_ETK KP_BLOB 0x383462 1 2 /end IF_DATA BIT_MASK 0xFFFF /end MEASUREMENT
/begin MEASUREMENT fln42_03 "Lernfilterwert, negativ" SWORD dtsegn_b720divZyl 0 0 -180.000439 179.994946 /begin IF_DATA ASAP1B_ETK KP_BLOB 0x383492 1 2 /end IF_DATA BIT_MASK 0xFFFF /end MEASUREMENT
/begin MEASUREMENT fln42_04 "Lernfilterwert, negativ" SWORD dtsegn_b720divZyl 0 0 -180.000439 179.994946 /begin IF_DATA ASAP1B_ETK KP_BLOB 0x3834C2 1 2 /end IF_DATA BIT_MASK 0xFFFF /end MEASUREMENT
/begin MEASUREMENT fln42_05 "Lernfilterwert, negativ" SWORD dtsegn_b720divZyl 0 0 -180.000439 179.994946 /begin IF_DATA ASAP1B_ETK KP_BLOB 0x3834F2 1 2 /end IF_DATA BIT_MASK 0xFFFF /end MEASUREMENT
/begin MEASUREMENT fln42_06 "Lernfilterwert, negativ" SWORD dtsegn_b720divZyl 0 0 -180.000439 179.994946 /begin IF_DATA ASAP1B_ETK KP_BLOB 0x383522 1 2 /end IF_DATA BIT_MASK 0xFFFF /end MEASUREMENT
/begin MEASUREMENT fln42_07 "Lernfilterwert, negativ" SWORD dtsegn_b720divZyl 0 0 -180.000439 179.994946 /begin IF_DATA ASAP1B_ETK KP_BLOB 0x383552 1 2 /end IF_DATA BIT_MASK 0xFFFF /end MEASUREMENT
/begin MEASUREMENT fln42_08 "Lernfilterwert, negativ" SWORD dtsegn_b720divZyl 0 0 -180.000439 179.994946 /begin IF_DATA ASAP1B_ETK KP_BLOB 0x383582 1 2 /end IF_DATA BIT_MASK 0xFFFF /end MEASUREMENT
/begin MEASUREMENT fln43_02 "Lernfilterwert, negativ" SWORD dtsegn_b720divZyl 0 0 -180.000439 179.994946 /begin IF_DATA ASAP1B_ETK KP_BLOB 0x383472 1 2 /end IF_DATA BIT_MASK 0xFFFF /end MEASUREMENT
/begin MEASUREMENT fln43_03 "Lernfilterwert, negativ" SWORD dtsegn_b720divZyl 0 0 -180.000439 179.994946 /begin IF_DATA ASAP1B_ETK KP_BLOB 0x3834A2 1 2 /end IF_DATA BIT_MASK 0xFFFF /end MEASUREMENT
/begin MEASUREMENT fln43_04 "Lernfilterwert, negativ" SWORD dtsegn_b720divZyl 0 0 -180.000439 179.994946 /begin IF_DATA ASAP1B_ETK KP_BLOB 0x3834D2 1 2 /end IF_DATA BIT_MASK 0xFFFF /end MEASUREMENT
/begin MEASUREMENT fln43_05 "Lernfilterwert, negativ" SWORD dtsegn_b720divZyl 0 0 -180.000439 179.994946 /begin IF_DATA ASAP1B_ETK KP_BLOB 0x383502 1 2 /end IF_DATA BIT_MASK 0xFFFF /end MEASUREMENT
/begin MEASUREMENT fln43_06 "Lernfilterwert, negativ" SWORD dtsegn_b720divZyl 0 0 -180.000439 179.994946 /begin IF_DATA ASAP1B_ETK KP_BLOB 0x383532 1 2 /end IF_DATA BIT_MASK 0xFFFF /end MEASUREMENT
/begin MEASUREMENT fln43_07 "Lernfilterwert, negativ" SWORD dtsegn_b720divZyl 0 0 -180.000439 179.994946 /begin IF_DATA ASAP1B_ETK KP_BLOB 0x383562 1 2 /end IF_DATA BIT_MASK 0xFFFF /end MEASUREMENT
/begin MEASUREMENT fln43_08 "Lernfilterwert, negativ" SWORD dtsegn_b720divZyl 0 0 -180.000439 179.994946 /begin IF_DATA ASAP1B_ETK KP_BLOB 0x383592 1 2 /end IF_DATA BIT_MASK 0xFFFF /end MEASUREMENT
/begin MEASUREMENT fln51_02 "Lernfilterwert, negativ" SWORD dtsegn_b720divZyl 0 0 -180.000439 179.994946 /begin IF_DATA ASAP1B_ETK KP_BLOB 0x383454 1 2 /end IF_DATA BIT_MASK 0xFFFF /end MEASUREMENT
/begin MEASUREMENT fln51_03 "Lernfilterwert, negativ" SWORD dtsegn_b720divZyl 0 0 -180.000439 179.994946 /begin IF_DATA ASAP1B_ETK KP_BLOB 0x383484 1 2 /end IF_DATA BIT_MASK 0xFFFF /end MEASUREMENT
/begin MEASUREMENT fln51_04 "Lernfilterwert, negativ" SWORD dtsegn_b720divZyl 0 0 -180.000439 179.994946 /begin IF_DATA ASAP1B_ETK KP_BLOB 0x3834B4 1 2 /end IF_DATA BIT_MASK 0xFFFF /end MEASUREMENT
/begin MEASUREMENT fln51_05 "Lernfilterwert, negativ" SWORD dtsegn_b720divZyl 0 0 -180.000439 179.994946 /begin IF_DATA ASAP1B_ETK KP_BLOB 0x3834E4 1 2 /end IF_DATA BIT_MASK 0xFFFF /end MEASUREMENT
/begin MEASUREMENT fln51_06 "Lernfilterwert, negativ" SWORD dtsegn_b720divZyl 0 0 -180.000439 179.994946 /begin IF_DATA ASAP1B_ETK KP_BLOB 0x383514 1 2 /end IF_DATA BIT_MASK 0xFFFF /end MEASUREMENT
/begin MEASUREMENT fln51_07 "Lernfilterwert, negativ" SWORD dtsegn_b720divZyl 0 0 -180.000439 179.994946 /begin IF_DATA ASAP1B_ETK KP_BLOB 0x383544 1 2 /end IF_DATA BIT_MASK 0xFFFF /end MEASUREMENT
/begin MEASUREMENT fln51_08 "Lernfilterwert, negativ" SWORD dtsegn_b720divZyl 0 0 -180.000439 179.994946 /begin IF_DATA ASAP1B_ETK KP_BLOB 0x383574 1 2 /end IF_DATA BIT_MASK 0xFFFF /end MEASUREMENT
/begin MEASUREMENT fln52_02 "Lernfilterwert, negativ" SWORD dtsegn_b720divZyl 0 0 -180.000439 179.994946 /begin IF_DATA ASAP1B_ETK KP_BLOB 0x383464 1 2 /end IF_DATA BIT_MASK 0xFFFF /end MEASUREMENT
/begin MEASUREMENT fln52_03 "Lernfilterwert, negativ" SWORD dtsegn_b720divZyl 0 0 -180.000439 179.994946 /begin IF_DATA ASAP1B_ETK KP_BLOB 0x383494 1 2 /end IF_DATA BIT_MASK 0xFFFF /end MEASUREMENT
/begin MEASUREMENT fln52_04 "Lernfilterwert, negativ" SWORD dtsegn_b720divZyl 0 0 -180.000439 179.994946 /begin IF_DATA ASAP1B_ETK KP_BLOB 0x3834C4 1 2 /end IF_DATA BIT_MASK 0xFFFF /end MEASUREMENT
/begin MEASUREMENT fln52_05 "Lernfilterwert, negativ" SWORD dtsegn_b720divZyl 0 0 -180.000439 179.994946 /begin IF_DATA ASAP1B_ETK KP_BLOB 0x3834F4 1 2 /end IF_DATA BIT_MASK 0xFFFF /end MEASUREMENT
/begin MEASUREMENT fln52_06 "Lernfilterwert, negativ" SWORD dtsegn_b720divZyl 0 0 -180.000439 179.994946 /begin IF_DATA ASAP1B_ETK KP_BLOB 0x383524 1 2 /end IF_DATA BIT_MASK 0xFFFF /end MEASUREMENT
/begin MEASUREMENT fln52_07 "Lernfilterwert, negativ" SWORD dtsegn_b720divZyl 0 0 -180.000439 179.994946 /begin IF_DATA ASAP1B_ETK KP_BLOB 0x383554 1 2 /end IF_DATA BIT_MASK 0xFFFF /end MEASUREMENT
/begin MEASUREMENT fln52_08 "Lernfilterwert, negativ" SWORD dtsegn_b720divZyl 0 0 -180.000439 179.994946 /begin IF_DATA ASAP1B_ETK KP_BLOB 0x383584 1 2 /end IF_DATA BIT_MASK 0xFFFF /end MEASUREMENT
/begin MEASUREMENT fln53_02 "Lernfilterwert, negativ" SWORD dtsegn_b720divZyl 0 0 -180.000439 179.994946 /begin IF_DATA ASAP1B_ETK KP_BLOB 0x383474 1 2 /end IF_DATA BIT_MASK 0xFFFF /end MEASUREMENT
/begin MEASUREMENT fln53_03 "Lernfilterwert, negativ" SWORD dtsegn_b720divZyl 0 0 -180.000439 179.994946 /begin IF_DATA ASAP1B_ETK KP_BLOB 0x3834A4 1 2 /end IF_DATA BIT_MASK 0xFFFF /end MEASUREMENT
/begin MEASUREMENT fln53_04 "Lernfilterwert, negativ" SWORD dtsegn_b720divZyl 0 0 -180.000439 179.994946 /begin IF_DATA ASAP1B_ETK KP_BLOB 0x3834D4 1 2 /end IF_DATA BIT_MASK 0xFFFF /end MEASUREMENT
/begin MEASUREMENT fln53_05 "Lernfilterwert, negativ" SWORD dtsegn_b720divZyl 0 0 -180.000439 179.994946 /begin IF_DATA ASAP1B_ETK KP_BLOB 0x383504 1 2 /end IF_DATA BIT_MASK 0xFFFF /end MEASUREMENT
/begin MEASUREMENT fln53_06 "Lernfilterwert, negativ" SWORD dtsegn_b720divZyl 0 0 -180.000439 179.994946 /begin IF_DATA ASAP1B_ETK KP_BLOB 0x383534 1 2 /end IF_DATA BIT_MASK 0xFFFF /end MEASUREMENT
/begin MEASUREMENT fln53_07 "Lernfilterwert, negativ" SWORD dtsegn_b720divZyl 0 0 -180.000439 179.994946 /begin IF_DATA ASAP1B_ETK KP_BLOB 0x383564 1 2 /end IF_DATA BIT_MASK 0xFFFF /end MEASUREMENT
/begin MEASUREMENT fln53_08 "Lernfilterwert, negativ" SWORD dtsegn_b720divZyl 0 0 -180.000439 179.994946 /begin IF_DATA ASAP1B_ETK KP_BLOB 0x383594 1 2 /end IF_DATA BIT_MASK 0xFFFF /end MEASUREMENT
/begin MEASUREMENT fln61_02 "Lernfilterwert, negativ" SWORD dtsegn_b720divZyl 0 0 -180.000439 179.994946 /begin IF_DATA ASAP1B_ETK KP_BLOB 0x383456 1 2 /end IF_DATA BIT_MASK 0xFFFF /end MEASUREMENT
/begin MEASUREMENT fln61_03 "Lernfilterwert, negativ" SWORD dtsegn_b720divZyl 0 0 -180.000439 179.994946 /begin IF_DATA ASAP1B_ETK KP_BLOB 0x383486 1 2 /end IF_DATA BIT_MASK 0xFFFF /end MEASUREMENT
/begin MEASUREMENT fln61_04 "Lernfilterwert, negativ" SWORD dtsegn_b720divZyl 0 0 -180.000439 179.994946 /begin IF_DATA ASAP1B_ETK KP_BLOB 0x3834B6 1 2 /end IF_DATA BIT_MASK 0xFFFF /end MEASUREMENT
/begin MEASUREMENT fln61_05 "Lernfilterwert, negativ" SWORD dtsegn_b720divZyl 0 0 -180.000439 179.994946 /begin IF_DATA ASAP1B_ETK KP_BLOB 0x3834E6 1 2 /end IF_DATA BIT_MASK 0xFFFF /end MEASUREMENT
/begin MEASUREMENT fln61_06 "Lernfilterwert, negativ" SWORD dtsegn_b720divZyl 0 0 -180.000439 179.994946 /begin IF_DATA ASAP1B_ETK KP_BLOB 0x383516 1 2 /end IF_DATA BIT_MASK 0xFFFF /end MEASUREMENT
/begin MEASUREMENT fln61_07 "Lernfilterwert, negativ" SWORD dtsegn_b720divZyl 0 0 -180.000439 179.994946 /begin IF_DATA ASAP1B_ETK KP_BLOB 0x383546 1 2 /end IF_DATA BIT_MASK 0xFFFF /end MEASUREMENT
/begin MEASUREMENT fln61_08 "Lernfilterwert, negativ" SWORD dtsegn_b720divZyl 0 0 -180.000439 179.994946 /begin IF_DATA ASAP1B_ETK KP_BLOB 0x383576 1 2 /end IF_DATA BIT_MASK 0xFFFF /end MEASUREMENT
/begin MEASUREMENT fln62_02 "Lernfilterwert, negativ" SWORD dtsegn_b720divZyl 0 0 -180.000439 179.994946 /begin IF_DATA ASAP1B_ETK KP_BLOB 0x383466 1 2 /end IF_DATA BIT_MASK 0xFFFF /end MEASUREMENT
/begin MEASUREMENT fln62_03 "Lernfilterwert, negativ" SWORD dtsegn_b720divZyl 0 0 -180.000439 179.994946 /begin IF_DATA ASAP1B_ETK KP_BLOB 0x383496 1 2 /end IF_DATA BIT_MASK 0xFFFF /end MEASUREMENT
/begin MEASUREMENT fln62_04 "Lernfilterwert, negativ" SWORD dtsegn_b720divZyl 0 0 -180.000439 179.994946 /begin IF_DATA ASAP1B_ETK KP_BLOB 0x3834C6 1 2 /end IF_DATA BIT_MASK 0xFFFF /end MEASUREMENT
/begin MEASUREMENT fln62_05 "Lernfilterwert, negativ" SWORD dtsegn_b720divZyl 0 0 -180.000439 179.994946 /begin IF_DATA ASAP1B_ETK KP_BLOB 0x3834F6 1 2 /end IF_DATA BIT_MASK 0xFFFF /end MEASUREMENT
/begin MEASUREMENT fln62_06 "Lernfilterwert, negativ" SWORD dtsegn_b720divZyl 0 0 -180.000439 179.994946 /begin IF_DATA ASAP1B_ETK KP_BLOB 0x383526 1 2 /end IF_DATA BIT_MASK 0xFFFF /end MEASUREMENT
/begin MEASUREMENT fln62_07 "Lernfilterwert, negativ" SWORD dtsegn_b720divZyl 0 0 -180.000439 179.994946 /begin IF_DATA ASAP1B_ETK KP_BLOB 0x383556 1 2 /end IF_DATA BIT_MASK 0xFFFF /end MEASUREMENT
/begin MEASUREMENT fln62_08 "Lernfilterwert, negativ" SWORD dtsegn_b720divZyl 0 0 -180.000439 179.994946 /begin IF_DATA ASAP1B_ETK KP_BLOB 0x383586 1 2 /end IF_DATA BIT_MASK 0xFFFF /end MEASUREMENT
/begin MEASUREMENT fln63_02 "Lernfilterwert, negativ" SWORD dtsegn_b720divZyl 0 0 -180.000439 179.994946 /begin IF_DATA ASAP1B_ETK KP_BLOB 0x383476 1 2 /end IF_DATA BIT_MASK 0xFFFF /end MEASUREMENT
/begin MEASUREMENT fln63_03 "Lernfilterwert, negativ" SWORD dtsegn_b720divZyl 0 0 -180.000439 179.994946 /begin IF_DATA ASAP1B_ETK KP_BLOB 0x3834A6 1 2 /end IF_DATA BIT_MASK 0xFFFF /end MEASUREMENT
/begin MEASUREMENT fln63_04 "Lernfilterwert, negativ" SWORD dtsegn_b720divZyl 0 0 -180.000439 179.994946 /begin IF_DATA ASAP1B_ETK KP_BLOB 0x3834D6 1 2 /end IF_DATA BIT_MASK 0xFFFF /end MEASUREMENT
/begin MEASUREMENT fln63_05 "Lernfilterwert, negativ" SWORD dtsegn_b720divZyl 0 0 -180.000439 179.994946 /begin IF_DATA ASAP1B_ETK KP_BLOB 0x383506 1 2 /end IF_DATA BIT_MASK 0xFFFF /end MEASUREMENT
/begin MEASUREMENT fln63_06 "Lernfilterwert, negativ" SWORD dtsegn_b720divZyl 0 0 -180.000439 179.994946 /begin IF_DATA ASAP1B_ETK KP_BLOB 0x383536 1 2 /end IF_DATA BIT_MASK 0xFFFF /end MEASUREMENT
/begin MEASUREMENT fln63_07 "Lernfilterwert, negativ" SWORD dtsegn_b720divZyl 0 0 -180.000439 179.994946 /begin IF_DATA ASAP1B_ETK KP_BLOB 0x383566 1 2 /end IF_DATA BIT_MASK 0xFFFF /end MEASUREMENT
/begin MEASUREMENT fln63_08 "Lernfilterwert, negativ" SWORD dtsegn_b720divZyl 0 0 -180.000439 179.994946 /begin IF_DATA ASAP1B_ETK KP_BLOB 0x383596 1 2 /end IF_DATA BIT_MASK 0xFFFF /end MEASUREMENT
/begin MEASUREMENT fln71_02 "Lernfilterwert, negativ" SWORD dtsegn_b720divZyl 0 0 -180.000439 179.994946 /begin IF_DATA ASAP1B_ETK KP_BLOB 0x383458 1 2 /end IF_DATA BIT_MASK 0xFFFF /end MEASUREMENT
/begin MEASUREMENT fln71_03 "Lernfilterwert, negativ" SWORD dtsegn_b720divZyl 0 0 -180.000439 179.994946 /begin IF_DATA ASAP1B_ETK KP_BLOB 0x383488 1 2 /end IF_DATA BIT_MASK 0xFFFF /end MEASUREMENT
/begin MEASUREMENT fln71_04 "Lernfilterwert, negativ" SWORD dtsegn_b720divZyl 0 0 -180.000439 179.994946 /begin IF_DATA ASAP1B_ETK KP_BLOB 0x3834B8 1 2 /end IF_DATA BIT_MASK 0xFFFF /end MEASUREMENT
/begin MEASUREMENT fln71_05 "Lernfilterwert, negativ" SWORD dtsegn_b720divZyl 0 0 -180.000439 179.994946 /begin IF_DATA ASAP1B_ETK KP_BLOB 0x3834E8 1 2 /end IF_DATA BIT_MASK 0xFFFF /end MEASUREMENT
/begin MEASUREMENT fln71_06 "Lernfilterwert, negativ" SWORD dtsegn_b720divZyl 0 0 -180.000439 179.994946 /begin IF_DATA ASAP1B_ETK KP_BLOB 0x383518 1 2 /end IF_DATA BIT_MASK 0xFFFF /end MEASUREMENT
/begin MEASUREMENT fln71_07 "Lernfilterwert, negativ" SWORD dtsegn_b720divZyl 0 0 -180.000439 179.994946 /begin IF_DATA ASAP1B_ETK KP_BLOB 0x383548 1 2 /end IF_DATA BIT_MASK 0xFFFF /end MEASUREMENT
/begin MEASUREMENT fln71_08 "Lernfilterwert, negativ" SWORD dtsegn_b720divZyl 0 0 -180.000439 179.994946 /begin IF_DATA ASAP1B_ETK KP_BLOB 0x383578 1 2 /end IF_DATA BIT_MASK 0xFFFF /end MEASUREMENT
/begin MEASUREMENT fln72_02 "Lernfilterwert, negativ" SWORD dtsegn_b720divZyl 0 0 -180.000439 179.994946 /begin IF_DATA ASAP1B_ETK KP_BLOB 0x383468 1 2 /end IF_DATA BIT_MASK 0xFFFF /end MEASUREMENT
/begin MEASUREMENT fln72_03 "Lernfilterwert, negativ" SWORD dtsegn_b720divZyl 0 0 -180.000439 179.994946 /begin IF_DATA ASAP1B_ETK KP_BLOB 0x383498 1 2 /end IF_DATA BIT_MASK 0xFFFF /end MEASUREMENT
/begin MEASUREMENT fln72_04 "Lernfilterwert, negativ" SWORD dtsegn_b720divZyl 0 0 -180.000439 179.994946 /begin IF_DATA ASAP1B_ETK KP_BLOB 0x3834C8 1 2 /end IF_DATA BIT_MASK 0xFFFF /end MEASUREMENT
/begin MEASUREMENT fln72_05 "Lernfilterwert, negativ" SWORD dtsegn_b720divZyl 0 0 -180.000439 179.994946 /begin IF_DATA ASAP1B_ETK KP_BLOB 0x3834F8 1 2 /end IF_DATA BIT_MASK 0xFFFF /end MEASUREMENT
/begin MEASUREMENT fln72_06 "Lernfilterwert, negativ" SWORD dtsegn_b720divZyl 0 0 -180.000439 179.994946 /begin IF_DATA ASAP1B_ETK KP_BLOB 0x383528 1 2 /end IF_DATA BIT_MASK 0xFFFF /end MEASUREMENT
/begin MEASUREMENT fln72_07 "Lernfilterwert, negativ" SWORD dtsegn_b720divZyl 0 0 -180.000439 179.994946 /begin IF_DATA ASAP1B_ETK KP_BLOB 0x383558 1 2 /end IF_DATA BIT_MASK 0xFFFF /end MEASUREMENT
/begin MEASUREMENT fln72_08 "Lernfilterwert, negativ" SWORD dtsegn_b720divZyl 0 0 -180.000439 179.994946 /begin IF_DATA ASAP1B_ETK KP_BLOB 0x383588 1 2 /end IF_DATA BIT_MASK 0xFFFF /end MEASUREMENT
/begin MEASUREMENT fln73_02 "Lernfilterwert, negativ" SWORD dtsegn_b720divZyl 0 0 -180.000439 179.994946 /begin IF_DATA ASAP1B_ETK KP_BLOB 0x383478 1 2 /end IF_DATA BIT_MASK 0xFFFF /end MEASUREMENT
/begin MEASUREMENT fln73_03 "Lernfilterwert, negativ" SWORD dtsegn_b720divZyl 0 0 -180.000439 179.994946 /begin IF_DATA ASAP1B_ETK KP_BLOB 0x3834A8 1 2 /end IF_DATA BIT_MASK 0xFFFF /end MEASUREMENT
/begin MEASUREMENT fln73_04 "Lernfilterwert, negativ" SWORD dtsegn_b720divZyl 0 0 -180.000439 179.994946 /begin IF_DATA ASAP1B_ETK KP_BLOB 0x3834D8 1 2 /end IF_DATA BIT_MASK 0xFFFF /end MEASUREMENT
/begin MEASUREMENT fln73_05 "Lernfilterwert, negativ" SWORD dtsegn_b720divZyl 0 0 -180.000439 179.994946 /begin IF_DATA ASAP1B_ETK KP_BLOB 0x383508 1 2 /end IF_DATA BIT_MASK 0xFFFF /end MEASUREMENT
/begin MEASUREMENT fln73_06 "Lernfilterwert, negativ" SWORD dtsegn_b720divZyl 0 0 -180.000439 179.994946 /begin IF_DATA ASAP1B_ETK KP_BLOB 0x383538 1 2 /end IF_DATA BIT_MASK 0xFFFF /end MEASUREMENT
/begin MEASUREMENT fln73_07 "Lernfilterwert, negativ" SWORD dtsegn_b720divZyl 0 0 -180.000439 179.994946 /begin IF_DATA ASAP1B_ETK KP_BLOB 0x383568 1 2 /end IF_DATA BIT_MASK 0xFFFF /end MEASUREMENT
/begin MEASUREMENT fln73_08 "Lernfilterwert, negativ" SWORD dtsegn_b720divZyl 0 0 -180.000439 179.994946 /begin IF_DATA ASAP1B_ETK KP_BLOB 0x383598 1 2 /end IF_DATA BIT_MASK 0xFFFF /end MEASUREMENT
/begin MEASUREMENT fln81_02 "Lernfilterwert, negativ" SWORD dtsegn_b720divZyl 0 0 -180.000439 179.994946 /begin IF_DATA ASAP1B_ETK KP_BLOB 0x38345A 1 2 /end IF_DATA BIT_MASK 0xFFFF /end MEASUREMENT
/begin MEASUREMENT fln81_03 "Lernfilterwert, negativ" SWORD dtsegn_b720divZyl 0 0 -180.000439 179.994946 /begin IF_DATA ASAP1B_ETK KP_BLOB 0x38348A 1 2 /end IF_DATA BIT_MASK 0xFFFF /end MEASUREMENT
/begin MEASUREMENT fln81_04 "Lernfilterwert, negativ" SWORD dtsegn_b720divZyl 0 0 -180.000439 179.994946 /begin IF_DATA ASAP1B_ETK KP_BLOB 0x3834BA 1 2 /end IF_DATA BIT_MASK 0xFFFF /end MEASUREMENT
/begin MEASUREMENT fln81_05 "Lernfilterwert, negativ" SWORD dtsegn_b720divZyl 0 0 -180.000439 179.994946 /begin IF_DATA ASAP1B_ETK KP_BLOB 0x3834EA 1 2 /end IF_DATA BIT_MASK 0xFFFF /end MEASUREMENT
/begin MEASUREMENT fln81_06 "Lernfilterwert, negativ" SWORD dtsegn_b720divZyl 0 0 -180.000439 179.994946 /begin IF_DATA ASAP1B_ETK KP_BLOB 0x38351A 1 2 /end IF_DATA BIT_MASK 0xFFFF /end MEASUREMENT
/begin MEASUREMENT fln81_07 "Lernfilterwert, negativ" SWORD dtsegn_b720divZyl 0 0 -180.000439 179.994946 /begin IF_DATA ASAP1B_ETK KP_BLOB 0x38354A 1 2 /end IF_DATA BIT_MASK 0xFFFF /end MEASUREMENT
/begin MEASUREMENT fln81_08 "Lernfilterwert, negativ" SWORD dtsegn_b720divZyl 0 0 -180.000439 179.994946 /begin IF_DATA ASAP1B_ETK KP_BLOB 0x38357A 1 2 /end IF_DATA BIT_MASK 0xFFFF /end MEASUREMENT
/begin MEASUREMENT fln82_02 "Lernfilterwert, negativ" SWORD dtsegn_b720divZyl 0 0 -180.000439 179.994946 /begin IF_DATA ASAP1B_ETK KP_BLOB 0x38346A 1 2 /end IF_DATA BIT_MASK 0xFFFF /end MEASUREMENT
/begin MEASUREMENT fln82_03 "Lernfilterwert, negativ" SWORD dtsegn_b720divZyl 0 0 -180.000439 179.994946 /begin IF_DATA ASAP1B_ETK KP_BLOB 0x38349A 1 2 /end IF_DATA BIT_MASK 0xFFFF /end MEASUREMENT
/begin MEASUREMENT fln82_04 "Lernfilterwert, negativ" SWORD dtsegn_b720divZyl 0 0 -180.000439 179.994946 /begin IF_DATA ASAP1B_ETK KP_BLOB 0x3834CA 1 2 /end IF_DATA BIT_MASK 0xFFFF /end MEASUREMENT
/begin MEASUREMENT fln82_05 "Lernfilterwert, negativ" SWORD dtsegn_b720divZyl 0 0 -180.000439 179.994946 /begin IF_DATA ASAP1B_ETK KP_BLOB 0x3834FA 1 2 /end IF_DATA BIT_MASK 0xFFFF /end MEASUREMENT
/begin MEASUREMENT fln82_06 "Lernfilterwert, negativ" SWORD dtsegn_b720divZyl 0 0 -180.000439 179.994946 /begin IF_DATA ASAP1B_ETK KP_BLOB 0x38352A 1 2 /end IF_DATA BIT_MASK 0xFFFF /end MEASUREMENT
/begin MEASUREMENT fln82_07 "Lernfilterwert, negativ" SWORD dtsegn_b720divZyl 0 0 -180.000439 179.994946 /begin IF_DATA ASAP1B_ETK KP_BLOB 0x38355A 1 2 /end IF_DATA BIT_MASK 0xFFFF /end MEASUREMENT
/begin MEASUREMENT fln82_08 "Lernfilterwert, negativ" SWORD dtsegn_b720divZyl 0 0 -180.000439 179.994946 /begin IF_DATA ASAP1B_ETK KP_BLOB 0x38358A 1 2 /end IF_DATA BIT_MASK 0xFFFF /end MEASUREMENT
/begin MEASUREMENT fln83_02 "Lernfilterwert, negativ" SWORD dtsegn_b720divZyl 0 0 -180.000439 179.994946 /begin IF_DATA ASAP1B_ETK KP_BLOB 0x38347A 1 2 /end IF_DATA BIT_MASK 0xFFFF /end MEASUREMENT
/begin MEASUREMENT fln83_03 "Lernfilterwert, negativ" SWORD dtsegn_b720divZyl 0 0 -180.000439 179.994946 /begin IF_DATA ASAP1B_ETK KP_BLOB 0x3834AA 1 2 /end IF_DATA BIT_MASK 0xFFFF /end MEASUREMENT
/begin MEASUREMENT fln83_04 "Lernfilterwert, negativ" SWORD dtsegn_b720divZyl 0 0 -180.000439 179.994946 /begin IF_DATA ASAP1B_ETK KP_BLOB 0x3834DA 1 2 /end IF_DATA BIT_MASK 0xFFFF /end MEASUREMENT
/begin MEASUREMENT fln83_05 "Lernfilterwert, negativ" SWORD dtsegn_b720divZyl 0 0 -180.000439 179.994946 /begin IF_DATA ASAP1B_ETK KP_BLOB 0x38350A 1 2 /end IF_DATA BIT_MASK 0xFFFF /end MEASUREMENT
/begin MEASUREMENT fln83_06 "Lernfilterwert, negativ" SWORD dtsegn_b720divZyl 0 0 -180.000439 179.994946 /begin IF_DATA ASAP1B_ETK KP_BLOB 0x38353A 1 2 /end IF_DATA BIT_MASK 0xFFFF /end MEASUREMENT
/begin MEASUREMENT fln83_07 "Lernfilterwert, negativ" SWORD dtsegn_b720divZyl 0 0 -180.000439 179.994946 /begin IF_DATA ASAP1B_ETK KP_BLOB 0x38356A 1 2 /end IF_DATA BIT_MASK 0xFFFF /end MEASUREMENT
/begin MEASUREMENT fln83_08 "Lernfilterwert, negativ" SWORD dtsegn_b720divZyl 0 0 -180.000439 179.994946 /begin IF_DATA ASAP1B_ETK KP_BLOB 0x38359A 1 2 /end IF_DATA BIT_MASK 0xFFFF /end MEASUREMENT
/begin MEASUREMENT flp11_02 "Lernfilterwert, positiv" SWORD dtsegn_b720divZyl 0 0 -180.000439 179.994946 /begin IF_DATA ASAP1B_ETK KP_BLOB 0x38359C 1 2 /end IF_DATA BIT_MASK 0xFFFF /end MEASUREMENT
/begin MEASUREMENT flp11_03 "Lernfilterwert, positiv" SWORD dtsegn_b720divZyl 0 0 -180.000439 179.994946 /begin IF_DATA ASAP1B_ETK KP_BLOB 0x3835CC 1 2 /end IF_DATA BIT_MASK 0xFFFF /end MEASUREMENT
/begin MEASUREMENT flp11_04 "Lernfilterwert, positiv" SWORD dtsegn_b720divZyl 0 0 -180.000439 179.994946 /begin IF_DATA ASAP1B_ETK KP_BLOB 0x3835FC 1 2 /end IF_DATA BIT_MASK 0xFFFF /end MEASUREMENT
/begin MEASUREMENT flp11_05 "Lernfilterwert, positiv" SWORD dtsegn_b720divZyl 0 0 -180.000439 179.994946 /begin IF_DATA ASAP1B_ETK KP_BLOB 0x38362C 1 2 /end IF_DATA BIT_MASK 0xFFFF /end MEASUREMENT
/begin MEASUREMENT flp11_06 "Lernfilterwert, positiv" SWORD dtsegn_b720divZyl 0 0 -180.000439 179.994946 /begin IF_DATA ASAP1B_ETK KP_BLOB 0x38365C 1 2 /end IF_DATA BIT_MASK 0xFFFF /end MEASUREMENT
/begin MEASUREMENT flp11_07 "Lernfilterwert, positiv" SWORD dtsegn_b720divZyl 0 0 -180.000439 179.994946 /begin IF_DATA ASAP1B_ETK KP_BLOB 0x38368C 1 2 /end IF_DATA BIT_MASK 0xFFFF /end MEASUREMENT
/begin MEASUREMENT flp11_08 "Lernfilterwert, positiv" SWORD dtsegn_b720divZyl 0 0 -180.000439 179.994946 /begin IF_DATA ASAP1B_ETK KP_BLOB 0x3836BC 1 2 /end IF_DATA BIT_MASK 0xFFFF /end MEASUREMENT
/begin MEASUREMENT flp12_02 "Lernfilterwert, positiv" SWORD dtsegn_b720divZyl 0 0 -180.000439 179.994946 /begin IF_DATA ASAP1B_ETK KP_BLOB 0x3835AC 1 2 /end IF_DATA BIT_MASK 0xFFFF /end MEASUREMENT
/begin MEASUREMENT flp12_03 "Lernfilterwert, positiv" SWORD dtsegn_b720divZyl 0 0 -180.000439 179.994946 /begin IF_DATA ASAP1B_ETK KP_BLOB 0x3835DC 1 2 /end IF_DATA BIT_MASK 0xFFFF /end MEASUREMENT
/begin MEASUREMENT flp12_04 "Lernfilterwert, positiv" SWORD dtsegn_b720divZyl 0 0 -180.000439 179.994946 /begin IF_DATA ASAP1B_ETK KP_BLOB 0x38360C 1 2 /end IF_DATA BIT_MASK 0xFFFF /end MEASUREMENT
/begin MEASUREMENT flp12_05 "Lernfilterwert, positiv" SWORD dtsegn_b720divZyl 0 0 -180.000439 179.994946 /begin IF_DATA ASAP1B_ETK KP_BLOB 0x38363C 1 2 /end IF_DATA BIT_MASK 0xFFFF /end MEASUREMENT
/begin MEASUREMENT flp12_06 "Lernfilterwert, positiv" SWORD dtsegn_b720divZyl 0 0 -180.000439 179.994946 /begin IF_DATA ASAP1B_ETK KP_BLOB 0x38366C 1 2 /end IF_DATA BIT_MASK 0xFFFF /end MEASUREMENT
/begin MEASUREMENT flp12_07 "Lernfilterwert, positiv" SWORD dtsegn_b720divZyl 0 0 -180.000439 179.994946 /begin IF_DATA ASAP1B_ETK KP_BLOB 0x38369C 1 2 /end IF_DATA BIT_MASK 0xFFFF /end MEASUREMENT
/begin MEASUREMENT flp12_08 "Lernfilterwert, positiv" SWORD dtsegn_b720divZyl 0 0 -180.000439 179.994946 /begin IF_DATA ASAP1B_ETK KP_BLOB 0x3836CC 1 2 /end IF_DATA BIT_MASK 0xFFFF /end MEASUREMENT
/begin MEASUREMENT flp13_02 "Lernfilterwert, positiv" SWORD dtsegn_b720divZyl 0 0 -180.000439 179.994946 /begin IF_DATA ASAP1B_ETK KP_BLOB 0x3835BC 1 2 /end IF_DATA BIT_MASK 0xFFFF /end MEASUREMENT
/begin MEASUREMENT flp13_03 "Lernfilterwert, positiv" SWORD dtsegn_b720divZyl 0 0 -180.000439 179.994946 /begin IF_DATA ASAP1B_ETK KP_BLOB 0x3835EC 1 2 /end IF_DATA BIT_MASK 0xFFFF /end MEASUREMENT
/begin MEASUREMENT flp13_04 "Lernfilterwert, positiv" SWORD dtsegn_b720divZyl 0 0 -180.000439 179.994946 /begin IF_DATA ASAP1B_ETK KP_BLOB 0x38361C 1 2 /end IF_DATA BIT_MASK 0xFFFF /end MEASUREMENT
/begin MEASUREMENT flp13_05 "Lernfilterwert, positiv" SWORD dtsegn_b720divZyl 0 0 -180.000439 179.994946 /begin IF_DATA ASAP1B_ETK KP_BLOB 0x38364C 1 2 /end IF_DATA BIT_MASK 0xFFFF /end MEASUREMENT
/begin MEASUREMENT flp13_06 "Lernfilterwert, positiv" SWORD dtsegn_b720divZyl 0 0 -180.000439 179.994946 /begin IF_DATA ASAP1B_ETK KP_BLOB 0x38367C 1 2 /end IF_DATA BIT_MASK 0xFFFF /end MEASUREMENT
/begin MEASUREMENT flp13_07 "Lernfilterwert, positiv" SWORD dtsegn_b720divZyl 0 0 -180.000439 179.994946 /begin IF_DATA ASAP1B_ETK KP_BLOB 0x3836AC 1 2 /end IF_DATA BIT_MASK 0xFFFF /end MEASUREMENT
/begin MEASUREMENT flp13_08 "Lernfilterwert, positiv" SWORD dtsegn_b720divZyl 0 0 -180.000439 179.994946 /begin IF_DATA ASAP1B_ETK KP_BLOB 0x3836DC 1 2 /end IF_DATA BIT_MASK 0xFFFF /end MEASUREMENT
/begin MEASUREMENT flp21_02 "Lernfilterwert, positiv" SWORD dtsegn_b720divZyl 0 0 -180.000439 179.994946 /begin IF_DATA ASAP1B_ETK KP_BLOB 0x38359E 1 2 /end IF_DATA BIT_MASK 0xFFFF /end MEASUREMENT
/begin MEASUREMENT flp21_03 "Lernfilterwert, positiv" SWORD dtsegn_b720divZyl 0 0 -180.000439 179.994946 /begin IF_DATA ASAP1B_ETK KP_BLOB 0x3835CE 1 2 /end IF_DATA BIT_MASK 0xFFFF /end MEASUREMENT
/begin MEASUREMENT flp21_04 "Lernfilterwert, positiv" SWORD dtsegn_b720divZyl 0 0 -180.000439 179.994946 /begin IF_DATA ASAP1B_ETK KP_BLOB 0x3835FE 1 2 /end IF_DATA BIT_MASK 0xFFFF /end MEASUREMENT
/begin MEASUREMENT flp21_05 "Lernfilterwert, positiv" SWORD dtsegn_b720divZyl 0 0 -180.000439 179.994946 /begin IF_DATA ASAP1B_ETK KP_BLOB 0x38362E 1 2 /end IF_DATA BIT_MASK 0xFFFF /end MEASUREMENT
/begin MEASUREMENT flp21_06 "Lernfilterwert, positiv" SWORD dtsegn_b720divZyl 0 0 -180.000439 179.994946 /begin IF_DATA ASAP1B_ETK KP_BLOB 0x38365E 1 2 /end IF_DATA BIT_MASK 0xFFFF /end MEASUREMENT
/begin MEASUREMENT flp21_07 "Lernfilterwert, positiv" SWORD dtsegn_b720divZyl 0 0 -180.000439 179.994946 /begin IF_DATA ASAP1B_ETK KP_BLOB 0x38368E 1 2 /end IF_DATA BIT_MASK 0xFFFF /end MEASUREMENT
/begin MEASUREMENT flp21_08 "Lernfilterwert, positiv" SWORD dtsegn_b720divZyl 0 0 -180.000439 179.994946 /begin IF_DATA ASAP1B_ETK KP_BLOB 0x3836BE 1 2 /end IF_DATA BIT_MASK 0xFFFF /end MEASUREMENT
/begin MEASUREMENT flp22_02 "Lernfilterwert, positiv" SWORD dtsegn_b720divZyl 0 0 -180.000439 179.994946 /begin IF_DATA ASAP1B_ETK KP_BLOB 0x3835AE 1 2 /end IF_DATA BIT_MASK 0xFFFF /end MEASUREMENT
/begin MEASUREMENT flp22_03 "Lernfilterwert, positiv" SWORD dtsegn_b720divZyl 0 0 -180.000439 179.994946 /begin IF_DATA ASAP1B_ETK KP_BLOB 0x3835DE 1 2 /end IF_DATA BIT_MASK 0xFFFF /end MEASUREMENT
/begin MEASUREMENT flp22_04 "Lernfilterwert, positiv" SWORD dtsegn_b720divZyl 0 0 -180.000439 179.994946 /begin IF_DATA ASAP1B_ETK KP_BLOB 0x38360E 1 2 /end IF_DATA BIT_MASK 0xFFFF /end MEASUREMENT
/begin MEASUREMENT flp22_05 "Lernfilterwert, positiv" SWORD dtsegn_b720divZyl 0 0 -180.000439 179.994946 /begin IF_DATA ASAP1B_ETK KP_BLOB 0x38363E 1 2 /end IF_DATA BIT_MASK 0xFFFF /end MEASUREMENT
/begin MEASUREMENT flp22_06 "Lernfilterwert, positiv" SWORD dtsegn_b720divZyl 0 0 -180.000439 179.994946 /begin IF_DATA ASAP1B_ETK KP_BLOB 0x38366E 1 2 /end IF_DATA BIT_MASK 0xFFFF /end MEASUREMENT
/begin MEASUREMENT flp22_07 "Lernfilterwert, positiv" SWORD dtsegn_b720divZyl 0 0 -180.000439 179.994946 /begin IF_DATA ASAP1B_ETK KP_BLOB 0x38369E 1 2 /end IF_DATA BIT_MASK 0xFFFF /end MEASUREMENT
/begin MEASUREMENT flp22_08 "Lernfilterwert, positiv" SWORD dtsegn_b720divZyl 0 0 -180.000439 179.994946 /begin IF_DATA ASAP1B_ETK KP_BLOB 0x3836CE 1 2 /end IF_DATA BIT_MASK 0xFFFF /end MEASUREMENT
/begin MEASUREMENT flp23_02 "Lernfilterwert, positiv" SWORD dtsegn_b720divZyl 0 0 -180.000439 179.994946 /begin IF_DATA ASAP1B_ETK KP_BLOB 0x3835BE 1 2 /end IF_DATA BIT_MASK 0xFFFF /end MEASUREMENT
/begin MEASUREMENT flp23_03 "Lernfilterwert, positiv" SWORD dtsegn_b720divZyl 0 0 -180.000439 179.994946 /begin IF_DATA ASAP1B_ETK KP_BLOB 0x3835EE 1 2 /end IF_DATA BIT_MASK 0xFFFF /end MEASUREMENT
/begin MEASUREMENT flp23_04 "Lernfilterwert, positiv" SWORD dtsegn_b720divZyl 0 0 -180.000439 179.994946 /begin IF_DATA ASAP1B_ETK KP_BLOB 0x38361E 1 2 /end IF_DATA BIT_MASK 0xFFFF /end MEASUREMENT
/begin MEASUREMENT flp23_05 "Lernfilterwert, positiv" SWORD dtsegn_b720divZyl 0 0 -180.000439 179.994946 /begin IF_DATA ASAP1B_ETK KP_BLOB 0x38364E 1 2 /end IF_DATA BIT_MASK 0xFFFF /end MEASUREMENT
/begin MEASUREMENT flp23_06 "Lernfilterwert, positiv" SWORD dtsegn_b720divZyl 0 0 -180.000439 179.994946 /begin IF_DATA ASAP1B_ETK KP_BLOB 0x38367E 1 2 /end IF_DATA BIT_MASK 0xFFFF /end MEASUREMENT
/begin MEASUREMENT flp23_07 "Lernfilterwert, positiv" SWORD dtsegn_b720divZyl 0 0 -180.000439 179.994946 /begin IF_DATA ASAP1B_ETK KP_BLOB 0x3836AE 1 2 /end IF_DATA BIT_MASK 0xFFFF /end MEASUREMENT
/begin MEASUREMENT flp23_08 "Lernfilterwert, positiv" SWORD dtsegn_b720divZyl 0 0 -180.000439 179.994946 /begin IF_DATA ASAP1B_ETK KP_BLOB 0x3836DE 1 2 /end IF_DATA BIT_MASK 0xFFFF /end MEASUREMENT
/begin MEASUREMENT flp31_02 "Lernfilterwert, positiv" SWORD dtsegn_b720divZyl 0 0 -180.000439 179.994946 /begin IF_DATA ASAP1B_ETK KP_BLOB 0x3835A0 1 2 /end IF_DATA BIT_MASK 0xFFFF /end MEASUREMENT
/begin MEASUREMENT flp31_03 "Lernfilterwert, positiv" SWORD dtsegn_b720divZyl 0 0 -180.000439 179.994946 /begin IF_DATA ASAP1B_ETK KP_BLOB 0x3835D0 1 2 /end IF_DATA BIT_MASK 0xFFFF /end MEASUREMENT
/begin MEASUREMENT flp31_04 "Lernfilterwert, positiv" SWORD dtsegn_b720divZyl 0 0 -180.000439 179.994946 /begin IF_DATA ASAP1B_ETK KP_BLOB 0x383600 1 2 /end IF_DATA BIT_MASK 0xFFFF /end MEASUREMENT
/begin MEASUREMENT flp31_05 "Lernfilterwert, positiv" SWORD dtsegn_b720divZyl 0 0 -180.000439 179.994946 /begin IF_DATA ASAP1B_ETK KP_BLOB 0x383630 1 2 /end IF_DATA BIT_MASK 0xFFFF /end MEASUREMENT
/begin MEASUREMENT flp31_06 "Lernfilterwert, positiv" SWORD dtsegn_b720divZyl 0 0 -180.000439 179.994946 /begin IF_DATA ASAP1B_ETK KP_BLOB 0x383660 1 2 /end IF_DATA BIT_MASK 0xFFFF /end MEASUREMENT
/begin MEASUREMENT flp31_07 "Lernfilterwert, positiv" SWORD dtsegn_b720divZyl 0 0 -180.000439 179.994946 /begin IF_DATA ASAP1B_ETK KP_BLOB 0x383690 1 2 /end IF_DATA BIT_MASK 0xFFFF /end MEASUREMENT
/begin MEASUREMENT flp31_08 "Lernfilterwert, positiv" SWORD dtsegn_b720divZyl 0 0 -180.000439 179.994946 /begin IF_DATA ASAP1B_ETK KP_BLOB 0x3836C0 1 2 /end IF_DATA BIT_MASK 0xFFFF /end MEASUREMENT
/begin MEASUREMENT flp32_02 "Lernfilterwert, positiv" SWORD dtsegn_b720divZyl 0 0 -180.000439 179.994946 /begin IF_DATA ASAP1B_ETK KP_BLOB 0x3835B0 1 2 /end IF_DATA BIT_MASK 0xFFFF /end MEASUREMENT
/begin MEASUREMENT flp32_03 "Lernfilterwert, positiv" SWORD dtsegn_b720divZyl 0 0 -180.000439 179.994946 /begin IF_DATA ASAP1B_ETK KP_BLOB 0x3835E0 1 2 /end IF_DATA BIT_MASK 0xFFFF /end MEASUREMENT
/begin MEASUREMENT flp32_04 "Lernfilterwert, positiv" SWORD dtsegn_b720divZyl 0 0 -180.000439 179.994946 /begin IF_DATA ASAP1B_ETK KP_BLOB 0x383610 1 2 /end IF_DATA BIT_MASK 0xFFFF /end MEASUREMENT
/begin MEASUREMENT flp32_05 "Lernfilterwert, positiv" SWORD dtsegn_b720divZyl 0 0 -180.000439 179.994946 /begin IF_DATA ASAP1B_ETK KP_BLOB 0x383640 1 2 /end IF_DATA BIT_MASK 0xFFFF /end MEASUREMENT
/begin MEASUREMENT flp32_06 "Lernfilterwert, positiv" SWORD dtsegn_b720divZyl 0 0 -180.000439 179.994946 /begin IF_DATA ASAP1B_ETK KP_BLOB 0x383670 1 2 /end IF_DATA BIT_MASK 0xFFFF /end MEASUREMENT
/begin MEASUREMENT flp32_07 "Lernfilterwert, positiv" SWORD dtsegn_b720divZyl 0 0 -180.000439 179.994946 /begin IF_DATA ASAP1B_ETK KP_BLOB 0x3836A0 1 2 /end IF_DATA BIT_MASK 0xFFFF /end MEASUREMENT
/begin MEASUREMENT flp32_08 "Lernfilterwert, positiv" SWORD dtsegn_b720divZyl 0 0 -180.000439 179.994946 /begin IF_DATA ASAP1B_ETK KP_BLOB 0x3836D0 1 2 /end IF_DATA BIT_MASK 0xFFFF /end MEASUREMENT
/begin MEASUREMENT flp33_02 "Lernfilterwert, positiv" SWORD dtsegn_b720divZyl 0 0 -180.000439 179.994946 /begin IF_DATA ASAP1B_ETK KP_BLOB 0x3835C0 1 2 /end IF_DATA BIT_MASK 0xFFFF /end MEASUREMENT
/begin MEASUREMENT flp33_03 "Lernfilterwert, positiv" SWORD dtsegn_b720divZyl 0 0 -180.000439 179.994946 /begin IF_DATA ASAP1B_ETK KP_BLOB 0x3835F0 1 2 /end IF_DATA BIT_MASK 0xFFFF /end MEASUREMENT
/begin MEASUREMENT flp33_04 "Lernfilterwert, positiv" SWORD dtsegn_b720divZyl 0 0 -180.000439 179.994946 /begin IF_DATA ASAP1B_ETK KP_BLOB 0x383620 1 2 /end IF_DATA BIT_MASK 0xFFFF /end MEASUREMENT
/begin MEASUREMENT flp33_05 "Lernfilterwert, positiv" SWORD dtsegn_b720divZyl 0 0 -180.000439 179.994946 /begin IF_DATA ASAP1B_ETK KP_BLOB 0x383650 1 2 /end IF_DATA BIT_MASK 0xFFFF /end MEASUREMENT
/begin MEASUREMENT flp33_06 "Lernfilterwert, positiv" SWORD dtsegn_b720divZyl 0 0 -180.000439 179.994946 /begin IF_DATA ASAP1B_ETK KP_BLOB 0x383680 1 2 /end IF_DATA BIT_MASK 0xFFFF /end MEASUREMENT
/begin MEASUREMENT flp33_07 "Lernfilterwert, positiv" SWORD dtsegn_b720divZyl 0 0 -180.000439 179.994946 /begin IF_DATA ASAP1B_ETK KP_BLOB 0x3836B0 1 2 /end IF_DATA BIT_MASK 0xFFFF /end MEASUREMENT
/begin MEASUREMENT flp33_08 "Lernfilterwert, positiv" SWORD dtsegn_b720divZyl 0 0 -180.000439 179.994946 /begin IF_DATA ASAP1B_ETK KP_BLOB 0x3836E0 1 2 /end IF_DATA BIT_MASK 0xFFFF /end MEASUREMENT
/begin MEASUREMENT flp41_02 "Lernfilterwert, positiv" SWORD dtsegn_b720divZyl 0 0 -180.000439 179.994946 /begin IF_DATA ASAP1B_ETK KP_BLOB 0x3835A2 1 2 /end IF_DATA BIT_MASK 0xFFFF /end MEASUREMENT
/begin MEASUREMENT flp41_03 "Lernfilterwert, positiv" SWORD dtsegn_b720divZyl 0 0 -180.000439 179.994946 /begin IF_DATA ASAP1B_ETK KP_BLOB 0x3835D2 1 2 /end IF_DATA BIT_MASK 0xFFFF /end MEASUREMENT
/begin MEASUREMENT flp41_04 "Lernfilterwert, positiv" SWORD dtsegn_b720divZyl 0 0 -180.000439 179.994946 /begin IF_DATA ASAP1B_ETK KP_BLOB 0x383602 1 2 /end IF_DATA BIT_MASK 0xFFFF /end MEASUREMENT
/begin MEASUREMENT flp41_05 "Lernfilterwert, positiv" SWORD dtsegn_b720divZyl 0 0 -180.000439 179.994946 /begin IF_DATA ASAP1B_ETK KP_BLOB 0x383632 1 2 /end IF_DATA BIT_MASK 0xFFFF /end MEASUREMENT
/begin MEASUREMENT flp41_06 "Lernfilterwert, positiv" SWORD dtsegn_b720divZyl 0 0 -180.000439 179.994946 /begin IF_DATA ASAP1B_ETK KP_BLOB 0x383662 1 2 /end IF_DATA BIT_MASK 0xFFFF /end MEASUREMENT
/begin MEASUREMENT flp41_07 "Lernfilterwert, positiv" SWORD dtsegn_b720divZyl 0 0 -180.000439 179.994946 /begin IF_DATA ASAP1B_ETK KP_BLOB 0x383692 1 2 /end IF_DATA BIT_MASK 0xFFFF /end MEASUREMENT
/begin MEASUREMENT flp41_08 "Lernfilterwert, positiv" SWORD dtsegn_b720divZyl 0 0 -180.000439 179.994946 /begin IF_DATA ASAP1B_ETK KP_BLOB 0x3836C2 1 2 /end IF_DATA BIT_MASK 0xFFFF /end MEASUREMENT
/begin MEASUREMENT flp42_02 "Lernfilterwert, positiv" SWORD dtsegn_b720divZyl 0 0 -180.000439 179.994946 /begin IF_DATA ASAP1B_ETK KP_BLOB 0x3835B2 1 2 /end IF_DATA BIT_MASK 0xFFFF /end MEASUREMENT
/begin MEASUREMENT flp42_03 "Lernfilterwert, positiv" SWORD dtsegn_b720divZyl 0 0 -180.000439 179.994946 /begin IF_DATA ASAP1B_ETK KP_BLOB 0x3835E2 1 2 /end IF_DATA BIT_MASK 0xFFFF /end MEASUREMENT
/begin MEASUREMENT flp42_04 "Lernfilterwert, positiv" SWORD dtsegn_b720divZyl 0 0 -180.000439 179.994946 /begin IF_DATA ASAP1B_ETK KP_BLOB 0x383612 1 2 /end IF_DATA BIT_MASK 0xFFFF /end MEASUREMENT
/begin MEASUREMENT flp42_05 "Lernfilterwert, positiv" SWORD dtsegn_b720divZyl 0 0 -180.000439 179.994946 /begin IF_DATA ASAP1B_ETK KP_BLOB 0x383642 1 2 /end IF_DATA BIT_MASK 0xFFFF /end MEASUREMENT
/begin MEASUREMENT flp42_06 "Lernfilterwert, positiv" SWORD dtsegn_b720divZyl 0 0 -180.000439 179.994946 /begin IF_DATA ASAP1B_ETK KP_BLOB 0x383672 1 2 /end IF_DATA BIT_MASK 0xFFFF /end MEASUREMENT
/begin MEASUREMENT flp42_07 "Lernfilterwert, positiv" SWORD dtsegn_b720divZyl 0 0 -180.000439 179.994946 /begin IF_DATA ASAP1B_ETK KP_BLOB 0x3836A2 1 2 /end IF_DATA BIT_MASK 0xFFFF /end MEASUREMENT
/begin MEASUREMENT flp42_08 "Lernfilterwert, positiv" SWORD dtsegn_b720divZyl 0 0 -180.000439 179.994946 /begin IF_DATA ASAP1B_ETK KP_BLOB 0x3836D2 1 2 /end IF_DATA BIT_MASK 0xFFFF /end MEASUREMENT
/begin MEASUREMENT flp43_02 "Lernfilterwert, positiv" SWORD dtsegn_b720divZyl 0 0 -180.000439 179.994946 /begin IF_DATA ASAP1B_ETK KP_BLOB 0x3835C2 1 2 /end IF_DATA BIT_MASK 0xFFFF /end MEASUREMENT
/begin MEASUREMENT flp43_03 "Lernfilterwert, positiv" SWORD dtsegn_b720divZyl 0 0 -180.000439 179.994946 /begin IF_DATA ASAP1B_ETK KP_BLOB 0x3835F2 1 2 /end IF_DATA BIT_MASK 0xFFFF /end MEASUREMENT
/begin MEASUREMENT flp43_04 "Lernfilterwert, positiv" SWORD dtsegn_b720divZyl 0 0 -180.000439 179.994946 /begin IF_DATA ASAP1B_ETK KP_BLOB 0x383622 1 2 /end IF_DATA BIT_MASK 0xFFFF /end MEASUREMENT
/begin MEASUREMENT flp43_05 "Lernfilterwert, positiv" SWORD dtsegn_b720divZyl 0 0 -180.000439 179.994946 /begin IF_DATA ASAP1B_ETK KP_BLOB 0x383652 1 2 /end IF_DATA BIT_MASK 0xFFFF /end MEASUREMENT
/begin MEASUREMENT flp43_06 "Lernfilterwert, positiv" SWORD dtsegn_b720divZyl 0 0 -180.000439 179.994946 /begin IF_DATA ASAP1B_ETK KP_BLOB 0x383682 1 2 /end IF_DATA BIT_MASK 0xFFFF /end MEASUREMENT
/begin MEASUREMENT flp43_07 "Lernfilterwert, positiv" SWORD dtsegn_b720divZyl 0 0 -180.000439 179.994946 /begin IF_DATA ASAP1B_ETK KP_BLOB 0x3836B2 1 2 /end IF_DATA BIT_MASK 0xFFFF /end MEASUREMENT
/begin MEASUREMENT flp43_08 "Lernfilterwert, positiv" SWORD dtsegn_b720divZyl 0 0 -180.000439 179.994946 /begin IF_DATA ASAP1B_ETK KP_BLOB 0x3836E2 1 2 /end IF_DATA BIT_MASK 0xFFFF /end MEASUREMENT
/begin MEASUREMENT flp51_02 "Lernfilterwert, positiv" SWORD dtsegn_b720divZyl 0 0 -180.000439 179.994946 /begin IF_DATA ASAP1B_ETK KP_BLOB 0x3835A4 1 2 /end IF_DATA BIT_MASK 0xFFFF /end MEASUREMENT
/begin MEASUREMENT flp51_03 "Lernfilterwert, positiv" SWORD dtsegn_b720divZyl 0 0 -180.000439 179.994946 /begin IF_DATA ASAP1B_ETK KP_BLOB 0x3835D4 1 2 /end IF_DATA BIT_MASK 0xFFFF /end MEASUREMENT
/begin MEASUREMENT flp51_04 "Lernfilterwert, positiv" SWORD dtsegn_b720divZyl 0 0 -180.000439 179.994946 /begin IF_DATA ASAP1B_ETK KP_BLOB 0x383604 1 2 /end IF_DATA BIT_MASK 0xFFFF /end MEASUREMENT
/begin MEASUREMENT flp51_05 "Lernfilterwert, positiv" SWORD dtsegn_b720divZyl 0 0 -180.000439 179.994946 /begin IF_DATA ASAP1B_ETK KP_BLOB 0x383634 1 2 /end IF_DATA BIT_MASK 0xFFFF /end MEASUREMENT
/begin MEASUREMENT flp51_06 "Lernfilterwert, positiv" SWORD dtsegn_b720divZyl 0 0 -180.000439 179.994946 /begin IF_DATA ASAP1B_ETK KP_BLOB 0x383664 1 2 /end IF_DATA BIT_MASK 0xFFFF /end MEASUREMENT
/begin MEASUREMENT flp51_07 "Lernfilterwert, positiv" SWORD dtsegn_b720divZyl 0 0 -180.000439 179.994946 /begin IF_DATA ASAP1B_ETK KP_BLOB 0x383694 1 2 /end IF_DATA BIT_MASK 0xFFFF /end MEASUREMENT
/begin MEASUREMENT flp51_08 "Lernfilterwert, positiv" SWORD dtsegn_b720divZyl 0 0 -180.000439 179.994946 /begin IF_DATA ASAP1B_ETK KP_BLOB 0x3836C4 1 2 /end IF_DATA BIT_MASK 0xFFFF /end MEASUREMENT
/begin MEASUREMENT flp52_02 "Lernfilterwert, positiv" SWORD dtsegn_b720divZyl 0 0 -180.000439 179.994946 /begin IF_DATA ASAP1B_ETK KP_BLOB 0x3835B4 1 2 /end IF_DATA BIT_MASK 0xFFFF /end MEASUREMENT
/begin MEASUREMENT flp52_03 "Lernfilterwert, positiv" SWORD dtsegn_b720divZyl 0 0 -180.000439 179.994946 /begin IF_DATA ASAP1B_ETK KP_BLOB 0x3835E4 1 2 /end IF_DATA BIT_MASK 0xFFFF /end MEASUREMENT
/begin MEASUREMENT flp52_04 "Lernfilterwert, positiv" SWORD dtsegn_b720divZyl 0 0 -180.000439 179.994946 /begin IF_DATA ASAP1B_ETK KP_BLOB 0x383614 1 2 /end IF_DATA BIT_MASK 0xFFFF /end MEASUREMENT
/begin MEASUREMENT flp52_05 "Lernfilterwert, positiv" SWORD dtsegn_b720divZyl 0 0 -180.000439 179.994946 /begin IF_DATA ASAP1B_ETK KP_BLOB 0x383644 1 2 /end IF_DATA BIT_MASK 0xFFFF /end MEASUREMENT
/begin MEASUREMENT flp52_06 "Lernfilterwert, positiv" SWORD dtsegn_b720divZyl 0 0 -180.000439 179.994946 /begin IF_DATA ASAP1B_ETK KP_BLOB 0x383674 1 2 /end IF_DATA BIT_MASK 0xFFFF /end MEASUREMENT
/begin MEASUREMENT flp52_07 "Lernfilterwert, positiv" SWORD dtsegn_b720divZyl 0 0 -180.000439 179.994946 /begin IF_DATA ASAP1B_ETK KP_BLOB 0x3836A4 1 2 /end IF_DATA BIT_MASK 0xFFFF /end MEASUREMENT
/begin MEASUREMENT flp52_08 "Lernfilterwert, positiv" SWORD dtsegn_b720divZyl 0 0 -180.000439 179.994946 /begin IF_DATA ASAP1B_ETK KP_BLOB 0x3836D4 1 2 /end IF_DATA BIT_MASK 0xFFFF /end MEASUREMENT
/begin MEASUREMENT flp53_02 "Lernfilterwert, positiv" SWORD dtsegn_b720divZyl 0 0 -180.000439 179.994946 /begin IF_DATA ASAP1B_ETK KP_BLOB 0x3835C4 1 2 /end IF_DATA BIT_MASK 0xFFFF /end MEASUREMENT
/begin MEASUREMENT flp53_03 "Lernfilterwert, positiv" SWORD dtsegn_b720divZyl 0 0 -180.000439 179.994946 /begin IF_DATA ASAP1B_ETK KP_BLOB 0x3835F4 1 2 /end IF_DATA BIT_MASK 0xFFFF /end MEASUREMENT
/begin MEASUREMENT flp53_04 "Lernfilterwert, positiv" SWORD dtsegn_b720divZyl 0 0 -180.000439 179.994946 /begin IF_DATA ASAP1B_ETK KP_BLOB 0x383624 1 2 /end IF_DATA BIT_MASK 0xFFFF /end MEASUREMENT
/begin MEASUREMENT flp53_05 "Lernfilterwert, positiv" SWORD dtsegn_b720divZyl 0 0 -180.000439 179.994946 /begin IF_DATA ASAP1B_ETK KP_BLOB 0x383654 1 2 /end IF_DATA BIT_MASK 0xFFFF /end MEASUREMENT
/begin MEASUREMENT flp53_06 "Lernfilterwert, positiv" SWORD dtsegn_b720divZyl 0 0 -180.000439 179.994946 /begin IF_DATA ASAP1B_ETK KP_BLOB 0x383684 1 2 /end IF_DATA BIT_MASK 0xFFFF /end MEASUREMENT
/begin MEASUREMENT flp53_07 "Lernfilterwert, positiv" SWORD dtsegn_b720divZyl 0 0 -180.000439 179.994946 /begin IF_DATA ASAP1B_ETK KP_BLOB 0x3836B4 1 2 /end IF_DATA BIT_MASK 0xFFFF /end MEASUREMENT
/begin MEASUREMENT flp53_08 "Lernfilterwert, positiv" SWORD dtsegn_b720divZyl 0 0 -180.000439 179.994946 /begin IF_DATA ASAP1B_ETK KP_BLOB 0x3836E4 1 2 /end IF_DATA BIT_MASK 0xFFFF /end MEASUREMENT
/begin MEASUREMENT flp61_02 "Lernfilterwert, positiv" SWORD dtsegn_b720divZyl 0 0 -180.000439 179.994946 /begin IF_DATA ASAP1B_ETK KP_BLOB 0x3835A6 1 2 /end IF_DATA BIT_MASK 0xFFFF /end MEASUREMENT
/begin MEASUREMENT flp61_03 "Lernfilterwert, positiv" SWORD dtsegn_b720divZyl 0 0 -180.000439 179.994946 /begin IF_DATA ASAP1B_ETK KP_BLOB 0x3835D6 1 2 /end IF_DATA BIT_MASK 0xFFFF /end MEASUREMENT
/begin MEASUREMENT flp61_04 "Lernfilterwert, positiv" SWORD dtsegn_b720divZyl 0 0 -180.000439 179.994946 /begin IF_DATA ASAP1B_ETK KP_BLOB 0x383606 1 2 /end IF_DATA BIT_MASK 0xFFFF /end MEASUREMENT
/begin MEASUREMENT flp61_05 "Lernfilterwert, positiv" SWORD dtsegn_b720divZyl 0 0 -180.000439 179.994946 /begin IF_DATA ASAP1B_ETK KP_BLOB 0x383636 1 2 /end IF_DATA BIT_MASK 0xFFFF /end MEASUREMENT
/begin MEASUREMENT flp61_06 "Lernfilterwert, positiv" SWORD dtsegn_b720divZyl 0 0 -180.000439 179.994946 /begin IF_DATA ASAP1B_ETK KP_BLOB 0x383666 1 2 /end IF_DATA BIT_MASK 0xFFFF /end MEASUREMENT
/begin MEASUREMENT flp61_07 "Lernfilterwert, positiv" SWORD dtsegn_b720divZyl 0 0 -180.000439 179.994946 /begin IF_DATA ASAP1B_ETK KP_BLOB 0x383696 1 2 /end IF_DATA BIT_MASK 0xFFFF /end MEASUREMENT
/begin MEASUREMENT flp61_08 "Lernfilterwert, positiv" SWORD dtsegn_b720divZyl 0 0 -180.000439 179.994946 /begin IF_DATA ASAP1B_ETK KP_BLOB 0x3836C6 1 2 /end IF_DATA BIT_MASK 0xFFFF /end MEASUREMENT
/begin MEASUREMENT flp62_02 "Lernfilterwert, positiv" SWORD dtsegn_b720divZyl 0 0 -180.000439 179.994946 /begin IF_DATA ASAP1B_ETK KP_BLOB 0x3835B6 1 2 /end IF_DATA BIT_MASK 0xFFFF /end MEASUREMENT
/begin MEASUREMENT flp62_03 "Lernfilterwert, positiv" SWORD dtsegn_b720divZyl 0 0 -180.000439 179.994946 /begin IF_DATA ASAP1B_ETK KP_BLOB 0x3835E6 1 2 /end IF_DATA BIT_MASK 0xFFFF /end MEASUREMENT
/begin MEASUREMENT flp62_04 "Lernfilterwert, positiv" SWORD dtsegn_b720divZyl 0 0 -180.000439 179.994946 /begin IF_DATA ASAP1B_ETK KP_BLOB 0x383616 1 2 /end IF_DATA BIT_MASK 0xFFFF /end MEASUREMENT
/begin MEASUREMENT flp62_05 "Lernfilterwert, positiv" SWORD dtsegn_b720divZyl 0 0 -180.000439 179.994946 /begin IF_DATA ASAP1B_ETK KP_BLOB 0x383646 1 2 /end IF_DATA BIT_MASK 0xFFFF /end MEASUREMENT
/begin MEASUREMENT flp62_06 "Lernfilterwert, positiv" SWORD dtsegn_b720divZyl 0 0 -180.000439 179.994946 /begin IF_DATA ASAP1B_ETK KP_BLOB 0x383676 1 2 /end IF_DATA BIT_MASK 0xFFFF /end MEASUREMENT
/begin MEASUREMENT flp62_07 "Lernfilterwert, positiv" SWORD dtsegn_b720divZyl 0 0 -180.000439 179.994946 /begin IF_DATA ASAP1B_ETK KP_BLOB 0x3836A6 1 2 /end IF_DATA BIT_MASK 0xFFFF /end MEASUREMENT
/begin MEASUREMENT flp62_08 "Lernfilterwert, positiv" SWORD dtsegn_b720divZyl 0 0 -180.000439 179.994946 /begin IF_DATA ASAP1B_ETK KP_BLOB 0x3836D6 1 2 /end IF_DATA BIT_MASK 0xFFFF /end MEASUREMENT
/begin MEASUREMENT flp63_02 "Lernfilterwert, positiv" SWORD dtsegn_b720divZyl 0 0 -180.000439 179.994946 /begin IF_DATA ASAP1B_ETK KP_BLOB 0x3835C6 1 2 /end IF_DATA BIT_MASK 0xFFFF /end MEASUREMENT
/begin MEASUREMENT flp63_03 "Lernfilterwert, positiv" SWORD dtsegn_b720divZyl 0 0 -180.000439 179.994946 /begin IF_DATA ASAP1B_ETK KP_BLOB 0x3835F6 1 2 /end IF_DATA BIT_MASK 0xFFFF /end MEASUREMENT
/begin MEASUREMENT flp63_04 "Lernfilterwert, positiv" SWORD dtsegn_b720divZyl 0 0 -180.000439 179.994946 /begin IF_DATA ASAP1B_ETK KP_BLOB 0x383626 1 2 /end IF_DATA BIT_MASK 0xFFFF /end MEASUREMENT
/begin MEASUREMENT flp63_05 "Lernfilterwert, positiv" SWORD dtsegn_b720divZyl 0 0 -180.000439 179.994946 /begin IF_DATA ASAP1B_ETK KP_BLOB 0x383656 1 2 /end IF_DATA BIT_MASK 0xFFFF /end MEASUREMENT
/begin MEASUREMENT flp63_06 "Lernfilterwert, positiv" SWORD dtsegn_b720divZyl 0 0 -180.000439 179.994946 /begin IF_DATA ASAP1B_ETK KP_BLOB 0x383686 1 2 /end IF_DATA BIT_MASK 0xFFFF /end MEASUREMENT
/begin MEASUREMENT flp63_07 "Lernfilterwert, positiv" SWORD dtsegn_b720divZyl 0 0 -180.000439 179.994946 /begin IF_DATA ASAP1B_ETK KP_BLOB 0x3836B6 1 2 /end IF_DATA BIT_MASK 0xFFFF /end MEASUREMENT
/begin MEASUREMENT flp63_08 "Lernfilterwert, positiv" SWORD dtsegn_b720divZyl 0 0 -180.000439 179.994946 /begin IF_DATA ASAP1B_ETK KP_BLOB 0x3836E6 1 2 /end IF_DATA BIT_MASK 0xFFFF /end MEASUREMENT
/begin MEASUREMENT flp71_02 "Lernfilterwert, positiv" SWORD dtsegn_b720divZyl 0 0 -180.000439 179.994946 /begin IF_DATA ASAP1B_ETK KP_BLOB 0x3835A8 1 2 /end IF_DATA BIT_MASK 0xFFFF /end MEASUREMENT
/begin MEASUREMENT flp71_03 "Lernfilterwert, positiv" SWORD dtsegn_b720divZyl 0 0 -180.000439 179.994946 /begin IF_DATA ASAP1B_ETK KP_BLOB 0x3835D8 1 2 /end IF_DATA BIT_MASK 0xFFFF /end MEASUREMENT
/begin MEASUREMENT flp71_04 "Lernfilterwert, positiv" SWORD dtsegn_b720divZyl 0 0 -180.000439 179.994946 /begin IF_DATA ASAP1B_ETK KP_BLOB 0x383608 1 2 /end IF_DATA BIT_MASK 0xFFFF /end MEASUREMENT
/begin MEASUREMENT flp71_05 "Lernfilterwert, positiv" SWORD dtsegn_b720divZyl 0 0 -180.000439 179.994946 /begin IF_DATA ASAP1B_ETK KP_BLOB 0x383638 1 2 /end IF_DATA BIT_MASK 0xFFFF /end MEASUREMENT
/begin MEASUREMENT flp71_06 "Lernfilterwert, positiv" SWORD dtsegn_b720divZyl 0 0 -180.000439 179.994946 /begin IF_DATA ASAP1B_ETK KP_BLOB 0x383668 1 2 /end IF_DATA BIT_MASK 0xFFFF /end MEASUREMENT
/begin MEASUREMENT flp71_07 "Lernfilterwert, positiv" SWORD dtsegn_b720divZyl 0 0 -180.000439 179.994946 /begin IF_DATA ASAP1B_ETK KP_BLOB 0x383698 1 2 /end IF_DATA BIT_MASK 0xFFFF /end MEASUREMENT
/begin MEASUREMENT flp71_08 "Lernfilterwert, positiv" SWORD dtsegn_b720divZyl 0 0 -180.000439 179.994946 /begin IF_DATA ASAP1B_ETK KP_BLOB 0x3836C8 1 2 /end IF_DATA BIT_MASK 0xFFFF /end MEASUREMENT
/begin MEASUREMENT flp72_02 "Lernfilterwert, positiv" SWORD dtsegn_b720divZyl 0 0 -180.000439 179.994946 /begin IF_DATA ASAP1B_ETK KP_BLOB 0x3835B8 1 2 /end IF_DATA BIT_MASK 0xFFFF /end MEASUREMENT
/begin MEASUREMENT flp72_03 "Lernfilterwert, positiv" SWORD dtsegn_b720divZyl 0 0 -180.000439 179.994946 /begin IF_DATA ASAP1B_ETK KP_BLOB 0x3835E8 1 2 /end IF_DATA BIT_MASK 0xFFFF /end MEASUREMENT
/begin MEASUREMENT flp72_04 "Lernfilterwert, positiv" SWORD dtsegn_b720divZyl 0 0 -180.000439 179.994946 /begin IF_DATA ASAP1B_ETK KP_BLOB 0x383618 1 2 /end IF_DATA BIT_MASK 0xFFFF /end MEASUREMENT
/begin MEASUREMENT flp72_05 "Lernfilterwert, positiv" SWORD dtsegn_b720divZyl 0 0 -180.000439 179.994946 /begin IF_DATA ASAP1B_ETK KP_BLOB 0x383648 1 2 /end IF_DATA BIT_MASK 0xFFFF /end MEASUREMENT
/begin MEASUREMENT flp72_06 "Lernfilterwert, positiv" SWORD dtsegn_b720divZyl 0 0 -180.000439 179.994946 /begin IF_DATA ASAP1B_ETK KP_BLOB 0x383678 1 2 /end IF_DATA BIT_MASK 0xFFFF /end MEASUREMENT
/begin MEASUREMENT flp72_07 "Lernfilterwert, positiv" SWORD dtsegn_b720divZyl 0 0 -180.000439 179.994946 /begin IF_DATA ASAP1B_ETK KP_BLOB 0x3836A8 1 2 /end IF_DATA BIT_MASK 0xFFFF /end MEASUREMENT
/begin MEASUREMENT flp72_08 "Lernfilterwert, positiv" SWORD dtsegn_b720divZyl 0 0 -180.000439 179.994946 /begin IF_DATA ASAP1B_ETK KP_BLOB 0x3836D8 1 2 /end IF_DATA BIT_MASK 0xFFFF /end MEASUREMENT
/begin MEASUREMENT flp73_02 "Lernfilterwert, positiv" SWORD dtsegn_b720divZyl 0 0 -180.000439 179.994946 /begin IF_DATA ASAP1B_ETK KP_BLOB 0x3835C8 1 2 /end IF_DATA BIT_MASK 0xFFFF /end MEASUREMENT
/begin MEASUREMENT flp73_03 "Lernfilterwert, positiv" SWORD dtsegn_b720divZyl 0 0 -180.000439 179.994946 /begin IF_DATA ASAP1B_ETK KP_BLOB 0x3835F8 1 2 /end IF_DATA BIT_MASK 0xFFFF /end MEASUREMENT
/begin MEASUREMENT flp73_04 "Lernfilterwert, positiv" SWORD dtsegn_b720divZyl 0 0 -180.000439 179.994946 /begin IF_DATA ASAP1B_ETK KP_BLOB 0x383628 1 2 /end IF_DATA BIT_MASK 0xFFFF /end MEASUREMENT
/begin MEASUREMENT flp73_05 "Lernfilterwert, positiv" SWORD dtsegn_b720divZyl 0 0 -180.000439 179.994946 /begin IF_DATA ASAP1B_ETK KP_BLOB 0x383658 1 2 /end IF_DATA BIT_MASK 0xFFFF /end MEASUREMENT
/begin MEASUREMENT flp73_06 "Lernfilterwert, positiv" SWORD dtsegn_b720divZyl 0 0 -180.000439 179.994946 /begin IF_DATA ASAP1B_ETK KP_BLOB 0x383688 1 2 /end IF_DATA BIT_MASK 0xFFFF /end MEASUREMENT
/begin MEASUREMENT flp73_07 "Lernfilterwert, positiv" SWORD dtsegn_b720divZyl 0 0 -180.000439 179.994946 /begin IF_DATA ASAP1B_ETK KP_BLOB 0x3836B8 1 2 /end IF_DATA BIT_MASK 0xFFFF /end MEASUREMENT
/begin MEASUREMENT flp73_08 "Lernfilterwert, positiv" SWORD dtsegn_b720divZyl 0 0 -180.000439 179.994946 /begin IF_DATA ASAP1B_ETK KP_BLOB 0x3836E8 1 2 /end IF_DATA BIT_MASK 0xFFFF /end MEASUREMENT
/begin MEASUREMENT flp81_02 "Lernfilterwert, positiv" SWORD dtsegn_b720divZyl 0 0 -180.000439 179.994946 /begin IF_DATA ASAP1B_ETK KP_BLOB 0x3835AA 1 2 /end IF_DATA BIT_MASK 0xFFFF /end MEASUREMENT
/begin MEASUREMENT flp81_03 "Lernfilterwert, positiv" SWORD dtsegn_b720divZyl 0 0 -180.000439 179.994946 /begin IF_DATA ASAP1B_ETK KP_BLOB 0x3835DA 1 2 /end IF_DATA BIT_MASK 0xFFFF /end MEASUREMENT
/begin MEASUREMENT flp81_04 "Lernfilterwert, positiv" SWORD dtsegn_b720divZyl 0 0 -180.000439 179.994946 /begin IF_DATA ASAP1B_ETK KP_BLOB 0x38360A 1 2 /end IF_DATA BIT_MASK 0xFFFF /end MEASUREMENT
/begin MEASUREMENT flp81_05 "Lernfilterwert, positiv" SWORD dtsegn_b720divZyl 0 0 -180.000439 179.994946 /begin IF_DATA ASAP1B_ETK KP_BLOB 0x38363A 1 2 /end IF_DATA BIT_MASK 0xFFFF /end MEASUREMENT
/begin MEASUREMENT flp81_06 "Lernfilterwert, positiv" SWORD dtsegn_b720divZyl 0 0 -180.000439 179.994946 /begin IF_DATA ASAP1B_ETK KP_BLOB 0x38366A 1 2 /end IF_DATA BIT_MASK 0xFFFF /end MEASUREMENT
/begin MEASUREMENT flp81_07 "Lernfilterwert, positiv" SWORD dtsegn_b720divZyl 0 0 -180.000439 179.994946 /begin IF_DATA ASAP1B_ETK KP_BLOB 0x38369A 1 2 /end IF_DATA BIT_MASK 0xFFFF /end MEASUREMENT
/begin MEASUREMENT flp81_08 "Lernfilterwert, positiv" SWORD dtsegn_b720divZyl 0 0 -180.000439 179.994946 /begin IF_DATA ASAP1B_ETK KP_BLOB 0x3836CA 1 2 /end IF_DATA BIT_MASK 0xFFFF /end MEASUREMENT
/begin MEASUREMENT flp82_02 "Lernfilterwert, positiv" SWORD dtsegn_b720divZyl 0 0 -180.000439 179.994946 /begin IF_DATA ASAP1B_ETK KP_BLOB 0x3835BA 1 2 /end IF_DATA BIT_MASK 0xFFFF /end MEASUREMENT
/begin MEASUREMENT flp82_03 "Lernfilterwert, positiv" SWORD dtsegn_b720divZyl 0 0 -180.000439 179.994946 /begin IF_DATA ASAP1B_ETK KP_BLOB 0x3835EA 1 2 /end IF_DATA BIT_MASK 0xFFFF /end MEASUREMENT
/begin MEASUREMENT flp82_04 "Lernfilterwert, positiv" SWORD dtsegn_b720divZyl 0 0 -180.000439 179.994946 /begin IF_DATA ASAP1B_ETK KP_BLOB 0x38361A 1 2 /end IF_DATA BIT_MASK 0xFFFF /end MEASUREMENT
/begin MEASUREMENT flp82_05 "Lernfilterwert, positiv" SWORD dtsegn_b720divZyl 0 0 -180.000439 179.994946 /begin IF_DATA ASAP1B_ETK KP_BLOB 0x38364A 1 2 /end IF_DATA BIT_MASK 0xFFFF /end MEASUREMENT
/begin MEASUREMENT flp82_06 "Lernfilterwert, positiv" SWORD dtsegn_b720divZyl 0 0 -180.000439 179.994946 /begin IF_DATA ASAP1B_ETK KP_BLOB 0x38367A 1 2 /end IF_DATA BIT_MASK 0xFFFF /end MEASUREMENT
/begin MEASUREMENT flp82_07 "Lernfilterwert, positiv" SWORD dtsegn_b720divZyl 0 0 -180.000439 179.994946 /begin IF_DATA ASAP1B_ETK KP_BLOB 0x3836AA 1 2 /end IF_DATA BIT_MASK 0xFFFF /end MEASUREMENT
/begin MEASUREMENT flp82_08 "Lernfilterwert, positiv" SWORD dtsegn_b720divZyl 0 0 -180.000439 179.994946 /begin IF_DATA ASAP1B_ETK KP_BLOB 0x3836DA 1 2 /end IF_DATA BIT_MASK 0xFFFF /end MEASUREMENT
/begin MEASUREMENT flp83_02 "Lernfilterwert, positiv" SWORD dtsegn_b720divZyl 0 0 -180.000439 179.994946 /begin IF_DATA ASAP1B_ETK KP_BLOB 0x3835CA 1 2 /end IF_DATA BIT_MASK 0xFFFF /end MEASUREMENT
/begin MEASUREMENT flp83_03 "Lernfilterwert, positiv" SWORD dtsegn_b720divZyl 0 0 -180.000439 179.994946 /begin IF_DATA ASAP1B_ETK KP_BLOB 0x3835FA 1 2 /end IF_DATA BIT_MASK 0xFFFF /end MEASUREMENT
/begin MEASUREMENT flp83_04 "Lernfilterwert, positiv" SWORD dtsegn_b720divZyl 0 0 -180.000439 179.994946 /begin IF_DATA ASAP1B_ETK KP_BLOB 0x38362A 1 2 /end IF_DATA BIT_MASK 0xFFFF /end MEASUREMENT
/begin MEASUREMENT flp83_05 "Lernfilterwert, positiv" SWORD dtsegn_b720divZyl 0 0 -180.000439 179.994946 /begin IF_DATA ASAP1B_ETK KP_BLOB 0x38365A 1 2 /end IF_DATA BIT_MASK 0xFFFF /end MEASUREMENT
/begin MEASUREMENT flp83_06 "Lernfilterwert, positiv" SWORD dtsegn_b720divZyl 0 0 -180.000439 179.994946 /begin IF_DATA ASAP1B_ETK KP_BLOB 0x38368A 1 2 /end IF_DATA BIT_MASK 0xFFFF /end MEASUREMENT
/begin MEASUREMENT flp83_07 "Lernfilterwert, positiv" SWORD dtsegn_b720divZyl 0 0 -180.000439 179.994946 /begin IF_DATA ASAP1B_ETK KP_BLOB 0x3836BA 1 2 /end IF_DATA BIT_MASK 0xFFFF /end MEASUREMENT
/begin MEASUREMENT flp83_08 "Lernfilterwert, positiv" SWORD dtsegn_b720divZyl 0 0 -180.000439 179.994946 /begin IF_DATA ASAP1B_ETK KP_BLOB 0x3836EA 1 2 /end IF_DATA BIT_MASK 0xFFFF /end MEASUREMENT
/begin MEASUREMENT fluts "Filter der Laufunruhe-Testgrî·e" SWORD luquant_w 0 0 -80.843967 80.841500 /begin IF_DATA ASAP1B_ETK KP_BLOB 0x381656 1 2 /end IF_DATA BIT_MASK 0xFFFF /end MEASUREMENT
/begin MEASUREMENT fluts1 "Filter der Laufunruhe-Testgrî·e von Zylinder 1 bzw. ZÅndung 1, signed" SWORD luquant_w 0 0 -80.843967 80.841500 /begin IF_DATA ASAP1B_ETK KP_BLOB 0x381658 1 2 /end IF_DATA BIT_MASK 0xFFFF /end MEASUREMENT
/begin MEASUREMENT fluts2 "Filter der Laufunruhe-Testgrî·e von Zylinder 2 bzw. ZÅndung 2, signed" SWORD luquant_w 0 0 -80.843967 80.841500 /begin IF_DATA ASAP1B_ETK KP_BLOB 0x38165A 1 2 /end IF_DATA BIT_MASK 0xFFFF /end MEASUREMENT
/begin MEASUREMENT fluts3 "Filter der Laufunruhe-Testgrî·e von Zylinder 3 bzw. ZÅndung 3, signed" SWORD luquant_w 0 0 -80.843967 80.841500 /begin IF_DATA ASAP1B_ETK KP_BLOB 0x38165C 1 2 /end IF_DATA BIT_MASK 0xFFFF /end MEASUREMENT
/begin MEASUREMENT fluts4 "Filter der Laufunruhe-Testgrî·e von Zylinder 4 bzw. ZÅndung 4, signed" SWORD luquant_w 0 0 -80.843967 80.841500 /begin IF_DATA ASAP1B_ETK KP_BLOB 0x38165E 1 2 /end IF_DATA BIT_MASK 0xFFFF /end MEASUREMENT
/begin MEASUREMENT fluts5 "Filter der Laufunruhe-Testgrî·e von Zylinder 5 bzw. ZÅndung 5, signed" SWORD luquant_w 0 0 -80.843967 80.841500 /begin IF_DATA ASAP1B_ETK KP_BLOB 0x381660 1 2 /end IF_DATA BIT_MASK 0xFFFF /end MEASUREMENT
/begin MEASUREMENT fluts6 "Filter der Laufunruhe-Testgrî·e von Zylinder 6 bzw. ZÅndung 6, signed" SWORD luquant_w 0 0 -80.843967 80.841500 /begin IF_DATA ASAP1B_ETK KP_BLOB 0x381662 1 2 /end IF_DATA BIT_MASK 0xFFFF /end MEASUREMENT
/begin MEASUREMENT fluts7 "Filter der Laufunruhe-Testgrî·e von Zylinder 7 bzw. ZÅndung 7, signed" SWORD luquant_w 0 0 -80.843967 80.841500 /begin IF_DATA ASAP1B_ETK KP_BLOB 0x381664 1 2 /end IF_DATA BIT_MASK 0xFFFF /end MEASUREMENT
/begin MEASUREMENT fluts8 "Filter der Laufunruhe-Testgrî·e von Zylinder 8 bzw. ZÅndung 8, signed" SWORD luquant_w 0 0 -80.843967 80.841500 /begin IF_DATA ASAP1B_ETK KP_BLOB 0x381666 1 2 /end IF_DATA BIT_MASK 0xFFFF /end MEASUREMENT
/begin MEASUREMENT fluts_m "Monitor, gefilterte Laufunruhetestgrî·e, signed, verzîgerte Ausgabe" SWORD luquant_w 0 0 -80.843967 80.841500 /begin IF_DATA ASAP1B_ETK KP_BLOB 0xE400 0 2 /end IF_DATA BIT_MASK 0xFFFF /end MEASUREMENT
/begin MEASUREMENT fostat "Status der fuel-on/-off Adaption im aktuellen Betriebsbereich" UBYTE dez 0 0 0.000000 255.000000 /begin IF_DATA ASAP1B_ETK KP_BLOB 0x3809EA 1 1 /end IF_DATA BIT_MASK 0xFF /end MEASUREMENT
/begin MEASUREMENT fostat_m "Monitor, Status der Adpation im akt. Bereich, verzîgerte Ausgabe" UBYTE dez 0 0 0.000000 255.000000 /begin IF_DATA ASAP1B_ETK KP_BLOB 0xE3DC 0 1 /end IF_DATA BIT_MASK 0xFF /end MEASUREMENT
/begin MEASUREMENT fs11_02 "Filterwert Segmentabweichung, Betriebsbereich 11, ZÅndung 2" UWORD dtsegn_b720divZylP5 0 0 -180.000439 179.994946 /begin IF_DATA ASAP1B_ETK KP_BLOB 0x3836EC 1 2 /end IF_DATA BIT_MASK 0xFFFF /end MEASUREMENT
/begin MEASUREMENT fs11_03 "Filterwert Segmentabweichung, Betriebsbereich 11, ZÅndung 3" UWORD dtsegn_b720divZylP5 0 0 -180.000439 179.994946 /begin IF_DATA ASAP1B_ETK KP_BLOB 0x38371C 1 2 /end IF_DATA BIT_MASK 0xFFFF /end MEASUREMENT
/begin MEASUREMENT fs11_04 "Filterwert Segmentabweichung, Betriebsbereich 11, ZÅndung 4" UWORD dtsegn_b720divZylP5 0 0 -180.000439 179.994946 /begin IF_DATA ASAP1B_ETK KP_BLOB 0x38374C 1 2 /end IF_DATA BIT_MASK 0xFFFF /end MEASUREMENT
/begin MEASUREMENT fs11_05 "Filterwert Segmentabweichung, Betriebsbereich 11, ZÅndung 5" UWORD dtsegn_b720divZylP5 0 0 -180.000439 179.994946 /begin IF_DATA ASAP1B_ETK KP_BLOB 0x38377C 1 2 /end IF_DATA BIT_MASK 0xFFFF /end MEASUREMENT
/begin MEASUREMENT fs11_06 "Filterwert Segmentabweichung, Betriebsbereich 11, ZÅndung 6" UWORD dtsegn_b720divZylP5 0 0 -180.000439 179.994946 /begin IF_DATA ASAP1B_ETK KP_BLOB 0x3837AC 1 2 /end IF_DATA BIT_MASK 0xFFFF /end MEASUREMENT
/begin MEASUREMENT fs11_07 "Filterwert Segmentabweichung, Betriebsbereich 11, ZÅndung 7" UWORD dtsegn_b720divZylP5 0 0 -180.000439 179.994946 /begin IF_DATA ASAP1B_ETK KP_BLOB 0x3837DC 1 2 /end IF_DATA BIT_MASK 0xFFFF /end MEASUREMENT
/begin MEASUREMENT fs11_08 "Filterwert Segmentabweichung, Betriebsbereich 11, ZÅndung 8" UWORD dtsegn_b720divZylP5 0 0 -180.000439 179.994946 /begin IF_DATA ASAP1B_ETK KP_BLOB 0x38380C 1 2 /end IF_DATA BIT_MASK 0xFFFF /end MEASUREMENT
/begin MEASUREMENT fs12_02 "Filterwert Segmentabweichung, Betriebsbereich 12, ZÅndung 2" UWORD dtsegn_b720divZylP5 0 0 -180.000439 179.994946 /begin IF_DATA ASAP1B_ETK KP_BLOB 0x3836FC 1 2 /end IF_DATA BIT_MASK 0xFFFF /end MEASUREMENT
/begin MEASUREMENT fs12_03 "Filterwert Segmentabweichung, Betriebsbereich 12, ZÅndung 3" UWORD dtsegn_b720divZylP5 0 0 -180.000439 179.994946 /begin IF_DATA ASAP1B_ETK KP_BLOB 0x38372C 1 2 /end IF_DATA BIT_MASK 0xFFFF /end MEASUREMENT
/begin MEASUREMENT fs12_04 "Filterwert Segmentabweichung, Betriebsbereich 12, ZÅndung 4" UWORD dtsegn_b720divZylP5 0 0 -180.000439 179.994946 /begin IF_DATA ASAP1B_ETK KP_BLOB 0x38375C 1 2 /end IF_DATA BIT_MASK 0xFFFF /end MEASUREMENT
/begin MEASUREMENT fs12_05 "Filterwert Segmentabweichung, Betriebsbereich 12, ZÅndung 5" UWORD dtsegn_b720divZylP5 0 0 -180.000439 179.994946 /begin IF_DATA ASAP1B_ETK KP_BLOB 0x38378C 1 2 /end IF_DATA BIT_MASK 0xFFFF /end MEASUREMENT
/begin MEASUREMENT fs12_06 "Filterwert Segmentabweichung, Betriebsbereich 12, ZÅndung 6" UWORD dtsegn_b720divZylP5 0 0 -180.000439 179.994946 /begin IF_DATA ASAP1B_ETK KP_BLOB 0x3837BC 1 2 /end IF_DATA BIT_MASK 0xFFFF /end MEASUREMENT
/begin MEASUREMENT fs12_07 "Filterwert Segmentabweichung, Betriebsbereich 12, ZÅndung 7" UWORD dtsegn_b720divZylP5 0 0 -180.000439 179.994946 /begin IF_DATA ASAP1B_ETK KP_BLOB 0x3837EC 1 2 /end IF_DATA BIT_MASK 0xFFFF /end MEASUREMENT
/begin MEASUREMENT fs12_08 "Filterwert Segmentabweichung, Betriebsbereich 12, ZÅndung 8" UWORD dtsegn_b720divZylP5 0 0 -180.000439 179.994946 /begin IF_DATA ASAP1B_ETK KP_BLOB 0x38381C 1 2 /end IF_DATA BIT_MASK 0xFFFF /end MEASUREMENT
/begin MEASUREMENT fs13_02 "Filterwert Segmentabweichung, Betriebsbereich 13, ZÅndung 2" UWORD dtsegn_b720divZylP5 0 0 -180.000439 179.994946 /begin IF_DATA ASAP1B_ETK KP_BLOB 0x38370C 1 2 /end IF_DATA BIT_MASK 0xFFFF /end MEASUREMENT
/begin MEASUREMENT fs13_03 "Filterwert Segmentabweichung, Betriebsbereich 13, ZÅndung 3" UWORD dtsegn_b720divZylP5 0 0 -180.000439 179.994946 /begin IF_DATA ASAP1B_ETK KP_BLOB 0x38373C 1 2 /end IF_DATA BIT_MASK 0xFFFF /end MEASUREMENT
/begin MEASUREMENT fs13_04 "Filterwert Segmentabweichung, Betriebsbereich 13, ZÅndung 4" UWORD dtsegn_b720divZylP5 0 0 -180.000439 179.994946 /begin IF_DATA ASAP1B_ETK KP_BLOB 0x38376C 1 2 /end IF_DATA BIT_MASK 0xFFFF /end MEASUREMENT
/begin MEASUREMENT fs13_05 "Filterwert Segmentabweichung, Betriebsbereich 13, ZÅndung 5" UWORD dtsegn_b720divZylP5 0 0 -180.000439 179.994946 /begin IF_DATA ASAP1B_ETK KP_BLOB 0x38379C 1 2 /end IF_DATA BIT_MASK 0xFFFF /end MEASUREMENT
/begin MEASUREMENT fs13_06 "Filterwert Segmentabweichung, Betriebsbereich 13, ZÅndung 6" UWORD dtsegn_b720divZylP5 0 0 -180.000439 179.994946 /begin IF_DATA ASAP1B_ETK KP_BLOB 0x3837CC 1 2 /end IF_DATA BIT_MASK 0xFFFF /end MEASUREMENT
/begin MEASUREMENT fs13_07 "Filterwert Segmentabweichung, Betriebsbereich 13, ZÅndung 7" UWORD dtsegn_b720divZylP5 0 0 -180.000439 179.994946 /begin IF_DATA ASAP1B_ETK KP_BLOB 0x3837FC 1 2 /end IF_DATA BIT_MASK 0xFFFF /end MEASUREMENT
/begin MEASUREMENT fs13_08 "Filterwert Segmentabweichung, Betriebsbereich 13, ZÅndung 8" UWORD dtsegn_b720divZylP5 0 0 -180.000439 179.994946 /begin IF_DATA ASAP1B_ETK KP_BLOB 0x38382C 1 2 /end IF_DATA BIT_MASK 0xFFFF /end MEASUREMENT
/begin MEASUREMENT fs21_02 "Filterwert Segmentabweichung, Betriebsbereich 21, ZÅndung 2" UWORD dtsegn_b720divZylP5 0 0 -180.000439 179.994946 /begin IF_DATA ASAP1B_ETK KP_BLOB 0x3836EE 1 2 /end IF_DATA BIT_MASK 0xFFFF /end MEASUREMENT
/begin MEASUREMENT fs21_03 "Filterwert Segmentabweichung, Betriebsbereich 21, ZÅndung 3" UWORD dtsegn_b720divZylP5 0 0 -180.000439 179.994946 /begin IF_DATA ASAP1B_ETK KP_BLOB 0x38371E 1 2 /end IF_DATA BIT_MASK 0xFFFF /end MEASUREMENT
/begin MEASUREMENT fs21_04 "Filterwert Segmentabweichung, Betriebsbereich 21, ZÅndung 4" UWORD dtsegn_b720divZylP5 0 0 -180.000439 179.994946 /begin IF_DATA ASAP1B_ETK KP_BLOB 0x38374E 1 2 /end IF_DATA BIT_MASK 0xFFFF /end MEASUREMENT
/begin MEASUREMENT fs21_05 "Filterwert Segmentabweichung, Betriebsbereich 21, ZÅndung 5" UWORD dtsegn_b720divZylP5 0 0 -180.000439 179.994946 /begin IF_DATA ASAP1B_ETK KP_BLOB 0x38377E 1 2 /end IF_DATA BIT_MASK 0xFFFF /end MEASUREMENT
/begin MEASUREMENT fs21_06 "Filterwert Segmentabweichung, Betriebsbereich 21, ZÅndung 6" UWORD dtsegn_b720divZylP5 0 0 -180.000439 179.994946 /begin IF_DATA ASAP1B_ETK KP_BLOB 0x3837AE 1 2 /end IF_DATA BIT_MASK 0xFFFF /end MEASUREMENT
/begin MEASUREMENT fs21_07 "Filterwert Segmentabweichung, Betriebsbereich 21, ZÅndung 7" UWORD dtsegn_b720divZylP5 0 0 -180.000439 179.994946 /begin IF_DATA ASAP1B_ETK KP_BLOB 0x3837DE 1 2 /end IF_DATA BIT_MASK 0xFFFF /end MEASUREMENT
/begin MEASUREMENT fs21_08 "Filterwert Segmentabweichung, Betriebsbereich 21, ZÅndung 8" UWORD dtsegn_b720divZylP5 0 0 -180.000439 179.994946 /begin IF_DATA ASAP1B_ETK KP_BLOB 0x38380E 1 2 /end IF_DATA BIT_MASK 0xFFFF /end MEASUREMENT
/begin MEASUREMENT fs22_02 "Filterwert Segmentabweichung, Betriebsbereich 22, ZÅndung 2" UWORD dtsegn_b720divZylP5 0 0 -180.000439 179.994946 /begin IF_DATA ASAP1B_ETK KP_BLOB 0x3836FE 1 2 /end IF_DATA BIT_MASK 0xFFFF /end MEASUREMENT
/begin MEASUREMENT fs22_03 "Filterwert Segmentabweichung, Betriebsbereich 22, ZÅndung 3" UWORD dtsegn_b720divZylP5 0 0 -180.000439 179.994946 /begin IF_DATA ASAP1B_ETK KP_BLOB 0x38372E 1 2 /end IF_DATA BIT_MASK 0xFFFF /end MEASUREMENT
/begin MEASUREMENT fs22_04 "Filterwert Segmentabweichung, Betriebsbereich 22, ZÅndung 4" UWORD dtsegn_b720divZylP5 0 0 -180.000439 179.994946 /begin IF_DATA ASAP1B_ETK KP_BLOB 0x38375E 1 2 /end IF_DATA BIT_MASK 0xFFFF /end MEASUREMENT
/begin MEASUREMENT fs22_05 "Filterwert Segmentabweichung, Betriebsbereich 22, ZÅndung 5" UWORD dtsegn_b720divZylP5 0 0 -180.000439 179.994946 /begin IF_DATA ASAP1B_ETK KP_BLOB 0x38378E 1 2 /end IF_DATA BIT_MASK 0xFFFF /end MEASUREMENT
/begin MEASUREMENT fs22_06 "Filterwert Segmentabweichung, Betriebsbereich 22, ZÅndung 6" UWORD dtsegn_b720divZylP5 0 0 -180.000439 179.994946 /begin IF_DATA ASAP1B_ETK KP_BLOB 0x3837BE 1 2 /end IF_DATA BIT_MASK 0xFFFF /end MEASUREMENT
/begin MEASUREMENT fs22_07 "Filterwert Segmentabweichung, Betriebsbereich 22, ZÅndung 7" UWORD dtsegn_b720divZylP5 0 0 -180.000439 179.994946 /begin IF_DATA ASAP1B_ETK KP_BLOB 0x3837EE 1 2 /end IF_DATA BIT_MASK 0xFFFF /end MEASUREMENT
/begin MEASUREMENT fs22_08 "Filterwert Segmentabweichung, Betriebsbereich 22, ZÅndung 8" UWORD dtsegn_b720divZylP5 0 0 -180.000439 179.994946 /begin IF_DATA ASAP1B_ETK KP_BLOB 0x38381E 1 2 /end IF_DATA BIT_MASK 0xFFFF /end MEASUREMENT
/begin MEASUREMENT fs23_02 "Filterwert Segmentabweichung, Betriebsbereich 23, ZÅndung 2" UWORD dtsegn_b720divZylP5 0 0 -180.000439 179.994946 /begin IF_DATA ASAP1B_ETK KP_BLOB 0x38370E 1 2 /end IF_DATA BIT_MASK 0xFFFF /end MEASUREMENT
/begin MEASUREMENT fs23_03 "Filterwert Segmentabweichung, Betriebsbereich 23, ZÅndung 3" UWORD dtsegn_b720divZylP5 0 0 -180.000439 179.994946 /begin IF_DATA ASAP1B_ETK KP_BLOB 0x38373E 1 2 /end IF_DATA BIT_MASK 0xFFFF /end MEASUREMENT
/begin MEASUREMENT fs23_04 "Filterwert Segmentabweichung, Betriebsbereich 23, ZÅndung 4" UWORD dtsegn_b720divZylP5 0 0 -180.000439 179.994946 /begin IF_DATA ASAP1B_ETK KP_BLOB 0x38376E 1 2 /end IF_DATA BIT_MASK 0xFFFF /end MEASUREMENT
/begin MEASUREMENT fs23_05 "Filterwert Segmentabweichung, Betriebsbereich 23, ZÅndung 5" UWORD dtsegn_b720divZylP5 0 0 -180.000439 179.994946 /begin IF_DATA ASAP1B_ETK KP_BLOB 0x38379E 1 2 /end IF_DATA BIT_MASK 0xFFFF /end MEASUREMENT
/begin MEASUREMENT fs23_06 "Filterwert Segmentabweichung, Betriebsbereich 23, ZÅndung 6" UWORD dtsegn_b720divZylP5 0 0 -180.000439 179.994946 /begin IF_DATA ASAP1B_ETK KP_BLOB 0x3837CE 1 2 /end IF_DATA BIT_MASK 0xFFFF /end MEASUREMENT
/begin MEASUREMENT fs23_07 "Filterwert Segmentabweichung, Betriebsbereich 23, ZÅndung 7" UWORD dtsegn_b720divZylP5 0 0 -180.000439 179.994946 /begin IF_DATA ASAP1B_ETK KP_BLOB 0x3837FE 1 2 /end IF_DATA BIT_MASK 0xFFFF /end MEASUREMENT
/begin MEASUREMENT fs23_08 "Filterwert Segmentabweichung, Betriebsbereich 23, ZÅndung 8" UWORD dtsegn_b720divZylP5 0 0 -180.000439 179.994946 /begin IF_DATA ASAP1B_ETK KP_BLOB 0x38382E 1 2 /end IF_DATA BIT_MASK 0xFFFF /end MEASUREMENT
/begin MEASUREMENT fs31_02 "Filterwert Segmentabweichung, Betriebsbereich 31, Zylinder 2" UWORD dtsegn_b720divZylP5 0 0 -180.000439 179.994946 /begin IF_DATA ASAP1B_ETK KP_BLOB 0x3836F0 1 2 /end IF_DATA BIT_MASK 0xFFFF /end MEASUREMENT
/begin MEASUREMENT fs31_03 "Filterwert Segmentabweichung, Betriebsbereich 31" UWORD dtsegn_b720divZylP5 0 0 -180.000439 179.994946 /begin IF_DATA ASAP1B_ETK KP_BLOB 0x383720 1 2 /end IF_DATA BIT_MASK 0xFFFF /end MEASUREMENT
/begin MEASUREMENT fs31_04 "Filterwert Segmentabweichung, Betriebsbereich 31" UWORD dtsegn_b720divZylP5 0 0 -180.000439 179.994946 /begin IF_DATA ASAP1B_ETK KP_BLOB 0x383750 1 2 /end IF_DATA BIT_MASK 0xFFFF /end MEASUREMENT
/begin MEASUREMENT fs31_05 "Filterwert Segmentabweichung, Betriebsbereich 31" UWORD dtsegn_b720divZylP5 0 0 -180.000439 179.994946 /begin IF_DATA ASAP1B_ETK KP_BLOB 0x383780 1 2 /end IF_DATA BIT_MASK 0xFFFF /end MEASUREMENT
/begin MEASUREMENT fs31_06 "Filterwert Segmentabweichung, Betriebsbereich 31" UWORD dtsegn_b720divZylP5 0 0 -180.000439 179.994946 /begin IF_DATA ASAP1B_ETK KP_BLOB 0x3837B0 1 2 /end IF_DATA BIT_MASK 0xFFFF /end MEASUREMENT
/begin MEASUREMENT fs31_07 "Filterwert Segmentabweichung, Betriebsbereich 31" UWORD dtsegn_b720divZylP5 0 0 -180.000439 179.994946 /begin IF_DATA ASAP1B_ETK KP_BLOB 0x3837E0 1 2 /end IF_DATA BIT_MASK 0xFFFF /end MEASUREMENT
/begin MEASUREMENT fs31_08 "Filterwert Segmentabweichung, Betriebsbereich 31" UWORD dtsegn_b720divZylP5 0 0 -180.000439 179.994946 /begin IF_DATA ASAP1B_ETK KP_BLOB 0x383810 1 2 /end IF_DATA BIT_MASK 0xFFFF /end MEASUREMENT
/begin MEASUREMENT fs32_02 "Filterwert Segmentabweichung, Betriebsbereich 32, Zylinder 2" UWORD dtsegn_b720divZylP5 0 0 -180.000439 179.994946 /begin IF_DATA ASAP1B_ETK KP_BLOB 0x383700 1 2 /end IF_DATA BIT_MASK 0xFFFF /end MEASUREMENT
/begin MEASUREMENT fs32_03 "Filterwert Segmentabweichung, Betriebsbereich 32" UWORD dtsegn_b720divZylP5 0 0 -180.000439 179.994946 /begin IF_DATA ASAP1B_ETK KP_BLOB 0x383730 1 2 /end IF_DATA BIT_MASK 0xFFFF /end MEASUREMENT
/begin MEASUREMENT fs32_04 "Filterwert Segmentabweichung, Betriebsbereich 32" UWORD dtsegn_b720divZylP5 0 0 -180.000439 179.994946 /begin IF_DATA ASAP1B_ETK KP_BLOB 0x383760 1 2 /end IF_DATA BIT_MASK 0xFFFF /end MEASUREMENT
/begin MEASUREMENT fs32_05 "Filterwert Segmentabweichung, Betriebsbereich 32" UWORD dtsegn_b720divZylP5 0 0 -180.000439 179.994946 /begin IF_DATA ASAP1B_ETK KP_BLOB 0x383790 1 2 /end IF_DATA BIT_MASK 0xFFFF /end MEASUREMENT
/begin MEASUREMENT fs32_06 "Filterwert Segmentabweichung, Betriebsbereich 32" UWORD dtsegn_b720divZylP5 0 0 -180.000439 179.994946 /begin IF_DATA ASAP1B_ETK KP_BLOB 0x3837C0 1 2 /end IF_DATA BIT_MASK 0xFFFF /end MEASUREMENT
/begin MEASUREMENT fs32_07 "Filterwert Segmentabweichung, Betriebsbereich 32" UWORD dtsegn_b720divZylP5 0 0 -180.000439 179.994946 /begin IF_DATA ASAP1B_ETK KP_BLOB 0x3837F0 1 2 /end IF_DATA BIT_MASK 0xFFFF /end MEASUREMENT
/begin MEASUREMENT fs32_08 "Filterwert Segmentabweichung, Betriebsbereich 32" UWORD dtsegn_b720divZylP5 0 0 -180.000439 179.994946 /begin IF_DATA ASAP1B_ETK KP_BLOB 0x383820 1 2 /end IF_DATA BIT_MASK 0xFFFF /end MEASUREMENT
/begin MEASUREMENT fs33_02 "Filterwert Segmentabweichung, Betriebsbereich 33, Zylinder 2" UWORD dtsegn_b720divZylP5 0 0 -180.000439 179.994946 /begin IF_DATA ASAP1B_ETK KP_BLOB 0x383710 1 2 /end IF_DATA BIT_MASK 0xFFFF /end MEASUREMENT
/begin MEASUREMENT fs33_03 "Filterwert Segmentabweichung, Betriebsbereich 33" UWORD dtsegn_b720divZylP5 0 0 -180.000439 179.994946 /begin IF_DATA ASAP1B_ETK KP_BLOB 0x383740 1 2 /end IF_DATA BIT_MASK 0xFFFF /end MEASUREMENT
/begin MEASUREMENT fs33_04 "Filterwert Segmentabweichung, Betriebsbereich 33" UWORD dtsegn_b720divZylP5 0 0 -180.000439 179.994946 /begin IF_DATA ASAP1B_ETK KP_BLOB 0x383770 1 2 /end IF_DATA BIT_MASK 0xFFFF /end MEASUREMENT
/begin MEASUREMENT fs33_05 "Filterwert Segmentabweichung, Betriebsbereich 33" UWORD dtsegn_b720divZylP5 0 0 -180.000439 179.994946 /begin IF_DATA ASAP1B_ETK KP_BLOB 0x3837A0 1 2 /end IF_DATA BIT_MASK 0xFFFF /end MEASUREMENT
/begin MEASUREMENT fs33_06 "Filterwert Segmentabweichung, Betriebsbereich 33" UWORD dtsegn_b720divZylP5 0 0 -180.000439 179.994946 /begin IF_DATA ASAP1B_ETK KP_BLOB 0x3837D0 1 2 /end IF_DATA BIT_MASK 0xFFFF /end MEASUREMENT
/begin MEASUREMENT fs33_07 "Filterwert Segmentabweichung, Betriebsbereich 33" UWORD dtsegn_b720divZylP5 0 0 -180.000439 179.994946 /begin IF_DATA ASAP1B_ETK KP_BLOB 0x383800 1 2 /end IF_DATA BIT_MASK 0xFFFF /end MEASUREMENT
/begin MEASUREMENT fs33_08 "Filterwert Segmentabweichung, Betriebsbereich 33" UWORD dtsegn_b720divZylP5 0 0 -180.000439 179.994946 /begin IF_DATA ASAP1B_ETK KP_BLOB 0x383830 1 2 /end IF_DATA BIT_MASK 0xFFFF /end MEASUREMENT
/begin MEASUREMENT fs41_02 "Filterwert Segmentabweichung, Betriebsbereich 41, Zylinder 2" UWORD dtsegn_b720divZylP5 0 0 -180.000439 179.994946 /begin IF_DATA ASAP1B_ETK KP_BLOB 0x3836F2 1 2 /end IF_DATA BIT_MASK 0xFFFF /end MEASUREMENT
/begin MEASUREMENT fs41_03 "Filterwert Segmentabweichung, Betriebsbereich 41" UWORD dtsegn_b720divZylP5 0 0 -180.000439 179.994946 /begin IF_DATA ASAP1B_ETK KP_BLOB 0x383722 1 2 /end IF_DATA BIT_MASK 0xFFFF /end MEASUREMENT
/begin MEASUREMENT fs41_04 "Filterwert Segmentabweichung, Betriebsbereich 41" UWORD dtsegn_b720divZylP5 0 0 -180.000439 179.994946 /begin IF_DATA ASAP1B_ETK KP_BLOB 0x383752 1 2 /end IF_DATA BIT_MASK 0xFFFF /end MEASUREMENT
/begin MEASUREMENT fs41_05 "Filterwert Segmentabweichung, Betriebsbereich 41" UWORD dtsegn_b720divZylP5 0 0 -180.000439 179.994946 /begin IF_DATA ASAP1B_ETK KP_BLOB 0x383782 1 2 /end IF_DATA BIT_MASK 0xFFFF /end MEASUREMENT
/begin MEASUREMENT fs41_06 "Filterwert Segmentabweichung, Betriebsbereich 41" UWORD dtsegn_b720divZylP5 0 0 -180.000439 179.994946 /begin IF_DATA ASAP1B_ETK KP_BLOB 0x3837B2 1 2 /end IF_DATA BIT_MASK 0xFFFF /end MEASUREMENT
/begin MEASUREMENT fs41_07 "Filterwert Segmentabweichung, Betriebsbereich 41" UWORD dtsegn_b720divZylP5 0 0 -180.000439 179.994946 /begin IF_DATA ASAP1B_ETK KP_BLOB 0x3837E2 1 2 /end IF_DATA BIT_MASK 0xFFFF /end MEASUREMENT
/begin MEASUREMENT fs41_08 "Filterwert Segmentabweichung, Betriebsbereich 41" UWORD dtsegn_b720divZylP5 0 0 -180.000439 179.994946 /begin IF_DATA ASAP1B_ETK KP_BLOB 0x383812 1 2 /end IF_DATA BIT_MASK 0xFFFF /end MEASUREMENT
/begin MEASUREMENT fs42_02 "Filterwert Segmentabweichung, Betriebsbereich 42, Zylinder 2" UWORD dtsegn_b720divZylP5 0 0 -180.000439 179.994946 /begin IF_DATA ASAP1B_ETK KP_BLOB 0x383702 1 2 /end IF_DATA BIT_MASK 0xFFFF /end MEASUREMENT
/begin MEASUREMENT fs42_03 "Filterwert Segmentabweichung, Betriebsbereich 42" UWORD dtsegn_b720divZylP5 0 0 -180.000439 179.994946 /begin IF_DATA ASAP1B_ETK KP_BLOB 0x383732 1 2 /end IF_DATA BIT_MASK 0xFFFF /end MEASUREMENT
/begin MEASUREMENT fs42_04 "Filterwert Segmentabweichung, Betriebsbereich 42" UWORD dtsegn_b720divZylP5 0 0 -180.000439 179.994946 /begin IF_DATA ASAP1B_ETK KP_BLOB 0x383762 1 2 /end IF_DATA BIT_MASK 0xFFFF /end MEASUREMENT
/begin MEASUREMENT fs42_05 "Filterwert Segmentabweichung, Betriebsbereich 42" UWORD dtsegn_b720divZylP5 0 0 -180.000439 179.994946 /begin IF_DATA ASAP1B_ETK KP_BLOB 0x383792 1 2 /end IF_DATA BIT_MASK 0xFFFF /end MEASUREMENT
/begin MEASUREMENT fs42_06 "Filterwert Segmentabweichung, Betriebsbereich 42" UWORD dtsegn_b720divZylP5 0 0 -180.000439 179.994946 /begin IF_DATA ASAP1B_ETK KP_BLOB 0x3837C2 1 2 /end IF_DATA BIT_MASK 0xFFFF /end MEASUREMENT
/begin MEASUREMENT fs42_07 "Filterwert Segmentabweichung, Betriebsbereich 42" UWORD dtsegn_b720divZylP5 0 0 -180.000439 179.994946 /begin IF_DATA ASAP1B_ETK KP_BLOB 0x3837F2 1 2 /end IF_DATA BIT_MASK 0xFFFF /end MEASUREMENT
/begin MEASUREMENT fs42_08 "Filterwert Segmentabweichung, Betriebsbereich 42" UWORD dtsegn_b720divZylP5 0 0 -180.000439 179.994946 /begin IF_DATA ASAP1B_ETK KP_BLOB 0x383822 1 2 /end IF_DATA BIT_MASK 0xFFFF /end MEASUREMENT
/begin MEASUREMENT fs43_02 "Filterwert Segmentabweichung, Betriebsbereich 43, Zylinder 2" UWORD dtsegn_b720divZylP5 0 0 -180.000439 179.994946 /begin IF_DATA ASAP1B_ETK KP_BLOB 0x383712 1 2 /end IF_DATA BIT_MASK 0xFFFF /end MEASUREMENT
/begin MEASUREMENT fs43_03 "Filterwert Segmentabweichung, Betriebsbereich 43" UWORD dtsegn_b720divZylP5 0 0 -180.000439 179.994946 /begin IF_DATA ASAP1B_ETK KP_BLOB 0x383742 1 2 /end IF_DATA BIT_MASK 0xFFFF /end MEASUREMENT
/begin MEASUREMENT fs43_04 "Filterwert Segmentabweichung, Betriebsbereich 43" UWORD dtsegn_b720divZylP5 0 0 -180.000439 179.994946 /begin IF_DATA ASAP1B_ETK KP_BLOB 0x383772 1 2 /end IF_DATA BIT_MASK 0xFFFF /end MEASUREMENT
/begin MEASUREMENT fs43_05 "Filterwert Segmentabweichung, Betriebsbereich 43" UWORD dtsegn_b720divZylP5 0 0 -180.000439 179.994946 /begin IF_DATA ASAP1B_ETK KP_BLOB 0x3837A2 1 2 /end IF_DATA BIT_MASK 0xFFFF /end MEASUREMENT
/begin MEASUREMENT fs43_06 "Filterwert Segmentabweichung, Betriebsbereich 43" UWORD dtsegn_b720divZylP5 0 0 -180.000439 179.994946 /begin IF_DATA ASAP1B_ETK KP_BLOB 0x3837D2 1 2 /end IF_DATA BIT_MASK 0xFFFF /end MEASUREMENT
/begin MEASUREMENT fs43_07 "Filterwert Segmentabweichung, Betriebsbereich 43" UWORD dtsegn_b720divZylP5 0 0 -180.000439 179.994946 /begin IF_DATA ASAP1B_ETK KP_BLOB 0x383802 1 2 /end IF_DATA BIT_MASK 0xFFFF /end MEASUREMENT
/begin MEASUREMENT fs43_08 "Filterwert Segmentabweichung, Betriebsbereich 43" UWORD dtsegn_b720divZylP5 0 0 -180.000439 179.994946 /begin IF_DATA ASAP1B_ETK KP_BLOB 0x383832 1 2 /end IF_DATA BIT_MASK 0xFFFF /end MEASUREMENT
/begin MEASUREMENT fs51_02 "Filterwert Segmentabweichung, Betriebsbereich 51, Zylinder 2" UWORD dtsegn_b720divZylP5 0 0 -180.000439 179.994946 /begin IF_DATA ASAP1B_ETK KP_BLOB 0x3836F4 1 2 /end IF_DATA BIT_MASK 0xFFFF /end MEASUREMENT
/begin MEASUREMENT fs51_03 "Filterwert Segmentabweichung, Betriebsbereich 51" UWORD dtsegn_b720divZylP5 0 0 -180.000439 179.994946 /begin IF_DATA ASAP1B_ETK KP_BLOB 0x383724 1 2 /end IF_DATA BIT_MASK 0xFFFF /end MEASUREMENT
/begin MEASUREMENT fs51_04 "Filterwert Segmentabweichung, Betriebsbereich 51" UWORD dtsegn_b720divZylP5 0 0 -180.000439 179.994946 /begin IF_DATA ASAP1B_ETK KP_BLOB 0x383754 1 2 /end IF_DATA BIT_MASK 0xFFFF /end MEASUREMENT
/begin MEASUREMENT fs51_05 "Filterwert Segmentabweichung, Betriebsbereich 51" UWORD dtsegn_b720divZylP5 0 0 -180.000439 179.994946 /begin IF_DATA ASAP1B_ETK KP_BLOB 0x383784 1 2 /end IF_DATA BIT_MASK 0xFFFF /end MEASUREMENT
/begin MEASUREMENT fs51_06 "Filterwert Segmentabweichung, Betriebsbereich 51" UWORD dtsegn_b720divZylP5 0 0 -180.000439 179.994946 /begin IF_DATA ASAP1B_ETK KP_BLOB 0x3837B4 1 2 /end IF_DATA BIT_MASK 0xFFFF /end MEASUREMENT
/begin MEASUREMENT fs51_07 "Filterwert Segmentabweichung, Betriebsbereich 51" UWORD dtsegn_b720divZylP5 0 0 -180.000439 179.994946 /begin IF_DATA ASAP1B_ETK KP_BLOB 0x3837E4 1 2 /end IF_DATA BIT_MASK 0xFFFF /end MEASUREMENT
/begin MEASUREMENT fs51_08 "Filterwert Segmentabweichung, Betriebsbereich 51" UWORD dtsegn_b720divZylP5 0 0 -180.000439 179.994946 /begin IF_DATA ASAP1B_ETK KP_BLOB 0x383814 1 2 /end IF_DATA BIT_MASK 0xFFFF /end MEASUREMENT
/begin MEASUREMENT fs52_02 "Filterwert Segmentabweichung, Betriebsbereich 52, Zylinder 2" UWORD dtsegn_b720divZylP5 0 0 -180.000439 179.994946 /begin IF_DATA ASAP1B_ETK KP_BLOB 0x383704 1 2 /end IF_DATA BIT_MASK 0xFFFF /end MEASUREMENT
/begin MEASUREMENT fs52_03 "Filterwert Segmentabweichung, Betriebsbereich 52" UWORD dtsegn_b720divZylP5 0 0 -180.000439 179.994946 /begin IF_DATA ASAP1B_ETK KP_BLOB 0x383734 1 2 /end IF_DATA BIT_MASK 0xFFFF /end MEASUREMENT
/begin MEASUREMENT fs52_04 "Filterwert Segmentabweichung, Betriebsbereich 52" UWORD dtsegn_b720divZylP5 0 0 -180.000439 179.994946 /begin IF_DATA ASAP1B_ETK KP_BLOB 0x383764 1 2 /end IF_DATA BIT_MASK 0xFFFF /end MEASUREMENT
/begin MEASUREMENT fs52_05 "Filterwert Segmentabweichung, Betriebsbereich 52" UWORD dtsegn_b720divZylP5 0 0 -180.000439 179.994946 /begin IF_DATA ASAP1B_ETK KP_BLOB 0x383794 1 2 /end IF_DATA BIT_MASK 0xFFFF /end MEASUREMENT
/begin MEASUREMENT fs52_06 "Filterwert Segmentabweichung, Betriebsbereich 52" UWORD dtsegn_b720divZylP5 0 0 -180.000439 179.994946 /begin IF_DATA ASAP1B_ETK KP_BLOB 0x3837C4 1 2 /end IF_DATA BIT_MASK 0xFFFF /end MEASUREMENT
/begin MEASUREMENT fs52_07 "Filterwert Segmentabweichung, Betriebsbereich 52" UWORD dtsegn_b720divZylP5 0 0 -180.000439 179.994946 /begin IF_DATA ASAP1B_ETK KP_BLOB 0x3837F4 1 2 /end IF_DATA BIT_MASK 0xFFFF /end MEASUREMENT
/begin MEASUREMENT fs52_08 "Filterwert Segmentabweichung, Betriebsbereich 52" UWORD dtsegn_b720divZylP5 0 0 -180.000439 179.994946 /begin IF_DATA ASAP1B_ETK KP_BLOB 0x383824 1 2 /end IF_DATA BIT_MASK 0xFFFF /end MEASUREMENT
/begin MEASUREMENT fs53_02 "Filterwert Segmentabweichung, Betriebsbereich 53, Zylinder 2" UWORD dtsegn_b720divZylP5 0 0 -180.000439 179.994946 /begin IF_DATA ASAP1B_ETK KP_BLOB 0x383714 1 2 /end IF_DATA BIT_MASK 0xFFFF /end MEASUREMENT
/begin MEASUREMENT fs53_03 "Filterwert Segmentabweichung, Betriebsbereich 53" UWORD dtsegn_b720divZylP5 0 0 -180.000439 179.994946 /begin IF_DATA ASAP1B_ETK KP_BLOB 0x383744 1 2 /end IF_DATA BIT_MASK 0xFFFF /end MEASUREMENT
/begin MEASUREMENT fs53_04 "Filterwert Segmentabweichung, Betriebsbereich 53" UWORD dtsegn_b720divZylP5 0 0 -180.000439 179.994946 /begin IF_DATA ASAP1B_ETK KP_BLOB 0x383774 1 2 /end IF_DATA BIT_MASK 0xFFFF /end MEASUREMENT
/begin MEASUREMENT fs53_05 "Filterwert Segmentabweichung, Betriebsbereich 53" UWORD dtsegn_b720divZylP5 0 0 -180.000439 179.994946 /begin IF_DATA ASAP1B_ETK KP_BLOB 0x3837A4 1 2 /end IF_DATA BIT_MASK 0xFFFF /end MEASUREMENT
/begin MEASUREMENT fs53_06 "Filterwert Segmentabweichung, Betriebsbereich 53" UWORD dtsegn_b720divZylP5 0 0 -180.000439 179.994946 /begin IF_DATA ASAP1B_ETK KP_BLOB 0x3837D4 1 2 /end IF_DATA BIT_MASK 0xFFFF /end MEASUREMENT
/begin MEASUREMENT fs53_07 "Filterwert Segmentabweichung, Betriebsbereich 53" UWORD dtsegn_b720divZylP5 0 0 -180.000439 179.994946 /begin IF_DATA ASAP1B_ETK KP_BLOB 0x383804 1 2 /end IF_DATA BIT_MASK 0xFFFF /end MEASUREMENT
/begin MEASUREMENT fs53_08 "Filterwert Segmentabweichung, Betriebsbereich 53" UWORD dtsegn_b720divZylP5 0 0 -180.000439 179.994946 /begin IF_DATA ASAP1B_ETK KP_BLOB 0x383834 1 2 /end IF_DATA BIT_MASK 0xFFFF /end MEASUREMENT
/begin MEASUREMENT fs61_02 "Filterwert Segmentabweichung, Betriebsbereich 61, Zylinder 2" UWORD dtsegn_b720divZylP5 0 0 -180.000439 179.994946 /begin IF_DATA ASAP1B_ETK KP_BLOB 0x3836F6 1 2 /end IF_DATA BIT_MASK 0xFFFF /end MEASUREMENT
/begin MEASUREMENT fs61_03 "Filterwert Segmentabweichung, Betriebsbereich 61" UWORD dtsegn_b720divZylP5 0 0 -180.000439 179.994946 /begin IF_DATA ASAP1B_ETK KP_BLOB 0x383726 1 2 /end IF_DATA BIT_MASK 0xFFFF /end MEASUREMENT
/begin MEASUREMENT fs61_04 "Filterwert Segmentabweichung, Betriebsbereich 61" UWORD dtsegn_b720divZylP5 0 0 -180.000439 179.994946 /begin IF_DATA ASAP1B_ETK KP_BLOB 0x383756 1 2 /end IF_DATA BIT_MASK 0xFFFF /end MEASUREMENT
/begin MEASUREMENT fs61_05 "Filterwert Segmentabweichung, Betriebsbereich 61" UWORD dtsegn_b720divZylP5 0 0 -180.000439 179.994946 /begin IF_DATA ASAP1B_ETK KP_BLOB 0x383786 1 2 /end IF_DATA BIT_MASK 0xFFFF /end MEASUREMENT
/begin MEASUREMENT fs61_06 "Filterwert Segmentabweichung, Betriebsbereich 61" UWORD dtsegn_b720divZylP5 0 0 -180.000439 179.994946 /begin IF_DATA ASAP1B_ETK KP_BLOB 0x3837B6 1 2 /end IF_DATA BIT_MASK 0xFFFF /end MEASUREMENT
/begin MEASUREMENT fs61_07 "Filterwert Segmentabweichung, Betriebsbereich 61" UWORD dtsegn_b720divZylP5 0 0 -180.000439 179.994946 /begin IF_DATA ASAP1B_ETK KP_BLOB 0x3837E6 1 2 /end IF_DATA BIT_MASK 0xFFFF /end MEASUREMENT
/begin MEASUREMENT fs61_08 "Filterwert Segmentabweichung, Betriebsbereich 61" UWORD dtsegn_b720divZylP5 0 0 -180.000439 179.994946 /begin IF_DATA ASAP1B_ETK KP_BLOB 0x383816 1 2 /end IF_DATA BIT_MASK 0xFFFF /end MEASUREMENT
/begin MEASUREMENT fs62_02 "Filterwert Segmentabweichung, Betriebsbereich 62, Zylinder 2" UWORD dtsegn_b720divZylP5 0 0 -180.000439 179.994946 /begin IF_DATA ASAP1B_ETK KP_BLOB 0x383706 1 2 /end IF_DATA BIT_MASK 0xFFFF /end MEASUREMENT
/begin MEASUREMENT fs62_03 "Filterwert Segmentabweichung, Betriebsbereich 62" UWORD dtsegn_b720divZylP5 0 0 -180.000439 179.994946 /begin IF_DATA ASAP1B_ETK KP_BLOB 0x383736 1 2 /end IF_DATA BIT_MASK 0xFFFF /end MEASUREMENT
/begin MEASUREMENT fs62_04 "Filterwert Segmentabweichung, Betriebsbereich 62" UWORD dtsegn_b720divZylP5 0 0 -180.000439 179.994946 /begin IF_DATA ASAP1B_ETK KP_BLOB 0x383766 1 2 /end IF_DATA BIT_MASK 0xFFFF /end MEASUREMENT
/begin MEASUREMENT fs62_05 "Filterwert Segmentabweichung, Betriebsbereich 62" UWORD dtsegn_b720divZylP5 0 0 -180.000439 179.994946 /begin IF_DATA ASAP1B_ETK KP_BLOB 0x383796 1 2 /end IF_DATA BIT_MASK 0xFFFF /end MEASUREMENT
/begin MEASUREMENT fs62_06 "Filterwert Segmentabweichung, Betriebsbereich 62" UWORD dtsegn_b720divZylP5 0 0 -180.000439 179.994946 /begin IF_DATA ASAP1B_ETK KP_BLOB 0x3837C6 1 2 /end IF_DATA BIT_MASK 0xFFFF /end MEASUREMENT
/begin MEASUREMENT fs62_07 "Filterwert Segmentabweichung, Betriebsbereich 62" UWORD dtsegn_b720divZylP5 0 0 -180.000439 179.994946 /begin IF_DATA ASAP1B_ETK KP_BLOB 0x3837F6 1 2 /end IF_DATA BIT_MASK 0xFFFF /end MEASUREMENT
/begin MEASUREMENT fs62_08 "Filterwert Segmentabweichung, Betriebsbereich 62" UWORD dtsegn_b720divZylP5 0 0 -180.000439 179.994946 /begin IF_DATA ASAP1B_ETK KP_BLOB 0x383826 1 2 /end IF_DATA BIT_MASK 0xFFFF /end MEASUREMENT
/begin MEASUREMENT fs63_02 "Filterwert Segmentabweichung, Betriebsbereich 63, Zylinder 2" UWORD dtsegn_b720divZylP5 0 0 -180.000439 179.994946 /begin IF_DATA ASAP1B_ETK KP_BLOB 0x383716 1 2 /end IF_DATA BIT_MASK 0xFFFF /end MEASUREMENT
/begin MEASUREMENT fs63_03 "Filterwert Segmentabweichung, Betriebsbereich 63" UWORD dtsegn_b720divZylP5 0 0 -180.000439 179.994946 /begin IF_DATA ASAP1B_ETK KP_BLOB 0x383746 1 2 /end IF_DATA BIT_MASK 0xFFFF /end MEASUREMENT
/begin MEASUREMENT fs63_04 "Filterwert Segmentabweichung, Betriebsbereich 63" UWORD dtsegn_b720divZylP5 0 0 -180.000439 179.994946 /begin IF_DATA ASAP1B_ETK KP_BLOB 0x383776 1 2 /end IF_DATA BIT_MASK 0xFFFF /end MEASUREMENT
/begin MEASUREMENT fs63_05 "Filterwert Segmentabweichung, Betriebsbereich 63" UWORD dtsegn_b720divZylP5 0 0 -180.000439 179.994946 /begin IF_DATA ASAP1B_ETK KP_BLOB 0x3837A6 1 2 /end IF_DATA BIT_MASK 0xFFFF /end MEASUREMENT
/begin MEASUREMENT fs63_06 "Filterwert Segmentabweichung, Betriebsbereich 63" UWORD dtsegn_b720divZylP5 0 0 -180.000439 179.994946 /begin IF_DATA ASAP1B_ETK KP_BLOB 0x3837D6 1 2 /end IF_DATA BIT_MASK 0xFFFF /end MEASUREMENT
/begin MEASUREMENT fs63_07 "Filterwert Segmentabweichung, Betriebsbereich 63" UWORD dtsegn_b720divZylP5 0 0 -180.000439 179.994946 /begin IF_DATA ASAP1B_ETK KP_BLOB 0x383806 1 2 /end IF_DATA BIT_MASK 0xFFFF /end MEASUREMENT
/begin MEASUREMENT fs63_08 "Filterwert Segmentabweichung, Betriebsbereich 63" UWORD dtsegn_b720divZylP5 0 0 -180.000439 179.994946 /begin IF_DATA ASAP1B_ETK KP_BLOB 0x383836 1 2 /end IF_DATA BIT_MASK 0xFFFF /end MEASUREMENT
/begin MEASUREMENT fs71_02 "Filterwert Segmentabweichung, Betriebsbereich 71, Zylinder 2" UWORD dtsegn_b720divZylP5 0 0 -180.000439 179.994946 /begin IF_DATA ASAP1B_ETK KP_BLOB 0x3836F8 1 2 /end IF_DATA BIT_MASK 0xFFFF /end MEASUREMENT
/begin MEASUREMENT fs71_03 "Filterwert Segmentabweichung, Betriebsbereich 71, Zylinder 3" UWORD dtsegn_b720divZylP5 0 0 -180.000439 179.994946 /begin IF_DATA ASAP1B_ETK KP_BLOB 0x383728 1 2 /end IF_DATA BIT_MASK 0xFFFF /end MEASUREMENT
/begin MEASUREMENT fs71_04 "Filterwert Segmentabweichung, Betriebsbereich 71, Zylinder 4" UWORD dtsegn_b720divZylP5 0 0 -180.000439 179.994946 /begin IF_DATA ASAP1B_ETK KP_BLOB 0x383758 1 2 /end IF_DATA BIT_MASK 0xFFFF /end MEASUREMENT
/begin MEASUREMENT fs71_05 "Filterwert Segmentabweichung, Betriebsbereich 71, Zylinder 5" UWORD dtsegn_b720divZylP5 0 0 -180.000439 179.994946 /begin IF_DATA ASAP1B_ETK KP_BLOB 0x383788 1 2 /end IF_DATA BIT_MASK 0xFFFF /end MEASUREMENT
/begin MEASUREMENT fs71_06 "Filterwert Segmentabweichung, Betriebsbereich 71, Zylinder 6" UWORD dtsegn_b720divZylP5 0 0 -180.000439 179.994946 /begin IF_DATA ASAP1B_ETK KP_BLOB 0x3837B8 1 2 /end IF_DATA BIT_MASK 0xFFFF /end MEASUREMENT
/begin MEASUREMENT fs71_07 "Filterwert Segmentabweichung, Betriebsbereich 71, Zylinder 7" UWORD dtsegn_b720divZylP5 0 0 -180.000439 179.994946 /begin IF_DATA ASAP1B_ETK KP_BLOB 0x3837E8 1 2 /end IF_DATA BIT_MASK 0xFFFF /end MEASUREMENT
/begin MEASUREMENT fs71_08 "Filterwert Segmentabweichung, Betriebsbereich 71, Zylinder 8" UWORD dtsegn_b720divZylP5 0 0 -180.000439 179.994946 /begin IF_DATA ASAP1B_ETK KP_BLOB 0x383818 1 2 /end IF_DATA BIT_MASK 0xFFFF /end MEASUREMENT
/begin MEASUREMENT fs72_02 "Filterwert Segmentabweichung, Betriebsbereich 72, Zylinder 2" UWORD dtsegn_b720divZylP5 0 0 -180.000439 179.994946 /begin IF_DATA ASAP1B_ETK KP_BLOB 0x383708 1 2 /end IF_DATA BIT_MASK 0xFFFF /end MEASUREMENT
/begin MEASUREMENT fs72_03 "Filterwert Segmentabweichung, Betriebsbereich 72, Zylinder 3" UWORD dtsegn_b720divZylP5 0 0 -180.000439 179.994946 /begin IF_DATA ASAP1B_ETK KP_BLOB 0x383738 1 2 /end IF_DATA BIT_MASK 0xFFFF /end MEASUREMENT
/begin MEASUREMENT fs72_04 "Filterwert Segmentabweichung, Betriebsbereich 72, Zylinder 4" UWORD dtsegn_b720divZylP5 0 0 -180.000439 179.994946 /begin IF_DATA ASAP1B_ETK KP_BLOB 0x383768 1 2 /end IF_DATA BIT_MASK 0xFFFF /end MEASUREMENT
/begin MEASUREMENT fs72_05 "Filterwert Segmentabweichung, Betriebsbereich 72, Zylinder 5" UWORD dtsegn_b720divZylP5 0 0 -180.000439 179.994946 /begin IF_DATA ASAP1B_ETK KP_BLOB 0x383798 1 2 /end IF_DATA BIT_MASK 0xFFFF /end MEASUREMENT
/begin MEASUREMENT fs72_06 "Filterwert Segmentabweichung, Betriebsbereich 72, Zylinder 6" UWORD dtsegn_b720divZylP5 0 0 -180.000439 179.994946 /begin IF_DATA ASAP1B_ETK KP_BLOB 0x3837C8 1 2 /end IF_DATA BIT_MASK 0xFFFF /end MEASUREMENT
/begin MEASUREMENT fs72_07 "Filterwert Segmentabweichung, Betriebsbereich 72, Zylinder 7" UWORD dtsegn_b720divZylP5 0 0 -180.000439 179.994946 /begin IF_DATA ASAP1B_ETK KP_BLOB 0x3837F8 1 2 /end IF_DATA BIT_MASK 0xFFFF /end MEASUREMENT
/begin MEASUREMENT fs72_08 "Filterwert Segmentabweichung, Betriebsbereich 72, Zylinder 8" UWORD dtsegn_b720divZylP5 0 0 -180.000439 179.994946 /begin IF_DATA ASAP1B_ETK KP_BLOB 0x383828 1 2 /end IF_DATA BIT_MASK 0xFFFF /end MEASUREMENT
/begin MEASUREMENT fs73_02 "Filterwert Segmentabweichung, Betriebsbereich 73, Zylinder 2" UWORD dtsegn_b720divZylP5 0 0 -180.000439 179.994946 /begin IF_DATA ASAP1B_ETK KP_BLOB 0x383718 1 2 /end IF_DATA BIT_MASK 0xFFFF /end MEASUREMENT
/begin MEASUREMENT fs73_03 "Filterwert Segmentabweichung, Betriebsbereich 73, Zylinder 3" UWORD dtsegn_b720divZylP5 0 0 -180.000439 179.994946 /begin IF_DATA ASAP1B_ETK KP_BLOB 0x383748 1 2 /end IF_DATA BIT_MASK 0xFFFF /end MEASUREMENT
/begin MEASUREMENT fs73_04 "Filterwert Segmentabweichung, Betriebsbereich 73, Zylinder 4" UWORD dtsegn_b720divZylP5 0 0 -180.000439 179.994946 /begin IF_DATA ASAP1B_ETK KP_BLOB 0x383778 1 2 /end IF_DATA BIT_MASK 0xFFFF /end MEASUREMENT
/begin MEASUREMENT fs73_05 "Filterwert Segmentabweichung, Betriebsbereich 73, Zylinder 5" UWORD dtsegn_b720divZylP5 0 0 -180.000439 179.994946 /begin IF_DATA ASAP1B_ETK KP_BLOB 0x3837A8 1 2 /end IF_DATA BIT_MASK 0xFFFF /end MEASUREMENT
/begin MEASUREMENT fs73_06 "Filterwert Segmentabweichung, Betriebsbereich 73, Zylinder 6" UWORD dtsegn_b720divZylP5 0 0 -180.000439 179.994946 /begin IF_DATA ASAP1B_ETK KP_BLOB 0x3837D8 1 2 /end IF_DATA BIT_MASK 0xFFFF /end MEASUREMENT
/begin MEASUREMENT fs73_07 "Filterwert Segmentabweichung, Betriebsbereich 73, Zylinder 7" UWORD dtsegn_b720divZylP5 0 0 -180.000439 179.994946 /begin IF_DATA ASAP1B_ETK KP_BLOB 0x383808 1 2 /end IF_DATA BIT_MASK 0xFFFF /end MEASUREMENT
/begin MEASUREMENT fs73_08 "Filterwert Segmentabweichung, Betriebsbereich 73, Zylinder 8" UWORD dtsegn_b720divZylP5 0 0 -180.000439 179.994946 /begin IF_DATA ASAP1B_ETK KP_BLOB 0x383838 1 2 /end IF_DATA BIT_MASK 0xFFFF /end MEASUREMENT
/begin MEASUREMENT fs81_02 "Filterwert Segmentabweichung, Betriebsbereich 81, Zylinder 2" UWORD dtsegn_b720divZylP5 0 0 -180.000439 179.994946 /begin IF_DATA ASAP1B_ETK KP_BLOB 0x3836FA 1 2 /end IF_DATA BIT_MASK 0xFFFF /end MEASUREMENT
/begin MEASUREMENT fs81_03 "Filterwert Segmentabweichung, Betriebsbereich 81, Zylinder 3" UWORD dtsegn_b720divZylP5 0 0 -180.000439 179.994946 /begin IF_DATA ASAP1B_ETK KP_BLOB 0x38372A 1 2 /end IF_DATA BIT_MASK 0xFFFF /end MEASUREMENT
/begin MEASUREMENT fs81_04 "Filterwert Segmentabweichung, Betriebsbereich 81, Zylinder 4" UWORD dtsegn_b720divZylP5 0 0 -180.000439 179.994946 /begin IF_DATA ASAP1B_ETK KP_BLOB 0x38375A 1 2 /end IF_DATA BIT_MASK 0xFFFF /end MEASUREMENT
/begin MEASUREMENT fs81_05 "Filterwert Segmentabweichung, Betriebsbereich 81, Zylinder 5" UWORD dtsegn_b720divZylP5 0 0 -180.000439 179.994946 /begin IF_DATA ASAP1B_ETK KP_BLOB 0x38378A 1 2 /end IF_DATA BIT_MASK 0xFFFF /end MEASUREMENT
/begin MEASUREMENT fs81_06 "Filterwert Segmentabweichung, Betriebsbereich 81, Zylinder 6" UWORD dtsegn_b720divZylP5 0 0 -180.000439 179.994946 /begin IF_DATA ASAP1B_ETK KP_BLOB 0x3837BA 1 2 /end IF_DATA BIT_MASK 0xFFFF /end MEASUREMENT
/begin MEASUREMENT fs81_07 "Filterwert Segmentabweichung, Betriebsbereich 81, Zylinder 7" UWORD dtsegn_b720divZylP5 0 0 -180.000439 179.994946 /begin IF_DATA ASAP1B_ETK KP_BLOB 0x3837EA 1 2 /end IF_DATA BIT_MASK 0xFFFF /end MEASUREMENT
/begin MEASUREMENT fs81_08 "Filterwert Segmentabweichung, Betriebsbereich 81, Zylinder 8" UWORD dtsegn_b720divZylP5 0 0 -180.000439 179.994946 /begin IF_DATA ASAP1B_ETK KP_BLOB 0x38381A 1 2 /end IF_DATA BIT_MASK 0xFFFF /end MEASUREMENT
/begin MEASUREMENT fs82_02 "Filterwert Segmentabweichung, Betriebsbereich 82, Zylinder 2" UWORD dtsegn_b720divZylP5 0 0 -180.000439 179.994946 /begin IF_DATA ASAP1B_ETK KP_BLOB 0x38370A 1 2 /end IF_DATA BIT_MASK 0xFFFF /end MEASUREMENT
/begin MEASUREMENT fs82_03 "Filterwert Segmentabweichung, Betriebsbereich 82, Zylinder 3" UWORD dtsegn_b720divZylP5 0 0 -180.000439 179.994946 /begin IF_DATA ASAP1B_ETK KP_BLOB 0x38373A 1 2 /end IF_DATA BIT_MASK 0xFFFF /end MEASUREMENT
/begin MEASUREMENT fs82_04 "Filterwert Segmentabweichung, Betriebsbereich 82, Zylinder 4" UWORD dtsegn_b720divZylP5 0 0 -180.000439 179.994946 /begin IF_DATA ASAP1B_ETK KP_BLOB 0x38376A 1 2 /end IF_DATA BIT_MASK 0xFFFF /end MEASUREMENT
/begin MEASUREMENT fs82_05 "Filterwert Segmentabweichung, Betriebsbereich 82, Zylinder 5" UWORD dtsegn_b720divZylP5 0 0 -180.000439 179.994946 /begin IF_DATA ASAP1B_ETK KP_BLOB 0x38379A 1 2 /end IF_DATA BIT_MASK 0xFFFF /end MEASUREMENT
/begin MEASUREMENT fs82_06 "Filterwert Segmentabweichung, Betriebsbereich 82, Zylinder 6" UWORD dtsegn_b720divZylP5 0 0 -180.000439 179.994946 /begin IF_DATA ASAP1B_ETK KP_BLOB 0x3837CA 1 2 /end IF_DATA BIT_MASK 0xFFFF /end MEASUREMENT
/begin MEASUREMENT fs82_07 "Filterwert Segmentabweichung, Betriebsbereich 82, Zylinder 7" UWORD dtsegn_b720divZylP5 0 0 -180.000439 179.994946 /begin IF_DATA ASAP1B_ETK KP_BLOB 0x3837FA 1 2 /end IF_DATA BIT_MASK 0xFFFF /end MEASUREMENT
/begin MEASUREMENT fs82_08 "Filterwert Segmentabweichung, Betriebsbereich 82, Zylinder 8" UWORD dtsegn_b720divZylP5 0 0 -180.000439 179.994946 /begin IF_DATA ASAP1B_ETK KP_BLOB 0x38382A 1 2 /end IF_DATA BIT_MASK 0xFFFF /end MEASUREMENT
/begin MEASUREMENT fs83_02 "Filterwert Segmentabweichung, Betriebsbereich 83, Zylinder 2" UWORD dtsegn_b720divZylP5 0 0 -180.000439 179.994946 /begin IF_DATA ASAP1B_ETK KP_BLOB 0x38371A 1 2 /end IF_DATA BIT_MASK 0xFFFF /end MEASUREMENT
/begin MEASUREMENT fs83_03 "Filterwert Segmentabweichung, Betriebsbereich 83, Zylinder 3" UWORD dtsegn_b720divZylP5 0 0 -180.000439 179.994946 /begin IF_DATA ASAP1B_ETK KP_BLOB 0x38374A 1 2 /end IF_DATA BIT_MASK 0xFFFF /end MEASUREMENT
/begin MEASUREMENT fs83_04 "Filterwert Segmentabweichung, Betriebsbereich 83, Zylinder 4" UWORD dtsegn_b720divZylP5 0 0 -180.000439 179.994946 /begin IF_DATA ASAP1B_ETK KP_BLOB 0x38377A 1 2 /end IF_DATA BIT_MASK 0xFFFF /end MEASUREMENT
/begin MEASUREMENT fs83_05 "Filterwert Segmentabweichung, Betriebsbereich 83, Zylinder 5" UWORD dtsegn_b720divZylP5 0 0 -180.000439 179.994946 /begin IF_DATA ASAP1B_ETK KP_BLOB 0x3837AA 1 2 /end IF_DATA BIT_MASK 0xFFFF /end MEASUREMENT
/begin MEASUREMENT fs83_06 "Filterwert Segmentabweichung, Betriebsbereich 83, Zylinder 6" UWORD dtsegn_b720divZylP5 0 0 -180.000439 179.994946 /begin IF_DATA ASAP1B_ETK KP_BLOB 0x3837DA 1 2 /end IF_DATA BIT_MASK 0xFFFF /end MEASUREMENT
/begin MEASUREMENT fs83_07 "Filterwert Segmentabweichung, Betriebsbereich 83, Zylinder 7" UWORD dtsegn_b720divZylP5 0 0 -180.000439 179.994946 /begin IF_DATA ASAP1B_ETK KP_BLOB 0x38380A 1 2 /end IF_DATA BIT_MASK 0xFFFF /end MEASUREMENT
/begin MEASUREMENT fs83_08 "Filterwert Segmentabweichung, Betriebsbereich 83, Zylinder 8" UWORD dtsegn_b720divZylP5 0 0 -180.000439 179.994946 /begin IF_DATA ASAP1B_ETK KP_BLOB 0x38383A 1 2 /end IF_DATA BIT_MASK 0xFFFF /end MEASUREMENT
/begin MEASUREMENT fse "aktueller Filterwert Segmentabweichung, zur Segmentzeit-Korrektur" SBYTE dtsegn_b11p25divZyl 0 0 -2.812501 2.790528 /begin IF_DATA ASAP1B_ETK KP_BLOB 0x380A0D 1 1 /end IF_DATA BIT_MASK 0xFF /end MEASUREMENT
/begin MEASUREMENT fse11_02 "Filterwert Segmentabweichung, eingerechnet" UBYTE dtsegno_b11p25divZyl 0 0 -2.812501 2.790528 /begin IF_DATA ASAP1B_ETK KP_BLOB 0x383254 1 1 /end IF_DATA BIT_MASK 0xFF /end MEASUREMENT
/begin MEASUREMENT fse11_03 "Filterwert Segmentabweichung, eingerechnet" UBYTE dtsegno_b11p25divZyl 0 0 -2.812501 2.790528 /begin IF_DATA ASAP1B_ETK KP_BLOB 0x38326C 1 1 /end IF_DATA BIT_MASK 0xFF /end MEASUREMENT
/begin MEASUREMENT fse11_04 "Filterwert Segmentabweichung, eingerechnet" UBYTE dtsegno_b11p25divZyl 0 0 -2.812501 2.790528 /begin IF_DATA ASAP1B_ETK KP_BLOB 0x383284 1 1 /end IF_DATA BIT_MASK 0xFF /end MEASUREMENT
/begin MEASUREMENT fse11_05 "Filterwert Segmentabweichung, eingerechnet" UBYTE dtsegno_b11p25divZyl 0 0 -2.812501 2.790528 /begin IF_DATA ASAP1B_ETK KP_BLOB 0x38329C 1 1 /end IF_DATA BIT_MASK 0xFF /end MEASUREMENT
/begin MEASUREMENT fse11_06 "Filterwert Segmentabweichung, eingerechnet" UBYTE dtsegno_b11p25divZyl 0 0 -2.812501 2.790528 /begin IF_DATA ASAP1B_ETK KP_BLOB 0x3832B4 1 1 /end IF_DATA BIT_MASK 0xFF /end MEASUREMENT
/begin MEASUREMENT fse11_07 "Filterwert Segmentabweichung, eingerechnet" UBYTE dtsegno_b11p25divZyl 0 0 -2.812501 2.790528 /begin IF_DATA ASAP1B_ETK KP_BLOB 0x3832CC 1 1 /end IF_DATA BIT_MASK 0xFF /end MEASUREMENT
/begin MEASUREMENT fse11_08 "Filterwert Segmentabweichung, eingerechnet" UBYTE dtsegno_b11p25divZyl 0 0 -2.812501 2.790528 /begin IF_DATA ASAP1B_ETK KP_BLOB 0x3832E4 1 1 /end IF_DATA BIT_MASK 0xFF /end MEASUREMENT
/begin MEASUREMENT fse12_02 "Filterwert Segmentabweichung, eingerechnet" UBYTE dtsegno_b11p25divZyl 0 0 -2.812501 2.790528 /begin IF_DATA ASAP1B_ETK KP_BLOB 0x38325C 1 1 /end IF_DATA BIT_MASK 0xFF /end MEASUREMENT
/begin MEASUREMENT fse12_03 "Filterwert Segmentabweichung, eingerechnet" UBYTE dtsegno_b11p25divZyl 0 0 -2.812501 2.790528 /begin IF_DATA ASAP1B_ETK KP_BLOB 0x383274 1 1 /end IF_DATA BIT_MASK 0xFF /end MEASUREMENT
/begin MEASUREMENT fse12_04 "Filterwert Segmentabweichung, eingerechnet" UBYTE dtsegno_b11p25divZyl 0 0 -2.812501 2.790528 /begin IF_DATA ASAP1B_ETK KP_BLOB 0x38328C 1 1 /end IF_DATA BIT_MASK 0xFF /end MEASUREMENT
/begin MEASUREMENT fse12_05 "Filterwert Segmentabweichung, eingerechnet" UBYTE dtsegno_b11p25divZyl 0 0 -2.812501 2.790528 /begin IF_DATA ASAP1B_ETK KP_BLOB 0x3832A4 1 1 /end IF_DATA BIT_MASK 0xFF /end MEASUREMENT
/begin MEASUREMENT fse12_06 "Filterwert Segmentabweichung, eingerechnet" UBYTE dtsegno_b11p25divZyl 0 0 -2.812501 2.790528 /begin IF_DATA ASAP1B_ETK KP_BLOB 0x3832BC 1 1 /end IF_DATA BIT_MASK 0xFF /end MEASUREMENT
/begin MEASUREMENT fse12_07 "Filterwert Segmentabweichung, eingerechnet" UBYTE dtsegno_b11p25divZyl 0 0 -2.812501 2.790528 /begin IF_DATA ASAP1B_ETK KP_BLOB 0x3832D4 1 1 /end IF_DATA BIT_MASK 0xFF /end MEASUREMENT
/begin MEASUREMENT fse12_08 "Filterwert Segmentabweichung, eingerechnet" UBYTE dtsegno_b11p25divZyl 0 0 -2.812501 2.790528 /begin IF_DATA ASAP1B_ETK KP_BLOB 0x3832EC 1 1 /end IF_DATA BIT_MASK 0xFF /end MEASUREMENT
/begin MEASUREMENT fse13_02 "Filterwert Segmentabweichung, eingerechnet" UBYTE dtsegno_b11p25divZyl 0 0 -2.812501 2.790528 /begin IF_DATA ASAP1B_ETK KP_BLOB 0x383264 1 1 /end IF_DATA BIT_MASK 0xFF /end MEASUREMENT
/begin MEASUREMENT fse13_03 "Filterwert Segmentabweichung, eingerechnet" UBYTE dtsegno_b11p25divZyl 0 0 -2.812501 2.790528 /begin IF_DATA ASAP1B_ETK KP_BLOB 0x38327C 1 1 /end IF_DATA BIT_MASK 0xFF /end MEASUREMENT
/begin MEASUREMENT fse13_04 "Filterwert Segmentabweichung, eingerechnet" UBYTE dtsegno_b11p25divZyl 0 0 -2.812501 2.790528 /begin IF_DATA ASAP1B_ETK KP_BLOB 0x383294 1 1 /end IF_DATA BIT_MASK 0xFF /end MEASUREMENT
/begin MEASUREMENT fse13_05 "Filterwert Segmentabweichung, eingerechnet" UBYTE dtsegno_b11p25divZyl 0 0 -2.812501 2.790528 /begin IF_DATA ASAP1B_ETK KP_BLOB 0x3832AC 1 1 /end IF_DATA BIT_MASK 0xFF /end MEASUREMENT
/begin MEASUREMENT fse13_06 "Filterwert Segmentabweichung, eingerechnet" UBYTE dtsegno_b11p25divZyl 0 0 -2.812501 2.790528 /begin IF_DATA ASAP1B_ETK KP_BLOB 0x3832C4 1 1 /end IF_DATA BIT_MASK 0xFF /end MEASUREMENT
/begin MEASUREMENT fse13_07 "Filterwert Segmentabweichung, eingerechnet" UBYTE dtsegno_b11p25divZyl 0 0 -2.812501 2.790528 /begin IF_DATA ASAP1B_ETK KP_BLOB 0x3832DC 1 1 /end IF_DATA BIT_MASK 0xFF /end MEASUREMENT
/begin MEASUREMENT fse13_08 "Filterwert Segmentabweichung, eingerechnet" UBYTE dtsegno_b11p25divZyl 0 0 -2.812501 2.790528 /begin IF_DATA ASAP1B_ETK KP_BLOB 0x3832F4 1 1 /end IF_DATA BIT_MASK 0xFF /end MEASUREMENT
/begin MEASUREMENT fse21_02 "Filterwert Segmentabweichung, eingerechnet" UBYTE dtsegno_b11p25divZyl 0 0 -2.812501 2.790528 /begin IF_DATA ASAP1B_ETK KP_BLOB 0x383255 1 1 /end IF_DATA BIT_MASK 0xFF /end MEASUREMENT
/begin MEASUREMENT fse21_03 "Filterwert Segmentabweichung, eingerechnet" UBYTE dtsegno_b11p25divZyl 0 0 -2.812501 2.790528 /begin IF_DATA ASAP1B_ETK KP_BLOB 0x38326D 1 1 /end IF_DATA BIT_MASK 0xFF /end MEASUREMENT
/begin MEASUREMENT fse21_04 "Filterwert Segmentabweichung, eingerechnet" UBYTE dtsegno_b11p25divZyl 0 0 -2.812501 2.790528 /begin IF_DATA ASAP1B_ETK KP_BLOB 0x383285 1 1 /end IF_DATA BIT_MASK 0xFF /end MEASUREMENT
/begin MEASUREMENT fse21_05 "Filterwert Segmentabweichung, eingerechnet" UBYTE dtsegno_b11p25divZyl 0 0 -2.812501 2.790528 /begin IF_DATA ASAP1B_ETK KP_BLOB 0x38329D 1 1 /end IF_DATA BIT_MASK 0xFF /end MEASUREMENT
/begin MEASUREMENT fse21_06 "Filterwert Segmentabweichung, eingerechnet" UBYTE dtsegno_b11p25divZyl 0 0 -2.812501 2.790528 /begin IF_DATA ASAP1B_ETK KP_BLOB 0x3832B5 1 1 /end IF_DATA BIT_MASK 0xFF /end MEASUREMENT
/begin MEASUREMENT fse21_07 "Filterwert Segmentabweichung, eingerechnet" UBYTE dtsegno_b11p25divZyl 0 0 -2.812501 2.790528 /begin IF_DATA ASAP1B_ETK KP_BLOB 0x3832CD 1 1 /end IF_DATA BIT_MASK 0xFF /end MEASUREMENT
/begin MEASUREMENT fse21_08 "Filterwert Segmentabweichung, eingerechnet" UBYTE dtsegno_b11p25divZyl 0 0 -2.812501 2.790528 /begin IF_DATA ASAP1B_ETK KP_BLOB 0x3832E5 1 1 /end IF_DATA BIT_MASK 0xFF /end MEASUREMENT
/begin MEASUREMENT fse22_02 "Filterwert Segmentabweichung, eingerechnet" UBYTE dtsegno_b11p25divZyl 0 0 -2.812501 2.790528 /begin IF_DATA ASAP1B_ETK KP_BLOB 0x38325D 1 1 /end IF_DATA BIT_MASK 0xFF /end MEASUREMENT
/begin MEASUREMENT fse22_03 "Filterwert Segmentabweichung, eingerechnet" UBYTE dtsegno_b11p25divZyl 0 0 -2.812501 2.790528 /begin IF_DATA ASAP1B_ETK KP_BLOB 0x383275 1 1 /end IF_DATA BIT_MASK 0xFF /end MEASUREMENT
/begin MEASUREMENT fse22_04 "Filterwert Segmentabweichung, eingerechnet" UBYTE dtsegno_b11p25divZyl 0 0 -2.812501 2.790528 /begin IF_DATA ASAP1B_ETK KP_BLOB 0x38328D 1 1 /end IF_DATA BIT_MASK 0xFF /end MEASUREMENT
/begin MEASUREMENT fse22_05 "Filterwert Segmentabweichung, eingerechnet" UBYTE dtsegno_b11p25divZyl 0 0 -2.812501 2.790528 /begin IF_DATA ASAP1B_ETK KP_BLOB 0x3832A5 1 1 /end IF_DATA BIT_MASK 0xFF /end MEASUREMENT
/begin MEASUREMENT fse22_06 "Filterwert Segmentabweichung, eingerechnet" UBYTE dtsegno_b11p25divZyl 0 0 -2.812501 2.790528 /begin IF_DATA ASAP1B_ETK KP_BLOB 0x3832BD 1 1 /end IF_DATA BIT_MASK 0xFF /end MEASUREMENT
/begin MEASUREMENT fse22_07 "Filterwert Segmentabweichung, eingerechnet" UBYTE dtsegno_b11p25divZyl 0 0 -2.812501 2.790528 /begin IF_DATA ASAP1B_ETK KP_BLOB 0x3832D5 1 1 /end IF_DATA BIT_MASK 0xFF /end MEASUREMENT
/begin MEASUREMENT fse22_08 "Filterwert Segmentabweichung, eingerechnet" UBYTE dtsegno_b11p25divZyl 0 0 -2.812501 2.790528 /begin IF_DATA ASAP1B_ETK KP_BLOB 0x3832ED 1 1 /end IF_DATA BIT_MASK 0xFF /end MEASUREMENT
/begin MEASUREMENT fse23_02 "Filterwert Segmentabweichung, eingerechnet" UBYTE dtsegno_b11p25divZyl 0 0 -2.812501 2.790528 /begin IF_DATA ASAP1B_ETK KP_BLOB 0x383265 1 1 /end IF_DATA BIT_MASK 0xFF /end MEASUREMENT
/begin MEASUREMENT fse23_03 "Filterwert Segmentabweichung, eingerechnet" UBYTE dtsegno_b11p25divZyl 0 0 -2.812501 2.790528 /begin IF_DATA ASAP1B_ETK KP_BLOB 0x38327D 1 1 /end IF_DATA BIT_MASK 0xFF /end MEASUREMENT
/begin MEASUREMENT fse23_04 "Filterwert Segmentabweichung, eingerechnet" UBYTE dtsegno_b11p25divZyl 0 0 -2.812501 2.790528 /begin IF_DATA ASAP1B_ETK KP_BLOB 0x383295 1 1 /end IF_DATA BIT_MASK 0xFF /end MEASUREMENT
/begin MEASUREMENT fse23_05 "Filterwert Segmentabweichung, eingerechnet" UBYTE dtsegno_b11p25divZyl 0 0 -2.812501 2.790528 /begin IF_DATA ASAP1B_ETK KP_BLOB 0x3832AD 1 1 /end IF_DATA BIT_MASK 0xFF /end MEASUREMENT
/begin MEASUREMENT fse23_06 "Filterwert Segmentabweichung, eingerechnet" UBYTE dtsegno_b11p25divZyl 0 0 -2.812501 2.790528 /begin IF_DATA ASAP1B_ETK KP_BLOB 0x3832C5 1 1 /end IF_DATA BIT_MASK 0xFF /end MEASUREMENT
/begin MEASUREMENT fse23_07 "Filterwert Segmentabweichung, eingerechnet" UBYTE dtsegno_b11p25divZyl 0 0 -2.812501 2.790528 /begin IF_DATA ASAP1B_ETK KP_BLOB 0x3832DD 1 1 /end IF_DATA BIT_MASK 0xFF /end MEASUREMENT
/begin MEASUREMENT fse23_08 "Filterwert Segmentabweichung, eingerechnet" UBYTE dtsegno_b11p25divZyl 0 0 -2.812501 2.790528 /begin IF_DATA ASAP1B_ETK KP_BLOB 0x3832F5 1 1 /end IF_DATA BIT_MASK 0xFF /end MEASUREMENT
/begin MEASUREMENT fse31_02 "Filterwert Segmentabweichung, eingerechnet" UBYTE dtsegno_b11p25divZyl 0 0 -2.812501 2.790528 /begin IF_DATA ASAP1B_ETK KP_BLOB 0x383256 1 1 /end IF_DATA BIT_MASK 0xFF /end MEASUREMENT
/begin MEASUREMENT fse31_03 "Filterwert Segmentabweichung, eingerechnet" UBYTE dtsegno_b11p25divZyl 0 0 -2.812501 2.790528 /begin IF_DATA ASAP1B_ETK KP_BLOB 0x38326E 1 1 /end IF_DATA BIT_MASK 0xFF /end MEASUREMENT
/begin MEASUREMENT fse31_04 "Filterwert Segmentabweichung, eingerechnet" UBYTE dtsegno_b11p25divZyl 0 0 -2.812501 2.790528 /begin IF_DATA ASAP1B_ETK KP_BLOB 0x383286 1 1 /end IF_DATA BIT_MASK 0xFF /end MEASUREMENT
/begin MEASUREMENT fse31_05 "Filterwert Segmentabweichung, eingerechnet" UBYTE dtsegno_b11p25divZyl 0 0 -2.812501 2.790528 /begin IF_DATA ASAP1B_ETK KP_BLOB 0x38329E 1 1 /end IF_DATA BIT_MASK 0xFF /end MEASUREMENT
/begin MEASUREMENT fse31_06 "Filterwert Segmentabweichung, eingerechnet" UBYTE dtsegno_b11p25divZyl 0 0 -2.812501 2.790528 /begin IF_DATA ASAP1B_ETK KP_BLOB 0x3832B6 1 1 /end IF_DATA BIT_MASK 0xFF /end MEASUREMENT
/begin MEASUREMENT fse31_07 "Filterwert Segmentabweichung, eingerechnet" UBYTE dtsegno_b11p25divZyl 0 0 -2.812501 2.790528 /begin IF_DATA ASAP1B_ETK KP_BLOB 0x3832CE 1 1 /end IF_DATA BIT_MASK 0xFF /end MEASUREMENT
/begin MEASUREMENT fse31_08 "Filterwert Segmentabweichung, eingerechnet" UBYTE dtsegno_b11p25divZyl 0 0 -2.812501 2.790528 /begin IF_DATA ASAP1B_ETK KP_BLOB 0x3832E6 1 1 /end IF_DATA BIT_MASK 0xFF /end MEASUREMENT
/begin MEASUREMENT fse32_02 "Filterwert Segmentabweichung, eingerechnet" UBYTE dtsegno_b11p25divZyl 0 0 -2.812501 2.790528 /begin IF_DATA ASAP1B_ETK KP_BLOB 0x38325E 1 1 /end IF_DATA BIT_MASK 0xFF /end MEASUREMENT
/begin MEASUREMENT fse32_03 "Filterwert Segmentabweichung, eingerechnet" UBYTE dtsegno_b11p25divZyl 0 0 -2.812501 2.790528 /begin IF_DATA ASAP1B_ETK KP_BLOB 0x383276 1 1 /end IF_DATA BIT_MASK 0xFF /end MEASUREMENT
/begin MEASUREMENT fse32_04 "Filterwert Segmentabweichung, eingerechnet" UBYTE dtsegno_b11p25divZyl 0 0 -2.812501 2.790528 /begin IF_DATA ASAP1B_ETK KP_BLOB 0x38328E 1 1 /end IF_DATA BIT_MASK 0xFF /end MEASUREMENT
/begin MEASUREMENT fse32_05 "Filterwert Segmentabweichung, eingerechnet" UBYTE dtsegno_b11p25divZyl 0 0 -2.812501 2.790528 /begin IF_DATA ASAP1B_ETK KP_BLOB 0x3832A6 1 1 /end IF_DATA BIT_MASK 0xFF /end MEASUREMENT
/begin MEASUREMENT fse32_06 "Filterwert Segmentabweichung, eingerechnet" UBYTE dtsegno_b11p25divZyl 0 0 -2.812501 2.790528 /begin IF_DATA ASAP1B_ETK KP_BLOB 0x3832BE 1 1 /end IF_DATA BIT_MASK 0xFF /end MEASUREMENT
/begin MEASUREMENT fse32_07 "Filterwert Segmentabweichung, eingerechnet" UBYTE dtsegno_b11p25divZyl 0 0 -2.812501 2.790528 /begin IF_DATA ASAP1B_ETK KP_BLOB 0x3832D6 1 1 /end IF_DATA BIT_MASK 0xFF /end MEASUREMENT
/begin MEASUREMENT fse32_08 "Filterwert Segmentabweichung, eingerechnet" UBYTE dtsegno_b11p25divZyl 0 0 -2.812501 2.790528 /begin IF_DATA ASAP1B_ETK KP_BLOB 0x3832EE 1 1 /end IF_DATA BIT_MASK 0xFF /end MEASUREMENT
/begin MEASUREMENT fse33_02 "Filterwert Segmentabweichung, eingerechnet" UBYTE dtsegno_b11p25divZyl 0 0 -2.812501 2.790528 /begin IF_DATA ASAP1B_ETK KP_BLOB 0x383266 1 1 /end IF_DATA BIT_MASK 0xFF /end MEASUREMENT
/begin MEASUREMENT fse33_03 "Filterwert Segmentabweichung, eingerechnet" UBYTE dtsegno_b11p25divZyl 0 0 -2.812501 2.790528 /begin IF_DATA ASAP1B_ETK KP_BLOB 0x38327E 1 1 /end IF_DATA BIT_MASK 0xFF /end MEASUREMENT
/begin MEASUREMENT fse33_04 "Filterwert Segmentabweichung, eingerechnet" UBYTE dtsegno_b11p25divZyl 0 0 -2.812501 2.790528 /begin IF_DATA ASAP1B_ETK KP_BLOB 0x383296 1 1 /end IF_DATA BIT_MASK 0xFF /end MEASUREMENT
/begin MEASUREMENT fse33_05 "Filterwert Segmentabweichung, eingerechnet" UBYTE dtsegno_b11p25divZyl 0 0 -2.812501 2.790528 /begin IF_DATA ASAP1B_ETK KP_BLOB 0x3832AE 1 1 /end IF_DATA BIT_MASK 0xFF /end MEASUREMENT
/begin MEASUREMENT fse33_06 "Filterwert Segmentabweichung, eingerechnet" UBYTE dtsegno_b11p25divZyl 0 0 -2.812501 2.790528 /begin IF_DATA ASAP1B_ETK KP_BLOB 0x3832C6 1 1 /end IF_DATA BIT_MASK 0xFF /end MEASUREMENT
/begin MEASUREMENT fse33_07 "Filterwert Segmentabweichung, eingerechnet" UBYTE dtsegno_b11p25divZyl 0 0 -2.812501 2.790528 /begin IF_DATA ASAP1B_ETK KP_BLOB 0x3832DE 1 1 /end IF_DATA BIT_MASK 0xFF /end MEASUREMENT
/begin MEASUREMENT fse33_08 "Filterwert Segmentabweichung, eingerechnet" UBYTE dtsegno_b11p25divZyl 0 0 -2.812501 2.790528 /begin IF_DATA ASAP1B_ETK KP_BLOB 0x3832F6 1 1 /end IF_DATA BIT_MASK 0xFF /end MEASUREMENT
/begin MEASUREMENT fse41_02 "Filterwert Segmentabweichung, eingerechnet" UBYTE dtsegno_b11p25divZyl 0 0 -2.812501 2.790528 /begin IF_DATA ASAP1B_ETK KP_BLOB 0x383257 1 1 /end IF_DATA BIT_MASK 0xFF /end MEASUREMENT
/begin MEASUREMENT fse41_03 "Filterwert Segmentabweichung, eingerechnet" UBYTE dtsegno_b11p25divZyl 0 0 -2.812501 2.790528 /begin IF_DATA ASAP1B_ETK KP_BLOB 0x38326F 1 1 /end IF_DATA BIT_MASK 0xFF /end MEASUREMENT
/begin MEASUREMENT fse41_04 "Filterwert Segmentabweichung, eingerechnet" UBYTE dtsegno_b11p25divZyl 0 0 -2.812501 2.790528 /begin IF_DATA ASAP1B_ETK KP_BLOB 0x383287 1 1 /end IF_DATA BIT_MASK 0xFF /end MEASUREMENT
/begin MEASUREMENT fse41_05 "Filterwert Segmentabweichung, eingerechnet" UBYTE dtsegno_b11p25divZyl 0 0 -2.812501 2.790528 /begin IF_DATA ASAP1B_ETK KP_BLOB 0x38329F 1 1 /end IF_DATA BIT_MASK 0xFF /end MEASUREMENT
/begin MEASUREMENT fse41_06 "Filterwert Segmentabweichung, eingerechnet" UBYTE dtsegno_b11p25divZyl 0 0 -2.812501 2.790528 /begin IF_DATA ASAP1B_ETK KP_BLOB 0x3832B7 1 1 /end IF_DATA BIT_MASK 0xFF /end MEASUREMENT
/begin MEASUREMENT fse41_07 "Filterwert Segmentabweichung, eingerechnet" UBYTE dtsegno_b11p25divZyl 0 0 -2.812501 2.790528 /begin IF_DATA ASAP1B_ETK KP_BLOB 0x3832CF 1 1 /end IF_DATA BIT_MASK 0xFF /end MEASUREMENT
/begin MEASUREMENT fse41_08 "Filterwert Segmentabweichung, eingerechnet" UBYTE dtsegno_b11p25divZyl 0 0 -2.812501 2.790528 /begin IF_DATA ASAP1B_ETK KP_BLOB 0x3832E7 1 1 /end IF_DATA BIT_MASK 0xFF /end MEASUREMENT
/begin MEASUREMENT fse42_02 "Filterwert Segmentabweichung, eingerechnet" UBYTE dtsegno_b11p25divZyl 0 0 -2.812501 2.790528 /begin IF_DATA ASAP1B_ETK KP_BLOB 0x38325F 1 1 /end IF_DATA BIT_MASK 0xFF /end MEASUREMENT
/begin MEASUREMENT fse42_03 "Filterwert Segmentabweichung, eingerechnet" UBYTE dtsegno_b11p25divZyl 0 0 -2.812501 2.790528 /begin IF_DATA ASAP1B_ETK KP_BLOB 0x383277 1 1 /end IF_DATA BIT_MASK 0xFF /end MEASUREMENT
/begin MEASUREMENT fse42_04 "Filterwert Segmentabweichung, eingerechnet" UBYTE dtsegno_b11p25divZyl 0 0 -2.812501 2.790528 /begin IF_DATA ASAP1B_ETK KP_BLOB 0x38328F 1 1 /end IF_DATA BIT_MASK 0xFF /end MEASUREMENT
/begin MEASUREMENT fse42_05 "Filterwert Segmentabweichung, eingerechnet" UBYTE dtsegno_b11p25divZyl 0 0 -2.812501 2.790528 /begin IF_DATA ASAP1B_ETK KP_BLOB 0x3832A7 1 1 /end IF_DATA BIT_MASK 0xFF /end MEASUREMENT
/begin MEASUREMENT fse42_06 "Filterwert Segmentabweichung, eingerechnet" UBYTE dtsegno_b11p25divZyl 0 0 -2.812501 2.790528 /begin IF_DATA ASAP1B_ETK KP_BLOB 0x3832BF 1 1 /end IF_DATA BIT_MASK 0xFF /end MEASUREMENT
/begin MEASUREMENT fse42_07 "Filterwert Segmentabweichung, eingerechnet" UBYTE dtsegno_b11p25divZyl 0 0 -2.812501 2.790528 /begin IF_DATA ASAP1B_ETK KP_BLOB 0x3832D7 1 1 /end IF_DATA BIT_MASK 0xFF /end MEASUREMENT
/begin MEASUREMENT fse42_08 "Filterwert Segmentabweichung, eingerechnet" UBYTE dtsegno_b11p25divZyl 0 0 -2.812501 2.790528 /begin IF_DATA ASAP1B_ETK KP_BLOB 0x3832EF 1 1 /end IF_DATA BIT_MASK 0xFF /end MEASUREMENT
/begin MEASUREMENT fse43_02 "Filterwert Segmentabweichung, eingerechnet" UBYTE dtsegno_b11p25divZyl 0 0 -2.812501 2.790528 /begin IF_DATA ASAP1B_ETK KP_BLOB 0x383267 1 1 /end IF_DATA BIT_MASK 0xFF /end MEASUREMENT
/begin MEASUREMENT fse43_03 "Filterwert Segmentabweichung, eingerechnet" UBYTE dtsegno_b11p25divZyl 0 0 -2.812501 2.790528 /begin IF_DATA ASAP1B_ETK KP_BLOB 0x38327F 1 1 /end IF_DATA BIT_MASK 0xFF /end MEASUREMENT
/begin MEASUREMENT fse43_04 "Filterwert Segmentabweichung, eingerechnet" UBYTE dtsegno_b11p25divZyl 0 0 -2.812501 2.790528 /begin IF_DATA ASAP1B_ETK KP_BLOB 0x383297 1 1 /end IF_DATA BIT_MASK 0xFF /end MEASUREMENT
/begin MEASUREMENT fse43_05 "Filterwert Segmentabweichung, eingerechnet" UBYTE dtsegno_b11p25divZyl 0 0 -2.812501 2.790528 /begin IF_DATA ASAP1B_ETK KP_BLOB 0x3832AF 1 1 /end IF_DATA BIT_MASK 0xFF /end MEASUREMENT
/begin MEASUREMENT fse43_06 "Filterwert Segmentabweichung, eingerechnet" UBYTE dtsegno_b11p25divZyl 0 0 -2.812501 2.790528 /begin IF_DATA ASAP1B_ETK KP_BLOB 0x3832C7 1 1 /end IF_DATA BIT_MASK 0xFF /end MEASUREMENT
/begin MEASUREMENT fse43_07 "Filterwert Segmentabweichung, eingerechnet" UBYTE dtsegno_b11p25divZyl 0 0 -2.812501 2.790528 /begin IF_DATA ASAP1B_ETK KP_BLOB 0x3832DF 1 1 /end IF_DATA BIT_MASK 0xFF /end MEASUREMENT
/begin MEASUREMENT fse43_08 "Filterwert Segmentabweichung, eingerechnet" UBYTE dtsegno_b11p25divZyl 0 0 -2.812501 2.790528 /begin IF_DATA ASAP1B_ETK KP_BLOB 0x3832F7 1 1 /end IF_DATA BIT_MASK 0xFF /end MEASUREMENT
/begin MEASUREMENT fse51_02 "Filterwert Segmentabweichung, eingerechnet" UBYTE dtsegno_b11p25divZyl 0 0 -2.812501 2.790528 /begin IF_DATA ASAP1B_ETK KP_BLOB 0x383258 1 1 /end IF_DATA BIT_MASK 0xFF /end MEASUREMENT
/begin MEASUREMENT fse51_03 "Filterwert Segmentabweichung, eingerechnet" UBYTE dtsegno_b11p25divZyl 0 0 -2.812501 2.790528 /begin IF_DATA ASAP1B_ETK KP_BLOB 0x383270 1 1 /end IF_DATA BIT_MASK 0xFF /end MEASUREMENT
/begin MEASUREMENT fse51_04 "Filterwert Segmentabweichung, eingerechnet" UBYTE dtsegno_b11p25divZyl 0 0 -2.812501 2.790528 /begin IF_DATA ASAP1B_ETK KP_BLOB 0x383288 1 1 /end IF_DATA BIT_MASK 0xFF /end MEASUREMENT
/begin MEASUREMENT fse51_05 "Filterwert Segmentabweichung, eingerechnet" UBYTE dtsegno_b11p25divZyl 0 0 -2.812501 2.790528 /begin IF_DATA ASAP1B_ETK KP_BLOB 0x3832A0 1 1 /end IF_DATA BIT_MASK 0xFF /end MEASUREMENT
/begin MEASUREMENT fse51_06 "Filterwert Segmentabweichung, eingerechnet" UBYTE dtsegno_b11p25divZyl 0 0 -2.812501 2.790528 /begin IF_DATA ASAP1B_ETK KP_BLOB 0x3832B8 1 1 /end IF_DATA BIT_MASK 0xFF /end MEASUREMENT
/begin MEASUREMENT fse51_07 "Filterwert Segmentabweichung, eingerechnet" UBYTE dtsegno_b11p25divZyl 0 0 -2.812501 2.790528 /begin IF_DATA ASAP1B_ETK KP_BLOB 0x3832D0 1 1 /end IF_DATA BIT_MASK 0xFF /end MEASUREMENT
/begin MEASUREMENT fse51_08 "Filterwert Segmentabweichung, eingerechnet" UBYTE dtsegno_b11p25divZyl 0 0 -2.812501 2.790528 /begin IF_DATA ASAP1B_ETK KP_BLOB 0x3832E8 1 1 /end IF_DATA BIT_MASK 0xFF /end MEASUREMENT
/begin MEASUREMENT fse52_02 "Filterwert Segmentabweichung, eingerechnet" UBYTE dtsegno_b11p25divZyl 0 0 -2.812501 2.790528 /begin IF_DATA ASAP1B_ETK KP_BLOB 0x383260 1 1 /end IF_DATA BIT_MASK 0xFF /end MEASUREMENT
/begin MEASUREMENT fse52_03 "Filterwert Segmentabweichung, eingerechnet" UBYTE dtsegno_b11p25divZyl 0 0 -2.812501 2.790528 /begin IF_DATA ASAP1B_ETK KP_BLOB 0x383278 1 1 /end IF_DATA BIT_MASK 0xFF /end MEASUREMENT
/begin MEASUREMENT fse52_04 "Filterwert Segmentabweichung, eingerechnet" UBYTE dtsegno_b11p25divZyl 0 0 -2.812501 2.790528 /begin IF_DATA ASAP1B_ETK KP_BLOB 0x383290 1 1 /end IF_DATA BIT_MASK 0xFF /end MEASUREMENT
/begin MEASUREMENT fse52_05 "Filterwert Segmentabweichung, eingerechnet" UBYTE dtsegno_b11p25divZyl 0 0 -2.812501 2.790528 /begin IF_DATA ASAP1B_ETK KP_BLOB 0x3832A8 1 1 /end IF_DATA BIT_MASK 0xFF /end MEASUREMENT
/begin MEASUREMENT fse52_06 "Filterwert Segmentabweichung, eingerechnet" UBYTE dtsegno_b11p25divZyl 0 0 -2.812501 2.790528 /begin IF_DATA ASAP1B_ETK KP_BLOB 0x3832C0 1 1 /end IF_DATA BIT_MASK 0xFF /end MEASUREMENT
/begin MEASUREMENT fse52_07 "Filterwert Segmentabweichung, eingerechnet" UBYTE dtsegno_b11p25divZyl 0 0 -2.812501 2.790528 /begin IF_DATA ASAP1B_ETK KP_BLOB 0x3832D8 1 1 /end IF_DATA BIT_MASK 0xFF /end MEASUREMENT
/begin MEASUREMENT fse52_08 "Filterwert Segmentabweichung, eingerechnet" UBYTE dtsegno_b11p25divZyl 0 0 -2.812501 2.790528 /begin IF_DATA ASAP1B_ETK KP_BLOB 0x3832F0 1 1 /end IF_DATA BIT_MASK 0xFF /end MEASUREMENT
/begin MEASUREMENT fse53_02 "Filterwert Segmentabweichung, eingerechnet" UBYTE dtsegno_b11p25divZyl 0 0 -2.812501 2.790528 /begin IF_DATA ASAP1B_ETK KP_BLOB 0x383268 1 1 /end IF_DATA BIT_MASK 0xFF /end MEASUREMENT
/begin MEASUREMENT fse53_03 "Filterwert Segmentabweichung, eingerechnet" UBYTE dtsegno_b11p25divZyl 0 0 -2.812501 2.790528 /begin IF_DATA ASAP1B_ETK KP_BLOB 0x383280 1 1 /end IF_DATA BIT_MASK 0xFF /end MEASUREMENT
/begin MEASUREMENT fse53_04 "Filterwert Segmentabweichung, eingerechnet" UBYTE dtsegno_b11p25divZyl 0 0 -2.812501 2.790528 /begin IF_DATA ASAP1B_ETK KP_BLOB 0x383298 1 1 /end IF_DATA BIT_MASK 0xFF /end MEASUREMENT
/begin MEASUREMENT fse53_05 "Filterwert Segmentabweichung, eingerechnet" UBYTE dtsegno_b11p25divZyl 0 0 -2.812501 2.790528 /begin IF_DATA ASAP1B_ETK KP_BLOB 0x3832B0 1 1 /end IF_DATA BIT_MASK 0xFF /end MEASUREMENT
/begin MEASUREMENT fse53_06 "Filterwert Segmentabweichung, eingerechnet" UBYTE dtsegno_b11p25divZyl 0 0 -2.812501 2.790528 /begin IF_DATA ASAP1B_ETK KP_BLOB 0x3832C8 1 1 /end IF_DATA BIT_MASK 0xFF /end MEASUREMENT
/begin MEASUREMENT fse53_07 "Filterwert Segmentabweichung, eingerechnet" UBYTE dtsegno_b11p25divZyl 0 0 -2.812501 2.790528 /begin IF_DATA ASAP1B_ETK KP_BLOB 0x3832E0 1 1 /end IF_DATA BIT_MASK 0xFF /end MEASUREMENT
/begin MEASUREMENT fse53_08 "Filterwert Segmentabweichung, eingerechnet" UBYTE dtsegno_b11p25divZyl 0 0 -2.812501 2.790528 /begin IF_DATA ASAP1B_ETK KP_BLOB 0x3832F8 1 1 /end IF_DATA BIT_MASK 0xFF /end MEASUREMENT
/begin MEASUREMENT fse61_02 "Filterwert Segmentabweichung, eingerechnet" UBYTE dtsegno_b11p25divZyl 0 0 -2.812501 2.790528 /begin IF_DATA ASAP1B_ETK KP_BLOB 0x383259 1 1 /end IF_DATA BIT_MASK 0xFF /end MEASUREMENT
/begin MEASUREMENT fse61_03 "Filterwert Segmentabweichung, eingerechnet" UBYTE dtsegno_b11p25divZyl 0 0 -2.812501 2.790528 /begin IF_DATA ASAP1B_ETK KP_BLOB 0x383271 1 1 /end IF_DATA BIT_MASK 0xFF /end MEASUREMENT
/begin MEASUREMENT fse61_04 "Filterwert Segmentabweichung, eingerechnet" UBYTE dtsegno_b11p25divZyl 0 0 -2.812501 2.790528 /begin IF_DATA ASAP1B_ETK KP_BLOB 0x383289 1 1 /end IF_DATA BIT_MASK 0xFF /end MEASUREMENT
/begin MEASUREMENT fse61_05 "Filterwert Segmentabweichung, eingerechnet" UBYTE dtsegno_b11p25divZyl 0 0 -2.812501 2.790528 /begin IF_DATA ASAP1B_ETK KP_BLOB 0x3832A1 1 1 /end IF_DATA BIT_MASK 0xFF /end MEASUREMENT
/begin MEASUREMENT fse61_06 "Filterwert Segmentabweichung, eingerechnet" UBYTE dtsegno_b11p25divZyl 0 0 -2.812501 2.790528 /begin IF_DATA ASAP1B_ETK KP_BLOB 0x3832B9 1 1 /end IF_DATA BIT_MASK 0xFF /end MEASUREMENT
/begin MEASUREMENT fse61_07 "Filterwert Segmentabweichung, eingerechnet" UBYTE dtsegno_b11p25divZyl 0 0 -2.812501 2.790528 /begin IF_DATA ASAP1B_ETK KP_BLOB 0x3832D1 1 1 /end IF_DATA BIT_MASK 0xFF /end MEASUREMENT
/begin MEASUREMENT fse61_08 "Filterwert Segmentabweichung, eingerechnet" UBYTE dtsegno_b11p25divZyl 0 0 -2.812501 2.790528 /begin IF_DATA ASAP1B_ETK KP_BLOB 0x3832E9 1 1 /end IF_DATA BIT_MASK 0xFF /end MEASUREMENT
/begin MEASUREMENT fse62_02 "Filterwert Segmentabweichung, eingerechnet" UBYTE dtsegno_b11p25divZyl 0 0 -2.812501 2.790528 /begin IF_DATA ASAP1B_ETK KP_BLOB 0x383261 1 1 /end IF_DATA BIT_MASK 0xFF /end MEASUREMENT
/begin MEASUREMENT fse62_03 "Filterwert Segmentabweichung, eingerechnet" UBYTE dtsegno_b11p25divZyl 0 0 -2.812501 2.790528 /begin IF_DATA ASAP1B_ETK KP_BLOB 0x383279 1 1 /end IF_DATA BIT_MASK 0xFF /end MEASUREMENT
/begin MEASUREMENT fse62_04 "Filterwert Segmentabweichung, eingerechnet" UBYTE dtsegno_b11p25divZyl 0 0 -2.812501 2.790528 /begin IF_DATA ASAP1B_ETK KP_BLOB 0x383291 1 1 /end IF_DATA BIT_MASK 0xFF /end MEASUREMENT
/begin MEASUREMENT fse62_05 "Filterwert Segmentabweichung, eingerechnet" UBYTE dtsegno_b11p25divZyl 0 0 -2.812501 2.790528 /begin IF_DATA ASAP1B_ETK KP_BLOB 0x3832A9 1 1 /end IF_DATA BIT_MASK 0xFF /end MEASUREMENT
/begin MEASUREMENT fse62_06 "Filterwert Segmentabweichung, eingerechnet" UBYTE dtsegno_b11p25divZyl 0 0 -2.812501 2.790528 /begin IF_DATA ASAP1B_ETK KP_BLOB 0x3832C1 1 1 /end IF_DATA BIT_MASK 0xFF /end MEASUREMENT
/begin MEASUREMENT fse62_07 "Filterwert Segmentabweichung, eingerechnet" UBYTE dtsegno_b11p25divZyl 0 0 -2.812501 2.790528 /begin IF_DATA ASAP1B_ETK KP_BLOB 0x3832D9 1 1 /end IF_DATA BIT_MASK 0xFF /end MEASUREMENT
/begin MEASUREMENT fse62_08 "Filterwert Segmentabweichung, eingerechnet" UBYTE dtsegno_b11p25divZyl 0 0 -2.812501 2.790528 /begin IF_DATA ASAP1B_ETK KP_BLOB 0x3832F1 1 1 /end IF_DATA BIT_MASK 0xFF /end MEASUREMENT
/begin MEASUREMENT fse63_02 "Filterwert Segmentabweichung, eingerechnet" UBYTE dtsegno_b11p25divZyl 0 0 -2.812501 2.790528 /begin IF_DATA ASAP1B_ETK KP_BLOB 0x383269 1 1 /end IF_DATA BIT_MASK 0xFF /end MEASUREMENT
/begin MEASUREMENT fse63_03 "Filterwert Segmentabweichung, eingerechnet" UBYTE dtsegno_b11p25divZyl 0 0 -2.812501 2.790528 /begin IF_DATA ASAP1B_ETK KP_BLOB 0x383281 1 1 /end IF_DATA BIT_MASK 0xFF /end MEASUREMENT
/begin MEASUREMENT fse63_04 "Filterwert Segmentabweichung, eingerechnet" UBYTE dtsegno_b11p25divZyl 0 0 -2.812501 2.790528 /begin IF_DATA ASAP1B_ETK KP_BLOB 0x383299 1 1 /end IF_DATA BIT_MASK 0xFF /end MEASUREMENT
/begin MEASUREMENT fse63_05 "Filterwert Segmentabweichung, eingerechnet" UBYTE dtsegno_b11p25divZyl 0 0 -2.812501 2.790528 /begin IF_DATA ASAP1B_ETK KP_BLOB 0x3832B1 1 1 /end IF_DATA BIT_MASK 0xFF /end MEASUREMENT
/begin MEASUREMENT fse63_06 "Filterwert Segmentabweichung, eingerechnet" UBYTE dtsegno_b11p25divZyl 0 0 -2.812501 2.790528 /begin IF_DATA ASAP1B_ETK KP_BLOB 0x3832C9 1 1 /end IF_DATA BIT_MASK 0xFF /end MEASUREMENT
/begin MEASUREMENT fse63_07 "Filterwert Segmentabweichung, eingerechnet" UBYTE dtsegno_b11p25divZyl 0 0 -2.812501 2.790528 /begin IF_DATA ASAP1B_ETK KP_BLOB 0x3832E1 1 1 /end IF_DATA BIT_MASK 0xFF /end MEASUREMENT
/begin MEASUREMENT fse63_08 "Filterwert Segmentabweichung, eingerechnet" UBYTE dtsegno_b11p25divZyl 0 0 -2.812501 2.790528 /begin IF_DATA ASAP1B_ETK KP_BLOB 0x3832F9 1 1 /end IF_DATA BIT_MASK 0xFF /end MEASUREMENT
/begin MEASUREMENT fse71_02 "Filterwert Segmentabweichung, eingerechnet" UBYTE dtsegno_b11p25divZyl 0 0 -2.812501 2.790528 /begin IF_DATA ASAP1B_ETK KP_BLOB 0x38325A 1 1 /end IF_DATA BIT_MASK 0xFF /end MEASUREMENT
/begin MEASUREMENT fse71_03 "Filterwert Segmentabweichung, eingerechnet" UBYTE dtsegno_b11p25divZyl 0 0 -2.812501 2.790528 /begin IF_DATA ASAP1B_ETK KP_BLOB 0x383272 1 1 /end IF_DATA BIT_MASK 0xFF /end MEASUREMENT
/begin MEASUREMENT fse71_04 "Filterwert Segmentabweichung, eingerechnet" UBYTE dtsegno_b11p25divZyl 0 0 -2.812501 2.790528 /begin IF_DATA ASAP1B_ETK KP_BLOB 0x38328A 1 1 /end IF_DATA BIT_MASK 0xFF /end MEASUREMENT
/begin MEASUREMENT fse71_05 "Filterwert Segmentabweichung, eingerechnet" UBYTE dtsegno_b11p25divZyl 0 0 -2.812501 2.790528 /begin IF_DATA ASAP1B_ETK KP_BLOB 0x3832A2 1 1 /end IF_DATA BIT_MASK 0xFF /end MEASUREMENT
/begin MEASUREMENT fse71_06 "Filterwert Segmentabweichung, eingerechnet" UBYTE dtsegno_b11p25divZyl 0 0 -2.812501 2.790528 /begin IF_DATA ASAP1B_ETK KP_BLOB 0x3832BA 1 1 /end IF_DATA BIT_MASK 0xFF /end MEASUREMENT
/begin MEASUREMENT fse71_07 "Filterwert Segmentabweichung, eingerechnet" UBYTE dtsegno_b11p25divZyl 0 0 -2.812501 2.790528 /begin IF_DATA ASAP1B_ETK KP_BLOB 0x3832D2 1 1 /end IF_DATA BIT_MASK 0xFF /end MEASUREMENT
/begin MEASUREMENT fse71_08 "Filterwert Segmentabweichung, eingerechnet" UBYTE dtsegno_b11p25divZyl 0 0 -2.812501 2.790528 /begin IF_DATA ASAP1B_ETK KP_BLOB 0x3832EA 1 1 /end IF_DATA BIT_MASK 0xFF /end MEASUREMENT
/begin MEASUREMENT fse72_02 "Filterwert Segmentabweichung, eingerechnet" UBYTE dtsegno_b11p25divZyl 0 0 -2.812501 2.790528 /begin IF_DATA ASAP1B_ETK KP_BLOB 0x383262 1 1 /end IF_DATA BIT_MASK 0xFF /end MEASUREMENT
/begin MEASUREMENT fse72_03 "Filterwert Segmentabweichung, eingerechnet" UBYTE dtsegno_b11p25divZyl 0 0 -2.812501 2.790528 /begin IF_DATA ASAP1B_ETK KP_BLOB 0x38327A 1 1 /end IF_DATA BIT_MASK 0xFF /end MEASUREMENT
/begin MEASUREMENT fse72_04 "Filterwert Segmentabweichung, eingerechnet" UBYTE dtsegno_b11p25divZyl 0 0 -2.812501 2.790528 /begin IF_DATA ASAP1B_ETK KP_BLOB 0x383292 1 1 /end IF_DATA BIT_MASK 0xFF /end MEASUREMENT
/begin MEASUREMENT fse72_05 "Filterwert Segmentabweichung, eingerechnet" UBYTE dtsegno_b11p25divZyl 0 0 -2.812501 2.790528 /begin IF_DATA ASAP1B_ETK KP_BLOB 0x3832AA 1 1 /end IF_DATA BIT_MASK 0xFF /end MEASUREMENT
/begin MEASUREMENT fse72_06 "Filterwert Segmentabweichung, eingerechnet" UBYTE dtsegno_b11p25divZyl 0 0 -2.812501 2.790528 /begin IF_DATA ASAP1B_ETK KP_BLOB 0x3832C2 1 1 /end IF_DATA BIT_MASK 0xFF /end MEASUREMENT
/begin MEASUREMENT fse72_07 "Filterwert Segmentabweichung, eingerechnet" UBYTE dtsegno_b11p25divZyl 0 0 -2.812501 2.790528 /begin IF_DATA ASAP1B_ETK KP_BLOB 0x3832DA 1 1 /end IF_DATA BIT_MASK 0xFF /end MEASUREMENT
/begin MEASUREMENT fse72_08 "Filterwert Segmentabweichung, eingerechnet" UBYTE dtsegno_b11p25divZyl 0 0 -2.812501 2.790528 /begin IF_DATA ASAP1B_ETK KP_BLOB 0x3832F2 1 1 /end IF_DATA BIT_MASK 0xFF /end MEASUREMENT
/begin MEASUREMENT fse73_02 "Filterwert Segmentabweichung, eingerechnet" UBYTE dtsegno_b11p25divZyl 0 0 -2.812501 2.790528 /begin IF_DATA ASAP1B_ETK KP_BLOB 0x38326A 1 1 /end IF_DATA BIT_MASK 0xFF /end MEASUREMENT
/begin MEASUREMENT fse73_03 "Filterwert Segmentabweichung, eingerechnet" UBYTE dtsegno_b11p25divZyl 0 0 -2.812501 2.790528 /begin IF_DATA ASAP1B_ETK KP_BLOB 0x383282 1 1 /end IF_DATA BIT_MASK 0xFF /end MEASUREMENT
/begin MEASUREMENT fse73_04 "Filterwert Segmentabweichung, eingerechnet" UBYTE dtsegno_b11p25divZyl 0 0 -2.812501 2.790528 /begin IF_DATA ASAP1B_ETK KP_BLOB 0x38329A 1 1 /end IF_DATA BIT_MASK 0xFF /end MEASUREMENT
/begin MEASUREMENT fse73_05 "Filterwert Segmentabweichung, eingerechnet" UBYTE dtsegno_b11p25divZyl 0 0 -2.812501 2.790528 /begin IF_DATA ASAP1B_ETK KP_BLOB 0x3832B2 1 1 /end IF_DATA BIT_MASK 0xFF /end MEASUREMENT
/begin MEASUREMENT fse73_06 "Filterwert Segmentabweichung, eingerechnet" UBYTE dtsegno_b11p25divZyl 0 0 -2.812501 2.790528 /begin IF_DATA ASAP1B_ETK KP_BLOB 0x3832CA 1 1 /end IF_DATA BIT_MASK 0xFF /end MEASUREMENT
/begin MEASUREMENT fse73_07 "Filterwert Segmentabweichung, eingerechnet" UBYTE dtsegno_b11p25divZyl 0 0 -2.812501 2.790528 /begin IF_DATA ASAP1B_ETK KP_BLOB 0x3832E2 1 1 /end IF_DATA BIT_MASK 0xFF /end MEASUREMENT
/begin MEASUREMENT fse73_08 "Filterwert Segmentabweichung, eingerechnet" UBYTE dtsegno_b11p25divZyl 0 0 -2.812501 2.790528 /begin IF_DATA ASAP1B_ETK KP_BLOB 0x3832FA 1 1 /end IF_DATA BIT_MASK 0xFF /end MEASUREMENT
/begin MEASUREMENT fse81_02 "Filterwert Segmentabweichung, eingerechnet" UBYTE dtsegno_b11p25divZyl 0 0 -2.812501 2.790528 /begin IF_DATA ASAP1B_ETK KP_BLOB 0x38325B 1 1 /end IF_DATA BIT_MASK 0xFF /end MEASUREMENT
/begin MEASUREMENT fse81_03 "Filterwert Segmentabweichung, eingerechnet" UBYTE dtsegno_b11p25divZyl 0 0 -2.812501 2.790528 /begin IF_DATA ASAP1B_ETK KP_BLOB 0x383273 1 1 /end IF_DATA BIT_MASK 0xFF /end MEASUREMENT
/begin MEASUREMENT fse81_04 "Filterwert Segmentabweichung, eingerechnet" UBYTE dtsegno_b11p25divZyl 0 0 -2.812501 2.790528 /begin IF_DATA ASAP1B_ETK KP_BLOB 0x38328B 1 1 /end IF_DATA BIT_MASK 0xFF /end MEASUREMENT
/begin MEASUREMENT fse81_05 "Filterwert Segmentabweichung, eingerechnet" UBYTE dtsegno_b11p25divZyl 0 0 -2.812501 2.790528 /begin IF_DATA ASAP1B_ETK KP_BLOB 0x3832A3 1 1 /end IF_DATA BIT_MASK 0xFF /end MEASUREMENT
/begin MEASUREMENT fse81_06 "Filterwert Segmentabweichung, eingerechnet" UBYTE dtsegno_b11p25divZyl 0 0 -2.812501 2.790528 /begin IF_DATA ASAP1B_ETK KP_BLOB 0x3832BB 1 1 /end IF_DATA BIT_MASK 0xFF /end MEASUREMENT
/begin MEASUREMENT fse81_07 "Filterwert Segmentabweichung, eingerechnet" UBYTE dtsegno_b11p25divZyl 0 0 -2.812501 2.790528 /begin IF_DATA ASAP1B_ETK KP_BLOB 0x3832D3 1 1 /end IF_DATA BIT_MASK 0xFF /end MEASUREMENT
/begin MEASUREMENT fse81_08 "Filterwert Segmentabweichung, eingerechnet" UBYTE dtsegno_b11p25divZyl 0 0 -2.812501 2.790528 /begin IF_DATA ASAP1B_ETK KP_BLOB 0x3832EB 1 1 /end IF_DATA BIT_MASK 0xFF /end MEASUREMENT
/begin MEASUREMENT fse82_02 "Filterwert Segmentabweichung, eingerechnet" UBYTE dtsegno_b11p25divZyl 0 0 -2.812501 2.790528 /begin IF_DATA ASAP1B_ETK KP_BLOB 0x383263 1 1 /end IF_DATA BIT_MASK 0xFF /end MEASUREMENT
/begin MEASUREMENT fse82_03 "Filterwert Segmentabweichung, eingerechnet" UBYTE dtsegno_b11p25divZyl 0 0 -2.812501 2.790528 /begin IF_DATA ASAP1B_ETK KP_BLOB 0x38327B 1 1 /end IF_DATA BIT_MASK 0xFF /end MEASUREMENT
/begin MEASUREMENT fse82_04 "Filterwert Segmentabweichung, eingerechnet" UBYTE dtsegno_b11p25divZyl 0 0 -2.812501 2.790528 /begin IF_DATA ASAP1B_ETK KP_BLOB 0x383293 1 1 /end IF_DATA BIT_MASK 0xFF /end MEASUREMENT
/begin MEASUREMENT fse82_05 "Filterwert Segmentabweichung, eingerechnet" UBYTE dtsegno_b11p25divZyl 0 0 -2.812501 2.790528 /begin IF_DATA ASAP1B_ETK KP_BLOB 0x3832AB 1 1 /end IF_DATA BIT_MASK 0xFF /end MEASUREMENT
/begin MEASUREMENT fse82_06 "Filterwert Segmentabweichung, eingerechnet" UBYTE dtsegno_b11p25divZyl 0 0 -2.812501 2.790528 /begin IF_DATA ASAP1B_ETK KP_BLOB 0x3832C3 1 1 /end IF_DATA BIT_MASK 0xFF /end MEASUREMENT
/begin MEASUREMENT fse82_07 "Filterwert Segmentabweichung, eingerechnet" UBYTE dtsegno_b11p25divZyl 0 0 -2.812501 2.790528 /begin IF_DATA ASAP1B_ETK KP_BLOB 0x3832DB 1 1 /end IF_DATA BIT_MASK 0xFF /end MEASUREMENT
/begin MEASUREMENT fse82_08 "Filterwert Segmentabweichung, eingerechnet" UBYTE dtsegno_b11p25divZyl 0 0 -2.812501 2.790528 /begin IF_DATA ASAP1B_ETK KP_BLOB 0x3832F3 1 1 /end IF_DATA BIT_MASK 0xFF /end MEASUREMENT
/begin MEASUREMENT fse83_02 "Filterwert Segmentabweichung, eingerechnet" UBYTE dtsegno_b11p25divZyl 0 0 -2.812501 2.790528 /begin IF_DATA ASAP1B_ETK KP_BLOB 0x38326B 1 1 /end IF_DATA BIT_MASK 0xFF /end MEASUREMENT
/begin MEASUREMENT fse83_03 "Filterwert Segmentabweichung, eingerechnet" UBYTE dtsegno_b11p25divZyl 0 0 -2.812501 2.790528 /begin IF_DATA ASAP1B_ETK KP_BLOB 0x383283 1 1 /end IF_DATA BIT_MASK 0xFF /end MEASUREMENT
/begin MEASUREMENT fse83_04 "Filterwert Segmentabweichung, eingerechnet" UBYTE dtsegno_b11p25divZyl 0 0 -2.812501 2.790528 /begin IF_DATA ASAP1B_ETK KP_BLOB 0x38329B 1 1 /end IF_DATA BIT_MASK 0xFF /end MEASUREMENT
/begin MEASUREMENT fse83_05 "Filterwert Segmentabweichung, eingerechnet" UBYTE dtsegno_b11p25divZyl 0 0 -2.812501 2.790528 /begin IF_DATA ASAP1B_ETK KP_BLOB 0x3832B3 1 1 /end IF_DATA BIT_MASK 0xFF /end MEASUREMENT
/begin MEASUREMENT fse83_06 "Filterwert Segmentabweichung, eingerechnet" UBYTE dtsegno_b11p25divZyl 0 0 -2.812501 2.790528 /begin IF_DATA ASAP1B_ETK KP_BLOB 0x3832CB 1 1 /end IF_DATA BIT_MASK 0xFF /end MEASUREMENT
/begin MEASUREMENT fse83_07 "Filterwert Segmentabweichung, eingerechnet" UBYTE dtsegno_b11p25divZyl 0 0 -2.812501 2.790528 /begin IF_DATA ASAP1B_ETK KP_BLOB 0x3832E3 1 1 /end IF_DATA BIT_MASK 0xFF /end MEASUREMENT
/begin MEASUREMENT fse83_08 "Filterwert Segmentabweichung, eingerechnet" UBYTE dtsegno_b11p25divZyl 0 0 -2.812501 2.790528 /begin IF_DATA ASAP1B_ETK KP_BLOB 0x3832FB 1 1 /end IF_DATA BIT_MASK 0xFF /end MEASUREMENT
/begin MEASUREMENT idxfo "Index: Kennzeichnet den aktuellen KF-Bereich" UWORD dez___UW 0 0 0.000000 65535.000000 /begin IF_DATA ASAP1B_ETK KP_BLOB 0x38166E 1 2 /end IF_DATA BIT_MASK 0xFFFF /end MEASUREMENT
/begin MEASUREMENT idxfob "Index: Kennzeichnet den aktuellen KF-Bereich (Drehz., Last)" UBYTE dez 0 0 0.000000 255.000000 /begin IF_DATA ASAP1B_ETK KP_BLOB 0x380A11 1 1 /end IF_DATA BIT_MASK 0xFF /end MEASUREMENT
/begin MEASUREMENT idxfon "Drehzahlindex fÅr Betriebsbereich der fuel-on Adaption" UBYTE dez 0 0 0.000000 255.000000 /begin IF_DATA ASAP1B_ETK KP_BLOB 0x38166E 1 1 /end IF_DATA BIT_MASK 0xFF /end MEASUREMENT
/begin MEASUREMENT idxforl "Lastindex fÅr Betriebsbereich der fuel-on Adaption" UBYTE dez 0 0 0.000000 255.000000 /begin IF_DATA ASAP1B_ETK KP_BLOB 0x38166F 1 1 /end IF_DATA BIT_MASK 0xFF /end MEASUREMENT
/begin MEASUREMENT luar "Laufunruhe-Abstandsmass-Referenzwert" SBYTE luquant 0 0 -80.843807 80.212215 /begin IF_DATA ASAP1B_ETK KP_BLOB 0x380A01 1 1 /end IF_DATA BIT_MASK 0xFF /end MEASUREMENT
/begin MEASUREMENT luarmn "Laufunruhe-Abstandsmass-Referenzwert Minimun" SBYTE luquant 0 0 -80.843807 80.212215 /begin IF_DATA ASAP1B_ETK KP_BLOB 0x380A02 1 1 /end IF_DATA BIT_MASK 0xFF /end MEASUREMENT
/begin MEASUREMENT luaroff "Laufunruhe-Abstandsmass-Referenzwert offset" UBYTE luquant___UB 0 0 0.000000 161.056022 /begin IF_DATA ASAP1B_ETK KP_BLOB 0x380A03 1 1 /end IF_DATA BIT_MASK 0xFF /end MEASUREMENT
/begin MEASUREMENT luar_m "Monitor, Laufunruhe-Abstandsma·-Referenzwert, verzîgerte Ausgabe" SBYTE luquant 0 0 -80.843807 80.212215 /begin IF_DATA ASAP1B_ETK KP_BLOB 0xE3DA 0 1 /end IF_DATA BIT_MASK 0xFF /end MEASUREMENT
/begin MEASUREMENT lums "Laufunruhe-Mittelwert fÅr Erkennung Mehrfachaussetzer, signed" SBYTE luquant 0 0 -80.843807 80.212215 /begin IF_DATA ASAP1B_ETK KP_BLOB 0xE405 0 1 /end IF_DATA BIT_MASK 0xFF /end MEASUREMENT
/begin MEASUREMENT lums_m "Monitor, Laufunruhe-Mittelwert fÅr Erkennung Mehrfachaussetzer, signed" SBYTE luquant 0 0 -80.843807 80.212215 /begin IF_DATA ASAP1B_ETK KP_BLOB 0xE3FD 0 1 /end IF_DATA BIT_MASK 0xFF /end MEASUREMENT
/begin MEASUREMENT lunw "Laufunruhe Åber 1 NW-Umdr." UBYTE luquant___UB 0 0 0.000000 161.056022 /begin IF_DATA ASAP1B_ETK KP_BLOB 0x380A0B 1 1 /end IF_DATA BIT_MASK 0xFF /end MEASUREMENT
/begin MEASUREMENT lurms "Laufunruhe-Referenzwert fÅr Mehrfachaussetzererkennung, -> Vgl. mit Lum, signed" SBYTE luquant 0 0 -80.843807 80.212215 /begin IF_DATA ASAP1B_ETK KP_BLOB 0x380A07 1 1 /end IF_DATA BIT_MASK 0xFF /end MEASUREMENT
/begin MEASUREMENT lurms_m "Monitor, Laufunruhe-Referenzwert fÅr Mehrfachaussetzererkenng, signed" SBYTE luquant 0 0 -80.843807 80.212215 /begin IF_DATA ASAP1B_ETK KP_BLOB 0xE3FC 0 1 /end IF_DATA BIT_MASK 0xFF /end MEASUREMENT
/begin MEASUREMENT lurs "Laufunruhe-Referenzwert, signed" SBYTE luquant 0 0 -80.843807 80.212215 /begin IF_DATA ASAP1B_ETK KP_BLOB 0x3809D7 1 1 /end IF_DATA BIT_MASK 0xFF /end MEASUREMENT
/begin MEASUREMENT lursktm "tmot-abhÑngiger offset zum Laufunruhe-Referenzwert dlurs, signed" SBYTE luquant 0 0 -80.843807 80.212215 /begin IF_DATA ASAP1B_ETK KP_BLOB 0x380A12 1 1 /end IF_DATA BIT_MASK 0xFF /end MEASUREMENT
/begin MEASUREMENT lurs_m "Monitor Laufunruhe-Referenzwert, signed" SBYTE luquant 0 0 -80.843807 80.212215 /begin IF_DATA ASAP1B_ETK KP_BLOB 0xE3FA 0 1 /end IF_DATA BIT_MASK 0xFF /end MEASUREMENT
/begin MEASUREMENT lurs_min "Wert von LUR falls Adaption nicht abgeschlossen, Wert aus LURMIN*" UBYTE luquant___UB 0 0 0.000000 161.056022 /begin IF_DATA ASAP1B_ETK KP_BLOB 0x3809D8 1 1 /end IF_DATA BIT_MASK 0xFF /end MEASUREMENT
/begin MEASUREMENT luts "Laufunruhe-Testgrî·e, signed" SBYTE luquant 0 0 -80.843807 80.212215 /begin IF_DATA ASAP1B_ETK KP_BLOB 0xE3E0 0 1 /end IF_DATA BIT_MASK 0xFF /end MEASUREMENT
/begin MEASUREMENT luts1 "Laufunruhe-Testgrî·e von Zylinder 1 bzw. ZÅndung 1, signed" SBYTE luquant 0 0 -80.843807 80.212215 /begin IF_DATA ASAP1B_ETK KP_BLOB 0x3809DD 1 1 /end IF_DATA BIT_MASK 0xFF /end MEASUREMENT
/begin MEASUREMENT luts2 "Laufunruhe-Testgrî·e von Zylinder 2 bzw. ZÅndung 2, signed" SBYTE luquant 0 0 -80.843807 80.212215 /begin IF_DATA ASAP1B_ETK KP_BLOB 0x3809DE 1 1 /end IF_DATA BIT_MASK 0xFF /end MEASUREMENT
/begin MEASUREMENT luts3 "Laufunruhe-Testgrî·e von Zylinder 3 bzw. ZÅndung 3, signed" SBYTE luquant 0 0 -80.843807 80.212215 /begin IF_DATA ASAP1B_ETK KP_BLOB 0x3809DF 1 1 /end IF_DATA BIT_MASK 0xFF /end MEASUREMENT
/begin MEASUREMENT luts4 "Laufunruhe-Testgrî·e von Zylinder 4 bzw. ZÅndung 4, signed" SBYTE luquant 0 0 -80.843807 80.212215 /begin IF_DATA ASAP1B_ETK KP_BLOB 0x3809E0 1 1 /end IF_DATA BIT_MASK 0xFF /end MEASUREMENT
/begin MEASUREMENT luts5 "Laufunruhe-Testgrî·e von Zylinder 5 bzw. ZÅndung 5, signed" SBYTE luquant 0 0 -80.843807 80.212215 /begin IF_DATA ASAP1B_ETK KP_BLOB 0x3809E1 1 1 /end IF_DATA BIT_MASK 0xFF /end MEASUREMENT
/begin MEASUREMENT luts6 "Laufunruhe-Testgrî·e von Zylinder 6 bzw. ZÅndung 6, signed" SBYTE luquant 0 0 -80.843807 80.212215 /begin IF_DATA ASAP1B_ETK KP_BLOB 0x3809E2 1 1 /end IF_DATA BIT_MASK 0xFF /end MEASUREMENT
/begin MEASUREMENT luts7 "Laufunruhe-Testgrî·e von Zylinder 7 bzw. ZÅndung 7, signed" SBYTE luquant 0 0 -80.843807 80.212215 /begin IF_DATA ASAP1B_ETK KP_BLOB 0x3809E3 1 1 /end IF_DATA BIT_MASK 0xFF /end MEASUREMENT
/begin MEASUREMENT luts8 "Laufunruhe-Testgrî·e von Zylinder 8 bzw. ZÅndung 8, signed" SBYTE luquant 0 0 -80.843807 80.212215 /begin IF_DATA ASAP1B_ETK KP_BLOB 0x3809E4 1 1 /end IF_DATA BIT_MASK 0xFF /end MEASUREMENT
/begin MEASUREMENT luts_m "Monitor Laufunruhe-Testgrî·e, signed" SBYTE luquant 0 0 -80.843807 80.212215 /begin IF_DATA ASAP1B_ETK KP_BLOB 0xE3F9 0 1 /end IF_DATA BIT_MASK 0xFF /end MEASUREMENT
/begin MEASUREMENT rl_m "Monitor, relative LuftfÅllung" UBYTE rel_ub_q0p75 0 0 0.000000 191.250000 /begin IF_DATA ASAP1B_ETK KP_BLOB 0xE3FB 0 1 /end IF_DATA BIT_MASK 0xFF /end MEASUREMENT
/begin MEASUREMENT slfoo "" SWORD dtsegn_b720divZyl 0 0 -180.000439 179.994946 /begin IF_DATA ASAP1B_ETK KP_BLOB 0x3816C6 1 2 /end IF_DATA BIT_MASK 0xFFFF /end MEASUREMENT
/begin MEASUREMENT ts01 "Segmentdauer Zylinder 1" UWORD tsquant 0 0 0.000000 78642.031457 /begin IF_DATA ASAP1B_ETK KP_BLOB 0x381646 1 2 /end IF_DATA BIT_MASK 0xFFFF /end MEASUREMENT
/begin MEASUREMENT ts02 "Segmentdauer Zylinder 2" UWORD tsquant 0 0 0.000000 78642.031457 /begin IF_DATA ASAP1B_ETK KP_BLOB 0x381648 1 2 /end IF_DATA BIT_MASK 0xFFFF /end MEASUREMENT
/begin MEASUREMENT ts03 "Segmentdauer Zylinder 3" UWORD tsquant 0 0 0.000000 78642.031457 /begin IF_DATA ASAP1B_ETK KP_BLOB 0x38164A 1 2 /end IF_DATA BIT_MASK 0xFFFF /end MEASUREMENT
/begin MEASUREMENT ts04 "Segmentdauer Zylinder 4" UWORD tsquant 0 0 0.000000 78642.031457 /begin IF_DATA ASAP1B_ETK KP_BLOB 0x38164C 1 2 /end IF_DATA BIT_MASK 0xFFFF /end MEASUREMENT
/begin MEASUREMENT ts05 "Segmentdauer Zylinder 5" UWORD tsquant 0 0 0.000000 78642.031457 /begin IF_DATA ASAP1B_ETK KP_BLOB 0x38164E 1 2 /end IF_DATA BIT_MASK 0xFFFF /end MEASUREMENT
/begin MEASUREMENT ts06 "Segmentdauer Zylinder 6" UWORD tsquant 0 0 0.000000 78642.031457 /begin IF_DATA ASAP1B_ETK KP_BLOB 0x381650 1 2 /end IF_DATA BIT_MASK 0xFFFF /end MEASUREMENT
/begin MEASUREMENT ts07 "Segmentdauer Zylinder 7" UWORD tsquant 0 0 0.000000 78642.031457 /begin IF_DATA ASAP1B_ETK KP_BLOB 0x381652 1 2 /end IF_DATA BIT_MASK 0xFFFF /end MEASUREMENT
/begin MEASUREMENT ts08 "Segmentdauer Zylinder 8" UWORD tsquant 0 0 0.000000 78642.031457 /begin IF_DATA ASAP1B_ETK KP_BLOB 0x381654 1 2 /end IF_DATA BIT_MASK 0xFFFF /end MEASUREMENT
/begin MEASUREMENT tsk_m "Monitor korrigierte Segmentdauer" UWORD tsquant 0 0 0.000000 78642.031457 /begin IF_DATA ASAP1B_ETK KP_BLOB 0xE3FE 0 2 /end IF_DATA BIT_MASK 0xFFFF /end MEASUREMENT
/begin MEASUREMENT ts_m "Monitor Segmentdauer" UWORD tsquant 0 0 0.000000 78642.031457 /begin IF_DATA ASAP1B_ETK KP_BLOB 0xE3F6 0 2 /end IF_DATA BIT_MASK 0xFFFF /end MEASUREMENT
/begin MEASUREMENT xs02 "Segmentabweichung, normiert" UWORD dtsegn_b720divZyl___UW 0 0 0.000000 359.995386 /begin IF_DATA ASAP1B_ETK KP_BLOB 0x3816B6 1 2 /end IF_DATA BIT_MASK 0xFFFF /end MEASUREMENT
/begin MEASUREMENT xs03 "Segmentabweichung, normiert" UWORD dtsegn_b720divZyl___UW 0 0 0.000000 359.995386 /begin IF_DATA ASAP1B_ETK KP_BLOB 0x3816B8 1 2 /end IF_DATA BIT_MASK 0xFFFF /end MEASUREMENT
/begin MEASUREMENT xs04 "Segmentabweichung, normiert" UWORD dtsegn_b720divZyl___UW 0 0 0.000000 359.995386 /begin IF_DATA ASAP1B_ETK KP_BLOB 0x3816BA 1 2 /end IF_DATA BIT_MASK 0xFFFF /end MEASUREMENT
/begin MEASUREMENT xs05 "Segmentabweichung, normiert" UWORD dtsegn_b720divZyl___UW 0 0 0.000000 359.995386 /begin IF_DATA ASAP1B_ETK KP_BLOB 0x3816BC 1 2 /end IF_DATA BIT_MASK 0xFFFF /end MEASUREMENT
/begin MEASUREMENT xs06 "Segmentabweichung, normiert" UWORD dtsegn_b720divZyl___UW 0 0 0.000000 359.995386 /begin IF_DATA ASAP1B_ETK KP_BLOB 0x3816BE 1 2 /end IF_DATA BIT_MASK 0xFFFF /end MEASUREMENT
/begin MEASUREMENT xs07 "Segmentabweichung, normiert" UWORD dtsegn_b720divZyl___UW 0 0 0.000000 359.995386 /begin IF_DATA ASAP1B_ETK KP_BLOB 0x3816C0 1 2 /end IF_DATA BIT_MASK 0xFFFF /end MEASUREMENT
/begin MEASUREMENT xs08 "Segmentabweichung, normiert" UWORD dtsegn_b720divZyl___UW 0 0 0.000000 359.995386 /begin IF_DATA ASAP1B_ETK KP_BLOB 0x3816C2 1 2 /end IF_DATA BIT_MASK 0xFFFF /end MEASUREMENT
/begin FUNCTION DMDFONA ""
 /begin LOC_MEASUREMENT flp83_08 flp83_07 flp83_06 flp83_05 flp83_04 flp83_03 flp83_02 flp82_08 flp82_07 flp82_06 flp82_05 flp82_04 flp82_03 flp82_02 flp81_08 flp81_07 flp81_06 flp81_05 flp81_04 flp81_03 flp81_02 flp73_08 flp73_07 flp73_06 flp73_05 flp73_04 flp73_03 flp73_02 flp72_08 flp72_07 flp72_06 flp72_05 flp72_04 flp72_03 flp72_02 flp71_08 flp71_07 flp71_06 flp71_05 flp71_04 flp71_03 flp71_02 flp63_08 flp63_07 flp63_06 flp63_05 flp63_04 flp63_03 flp63_02 flp62_08 flp62_07 flp62_06 flp62_05 flp62_04 flp62_03 flp62_02 flp61_08 flp61_07 flp61_06 flp61_05 flp61_04 flp61_03 flp61_02 flp53_08 flp53_07 flp53_06 flp53_05 flp53_04 flp53_03 flp53_02 flp52_08 flp52_07 flp52_06 flp52_05 flp52_04 flp52_03 flp52_02 flp51_08 flp51_07 flp51_06 flp51_05 flp51_04 flp51_03 flp51_02 flp43_08 flp43_07 flp43_06 flp43_05 flp43_04 flp43_03 flp43_02 flp42_08 flp42_07 flp42_06 flp42_05 flp42_04 flp42_03 flp42_02 flp41_08 flp41_07 flp41_06 flp41_05 flp41_04 flp41_03 flp41_02 flp33_08 flp33_07 flp33_06 flp33_05 flp33_04 flp33_03 flp33_02 flp32_08 flp32_07 flp32_06 flp32_05 flp32_04 flp32_03 flp32_02 flp31_08 flp31_07 flp31_06 flp31_05 flp31_04 flp31_03 flp31_02 flp23_08 flp23_07 flp23_06 flp23_05 flp23_04 flp23_03 flp23_02 flp22_08 flp22_07 flp22_06 flp22_05 flp22_04 flp22_03 flp22_02 flp21_08 flp21_07 flp21_06 flp21_05 flp21_04 flp21_03 flp21_02 flp13_08 flp13_07 flp13_06 flp13_05 flp13_04 flp13_03 flp13_02 flp12_08 flp12_07 flp12_06 flp12_05 flp12_04 flp12_03 flp12_02 flp11_08 flp11_07 flp11_06 flp11_05 flp11_04 flp11_03 flp11_02 fln83_08 fln83_07 fln83_06 fln83_05 fln83_04 fln83_03 fln83_02 fln82_08 fln82_07 fln82_06 fln82_05 fln82_04 fln82_03 fln82_02 fln81_08 fln81_07 fln81_06 fln81_05 fln81_04 fln81_03 fln81_02 fln73_08 fln73_07 fln73_06 fln73_05 fln73_04 fln73_03 fln73_02 fln72_08 fln72_07 fln72_06 fln72_05 fln72_04 fln72_03 fln72_02 fln71_08 fln71_07 fln71_06 fln71_05 fln71_04 fln71_03 fln71_02 fln63_08 fln63_07 fln63_06 fln63_05 fln63_04 fln63_03 fln63_02 fln62_08 fln62_07 fln62_06 fln62_05 fln62_04 fln62_03 fln62_02 fln61_08 fln61_07 fln61_06 fln61_05 fln61_04 fln61_03 fln61_02 fln53_08 fln53_07 fln53_06 fln53_05 fln53_04 fln53_03 fln53_02 fln52_08 fln52_07 fln52_06 fln52_05 fln52_04 fln52_03 fln52_02 fln51_08 fln51_07 fln51_06 fln51_05 fln51_04 fln51_03 fln51_02 fln43_08 fln43_07 fln43_06 fln43_05 fln43_04 fln43_03 fln43_02 fln42_08 fln42_07 fln42_06 fln42_05 fln42_04 fln42_03 fln42_02 fln41_08 fln41_07 fln41_06 fln41_05 fln41_04 fln41_03 fln41_02 fln33_08 fln33_07 fln33_06 fln33_05 fln33_04 fln33_03 fln33_02 fln32_08 fln32_07 fln32_06 fln32_05 fln32_04 fln32_03 fln32_02 fln31_08 fln31_07 fln31_06 fln31_05 fln31_04 fln31_03 fln31_02 fln23_08 fln23_07 fln23_06 fln23_05 fln23_04 fln23_03 fln23_02 fln22_08 fln22_07 fln22_06 fln22_05 fln22_04 fln22_03 fln22_02 fln21_08 fln21_07 fln21_06 fln21_05 fln21_04 fln21_03 fln21_02 fln13_08 fln13_07 fln13_06 fln13_05 fln13_04 fln13_03 fln13_02 fln12_08 fln12_07 fln12_06 fln12_05 fln12_04 fln12_03 fln12_02 fln11_08 fln11_07 fln11_06 fln11_05 fln11_04 fln11_03 fln11_02 flmx ffpl1 fforn1 ffonn3 ffonn2 ffonn1 ffon dfsen dfse08 dfse07 dfse06 dfse05 dfse04 dfse03 dfse02 dfse01 cfoxx B_plokn_m B_plok08 B_plok07 B_plok06 B_plok05 B_plok04 B_plok03 B_plok02 B_plok01 B_plok B_foxfg B_fos B_forun B_forset B_forn_m B_forn08 B_forn07 B_forn06 B_forn05 B_forn04 B_forn03 B_forn02 B_forn01 B_for83 B_for82 B_for81 B_for73 B_for72 B_for71 B_for63 B_for62 B_for61 B_for53 B_for52 B_for51 B_for43 B_for42 B_for41 B_for33 B_for32 B_for31 B_for23 B_for22 B_for21 B_for13 B_for12 B_for11 B_fon_m B_fontm B_fohold B_fohe B_fof_m B_fodon B_fodo B_dmd_reset anwfos anwfoh /end LOC_MEASUREMENT
/end FUNCTION
/begin FUNCTION DMDFONB ""
 /begin REF_CHARACTERISTIC ZASMASK SLFOU SLFOON SLFOO2N SFONTM SDZ08DMUB2 SDZ08DMUB SDZ03DMUB2 SDZ03DMUB MDERKFON LURFOST KFCFO2 KFCFO FS2FO FS1FO FLFO DFSERES DFSEFON DFSEFO2N CDFO ANWFOST ANWFOHE ALFO /end REF_CHARACTERISTIC
 /begin LOC_MEASUREMENT xs08 xs07 xs06 xs05 xs04 xs03 xs02 ts_m tsk_m ts08 ts07 ts06 ts05 ts04 ts03 ts02 ts01 slfoo rl nmot lunw idxforl idxfon idxfob idxfo fse83_08 fse83_07 fse83_06 fse83_05 fse83_04 fse83_03 fse83_02 fse82_08 fse82_07 fse82_06 fse82_05 fse82_04 fse82_03 fse82_02 fse81_08 fse81_07 fse81_06 fse81_05 fse81_04 fse81_03 fse81_02 fse73_08 fse73_07 fse73_06 fse73_05 fse73_04 fse73_03 fse73_02 fse72_08 fse72_07 fse72_06 fse72_05 fse72_04 fse72_03 fse72_02 fse71_08 fse71_07 fse71_06 fse71_05 fse71_04 fse71_03 fse71_02 fse63_08 fse63_07 fse63_06 fse63_05 fse63_04 fse63_03 fse63_02 fse62_08 fse62_07 fse62_06 fse62_05 fse62_04 fse62_03 fse62_02 fse61_08 fse61_07 fse61_06 fse61_05 fse61_04 fse61_03 fse61_02 fse53_08 fse53_07 fse53_06 fse53_05 fse53_04 fse53_03 fse53_02 fse52_08 fse52_07 fse52_06 fse52_05 fse52_04 fse52_03 fse52_02 fse51_08 fse51_07 fse51_06 fse51_05 fse51_04 fse51_03 fse51_02 fse43_08 fse43_07 fse43_06 fse43_05 fse43_04 fse43_03 fse43_02 fse42_08 fse42_07 fse42_06 fse42_05 fse42_04 fse42_03 fse42_02 fse41_08 fse41_07 fse41_06 fse41_05 fse41_04 fse41_03 fse41_02 fse33_08 fse33_07 fse33_06 fse33_05 fse33_04 fse33_03 fse33_02 fse32_08 fse32_07 fse32_06 fse32_05 fse32_04 fse32_03 fse32_02 fse31_08 fse31_07 fse31_06 fse31_05 fse31_04 fse31_03 fse31_02 fse23_08 fse23_07 fse23_06 fse23_05 fse23_04 fse23_03 fse23_02 fse22_08 fse22_07 fse22_06 fse22_05 fse22_04 fse22_03 fse22_02 fse21_08 fse21_07 fse21_06 fse21_05 fse21_04 fse21_03 fse21_02 fse13_08 fse13_07 fse13_06 fse13_05 fse13_04 fse13_03 fse13_02 fse12_08 fse12_07 fse12_06 fse12_05 fse12_04 fse12_03 fse12_02 fse11_08 fse11_07 fse11_06 fse11_05 fse11_04 fse11_03 fse11_02 fse fs83_08 fs83_07 fs83_06 fs83_05 fs83_04 fs83_03 fs83_02 fs82_08 fs82_07 fs82_06 fs82_05 fs82_04 fs82_03 fs82_02 fs81_08 fs81_07 fs81_06 fs81_05 fs81_04 fs81_03 fs81_02 fs73_08 fs73_07 fs73_06 fs73_05 fs73_04 fs73_03 fs73_02 fs72_08 fs72_07 fs72_06 fs72_05 fs72_04 fs72_03 fs72_02 fs71_08 fs71_07 fs71_06 fs71_05 fs71_04 fs71_03 fs71_02 fs63_08 fs63_07 fs63_06 fs63_05 fs63_04 fs63_03 fs63_02 fs62_08 fs62_07 fs62_06 fs62_05 fs62_04 fs62_03 fs62_02 fs61_08 fs61_07 fs61_06 fs61_05 fs61_04 fs61_03 fs61_02 fs53_08 fs53_07 fs53_06 fs53_05 fs53_04 fs53_03 fs53_02 fs52_08 fs52_07 fs52_06 fs52_05 fs52_04 fs52_03 fs52_02 fs51_08 fs51_07 fs51_06 fs51_05 fs51_04 fs51_03 fs51_02 fs43_08 fs43_07 fs43_06 fs43_05 fs43_04 fs43_03 fs43_02 fs42_08 fs42_07 fs42_06 fs42_05 fs42_04 fs42_03 fs42_02 fs41_08 fs41_07 fs41_06 fs41_05 fs41_04 fs41_03 fs41_02 fs33_08 fs33_07 fs33_06 fs33_05 fs33_04 fs33_03 fs33_02 fs32_08 fs32_07 fs32_06 fs32_05 fs32_04 fs32_03 fs32_02 fs31_08 fs31_07 fs31_06 fs31_05 fs31_04 fs31_03 fs31_02 fs23_08 fs23_07 fs23_06 fs23_05 fs23_04 fs23_03 fs23_02 fs22_08 fs22_07 fs22_06 fs22_05 fs22_04 fs22_03 fs22_02 fs21_08 fs21_07 fs21_06 fs21_05 fs21_04 fs21_03 fs21_02 fs13_08 fs13_07 fs13_06 fs13_05 fs13_04 fs13_03 fs13_02 fs12_08 fs12_07 fs12_06 fs12_05 fs12_04 fs12_03 fs12_02 fs11_08 fs11_07 fs11_06 fs11_05 fs11_04 fs11_03 fs11_02 fostat_m fostat flmxresz esst_sdz08dmub esst_sdz03dmub dfseresz B_tsroov_m B_for_m B_fordo_m B_autget /end LOC_MEASUREMENT
/end FUNCTION
/begin FUNCTION DMDLAD "3.10      Logic and Delay; Log. VerknÅpfung versch. Blîcke zur Aussetzererkennung" /begin LOC_MEASUREMENT B_mderk /end LOC_MEASUREMENT /end FUNCTION
/begin FUNCTION DMDLU "4.40      Diagnose misfire detection; Laufunruhe"
 /begin REF_CHARACTERISTIC TNALU STM08DMUB SRL08DMUB SNM08DMUB P_ZYL NFLUV LURMIN3 LURMIN2 LURMIN1 LURKTM LURBRL KFLURM_1_A KFLURM_0_A KFLURM1 KFLURB_1_A KFLURB_0_A KFLURBZ KFLURB2 KFLURB1 KFAMAL_1_A KFAMAL_0_A FLUV2 FLUV1 FIMALU FIAMALU DMXRLU ANALUN /end REF_CHARACTERISTIC
 /begin LOC_MEASUREMENT vfzg tmot rl_m rl nmot luts_m luts8 luts7 luts6 luts5 luts4 luts3 luts2 luts1 luts lurs_min lurs_m lursktm lurs lurms_m lurms lums_m lums famal esst_stm08dmub esst_srl08dmub esst_snm08dmub cd_bits1_w B_tnalu_m B_mdzyl1_m B_mdstim_m B_lustop_m B_luerk_m B_ll B_cdmd B_analu_m /end LOC_MEASUREMENT
/end FUNCTION
/begin FUNCTION DMDLUA "4.10      Diagnose Misfire Detection Laufunruhe Abstandsmass"
 /begin REF_CHARACTERISTIC SRL08DMUB SNM08DMUB KFLUAR_1_A KFLUAR_0_A KFLUARZ KFLUAR2 KFLUAR1 FLUTN DMXRFL /end REF_CHARACTERISTIC
 /begin LOC_MEASUREMENT rl nmot luar_m luaroff luarmn luar fluts_m fluts8 fluts7 fluts6 fluts5 fluts4 fluts3 fluts2 fluts1 fluts fflutn esst_srl08dmub esst_snm08dmub B_luaerk_m /end LOC_MEASUREMENT
/end FUNCTION
/end MODULE
/end PROJECT
