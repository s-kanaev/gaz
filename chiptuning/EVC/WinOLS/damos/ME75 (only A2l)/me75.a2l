/*** Created by DAM2ASAP Version 2.8 vom 26.01.1999 ***/
ASAP2_VERSION 1 21
/begin PROJECT Pro4017 "R4 1.8l 5V T lÑngs FR5ROM F5051"
/begin HEADER "" PROJECT_NO Pro4017 VERSION "PrV = F21dc mit 00" /end HEADER
/begin MODULE DIM " "
/begin MOD_PAR "R4 1.8l 5V T lÑngs FR5ROM F5051" VERSION "PrV = F21dc mit 00  " ADDR_EPK 0x814329 EPK "41/1/ME7.5/5/4017.00//F21dc/Dst0" CUSTOMER_NO "5" USER "" PHONE_NO "" ECU "ME7.5" CPU_TYPE "S80166"
 /begin MEMORY_LAYOUT PRG_CODE 0x800000 0x10000 -1 -1 -1 -1 -1 /begin IF_DATA ASAP1B_ETK DP_BLOB 0x800000 0x10000 /end IF_DATA /end MEMORY_LAYOUT
 /begin MEMORY_LAYOUT PRG_CODE 0x820000 0x60000 -1 -1 -1 -1 -1 /begin IF_DATA ASAP1B_ETK DP_BLOB 0x820000 0x60000 /end IF_DATA /end MEMORY_LAYOUT
 /begin MEMORY_LAYOUT PRG_DATA 0x810000 0x10000 -1 -1 -1 -1 -1 /begin IF_DATA ASAP1B_ETK DP_BLOB 0x810000 0x10000 /end IF_DATA /end MEMORY_LAYOUT
/end MOD_PAR
/begin MOD_COMMON " " S_REC_LAYOUT ME7 BYTE_ORDER MSB_LAST /end MOD_COMMON
/begin IF_DATA ASAP1B_ETK
 /begin SOURCE "Synchro" 103 1 QP_BLOB 1 10 0x817F68 0x381A4C 0x383236 0 0 0 /end SOURCE
 /begin SOURCE "10ms" 4 1 QP_BLOB 2 26 0x817F7E 0x381A56 0x383238 10 0 0 /end SOURCE
 /begin SOURCE "100ms" 5 1 QP_BLOB 3 36 0x817FB4 0x381A70 0x38323A 100 0 0 /end SOURCE
 /begin TP_BLOB 0x383200 1 39 12 2 0x0 0x0 0x0 0x0 0 0 ETK_CFG 0xF 0xF0 0xFF 0x3 0xFF 0xEE 0xFF 0x1 /end TP_BLOB
/end IF_DATA
/begin COMPU_METHOD bfzg_sb_q0p217 "" RAT_FUNC "%6.3" "m/s^2" COEFFS 0 1.000000 0.000000 0 0.000000 2.170000e-01 /end COMPU_METHOD
/begin COMPU_METHOD B_TRUE "boolsche ZustÑnde, positive Logik" TAB_VERB "%6.3" "" COMPU_TAB_REF B_TRUE /end COMPU_METHOD
/begin COMPU_METHOD B_TRUE___UW "boolsche ZustÑnde, positive Logik" TAB_VERB "%6.3" "" COMPU_TAB_REF B_TRUE /end COMPU_METHOD
/begin COMPU_METHOD DEZ "1 : 1 Umrechnug (dez/hex)" RAT_FUNC "%6.2" "" COEFFS 0 1.000000 0.000000 0 0.000000 1.000000 /end COMPU_METHOD
/begin COMPU_METHOD dez "1 : 1 Umrechnug (dez/hex)" RAT_FUNC "%6.2" "" COEFFS 0 1.000000 0.000000 0 0.000000 1.000000 /end COMPU_METHOD
/begin COMPU_METHOD dez___SW "1 : 1 Umrechnug (dez/hex)" RAT_FUNC "%6.2" "" COEFFS 0 1.000000 0.000000 0 0.000000 1.000000 /end COMPU_METHOD
/begin COMPU_METHOD DEZ___UW "1 : 1 Umrechnug (dez/hex)" RAT_FUNC "%6.2" "" COEFFS 0 1.000000 0.000000 0 0.000000 1.000000 /end COMPU_METHOD
/begin COMPU_METHOD dez___UW "1 : 1 Umrechnug (dez/hex)" RAT_FUNC "%6.2" "" COEFFS 0 1.000000 0.000000 0 0.000000 1.000000 /end COMPU_METHOD
/begin COMPU_METHOD fak_q0p0039 "" RAT_FUNC "%6.4" "-" COEFFS 0 256.000000 0.000000 0 0.000000 1.000000 /end COMPU_METHOD
/begin COMPU_METHOD fak_q0p1 "" RAT_FUNC "%6.3" "" COEFFS 0 1.000000 0.000000 0 0.000000 1.000000e-01 /end COMPU_METHOD
/begin COMPU_METHOD fak_sw_b1 "" RAT_FUNC "%7.6" "-" COEFFS 0 6.553600e+04 0.000000 0 0.000000 2.000000 /end COMPU_METHOD
/begin COMPU_METHOD fak_sw_b64 "" RAT_FUNC "%6.4" "-" COEFFS 0 6.553600e+04 0.000000 0 0.000000 128.000000 /end COMPU_METHOD
/begin COMPU_METHOD fak_ub_b1 "" RAT_FUNC "%6.4" "-" COEFFS 0 256.000000 0.000000 0 0.000000 1.000000 /end COMPU_METHOD
/begin COMPU_METHOD fak_ub_b16 "" RAT_FUNC "%6.4" "-" COEFFS 0 256.000000 0.000000 0 0.000000 16.000000 /end COMPU_METHOD
/begin COMPU_METHOD fak_ub_b2 "" RAT_FUNC "%6.4" "-" COEFFS 0 256.000000 0.000000 0 0.000000 2.000000 /end COMPU_METHOD
/begin COMPU_METHOD fak_ub_b3p125 "" RAT_FUNC "%6.4" "%/Upm" COEFFS 0 2048.000000 0.000000 0 0.000000 25.000000 /end COMPU_METHOD
/begin COMPU_METHOD fak_ub_b4 "" RAT_FUNC "%6.4" "-" COEFFS 0 256.000000 0.000000 0 0.000000 4.000000 /end COMPU_METHOD
/begin COMPU_METHOD fak_uw_b1 "" RAT_FUNC "%7.6" "-" COEFFS 0 6.553600e+04 0.000000 0 0.000000 1.000000 /end COMPU_METHOD
/begin COMPU_METHOD fak_uw_b16 "" RAT_FUNC "%6.5" "-" COEFFS 0 6.553600e+04 0.000000 0 0.000000 16.000000 /end COMPU_METHOD
/begin COMPU_METHOD fak_uw_b2 "" RAT_FUNC "%7.6" "-" COEFFS 0 6.553600e+04 0.000000 0 0.000000 2.000000 /end COMPU_METHOD
/begin COMPU_METHOD fak_uw_b4 "" RAT_FUNC "%7.6" "-" COEFFS 0 6.553600e+04 0.000000 0 0.000000 4.000000 /end COMPU_METHOD
/begin COMPU_METHOD fak_uw_b4864 "" RAT_FUNC "%6.4" "-" COEFFS 0 6.553600e+04 0.000000 0 0.000000 4864.000000 /end COMPU_METHOD
/begin COMPU_METHOD fak_uw_q0p001 "" RAT_FUNC "%6.4" "" COEFFS 0 6.553600e+04 0.000000 0 0.000000 65.536000 /end COMPU_METHOD
/begin COMPU_METHOD kw_q2p8125 "" RAT_FUNC "%6.2" "∞KW" COEFFS 0 1.000000 0.000000 0 0.000000 2.812500 /end COMPU_METHOD
/begin COMPU_METHOD kw_q6 "" RAT_FUNC "%6.2" "∞KW" COEFFS 0 1.000000 0.000000 0 0.000000 6.000000 /end COMPU_METHOD
/begin COMPU_METHOD kw_q6___UW "" RAT_FUNC "%6.2" "∞KW" COEFFS 0 1.000000 0.000000 0 0.000000 6.000000 /end COMPU_METHOD
/begin COMPU_METHOD m_sw_q0p1 "" RAT_FUNC "%6.3" "kg/h" COEFFS 0 1.000000 0.000000 0 0.000000 1.000000e-01 /end COMPU_METHOD
/begin COMPU_METHOD m_ub_b1020 "" RAT_FUNC "%6.2" "kg/h" COEFFS 0 1.000000 0.000000 0 0.000000 4.000000 /end COMPU_METHOD
/begin COMPU_METHOD m_ub_b23p3 "" RAT_FUNC "%6.3" "kg" COEFFS 0 2812.500000 0.000000 0 0.000000 256.000000 /end COMPU_METHOD
/begin COMPU_METHOD m_ub_b25p6 "" RAT_FUNC "%6.3" "kg/h" COEFFS 0 256.000000 0.000000 0 0.000000 25.600000 /end COMPU_METHOD
/begin COMPU_METHOD m_ub_b5p8 "" RAT_FUNC "%6.4" "kg" COEFFS 0 5625.000000 0.000000 0 0.000000 128.000000 /end COMPU_METHOD
/begin COMPU_METHOD m_ub_q0p398 "" RAT_FUNC "%6.3" "kg/h" COEFFS 0 256.000000 0.000000 0 0.000000 102.000000 /end COMPU_METHOD
/begin COMPU_METHOD m_ub_q0p4 "" RAT_FUNC "%6.3" "kg" COEFFS 0 1.000000 0.000000 0 0.000000 4.000000e-01 /end COMPU_METHOD
/begin COMPU_METHOD m_ub_q25p6 "" RAT_FUNC "%6.1" "kg/h" COEFFS 0 1.000000 0.000000 0 0.000000 25.600000 /end COMPU_METHOD
/begin COMPU_METHOD m_uw_b23p3 "" RAT_FUNC "%6.5" "kg" COEFFS 0 2812.500000 0.000000 0 0.000000 1.000000 /end COMPU_METHOD
/begin COMPU_METHOD m_uw_b25p6 "" RAT_FUNC "%6.5" "kg/h" COEFFS 0 6.553600e+04 0.000000 0 0.000000 25.600000 /end COMPU_METHOD
/begin COMPU_METHOD m_uw_b6553p5 "" RAT_FUNC "%6.3" "kg/h" COEFFS 0 1.000000 0.000000 0 0.000000 1.000000e-01 /end COMPU_METHOD
/begin COMPU_METHOD m_uw_q0p0005 "" RAT_FUNC "%6.5" "kg/h" COEFFS 0 1.000000 0.000000 0 0.000000 5.000000e-04 /end COMPU_METHOD
/begin COMPU_METHOD nmotg_sb_q100 "" RAT_FUNC "%6.0" "U/min/s" COEFFS 0 1.000000 0.000000 0 0.000000 100.000000 /end COMPU_METHOD
/begin COMPU_METHOD nmotg_sw_q0p39 "" RAT_FUNC "%6.3" "U/min/s" COEFFS 0 1.000000 0.000000 0 0.000000 3.906300e-01 /end COMPU_METHOD
/begin COMPU_METHOD nmot_sw_q0p25 "" RAT_FUNC "%6.3" "U/min" COEFFS 0 1.000000 0.000000 0 0.000000 2.500000e-01 /end COMPU_METHOD
/begin COMPU_METHOD nmot_ub_q10 "" RAT_FUNC "%6.1" "U/min" COEFFS 0 1.000000 0.000000 0 0.000000 10.000000 /end COMPU_METHOD
/begin COMPU_METHOD nmot_ub_q40 "" RAT_FUNC "%6.1" "Upm" COEFFS 0 1.000000 0.000000 0 0.000000 40.000000 /end COMPU_METHOD
/begin COMPU_METHOD nmot_uw_q0p25 "" RAT_FUNC "%6.3" "U/min" COEFFS 0 1.000000 0.000000 0 0.000000 2.500000e-01 /end COMPU_METHOD
/begin COMPU_METHOD p_sw_q0p078 "" RAT_FUNC "%6.4" "hPa" COEFFS 0 6.553600e+04 0.000000 0 0.000000 5120.000000 /end COMPU_METHOD
/begin COMPU_METHOD p_ub_q10 "" RAT_FUNC "%6.1" "hPa" COEFFS 0 1.000000 0.000000 0 0.000000 10.000000 /end COMPU_METHOD
/begin COMPU_METHOD p_uw_b32 "" RAT_FUNC "%6.5" "hPa/%" COEFFS 0 6.553600e+04 0.000000 0 0.000000 32.000000 /end COMPU_METHOD
/begin COMPU_METHOD p_uw_q0p039 "" RAT_FUNC "%6.4" "hPa" COEFFS 0 256.000000 0.000000 0 0.000000 10.000000 /end COMPU_METHOD
/begin COMPU_METHOD qnv_uw_b512 "" RAT_FUNC "%6.4" "(U/min)/(km/h)" COEFFS 0 6.553600e+04 0.000000 0 0.000000 512.000000 /end COMPU_METHOD
/begin COMPU_METHOD q_uw_q0p0566 "" RAT_FUNC "%6.4" "kJ" COEFFS 0 65535.000000 0.000000 0 0.000000 3712.000000 /end COMPU_METHOD
/begin COMPU_METHOD relDK_q0p00152 "" RAT_FUNC "%6.4" "%DK" COEFFS 0 6.553600e+04 0.000000 0 0.000000 100.000000 /end COMPU_METHOD
/begin COMPU_METHOD relDK_q0p00152___UW "" RAT_FUNC "%6.4" "%DK" COEFFS 0 6.553600e+04 0.000000 0 0.000000 100.000000 /end COMPU_METHOD
/begin COMPU_METHOD relDK_q0p02441 "" RAT_FUNC "%6.4" "% DK" COEFFS 0 6.553600e+04 0.000000 0 0.000000 1600.000000 /end COMPU_METHOD
/begin COMPU_METHOD relDK_q0p02441___UW "" RAT_FUNC "%6.4" "% DK" COEFFS 0 6.553600e+04 0.000000 0 0.000000 1600.000000 /end COMPU_METHOD
/begin COMPU_METHOD relDK_q0p0625 "" RAT_FUNC "%6.4" "%PWM/%DK" COEFFS 0 16.000000 0.000000 0 0.000000 1.000000 /end COMPU_METHOD
/begin COMPU_METHOD relDK_q0p3922 "" RAT_FUNC "%6.3" "% DK" COEFFS 0 255.000000 0.000000 0 0.000000 100.000000 /end COMPU_METHOD
/begin COMPU_METHOD relDK_q1 "" RAT_FUNC "%6.2" "%PWM/%DK" COEFFS 0 1.000000 0.000000 0 0.000000 1.000000 /end COMPU_METHOD
/begin COMPU_METHOD relDK_q4 "" RAT_FUNC "%6.2" "%PWM/%DK" COEFFS 0 1.000000 0.000000 0 0.000000 4.000000 /end COMPU_METHOD
/begin COMPU_METHOD relDK_uw_b100 "" RAT_FUNC "%6.4" "% DK" COEFFS 0 65535.000000 0.000000 0 0.000000 100.000000 /end COMPU_METHOD
/begin COMPU_METHOD relPED_ub_b100 "" RAT_FUNC "%6.3" "% PED" COEFFS 0 255.000000 0.000000 0 0.000000 100.000000 /end COMPU_METHOD
/begin COMPU_METHOD relPED_uw_b100 "" RAT_FUNC "%6.4" "% PED" COEFFS 0 65535.000000 0.000000 0 0.000000 100.000000 /end COMPU_METHOD
/begin COMPU_METHOD rel_q0p1957 "" RAT_FUNC "%6.3" "%" COEFFS 0 511.000000 0.000000 0 0.000000 100.000000 /end COMPU_METHOD
/begin COMPU_METHOD rel_q0p1957___SW "" RAT_FUNC "%6.3" "%" COEFFS 0 511.000000 0.000000 0 0.000000 100.000000 /end COMPU_METHOD
/begin COMPU_METHOD rel_sw_b100 "" RAT_FUNC "%6.4" "%" COEFFS 0 3.276800e+04 0.000000 0 0.000000 100.000000 /end COMPU_METHOD
/begin COMPU_METHOD rel_sw_q0p0234 "" RAT_FUNC "%6.4" "%/seg" COEFFS 0 32.000000 0.000000 0 0.000000 7.500000e-01 /end COMPU_METHOD
/begin COMPU_METHOD rel_sw_q0p1953 "" RAT_FUNC "%6.3" "%" COEFFS 0 6.553600e+04 0.000000 0 0.000000 12800.000000 /end COMPU_METHOD
/begin COMPU_METHOD rel_ub_b127p5 "" RAT_FUNC "%6.3" "%" COEFFS 0 2.000000 0.000000 0 0.000000 1.000000 /end COMPU_METHOD
/begin COMPU_METHOD rel_ub_b99p6 "" RAT_FUNC "%6.3" "%" COEFFS 0 256.000000 0.000000 0 0.000000 100.000000 /end COMPU_METHOD
/begin COMPU_METHOD rel_ub_q0p75 "" RAT_FUNC "%6.3" "%" COEFFS 0 1.000000 0.000000 0 0.000000 7.500000e-01 /end COMPU_METHOD
/begin COMPU_METHOD rel_uw_b100 "" RAT_FUNC "%6.4" "%" COEFFS 0 6.553600e+04 0.000000 0 0.000000 100.000000 /end COMPU_METHOD
/begin COMPU_METHOD rel_uw_b40 "" RAT_FUNC "%6.5" "%" COEFFS 0 6.553600e+04 0.000000 0 0.000000 40.000000 /end COMPU_METHOD
/begin COMPU_METHOD rel_uw_q0p0234 "" RAT_FUNC "%6.4" "%" COEFFS 0 32.000000 0.000000 0 0.000000 7.500000e-01 /end COMPU_METHOD
/begin COMPU_METHOD rkti_sy "" RAT_FUNC "%6.4" "ms/%" COEFFS 0 468.750000 0.000000 0 0.000000 1.000000 /end COMPU_METHOD
/begin COMPU_METHOD spg_q0p00977 "" RAT_FUNC "%6.4" "V" COEFFS 0 256.000000 0.000000 0 0.000000 2.500000 /end COMPU_METHOD
/begin COMPU_METHOD spg_q0p03125 "" RAT_FUNC "%6.4" "V" COEFFS 0 256.000000 0.000000 0 0.000000 8.000000 /end COMPU_METHOD
/begin COMPU_METHOD spg_sw_q0p001222 "" RAT_FUNC "%6.4" "V" COEFFS 0 1.000000 0.000000 0 0.000000 1.222000e-03 /end COMPU_METHOD
/begin COMPU_METHOD spg_ubatt "" RAT_FUNC "%6.4" "V" COEFFS 0 1.000000 0.000000 0 0.000000 7.040000e-02 /end COMPU_METHOD
/begin COMPU_METHOD spg_ubatt___SB "" RAT_FUNC "%6.4" "V" COEFFS 0 1.000000 0.000000 0 0.000000 7.040000e-02 /end COMPU_METHOD
/begin COMPU_METHOD spg_ub_b5 "" RAT_FUNC "%6.4" "V" COEFFS 0 256.000000 0.000000 0 0.000000 5.000000 /end COMPU_METHOD
/begin COMPU_METHOD spg_ub_q0p019 "" RAT_FUNC "%6.4" "V" COEFFS 0 256.000000 0.000000 0 0.000000 5.000000 /end COMPU_METHOD
/begin COMPU_METHOD spg_uw_b5 "" RAT_FUNC "%6.4" "V" COEFFS 0 1024.000000 0.000000 0 0.000000 5.000000 /end COMPU_METHOD
/begin COMPU_METHOD spg_uw_q0p001222 "" RAT_FUNC "%6.4" "V" COEFFS 0 1.000000 0.000000 0 0.000000 1.222000e-03 /end COMPU_METHOD
/begin COMPU_METHOD spg_uw_q0p00488 "" RAT_FUNC "%6.4" "V" COEFFS 0 1024.000000 0.000000 0 0.000000 5.000000 /end COMPU_METHOD
/begin COMPU_METHOD spg_uw_q0p004888 "" RAT_FUNC "%6.4" "V" COEFFS 0 1.000000 0.000000 0 0.000000 4.888000e-03 /end COMPU_METHOD
/begin COMPU_METHOD s_q1_km "" RAT_FUNC "%6.2" "km" COEFFS 0 1.000000 0.000000 0 0.000000 1.000000 /end COMPU_METHOD
/begin COMPU_METHOD s_q6_km "" RAT_FUNC "%6.2" "km" COEFFS 0 1.000000 0.000000 0 0.000000 6.000000 /end COMPU_METHOD
/begin COMPU_METHOD t100msxs_uw_b6553p5 "" RAT_FUNC "%6.3" "s" COEFFS 0 1.000000 0.000000 0 0.000000 1.000000e-01 /end COMPU_METHOD
/begin COMPU_METHOD t100msxs_uw_b6553p6 "" RAT_FUNC "%6.3" "s" COEFFS 0 10.000000 0.000000 0 0.000000 1.000000 /end COMPU_METHOD
/begin COMPU_METHOD t10msxs_ub_b2p55 "" RAT_FUNC "%6.4" "s" COEFFS 0 1.000000 0.000000 0 0.000000 1.000000e-02 /end COMPU_METHOD
/begin COMPU_METHOD t10msxs_uw_b655p35 "" RAT_FUNC "%6.4" "s" COEFFS 0 1.000000 0.000000 0 0.000000 1.000000e-02 /end COMPU_METHOD
/begin COMPU_METHOD t1sxs_ub_b255 "" RAT_FUNC "%6.2" "s" COEFFS 0 1.000000 0.000000 0 0.000000 1.000000 /end COMPU_METHOD
/begin COMPU_METHOD t1sxs_uw_q1 "" RAT_FUNC "%6.2" "s" COEFFS 0 1.000000 0.000000 0 0.000000 1.000000 /end COMPU_METHOD
/begin COMPU_METHOD t20msxs_ub_b5p1 "" RAT_FUNC "%6.4" "s" COEFFS 0 1.000000 0.000000 0 0.000000 2.000000e-02 /end COMPU_METHOD
/begin COMPU_METHOD t20msxs_uw_q0p02 "" RAT_FUNC "%6.4" "s" COEFFS 0 1.000000 0.000000 0 0.000000 2.000000e-02 /end COMPU_METHOD
/begin COMPU_METHOD t500usxms_ub_q0p5 "" RAT_FUNC "%6.3" "ms" COEFFS 0 1.000000 0.000000 0 0.000000 5.000000e-01 /end COMPU_METHOD
/begin COMPU_METHOD t50msxs_q0p05 "" RAT_FUNC "%6.4" "s" COEFFS 0 1.000000 0.000000 0 0.000000 5.000000e-02 /end COMPU_METHOD
/begin COMPU_METHOD temp_ub_q0p75_o48 "" RAT_FUNC "%6.2" "Grad C" COEFFS 0 1.000000 48.000000 0 0.000000 7.500000e-01 /end COMPU_METHOD
/begin COMPU_METHOD temp_ub_q5_o50 "" RAT_FUNC "%6.2" "Grad C" COEFFS 0 1.000000 50.000000 0 0.000000 5.000000 /end COMPU_METHOD
/begin COMPU_METHOD temp_uw_q0p0195_o50 "" RAT_FUNC "%6.2" "Grad C" COEFFS 0 256.000000 12800.000000 0 0.000000 5.000000 /end COMPU_METHOD
/begin COMPU_METHOD tinjection_sy "" RAT_FUNC "%6.4" "ms" COEFFS 0 312.500000 0.000000 0 0.000000 1.000000 /end COMPU_METHOD
/begin COMPU_METHOD tsegment_sy "" RAT_FUNC "%6.5" "ms" COEFFS 0 1250.000000 0.000000 0 0.000000 1.000000 /end COMPU_METHOD
/begin COMPU_METHOD tsquant "Umrechnung Segmentzeit in DMD" RAT_FUNC "%6.2" "us" COEFFS 0 8.333330e-01 0.000000 0 0.000000 1.000000 /end COMPU_METHOD
/begin COMPU_METHOD tsquantl "" RAT_FUNC "%6.1" "us" COEFFS 0 5.208330e-02 0.000000 0 0.000000 1.000000 /end COMPU_METHOD
/begin COMPU_METHOD uefktget_ub_b25p4 "" RAT_FUNC "%6.3" "" COEFFS 0 10.000000 0.000000 0 0.000000 1.000000 /end COMPU_METHOD
/begin COMPU_METHOD vfzg_q1p0 "" RAT_FUNC "%6.2" "km/h" COEFFS 0 1.000000 0.000000 0 0.000000 1.000000 /end COMPU_METHOD
/begin COMPU_METHOD vfzg_ub_q1p25___UB "" RAT_FUNC "%6.2" "km/h" COEFFS 0 1.000000 0.000000 0 0.000000 1.250000 /end COMPU_METHOD
/begin COMPU_METHOD vfzg_uw_b512 "" RAT_FUNC "%6.4" "km/h" COEFFS 0 6.553600e+04 0.000000 0 0.000000 512.000000 /end COMPU_METHOD
/begin COMPU_METHOD vfzg_uw_q0p00781 "" RAT_FUNC "%6.4" "km/h" COEFFS 0 1.000000 0.000000 0 0.000000 7.812500e-03 /end COMPU_METHOD
/begin COMPU_METHOD zw_sb_q0p75 "" RAT_FUNC "%6.3" "grad KW" COEFFS 0 255.000000 0.000000 0 0.000000 191.250000 /end COMPU_METHOD
/begin COMPU_METHOD zw_ub_q0p75 "" RAT_FUNC "%6.3" "Grad KW" COEFFS 0 255.000000 0.000000 0 0.000000 191.250000 /end COMPU_METHOD
/begin COMPU_METHOD zw_ub_q0p75___UW "" RAT_FUNC "%6.3" "Grad KW" COEFFS 0 255.000000 0.000000 0 0.000000 191.250000 /end COMPU_METHOD
/begin COMPU_VTAB B_TRUE "" TAB_VERB 2 0 "----" 1 "TRUE" /end COMPU_VTAB
/begin MEASUREMENT tmot "Motor-Temperatur" UBYTE temp_ub_q0p75_o48 0 0 -48.000000 143.250000 /begin IF_DATA ASAP1B_ETK KP_BLOB 0x380B61 1 1 /end IF_DATA BIT_MASK 0xFF /end MEASUREMENT
/begin MEASUREMENT rl "relative LuftfÅllung" UBYTE rel_ub_q0p75 0 0 0.000000 191.250000 /begin IF_DATA ASAP1B_ETK KP_BLOB 0xF997 0 1 /end IF_DATA BIT_MASK 0xFF /end MEASUREMENT
/begin MEASUREMENT nmot "Motordrehzahl" UBYTE nmot_ub_q40 0 0 0.000000 10200.000000 /begin IF_DATA ASAP1B_ETK KP_BLOB 0xF876 0 1 /end IF_DATA BIT_MASK 0xFF /end MEASUREMENT
/begin MEASUREMENT tans "Ansauglufttemperatur" UBYTE temp_ub_q0p75_o48 0 0 -48.000000 143.250000 /begin IF_DATA ASAP1B_ETK KP_BLOB 0x380B59 1 1 /end IF_DATA BIT_MASK 0xFF /end MEASUREMENT
/begin MEASUREMENT wped "Normierter Fahrpedalwinkel" UBYTE relPED_ub_b100 0 0 0.000000 100.000000 /begin IF_DATA ASAP1B_ETK KP_BLOB 0x380ABA 1 1 /end IF_DATA BIT_MASK 0xFF /end MEASUREMENT
/begin MEASUREMENT nmot_w "Motordrehzahl" UWORD nmot_uw_q0p25 0 0 0.000000 16383.750000 /begin IF_DATA ASAP1B_ETK KP_BLOB 0xF878 0 2 /end IF_DATA BIT_MASK 0xFFFF /end MEASUREMENT
/begin MEASUREMENT ml "Luftmassenflu·" UBYTE m_ub_b1020 0 0 0.000000 1020.000000 /begin IF_DATA ASAP1B_ETK KP_BLOB 0xF996 0 1 /end IF_DATA BIT_MASK 0xFF /end MEASUREMENT
/begin MEASUREMENT ngfil "gefilterter Drehzahlgradient" SBYTE nmotg_sb_q100 0 0 -12800.000000 12700.000000 /begin IF_DATA ASAP1B_ETK KP_BLOB 0x380A53 1 1 /end IF_DATA BIT_MASK 0xFF /end MEASUREMENT
/begin MEASUREMENT mifa_w "indiziertes Motormoment Fahrerwunsch" UWORD rel_uw_b100 0 0 0.000000 99.998474 /begin IF_DATA ASAP1B_ETK KP_BLOB 0x38243C 1 2 /end IF_DATA BIT_MASK 0xFFFF /end MEASUREMENT
/begin MEASUREMENT uevges "öbersetzungsverhÑltnis gesamt" UBYTE fak_q0p1 0 0 0.000000 25.500000 /begin IF_DATA ASAP1B_ETK KP_BLOB 0x380AB6 1 1 /end IF_DATA BIT_MASK 0xFF /end MEASUREMENT
/begin MEASUREMENT gangi "Ist-Gang" UBYTE dez 0 0 0.000000 255.000000 /begin IF_DATA ASAP1B_ETK KP_BLOB 0x380AB5 1 1 /end IF_DATA BIT_MASK 0xFF /end MEASUREMENT
/begin MEASUREMENT tmst "Motorstarttemperatur" UBYTE temp_ub_q0p75_o48 0 0 -48.000000 143.250000 /begin IF_DATA ASAP1B_ETK KP_BLOB 0x380B5F 1 1 /end IF_DATA BIT_MASK 0xFF /end MEASUREMENT
/begin MEASUREMENT ml_w "Luftmassenflu· gefiltert (Word)" UWORD m_uw_b6553p5 0 0 0.000000 6553.500000 /begin IF_DATA ASAP1B_ETK KP_BLOB 0xF998 0 2 /end IF_DATA BIT_MASK 0xFFFF /end MEASUREMENT
/begin MEASUREMENT lamsbg_w "Lambdasoll Begrenzung (word)" UWORD fak_uw_b16 0 0 0.000000 15.999756 /begin IF_DATA ASAP1B_ETK KP_BLOB 0x381FE2 1 2 /end IF_DATA BIT_MASK 0xFFFF /end MEASUREMENT
/begin MEASUREMENT etazwimt "Ist_ZÅndwinkelwirkungsgrad fÅr ATM gemittelt (200 ms)" UBYTE rel_ub_b127p5 0 0 0.000000 127.500000 /begin IF_DATA ASAP1B_ETK KP_BLOB 0x380A66 1 1 /end IF_DATA BIT_MASK 0xFF /end MEASUREMENT
/begin MEASUREMENT tabgmst "Abgastemperatur bei Motorstart" UBYTE temp_ub_q5_o50 0 0 -50.000000 1225.000000 /begin IF_DATA ASAP1B_ETK KP_BLOB 0x380A69 1 1 /end IF_DATA BIT_MASK 0xFF /end MEASUREMENT
/begin MEASUREMENT tkatmst "Katalysatortemperatur Modell Startwert = f(Abstellwert, Abstellzeit)" UBYTE temp_ub_q5_o50 0 0 -50.000000 1225.000000 /begin IF_DATA ASAP1B_ETK KP_BLOB 0x380A6E 1 1 /end IF_DATA BIT_MASK 0xFF /end MEASUREMENT
/begin MEASUREMENT tabstatm_w "Abstellzeit im SG-Nachlauf fÅr ATM" UWORD t1sxs_uw_q1 0 0 0.000000 65535.000000 /begin IF_DATA ASAP1B_ETK KP_BLOB 0x381B0E 1 2 /end IF_DATA BIT_MASK 0xFFFF /end MEASUREMENT
/begin MEASUREMENT vziel_w "Zielgeschwindigkeit FGR" UWORD vfzg_uw_b512 0 0 0.000000 511.992188 /begin IF_DATA ASAP1B_ETK KP_BLOB 0x381D62 1 2 /end IF_DATA BIT_MASK 0xFFFF /end MEASUREMENT
/begin MEASUREMENT mkar_w "Berechnetes Kupplungsmoment fÅr Antiruckelfunktion" SWORD rel_sw_b100 0 0 -100.000000 99.996948 /begin IF_DATA ASAP1B_ETK KP_BLOB 0x3823DE 1 2 /end IF_DATA BIT_MASK 0xFFFF /end MEASUREMENT
/begin MEASUREMENT vfzg "Fahrzeuggeschwindigkeit" UBYTE vfzg_ub_q1p25___UB 0 0 0.000000 318.750000 /begin IF_DATA ASAP1B_ETK KP_BLOB 0x380982 1 1 /end IF_DATA BIT_MASK 0xFF /end MEASUREMENT
/begin MEASUREMENT ubf "gefilterte Batteriespannung fÅr Batteriespannungsregelung" UBYTE spg_ubatt 0 0 0.000000 17.952000 /begin IF_DATA ASAP1B_ETK KP_BLOB 0x380AAF 1 1 /end IF_DATA BIT_MASK 0xFF /end MEASUREMENT
/begin MEASUREMENT tatu "Ansaugluft- oder Umgebungstemperatur" UBYTE temp_ub_q0p75_o48 0 0 -48.000000 143.250000 /begin IF_DATA ASAP1B_ETK KP_BLOB 0x380A6C 1 1 /end IF_DATA BIT_MASK 0xFF /end MEASUREMENT
/begin MEASUREMENT tkatm "Katalysatortemperatur aus Modell" UBYTE temp_ub_q5_o50 0 0 -50.000000 1225.000000 /begin IF_DATA ASAP1B_ETK KP_BLOB 0x380A6D 1 1 /end IF_DATA BIT_MASK 0xFF /end MEASUREMENT
/begin MEASUREMENT tabgm "Abgastemperatur vor Kat aus Modell" UBYTE temp_ub_q5_o50 0 0 -50.000000 1225.000000 /begin IF_DATA ASAP1B_ETK KP_BLOB 0x380A68 1 1 /end IF_DATA BIT_MASK 0xFF /end MEASUREMENT
/begin MEASUREMENT gwdk_kge "énderung des Drosselklappen-Sollwinkels, Betrag fÅr Kennlinieneingang" UWORD relDK_q0p00152___UW 0 0 0.000000 99.998474 /begin IF_DATA ASAP1B_ETK KP_BLOB 0x381D12 1 2 /end IF_DATA BIT_MASK 0xFFFF /end MEASUREMENT
/begin MEASUREMENT vfzg_w "Fahrzeuggeschwindigkeit, gefiltert" UWORD vfzg_uw_b512 0 0 0.000000 511.992188 /begin IF_DATA ASAP1B_ETK KP_BLOB 0x380DA6 1 2 /end IF_DATA BIT_MASK 0xFFFF /end MEASUREMENT
/begin MEASUREMENT uhfm_w "HFM-Spannung" UWORD spg_uw_q0p00488 0 0 0.000000 319.995117 /begin IF_DATA ASAP1B_ETK KP_BLOB 0x380F8C 1 2 /end IF_DATA BIT_MASK 0xFFFF /end MEASUREMENT
/begin MEASUREMENT klaf_kge "" UWORD fak_uw_q0p001 0 0 0.000000 65.535000 /begin IF_DATA ASAP1B_ETK KP_BLOB 0x381E62 1 2 /end IF_DATA BIT_MASK 0xFFFF /end MEASUREMENT
/begin MEASUREMENT pspvds_w "Quotient Saugrohrdruck/Druck vor DK" UWORD fak_uw_b2 0 0 0.000000 1.999969 /begin IF_DATA ASAP1B_ETK KP_BLOB 0x381E7A 1 2 /end IF_DATA BIT_MASK 0xFFFF /end MEASUREMENT
/begin MEASUREMENT wdkbab_w "wdkba_w begrenzt (Minimalauswahl zwischen wdkba_w und wdkugd_w)" UWORD rel_uw_b100 0 0 0.000000 99.998474 /begin IF_DATA ASAP1B_ETK KP_BLOB 0x381E82 1 2 /end IF_DATA BIT_MASK 0xFFFF /end MEASUREMENT
/begin MEASUREMENT hagr_w "Hub AGR-Ventil" UWORD rel_uw_b100 0 0 0.000000 99.998474 /begin IF_DATA ASAP1B_ETK KP_BLOB 0x380EC8 1 2 /end IF_DATA BIT_MASK 0xFFFF /end MEASUREMENT
/begin MEASUREMENT msagr "AGR Massenstrom ins Saugrohr" UBYTE m_ub_q0p398 0 0 0.000000 101.601562 /begin IF_DATA ASAP1B_ETK KP_BLOB 0x380AF7 1 1 /end IF_DATA BIT_MASK 0xFF /end MEASUREMENT
/begin MEASUREMENT tagrv "AGR-Ventil Temperatur" UBYTE temp_ub_q5_o50 0 0 -50.000000 1225.000000 /begin IF_DATA ASAP1B_ETK KP_BLOB 0x380AF6 1 1 /end IF_DATA BIT_MASK 0xFF /end MEASUREMENT
/begin MEASUREMENT nmotll "Motordrehzahl im Leerlaufbereich" UBYTE nmot_ub_q10 0 0 0.000000 2550.000000 /begin IF_DATA ASAP1B_ETK KP_BLOB 0x380C2D 1 1 /end IF_DATA BIT_MASK 0xFF /end MEASUREMENT
/begin MEASUREMENT wped_w "Normierter Fahrpedalwinkel" UWORD relPED_uw_b100 0 0 0.000000 100.000000 /begin IF_DATA ASAP1B_ETK KP_BLOB 0x381CAE 1 2 /end IF_DATA BIT_MASK 0xFFFF /end MEASUREMENT
/begin MEASUREMENT fho_w "Korrekturfaktor Hîhe (word)" UWORD fak_uw_b4 0 0 0.000000 3.999939 /begin IF_DATA ASAP1B_ETK KP_BLOB 0x381E9A 1 2 /end IF_DATA BIT_MASK 0xFFFF /end MEASUREMENT
/begin MEASUREMENT tabst_w "Abstellzeit" UWORD t1sxs_uw_q1 0 0 0.000000 65535.000000 /begin IF_DATA ASAP1B_ETK KP_BLOB 0x382080 1 2 /end IF_DATA BIT_MASK 0xFFFF /end MEASUREMENT
/begin MEASUREMENT evrbgn_one "Ev Nr -1 bei Beginn der Ev-Abschaltung zur Adressierung von REDABM" UBYTE dez 0 0 0.000000 255.000000 /begin IF_DATA ASAP1B_ETK KP_BLOB 0x380B1B 1 1 /end IF_DATA BIT_MASK 0xFF /end MEASUREMENT
/begin MEASUREMENT redsol_one "Berechnete Soll-Reduzierstufe - 1 zur Adress. von REDABM" UBYTE dez 0 0 0.000000 255.000000 /begin IF_DATA ASAP1B_ETK KP_BLOB 0x380B22 1 1 /end IF_DATA BIT_MASK 0xFF /end MEASUREMENT
/begin MEASUREMENT tmotab "Motortemperatur beim Abstellen" UBYTE temp_ub_q0p75_o48 0 0 -48.000000 143.250000 /begin IF_DATA ASAP1B_ETK KP_BLOB 0x38335E 1 1 /end IF_DATA BIT_MASK 0xFF /end MEASUREMENT
/begin MEASUREMENT ub "Batteriespannung" UBYTE spg_ubatt 0 0 0.000000 17.952000 /begin IF_DATA ASAP1B_ETK KP_BLOB 0x380AB1 1 1 /end IF_DATA BIT_MASK 0xFF /end MEASUREMENT
/begin MEASUREMENT dpus_w "Delta Druck Umgebung Saugrohr" SWORD p_sw_q0p078 0 0 -2560.000000 2559.921875 /begin IF_DATA ASAP1B_ETK KP_BLOB 0x382018 1 2 /end IF_DATA BIT_MASK 0xFFFF /end MEASUREMENT
/begin MEASUREMENT tabgm_w "Abgastemperatur vor Kat aus Modell (Word)" UWORD temp_uw_q0p0195_o50 0 0 -50.000000 1229.980469 /begin IF_DATA ASAP1B_ETK KP_BLOB 0x381B0C 1 2 /end IF_DATA BIT_MASK 0xFFFF /end MEASUREMENT
/begin MEASUREMENT wtans "A/D-Wert fÅr tans" UBYTE spg_ub_b5 0 0 0.000000 4.980469 /begin IF_DATA ASAP1B_ETK KP_BLOB 0x3809BB 1 1 /end IF_DATA BIT_MASK 0xFF /end MEASUREMENT
/begin MEASUREMENT wtmot_w "A/D-Wert fÅr tmot 10 bit" UWORD spg_uw_q0p00488 0 0 0.000000 319.995117 /begin IF_DATA ASAP1B_ETK KP_BLOB 0x380F9E 1 2 /end IF_DATA BIT_MASK 0xFFFF /end MEASUREMENT
/begin MEASUREMENT imlpr_w "Relatives Luftmassenintegral bei Katheizung (word)" UWORD fak_uw_b1 0 0 0.000000 0.999985 /begin IF_DATA ASAP1B_ETK KP_BLOB 0x382118 1 2 /end IF_DATA BIT_MASK 0xFFFF /end MEASUREMENT
/begin MEASUREMENT imlpr "Relatives Luftmassenintegral bei Katheizung" UBYTE fak_ub_b1 0 0 0.000000 0.996094 /begin IF_DATA ASAP1B_ETK KP_BLOB 0x380B68 1 1 /end IF_DATA BIT_MASK 0xFF /end MEASUREMENT
/begin MEASUREMENT tnst_w "Zeit nach Startende" UWORD t10msxs_uw_b655p35 0 0 0.000000 655.350000 /begin IF_DATA ASAP1B_ETK KP_BLOB 0x382672 1 2 /end IF_DATA BIT_MASK 0xFFFF /end MEASUREMENT
/begin MEASUREMENT mstesoll_w "Massenstrom TankentlÅftung ins Saugrohr, Sollwert" UWORD m_uw_b25p6 0 0 0.000000 25.599609 /begin IF_DATA ASAP1B_ETK KP_BLOB 0x3826A4 1 2 /end IF_DATA BIT_MASK 0xFFFF /end MEASUREMENT
/begin MEASUREMENT msntev_w "gewÅnschter normierter, Åberkritischer Massenstrom TEV" UWORD m_uw_b25p6 0 0 0.000000 25.599609 /begin IF_DATA ASAP1B_ETK KP_BLOB 0x38270E 1 2 /end IF_DATA BIT_MASK 0xFFFF /end MEASUREMENT
/begin MEASUREMENT tateroh "Rohwert TastverhÑltnis TEV" UBYTE rel_ub_b99p6 0 0 0.000000 99.609375 /begin IF_DATA ASAP1B_ETK KP_BLOB 0x380CB4 1 1 /end IF_DATA BIT_MASK 0xFF /end MEASUREMENT
/begin MEASUREMENT etazwist "Ist-ZÅndwinkelwirkungsgrad" UBYTE rel_ub_b127p5 0 0 0.000000 127.500000 /begin IF_DATA ASAP1B_ETK KP_BLOB 0x380C4B 1 1 /end IF_DATA BIT_MASK 0xFF /end MEASUREMENT
/begin MEASUREMENT pukor_w "Umgebungsdruckwerte nach additiver Staudruckkorrektur" UWORD p_uw_q0p039 0 0 0.000000 2559.960938 /begin IF_DATA ASAP1B_ETK KP_BLOB 0x3827AE 1 2 /end IF_DATA BIT_MASK 0xFFFF /end MEASUREMENT
/begin MEASUREMENT mshfm_w "Massenstrom HFM 16-Bit Grî·e" UWORD m_uw_b6553p5 0 0 0.000000 6553.500000 /begin IF_DATA ASAP1B_ETK KP_BLOB 0xF988 0 2 /end IF_DATA BIT_MASK 0xFFFF /end MEASUREMENT
/begin MEASUREMENT tkatm_w "Katalysatortemperatur aus Modell (Word)" UWORD temp_uw_q0p0195_o50 0 0 -50.000000 1229.980469 /begin IF_DATA ASAP1B_ETK KP_BLOB 0x381B10 1 2 /end IF_DATA BIT_MASK 0xFFFF /end MEASUREMENT
/begin MEASUREMENT ngfil_w "gefilterter Drehzahlgradient" SWORD nmotg_sw_q0p39 0 0 -12800.163840 12799.773210 /begin IF_DATA ASAP1B_ETK KP_BLOB 0x381A9E 1 2 /end IF_DATA BIT_MASK 0xFFFF /end MEASUREMENT
/begin MEASUREMENT abmf "Festeinspritzausblendmuster" UBYTE dez 0 0 0.000000 255.000000 /begin IF_DATA ASAP1B_ETK KP_BLOB 0x380B18 1 1 /end IF_DATA BIT_MASK 0xFF /end MEASUREMENT
/begin MEASUREMENT AEKPintbits "" UBYTE dez 0 0 0.000000 255.000000 /begin IF_DATA ASAP1B_ETK KP_BLOB 0x383442 1 1 /end IF_DATA BIT_MASK 0xFF /end MEASUREMENT
/begin MEASUREMENT aleNvBits "" UBYTE dez 0 0 0.000000 255.000000 /begin IF_DATA ASAP1B_ETK KP_BLOB 0x383315 1 1 /end IF_DATA BIT_MASK 0xFF /end MEASUREMENT
/begin MEASUREMENT anzti "ti-EinspritzzÑhler" UBYTE dez 0 0 0.000000 255.000000 /begin IF_DATA ASAP1B_ETK KP_BLOB 0xF91E 0 1 /end IF_DATA BIT_MASK 0xFF /end MEASUREMENT
/begin MEASUREMENT anzti_w "ti-EinspritzzÑhler" UWORD dez___UW 0 0 0.000000 65535.000000 /begin IF_DATA ASAP1B_ETK KP_BLOB 0xF94A 0 2 /end IF_DATA BIT_MASK 0xFFFF /end MEASUREMENT
/begin MEASUREMENT ATMbits "" UBYTE dez 0 0 0.000000 255.000000 /begin IF_DATA ASAP1B_ETK KP_BLOB 0x383318 1 1 /end IF_DATA BIT_MASK 0xFF /end MEASUREMENT
/begin MEASUREMENT BBFGRlokBits "" UBYTE dez 0 0 0.000000 255.000000 /begin IF_DATA ASAP1B_ETK KP_BLOB 0x380AE0 1 1 /end IF_DATA BIT_MASK 0xFF /end MEASUREMENT
/begin MEASUREMENT BBKDbits "" UBYTE dez 0 0 0.000000 255.000000 /begin IF_DATA ASAP1B_ETK KP_BLOB 0x380ABB 1 1 /end IF_DATA BIT_MASK 0xFF /end MEASUREMENT
/begin MEASUREMENT BBKHZBits "" UBYTE dez 0 0 0.000000 255.000000 /begin IF_DATA ASAP1B_ETK KP_BLOB 0x380B63 1 1 /end IF_DATA BIT_MASK 0xFF /end MEASUREMENT
/begin MEASUREMENT BBKHZlokBits "" UWORD dez___UW 0 0 0.000000 65535.000000 /begin IF_DATA ASAP1B_ETK KP_BLOB 0x382112 1 2 /end IF_DATA BIT_MASK 0xFFFF /end MEASUREMENT
/begin MEASUREMENT bblkderf "" UBYTE dez 0 0 0.000000 255.000000 /begin IF_DATA ASAP1B_ETK KP_BLOB 0x38334A 1 1 /end IF_DATA BIT_MASK 0xFF /end MEASUREMENT
/begin MEASUREMENT BBSAWElokbits "" UBYTE dez 0 0 0.000000 255.000000 /begin IF_DATA ASAP1B_ETK KP_BLOB 0x380C0E 1 1 /end IF_DATA BIT_MASK 0xFF /end MEASUREMENT
/begin MEASUREMENT bfzgl_b "FahrzeuglÑngsbeschleunigung" SBYTE bfzg_sb_q0p217 0 0 -27.776000 27.559000 /begin IF_DATA ASAP1B_ETK KP_BLOB 0x380983 1 1 /end IF_DATA BIT_MASK 0xFF /end MEASUREMENT
/begin MEASUREMENT BGDVEintbits "" UBYTE dez 0 0 0.000000 255.000000 /begin IF_DATA ASAP1B_ETK KP_BLOB 0x38334B 1 1 /end IF_DATA BIT_MASK 0xFF /end MEASUREMENT
/begin MEASUREMENT B_0101_ack "" UBYTE B_TRUE 0 0 0.000000 0.000000 /begin IF_DATA ASAP1B_ETK KP_BLOB 0x380BEF 1 1 /end IF_DATA BIT_MASK 0x2 /end MEASUREMENT
/begin MEASUREMENT B_0101_ident "" UBYTE B_TRUE 0 0 0.000000 0.000000 /begin IF_DATA ASAP1B_ETK KP_BLOB 0x380BEF 1 1 /end IF_DATA BIT_MASK 0x1 /end MEASUREMENT
/begin MEASUREMENT B_0101_notadr "" UBYTE B_TRUE 0 0 0.000000 0.000000 /begin IF_DATA ASAP1B_ETK KP_BLOB 0x380BEF 1 1 /end IF_DATA BIT_MASK 0x8 /end MEASUREMENT
/begin MEASUREMENT B_0101_switch "" UBYTE B_TRUE 0 0 0.000000 0.000000 /begin IF_DATA ASAP1B_ETK KP_BLOB 0x380BEF 1 1 /end IF_DATA BIT_MASK 0x4 /end MEASUREMENT
/begin MEASUREMENT B_abgle "Bedingung: Fehler beim VerstÑrkerabgleich" UWORD B_TRUE___UW 0 0 0.000000 0.000000 /begin IF_DATA ASAP1B_ETK KP_BLOB 0xFD40 0 2 /end IF_DATA BIT_MASK 0x10 /end MEASUREMENT
/begin MEASUREMENT B_acc "Bedingung: ACC-SteuergerÑt vorhanden" UWORD B_TRUE___UW 0 0 0.000000 0.000000 /begin IF_DATA ASAP1B_ETK KP_BLOB 0xFD74 0 2 /end IF_DATA BIT_MASK 0x20 /end MEASUREMENT
/begin MEASUREMENT B_add "Bedingung PlausibilitÑts- und Differenzbedingung fÅr aktuelles PUS_W erfÅllt" UBYTE B_TRUE 0 0 0.000000 0.000000 /begin IF_DATA ASAP1B_ETK KP_BLOB 0x380CD3 1 1 /end IF_DATA BIT_MASK 0x2 /end MEASUREMENT
/begin MEASUREMENT B_agr "Bedingung AGR ein" UWORD B_TRUE___UW 0 0 0.000000 0.000000 /begin IF_DATA ASAP1B_ETK KP_BLOB 0xFD06 0 2 /end IF_DATA BIT_MASK 0x80 /end MEASUREMENT
/begin MEASUREMENT B_ale "Bedingung Motorabstellposition erkannt" UBYTE B_TRUE 0 0 0.000000 0.000000 /begin IF_DATA ASAP1B_ETK KP_BLOB 0x383315 1 1 /end IF_DATA BIT_MASK 0x1 /end MEASUREMENT
/begin MEASUREMENT B_apnoluv "Verriegelungsbit: Applikationshilfe DK-Notluftfahren" UWORD B_TRUE___UW 0 0 0.000000 0.000000 /begin IF_DATA ASAP1B_ETK KP_BLOB 0xFD44 0 2 /end IF_DATA BIT_MASK 0x2 /end MEASUREMENT
/begin MEASUREMENT B_appnolu "Bedingung: DK-Notluftfahren durch Applikation angefordert" UWORD B_TRUE___UW 0 0 0.000000 0.000000 /begin IF_DATA ASAP1B_ETK KP_BLOB 0xFD44 0 2 /end IF_DATA BIT_MASK 0x4 /end MEASUREMENT
/begin MEASUREMENT B_ar "Antiruckeleingriff aktiv" UWORD B_TRUE___UW 0 0 0.000000 0.000000 /begin IF_DATA ASAP1B_ETK KP_BLOB 0xFD7C 0 2 /end IF_DATA BIT_MASK 0x8000 /end MEASUREMENT
/begin MEASUREMENT B_asr "Bedingung fÅr ASR aktiv" UWORD B_TRUE___UW 0 0 0.000000 0.000000 /begin IF_DATA ASAP1B_ETK KP_BLOB 0xFD82 0 2 /end IF_DATA BIT_MASK 0x8 /end MEASUREMENT
/begin MEASUREMENT B_atmst "Bedingung Startwert tabgmst,tkatmst berechnet" UWORD B_TRUE___UW 0 0 0.000000 0.000000 /begin IF_DATA ASAP1B_ETK KP_BLOB 0xFD22 0 2 /end IF_DATA BIT_MASK 0x20 /end MEASUREMENT
/begin MEASUREMENT B_atmtpa "Bedingung Taupunkt vor Kat ueberschritten" UWORD B_TRUE___UW 0 0 0.000000 0.000000 /begin IF_DATA ASAP1B_ETK KP_BLOB 0xFD22 0 2 /end IF_DATA BIT_MASK 0x40 /end MEASUREMENT
/begin MEASUREMENT B_atmtpf "Bedingung Taupunkt vor Kat Åberschritten (last trip)" UBYTE B_TRUE 0 0 0.000000 0.000000 /begin IF_DATA ASAP1B_ETK KP_BLOB 0x383318 1 1 /end IF_DATA BIT_MASK 0x4 /end MEASUREMENT
/begin MEASUREMENT B_atmtpk "Bedingung Taupunkt hinter Kat ueberschritten" UWORD B_TRUE___UW 0 0 0.000000 0.000000 /begin IF_DATA ASAP1B_ETK KP_BLOB 0xFD22 0 2 /end IF_DATA BIT_MASK 0x80 /end MEASUREMENT
/begin MEASUREMENT B_atmtpl "Bedingung Taupunktendezeit abgelaufen (last trip)" UBYTE B_TRUE 0 0 0.000000 0.000000 /begin IF_DATA ASAP1B_ETK KP_BLOB 0x383318 1 1 /end IF_DATA BIT_MASK 0x1 /end MEASUREMENT
/begin MEASUREMENT B_autget "Bedingung Automatikgetriebe" UWORD B_TRUE___UW 0 0 0.000000 0.000000 /begin IF_DATA ASAP1B_ETK KP_BLOB 0xFD00 0 2 /end IF_DATA BIT_MASK 0x8 /end MEASUREMENT
/begin MEASUREMENT B_bevab "Bedingung EV-Abschaltung auf Bank/Bank1" UWORD B_TRUE___UW 0 0 0.000000 0.000000 /begin IF_DATA ASAP1B_ETK KP_BLOB 0xFD5C 0 2 /end IF_DATA BIT_MASK 0x2 /end MEASUREMENT
/begin MEASUREMENT B_bevab2 "Bedingung EV-Abschaltung auf Bank2" UWORD B_TRUE___UW 0 0 0.000000 0.000000 /begin IF_DATA ASAP1B_ETK KP_BLOB 0xFD5C 0 2 /end IF_DATA BIT_MASK 0x4 /end MEASUREMENT
/begin MEASUREMENT B_bldrff "" UWORD B_TRUE___UW 0 0 0.000000 0.000000 /begin IF_DATA ASAP1B_ETK KP_BLOB 0xFD78 0 2 /end IF_DATA BIT_MASK 0x10 /end MEASUREMENT
/begin MEASUREMENT B_bldsff "" UWORD B_TRUE___UW 0 0 0.000000 0.000000 /begin IF_DATA ASAP1B_ETK KP_BLOB 0xFD78 0 2 /end IF_DATA BIT_MASK 0x20 /end MEASUREMENT
/begin MEASUREMENT B_blduff "" UWORD B_TRUE___UW 0 0 0.000000 0.000000 /begin IF_DATA ASAP1B_ETK KP_BLOB 0xFD78 0 2 /end IF_DATA BIT_MASK 0x40 /end MEASUREMENT
/begin MEASUREMENT B_bm "Bedingung Bezugsmarke erkannt" UWORD B_TRUE___UW 0 0 0.000000 0.000000 /begin IF_DATA ASAP1B_ETK KP_BLOB 0xFD1E 0 2 /end IF_DATA BIT_MASK 0x20 /end MEASUREMENT
/begin MEASUREMENT B_brems "Bedingung Bremse betÑtigt" UWORD B_TRUE___UW 0 0 0.000000 0.000000 /begin IF_DATA ASAP1B_ETK KP_BLOB 0xFD48 0 2 /end IF_DATA BIT_MASK 0x8 /end MEASUREMENT
/begin MEASUREMENT B_buf "" UWORD B_TRUE___UW 0 0 0.000000 0.000000 /begin IF_DATA ASAP1B_ETK KP_BLOB 0xFD9E 0 2 /end IF_DATA BIT_MASK 0x40 /end MEASUREMENT
/begin MEASUREMENT B_cvt "Bedingung continuously variable transmission" UWORD B_TRUE___UW 0 0 0.000000 0.000000 /begin IF_DATA ASAP1B_ETK KP_BLOB 0xFD00 0 2 /end IF_DATA BIT_MASK 0x20 /end MEASUREMENT
/begin MEASUREMENT B_cwesakt "Codewort CWESWEZ Bit 3 gesetzt" UWORD B_TRUE___UW 0 0 0.000000 0.000000 /begin IF_DATA ASAP1B_ETK KP_BLOB 0xFD48 0 2 /end IF_DATA BIT_MASK 0x100 /end MEASUREMENT
/begin MEASUREMENT B_dash "Bedingung: Dashpot-énderungsbegrenzung aktiv" UWORD B_TRUE___UW 0 0 0.000000 0.000000 /begin IF_DATA ASAP1B_ETK KP_BLOB 0xFD7E 0 2 /end IF_DATA BIT_MASK 0x20 /end MEASUREMENT
/begin MEASUREMENT B_dcdisfr "Bedingung: Disable DV-E-Endstufe durch den Funktionsrechner" UWORD B_TRUE___UW 0 0 0.000000 0.000000 /begin IF_DATA ASAP1B_ETK KP_BLOB 0xFD44 0 2 /end IF_DATA BIT_MASK 0x8 /end MEASUREMENT
/begin MEASUREMENT B_dcdisr "Bedingung: DV-E-Endstufenabschaltung wird angefordert" UWORD B_TRUE___UW 0 0 0.000000 0.000000 /begin IF_DATA ASAP1B_ETK KP_BLOB 0xFD40 0 2 /end IF_DATA BIT_MASK 0x20 /end MEASUREMENT
/begin MEASUREMENT B_dkaden "Bedingung: DK-Sollwert aus DK-Adaption und -PrÅfung verwenden" UWORD B_TRUE___UW 0 0 0.000000 0.000000 /begin IF_DATA ASAP1B_ETK KP_BLOB 0xFD40 0 2 /end IF_DATA BIT_MASK 0x40 /end MEASUREMENT
/begin MEASUREMENT B_dkbew "Bedingung: DK hat sich bewegt" UWORD B_TRUE___UW 0 0 0.000000 0.000000 /begin IF_DATA ASAP1B_ETK KP_BLOB 0xFD44 0 2 /end IF_DATA BIT_MASK 0x10 /end MEASUREMENT
/begin MEASUREMENT B_dknolu "Bedingung Drosselklappensteller stromlos" UWORD B_TRUE___UW 0 0 0.000000 0.000000 /begin IF_DATA ASAP1B_ETK KP_BLOB 0xFD46 0 2 /end IF_DATA BIT_MASK 0x100 /end MEASUREMENT
/begin MEASUREMENT B_dknot "Bedingung DK-Poti-Notfahren aktiv" UWORD B_TRUE___UW 0 0 0.000000 0.000000 /begin IF_DATA ASAP1B_ETK KP_BLOB 0xFD46 0 2 /end IF_DATA BIT_MASK 0x200 /end MEASUREMENT
/begin MEASUREMENT B_dkp1e "Bedingung Fehler DK-Poti 1" UWORD B_TRUE___UW 0 0 0.000000 0.000000 /begin IF_DATA ASAP1B_ETK KP_BLOB 0xFD3C 0 2 /end IF_DATA BIT_MASK 0x8000 /end MEASUREMENT
/begin MEASUREMENT B_dkp2e "Bedingung Fehler DK-Poti 2" UWORD B_TRUE___UW 0 0 0.000000 0.000000 /begin IF_DATA ASAP1B_ETK KP_BLOB 0xFD3E 0 2 /end IF_DATA BIT_MASK 0x10 /end MEASUREMENT
/begin MEASUREMENT B_dkpiu "Bedingung: irreversible SKA" UWORD B_TRUE___UW 0 0 0.000000 0.000000 /begin IF_DATA ASAP1B_ETK KP_BLOB 0xFD46 0 2 /end IF_DATA BIT_MASK 0x400 /end MEASUREMENT
/begin MEASUREMENT B_dkpu "Bedingung Sicherheitskraftstoffabschaltung (SKA)" UWORD B_TRUE___UW 0 0 0.000000 0.000000 /begin IF_DATA ASAP1B_ETK KP_BLOB 0xFD46 0 2 /end IF_DATA BIT_MASK 0x1000 /end MEASUREMENT
/begin MEASUREMENT B_dkuevab "Bedingung Ev-Abschaltung bei unplausibler DK" UWORD B_TRUE___UW 0 0 0.000000 0.000000 /begin IF_DATA ASAP1B_ETK KP_BLOB 0xFD5C 0 2 /end IF_DATA BIT_MASK 0x8 /end MEASUREMENT
/begin MEASUREMENT B_dldpte "Anforderung TEV schlie·en aus TankentlÅftungsdiagnose" UWORD B_TRUE___UW 0 0 0.000000 0.000000 /begin IF_DATA ASAP1B_ETK KP_BLOB 0xFD92 0 2 /end IF_DATA BIT_MASK 0x100 /end MEASUREMENT
/begin MEASUREMENT B_dlrbe "Bedingung: DLR-Stellbereich wurde Åberschritten" UWORD B_TRUE___UW 0 0 0.000000 0.000000 /begin IF_DATA ASAP1B_ETK KP_BLOB 0xFD44 0 2 /end IF_DATA BIT_MASK 0x20 /end MEASUREMENT
/begin MEASUREMENT B_dlrikla "Bedingung: DLR, I-Klein aktiv" UWORD B_TRUE___UW 0 0 0.000000 0.000000 /begin IF_DATA ASAP1B_ETK KP_BLOB 0xFD44 0 2 /end IF_DATA BIT_MASK 0x40 /end MEASUREMENT
/begin MEASUREMENT B_dlriklst "Bedingung: Erster Durchlauf I-Klein nach Start" UWORD B_TRUE___UW 0 0 0.000000 0.000000 /begin IF_DATA ASAP1B_ETK KP_BLOB 0xFD44 0 2 /end IF_DATA BIT_MASK 0x80 /end MEASUREMENT
/begin MEASUREMENT B_dlrparc "Bedingung: Sollgrî·ensprung steht an" UWORD B_TRUE___UW 0 0 0.000000 0.000000 /begin IF_DATA ASAP1B_ETK KP_BLOB 0xFD44 0 2 /end IF_DATA BIT_MASK 0x100 /end MEASUREMENT
/begin MEASUREMENT B_dlrpide "Bedingung: Fehler, DLR-Stellbereich am Anschlag" UWORD B_TRUE___UW 0 0 0.000000 0.000000 /begin IF_DATA ASAP1B_ETK KP_BLOB 0xFD44 0 2 /end IF_DATA BIT_MASK 0x200 /end MEASUREMENT
/begin MEASUREMENT B_dlrspid "Bedingung: DLR, Vorzeichen der Summe der PID-Anteile, =1: positiv, =0: negativ" UWORD B_TRUE___UW 0 0 0.000000 0.000000 /begin IF_DATA ASAP1B_ETK KP_BLOB 0xFD44 0 2 /end IF_DATA BIT_MASK 0x400 /end MEASUREMENT
/begin MEASUREMENT B_dlrumzu "Bedingung: NLP-Umladen zugelassen" UWORD B_TRUE___UW 0 0 0.000000 0.000000 /begin IF_DATA ASAP1B_ETK KP_BLOB 0xFD44 0 2 /end IF_DATA BIT_MASK 0x800 /end MEASUREMENT
/begin MEASUREMENT B_dls "Bedingung DLS-Funktion aktiv" UWORD B_TRUE___UW 0 0 0.000000 0.000000 /begin IF_DATA ASAP1B_ETK KP_BLOB 0xFD9E 0 2 /end IF_DATA BIT_MASK 0x80 /end MEASUREMENT
/begin MEASUREMENT B_dmtltz "Bedingung TEV soll geschlossen werden" UWORD B_TRUE___UW 0 0 0.000000 0.000000 /begin IF_DATA ASAP1B_ETK KP_BLOB 0xFD06 0 2 /end IF_DATA BIT_MASK 0x1000 /end MEASUREMENT
/begin MEASUREMENT B_dnn "Bedingung Drehzahlabweichung negativ, nsol<n" UWORD B_TRUE___UW 0 0 0.000000 0.000000 /begin IF_DATA ASAP1B_ETK KP_BLOB 0xFD9E 0 2 /end IF_DATA BIT_MASK 0x100 /end MEASUREMENT
/begin MEASUREMENT B_dnsll "Bedingung SA-Drehzahl-Hysterese DNSLL" UBYTE B_TRUE 0 0 0.000000 0.000000 /begin IF_DATA ASAP1B_ETK KP_BLOB 0x380C0E 1 1 /end IF_DATA BIT_MASK 0x1 /end MEASUREMENT
/begin MEASUREMENT B_dopzue "Bedingung doppelte ZÅndausgabe" UWORD B_TRUE___UW 0 0 0.000000 0.000000 /begin IF_DATA ASAP1B_ETK KP_BLOB 0xFD06 0 2 /end IF_DATA BIT_MASK 0x2000 /end MEASUREMENT
/begin MEASUREMENT B_dopzue_i "" UWORD B_TRUE___UW 0 0 0.000000 0.000000 /begin IF_DATA ASAP1B_ETK KP_BLOB 0xFD04 0 2 /end IF_DATA BIT_MASK 0x8000 /end MEASUREMENT
/begin MEASUREMENT B_dsla "Adaptionsphase: Bestimmung SekundÑrluftmasse" UWORD B_TRUE___UW 0 0 0.000000 0.000000 /begin IF_DATA ASAP1B_ETK KP_BLOB 0xFD0A 0 2 /end IF_DATA BIT_MASK 0x8000 /end MEASUREMENT
/begin MEASUREMENT B_dsls "Aktive Diagnose: SekundÑrluft-System" UWORD B_TRUE___UW 0 0 0.000000 0.000000 /begin IF_DATA ASAP1B_ETK KP_BLOB 0xFD0C 0 2 /end IF_DATA BIT_MASK 0x2 /end MEASUREMENT
/begin MEASUREMENT B_dslvh "Bedingung Ladedrucksensor vorhanden" UWORD B_TRUE___UW 0 0 0.000000 0.000000 /begin IF_DATA ASAP1B_ETK KP_BLOB 0xFD00 0 2 /end IF_DATA BIT_MASK 0x100 /end MEASUREMENT
/begin MEASUREMENT B_dssv "Bedingung Saugrohr-Drucksensor vorhanden als Hauptlastsensor" UWORD B_TRUE___UW 0 0 0.000000 0.000000 /begin IF_DATA ASAP1B_ETK KP_BLOB 0xFD00 0 2 /end IF_DATA BIT_MASK 0x200 /end MEASUREMENT
/begin MEASUREMENT B_dsuv "Umgebungsdrucksensor ist vorhanden" UWORD B_TRUE___UW 0 0 0.000000 0.000000 /begin IF_DATA ASAP1B_ETK KP_BLOB 0xFD00 0 2 /end IF_DATA BIT_MASK 0x800 /end MEASUREMENT
/begin MEASUREMENT B_dtes "Aktive Diagnose: TankentlÅftungssystem" UWORD B_TRUE___UW 0 0 0.000000 0.000000 /begin IF_DATA ASAP1B_ETK KP_BLOB 0xFD8C 0 2 /end IF_DATA BIT_MASK 0x800 /end MEASUREMENT
/begin MEASUREMENT B_dveada "Bedingung: DV-E-Adaption sperrt Einspritzung" UWORD B_TRUE___UW 0 0 0.000000 0.000000 /begin IF_DATA ASAP1B_ETK KP_BLOB 0xFD40 0 2 /end IF_DATA BIT_MASK 0x80 /end MEASUREMENT
/begin MEASUREMENT B_dveese "Bedingung: DV-E-Endstufen-Fehler" UWORD B_TRUE___UW 0 0 0.000000 0.000000 /begin IF_DATA ASAP1B_ETK KP_BLOB 0xFD44 0 2 /end IF_DATA BIT_MASK 0x1000 /end MEASUREMENT
/begin MEASUREMENT B_dveesh "Bedingung: DV-E-Enstufen-Heilung" UWORD B_TRUE___UW 0 0 0.000000 0.000000 /begin IF_DATA ASAP1B_ETK KP_BLOB 0xFD44 0 2 /end IF_DATA BIT_MASK 0x2000 /end MEASUREMENT
/begin MEASUREMENT B_dveeson "Bedingung: DV-E-Endstufe ist eingeschaltet = P_dveeson" UWORD B_TRUE___UW 0 0 0.000000 0.000000 /begin IF_DATA ASAP1B_ETK KP_BLOB 0xFD6A 0 2 /end IF_DATA BIT_MASK 0x1000 /end MEASUREMENT
/begin MEASUREMENT B_dvete "Bedingung: Erweiterte Stellertauscherkennung" UWORD B_TRUE___UW 0 0 0.000000 0.000000 /begin IF_DATA ASAP1B_ETK KP_BLOB 0xFD44 0 2 /end IF_DATA BIT_MASK 0x4000 /end MEASUREMENT
/begin MEASUREMENT B_dvetv "Bedingung: Verriegelungsbit erweiterte Stellertauscherkennung" UWORD B_TRUE___UW 0 0 0.000000 0.000000 /begin IF_DATA ASAP1B_ETK KP_BLOB 0xFD40 0 2 /end IF_DATA BIT_MASK 0x100 /end MEASUREMENT
/begin MEASUREMENT B_dzai "" UWORD B_TRUE___UW 0 0 0.000000 0.000000 /begin IF_DATA ASAP1B_ETK KP_BLOB 0xFD06 0 2 /end IF_DATA BIT_MASK 0x1 /end MEASUREMENT
/begin MEASUREMENT B_edkvs "Bedingung Adaptionsfehlerschwellen aktuell Åberschritten" UWORD B_TRUE___UW 0 0 0.000000 0.000000 /begin IF_DATA ASAP1B_ETK KP_BLOB 0xFD64 0 2 /end IF_DATA BIT_MASK 0x4000 /end MEASUREMENT
/begin MEASUREMENT B_ekp "Freigabe der EKP-Versorgung" UWORD B_TRUE___UW 0 0 0.000000 0.000000 /begin IF_DATA ASAP1B_ETK KP_BLOB 0xFDA6 0 2 /end IF_DATA BIT_MASK 0x200 /end MEASUREMENT
/begin MEASUREMENT B_ekpd "Bedingung EKP Dauerbetrieb" UBYTE B_TRUE 0 0 0.000000 0.000000 /begin IF_DATA ASAP1B_ETK KP_BLOB 0x380D2D 1 1 /end IF_DATA BIT_MASK 0x8 /end MEASUREMENT
/begin MEASUREMENT B_ekpn "Bedingung EKP-Einschaltbedingung Drehzahl erfÅllt" UBYTE B_TRUE 0 0 0.000000 0.000000 /begin IF_DATA ASAP1B_ETK KP_BLOB 0x380D2D 1 1 /end IF_DATA BIT_MASK 0x10 /end MEASUREMENT
/begin MEASUREMENT B_ekpubn "Bedingung EKP-Einschaltbedingung UBatt-Einbruch und Zahnsignal erfÅllt" UBYTE B_TRUE 0 0 0.000000 0.000000 /begin IF_DATA ASAP1B_ETK KP_BLOB 0x380D2D 1 1 /end IF_DATA BIT_MASK 0x20 /end MEASUREMENT
/begin MEASUREMENT B_ekpvl "Bedingung EKP-Vorlauf" UBYTE B_TRUE 0 0 0.000000 0.000000 /begin IF_DATA ASAP1B_ETK KP_BLOB 0x380D2D 1 1 /end IF_DATA BIT_MASK 0x40 /end MEASUREMENT
/begin MEASUREMENT B_enabale "Bedingung: Freigabe zur Berechnung der Motorabstellposition" UWORD B_TRUE___UW 0 0 0.000000 0.000000 /begin IF_DATA ASAP1B_ETK KP_BLOB 0xFD1C 0 2 /end IF_DATA BIT_MASK 0x4000 /end MEASUREMENT
/begin MEASUREMENT B_encifi "" UWORD B_TRUE___UW 0 0 0.000000 0.000000 /begin IF_DATA ASAP1B_ETK KP_BLOB 0xFD48 0 2 /end IF_DATA BIT_MASK 0x200 /end MEASUREMENT
/begin MEASUREMENT B_evabu "Bedingung Ev-Abschaltung durch öberwachungsfunktionen" UWORD B_TRUE___UW 0 0 0.000000 0.000000 /begin IF_DATA ASAP1B_ETK KP_BLOB 0xFD5C 0 2 /end IF_DATA BIT_MASK 0x10 /end MEASUREMENT
/begin MEASUREMENT B_evasel "Status alle fÅr DASE relevant. lokalen Einspritzventile d. SG werden angesteuert" UWORD B_TRUE___UW 0 0 0.000000 0.000000 /begin IF_DATA ASAP1B_ETK KP_BLOB 0xFD5C 0 2 /end IF_DATA BIT_MASK 0x20 /end MEASUREMENT
/begin MEASUREMENT B_evloc "Status alle lokalen Einspritzventile werden angesteuert, = B_EVTOT bei einen SG" UWORD B_TRUE___UW 0 0 0.000000 0.000000 /begin IF_DATA ASAP1B_ETK KP_BLOB 0xFD5C 0 2 /end IF_DATA BIT_MASK 0x40 /end MEASUREMENT
/begin MEASUREMENT B_fa "Bedingung Funktionsanforderung allgemein" UWORD B_TRUE___UW 0 0 0.000000 0.000000 /begin IF_DATA ASAP1B_ETK KP_BLOB 0xFD74 0 2 /end IF_DATA BIT_MASK 0x100 /end MEASUREMENT
/begin MEASUREMENT B_faatm "Bedingung Funktionsanforderung kurze Taupunktendezeiten" UWORD B_TRUE___UW 0 0 0.000000 0.000000 /begin IF_DATA ASAP1B_ETK KP_BLOB 0xFD74 0 2 /end IF_DATA BIT_MASK 0x800 /end MEASUREMENT
/begin MEASUREMENT B_faevz "Bedingung Zylinderausblendung durch Tester" UWORD B_TRUE___UW 0 0 0.000000 0.000000 /begin IF_DATA ASAP1B_ETK KP_BLOB 0xFD84 0 2 /end IF_DATA BIT_MASK 0x100 /end MEASUREMENT
/begin MEASUREMENT B_fakd "Bedingung Funktionsanforderung Kick-Down-Adaption" UWORD B_TRUE___UW 0 0 0.000000 0.000000 /begin IF_DATA ASAP1B_ETK KP_BLOB 0xFD74 0 2 /end IF_DATA BIT_MASK 0x8000 /end MEASUREMENT
/begin MEASUREMENT B_fasla "Bedingung: externe Anforderung an SekundÑrluft aktiv" UWORD B_TRUE___UW 0 0 0.000000 0.000000 /begin IF_DATA ASAP1B_ETK KP_BLOB 0xFD0A 0 2 /end IF_DATA BIT_MASK 0x10 /end MEASUREMENT
/begin MEASUREMENT B_fgr "Bedingung FGR (Tempomat) aktiv" UWORD B_TRUE___UW 0 0 0.000000 0.000000 /begin IF_DATA ASAP1B_ETK KP_BLOB 0xFD7E 0 2 /end IF_DATA BIT_MASK 0x400 /end MEASUREMENT
/begin MEASUREMENT B_fgrab "FGR-/ACC-Abschaltung aus der Funktion" UWORD B_TRUE___UW 0 0 0.000000 0.000000 /begin IF_DATA ASAP1B_ETK KP_BLOB 0xFD4C 0 2 /end IF_DATA BIT_MASK 0x4000 /end MEASUREMENT
/begin MEASUREMENT B_fgrabz "Bedingung zusÑtzliche FGR-Abschaltung" UWORD B_TRUE___UW 0 0 0.000000 0.000000 /begin IF_DATA ASAP1B_ETK KP_BLOB 0xFD10 0 2 /end IF_DATA BIT_MASK 0x2 /end MEASUREMENT
/begin MEASUREMENT B_fgrai "Bedingung FGR-Abschaltung irreversibel" UWORD B_TRUE___UW 0 0 0.000000 0.000000 /begin IF_DATA ASAP1B_ETK KP_BLOB 0xFD4C 0 2 /end IF_DATA BIT_MASK 0x8000 /end MEASUREMENT
/begin MEASUREMENT B_fgral "Bedingung FGR-Abschaltung langsam" UBYTE B_TRUE 0 0 0.000000 0.000000 /begin IF_DATA ASAP1B_ETK KP_BLOB 0x380AE0 1 1 /end IF_DATA BIT_MASK 0x1 /end MEASUREMENT
/begin MEASUREMENT B_fgrars "Bedingung: FGR-Abschaltung reversibel schnell" UBYTE B_TRUE 0 0 0.000000 0.000000 /begin IF_DATA ASAP1B_ETK KP_BLOB 0x380AE0 1 1 /end IF_DATA BIT_MASK 0x2 /end MEASUREMENT
/begin MEASUREMENT B_fgras "Bedingung: FGR-Abschaltung schnell" UWORD B_TRUE___UW 0 0 0.000000 0.000000 /begin IF_DATA ASAP1B_ETK KP_BLOB 0xFD4E 0 2 /end IF_DATA BIT_MASK 0x1 /end MEASUREMENT
/begin MEASUREMENT B_fgrat "Bedingung: Tip-Schalter Aus am FGR-Bedienteil betÑtigt" UWORD B_TRUE___UW 0 0 0.000000 0.000000 /begin IF_DATA ASAP1B_ETK KP_BLOB 0xFD3A 0 2 /end IF_DATA BIT_MASK 0x800 /end MEASUREMENT
/begin MEASUREMENT B_fgren "Bedingung Fahrgeschwindigkeitsregelung aktiv (Enable)" UWORD B_TRUE___UW 0 0 0.000000 0.000000 /begin IF_DATA ASAP1B_ETK KP_BLOB 0xFD54 0 2 /end IF_DATA BIT_MASK 0x10 /end MEASUREMENT
/begin MEASUREMENT B_fgrenv "Bedingung FGR-Regelung aktiv (Enable) vorlÑufig" UWORD B_TRUE___UW 0 0 0.000000 0.000000 /begin IF_DATA ASAP1B_ETK KP_BLOB 0xFD4E 0 2 /end IF_DATA BIT_MASK 0x2 /end MEASUREMENT
/begin MEASUREMENT B_fgres "Bedingung FGR-Einschaltung" UBYTE B_TRUE 0 0 0.000000 0.000000 /begin IF_DATA ASAP1B_ETK KP_BLOB 0x380AE0 1 1 /end IF_DATA BIT_MASK 0x4 /end MEASUREMENT
/begin MEASUREMENT B_fgresv "Bedingung FGR-Einschaltgeschwindigkeit erreicht" UWORD B_TRUE___UW 0 0 0.000000 0.000000 /begin IF_DATA ASAP1B_ETK KP_BLOB 0xFD4E 0 2 /end IF_DATA BIT_MASK 0x4 /end MEASUREMENT
/begin MEASUREMENT B_fgrhe "Bedingung: FGR-Bedienteil-Fehler" UWORD B_TRUE___UW 0 0 0.000000 0.000000 /begin IF_DATA ASAP1B_ETK KP_BLOB 0xFD3A 0 2 /end IF_DATA BIT_MASK 0x4000 /end MEASUREMENT
/begin MEASUREMENT B_fgrhsa "Bedingung: FGR-Hauptschalter aus" UWORD B_TRUE___UW 0 0 0.000000 0.000000 /begin IF_DATA ASAP1B_ETK KP_BLOB 0xFD3C 0 2 /end IF_DATA BIT_MASK 0x2 /end MEASUREMENT
/begin MEASUREMENT B_fgrkf "Bedingung: FGR im Zustand Konstantfahrt" UWORD B_TRUE___UW 0 0 0.000000 0.000000 /begin IF_DATA ASAP1B_ETK KP_BLOB 0xFD54 0 2 /end IF_DATA BIT_MASK 0x20 /end MEASUREMENT
/begin MEASUREMENT B_fgrtbe "Bedingung: FGR-Taste Beschleunigen" UWORD B_TRUE___UW 0 0 0.000000 0.000000 /begin IF_DATA ASAP1B_ETK KP_BLOB 0xFD3C 0 2 /end IF_DATA BIT_MASK 0x8 /end MEASUREMENT
/begin MEASUREMENT B_fgrtse "Bedingung: FGR-Taste-Setzen" UWORD B_TRUE___UW 0 0 0.000000 0.000000 /begin IF_DATA ASAP1B_ETK KP_BLOB 0xFD3C 0 2 /end IF_DATA BIT_MASK 0x10 /end MEASUREMENT
/begin MEASUREMENT B_fgrtve "Bedingung: FGR-Taste Verzîgern" UWORD B_TRUE___UW 0 0 0.000000 0.000000 /begin IF_DATA ASAP1B_ETK KP_BLOB 0xFD3C 0 2 /end IF_DATA BIT_MASK 0x20 /end MEASUREMENT
/begin MEASUREMENT B_fgrtwa "Bedingung: FGR-Taste Wiederaufnahme" UWORD B_TRUE___UW 0 0 0.000000 0.000000 /begin IF_DATA ASAP1B_ETK KP_BLOB 0xFD3C 0 2 /end IF_DATA BIT_MASK 0x40 /end MEASUREMENT
/begin MEASUREMENT B_fgr_um "FGR-/ACC-Momenteneingriff in der FunktionsÅberwachung erlaubt" UWORD B_TRUE___UW 0 0 0.000000 0.000000 /begin IF_DATA ASAP1B_ETK KP_BLOB 0xFD86 0 2 /end IF_DATA BIT_MASK 0x8 /end MEASUREMENT
/begin MEASUREMENT B_fkmsdks "Integratorstop fkmsdk" UWORD B_TRUE___UW 0 0 0.000000 0.000000 /begin IF_DATA ASAP1B_ETK KP_BLOB 0xFD58 0 2 /end IF_DATA BIT_MASK 0x2000 /end MEASUREMENT
/begin MEASUREMENT B_fkmsmn "schnelle Massenstromadaption fkmsdks im unteren Anschlag" UWORD B_TRUE___UW 0 0 0.000000 0.000000 /begin IF_DATA ASAP1B_ETK KP_BLOB 0xFD56 0 2 /end IF_DATA BIT_MASK 0x80 /end MEASUREMENT
/begin MEASUREMENT B_fkmsmx "schnelle Massenstromadaption fkmsdks im oberen Anschlag" UWORD B_TRUE___UW 0 0 0.000000 0.000000 /begin IF_DATA ASAP1B_ETK KP_BLOB 0xFD56 0 2 /end IF_DATA BIT_MASK 0x100 /end MEASUREMENT
/begin MEASUREMENT B_fkpvdk "Bedingung fÅr die Freigabe des langsamen multiplikativen FÅllungsabgleichs" UWORD B_TRUE___UW 0 0 0.000000 0.000000 /begin IF_DATA ASAP1B_ETK KP_BLOB 0xFD56 0 2 /end IF_DATA BIT_MASK 0x200 /end MEASUREMENT
/begin MEASUREMENT B_fkpvmn "langsame Massenstromadaption fkpvdk im unteren Anschlag" UWORD B_TRUE___UW 0 0 0.000000 0.000000 /begin IF_DATA ASAP1B_ETK KP_BLOB 0xFD56 0 2 /end IF_DATA BIT_MASK 0x400 /end MEASUREMENT
/begin MEASUREMENT B_fkpvmx "langsame Massenstromadaption fkpvdk im oberen Anschlag" UWORD B_TRUE___UW 0 0 0.000000 0.000000 /begin IF_DATA ASAP1B_ETK KP_BLOB 0xFD56 0 2 /end IF_DATA BIT_MASK 0x800 /end MEASUREMENT
/begin MEASUREMENT B_fprakt "DK-RÅckstellfeder-PrÅfung aktiv" UWORD B_TRUE___UW 0 0 0.000000 0.000000 /begin IF_DATA ASAP1B_ETK KP_BLOB 0xFD40 0 2 /end IF_DATA BIT_MASK 0x200 /end MEASUREMENT
/begin MEASUREMENT B_fproab "Bedingung: DV-E-PrÅfung îffnende Feder Abbruch, Feder îffnet nicht" UWORD B_TRUE___UW 0 0 0.000000 0.000000 /begin IF_DATA ASAP1B_ETK KP_BLOB 0xFD40 0 2 /end IF_DATA BIT_MASK 0x400 /end MEASUREMENT
/begin MEASUREMENT B_fproe "Bedingung: ôffnende FederprÅfung Fehler" UWORD B_TRUE___UW 0 0 0.000000 0.000000 /begin IF_DATA ASAP1B_ETK KP_BLOB 0xFD40 0 2 /end IF_DATA BIT_MASK 0x800 /end MEASUREMENT
/begin MEASUREMENT B_fprook "Bedingung: îffnende FederprÅfung i.O." UWORD B_TRUE___UW 0 0 0.000000 0.000000 /begin IF_DATA ASAP1B_ETK KP_BLOB 0xFD40 0 2 /end IF_DATA BIT_MASK 0x1000 /end MEASUREMENT
/begin MEASUREMENT B_fprordy "Bedingung: ôffnende FederprÅfung fertig" UWORD B_TRUE___UW 0 0 0.000000 0.000000 /begin IF_DATA ASAP1B_ETK KP_BLOB 0xFD40 0 2 /end IF_DATA BIT_MASK 0x2000 /end MEASUREMENT
/begin MEASUREMENT B_fprovb "Bedingung: ôffnende FederprÅfung verboten" UWORD B_TRUE___UW 0 0 0.000000 0.000000 /begin IF_DATA ASAP1B_ETK KP_BLOB 0xFD40 0 2 /end IF_DATA BIT_MASK 0x4000 /end MEASUREMENT
/begin MEASUREMENT B_fprrdy "DK-RÅckstellfeder-PrÅfung beendet" UWORD B_TRUE___UW 0 0 0.000000 0.000000 /begin IF_DATA ASAP1B_ETK KP_BLOB 0xFD40 0 2 /end IF_DATA BIT_MASK 0x8000 /end MEASUREMENT
/begin MEASUREMENT B_fprzab "Bedingung: DV-E-RÅckstellfederprÅfung Abbruch, Feder schlie·t nicht" UWORD B_TRUE___UW 0 0 0.000000 0.000000 /begin IF_DATA ASAP1B_ETK KP_BLOB 0xFD42 0 2 /end IF_DATA BIT_MASK 0x1 /end MEASUREMENT
/begin MEASUREMENT B_fprze "Bedingung: Fehler in der DV-E-RÅckstellfederprÅfung" UWORD B_TRUE___UW 0 0 0.000000 0.000000 /begin IF_DATA ASAP1B_ETK KP_BLOB 0xFD42 0 2 /end IF_DATA BIT_MASK 0x2 /end MEASUREMENT
/begin MEASUREMENT B_fprzok "Bedingung: DV-E-RÅckstellfederprÅfung i.O." UWORD B_TRUE___UW 0 0 0.000000 0.000000 /begin IF_DATA ASAP1B_ETK KP_BLOB 0xFD42 0 2 /end IF_DATA BIT_MASK 0x4 /end MEASUREMENT
/begin MEASUREMENT B_fprzvb "Bedingung: DV-E-RÅckstellfederprÅfung verboten" UWORD B_TRUE___UW 0 0 0.000000 0.000000 /begin IF_DATA ASAP1B_ETK KP_BLOB 0xFD42 0 2 /end IF_DATA BIT_MASK 0x8 /end MEASUREMENT
/begin MEASUREMENT B_frao "Einschaltbedingung fÅr Adaption von frao" UWORD B_TRUE___UW 0 0 0.000000 0.000000 /begin IF_DATA ASAP1B_ETK KP_BLOB 0xFD5E 0 2 /end IF_DATA BIT_MASK 0x40 /end MEASUREMENT
/begin MEASUREMENT B_fraoan "Anforderung TEV schnell schlie·en zur Aktivierung der Gemischadaption" UWORD B_TRUE___UW 0 0 0.000000 0.000000 /begin IF_DATA ASAP1B_ETK KP_BLOB 0xFD60 0 2 /end IF_DATA BIT_MASK 0x2000 /end MEASUREMENT
/begin MEASUREMENT B_fs "Bedingung Fahrstufe" UWORD B_TRUE___UW 0 0 0.000000 0.000000 /begin IF_DATA ASAP1B_ETK KP_BLOB 0xFD3A 0 2 /end IF_DATA BIT_MASK 0x200 /end MEASUREMENT
/begin MEASUREMENT B_gae "Bedingung Grundadaption eingeschwungen" UWORD B_TRUE___UW 0 0 0.000000 0.000000 /begin IF_DATA ASAP1B_ETK KP_BLOB 0xFD66 0 2 /end IF_DATA BIT_MASK 0x10 /end MEASUREMENT
/begin MEASUREMENT B_gaefra "Bedingung Grundadaption (fra-Integrator) eingeschwungen" UWORD B_TRUE___UW 0 0 0.000000 0.000000 /begin IF_DATA ASAP1B_ETK KP_BLOB 0xFD66 0 2 /end IF_DATA BIT_MASK 0x20 /end MEASUREMENT
/begin MEASUREMENT B_gap "Bedingung Gemischadaptionsphase aktiv" UWORD B_TRUE___UW 0 0 0.000000 0.000000 /begin IF_DATA ASAP1B_ETK KP_BLOB 0xFD60 0 2 /end IF_DATA BIT_MASK 0x4000 /end MEASUREMENT
/begin MEASUREMENT B_gasp "; 1 = Gemischadaption gesperrt" UWORD B_TRUE___UW 0 0 0.000000 0.000000 /begin IF_DATA ASAP1B_ETK KP_BLOB 0xFD62 0 2 /end IF_DATA BIT_MASK 0x200 /end MEASUREMENT
/begin MEASUREMENT B_grdst "Bedingung Grundeinstellung" UWORD B_TRUE___UW 0 0 0.000000 0.000000 /begin IF_DATA ASAP1B_ETK KP_BLOB 0xFD76 0 2 /end IF_DATA BIT_MASK 0x4000 /end MEASUREMENT
/begin MEASUREMENT B_gwhs "Bedingung Gangwechsel bei Handschalter" UWORD B_TRUE___UW 0 0 0.000000 0.000000 /begin IF_DATA ASAP1B_ETK KP_BLOB 0xFD3A 0 2 /end IF_DATA BIT_MASK 0x400 /end MEASUREMENT
/begin MEASUREMENT B_hag "Bedingung Hîhenadaption gÅltig" UWORD B_TRUE___UW 0 0 0.000000 0.000000 /begin IF_DATA ASAP1B_ETK KP_BLOB 0xFD56 0 2 /end IF_DATA BIT_MASK 0x2000 /end MEASUREMENT
/begin MEASUREMENT B_hfm "Bedingung HFM messbereit" UWORD B_TRUE___UW 0 0 0.000000 0.000000 /begin IF_DATA ASAP1B_ETK KP_BLOB 0xFD56 0 2 /end IF_DATA BIT_MASK 0x40 /end MEASUREMENT
/begin MEASUREMENT B_hpnmot "Bedingung Hochpunkt Drehzahlschwingung" UWORD B_TRUE___UW 0 0 0.000000 0.000000 /begin IF_DATA ASAP1B_ETK KP_BLOB 0xFD7E 0 2 /end IF_DATA BIT_MASK 0x1 /end MEASUREMENT
/begin MEASUREMENT B_iklrest "Bedingung: Retriggerung I-Klein" UWORD B_TRUE___UW 0 0 0.000000 0.000000 /begin IF_DATA ASAP1B_ETK KP_BLOB 0xFD44 0 2 /end IF_DATA BIT_MASK 0x8000 /end MEASUREMENT
/begin MEASUREMENT B_iklstar "Bedingung: I-Klein soll starten" UWORD B_TRUE___UW 0 0 0.000000 0.000000 /begin IF_DATA ASAP1B_ETK KP_BLOB 0xFD46 0 2 /end IF_DATA BIT_MASK 0x1 /end MEASUREMENT
/begin MEASUREMENT B_imlprini "Initialisierung imlpr/imlpr_w" UWORD B_TRUE___UW 0 0 0.000000 0.000000 /begin IF_DATA ASAP1B_ETK KP_BLOB 0x382112 1 2 /end IF_DATA BIT_MASK 0x200 /end MEASUREMENT
/begin MEASUREMENT B_iniar "Bedingung Initialisierung der AR-Funktion" UWORD B_TRUE___UW 0 0 0.000000 0.000000 /begin IF_DATA ASAP1B_ETK KP_BLOB 0xFD7E 0 2 /end IF_DATA BIT_MASK 0x2 /end MEASUREMENT
/begin MEASUREMENT B_iniarv "Bedingung Initialisierung der Filterfunktion verzîgert" UWORD B_TRUE___UW 0 0 0.000000 0.000000 /begin IF_DATA ASAP1B_ETK KP_BLOB 0xFD7E 0 2 /end IF_DATA BIT_MASK 0x4 /end MEASUREMENT
/begin MEASUREMENT B_i_ska_um "Fehlerreaktion irrev. SKA (Sicherheitskraftstoffabschaltg) vom öberwachungsmodul" UWORD B_TRUE___UW 0 0 0.000000 0.000000 /begin IF_DATA ASAP1B_ETK KP_BLOB 0xFD84 0 2 /end IF_DATA BIT_MASK 0x400 /end MEASUREMENT
/begin MEASUREMENT B_katfz "Bedingung Kat in Fahrzeug eingebaut" UWORD B_TRUE___UW 0 0 0.000000 0.000000 /begin IF_DATA ASAP1B_ETK KP_BLOB 0xFD00 0 2 /end IF_DATA BIT_MASK 0x4000 /end MEASUREMENT
/begin MEASUREMENT B_kd "Kick-Down" UBYTE B_TRUE 0 0 0.000000 0.000000 /begin IF_DATA ASAP1B_ETK KP_BLOB 0x380ABB 1 1 /end IF_DATA BIT_MASK 0x1 /end MEASUREMENT
/begin MEASUREMENT B_kdpos "Bedingung Kick-Down-Position wÑhrend Lernvorgang erreicht" UBYTE B_TRUE 0 0 0.000000 0.000000 /begin IF_DATA ASAP1B_ETK KP_BLOB 0x380ABB 1 1 /end IF_DATA BIT_MASK 0x40 /end MEASUREMENT
/begin MEASUREMENT B_kh "Bedingung Kat-Heizung" UWORD B_TRUE___UW 0 0 0.000000 0.000000 /begin IF_DATA ASAP1B_ETK KP_BLOB 0xFD6E 0 2 /end IF_DATA BIT_MASK 0x1 /end MEASUREMENT
/begin MEASUREMENT B_kha "Anforderung Katheizen" UWORD B_TRUE___UW 0 0 0.000000 0.000000 /begin IF_DATA ASAP1B_ETK KP_BLOB 0xFD6E 0 2 /end IF_DATA BIT_MASK 0x2 /end MEASUREMENT
/begin MEASUREMENT B_khab "Bedingung Katheizen Abbruch" UWORD B_TRUE___UW 0 0 0.000000 0.000000 /begin IF_DATA ASAP1B_ETK KP_BLOB 0xFD6E 0 2 /end IF_DATA BIT_MASK 0x4 /end MEASUREMENT
/begin MEASUREMENT B_khares "Bedingung RÅcksetzen von Bit B_kha" UWORD B_TRUE___UW 0 0 0.000000 0.000000 /begin IF_DATA ASAP1B_ETK KP_BLOB 0x382112 1 2 /end IF_DATA BIT_MASK 0x40 /end MEASUREMENT
/begin MEASUREMENT B_khaset "Bedingung Setzen von Bit B_kha" UWORD B_TRUE___UW 0 0 0.000000 0.000000 /begin IF_DATA ASAP1B_ETK KP_BLOB 0x382112 1 2 /end IF_DATA BIT_MASK 0x20 /end MEASUREMENT
/begin MEASUREMENT B_kherr "Fehler bedingte Sperrbedingung fÅr Bit B_kh" UWORD B_TRUE___UW 0 0 0.000000 0.000000 /begin IF_DATA ASAP1B_ETK KP_BLOB 0x382112 1 2 /end IF_DATA BIT_MASK 0x100 /end MEASUREMENT
/begin MEASUREMENT B_khll "Bedingung Katheizen Leerlauf (Abbruchbedingung)" UWORD B_TRUE___UW 0 0 0.000000 0.000000 /begin IF_DATA ASAP1B_ETK KP_BLOB 0x382112 1 2 /end IF_DATA BIT_MASK 0x4 /end MEASUREMENT
/begin MEASUREMENT B_khlle "Bedingung Leerlauf wÑhrend Katheizen verlassen" UWORD B_TRUE___UW 0 0 0.000000 0.000000 /begin IF_DATA ASAP1B_ETK KP_BLOB 0x382112 1 2 /end IF_DATA BIT_MASK 0x1 /end MEASUREMENT
/begin MEASUREMENT B_khllmx "Bedingung max. Katheitzeit im Leerlauf erreicht" UWORD B_TRUE___UW 0 0 0.000000 0.000000 /begin IF_DATA ASAP1B_ETK KP_BLOB 0x382112 1 2 /end IF_DATA BIT_MASK 0x2 /end MEASUREMENT
/begin MEASUREMENT B_khn "Bedingung Katheiz-Drehzahl" UBYTE B_TRUE 0 0 0.000000 0.000000 /begin IF_DATA ASAP1B_ETK KP_BLOB 0x380B63 1 1 /end IF_DATA BIT_MASK 0x1 /end MEASUREMENT
/begin MEASUREMENT B_khres "Bedingung RÅcksetzen von Bit B_kh" UWORD B_TRUE___UW 0 0 0.000000 0.000000 /begin IF_DATA ASAP1B_ETK KP_BLOB 0x382112 1 2 /end IF_DATA BIT_MASK 0x10 /end MEASUREMENT
/begin MEASUREMENT B_khset "Bedingung Setzen von Bit B_kh" UWORD B_TRUE___UW 0 0 0.000000 0.000000 /begin IF_DATA ASAP1B_ETK KP_BLOB 0x382112 1 2 /end IF_DATA BIT_MASK 0x8 /end MEASUREMENT
/begin MEASUREMENT B_khstc "von Temperaturen oder Abstellzeit abhÑngige Freigabe Kat-Heizen" UWORD B_TRUE___UW 0 0 0.000000 0.000000 /begin IF_DATA ASAP1B_ETK KP_BLOB 0x382112 1 2 /end IF_DATA BIT_MASK 0x400 /end MEASUREMENT
/begin MEASUREMENT B_kl15 "Bedingung Klemme 15" UWORD B_TRUE___UW 0 0 0.000000 0.000000 /begin IF_DATA ASAP1B_ETK KP_BLOB 0xFD84 0 2 /end IF_DATA BIT_MASK 0x80 /end MEASUREMENT
/begin MEASUREMENT B_koe "Bedingung fÅr Kompressoreinschalten" UWORD B_TRUE___UW 0 0 0.000000 0.000000 /begin IF_DATA ASAP1B_ETK KP_BLOB 0xFDA0 0 2 /end IF_DATA BIT_MASK 0x100 /end MEASUREMENT
/begin MEASUREMENT B_kstebf "Bedingung KraftstofferstbefÅllung" UWORD B_TRUE___UW 0 0 0.000000 0.000000 /begin IF_DATA ASAP1B_ETK KP_BLOB 0xFD76 0 2 /end IF_DATA BIT_MASK 0x8000 /end MEASUREMENT
/begin MEASUREMENT B_kstebfa "" UWORD B_TRUE___UW 0 0 0.000000 0.000000 /begin IF_DATA ASAP1B_ETK KP_BLOB 0xFDA6 0 2 /end IF_DATA BIT_MASK 0x400 /end MEASUREMENT
/begin MEASUREMENT B_kupgw "Bedingung Kupplung betÑtigt bis erkannter Gangwechsel" UWORD B_TRUE___UW 0 0 0.000000 0.000000 /begin IF_DATA ASAP1B_ETK KP_BLOB 0xFD7E 0 2 /end IF_DATA BIT_MASK 0x8 /end MEASUREMENT
/begin MEASUREMENT B_kuppl "Bedingung Kupplung betÑtigt" UWORD B_TRUE___UW 0 0 0.000000 0.000000 /begin IF_DATA ASAP1B_ETK KP_BLOB 0xFD48 0 2 /end IF_DATA BIT_MASK 0x20 /end MEASUREMENT
/begin MEASUREMENT B_kw "Bedingung Kat warmhalten" UWORD B_TRUE___UW 0 0 0.000000 0.000000 /begin IF_DATA ASAP1B_ETK KP_BLOB 0xFD6E 0 2 /end IF_DATA BIT_MASK 0x8 /end MEASUREMENT
/begin MEASUREMENT B_ldb "Bedingung fÅr Ladedruckregelbereitschaft" UWORD B_TRUE___UW 0 0 0.000000 0.000000 /begin IF_DATA ASAP1B_ETK KP_BLOB 0xFD78 0 2 /end IF_DATA BIT_MASK 0x80 /end MEASUREMENT
/begin MEASUREMENT B_ldr "Flag fÅr Bedingung LDR aktiv" UWORD B_TRUE___UW 0 0 0.000000 0.000000 /begin IF_DATA ASAP1B_ETK KP_BLOB 0xFD78 0 2 /end IF_DATA BIT_MASK 0x100 /end MEASUREMENT
/begin MEASUREMENT B_ldra "Bedingung fÅr Ersatzma·nahme bei E_ldra" UWORD B_TRUE___UW 0 0 0.000000 0.000000 /begin IF_DATA ASAP1B_ETK KP_BLOB 0xFD7A 0 2 /end IF_DATA BIT_MASK 0x20 /end MEASUREMENT
/begin MEASUREMENT B_ldrbu "Flag fÅr Bedingung LDR backup Regler aktiv" UWORD B_TRUE___UW 0 0 0.000000 0.000000 /begin IF_DATA ASAP1B_ETK KP_BLOB 0xFD78 0 2 /end IF_DATA BIT_MASK 0x200 /end MEASUREMENT
/begin MEASUREMENT B_lds "Flag fÅr Bedingung LDR Steuerung" UWORD B_TRUE___UW 0 0 0.000000 0.000000 /begin IF_DATA ASAP1B_ETK KP_BLOB 0xFD78 0 2 /end IF_DATA BIT_MASK 0x400 /end MEASUREMENT
/begin MEASUREMENT B_lkderf "Bedingung Kick-Down-Position erfolgreich gelernt" UBYTE B_TRUE 0 0 0.000000 0.000000 /begin IF_DATA ASAP1B_ETK KP_BLOB 0x38334A 1 1 /end IF_DATA BIT_MASK 0x1 /end MEASUREMENT
/begin MEASUREMENT B_lkdfrg "Bedingung Freigabe Kick-Down-Lernen" UBYTE B_TRUE 0 0 0.000000 0.000000 /begin IF_DATA ASAP1B_ETK KP_BLOB 0x380ABB 1 1 /end IF_DATA BIT_MASK 0x80 /end MEASUREMENT
/begin MEASUREMENT B_ll "Bedingung Leerlauf" UWORD B_TRUE___UW 0 0 0.000000 0.000000 /begin IF_DATA ASAP1B_ETK KP_BLOB 0xFD7E 0 2 /end IF_DATA BIT_MASK 0x2000 /end MEASUREMENT
/begin MEASUREMENT B_llr "Bedingung Leerlaufregelung" UWORD B_TRUE___UW 0 0 0.000000 0.000000 /begin IF_DATA ASAP1B_ETK KP_BLOB 0xFD7C 0 2 /end IF_DATA BIT_MASK 0x4 /end MEASUREMENT
/begin MEASUREMENT B_lmsslof "Bedingung Lambda-Motor-Soll-SekundÑrluftanteil, Aus" UWORD B_TRUE___UW 0 0 0.000000 0.000000 /begin IF_DATA ASAP1B_ETK KP_BLOB 0xFD0A 0 2 /end IF_DATA BIT_MASK 0x20 /end MEASUREMENT
/begin MEASUREMENT B_lr "LREB: Bedingung Lambdaregelung (vor Kat); (Bank 1)" UWORD B_TRUE___UW 0 0 0.000000 0.000000 /begin IF_DATA ASAP1B_ETK KP_BLOB 0xFD94 0 2 /end IF_DATA BIT_MASK 0x2 /end MEASUREMENT
/begin MEASUREMENT B_lrnakt "Lernaktiv Bit" UWORD B_TRUE___UW 0 0 0.000000 0.000000 /begin IF_DATA ASAP1B_ETK KP_BLOB 0xFD42 0 2 /end IF_DATA BIT_MASK 0x10 /end MEASUREMENT
/begin MEASUREMENT B_lrndia "Bedingung: DV-E-Adaption und PrÅfungen per Diagnose-Tester aktivieren" UWORD B_TRUE___UW 0 0 0.000000 0.000000 /begin IF_DATA ASAP1B_ETK KP_BLOB 0xFD78 0 2 /end IF_DATA BIT_MASK 0x1 /end MEASUREMENT
/begin MEASUREMENT B_lrnerf "Lernerfolg Bit" UBYTE B_TRUE 0 0 0.000000 0.000000 /begin IF_DATA ASAP1B_ETK KP_BLOB 0x38334B 1 1 /end IF_DATA BIT_MASK 0x8 /end MEASUREMENT
/begin MEASUREMENT B_lrnfg "Lernfreigabe Bit" UWORD B_TRUE___UW 0 0 0.000000 0.000000 /begin IF_DATA ASAP1B_ETK KP_BLOB 0xFD42 0 2 /end IF_DATA BIT_MASK 0x20 /end MEASUREMENT
/begin MEASUREMENT B_lrnrdy "Lernen ist beendet" UWORD B_TRUE___UW 0 0 0.000000 0.000000 /begin IF_DATA ASAP1B_ETK KP_BLOB 0xFD42 0 2 /end IF_DATA BIT_MASK 0x40 /end MEASUREMENT
/begin MEASUREMENT B_lrntesa "Bedingung: UMA-Lernen u. Verst.abgl wegen Tester-Anford. aktiviert" UWORD B_TRUE___UW 0 0 0.000000 0.000000 /begin IF_DATA ASAP1B_ETK KP_BLOB 0xFD42 0 2 /end IF_DATA BIT_MASK 0x80 /end MEASUREMENT
/begin MEASUREMENT B_lrnvb "Lernverbot Bit" UWORD B_TRUE___UW 0 0 0.000000 0.000000 /begin IF_DATA ASAP1B_ETK KP_BLOB 0xFD42 0 2 /end IF_DATA BIT_MASK 0x100 /end MEASUREMENT
/begin MEASUREMENT B_lrnws "Lernwertspeicherung Bit" UBYTE B_TRUE 0 0 0.000000 0.000000 /begin IF_DATA ASAP1B_ETK KP_BLOB 0x38334B 1 1 /end IF_DATA BIT_MASK 0x1 /end MEASUREMENT
/begin MEASUREMENT B_luecke "Aktuelles Segment liegt Åber der ReferenzlÅcke" UWORD B_TRUE___UW 0 0 0.000000 0.000000 /begin IF_DATA ASAP1B_ETK KP_BLOB 0xFD1E 0 2 /end IF_DATA BIT_MASK 0x100 /end MEASUREMENT
/begin MEASUREMENT B_mdarv "kritische Aussetzerrate vorhanden" UWORD B_TRUE___UW 0 0 0.000000 0.000000 /begin IF_DATA ASAP1B_ETK KP_BLOB 0xFD1A 0 2 /end IF_DATA BIT_MASK 0x4 /end MEASUREMENT
/begin MEASUREMENT B_mdein "Bedingung Momenteneingriff aktiv" UWORD B_TRUE___UW 0 0 0.000000 0.000000 /begin IF_DATA ASAP1B_ETK KP_BLOB 0xFD82 0 2 /end IF_DATA BIT_MASK 0x10 /end MEASUREMENT
/begin MEASUREMENT B_mil "MIL-Ansteuerung" UWORD B_TRUE___UW 0 0 0.000000 0.000000 /begin IF_DATA ASAP1B_ETK KP_BLOB 0xFD1A 0 2 /end IF_DATA BIT_MASK 0x8000 /end MEASUREMENT
/begin MEASUREMENT B_mlsu "Bedingung mslu nicht grî·er 0" UWORD B_TRUE___UW 0 0 0.000000 0.000000 /begin IF_DATA ASAP1B_ETK KP_BLOB 0x382112 1 2 /end IF_DATA BIT_MASK 0x80 /end MEASUREMENT
/begin MEASUREMENT B_mluecke "Bedingung mittleres LÅckensegment bei Motoren mit ungerader Zylinderanzahl" UWORD B_TRUE___UW 0 0 0.000000 0.000000 /begin IF_DATA ASAP1B_ETK KP_BLOB 0xFD1E 0 2 /end IF_DATA BIT_MASK 0x200 /end MEASUREMENT
/begin MEASUREMENT B_msloff "SekundÑrluftmasse ausgerÑumt nach SekundÑrluftphase" UWORD B_TRUE___UW 0 0 0.000000 0.000000 /begin IF_DATA ASAP1B_ETK KP_BLOB 0xFD0A 0 2 /end IF_DATA BIT_MASK 0x40 /end MEASUREMENT
/begin MEASUREMENT B_msr "Bedingung fÅr Momentenschlupfregelung" UWORD B_TRUE___UW 0 0 0.000000 0.000000 /begin IF_DATA ASAP1B_ETK KP_BLOB 0xFD82 0 2 /end IF_DATA BIT_MASK 0x80 /end MEASUREMENT
/begin MEASUREMENT B_nachl "Steuerung SG-Nachlauf" UWORD B_TRUE___UW 0 0 0.000000 0.000000 /begin IF_DATA ASAP1B_ETK KP_BLOB 0x383CCE 1 2 /end IF_DATA BIT_MASK 0x8000 /end MEASUREMENT
/begin MEASUREMENT B_nachlend "Bedingung SG-Nachlauf regulÑr beendet" UWORD B_TRUE___UW 0 0 0.000000 0.000000 /begin IF_DATA ASAP1B_ETK KP_BLOB 0x383CCE 1 2 /end IF_DATA BIT_MASK 0x4000 /end MEASUREMENT
/begin MEASUREMENT B_ngasok "Bedingung Ringspeicher fÅr ngas-Berechnung ok" UWORD B_TRUE___UW 0 0 0.000000 0.000000 /begin IF_DATA ASAP1B_ETK KP_BLOB 0xFD1C 0 2 /end IF_DATA BIT_MASK 0x4 /end MEASUREMENT
/begin MEASUREMENT B_nlale "Anforderung SteuergerÑtenachlauf von Funktion ALE" UWORD B_TRUE___UW 0 0 0.000000 0.000000 /begin IF_DATA ASAP1B_ETK KP_BLOB 0x383CCE 1 2 /end IF_DATA BIT_MASK 0x1 /end MEASUREMENT
/begin MEASUREMENT B_nlatm "Anforderung SteuergerÑtenachlauf fÅr Abgastemp.Modell Sondenschutz" UWORD B_TRUE___UW 0 0 0.000000 0.000000 /begin IF_DATA ASAP1B_ETK KP_BLOB 0x383CCE 1 2 /end IF_DATA BIT_MASK 0x800 /end MEASUREMENT
/begin MEASUREMENT B_nldg "Bedingung Drehzahlgeber-Notlauf" UWORD B_TRUE___UW 0 0 0.000000 0.000000 /begin IF_DATA ASAP1B_ETK KP_BLOB 0xFD22 0 2 /end IF_DATA BIT_MASK 0x1 /end MEASUREMENT
/begin MEASUREMENT B_nlnlpl "Bedingung: Verriegelungsbit NLP-Lernen im SG-Nachlauf" UWORD B_TRUE___UW 0 0 0.000000 0.000000 /begin IF_DATA ASAP1B_ETK KP_BLOB 0xFD42 0 2 /end IF_DATA BIT_MASK 0x200 /end MEASUREMENT
/begin MEASUREMENT B_nlpe "Bedingung: Fehler in NLP-PrÅfung u. -Lernen" UWORD B_TRUE___UW 0 0 0.000000 0.000000 /begin IF_DATA ASAP1B_ETK KP_BLOB 0xFD42 0 2 /end IF_DATA BIT_MASK 0x400 /end MEASUREMENT
/begin MEASUREMENT B_nlperf "Dauer-RAM, Bedingung: NLP-Erfassung erfolgreich" UBYTE B_TRUE 0 0 0.000000 0.000000 /begin IF_DATA ASAP1B_ETK KP_BLOB 0x38334B 1 1 /end IF_DATA BIT_MASK 0x2 /end MEASUREMENT
/begin MEASUREMENT B_nlperft "Dauer-RAM, Bedingung: NLP-Erfassung teilweise erfolgreich, temp. Zustand" UBYTE B_TRUE 0 0 0.000000 0.000000 /begin IF_DATA ASAP1B_ETK KP_BLOB 0x38334B 1 1 /end IF_DATA BIT_MASK 0x4 /end MEASUREMENT
/begin MEASUREMENT B_nlpne "Bedingung: Bei gefordertem DK-Notluftfahren wurde NLP nicht erreicht" UWORD B_TRUE___UW 0 0 0.000000 0.000000 /begin IF_DATA ASAP1B_ETK KP_BLOB 0xFD46 0 2 /end IF_DATA BIT_MASK 0x2 /end MEASUREMENT
/begin MEASUREMENT B_nlpnew "Bedingung: NLP-Position ist noch nicht bekannt" UWORD B_TRUE___UW 0 0 0.000000 0.000000 /begin IF_DATA ASAP1B_ETK KP_BLOB 0xFD42 0 2 /end IF_DATA BIT_MASK 0x800 /end MEASUREMENT
/begin MEASUREMENT B_nlpreq "Bedingung: NLP-Lernen anfordern" UWORD B_TRUE___UW 0 0 0.000000 0.000000 /begin IF_DATA ASAP1B_ETK KP_BLOB 0xFD42 0 2 /end IF_DATA BIT_MASK 0x1000 /end MEASUREMENT
/begin MEASUREMENT B_nmaxd "Bedingung Drehzahlbegrenzung mit Einspritzausblendung" UWORD B_TRUE___UW 0 0 0.000000 0.000000 /begin IF_DATA ASAP1B_ETK KP_BLOB 0xFD82 0 2 /end IF_DATA BIT_MASK 0x2000 /end MEASUREMENT
/begin MEASUREMENT B_nmin "Bedingung Unterdrehzahl: n < NMIN" UWORD B_TRUE___UW 0 0 0.000000 0.000000 /begin IF_DATA ASAP1B_ETK KP_BLOB 0xFD1E 0 2 /end IF_DATA BIT_MASK 0x400 /end MEASUREMENT
/begin MEASUREMENT B_nmot "Bedingung Motordrehzahl: n > NMIN" UWORD B_TRUE___UW 0 0 0.000000 0.000000 /begin IF_DATA ASAP1B_ETK KP_BLOB 0xFD1E 0 2 /end IF_DATA BIT_MASK 0x800 /end MEASUREMENT
/begin MEASUREMENT B_nsp "Bedingung Nachspritzer" UWORD B_TRUE___UW 0 0 0.000000 0.000000 /begin IF_DATA ASAP1B_ETK KP_BLOB 0xFD5C 0 2 /end IF_DATA BIT_MASK 0x200 /end MEASUREMENT
/begin MEASUREMENT B_nwsaktiv "" UWORD B_TRUE___UW 0 0 0.000000 0.000000 /begin IF_DATA ASAP1B_ETK KP_BLOB 0xFD48 0 2 /end IF_DATA BIT_MASK 0x400 /end MEASUREMENT
/begin MEASUREMENT B_nwsalt "" UWORD B_TRUE___UW 0 0 0.000000 0.000000 /begin IF_DATA ASAP1B_ETK KP_BLOB 0xFD48 0 2 /end IF_DATA BIT_MASK 0x800 /end MEASUREMENT
/begin MEASUREMENT B_pagr "AGR-Berechnung abgeschaltet" UWORD B_TRUE___UW 0 0 0.000000 0.000000 /begin IF_DATA ASAP1B_ETK KP_BLOB 0xFD58 0 2 /end IF_DATA BIT_MASK 0x80 /end MEASUREMENT
/begin MEASUREMENT B_puerr "Bedingung Fehler  korrigiertes Umgebungsdrucksignal fÅr Bergabfahrterkennung" UBYTE B_TRUE 0 0 0.000000 0.000000 /begin IF_DATA ASAP1B_ETK KP_BLOB 0x380CD3 1 1 /end IF_DATA BIT_MASK 0x1 /end MEASUREMENT
/begin MEASUREMENT B_pvl1 "Bedingung Pumpenvorlauf bei Systemen mit Uhr" UBYTE B_TRUE 0 0 0.000000 0.000000 /begin IF_DATA ASAP1B_ETK KP_BLOB 0x380D2D 1 1 /end IF_DATA BIT_MASK 0x1 /end MEASUREMENT
/begin MEASUREMENT B_pvl2 "Bedingung Pumpenvorlauf bei Systemen ohne Uhr" UBYTE B_TRUE 0 0 0.000000 0.000000 /begin IF_DATA ASAP1B_ETK KP_BLOB 0x380D2D 1 1 /end IF_DATA BIT_MASK 0x2 /end MEASUREMENT
/begin MEASUREMENT B_pvlnl "Bedingung EKP-Vorlauf aus NachlaufzeitÅberschreitung" UBYTE B_TRUE 0 0 0.000000 0.000000 /begin IF_DATA ASAP1B_ETK KP_BLOB 0x383442 1 1 /end IF_DATA BIT_MASK 0x1 /end MEASUREMENT
/begin MEASUREMENT B_pwf "Bedingung Powerfail" UWORD B_TRUE___UW 0 0 0.000000 0.000000 /begin IF_DATA ASAP1B_ETK KP_BLOB 0xFD88 0 2 /end IF_DATA BIT_MASK 0x10 /end MEASUREMENT
/begin MEASUREMENT B_pwgnotfr "FR-Fehlerreaktion PWG-Notfahren" UWORD B_TRUE___UW 0 0 0.000000 0.000000 /begin IF_DATA ASAP1B_ETK KP_BLOB 0xFD3C 0 2 /end IF_DATA BIT_MASK 0x100 /end MEASUREMENT
/begin MEASUREMENT B_pwrsv "Bedingung: DV-E-powersave ist aktiv" UWORD B_TRUE___UW 0 0 0.000000 0.000000 /begin IF_DATA ASAP1B_ETK KP_BLOB 0xFD46 0 2 /end IF_DATA BIT_MASK 0x4 /end MEASUREMENT
/begin MEASUREMENT B_ralectr "Bedingung letzte Zahnzeit > TRD" UWORD B_TRUE___UW 0 0 0.000000 0.000000 /begin IF_DATA ASAP1B_ETK KP_BLOB 0xFD1C 0 2 /end IF_DATA BIT_MASK 0x8000 /end MEASUREMENT
/begin MEASUREMENT B_raleok "Bedingung letzter Zahn liegt im plausiblen RÅckdrehbereich" UWORD B_TRUE___UW 0 0 0.000000 0.000000 /begin IF_DATA ASAP1B_ETK KP_BLOB 0xFD1E 0 2 /end IF_DATA BIT_MASK 0x1 /end MEASUREMENT
/begin MEASUREMENT B_sa "Schubabschaltung" UWORD B_TRUE___UW 0 0 0.000000 0.000000 /begin IF_DATA ASAP1B_ETK KP_BLOB 0xFD84 0 2 /end IF_DATA BIT_MASK 0x2 /end MEASUREMENT
/begin MEASUREMENT B_sab "Bedingung Schubabschaltebereitschaft" UWORD B_TRUE___UW 0 0 0.000000 0.000000 /begin IF_DATA ASAP1B_ETK KP_BLOB 0xFD7A 0 2 /end IF_DATA BIT_MASK 0x100 /end MEASUREMENT
/begin MEASUREMENT B_sabt "Bedingung Schubabschaltebereitschaft" UBYTE B_TRUE 0 0 0.000000 0.000000 /begin IF_DATA ASAP1B_ETK KP_BLOB 0x380C0E 1 1 /end IF_DATA BIT_MASK 0x2 /end MEASUREMENT
/begin MEASUREMENT B_sacvt "Bedingung SchubabschaltunterstÅtzung fÅr CVT-Getriebe" UWORD B_TRUE___UW 0 0 0.000000 0.000000 /begin IF_DATA ASAP1B_ETK KP_BLOB 0xFD12 0 2 /end IF_DATA BIT_MASK 0x100 /end MEASUREMENT
/begin MEASUREMENT B_savfgr "Bedingung: Schubabschalteverbot durch FGR" UWORD B_TRUE___UW 0 0 0.000000 0.000000 /begin IF_DATA ASAP1B_ETK KP_BLOB 0xFD54 0 2 /end IF_DATA BIT_MASK 0x80 /end MEASUREMENT
/begin MEASUREMENT B_savmsr "Bedingung Schubabschalteverbot bei MSR-Anforderung" UWORD B_TRUE___UW 0 0 0.000000 0.000000 /begin IF_DATA ASAP1B_ETK KP_BLOB 0xFD12 0 2 /end IF_DATA BIT_MASK 0x400 /end MEASUREMENT
/begin MEASUREMENT B_skaevab "Bedingung Ev-Abschaltung durch Sicherheitskraftstoffabschaltung aktiv" UWORD B_TRUE___UW 0 0 0.000000 0.000000 /begin IF_DATA ASAP1B_ETK KP_BLOB 0xFD5C 0 2 /end IF_DATA BIT_MASK 0x80 /end MEASUREMENT
/begin MEASUREMENT B_slkhof "Bedingung Abschalten der SekundÑrluftpumpe durch imlpr-Schwelle" UWORD B_TRUE___UW 0 0 0.000000 0.000000 /begin IF_DATA ASAP1B_ETK KP_BLOB 0xFD0A 0 2 /end IF_DATA BIT_MASK 0x100 /end MEASUREMENT
/begin MEASUREMENT B_slpoff "SekundÑrluftpumpe abgeschaltet" UWORD B_TRUE___UW 0 0 0.000000 0.000000 /begin IF_DATA ASAP1B_ETK KP_BLOB 0xFD0A 0 2 /end IF_DATA BIT_MASK 0x400 /end MEASUREMENT
/begin MEASUREMENT B_slsfz "Bedingung SLS in Fahrzeug eingebaut" UWORD B_TRUE___UW 0 0 0.000000 0.000000 /begin IF_DATA ASAP1B_ETK KP_BLOB 0xFD02 0 2 /end IF_DATA BIT_MASK 0x4000 /end MEASUREMENT
/begin MEASUREMENT B_slsn2 "Bedingung öberlappung nach zylinderindiv. SpÑtverstellung" UWORD B_TRUE___UW 0 0 0.000000 0.000000 /begin IF_DATA ASAP1B_ETK KP_BLOB 0xFD06 0 2 /end IF_DATA BIT_MASK 0x2 /end MEASUREMENT
/begin MEASUREMENT B_spontan0 "" UWORD B_TRUE___UW 0 0 0.000000 0.000000 /begin IF_DATA ASAP1B_ETK KP_BLOB 0xFD48 0 2 /end IF_DATA BIT_MASK 0x1000 /end MEASUREMENT
/begin MEASUREMENT B_spontan1 "" UWORD B_TRUE___UW 0 0 0.000000 0.000000 /begin IF_DATA ASAP1B_ETK KP_BLOB 0xFD48 0 2 /end IF_DATA BIT_MASK 0x2000 /end MEASUREMENT
/begin MEASUREMENT B_spontan2 "" UWORD B_TRUE___UW 0 0 0.000000 0.000000 /begin IF_DATA ASAP1B_ETK KP_BLOB 0xFD48 0 2 /end IF_DATA BIT_MASK 0x4000 /end MEASUREMENT
/begin MEASUREMENT B_spontan3 "" UWORD B_TRUE___UW 0 0 0.000000 0.000000 /begin IF_DATA ASAP1B_ETK KP_BLOB 0xFD48 0 2 /end IF_DATA BIT_MASK 0x8000 /end MEASUREMENT
/begin MEASUREMENT B_spontan4 "" UWORD B_TRUE___UW 0 0 0.000000 0.000000 /begin IF_DATA ASAP1B_ETK KP_BLOB 0xFD4A 0 2 /end IF_DATA BIT_MASK 0x1 /end MEASUREMENT
/begin MEASUREMENT B_spontan5 "" UWORD B_TRUE___UW 0 0 0.000000 0.000000 /begin IF_DATA ASAP1B_ETK KP_BLOB 0xFD4A 0 2 /end IF_DATA BIT_MASK 0x2 /end MEASUREMENT
/begin MEASUREMENT B_spontan6 "" UWORD B_TRUE___UW 0 0 0.000000 0.000000 /begin IF_DATA ASAP1B_ETK KP_BLOB 0xFD4A 0 2 /end IF_DATA BIT_MASK 0x4 /end MEASUREMENT
/begin MEASUREMENT B_spontan7 "" UWORD B_TRUE___UW 0 0 0.000000 0.000000 /begin IF_DATA ASAP1B_ETK KP_BLOB 0xFD4A 0 2 /end IF_DATA BIT_MASK 0x8 /end MEASUREMENT
/begin MEASUREMENT B_st "Bedingung Start" UWORD B_TRUE___UW 0 0 0.000000 0.000000 /begin IF_DATA ASAP1B_ETK KP_BLOB 0xFD88 0 2 /end IF_DATA BIT_MASK 0x20 /end MEASUREMENT
/begin MEASUREMENT B_stend "1 = Startende erkannt" UWORD B_TRUE___UW 0 0 0.000000 0.000000 /begin IF_DATA ASAP1B_ETK KP_BLOB 0xFD88 0 2 /end IF_DATA BIT_MASK 0x40 /end MEASUREMENT
/begin MEASUREMENT B_stndnl "Bedingung Beginn SG-Nachlauf oder Startende (1->0)" UWORD B_TRUE___UW 0 0 0.000000 0.000000 /begin IF_DATA ASAP1B_ETK KP_BLOB 0xFD22 0 2 /end IF_DATA BIT_MASK 0x100 /end MEASUREMENT
/begin MEASUREMENT B_sw0 "Bedingung keine SchliesszeitÅberlappung" UWORD B_TRUE___UW 0 0 0.000000 0.000000 /begin IF_DATA ASAP1B_ETK KP_BLOB 0xFD06 0 2 /end IF_DATA BIT_MASK 0x4 /end MEASUREMENT
/begin MEASUREMENT B_sw1 "Bedingung SchliesszeitÅberlappung" UWORD B_TRUE___UW 0 0 0.000000 0.000000 /begin IF_DATA ASAP1B_ETK KP_BLOB 0xFD06 0 2 /end IF_DATA BIT_MASK 0x8 /end MEASUREMENT
/begin MEASUREMENT B_syn2nd "" UWORD B_TRUE___UW 0 0 0.000000 0.000000 /begin IF_DATA ASAP1B_ETK KP_BLOB 0xFD1C 0 2 /end IF_DATA BIT_MASK 0x8 /end MEASUREMENT
/begin MEASUREMENT B_synti "" UWORD B_TRUE___UW 0 0 0.000000 0.000000 /begin IF_DATA ASAP1B_ETK KP_BLOB 0xFD4A 0 2 /end IF_DATA BIT_MASK 0x10 /end MEASUREMENT
/begin MEASUREMENT B_te "TankentlÅftung aktiv" UWORD B_TRUE___UW 0 0 0.000000 0.000000 /begin IF_DATA ASAP1B_ETK KP_BLOB 0xFD88 0 2 /end IF_DATA BIT_MASK 0x100 /end MEASUREMENT
/begin MEASUREMENT B_teabb "Bedingung TankentlÅftung abbruchbereit" UWORD B_TRUE___UW 0 0 0.000000 0.000000 /begin IF_DATA ASAP1B_ETK KP_BLOB 0xFD88 0 2 /end IF_DATA BIT_MASK 0x4000 /end MEASUREMENT
/begin MEASUREMENT B_tehbx "Bedingung Beladungsintegrator ftead am Maximalanschlag" UWORD B_TRUE___UW 0 0 0.000000 0.000000 /begin IF_DATA ASAP1B_ETK KP_BLOB 0xFD8A 0 2 /end IF_DATA BIT_MASK 0x2 /end MEASUREMENT
/begin MEASUREMENT B_tehbxf "Bedingung Beladungsintegrator ftead am Maximalanschlag, gefiltert" UWORD B_TRUE___UW 0 0 0.000000 0.000000 /begin IF_DATA ASAP1B_ETK KP_BLOB 0xFD60 0 2 /end IF_DATA BIT_MASK 0x8000 /end MEASUREMENT
/begin MEASUREMENT B_tep "Bedingung TankentlÅftungsphase" UWORD B_TRUE___UW 0 0 0.000000 0.000000 /begin IF_DATA ASAP1B_ETK KP_BLOB 0xFD62 0 2 /end IF_DATA BIT_MASK 0x1 /end MEASUREMENT
/begin MEASUREMENT B_tepi "Bedingung TE-Phase intern aktiv" UWORD B_TRUE___UW 0 0 0.000000 0.000000 /begin IF_DATA ASAP1B_ETK KP_BLOB 0xFD62 0 2 /end IF_DATA BIT_MASK 0x2 /end MEASUREMENT
/begin MEASUREMENT B_tepzus "Bedingung zusÑtzliche TankentlÅftungsphase" UWORD B_TRUE___UW 0 0 0.000000 0.000000 /begin IF_DATA ASAP1B_ETK KP_BLOB 0xFD62 0 2 /end IF_DATA BIT_MASK 0x4 /end MEASUREMENT
/begin MEASUREMENT B_tesstp "Bedingung TankentlÅftung schnell stoppen" UWORD B_TRUE___UW 0 0 0.000000 0.000000 /begin IF_DATA ASAP1B_ETK KP_BLOB 0xFD62 0 2 /end IF_DATA BIT_MASK 0x8 /end MEASUREMENT
/begin MEASUREMENT B_tevtstp "Bedingung Stop fÅr TEV Timer" UWORD B_TRUE___UW 0 0 0.000000 0.000000 /begin IF_DATA ASAP1B_ETK KP_BLOB 0xFD8A 0 2 /end IF_DATA BIT_MASK 0x4 /end MEASUREMENT
/begin MEASUREMENT B_teza "Bedingung TankentlÅftung zwangsaktiv" UWORD B_TRUE___UW 0 0 0.000000 0.000000 /begin IF_DATA ASAP1B_ETK KP_BLOB 0xFD92 0 2 /end IF_DATA BIT_MASK 0x800 /end MEASUREMENT
/begin MEASUREMENT B_tezstp "Bedingung TankentlÅftung zwang stoppen" UWORD B_TRUE___UW 0 0 0.000000 0.000000 /begin IF_DATA ASAP1B_ETK KP_BLOB 0xFD62 0 2 /end IF_DATA BIT_MASK 0x10 /end MEASUREMENT
/begin MEASUREMENT B_tfu "Bedingung TemperaturfÅhler Umgebung vorhanden" UWORD B_TRUE___UW 0 0 0.000000 0.000000 /begin IF_DATA ASAP1B_ETK KP_BLOB 0xFD02 0 2 /end IF_DATA BIT_MASK 0x8000 /end MEASUREMENT
/begin MEASUREMENT B_tippg "Bedingung WÑhlhebel in Stellung 'Tippgasse'" UWORD B_TRUE___UW 0 0 0.000000 0.000000 /begin IF_DATA ASAP1B_ETK KP_BLOB 0xFD14 0 2 /end IF_DATA BIT_MASK 0x20 /end MEASUREMENT
/begin MEASUREMENT B_ti_cha0 "" UWORD B_TRUE___UW 0 0 0.000000 0.000000 /begin IF_DATA ASAP1B_ETK KP_BLOB 0xFD4A 0 2 /end IF_DATA BIT_MASK 0x20 /end MEASUREMENT
/begin MEASUREMENT B_ti_cha1 "" UWORD B_TRUE___UW 0 0 0.000000 0.000000 /begin IF_DATA ASAP1B_ETK KP_BLOB 0xFD4A 0 2 /end IF_DATA BIT_MASK 0x40 /end MEASUREMENT
/begin MEASUREMENT B_ti_cha2 "" UWORD B_TRUE___UW 0 0 0.000000 0.000000 /begin IF_DATA ASAP1B_ETK KP_BLOB 0xFD4A 0 2 /end IF_DATA BIT_MASK 0x80 /end MEASUREMENT
/begin MEASUREMENT B_ti_cha3 "" UWORD B_TRUE___UW 0 0 0.000000 0.000000 /begin IF_DATA ASAP1B_ETK KP_BLOB 0xFD4A 0 2 /end IF_DATA BIT_MASK 0x100 /end MEASUREMENT
/begin MEASUREMENT B_ti_cha4 "" UWORD B_TRUE___UW 0 0 0.000000 0.000000 /begin IF_DATA ASAP1B_ETK KP_BLOB 0xFD4A 0 2 /end IF_DATA BIT_MASK 0x200 /end MEASUREMENT
/begin MEASUREMENT B_ti_cha5 "" UWORD B_TRUE___UW 0 0 0.000000 0.000000 /begin IF_DATA ASAP1B_ETK KP_BLOB 0xFD4A 0 2 /end IF_DATA BIT_MASK 0x400 /end MEASUREMENT
/begin MEASUREMENT B_ti_cha6 "" UWORD B_TRUE___UW 0 0 0.000000 0.000000 /begin IF_DATA ASAP1B_ETK KP_BLOB 0xFD4A 0 2 /end IF_DATA BIT_MASK 0x800 /end MEASUREMENT
/begin MEASUREMENT B_ti_cha7 "" UWORD B_TRUE___UW 0 0 0.000000 0.000000 /begin IF_DATA ASAP1B_ETK KP_BLOB 0xFD4A 0 2 /end IF_DATA BIT_MASK 0x1000 /end MEASUREMENT
/begin MEASUREMENT B_ti_out0 "" UWORD B_TRUE___UW 0 0 0.000000 0.000000 /begin IF_DATA ASAP1B_ETK KP_BLOB 0xFD4A 0 2 /end IF_DATA BIT_MASK 0x2000 /end MEASUREMENT
/begin MEASUREMENT B_ti_out1 "" UWORD B_TRUE___UW 0 0 0.000000 0.000000 /begin IF_DATA ASAP1B_ETK KP_BLOB 0xFD4A 0 2 /end IF_DATA BIT_MASK 0x4000 /end MEASUREMENT
/begin MEASUREMENT B_ti_out2 "" UWORD B_TRUE___UW 0 0 0.000000 0.000000 /begin IF_DATA ASAP1B_ETK KP_BLOB 0xFD4A 0 2 /end IF_DATA BIT_MASK 0x8000 /end MEASUREMENT
/begin MEASUREMENT B_ti_out3 "" UWORD B_TRUE___UW 0 0 0.000000 0.000000 /begin IF_DATA ASAP1B_ETK KP_BLOB 0xFD4C 0 2 /end IF_DATA BIT_MASK 0x1 /end MEASUREMENT
/begin MEASUREMENT B_ti_out4 "" UWORD B_TRUE___UW 0 0 0.000000 0.000000 /begin IF_DATA ASAP1B_ETK KP_BLOB 0xFD4C 0 2 /end IF_DATA BIT_MASK 0x2 /end MEASUREMENT
/begin MEASUREMENT B_ti_out5 "" UWORD B_TRUE___UW 0 0 0.000000 0.000000 /begin IF_DATA ASAP1B_ETK KP_BLOB 0xFD4C 0 2 /end IF_DATA BIT_MASK 0x4 /end MEASUREMENT
/begin MEASUREMENT B_ti_out6 "" UWORD B_TRUE___UW 0 0 0.000000 0.000000 /begin IF_DATA ASAP1B_ETK KP_BLOB 0xFD4C 0 2 /end IF_DATA BIT_MASK 0x8 /end MEASUREMENT
/begin MEASUREMENT B_ti_out7 "" UWORD B_TRUE___UW 0 0 0.000000 0.000000 /begin IF_DATA ASAP1B_ETK KP_BLOB 0xFD4C 0 2 /end IF_DATA BIT_MASK 0x10 /end MEASUREMENT
/begin MEASUREMENT B_ti_wai0 "" UWORD B_TRUE___UW 0 0 0.000000 0.000000 /begin IF_DATA ASAP1B_ETK KP_BLOB 0xFD4C 0 2 /end IF_DATA BIT_MASK 0x20 /end MEASUREMENT
/begin MEASUREMENT B_ti_wai1 "" UWORD B_TRUE___UW 0 0 0.000000 0.000000 /begin IF_DATA ASAP1B_ETK KP_BLOB 0xFD4C 0 2 /end IF_DATA BIT_MASK 0x40 /end MEASUREMENT
/begin MEASUREMENT B_ti_wai2 "" UWORD B_TRUE___UW 0 0 0.000000 0.000000 /begin IF_DATA ASAP1B_ETK KP_BLOB 0xFD4C 0 2 /end IF_DATA BIT_MASK 0x80 /end MEASUREMENT
/begin MEASUREMENT B_ti_wai3 "" UWORD B_TRUE___UW 0 0 0.000000 0.000000 /begin IF_DATA ASAP1B_ETK KP_BLOB 0xFD4C 0 2 /end IF_DATA BIT_MASK 0x100 /end MEASUREMENT
/begin MEASUREMENT B_ti_wai4 "" UWORD B_TRUE___UW 0 0 0.000000 0.000000 /begin IF_DATA ASAP1B_ETK KP_BLOB 0xFD4C 0 2 /end IF_DATA BIT_MASK 0x200 /end MEASUREMENT
/begin MEASUREMENT B_ti_wai5 "" UWORD B_TRUE___UW 0 0 0.000000 0.000000 /begin IF_DATA ASAP1B_ETK KP_BLOB 0xFD4C 0 2 /end IF_DATA BIT_MASK 0x400 /end MEASUREMENT
/begin MEASUREMENT B_ti_wai6 "" UWORD B_TRUE___UW 0 0 0.000000 0.000000 /begin IF_DATA ASAP1B_ETK KP_BLOB 0xFD4C 0 2 /end IF_DATA BIT_MASK 0x800 /end MEASUREMENT
/begin MEASUREMENT B_ti_wai7 "" UWORD B_TRUE___UW 0 0 0.000000 0.000000 /begin IF_DATA ASAP1B_ETK KP_BLOB 0xFD4C 0 2 /end IF_DATA BIT_MASK 0x1000 /end MEASUREMENT
/begin MEASUREMENT B_tpnmot "Bedingung Tiefpunkt Drehzahlschwingung" UWORD B_TRUE___UW 0 0 0.000000 0.000000 /begin IF_DATA ASAP1B_ETK KP_BLOB 0xFD7E 0 2 /end IF_DATA BIT_MASK 0x10 /end MEASUREMENT
/begin MEASUREMENT B_tpvl "Bedingung Pumpenvorlauf der LÑnge TPVL Sekunden" UBYTE B_TRUE 0 0 0.000000 0.000000 /begin IF_DATA ASAP1B_ETK KP_BLOB 0x380D2D 1 1 /end IF_DATA BIT_MASK 0x4 /end MEASUREMENT
/begin MEASUREMENT B_trkh "Bedingung Katheizen, Thermoreaktor wirksam" UWORD B_TRUE___UW 0 0 0.000000 0.000000 /begin IF_DATA ASAP1B_ETK KP_BLOB 0xFD6E 0 2 /end IF_DATA BIT_MASK 0x10 /end MEASUREMENT
/begin MEASUREMENT B_tteae "Bedingung Umschaltung auf lange TE-Phase" UWORD B_TRUE___UW 0 0 0.000000 0.000000 /begin IF_DATA ASAP1B_ETK KP_BLOB 0xFD62 0 2 /end IF_DATA BIT_MASK 0x20 /end MEASUREMENT
/begin MEASUREMENT B_ubdve "Bedingung: Batteriespannung fÅr DV-E-Ansteuerung i.O." UWORD B_TRUE___UW 0 0 0.000000 0.000000 /begin IF_DATA ASAP1B_ETK KP_BLOB 0xFD46 0 2 /end IF_DATA BIT_MASK 0x8 /end MEASUREMENT
/begin MEASUREMENT B_ubpvg "Bedingung Batteriespannung ausreichend fÅr 5V-Potiversorgung" UWORD B_TRUE___UW 0 0 0.000000 0.000000 /begin IF_DATA ASAP1B_ETK KP_BLOB 0xFD46 0 2 /end IF_DATA BIT_MASK 0x10 /end MEASUREMENT
/begin MEASUREMENT B_ub_ok "1 = Batteriespannung ok" UWORD B_TRUE___UW 0 0 0.000000 0.000000 /begin IF_DATA ASAP1B_ETK KP_BLOB 0xFD46 0 2 /end IF_DATA BIT_MASK 0x20 /end MEASUREMENT
/begin MEASUREMENT B_ugd "Bedingung: DK-Winkel grî·er als fÅr 95% der max. rel. FÅllung erforderlich" UWORD B_TRUE___UW 0 0 0.000000 0.000000 /begin IF_DATA ASAP1B_ETK KP_BLOB 0xFD56 0 2 /end IF_DATA BIT_MASK 0x1000 /end MEASUREMENT
/begin MEASUREMENT B_uhrrmin "Bedingung Uhr mit relativem MinutenzÑhler" UWORD B_TRUE___UW 0 0 0.000000 0.000000 /begin IF_DATA ASAP1B_ETK KP_BLOB 0xFD04 0 2 /end IF_DATA BIT_MASK 0x1 /end MEASUREMENT
/begin MEASUREMENT B_uhrrsec "Bedingung Uhr mit relativem SekundenzÑhler" UWORD B_TRUE___UW 0 0 0.000000 0.000000 /begin IF_DATA ASAP1B_ETK KP_BLOB 0xFD04 0 2 /end IF_DATA BIT_MASK 0x2 /end MEASUREMENT
/begin MEASUREMENT B_umae "Bedingung: Fehler beim UMA-Lernen" UWORD B_TRUE___UW 0 0 0.000000 0.000000 /begin IF_DATA ASAP1B_ETK KP_BLOB 0xFD42 0 2 /end IF_DATA BIT_MASK 0x2000 /end MEASUREMENT
/begin MEASUREMENT B_umaerf "Bedingung: UMA-Lernen erfolgreich" UWORD B_TRUE___UW 0 0 0.000000 0.000000 /begin IF_DATA ASAP1B_ETK KP_BLOB 0xFD42 0 2 /end IF_DATA BIT_MASK 0x4000 /end MEASUREMENT
/begin MEASUREMENT B_umardr "Bedingung: UMA-Lernwert ins Dauer-RAM Åbernommen" UWORD B_TRUE___UW 0 0 0.000000 0.000000 /begin IF_DATA ASAP1B_ETK KP_BLOB 0xFD42 0 2 /end IF_DATA BIT_MASK 0x8000 /end MEASUREMENT
/begin MEASUREMENT B_umauab "Bedingung: UMA-Lernen wÑhrend Urinitialisierung abgebrochen (SKA)" UWORD B_TRUE___UW 0 0 0.000000 0.000000 /begin IF_DATA ASAP1B_ETK KP_BLOB 0xFD44 0 2 /end IF_DATA BIT_MASK 0x1 /end MEASUREMENT
/begin MEASUREMENT B_vnull "Bedingung Fahrzeug steht" UWORD B_TRUE___UW 0 0 0.000000 0.000000 /begin IF_DATA ASAP1B_ETK KP_BLOB 0xFD04 0 2 /end IF_DATA BIT_MASK 0x10 /end MEASUREMENT
/begin MEASUREMENT B_wdk1v "Bedingung Berechnung des DK-Winkels aus verstÑrktem Signal von Poti 1" UWORD B_TRUE___UW 0 0 0.000000 0.000000 /begin IF_DATA ASAP1B_ETK KP_BLOB 0xFD40 0 2 /end IF_DATA BIT_MASK 0x1 /end MEASUREMENT
/begin MEASUREMENT B_wdk2sel "Bedingung DK-Winkel-Berechnung fÅr Lageregler aus Poti 2" UWORD B_TRUE___UW 0 0 0.000000 0.000000 /begin IF_DATA ASAP1B_ETK KP_BLOB 0xFD40 0 2 /end IF_DATA BIT_MASK 0x4 /end MEASUREMENT
/begin MEASUREMENT B_wdksauf "Bedingung: DLR, Sollsprung in Richtung AUF" UWORD B_TRUE___UW 0 0 0.000000 0.000000 /begin IF_DATA ASAP1B_ETK KP_BLOB 0xFD46 0 2 /end IF_DATA BIT_MASK 0x40 /end MEASUREMENT
/begin MEASUREMENT B_wdksive "Bedingung: Fehler im Vergleich DK-Winkel-Sollwert/-Istwert" UWORD B_TRUE___UW 0 0 0.000000 0.000000 /begin IF_DATA ASAP1B_ETK KP_BLOB 0xFD46 0 2 /end IF_DATA BIT_MASK 0x80 /end MEASUREMENT
/begin MEASUREMENT B_wk "Bedingung: Wandlerkupplung ÅberbrÅckt" UWORD B_TRUE___UW 0 0 0.000000 0.000000 /begin IF_DATA ASAP1B_ETK KP_BLOB 0xFD14 0 2 /end IF_DATA BIT_MASK 0x200 /end MEASUREMENT
/begin MEASUREMENT B_wst "Bedingung Wiederholstart" UWORD B_TRUE___UW 0 0 0.000000 0.000000 /begin IF_DATA ASAP1B_ETK KP_BLOB 0xFD60 0 2 /end IF_DATA BIT_MASK 0x200 /end MEASUREMENT
/begin MEASUREMENT B_z1 "Bedingung ZÅndbereich 1 aktiv" UWORD B_TRUE___UW 0 0 0.000000 0.000000 /begin IF_DATA ASAP1B_ETK KP_BLOB 0xFD06 0 2 /end IF_DATA BIT_MASK 0x10 /end MEASUREMENT
/begin MEASUREMENT B_zesync "Bedingung ZÅndung synchronisiert" UWORD B_TRUE___UW 0 0 0.000000 0.000000 /begin IF_DATA ASAP1B_ETK KP_BLOB 0xFD06 0 2 /end IF_DATA BIT_MASK 0x20 /end MEASUREMENT
/begin MEASUREMENT B_zms "Bedingung Motordrehzahl im ZMS-Resonanzbereich" UWORD B_TRUE___UW 0 0 0.000000 0.000000 /begin IF_DATA ASAP1B_ETK KP_BLOB 0xFDA6 0 2 /end IF_DATA BIT_MASK 0x800 /end MEASUREMENT
/begin MEASUREMENT B_zmse "Bedingung Motordrehzahl sicher au·erhalb der ZMS-Resonanz" UWORD B_TRUE___UW 0 0 0.000000 0.000000 /begin IF_DATA ASAP1B_ETK KP_BLOB 0xFDA6 0 2 /end IF_DATA BIT_MASK 0x1000 /end MEASUREMENT
/begin MEASUREMENT B_zmsoff "Bedingung Motorabstellen wegen ZMS-Resonanz" UWORD B_TRUE___UW 0 0 0.000000 0.000000 /begin IF_DATA ASAP1B_ETK KP_BLOB 0xFDA6 0 2 /end IF_DATA BIT_MASK 0x2000 /end MEASUREMENT
/begin MEASUREMENT B_zprel "Bedingung Zahnentprellung erfolgt" UWORD B_TRUE___UW 0 0 0.000000 0.000000 /begin IF_DATA ASAP1B_ETK KP_BLOB 0xFD20 0 2 /end IF_DATA BIT_MASK 0x80 /end MEASUREMENT
/begin MEASUREMENT B_zws0 "Bedingung öbergang zur einfachen SchliesszeitÅberlappung - Schliesszeitausgabe" UWORD B_TRUE___UW 0 0 0.000000 0.000000 /begin IF_DATA ASAP1B_ETK KP_BLOB 0xFD06 0 2 /end IF_DATA BIT_MASK 0x40 /end MEASUREMENT
/begin MEASUREMENT cc_cha_0 "" UWORD dez___UW 0 0 0.000000 65535.000000 /begin IF_DATA ASAP1B_ETK KP_BLOB 0xF94C 0 2 /end IF_DATA BIT_MASK 0xFFFF /end MEASUREMENT
/begin MEASUREMENT cc_cha_1 "" UWORD dez___UW 0 0 0.000000 65535.000000 /begin IF_DATA ASAP1B_ETK KP_BLOB 0xF94E 0 2 /end IF_DATA BIT_MASK 0xFFFF /end MEASUREMENT
/begin MEASUREMENT cc_cha_2 "" UWORD dez___UW 0 0 0.000000 65535.000000 /begin IF_DATA ASAP1B_ETK KP_BLOB 0xF950 0 2 /end IF_DATA BIT_MASK 0xFFFF /end MEASUREMENT
/begin MEASUREMENT cc_cha_3 "" UWORD dez___UW 0 0 0.000000 65535.000000 /begin IF_DATA ASAP1B_ETK KP_BLOB 0xF952 0 2 /end IF_DATA BIT_MASK 0xFFFF /end MEASUREMENT
/begin MEASUREMENT cc_cha_4 "" UWORD dez___UW 0 0 0.000000 65535.000000 /begin IF_DATA ASAP1B_ETK KP_BLOB 0xF954 0 2 /end IF_DATA BIT_MASK 0xFFFF /end MEASUREMENT
/begin MEASUREMENT cc_cha_5 "" UWORD dez___UW 0 0 0.000000 65535.000000 /begin IF_DATA ASAP1B_ETK KP_BLOB 0xF956 0 2 /end IF_DATA BIT_MASK 0xFFFF /end MEASUREMENT
/begin MEASUREMENT cc_cha_6 "" UWORD dez___UW 0 0 0.000000 65535.000000 /begin IF_DATA ASAP1B_ETK KP_BLOB 0xF958 0 2 /end IF_DATA BIT_MASK 0xFFFF /end MEASUREMENT
/begin MEASUREMENT cc_cha_7 "" UWORD dez___UW 0 0 0.000000 65535.000000 /begin IF_DATA ASAP1B_ETK KP_BLOB 0xF95A 0 2 /end IF_DATA BIT_MASK 0xFFFF /end MEASUREMENT
/begin MEASUREMENT dekpub "Differenz der Batteriespannung zwischen zwei Messungen bis EKP-Dauerbetrieb" UBYTE spg_ubatt 0 0 0.000000 17.952000 /begin IF_DATA ASAP1B_ETK KP_BLOB 0x380D2E 1 1 /end IF_DATA BIT_MASK 0xFF /end MEASUREMENT
/begin MEASUREMENT deltaseg_w "" UWORD dez___UW 0 0 0.000000 65535.000000 /begin IF_DATA ASAP1B_ETK KP_BLOB 0x381D2E 1 2 /end IF_DATA BIT_MASK 0xFFFF /end MEASUREMENT
/begin MEASUREMENT devoff "EV-Ausblendmaske bei Testeranforderung" UBYTE dez 0 0 0.000000 255.000000 /begin IF_DATA ASAP1B_ETK KP_BLOB 0x380C5A 1 1 /end IF_DATA BIT_MASK 0xFF /end MEASUREMENT
/begin MEASUREMENT dfuelsan_w "Delta FÅllungssensor zu Alpha/n-System" SWORD fak_sw_b1 0 0 -1.000000 0.999969 /begin IF_DATA ASAP1B_ETK KP_BLOB 0x381E56 1 2 /end IF_DATA BIT_MASK 0xFFFF /end MEASUREMENT
/begin MEASUREMENT dklagerc "FehlerzÑhler DK-LageÅberwachung" UBYTE t20msxs_ub_b5p1 0 0 0.000000 5.100000 /begin IF_DATA ASAP1B_ETK KP_BLOB 0x380ADE 1 1 /end IF_DATA BIT_MASK 0xFF /end MEASUREMENT
/begin MEASUREMENT dkpstg_w "Steigung DK-Poti (% DK / V)" UWORD rel_uw_b40 0 0 0.000000 39.999390 /begin IF_DATA ASAP1B_ETK KP_BLOB 0x381CE2 1 2 /end IF_DATA BIT_MASK 0xFFFF /end MEASUREMENT
/begin MEASUREMENT dlrd "DLR, D-Parameter" UBYTE relDK_q4 0 0 0.000000 1020.000000 /begin IF_DATA ASAP1B_ETK KP_BLOB 0xF8F4 0 1 /end IF_DATA BIT_MASK 0xFF /end MEASUREMENT
/begin MEASUREMENT dlri "DLR, I-Parameter" UBYTE relDK_q0p0625 0 0 0.000000 15.937500 /begin IF_DATA ASAP1B_ETK KP_BLOB 0xF8F5 0 1 /end IF_DATA BIT_MASK 0xFF /end MEASUREMENT
/begin MEASUREMENT dlriamax "DLR, maximal mîglicher I-Anteil" UWORD rel_q0p1957 0 0 0.000000 12824.853229 /begin IF_DATA ASAP1B_ETK KP_BLOB 0xF8FA 0 2 /end IF_DATA BIT_MASK 0xFFFF /end MEASUREMENT
/begin MEASUREMENT dlriant_w "DLR, I-Anteil, highword von dlriant_l" SWORD rel_sw_q0p1953 0 0 -6400.000000 6399.804688 /begin IF_DATA ASAP1B_ETK KP_BLOB 0x381D0A 1 2 /end IF_DATA BIT_MASK 0xFFFF /end MEASUREMENT
/begin MEASUREMENT dlriklst_w "Vorladewert I-Kleinanteil" SWORD rel_q0p1957___SW 0 0 -6412.524462 6412.328767 /begin IF_DATA ASAP1B_ETK KP_BLOB 0x381D0C 1 2 /end IF_DATA BIT_MASK 0xFFFF /end MEASUREMENT
/begin MEASUREMENT dlrikl_w "DLR, I-Kleinanteil" SWORD rel_q0p1957___SW 0 0 -6412.524462 6412.328767 /begin IF_DATA ASAP1B_ETK KP_BLOB 0xF8FC 0 2 /end IF_DATA BIT_MASK 0xFFFF /end MEASUREMENT
/begin MEASUREMENT dlrkomp "DLR, Faktor KreisverstÑrkung" UBYTE fak_ub_b2 0 0 0.000000 1.992188 /begin IF_DATA ASAP1B_ETK KP_BLOB 0xF8F6 0 1 /end IF_DATA BIT_MASK 0xFF /end MEASUREMENT
/begin MEASUREMENT dlrmxt "timer fÅr DLR im UMA in der Begrenzung" UBYTE t50msxs_q0p05 0 0 0.000000 12.750000 /begin IF_DATA ASAP1B_ETK KP_BLOB 0x380AD1 1 1 /end IF_DATA BIT_MASK 0xFF /end MEASUREMENT
/begin MEASUREMENT dlrndif_w "Istwert aktuell - Istwert letzter fÅr D-Anteil des DLR" SWORD relDK_q0p02441 0 0 -800.000000 799.975586 /begin IF_DATA ASAP1B_ETK KP_BLOB 0xF8FE 0 2 /end IF_DATA BIT_MASK 0xFFFF /end MEASUREMENT
/begin MEASUREMENT dlrp "DLR, P-Parameter" UBYTE relDK_q1 0 0 0.000000 255.000000 /begin IF_DATA ASAP1B_ETK KP_BLOB 0xF8F7 0 1 /end IF_DATA BIT_MASK 0xFF /end MEASUREMENT
/begin MEASUREMENT dlrpidc "FehlerzÑhler DLR-StellbereichsÅberwachung" UWORD t10msxs_uw_b655p35 0 0 0.000000 655.350000 /begin IF_DATA ASAP1B_ETK KP_BLOB 0x381D0E 1 2 /end IF_DATA BIT_MASK 0xFFFF /end MEASUREMENT
/begin MEASUREMENT dlrspid_w "DLR fÅr DV-E: Summe der PID-Anteile" UWORD rel_uw_b100 0 0 0.000000 99.998474 /begin IF_DATA ASAP1B_ETK KP_BLOB 0xF900 0 2 /end IF_DATA BIT_MASK 0xFFFF /end MEASUREMENT
/begin MEASUREMENT dmar_w "Delta Drehmoment antiruckel" SWORD rel_sw_b100 0 0 -100.000000 99.996948 /begin IF_DATA ASAP1B_ETK KP_BLOB 0x3823D8 1 2 /end IF_DATA BIT_MASK 0xFFFF /end MEASUREMENT
/begin MEASUREMENT dnmotas_w "Differenzdrehzahl Åber ein Arbeitsspiel" SWORD nmot_sw_q0p25 0 0 -8192.000000 8191.750000 /begin IF_DATA ASAP1B_ETK KP_BLOB 0x381A98 1 2 /end IF_DATA BIT_MASK 0xFFFF /end MEASUREMENT
/begin MEASUREMENT dnmot_w "Differenzdrehzahl zwischen zwei folgenden Segmenten" SWORD nmot_sw_q0p25 0 0 -8192.000000 8191.750000 /begin IF_DATA ASAP1B_ETK KP_BLOB 0x381A9A 1 2 /end IF_DATA BIT_MASK 0xFFFF /end MEASUREMENT
/begin MEASUREMENT dnsa "ZeitabhÑngige Schubhysterese" UBYTE nmot_ub_q40 0 0 0.000000 10200.000000 /begin IF_DATA ASAP1B_ETK KP_BLOB 0x380C0F 1 1 /end IF_DATA BIT_MASK 0xFF /end MEASUREMENT
/begin MEASUREMENT dpwrsvc "ZeitzÑhler DV-E-Powersave" UWORD t10msxs_uw_b655p35 0 0 0.000000 655.350000 /begin IF_DATA ASAP1B_ETK KP_BLOB 0x381D10 1 2 /end IF_DATA BIT_MASK 0xFFFF /end MEASUREMENT
/begin MEASUREMENT drllad_w "Dynamikanteil der relativen FÅllung rl bei Laderdynamik" SWORD rel_sw_q0p0234 0 0 -768.000000 767.976562 /begin IF_DATA ASAP1B_ETK KP_BLOB 0x381E58 1 2 /end IF_DATA BIT_MASK 0xFFFF /end MEASUREMENT
/begin MEASUREMENT dub "Batteriespannungsabweichung fÅr Batteriespannungsregelung" SBYTE spg_ubatt___SB 0 0 -9.011200 8.940800 /begin IF_DATA ASAP1B_ETK KP_BLOB 0x380AAD 1 1 /end IF_DATA BIT_MASK 0xFF /end MEASUREMENT
/begin MEASUREMENT dveadchst "DV-E-Adaption: Status PrÅfbedingungen" UBYTE dez 0 0 0.000000 255.000000 /begin IF_DATA ASAP1B_ETK KP_BLOB 0x380AD2 1 1 /end IF_DATA BIT_MASK 0xFF /end MEASUREMENT
/begin MEASUREMENT dveesc "EntprellzÑhler fÅr DV-E-Endstufe" UBYTE t10msxs_ub_b2p55 0 0 0.000000 2.550000 /begin IF_DATA ASAP1B_ETK KP_BLOB 0x380ADF 1 1 /end IF_DATA BIT_MASK 0xFF /end MEASUREMENT
/begin MEASUREMENT dwdkdlr_w "Differenz-DK-Winkel Sollwert - Istwert (wdkdlr_w - wdkba_w)" SWORD relDK_q0p02441 0 0 -800.000000 799.975586 /begin IF_DATA ASAP1B_ETK KP_BLOB 0xF902 0 2 /end IF_DATA BIT_MASK 0xFFFF /end MEASUREMENT
/begin MEASUREMENT dynPeriod "" SWORD dez___SW 0 0 -32768.000000 32767.000000 /begin IF_DATA ASAP1B_ETK KP_BLOB 0x380D34 1 2 /end IF_DATA BIT_MASK 0xFFFF /end MEASUREMENT
/begin MEASUREMENT dzaCtr "" UBYTE dez 0 0 0.000000 255.000000 /begin IF_DATA ASAP1B_ETK KP_BLOB 0xF7B8 0 1 /end IF_DATA BIT_MASK 0xFF /end MEASUREMENT
/begin MEASUREMENT eevx "EV Fehlerbyte" UBYTE dez 0 0 0.000000 255.000000 /begin IF_DATA ASAP1B_ETK KP_BLOB 0x380B19 1 1 /end IF_DATA BIT_MASK 0xFF /end MEASUREMENT
/begin MEASUREMENT esst_sez06tmub "" UWORD dez___UW 0 0 0.000000 65535.000000 /begin IF_DATA ASAP1B_ETK KP_BLOB 0x380E0A 1 2 /end IF_DATA BIT_MASK 0xFFFF /end MEASUREMENT
/begin MEASUREMENT esst_sga06mdub "" UWORD dez___UW 0 0 0.000000 65535.000000 /begin IF_DATA ASAP1B_ETK KP_BLOB 0x380E0E 1 2 /end IF_DATA BIT_MASK 0xFFFF /end MEASUREMENT
/begin MEASUREMENT esst_sga08mdub "" UWORD dez___UW 0 0 0.000000 65535.000000 /begin IF_DATA ASAP1B_ETK KP_BLOB 0x380E60 1 2 /end IF_DATA BIT_MASK 0xFFFF /end MEASUREMENT
/begin MEASUREMENT esst_slx06tmuw "" UWORD dez___UW 0 0 0.000000 65535.000000 /begin IF_DATA ASAP1B_ETK KP_BLOB 0x380E10 1 2 /end IF_DATA BIT_MASK 0xFFFF /end MEASUREMENT
/begin MEASUREMENT esst_smk08mdsw "" UWORD dez___UW 0 0 0.000000 65535.000000 /begin IF_DATA ASAP1B_ETK KP_BLOB 0x3823D6 1 2 /end IF_DATA BIT_MASK 0xFFFF /end MEASUREMENT
/begin MEASUREMENT esst_sml06tmub "" UWORD dez___UW 0 0 0.000000 65535.000000 /begin IF_DATA ASAP1B_ETK KP_BLOB 0x380E18 1 2 /end IF_DATA BIT_MASK 0xFFFF /end MEASUREMENT
/begin MEASUREMENT esst_sml07tmuw "" UWORD dez___UW 0 0 0.000000 65535.000000 /begin IF_DATA ASAP1B_ETK KP_BLOB 0x380E1A 1 2 /end IF_DATA BIT_MASK 0xFFFF /end MEASUREMENT
/begin MEASUREMENT esst_snm08__ub "" UWORD dez___UW 0 0 0.000000 65535.000000 /begin IF_DATA ASAP1B_ETK KP_BLOB 0x380E2C 1 2 /end IF_DATA BIT_MASK 0xFFFF /end MEASUREMENT
/begin MEASUREMENT esst_snm12feub "" UWORD dez___UW 0 0 0.000000 65535.000000 /begin IF_DATA ASAP1B_ETK KP_BLOB 0x380E76 1 2 /end IF_DATA BIT_MASK 0xFFFF /end MEASUREMENT
/begin MEASUREMENT esst_snm16ciub "" UWORD dez___UW 0 0 0.000000 65535.000000 /begin IF_DATA ASAP1B_ETK KP_BLOB 0x380E30 1 2 /end IF_DATA BIT_MASK 0xFFFF /end MEASUREMENT
/begin MEASUREMENT esst_st107tmub "" UWORD dez___UW 0 0 0.000000 65535.000000 /begin IF_DATA ASAP1B_ETK KP_BLOB 0x380E46 1 2 /end IF_DATA BIT_MASK 0xFFFF /end MEASUREMENT
/begin MEASUREMENT esst_st307tmub "" UWORD dez___UW 0 0 0.000000 65535.000000 /begin IF_DATA ASAP1B_ETK KP_BLOB 0x380E48 1 2 /end IF_DATA BIT_MASK 0xFFFF /end MEASUREMENT
/begin MEASUREMENT esst_stm04__ub "" UWORD dez___UW 0 0 0.000000 65535.000000 /begin IF_DATA ASAP1B_ETK KP_BLOB 0x380E4C 1 2 /end IF_DATA BIT_MASK 0xFFFF /end MEASUREMENT
/begin MEASUREMENT esst_stm05saub "" UWORD dez___UW 0 0 0.000000 65535.000000 /begin IF_DATA ASAP1B_ETK KP_BLOB 0x380E4E 1 2 /end IF_DATA BIT_MASK 0xFFFF /end MEASUREMENT
/begin MEASUREMENT esst_stm05tmub "" UWORD dez___UW 0 0 0.000000 65535.000000 /begin IF_DATA ASAP1B_ETK KP_BLOB 0x380E50 1 2 /end IF_DATA BIT_MASK 0xFFFF /end MEASUREMENT
/begin MEASUREMENT esst_sts06tmuw "" UWORD dez___UW 0 0 0.000000 65535.000000 /begin IF_DATA ASAP1B_ETK KP_BLOB 0x381B06 1 2 /end IF_DATA BIT_MASK 0xFFFF /end MEASUREMENT
/begin MEASUREMENT evrbgn "Ev Nr. bei Beginn der Ev-Abschaltung Åber Momentenreduzierung" UBYTE dez 0 0 0.000000 255.000000 /begin IF_DATA ASAP1B_ETK KP_BLOB 0x380B1A 1 1 /end IF_DATA BIT_MASK 0xFF /end MEASUREMENT
/begin MEASUREMENT evz_ags "Einspritzausblendmuster gesamt von einem oder 2 SG" UBYTE dez 0 0 0.000000 255.000000 /begin IF_DATA ASAP1B_ETK KP_BLOB 0x380B1C 1 1 /end IF_DATA BIT_MASK 0xFF /end MEASUREMENT
/begin MEASUREMENT evz_aus "Lowbwyte von BK_EVAUS" UBYTE dez 0 0 0.000000 255.000000 /begin IF_DATA ASAP1B_ETK KP_BLOB 0x380B1D 1 1 /end IF_DATA BIT_MASK 0xFF /end MEASUREMENT
/begin MEASUREMENT evz_austot "Einspritzausblendmuster total" UBYTE dez 0 0 0.000000 255.000000 /begin IF_DATA ASAP1B_ETK KP_BLOB 0x380B1E 1 1 /end IF_DATA BIT_MASK 0xFF /end MEASUREMENT
/begin MEASUREMENT fcmEnd "Anzahl EintrÑge im Fehlerspeicher" UBYTE dez 0 0 0.000000 255.000000 /begin IF_DATA ASAP1B_ETK KP_BLOB 0x383307 1 1 /end IF_DATA BIT_MASK 0xFF /end MEASUREMENT
/begin MEASUREMENT FCMTab "" UWORD dez___UW 0 0 0.000000 65535.000000 /begin IF_DATA ASAP1B_ETK KP_BLOB 0x383846 1 2 /end IF_DATA BIT_MASK 0xFFFF /end MEASUREMENT
/begin MEASUREMENT fdar "VerstÑrkungsfaktor des AR-Eingriffs" UBYTE fak_ub_b3p125 0 0 0.000000 3.112793 /begin IF_DATA ASAP1B_ETK KP_BLOB 0x380C36 1 1 /end IF_DATA BIT_MASK 0xFF /end MEASUREMENT
/begin MEASUREMENT fgezs0 "" UBYTE fak_ub_b2 0 0 0.000000 1.992188 /begin IF_DATA ASAP1B_ETK KP_BLOB 0xF91F 0 1 /end IF_DATA BIT_MASK 0xFF /end MEASUREMENT
/begin MEASUREMENT fgezs1 "" UBYTE fak_ub_b2 0 0 0.000000 1.992188 /begin IF_DATA ASAP1B_ETK KP_BLOB 0xF920 0 1 /end IF_DATA BIT_MASK 0xFF /end MEASUREMENT
/begin MEASUREMENT fgezs2 "" UBYTE fak_ub_b2 0 0 0.000000 1.992188 /begin IF_DATA ASAP1B_ETK KP_BLOB 0xF921 0 1 /end IF_DATA BIT_MASK 0xFF /end MEASUREMENT
/begin MEASUREMENT fgezs3 "" UBYTE fak_ub_b2 0 0 0.000000 1.992188 /begin IF_DATA ASAP1B_ETK KP_BLOB 0xF922 0 1 /end IF_DATA BIT_MASK 0xFF /end MEASUREMENT
/begin MEASUREMENT fgezs4 "" UBYTE fak_ub_b2 0 0 0.000000 1.992188 /begin IF_DATA ASAP1B_ETK KP_BLOB 0xF923 0 1 /end IF_DATA BIT_MASK 0xFF /end MEASUREMENT
/begin MEASUREMENT fgezs5 "" UBYTE fak_ub_b2 0 0 0.000000 1.992188 /begin IF_DATA ASAP1B_ETK KP_BLOB 0xF924 0 1 /end IF_DATA BIT_MASK 0xFF /end MEASUREMENT
/begin MEASUREMENT fgezs6 "" UBYTE fak_ub_b2 0 0 0.000000 1.992188 /begin IF_DATA ASAP1B_ETK KP_BLOB 0xF925 0 1 /end IF_DATA BIT_MASK 0xFF /end MEASUREMENT
/begin MEASUREMENT fgezs7 "" UBYTE fak_ub_b2 0 0 0.000000 1.992188 /begin IF_DATA ASAP1B_ETK KP_BLOB 0xF926 0 1 /end IF_DATA BIT_MASK 0xFF /end MEASUREMENT
/begin MEASUREMENT fgnsol "Faktor zur Beeinflussung der Getriebesolldrehzahl" UBYTE rel_ub_b99p6 0 0 0.000000 99.609375 /begin IF_DATA ASAP1B_ETK KP_BLOB 0x380C15 1 1 /end IF_DATA BIT_MASK 0xFF /end MEASUREMENT
/begin MEASUREMENT fhost_w "Korrekturfaktor Hîhe bei Start(word)" UWORD fak_uw_b4 0 0 0.000000 3.999939 /begin IF_DATA ASAP1B_ETK KP_BLOB 0x382114 1 2 /end IF_DATA BIT_MASK 0xFFFF /end MEASUREMENT
/begin MEASUREMENT fkhab "Faktor Katheizen zur Abregelung" UBYTE fak_ub_b1 0 0 0.000000 0.996094 /begin IF_DATA ASAP1B_ETK KP_BLOB 0x380B64 1 1 /end IF_DATA BIT_MASK 0xFF /end MEASUREMENT
/begin MEASUREMENT fklaf_w "Faktor Ausflu· (KLAF)" UWORD fak_uw_b1 0 0 0.000000 0.999985 /begin IF_DATA ASAP1B_ETK KP_BLOB 0x383C5E 1 2 /end IF_DATA BIT_MASK 0xFFFF /end MEASUREMENT
/begin MEASUREMENT fkmsdks_w "Korrekturfaktor schneller Massenstromabgleich" UWORD fak_uw_b4 0 0 0.000000 3.999939 /begin IF_DATA ASAP1B_ETK KP_BLOB 0x381E5A 1 2 /end IF_DATA BIT_MASK 0xFFFF /end MEASUREMENT
/begin MEASUREMENT fkmsdk_w "Korrekturfaktor Massenstrom NebenfÅllungssignal" UWORD fak_uw_b4 0 0 0.000000 3.999939 /begin IF_DATA ASAP1B_ETK KP_BLOB 0x381E5C 1 2 /end IF_DATA BIT_MASK 0xFFFF /end MEASUREMENT
/begin MEASUREMENT fkpvdk_w "Korrekturfaktor langsamer Massenstromabgleich" UWORD fak_uw_b4 0 0 0.000000 3.999939 /begin IF_DATA ASAP1B_ETK KP_BLOB 0x383C60 1 2 /end IF_DATA BIT_MASK 0xFFFF /end MEASUREMENT
/begin MEASUREMENT flakh "Faktor Lambda-Steuerung bei Katheizen" UBYTE fak_ub_b1 0 0 0.000000 0.996094 /begin IF_DATA ASAP1B_ETK KP_BLOB 0x380B65 1 1 /end IF_DATA BIT_MASK 0xFF /end MEASUREMENT
/begin MEASUREMENT flamkh "Faktor Aufregelung Lambda-Motor-Soll bei Katheizen" UBYTE fak_ub_b1 0 0 0.000000 0.996094 /begin IF_DATA ASAP1B_ETK KP_BLOB 0x380B66 1 1 /end IF_DATA BIT_MASK 0xFF /end MEASUREMENT
/begin MEASUREMENT flgtiab "Statusflag ti-Abschaltung bei kat.schÑdigenden Aussetzerraten" UBYTE dez 0 0 0.000000 255.000000 /begin IF_DATA ASAP1B_ETK KP_BLOB 0x380A30 1 1 /end IF_DATA BIT_MASK 0xFF /end MEASUREMENT
/begin MEASUREMENT flrar "VerstÑrkungsfaktor zum Nachbilden der externen Last" UBYTE fak_ub_b16 0 0 0.000000 15.937500 /begin IF_DATA ASAP1B_ETK KP_BLOB 0x380C37 1 1 /end IF_DATA BIT_MASK 0xFF /end MEASUREMENT
/begin MEASUREMENT fmdkh "Faktor Steuerung Drehmomentreserve fÅr Katheizen" UBYTE fak_ub_b1 0 0 0.000000 0.996094 /begin IF_DATA ASAP1B_ETK KP_BLOB 0x380B67 1 1 /end IF_DATA BIT_MASK 0xFF /end MEASUREMENT
/begin MEASUREMENT fmdkhtns_w "" UWORD fak_uw_b1 0 0 0.000000 0.999985 /begin IF_DATA ASAP1B_ETK KP_BLOB 0x382116 1 2 /end IF_DATA BIT_MASK 0xFFFF /end MEASUREMENT
/begin MEASUREMENT fpag_w "Faktor Abgasgegendruck" UWORD fak_uw_b2 0 0 0.000000 1.999969 /begin IF_DATA ASAP1B_ETK KP_BLOB 0x381EEE 1 2 /end IF_DATA BIT_MASK 0xFFFF /end MEASUREMENT
/begin MEASUREMENT fprstep_c "SchrittzÑhler DK-RÅckstellfeder-PrÅfung" UBYTE dez 0 0 0.000000 255.000000 /begin IF_DATA ASAP1B_ETK KP_BLOB 0x380AD3 1 1 /end IF_DATA BIT_MASK 0xFF /end MEASUREMENT
/begin MEASUREMENT fprtim_c "ZeitzÑhler DK-RÅckstellfeder-PrÅfung" UBYTE t10msxs_ub_b2p55 0 0 0.000000 2.550000 /begin IF_DATA ASAP1B_ETK KP_BLOB 0x380AD4 1 1 /end IF_DATA BIT_MASK 0xFF /end MEASUREMENT
/begin MEASUREMENT fpvdk "Korrekturfaktor Druck vor Drosselklappe" UBYTE fak_ub_b4 0 0 0.000000 3.984375 /begin IF_DATA ASAP1B_ETK KP_BLOB 0x380AE8 1 1 /end IF_DATA BIT_MASK 0xFF /end MEASUREMENT
/begin MEASUREMENT fpvdkds_w "Faktor Druck vor Drosselklappe von Drucksensor (word)" UWORD fak_uw_b4 0 0 0.000000 3.999939 /begin IF_DATA ASAP1B_ETK KP_BLOB 0x381EA8 1 2 /end IF_DATA BIT_MASK 0xFFFF /end MEASUREMENT
/begin MEASUREMENT fpvdk_w "Korrekturfaktor Druck vor Drosselklappe 16-Bit" UWORD fak_uw_b4 0 0 0.000000 3.999939 /begin IF_DATA ASAP1B_ETK KP_BLOB 0x381E5E 1 2 /end IF_DATA BIT_MASK 0xFFFF /end MEASUREMENT
/begin MEASUREMENT frhodk_w "Faktor Luftdichtekorrektur fÅr DK-Durchflu· f(Ansauglufttemp.,Hîhe) 16 Bit" UWORD fak_uw_b2 0 0 0.000000 1.999969 /begin IF_DATA ASAP1B_ETK KP_BLOB 0x381E60 1 2 /end IF_DATA BIT_MASK 0xFFFF /end MEASUREMENT
/begin MEASUREMENT frkte "Faktor Umrechnung rel. Kraftstoffmasse rk effekt. Einspritzzeit te" UBYTE rkti_sy 0 0 0.000000 0.544000 /begin IF_DATA ASAP1B_ETK KP_BLOB 0x380B40 1 1 /end IF_DATA BIT_MASK 0xFF /end MEASUREMENT
/begin MEASUREMENT ftead_w "Beladung des Aktivkohlefilters" SWORD fak_sw_b64 0 0 -64.000000 63.998047 /begin IF_DATA ASAP1B_ETK KP_BLOB 0x38267C 1 2 /end IF_DATA BIT_MASK 0xFFFF /end MEASUREMENT
/begin MEASUREMENT ftvdk "Korrekturfaktor Temperatur vor Drosselklappe" UBYTE fak_ub_b2 0 0 0.000000 1.992188 /begin IF_DATA ASAP1B_ETK KP_BLOB 0xF9AF 0 1 /end IF_DATA BIT_MASK 0xFF /end MEASUREMENT
/begin MEASUREMENT fvisrm_w "Faktor VerstÑrkung Integrator Saugrohrmodell" UWORD p_uw_b32 0 0 0.000000 31.999512 /begin IF_DATA ASAP1B_ETK KP_BLOB 0x381E36 1 2 /end IF_DATA BIT_MASK 0xFFFF /end MEASUREMENT
/begin MEASUREMENT fweg "maximaler Faktor Wiedereinsetzmehrmenge" UBYTE fak_ub_b2 0 0 0.000000 1.992188 /begin IF_DATA ASAP1B_ETK KP_BLOB 0xF927 0 1 /end IF_DATA BIT_MASK 0xFF /end MEASUREMENT
/begin MEASUREMENT fwez0 "Faktor Wiedereinsetzmenge zylinderindividuell Zyl. 1" UBYTE fak_ub_b2 0 0 0.000000 1.992188 /begin IF_DATA ASAP1B_ETK KP_BLOB 0xF928 0 1 /end IF_DATA BIT_MASK 0xFF /end MEASUREMENT
/begin MEASUREMENT fwez1 "Faktor Wiedereinsetzmenge zylinderindividuell Zyl. 2" UBYTE fak_ub_b2 0 0 0.000000 1.992188 /begin IF_DATA ASAP1B_ETK KP_BLOB 0xF929 0 1 /end IF_DATA BIT_MASK 0xFF /end MEASUREMENT
/begin MEASUREMENT fwez2 "Faktor Wiedereinsetzmenge zylinderindividuell Zyl. 3" UBYTE fak_ub_b2 0 0 0.000000 1.992188 /begin IF_DATA ASAP1B_ETK KP_BLOB 0xF92A 0 1 /end IF_DATA BIT_MASK 0xFF /end MEASUREMENT
/begin MEASUREMENT fwez3 "Faktor Wiedereinsetzmenge zylinderindividuell Zyl. 4" UBYTE fak_ub_b2 0 0 0.000000 1.992188 /begin IF_DATA ASAP1B_ETK KP_BLOB 0xF92B 0 1 /end IF_DATA BIT_MASK 0xFF /end MEASUREMENT
/begin MEASUREMENT fwez4 "Faktor Wiedereinsetzmenge zylinderindividuell Zyl. 5" UBYTE fak_ub_b2 0 0 0.000000 1.992188 /begin IF_DATA ASAP1B_ETK KP_BLOB 0xF92C 0 1 /end IF_DATA BIT_MASK 0xFF /end MEASUREMENT
/begin MEASUREMENT fwez5 "Faktor Wiedereinsetzmenge zylinderindividuell Zyl. 6" UBYTE fak_ub_b2 0 0 0.000000 1.992188 /begin IF_DATA ASAP1B_ETK KP_BLOB 0xF92D 0 1 /end IF_DATA BIT_MASK 0xFF /end MEASUREMENT
/begin MEASUREMENT fwez6 "Faktor Wiedereinsetzmenge zylinderindividuell Zyl. 7" UBYTE fak_ub_b2 0 0 0.000000 1.992188 /begin IF_DATA ASAP1B_ETK KP_BLOB 0xF92E 0 1 /end IF_DATA BIT_MASK 0xFF /end MEASUREMENT
/begin MEASUREMENT fwez7 "Faktor Wiedereinsetzmenge zylinderindividuell Zyl. 8" UBYTE fak_ub_b2 0 0 0.000000 1.992188 /begin IF_DATA ASAP1B_ETK KP_BLOB 0xF92F 0 1 /end IF_DATA BIT_MASK 0xFF /end MEASUREMENT
/begin MEASUREMENT gangauti "bei Automatikgetriebe Åber CAN empfangener aktueller Gang" UBYTE DEZ 0 0 0.000000 255.000000 /begin IF_DATA ASAP1B_ETK KP_BLOB 0x3809C2 1 1 /end IF_DATA BIT_MASK 0xFF /end MEASUREMENT
/begin MEASUREMENT gwdkdlr_w "énderung des Drosselklappen-Sollwinkels, Betrag fÅr Kennlinieneingang" SWORD relDK_q0p00152 0 0 -50.000000 49.998474 /begin IF_DATA ASAP1B_ETK KP_BLOB 0xF904 0 2 /end IF_DATA BIT_MASK 0xFFFF /end MEASUREMENT
/begin MEASUREMENT hagr "Hub AGR-Ventil" UBYTE rel_ub_b99p6 0 0 0.000000 99.609375 /begin IF_DATA ASAP1B_ETK KP_BLOB 0x380987 1 1 /end IF_DATA BIT_MASK 0xFF /end MEASUREMENT
/begin MEASUREMENT iasp1plaus_w "" UWORD spg_uw_b5 0 0 0.000000 319.995117 /begin IF_DATA ASAP1B_ETK KP_BLOB 0x380F7C 1 2 /end IF_DATA BIT_MASK 0xFFFF /end MEASUREMENT
/begin MEASUREMENT imlatm "integr. Luftmassenfluss ab Motorstart bis Max.wert" UBYTE m_ub_b23p3 0 0 0.000000 23.210667 /begin IF_DATA ASAP1B_ETK KP_BLOB 0x380A67 1 1 /end IF_DATA BIT_MASK 0xFF /end MEASUREMENT
/begin MEASUREMENT imlatmw_w "Dauer-RAM integr. Luftmassenfluss bei Abstellen" UWORD m_uw_b23p3 0 0 0.000000 23.301333 /begin IF_DATA ASAP1B_ETK KP_BLOB 0x383CA4 1 2 /end IF_DATA BIT_MASK 0xFFFF /end MEASUREMENT
/begin MEASUREMENT imlatm_w "integr. Luftmassenfluss ab Startende bis max. Wert, (Word)" UWORD m_uw_b23p3 0 0 0.000000 23.301333 /begin IF_DATA ASAP1B_ETK KP_BLOB 0x381B08 1 2 /end IF_DATA BIT_MASK 0xFFFF /end MEASUREMENT
/begin MEASUREMENT irspsyn "Index fÅr Ringspeicheradressierung tsegrsp_w, nmotrsp_w, rlrsp_w" UBYTE dez 0 0 0.000000 255.000000 /begin IF_DATA ASAP1B_ETK KP_BLOB 0x380A52 1 1 /end IF_DATA BIT_MASK 0xFF /end MEASUREMENT
/begin MEASUREMENT iUipoti1_w "" UWORD DEZ___UW 0 0 0.000000 65535.000000 /begin IF_DATA ASAP1B_ETK KP_BLOB 0xF7FA 0 2 /end IF_DATA BIT_MASK 0xFFFF /end MEASUREMENT
/begin MEASUREMENT iUipoti2_w "" UWORD DEZ___UW 0 0 0.000000 65535.000000 /begin IF_DATA ASAP1B_ETK KP_BLOB 0xF7F6 0 2 /end IF_DATA BIT_MASK 0xFFFF /end MEASUREMENT
/begin MEASUREMENT iUspoti1_w "" UWORD DEZ___UW 0 0 0.000000 65535.000000 /begin IF_DATA ASAP1B_ETK KP_BLOB 0xF7EC 0 2 /end IF_DATA BIT_MASK 0xFFFF /end MEASUREMENT
/begin MEASUREMENT iUspoti2_w "" UWORD DEZ___UW 0 0 0.000000 65535.000000 /begin IF_DATA ASAP1B_ETK KP_BLOB 0xF7EA 0 2 /end IF_DATA BIT_MASK 0xFFFF /end MEASUREMENT
/begin MEASUREMENT iwmatm_w "WÑrmemenge fÅr Kondenswasser-Taupunktende Abgas/Kat (word)" UWORD q_uw_q0p0566 0 0 0.000000 3712.000000 /begin IF_DATA ASAP1B_ETK KP_BLOB 0x381B0A 1 2 /end IF_DATA BIT_MASK 0xFFFF /end MEASUREMENT
/begin MEASUREMENT kifz_w "VerstÑrkung des Fahrzeugmodells" UWORD fak_uw_b4864 0 0 0.000000 4863.925781 /begin IF_DATA ASAP1B_ETK KP_BLOB 0x3823DA 1 2 /end IF_DATA BIT_MASK 0xFFFF /end MEASUREMENT
/begin MEASUREMENT kmstmil_w "ZurÅckgelegte Fahrstrecke mit MIL on" UWORD s_q1_km 0 0 0.000000 65535.000000 /begin IF_DATA ASAP1B_ETK KP_BLOB 0x383C1E 1 2 /end IF_DATA BIT_MASK 0xFFFF /end MEASUREMENT
/begin MEASUREMENT kmst_w "ZurÅckgelegte Fahrstrecke seit Powerfail" UWORD s_q6_km 0 0 0.000000 393210.000000 /begin IF_DATA ASAP1B_ETK KP_BLOB 0x383C20 1 2 /end IF_DATA BIT_MASK 0xFFFF /end MEASUREMENT
/begin MEASUREMENT kwp71_bits "" UBYTE dez 0 0 0.000000 255.000000 /begin IF_DATA ASAP1B_ETK KP_BLOB 0x380BEF 1 1 /end IF_DATA BIT_MASK 0xFF /end MEASUREMENT
/begin MEASUREMENT lbz "Ladebilanz der Batterie" UBYTE rel_ub_b99p6 0 0 0.000000 99.609375 /begin IF_DATA ASAP1B_ETK KP_BLOB 0x380AAE 1 1 /end IF_DATA BIT_MASK 0xFF /end MEASUREMENT
/begin MEASUREMENT lokBits_Aekp "" UBYTE dez 0 0 0.000000 255.000000 /begin IF_DATA ASAP1B_ETK KP_BLOB 0x380D2D 1 1 /end IF_DATA BIT_MASK 0xFF /end MEASUREMENT
/begin MEASUREMENT lrnstep_c "ZÑhler fÅr Lerndauer eines Lernsteps" UBYTE dez 0 0 0.000000 255.000000 /begin IF_DATA ASAP1B_ETK KP_BLOB 0x380AD5 1 1 /end IF_DATA BIT_MASK 0xFF /end MEASUREMENT
/begin MEASUREMENT lrntim_c "ZeitzÑhler fÅr Wartezeit in den Lernschritten" UBYTE t20msxs_ub_b5p1 0 0 0.000000 5.100000 /begin IF_DATA ASAP1B_ETK KP_BLOB 0x380AD6 1 1 /end IF_DATA BIT_MASK 0xFF /end MEASUREMENT
/begin MEASUREMENT lrnvb_c "LernverbotszÑhler (Wartezeit)" UWORD t20msxs_uw_q0p02 0 0 0.000000 1310.700000 /begin IF_DATA ASAP1B_ETK KP_BLOB 0x381CE4 1 2 /end IF_DATA BIT_MASK 0xFFFF /end MEASUREMENT
/begin MEASUREMENT mdbes_w "Beschleunigungsmoment" SWORD rel_sw_b100 0 0 -100.000000 99.996948 /begin IF_DATA ASAP1B_ETK KP_BLOB 0x3823DC 1 2 /end IF_DATA BIT_MASK 0xFFFF /end MEASUREMENT
/begin MEASUREMENT mdverl_w "Motor-Verlustmoment" UWORD rel_uw_b100 0 0 0.000000 99.998474 /begin IF_DATA ASAP1B_ETK KP_BLOB 0x3823BC 1 2 /end IF_DATA BIT_MASK 0xFFFF /end MEASUREMENT
/begin MEASUREMENT minzahn "Minimale Zahnzahl ab TR-Marke ab dem ZÅndereignis stattfinden kann" UBYTE dez 0 0 0.000000 255.000000 /begin IF_DATA ASAP1B_ETK KP_BLOB 0xF7B9 0 1 /end IF_DATA BIT_MASK 0xFF /end MEASUREMENT
/begin MEASUREMENT misolv_w "Indiziertes resultierendes Sollmoment vor Momentenbegrenzung" UWORD rel_uw_b100 0 0 0.000000 99.998474 /begin IF_DATA ASAP1B_ETK KP_BLOB 0x382482 1 2 /end IF_DATA BIT_MASK 0xFFFF /end MEASUREMENT
/begin MEASUREMENT mlast_w "geschÑtztes Lastmoment" SWORD rel_sw_b100 0 0 -100.000000 99.996948 /begin IF_DATA ASAP1B_ETK KP_BLOB 0x3823E0 1 2 /end IF_DATA BIT_MASK 0xFFFF /end MEASUREMENT
/begin MEASUREMENT mlbb "Luftmassenflu· gefiltert (Byte), Bank1 bezogen" UBYTE m_ub_b1020 0 0 0.000000 1020.000000 /begin IF_DATA ASAP1B_ETK KP_BLOB 0x380A74 1 1 /end IF_DATA BIT_MASK 0xFF /end MEASUREMENT
/begin MEASUREMENT mlbb_w "Luftmassenflu· gefiltert (Word), Bank1 bezogen" UWORD m_uw_b6553p5 0 0 0.000000 6553.500000 /begin IF_DATA ASAP1B_ETK KP_BLOB 0x381B7E 1 2 /end IF_DATA BIT_MASK 0xFFFF /end MEASUREMENT
/begin MEASUREMENT mlsu "Soll-Luftmasse fÅr Katheizen" UBYTE m_ub_b5p8 0 0 0.000000 5.802667 /begin IF_DATA ASAP1B_ETK KP_BLOB 0x380B62 1 1 /end IF_DATA BIT_MASK 0xFF /end MEASUREMENT
/begin MEASUREMENT msabg "Abgasmassenflu· gefiltert, Bank 1" UBYTE m_ub_b1020 0 0 0.000000 1020.000000 /begin IF_DATA ASAP1B_ETK KP_BLOB 0x380A75 1 1 /end IF_DATA BIT_MASK 0xFF /end MEASUREMENT
/begin MEASUREMENT msabg_w "Abgasmassenflu· gefiltert (Word), Bank 1" UWORD m_uw_b6553p5 0 0 0.000000 6553.500000 /begin IF_DATA ASAP1B_ETK KP_BLOB 0x381B80 1 2 /end IF_DATA BIT_MASK 0xFFFF /end MEASUREMENT
/begin MEASUREMENT msagr_w "AGR Massenstrom ins Saugrohr ( 16-Bit )" UWORD m_uw_b6553p5 0 0 0.000000 6553.500000 /begin IF_DATA ASAP1B_ETK KP_BLOB 0x381EF6 1 2 /end IF_DATA BIT_MASK 0xFFFF /end MEASUREMENT
/begin MEASUREMENT msdif_w "Massenstromdifferenz mshfm_w - msdk_w" SWORD m_sw_q0p1 0 0 -3276.800000 3276.700000 /begin IF_DATA ASAP1B_ETK KP_BLOB 0x381E64 1 2 /end IF_DATA BIT_MASK 0xFFFF /end MEASUREMENT
/begin MEASUREMENT msdkalm_w "Massenstrom Åber Drosselklappe (abgeglichen mit HFM Signal)" UWORD m_uw_b6553p5 0 0 0.000000 6553.500000 /begin IF_DATA ASAP1B_ETK KP_BLOB 0x381E66 1 2 /end IF_DATA BIT_MASK 0xFFFF /end MEASUREMENT
/begin MEASUREMENT msdkue_w "Massenstrom Åber Drosselklappe Åberkritisch (word)" UWORD m_uw_b6553p5 0 0 0.000000 6553.500000 /begin IF_DATA ASAP1B_ETK KP_BLOB 0x381E68 1 2 /end IF_DATA BIT_MASK 0xFFFF /end MEASUREMENT
/begin MEASUREMENT msdk_w "Massenstrom Åber Drosselklappe (word)" UWORD m_uw_b6553p5 0 0 0.000000 6553.500000 /begin IF_DATA ASAP1B_ETK KP_BLOB 0x381E6A 1 2 /end IF_DATA BIT_MASK 0xFFFF /end MEASUREMENT
/begin MEASUREMENT msl "SekundÑrluftmasse" UBYTE m_ub_q0p4 0 0 0.000000 102.000000 /begin IF_DATA ASAP1B_ETK KP_BLOB 0x380997 1 1 /end IF_DATA BIT_MASK 0xFF /end MEASUREMENT
/begin MEASUREMENT msndkoo_w "normierter Massenstrom Drosselklappe ohne offset (word)" UWORD m_uw_b6553p5 0 0 0.000000 6553.500000 /begin IF_DATA ASAP1B_ETK KP_BLOB 0x383C5A 1 2 /end IF_DATA BIT_MASK 0xFFFF /end MEASUREMENT
/begin MEASUREMENT msndko_w "normierter Leckluftmassenstrom Åber Drosselklappe (word)" UWORD m_uw_b6553p5 0 0 0.000000 6553.500000 /begin IF_DATA ASAP1B_ETK KP_BLOB 0x383C5C 1 2 /end IF_DATA BIT_MASK 0xFFFF /end MEASUREMENT
/begin MEASUREMENT msndk_w "normierter Massenstrom Åber Drosselklappe (word)" UWORD m_uw_b6553p5 0 0 0.000000 6553.500000 /begin IF_DATA ASAP1B_ETK KP_BLOB 0x381E6C 1 2 /end IF_DATA BIT_MASK 0xFFFF /end MEASUREMENT
/begin MEASUREMENT msnsaug_w "normierter Massenstrom durch Saugrohr (word)" UWORD m_uw_b6553p5 0 0 0.000000 6553.500000 /begin IF_DATA ASAP1B_ETK KP_BLOB 0x381E6E 1 2 /end IF_DATA BIT_MASK 0xFFFF /end MEASUREMENT
/begin MEASUREMENT msntagr_w "tatsÑchlicher Åberkritischer AGR-Massenstrom ( 16-Bit )" UWORD m_uw_b6553p5 0 0 0.000000 6553.500000 /begin IF_DATA ASAP1B_ETK KP_BLOB 0x381EF8 1 2 /end IF_DATA BIT_MASK 0xFFFF /end MEASUREMENT
/begin MEASUREMENT msntevo_w "normierter, Åberkritischer Massenstrom durch das 100% offene TEV" UWORD m_uw_b25p6 0 0 0.000000 25.599609 /begin IF_DATA ASAP1B_ETK KP_BLOB 0x3827C2 1 2 /end IF_DATA BIT_MASK 0xFFFF /end MEASUREMENT
/begin MEASUREMENT msnwdk_kge "" UWORD rel_uw_b100 0 0 0.000000 99.998474 /begin IF_DATA ASAP1B_ETK KP_BLOB 0x381E70 1 2 /end IF_DATA BIT_MASK 0xFFFF /end MEASUREMENT
/begin MEASUREMENT mssaug "Massenstrom durch Saugrohr (Byte)" UBYTE m_ub_q25p6 0 0 0.000000 6528.000000 /begin IF_DATA ASAP1B_ETK KP_BLOB 0x380AE9 1 1 /end IF_DATA BIT_MASK 0xFF /end MEASUREMENT
/begin MEASUREMENT mssaug_w "Massenstrom durch Saugrohr (word)" UWORD m_uw_b6553p5 0 0 0.000000 6553.500000 /begin IF_DATA ASAP1B_ETK KP_BLOB 0x381E72 1 2 /end IF_DATA BIT_MASK 0xFFFF /end MEASUREMENT
/begin MEASUREMENT mss_w "Massenstrom vom Sensor (Auswahl zwischen mshfm_w und ml_w)" UWORD m_uw_b6553p5 0 0 0.000000 6553.500000 /begin IF_DATA ASAP1B_ETK KP_BLOB 0x381E74 1 2 /end IF_DATA BIT_MASK 0xFFFF /end MEASUREMENT
/begin MEASUREMENT mste "Massenstrom TankentlÅftung ins Saugrohr" UBYTE m_ub_b25p6 0 0 0.000000 25.500000 /begin IF_DATA ASAP1B_ETK KP_BLOB 0xF9EE 0 1 /end IF_DATA BIT_MASK 0xFF /end MEASUREMENT
/begin MEASUREMENT msteo_w "Massenstom durch das 100% offene TEV" UWORD m_uw_b25p6 0 0 0.000000 25.599609 /begin IF_DATA ASAP1B_ETK KP_BLOB 0x3827D0 1 2 /end IF_DATA BIT_MASK 0xFFFF /end MEASUREMENT
/begin MEASUREMENT na_abs_c "" UBYTE dez 0 0 0.000000 255.000000 /begin IF_DATA ASAP1B_ETK KP_BLOB 0xF930 0 1 /end IF_DATA BIT_MASK 0xFF /end MEASUREMENT
/begin MEASUREMENT na_rel_c "" UBYTE dez 0 0 0.000000 255.000000 /begin IF_DATA ASAP1B_ETK KP_BLOB 0xF931 0 1 /end IF_DATA BIT_MASK 0xFF /end MEASUREMENT
/begin MEASUREMENT ndar_w "Differenzdrehzahl fÅr Momenteneingriff" SWORD nmot_sw_q0p25 0 0 -8192.000000 8191.750000 /begin IF_DATA ASAP1B_ETK KP_BLOB 0x3823E2 1 2 /end IF_DATA BIT_MASK 0xFFFF /end MEASUREMENT
/begin MEASUREMENT ndfibet_w "" UWORD nmot_uw_q0p25 0 0 0.000000 16383.750000 /begin IF_DATA ASAP1B_ETK KP_BLOB 0x3823E4 1 2 /end IF_DATA BIT_MASK 0xFFFF /end MEASUREMENT
/begin MEASUREMENT ndfil_w "gefilterte Differenzdrehzahl" SWORD nmot_sw_q0p25 0 0 -8192.000000 8191.750000 /begin IF_DATA ASAP1B_ETK KP_BLOB 0x3823E6 1 2 /end IF_DATA BIT_MASK 0xFFFF /end MEASUREMENT
/begin MEASUREMENT ndiffog_w "Schwelle Drehzahldifferenz zum Resetieren der AR beim Verzîgern" SWORD nmot_sw_q0p25 0 0 -8192.000000 8191.750000 /begin IF_DATA ASAP1B_ETK KP_BLOB 0x3823E8 1 2 /end IF_DATA BIT_MASK 0xFFFF /end MEASUREMENT
/begin MEASUREMENT ndiff_w "Differenzdrehzahl fÅr LFR-HS-VerstÑrkungen" SWORD nmot_sw_q0p25 0 0 -8192.000000 8191.750000 /begin IF_DATA ASAP1B_ETK KP_BLOB 0x3823EA 1 2 /end IF_DATA BIT_MASK 0xFFFF /end MEASUREMENT
/begin MEASUREMENT nfskh "Leerlaufdrehzahl Fahrstufe bei Katheizen" UBYTE nmot_ub_q10 0 0 0.000000 2550.000000 /begin IF_DATA ASAP1B_ETK KP_BLOB 0x380B69 1 1 /end IF_DATA BIT_MASK 0xFF /end MEASUREMENT
/begin MEASUREMENT ngas_w "Drehzahlgradient Åber ein Arbeitsspiel" SWORD nmotg_sw_q0p39 0 0 -12800.163840 12799.773210 /begin IF_DATA ASAP1B_ETK KP_BLOB 0x381A9C 1 2 /end IF_DATA BIT_MASK 0xFFFF /end MEASUREMENT
/begin MEASUREMENT nllkh "Leerlaufdrehzahl bei Katheizen" UBYTE nmot_ub_q10 0 0 0.000000 2550.000000 /begin IF_DATA ASAP1B_ETK KP_BLOB 0x380B6A 1 1 /end IF_DATA BIT_MASK 0xFF /end MEASUREMENT
/begin MEASUREMENT nlp1tim "ZeitzÑhler fÅr Wartezeit 1 im NLP-Lernen" UBYTE t10msxs_ub_b2p55 0 0 0.000000 2.550000 /begin IF_DATA ASAP1B_ETK KP_BLOB 0x380AD7 1 1 /end IF_DATA BIT_MASK 0xFF /end MEASUREMENT
/begin MEASUREMENT nmod_w "Motordrehzahl aus Modell" UWORD nmot_uw_q0p25 0 0 0.000000 16383.750000 /begin IF_DATA ASAP1B_ETK KP_BLOB 0x3823EC 1 2 /end IF_DATA BIT_MASK 0xFFFF /end MEASUREMENT
/begin MEASUREMENT nmotas_w "" UWORD nmot_uw_q0p25 0 0 0.000000 16383.750000 /begin IF_DATA ASAP1B_ETK KP_BLOB 0x381AA0 1 2 /end IF_DATA BIT_MASK 0xFFFF /end MEASUREMENT
/begin MEASUREMENT nmotk1_w "" UWORD nmot_uw_q0p25 0 0 0.000000 16383.750000 /begin IF_DATA ASAP1B_ETK KP_BLOB 0xF9CC 0 2 /end IF_DATA BIT_MASK 0xFFFF /end MEASUREMENT
/begin MEASUREMENT nmotk2_w "" UWORD nmot_uw_q0p25 0 0 0.000000 16383.750000 /begin IF_DATA ASAP1B_ETK KP_BLOB 0xF9CE 0 2 /end IF_DATA BIT_MASK 0xFFFF /end MEASUREMENT
/begin MEASUREMENT nmotrsp_w_0__A "Beginn Ringspeicher fÅr Drehzahl" UWORD nmot_uw_q0p25 0 0 0.000000 16383.750000 /begin IF_DATA ASAP1B_ETK KP_BLOB 0xF87C 0 2 /end IF_DATA BIT_MASK 0xFFFF /end MEASUREMENT
/begin MEASUREMENT nmotrsp_w_1__A "Beginn Ringspeicher fÅr Drehzahl" UWORD nmot_uw_q0p25 0 0 0.000000 16383.750000 /begin IF_DATA ASAP1B_ETK KP_BLOB 0xF87E 0 2 /end IF_DATA BIT_MASK 0xFFFF /end MEASUREMENT
/begin MEASUREMENT nmotrsp_w_2__A "Beginn Ringspeicher fÅr Drehzahl" UWORD nmot_uw_q0p25 0 0 0.000000 16383.750000 /begin IF_DATA ASAP1B_ETK KP_BLOB 0xF880 0 2 /end IF_DATA BIT_MASK 0xFFFF /end MEASUREMENT
/begin MEASUREMENT nmotrsp_w_3__A "Beginn Ringspeicher fÅr Drehzahl" UWORD nmot_uw_q0p25 0 0 0.000000 16383.750000 /begin IF_DATA ASAP1B_ETK KP_BLOB 0xF882 0 2 /end IF_DATA BIT_MASK 0xFFFF /end MEASUREMENT
/begin MEASUREMENT nmotrsp_w_4__A "Beginn Ringspeicher fÅr Drehzahl" UWORD nmot_uw_q0p25 0 0 0.000000 16383.750000 /begin IF_DATA ASAP1B_ETK KP_BLOB 0xF884 0 2 /end IF_DATA BIT_MASK 0xFFFF /end MEASUREMENT
/begin MEASUREMENT nmotrsp_w_5__A "Beginn Ringspeicher fÅr Drehzahl" UWORD nmot_uw_q0p25 0 0 0.000000 16383.750000 /begin IF_DATA ASAP1B_ETK KP_BLOB 0xF886 0 2 /end IF_DATA BIT_MASK 0xFFFF /end MEASUREMENT
/begin MEASUREMENT nsa "Drehzahl Schub" UBYTE nmot_ub_q40 0 0 0.000000 10200.000000 /begin IF_DATA ASAP1B_ETK KP_BLOB 0x380C10 1 1 /end IF_DATA BIT_MASK 0xFF /end MEASUREMENT
/begin MEASUREMENT nstat "Solldrehzahl stationÑr" UBYTE nmot_ub_q10 0 0 0.000000 2550.000000 /begin IF_DATA ASAP1B_ETK KP_BLOB 0x380C20 1 1 /end IF_DATA BIT_MASK 0xFF /end MEASUREMENT
/begin MEASUREMENT nvquot_w "Quotient Motordrehzahl nmot / Fahrgeschwindigkeit vfzg" UWORD qnv_uw_b512 0 0 0.000000 511.992188 /begin IF_DATA ASAP1B_ETK KP_BLOB 0x381C9A 1 2 /end IF_DATA BIT_MASK 0xFFFF /end MEASUREMENT
/begin MEASUREMENT nwe "Wiedereinsetzdrehzahl" UBYTE nmot_ub_q40 0 0 0.000000 10200.000000 /begin IF_DATA ASAP1B_ETK KP_BLOB 0x380C11 1 1 /end IF_DATA BIT_MASK 0xFF /end MEASUREMENT
/begin MEASUREMENT nwecvt "Drehzahl Wiedereinsetzen bei CVT-Getriebe" UBYTE nmot_ub_q40 0 0 0.000000 10200.000000 /begin IF_DATA ASAP1B_ETK KP_BLOB 0x380C12 1 1 /end IF_DATA BIT_MASK 0xFF /end MEASUREMENT
/begin MEASUREMENT nwema "Drehzahl Wiedereinsetzen" UBYTE nmot_ub_q40 0 0 0.000000 10200.000000 /begin IF_DATA ASAP1B_ETK KP_BLOB 0x380C13 1 1 /end IF_DATA BIT_MASK 0xFF /end MEASUREMENT
/begin MEASUREMENT nwenga "Drehzahl Wiedereinsetzen" UBYTE nmot_ub_q40 0 0 0.000000 10200.000000 /begin IF_DATA ASAP1B_ETK KP_BLOB 0x380C14 1 1 /end IF_DATA BIT_MASK 0xFF /end MEASUREMENT
/begin MEASUREMENT ovlCtr "Schlie·zeit-öberlappsungszÑhler" UBYTE dez 0 0 0.000000 255.000000 /begin IF_DATA ASAP1B_ETK KP_BLOB 0xF7BA 0 1 /end IF_DATA BIT_MASK 0xFF /end MEASUREMENT
/begin MEASUREMENT pa_w "Absolutdruck Abgassystem" UWORD p_uw_q0p039 0 0 0.000000 2559.960938 /begin IF_DATA ASAP1B_ETK KP_BLOB 0x381EF0 1 2 /end IF_DATA BIT_MASK 0xFFFF /end MEASUREMENT
/begin MEASUREMENT pd_we_zy "" UWORD dez___UW 0 0 0.000000 65535.000000 /begin IF_DATA ASAP1B_ETK KP_BLOB 0xF95C 0 2 /end IF_DATA BIT_MASK 0xFFFF /end MEASUREMENT
/begin MEASUREMENT plsol_w "Soll-Ladedruck" UWORD p_uw_q0p039 0 0 0.000000 2559.960938 /begin IF_DATA ASAP1B_ETK KP_BLOB 0x381F24 1 2 /end IF_DATA BIT_MASK 0xFFFF /end MEASUREMENT
/begin MEASUREMENT psagr_w "Partialdruck durch externes Restgas (Restluft+Inertgas)" UWORD p_uw_q0p039 0 0 0.000000 2559.960938 /begin IF_DATA ASAP1B_ETK KP_BLOB 0x381EFA 1 2 /end IF_DATA BIT_MASK 0xFFFF /end MEASUREMENT
/begin MEASUREMENT pses_w "Saugrohrdruck Åber Verstellsystem korrigiert" UWORD p_uw_q0p039 0 0 0.000000 2559.960938 /begin IF_DATA ASAP1B_ETK KP_BLOB 0x38201A 1 2 /end IF_DATA BIT_MASK 0xFFFF /end MEASUREMENT
/begin MEASUREMENT pspa_w "Quotient Saugrohrdruck zu hîhenkorrigiertem Abgasgegendruck (Word)" UWORD fak_uw_b2 0 0 0.000000 1.999969 /begin IF_DATA ASAP1B_ETK KP_BLOB 0x381EFC 1 2 /end IF_DATA BIT_MASK 0xFFFF /end MEASUREMENT
/begin MEASUREMENT pspvdb_w "Quotient Saugrohrduck/Druck vor DK begrenzt (word)" UWORD fak_uw_b2 0 0 0.000000 1.999969 /begin IF_DATA ASAP1B_ETK KP_BLOB 0x381E76 1 2 /end IF_DATA BIT_MASK 0xFFFF /end MEASUREMENT
/begin MEASUREMENT pspvdk_w "Quotient Saugrohrdruck/Druck vor Drosselklappe (word)" UWORD fak_uw_b2 0 0 0.000000 1.999969 /begin IF_DATA ASAP1B_ETK KP_BLOB 0x381E78 1 2 /end IF_DATA BIT_MASK 0xFFFF /end MEASUREMENT
/begin MEASUREMENT ps_w "Saugrohr-Absolutdruck (Word)" UWORD p_uw_q0p039 0 0 0.000000 2559.960938 /begin IF_DATA ASAP1B_ETK KP_BLOB 0xF99A 0 2 /end IF_DATA BIT_MASK 0xFFFF /end MEASUREMENT
/begin MEASUREMENT pukBits "" UBYTE dez 0 0 0.000000 255.000000 /begin IF_DATA ASAP1B_ETK KP_BLOB 0x380CD3 1 1 /end IF_DATA BIT_MASK 0xFF /end MEASUREMENT
/begin MEASUREMENT pukorf_w "Umgebungsdruckwerte nach additiver Staudruckkorrektur gefiltert" UWORD p_uw_q0p039 0 0 0.000000 2559.960938 /begin IF_DATA ASAP1B_ETK KP_BLOB 0x3827AC 1 2 /end IF_DATA BIT_MASK 0xFFFF /end MEASUREMENT
/begin MEASUREMENT pumean_w "Umgebungsdruckmittelwert der plausiblen Umgebungsdruckwerte (Ausreiserfilter)" UWORD p_uw_q0p039 0 0 0.000000 2559.960938 /begin IF_DATA ASAP1B_ETK KP_BLOB 0x3827B0 1 2 /end IF_DATA BIT_MASK 0xFFFF /end MEASUREMENT
/begin MEASUREMENT pus_w "Umgebungsdruck ohne Umschaltung auf Ersatzwert bei Sensorfehler" UWORD p_uw_q0p039 0 0 0.000000 2559.960938 /begin IF_DATA ASAP1B_ETK KP_BLOB 0x381EA0 1 2 /end IF_DATA BIT_MASK 0xFFFF /end MEASUREMENT
/begin MEASUREMENT pu_w "Umgebungsdruck 16-Bit" UWORD p_uw_q0p039 0 0 0.000000 2559.960938 /begin IF_DATA ASAP1B_ETK KP_BLOB 0x381EA2 1 2 /end IF_DATA BIT_MASK 0xFFFF /end MEASUREMENT
/begin MEASUREMENT pvdk "Druck vor Drosselklappe" UBYTE p_ub_q10 0 0 0.000000 2550.000000 /begin IF_DATA ASAP1B_ETK KP_BLOB 0x380AEA 1 1 /end IF_DATA BIT_MASK 0xFF /end MEASUREMENT
/begin MEASUREMENT pvdkds_w "Druck vor Drosselklappe von Drucksensor (word)" UWORD p_uw_q0p039 0 0 0.000000 2559.960938 /begin IF_DATA ASAP1B_ETK KP_BLOB 0x381EB0 1 2 /end IF_DATA BIT_MASK 0xFFFF /end MEASUREMENT
/begin MEASUREMENT pvdk_w "Druck vor Drosselklappe 16-Bit" UWORD p_uw_q0p039 0 0 0.000000 2559.960938 /begin IF_DATA ASAP1B_ETK KP_BLOB 0x381E7C 1 2 /end IF_DATA BIT_MASK 0xFFFF /end MEASUREMENT
/begin MEASUREMENT redbas "Basis-Reduzierstufe" UBYTE dez 0 0 0.000000 255.000000 /begin IF_DATA ASAP1B_ETK KP_BLOB 0x380B1F 1 1 /end IF_DATA BIT_MASK 0xFF /end MEASUREMENT
/begin MEASUREMENT redist "Ist-Reduzierstufe" UBYTE dez 0 0 0.000000 255.000000 /begin IF_DATA ASAP1B_ETK KP_BLOB 0x380B20 1 1 /end IF_DATA BIT_MASK 0xFF /end MEASUREMENT
/begin MEASUREMENT redsol "Berechnete Soll-Reduzierstufe" UBYTE dez 0 0 0.000000 255.000000 /begin IF_DATA ASAP1B_ETK KP_BLOB 0x380C50 1 1 /end IF_DATA BIT_MASK 0xFF /end MEASUREMENT
/begin MEASUREMENT redsolr "Realisierte Reduzierstufe" UBYTE dez 0 0 0.000000 255.000000 /begin IF_DATA ASAP1B_ETK KP_BLOB 0x380B21 1 1 /end IF_DATA BIT_MASK 0xFF /end MEASUREMENT
/begin MEASUREMENT restw_b1 "" UBYTE dez 0 0 0.000000 255.000000 /begin IF_DATA ASAP1B_ETK KP_BLOB 0xF932 0 1 /end IF_DATA BIT_MASK 0xFF /end MEASUREMENT
/begin MEASUREMENT restw_b2 "" UBYTE dez 0 0 0.000000 255.000000 /begin IF_DATA ASAP1B_ETK KP_BLOB 0xF933 0 1 /end IF_DATA BIT_MASK 0xFF /end MEASUREMENT
/begin MEASUREMENT rfagrroh_w "AGR-FÅllungsanteil ins Saugrohr (word)" UWORD rel_uw_q0p0234 0 0 0.000000 1535.976562 /begin IF_DATA ASAP1B_ETK KP_BLOB 0x381EFE 1 2 /end IF_DATA BIT_MASK 0xFFFF /end MEASUREMENT
/begin MEASUREMENT rfagr_w "relative FÅllung AGR (word)" UWORD rel_uw_q0p0234 0 0 0.000000 1535.976562 /begin IF_DATA ASAP1B_ETK KP_BLOB 0x381E48 1 2 /end IF_DATA BIT_MASK 0xFFFF /end MEASUREMENT
/begin MEASUREMENT rldvs_w "relative LuftfÅllung durch Drosselventile am Saugrohr 16-Bit" UWORD rel_uw_q0p0234 0 0 0.000000 1535.976562 /begin IF_DATA ASAP1B_ETK KP_BLOB 0x381E7E 1 2 /end IF_DATA BIT_MASK 0xFFFF /end MEASUREMENT
/begin MEASUREMENT rlroh_w "relative LuftfÅllung: Rohwert vom Lastsensor (word)" UWORD rel_uw_q0p0234 0 0 0.000000 1535.976562 /begin IF_DATA ASAP1B_ETK KP_BLOB 0xF99E 0 2 /end IF_DATA BIT_MASK 0xFFFF /end MEASUREMENT
/begin MEASUREMENT segz_0_A "" UBYTE dez 0 0 0.000000 255.000000 /begin IF_DATA ASAP1B_ETK KP_BLOB 0xF934 0 1 /end IF_DATA BIT_MASK 0xFF /end MEASUREMENT
/begin MEASUREMENT segz_1_A "" UBYTE dez 0 0 0.000000 255.000000 /begin IF_DATA ASAP1B_ETK KP_BLOB 0xF935 0 1 /end IF_DATA BIT_MASK 0xFF /end MEASUREMENT
/begin MEASUREMENT segz_2_A "" UBYTE dez 0 0 0.000000 255.000000 /begin IF_DATA ASAP1B_ETK KP_BLOB 0xF936 0 1 /end IF_DATA BIT_MASK 0xFF /end MEASUREMENT
/begin MEASUREMENT segz_3_A "" UBYTE dez 0 0 0.000000 255.000000 /begin IF_DATA ASAP1B_ETK KP_BLOB 0xF937 0 1 /end IF_DATA BIT_MASK 0xFF /end MEASUREMENT
/begin MEASUREMENT segz_4_A "" UBYTE dez 0 0 0.000000 255.000000 /begin IF_DATA ASAP1B_ETK KP_BLOB 0xF938 0 1 /end IF_DATA BIT_MASK 0xFF /end MEASUREMENT
/begin MEASUREMENT segz_5_A "" UBYTE dez 0 0 0.000000 255.000000 /begin IF_DATA ASAP1B_ETK KP_BLOB 0xF939 0 1 /end IF_DATA BIT_MASK 0xFF /end MEASUREMENT
/begin MEASUREMENT segz_6_A "" UBYTE dez 0 0 0.000000 255.000000 /begin IF_DATA ASAP1B_ETK KP_BLOB 0xF93A 0 1 /end IF_DATA BIT_MASK 0xFF /end MEASUREMENT
/begin MEASUREMENT segz_7_A "" UBYTE dez 0 0 0.000000 255.000000 /begin IF_DATA ASAP1B_ETK KP_BLOB 0xF93B 0 1 /end IF_DATA BIT_MASK 0xFF /end MEASUREMENT
/begin MEASUREMENT slsninkr "Inkrementverfeinerung Schliessbeginnwinkel in 0.75 Grad" UBYTE dez 0 0 0.000000 255.000000 /begin IF_DATA ASAP1B_ETK KP_BLOB 0xF7BB 0 1 /end IF_DATA BIT_MASK 0xFF /end MEASUREMENT
/begin MEASUREMENT slsninkr2 "Inkrementverfeinerung Schliessbeginnwinkel öberlappung nach Klopfen in 0,75 Grad" UBYTE dez 0 0 0.000000 255.000000 /begin IF_DATA ASAP1B_ETK KP_BLOB 0xF7BC 0 1 /end IF_DATA BIT_MASK 0xFF /end MEASUREMENT
/begin MEASUREMENT slsnzahn "Schliessbeginnwinkel in Zahnquantisierung 6 Grad" UBYTE dez 0 0 0.000000 255.000000 /begin IF_DATA ASAP1B_ETK KP_BLOB 0xF7BD 0 1 /end IF_DATA BIT_MASK 0xFF /end MEASUREMENT
/begin MEASUREMENT slsnzahn2 "Schliessbeginnwinkel in Zahnquantisierung fÅr öberlappung nach Klopfen 6 Grad" UBYTE dez 0 0 0.000000 255.000000 /begin IF_DATA ASAP1B_ETK KP_BLOB 0xF7BE 0 1 /end IF_DATA BIT_MASK 0xFF /end MEASUREMENT
/begin MEASUREMENT sn2zkvek "NÑchster zu schlie·ender ZÅndkreis 2tes Schlie·ereignis" UWORD dez___UW 0 0 0.000000 65535.000000 /begin IF_DATA ASAP1B_ETK KP_BLOB 0xF7CC 0 2 /end IF_DATA BIT_MASK 0xFFFF /end MEASUREMENT
/begin MEASUREMENT snzkvek "NÑchster zu schlie·ender ZÅndkreis" UWORD dez___UW 0 0 0.000000 65535.000000 /begin IF_DATA ASAP1B_ETK KP_BLOB 0xF7CE 0 2 /end IF_DATA BIT_MASK 0xFFFF /end MEASUREMENT
/begin MEASUREMENT swOffDlBits "" UWORD dez___UW 0 0 0.000000 65535.000000 /begin IF_DATA ASAP1B_ETK KP_BLOB 0x383CCE 1 2 /end IF_DATA BIT_MASK 0xFFFF /end MEASUREMENT
/begin MEASUREMENT swout "Schlie·winkel" UWORD zw_ub_q0p75___UW 0 0 0.000000 49151.250000 /begin IF_DATA ASAP1B_ETK KP_BLOB 0xF7D0 0 2 /end IF_DATA BIT_MASK 0xFFFF /end MEASUREMENT
/begin MEASUREMENT synstate "Aktueller Synchronisierzustand" UBYTE dez 0 0 0.000000 255.000000 /begin IF_DATA ASAP1B_ETK KP_BLOB 0xF89B 0 1 /end IF_DATA BIT_MASK 0xFF /end MEASUREMENT
/begin MEASUREMENT synstate_o "Sychronisationszustand des vorherigen Synchros" UBYTE dez 0 0 0.000000 255.000000 /begin IF_DATA ASAP1B_ETK KP_BLOB 0xF89C 0 1 /end IF_DATA BIT_MASK 0xFF /end MEASUREMENT
/begin MEASUREMENT S_bls "Schalter Bremslicht" UWORD B_TRUE___UW 0 0 0.000000 0.000000 /begin IF_DATA ASAP1B_ETK KP_BLOB 0xFD0C 0 2 /end IF_DATA BIT_MASK 0x100 /end MEASUREMENT
/begin MEASUREMENT S_fgrat "Schalter Aus-Tip am FGR-Bedienhebelschalter" UWORD B_TRUE___UW 0 0 0.000000 0.000000 /begin IF_DATA ASAP1B_ETK KP_BLOB 0xFD0C 0 2 /end IF_DATA BIT_MASK 0x200 /end MEASUREMENT
/begin MEASUREMENT S_fgrhs "Hauptschalter am FGR-Bedienhebel" UWORD B_TRUE___UW 0 0 0.000000 0.000000 /begin IF_DATA ASAP1B_ETK KP_BLOB 0xFD0C 0 2 /end IF_DATA BIT_MASK 0x400 /end MEASUREMENT
/begin MEASUREMENT S_fs "Schalter Fahrstufe" UWORD B_TRUE___UW 0 0 0.000000 0.000000 /begin IF_DATA ASAP1B_ETK KP_BLOB 0xFD14 0 2 /end IF_DATA BIT_MASK 0x4000 /end MEASUREMENT
/begin MEASUREMENT tabgmab "Abgastemperatur beim Abstellen des Motors" UBYTE temp_ub_q5_o50 0 0 -50.000000 1225.000000 /begin IF_DATA ASAP1B_ETK KP_BLOB 0x383319 1 1 /end IF_DATA BIT_MASK 0xFF /end MEASUREMENT
/begin MEASUREMENT tabstmx_w "Abstellzeit Maximumabfrage fÅr ATM" UWORD t1sxs_uw_q1 0 0 0.000000 65535.000000 /begin IF_DATA ASAP1B_ETK KP_BLOB 0x383C32 1 2 /end IF_DATA BIT_MASK 0xFFFF /end MEASUREMENT
/begin MEASUREMENT tadtea "TEV-TastverhÑltnis aus TankentlÅftungsdiagnose" UBYTE rel_ub_b99p6 0 0 0.000000 99.609375 /begin IF_DATA ASAP1B_ETK KP_BLOB 0x380CBF 1 1 /end IF_DATA BIT_MASK 0xFF /end MEASUREMENT
/begin MEASUREMENT tagav "AGR-Temperatur am Ausla·ventil" UBYTE temp_ub_q5_o50 0 0 -50.000000 1225.000000 /begin IF_DATA ASAP1B_ETK KP_BLOB 0x380AF5 1 1 /end IF_DATA BIT_MASK 0xFF /end MEASUREMENT
/begin MEASUREMENT tagrv_w "AGR-Ventil Temperatur (Word)" UWORD temp_uw_q0p0195_o50 0 0 -50.000000 1229.980469 /begin IF_DATA ASAP1B_ETK KP_BLOB 0x381EF2 1 2 /end IF_DATA BIT_MASK 0xFFFF /end MEASUREMENT
/begin MEASUREMENT tags_w "AGR Temperatur bei Einleitung ins Saugrohr (Word)" UWORD temp_uw_q0p0195_o50 0 0 -50.000000 1229.980469 /begin IF_DATA ASAP1B_ETK KP_BLOB 0x381EF4 1 2 /end IF_DATA BIT_MASK 0xFFFF /end MEASUREMENT
/begin MEASUREMENT tateout "ausgegebenes TastverhÑltnis fÅr TankentlÅftungsventil" UBYTE rel_ub_b99p6 0 0 0.000000 99.609375 /begin IF_DATA ASAP1B_ETK KP_BLOB 0x380CB3 1 1 /end IF_DATA BIT_MASK 0xFF /end MEASUREMENT
/begin MEASUREMENT tatesoll "gewÅnschtes Soll-TastverhÑltnis TankentlÅftungsventil" UBYTE rel_ub_b99p6 0 0 0.000000 99.609375 /begin IF_DATA ASAP1B_ETK KP_BLOB 0x380CB5 1 1 /end IF_DATA BIT_MASK 0xFF /end MEASUREMENT
/begin MEASUREMENT tatmkf "Abgastemperatur vor Kat aus Kennfeld KFTATM" UBYTE temp_ub_q5_o50 0 0 -50.000000 1225.000000 /begin IF_DATA ASAP1B_ETK KP_BLOB 0x380A6A 1 1 /end IF_DATA BIT_MASK 0xFF /end MEASUREMENT
/begin MEASUREMENT tatmsta "Abgastemperatur vor Kat aus Modell stationÑr" UBYTE temp_ub_q5_o50 0 0 -50.000000 1225.000000 /begin IF_DATA ASAP1B_ETK KP_BLOB 0x380A6B 1 1 /end IF_DATA BIT_MASK 0xFF /end MEASUREMENT
/begin MEASUREMENT tephc "PhasenzÑhler Grundadaption / TankentlÅftung" UWORD t100msxs_uw_b6553p6 0 0 0.000000 6553.500000 /begin IF_DATA ASAP1B_ETK KP_BLOB 0x38201E 1 2 /end IF_DATA BIT_MASK 0xFFFF /end MEASUREMENT
/begin MEASUREMENT tevper "Periodendauer bei Ansteuerung TankentlÅftungsventil" UBYTE t500usxms_ub_q0p5 0 0 0.000000 127.500000 /begin IF_DATA ASAP1B_ETK KP_BLOB 0x380CB2 1 1 /end IF_DATA BIT_MASK 0xFF /end MEASUREMENT
/begin MEASUREMENT tinkr "Zeit pro Winkelinkrement" UWORD dez___UW 0 0 0.000000 65535.000000 /begin IF_DATA ASAP1B_ETK KP_BLOB 0xF7D2 0 2 /end IF_DATA BIT_MASK 0xFFFF /end MEASUREMENT
/begin MEASUREMENT tistzyl "Zylindernummer der ersten Einspritzung und ZÅndung" UBYTE dez 0 0 0.000000 255.000000 /begin IF_DATA ASAP1B_ETK KP_BLOB 0xF93C 0 1 /end IF_DATA BIT_MASK 0xFF /end MEASUREMENT
/begin MEASUREMENT ti_b1 "Einspritzzeit fÅr EV's auf Bank1" UWORD tinjection_sy 0 0 0.000000 209.712000 /begin IF_DATA ASAP1B_ETK KP_BLOB 0x381FB8 1 2 /end IF_DATA BIT_MASK 0xFFFF /end MEASUREMENT
/begin MEASUREMENT ti_b2 "Einspritzzeit fÅr EV's auf Bank2" UWORD tinjection_sy 0 0 0.000000 209.712000 /begin IF_DATA ASAP1B_ETK KP_BLOB 0x381FBA 1 2 /end IF_DATA BIT_MASK 0xFFFF /end MEASUREMENT
/begin MEASUREMENT ti_ev0 "Einspritzzeit 1. Zylinder in ZÅndfolge" UWORD tinjection_sy 0 0 0.000000 209.712000 /begin IF_DATA ASAP1B_ETK KP_BLOB 0xF95E 0 2 /end IF_DATA BIT_MASK 0xFFFF /end MEASUREMENT
/begin MEASUREMENT ti_ev1 "Einspritzzeit 2. Zylinder in ZÅndfolge" UWORD tinjection_sy 0 0 0.000000 209.712000 /begin IF_DATA ASAP1B_ETK KP_BLOB 0xF960 0 2 /end IF_DATA BIT_MASK 0xFFFF /end MEASUREMENT
/begin MEASUREMENT ti_ev2 "Einspritzzeit 3. Zylinder in ZÅndfolge" UWORD tinjection_sy 0 0 0.000000 209.712000 /begin IF_DATA ASAP1B_ETK KP_BLOB 0xF962 0 2 /end IF_DATA BIT_MASK 0xFFFF /end MEASUREMENT
/begin MEASUREMENT ti_ev3 "Einspritzzeit 4. Zylinder in ZÅndfolge" UWORD tinjection_sy 0 0 0.000000 209.712000 /begin IF_DATA ASAP1B_ETK KP_BLOB 0xF964 0 2 /end IF_DATA BIT_MASK 0xFFFF /end MEASUREMENT
/begin MEASUREMENT ti_ev4 "Einspritzzeit 5. Zylinder in ZÅndfolge" UWORD tinjection_sy 0 0 0.000000 209.712000 /begin IF_DATA ASAP1B_ETK KP_BLOB 0xF966 0 2 /end IF_DATA BIT_MASK 0xFFFF /end MEASUREMENT
/begin MEASUREMENT ti_ev5 "Einspritzzeit 6. Zylinder in ZÅndfolge" UWORD tinjection_sy 0 0 0.000000 209.712000 /begin IF_DATA ASAP1B_ETK KP_BLOB 0xF968 0 2 /end IF_DATA BIT_MASK 0xFFFF /end MEASUREMENT
/begin MEASUREMENT ti_ev6 "Einspritzzeit 7. Zylinder in ZÅndfolge" UWORD tinjection_sy 0 0 0.000000 209.712000 /begin IF_DATA ASAP1B_ETK KP_BLOB 0xF96A 0 2 /end IF_DATA BIT_MASK 0xFFFF /end MEASUREMENT
/begin MEASUREMENT ti_ev7 "Einspritzzeit 8. Zylinder in ZÅndfolge" UWORD tinjection_sy 0 0 0.000000 209.712000 /begin IF_DATA ASAP1B_ETK KP_BLOB 0xF96C 0 2 /end IF_DATA BIT_MASK 0xFFFF /end MEASUREMENT
/begin MEASUREMENT ti_sto_0 "ausgegebene Einspritzzeit fÅr Nachspritzer 1. Zyl. in ZÅndfolge" UWORD tinjection_sy 0 0 0.000000 209.712000 /begin IF_DATA ASAP1B_ETK KP_BLOB 0xF96E 0 2 /end IF_DATA BIT_MASK 0xFFFF /end MEASUREMENT
/begin MEASUREMENT ti_sto_1 "ausgegebene Einspritzzeit fÅr Nachspritzer 2. Zyl. in ZÅndfolge" UWORD tinjection_sy 0 0 0.000000 209.712000 /begin IF_DATA ASAP1B_ETK KP_BLOB 0xF970 0 2 /end IF_DATA BIT_MASK 0xFFFF /end MEASUREMENT
/begin MEASUREMENT ti_sto_2 "ausgegebene Einspritzzeit fÅr Nachspritzer 3. Zyl. in ZÅndfolge" UWORD tinjection_sy 0 0 0.000000 209.712000 /begin IF_DATA ASAP1B_ETK KP_BLOB 0xF972 0 2 /end IF_DATA BIT_MASK 0xFFFF /end MEASUREMENT
/begin MEASUREMENT ti_sto_3 "ausgegebene Einspritzzeit fÅr Nachspritzer 4. Zyl. in ZÅndfolge" UWORD tinjection_sy 0 0 0.000000 209.712000 /begin IF_DATA ASAP1B_ETK KP_BLOB 0xF974 0 2 /end IF_DATA BIT_MASK 0xFFFF /end MEASUREMENT
/begin MEASUREMENT ti_sto_4 "ausgegebene Einspritzzeit fÅr Nachspritzer 5. Zyl. in ZÅndfolge" UWORD tinjection_sy 0 0 0.000000 209.712000 /begin IF_DATA ASAP1B_ETK KP_BLOB 0xF976 0 2 /end IF_DATA BIT_MASK 0xFFFF /end MEASUREMENT
/begin MEASUREMENT ti_sto_5 "ausgegebene Einspritzzeit fÅr Nachspritzer 6. Zyl. in ZÅndfolge" UWORD tinjection_sy 0 0 0.000000 209.712000 /begin IF_DATA ASAP1B_ETK KP_BLOB 0xF978 0 2 /end IF_DATA BIT_MASK 0xFFFF /end MEASUREMENT
/begin MEASUREMENT ti_sto_6 "ausgegebene Einspritzzeit fÅr Nachspritzer 7. Zyl. in ZÅndfolge" UWORD tinjection_sy 0 0 0.000000 209.712000 /begin IF_DATA ASAP1B_ETK KP_BLOB 0xF97A 0 2 /end IF_DATA BIT_MASK 0xFFFF /end MEASUREMENT
/begin MEASUREMENT ti_sto_7 "ausgegebene Einspritzzeit fÅr Nachspritzer 8. Zyl. in ZÅndfolge" UWORD tinjection_sy 0 0 0.000000 209.712000 /begin IF_DATA ASAP1B_ETK KP_BLOB 0xF97C 0 2 /end IF_DATA BIT_MASK 0xFFFF /end MEASUREMENT
/begin MEASUREMENT ti_tvu_w "BatteriespannungsabhÑngige Einspritzzeitkorrektur CPU-Quantisierung" UWORD tinjection_sy 0 0 0.000000 209.712000 /begin IF_DATA ASAP1B_ETK KP_BLOB 0xF9B0 0 2 /end IF_DATA BIT_MASK 0xFFFF /end MEASUREMENT
/begin MEASUREMENT tkatmab "Abgastemperatur hinter Kat beim Abstellen des Motors (Modell)" UBYTE temp_ub_q5_o50 0 0 -50.000000 1225.000000 /begin IF_DATA ASAP1B_ETK KP_BLOB 0x38331A 1 1 /end IF_DATA BIT_MASK 0xFF /end MEASUREMENT
/begin MEASUREMENT tloop "RingzÑhler fÅr Zeitdifferenzmessungen" UBYTE t1sxs_ub_b255 0 0 0.000000 255.000000 /begin IF_DATA ASAP1B_ETK KP_BLOB 0x380AD8 1 1 /end IF_DATA BIT_MASK 0xFF /end MEASUREMENT
/begin MEASUREMENT tmlastz "AbwÑrtszÑhler zum Resetieren der AR beim Verzîgern" UBYTE t10msxs_ub_b2p55 0 0 0.000000 2.550000 /begin IF_DATA ASAP1B_ETK KP_BLOB 0x380C38 1 1 /end IF_DATA BIT_MASK 0xFF /end MEASUREMENT
/begin MEASUREMENT tmpumast "Status fÅr temporÑre UMA-Adaption" UBYTE dez 0 0 0.000000 255.000000 /begin IF_DATA ASAP1B_ETK KP_BLOB 0x380AD9 1 1 /end IF_DATA BIT_MASK 0xFF /end MEASUREMENT
/begin MEASUREMENT tn2 "Segmentzeit pro ZÅndung" UWORD tinjection_sy 0 0 0.000000 209.712000 /begin IF_DATA ASAP1B_ETK KP_BLOB 0xF982 0 2 /end IF_DATA BIT_MASK 0xFFFF /end MEASUREMENT
/begin MEASUREMENT tnachl_w "SG-Nachlaufzeit" UWORD t100msxs_uw_b6553p6 0 0 0.000000 6553.500000 /begin IF_DATA ASAP1B_ETK KP_BLOB 0x383CD0 1 2 /end IF_DATA BIT_MASK 0xFFFF /end MEASUREMENT
/begin MEASUREMENT tnbm1_w "Zahnperiodenzeit des zweitletzten NBM Signals" UWORD dez___UW 0 0 0.000000 65535.000000 /begin IF_DATA ASAP1B_ETK KP_BLOB 0x381ACE 1 2 /end IF_DATA BIT_MASK 0xFFFF /end MEASUREMENT
/begin MEASUREMENT tnbm_w "Zahnperiodenzeit des letzten NBM Signals" UWORD dez___UW 0 0 0.000000 65535.000000 /begin IF_DATA ASAP1B_ETK KP_BLOB 0x381AD2 1 2 /end IF_DATA BIT_MASK 0xFFFF /end MEASUREMENT
/begin MEASUREMENT tnmst1z "" UBYTE t10msxs_ub_b2p55 0 0 0.000000 2.550000 /begin IF_DATA ASAP1B_ETK KP_BLOB 0x380C39 1 1 /end IF_DATA BIT_MASK 0xFF /end MEASUREMENT
/begin MEASUREMENT tnmst2z "" UBYTE t10msxs_ub_b2p55 0 0 0.000000 2.550000 /begin IF_DATA ASAP1B_ETK KP_BLOB 0x380C3A 1 1 /end IF_DATA BIT_MASK 0xFF /end MEASUREMENT
/begin MEASUREMENT tnse_w "ZeitzÑhler ab Startende (16bit)" UWORD t100msxs_uw_b6553p5 0 0 0.000000 6553.500000 /begin IF_DATA ASAP1B_ETK KP_BLOB 0x382670 1 2 /end IF_DATA BIT_MASK 0xFFFF /end MEASUREMENT
/begin MEASUREMENT tooth_rale "Erster rÅckdrehender Zahn im Segment" UBYTE kw_q6 0 0 0.000000 1530.000000 /begin IF_DATA ASAP1B_ETK KP_BLOB 0x380A58 1 1 /end IF_DATA BIT_MASK 0xFF /end MEASUREMENT
/begin MEASUREMENT tr_zeit "Timerstand zum Zeitpunkt der TR-Marke" UWORD dez___UW 0 0 0.000000 65535.000000 /begin IF_DATA ASAP1B_ETK KP_BLOB 0xF7A6 0 2 /end IF_DATA BIT_MASK 0xFFFF /end MEASUREMENT
/begin MEASUREMENT tr_zeit_msb "" UBYTE dez 0 0 0.000000 255.000000 /begin IF_DATA ASAP1B_ETK KP_BLOB 0xF7A0 0 1 /end IF_DATA BIT_MASK 0xFF /end MEASUREMENT
/begin MEASUREMENT tsas_w "Zeit Åber ein Arbeitsspiel fÅr ngas_w" UWORD tsquantl 0 0 0.000000 1258272.805295 /begin IF_DATA ASAP1B_ETK KP_BLOB 0x381AA2 1 2 /end IF_DATA BIT_MASK 0xFFFF /end MEASUREMENT
/begin MEASUREMENT tseghi "Winkel-Segmentzeit, high, low byte des high word" UBYTE dez 0 0 0.000000 255.000000 /begin IF_DATA ASAP1B_ETK KP_BLOB 0xF877 0 1 /end IF_DATA BIT_MASK 0xFF /end MEASUREMENT
/begin MEASUREMENT tsegrsp_w_0__A "Beginn Ringspeicher fÅr Segmentzeit" UWORD tsquant 0 0 0.000000 78642.031457 /begin IF_DATA ASAP1B_ETK KP_BLOB 0xF888 0 2 /end IF_DATA BIT_MASK 0xFFFF /end MEASUREMENT
/begin MEASUREMENT tsegrsp_w_1__A "Beginn Ringspeicher fÅr Segmentzeit" UWORD tsquant 0 0 0.000000 78642.031457 /begin IF_DATA ASAP1B_ETK KP_BLOB 0xF88A 0 2 /end IF_DATA BIT_MASK 0xFFFF /end MEASUREMENT
/begin MEASUREMENT tsegrsp_w_2__A "Beginn Ringspeicher fÅr Segmentzeit" UWORD tsquant 0 0 0.000000 78642.031457 /begin IF_DATA ASAP1B_ETK KP_BLOB 0xF88C 0 2 /end IF_DATA BIT_MASK 0xFFFF /end MEASUREMENT
/begin MEASUREMENT tsegrsp_w_3__A "Beginn Ringspeicher fÅr Segmentzeit" UWORD tsquant 0 0 0.000000 78642.031457 /begin IF_DATA ASAP1B_ETK KP_BLOB 0xF88E 0 2 /end IF_DATA BIT_MASK 0xFFFF /end MEASUREMENT
/begin MEASUREMENT tsegrsp_w_4__A "Beginn Ringspeicher fÅr Segmentzeit" UWORD tsquant 0 0 0.000000 78642.031457 /begin IF_DATA ASAP1B_ETK KP_BLOB 0xF890 0 2 /end IF_DATA BIT_MASK 0xFFFF /end MEASUREMENT
/begin MEASUREMENT tsegrsp_w_5__A "Beginn Ringspeicher fÅr Segmentzeit" UWORD tsquant 0 0 0.000000 78642.031457 /begin IF_DATA ASAP1B_ETK KP_BLOB 0xF892 0 2 /end IF_DATA BIT_MASK 0xFFFF /end MEASUREMENT
/begin MEASUREMENT tseg_w "Winkel-Segmentzeit" UWORD tsegment_sy 0 0 0.000000 52.428000 /begin IF_DATA ASAP1B_ETK KP_BLOB 0xF87A 0 2 /end IF_DATA BIT_MASK 0xFFFF /end MEASUREMENT
/begin MEASUREMENT ttmumad "Zeitdifferenz fÅr temorÑre UMA-Adaption" UBYTE t1sxs_ub_b255 0 0 0.000000 255.000000 /begin IF_DATA ASAP1B_ETK KP_BLOB 0x380ADA 1 1 /end IF_DATA BIT_MASK 0xFF /end MEASUREMENT
/begin MEASUREMENT ttooth10ms "ZÑhler 10 ms Raster ohne Zahninterrupt" UBYTE dez 0 0 0.000000 255.000000 /begin IF_DATA ASAP1B_ETK KP_BLOB 0x380A5C 1 1 /end IF_DATA BIT_MASK 0xFF /end MEASUREMENT
/begin MEASUREMENT tumg "Umgebungstemperatur" UBYTE temp_ub_q0p75_o48 0 0 -48.000000 143.250000 /begin IF_DATA ASAP1B_ETK KP_BLOB 0xF7DC 0 1 /end IF_DATA BIT_MASK 0xFF /end MEASUREMENT
/begin MEASUREMENT tvfznw_t "" UBYTE t10msxs_ub_b2p55 0 0 0.000000 2.550000 /begin IF_DATA ASAP1B_ETK KP_BLOB 0xF93D 0 1 /end IF_DATA BIT_MASK 0xFF /end MEASUREMENT
/begin MEASUREMENT tvrnr "Verzîgerungszeit bis zum wirklichen Ev-Abschaltende" UBYTE dez 0 0 0.000000 255.000000 /begin IF_DATA ASAP1B_ETK KP_BLOB 0x380B23 1 1 /end IF_DATA BIT_MASK 0xFF /end MEASUREMENT
/begin MEASUREMENT tvu_w "Batteriespannungskorrektur" UWORD tinjection_sy 0 0 0.000000 209.712000 /begin IF_DATA ASAP1B_ETK KP_BLOB 0x38201C 1 2 /end IF_DATA BIT_MASK 0xFFFF /end MEASUREMENT
/begin MEASUREMENT tzarni "ZeitzÑhler AR nach Initialisierung" UBYTE t10msxs_ub_b2p55 0 0 0.000000 2.550000 /begin IF_DATA ASAP1B_ETK KP_BLOB 0x380C3B 1 1 /end IF_DATA BIT_MASK 0xFF /end MEASUREMENT
/begin MEASUREMENT tzms_w "" UWORD t10msxs_uw_b655p35 0 0 0.000000 655.350000 /begin IF_DATA ASAP1B_ETK KP_BLOB 0x382922 1 2 /end IF_DATA BIT_MASK 0xFFFF /end MEASUREMENT
/begin MEASUREMENT tznd "TatsÑchlich angesteuerte Schliesszeit in ZÅndbereich 1" UWORD tsquant 0 0 0.000000 78642.031457 /begin IF_DATA ASAP1B_ETK KP_BLOB 0xF7D4 0 2 /end IF_DATA BIT_MASK 0xFFFF /end MEASUREMENT
/begin MEASUREMENT t_idle_ctr "" UBYTE dez 0 0 0.000000 255.000000 /begin IF_DATA ASAP1B_ETK KP_BLOB 0x380BEE 1 1 /end IF_DATA BIT_MASK 0xFF /end MEASUREMENT
/begin MEASUREMENT uagrvh_w "Spannung der AGR-LagerÅckmeldung" UWORD spg_uw_q0p00488 0 0 0.000000 319.995117 /begin IF_DATA ASAP1B_ETK KP_BLOB 0x380F7E 1 2 /end IF_DATA BIT_MASK 0xFFFF /end MEASUREMENT
/begin MEASUREMENT ubsol "Soll-Batteriespannung" UBYTE spg_ubatt 0 0 0.000000 17.952000 /begin IF_DATA ASAP1B_ETK KP_BLOB 0x380AB0 1 1 /end IF_DATA BIT_MASK 0xFF /end MEASUREMENT
/begin MEASUREMENT udknlp1 "Spannung DK-Poti 1 im NLP" UWORD spg_uw_q0p001222 0 0 0.000000 80.083770 /begin IF_DATA ASAP1B_ETK KP_BLOB 0x381CE6 1 2 /end IF_DATA BIT_MASK 0xFFFF /end MEASUREMENT
/begin MEASUREMENT udknlp1r "Dauer-RAM: Spannung DK-Poti 1 im NLP" UWORD spg_uw_q0p001222 0 0 0.000000 80.083770 /begin IF_DATA ASAP1B_ETK KP_BLOB 0x383C4A 1 2 /end IF_DATA BIT_MASK 0xFFFF /end MEASUREMENT
/begin MEASUREMENT udknlp2 "Spannung DK-Poti 2 im NLP" UWORD spg_uw_q0p001222 0 0 0.000000 80.083770 /begin IF_DATA ASAP1B_ETK KP_BLOB 0x381CE8 1 2 /end IF_DATA BIT_MASK 0xFFFF /end MEASUREMENT
/begin MEASUREMENT udknlp2r "Dauer-RAM: Spannung DK-Poti 2 im NLP" UWORD spg_uw_q0p001222 0 0 0.000000 80.083770 /begin IF_DATA ASAP1B_ETK KP_BLOB 0x383C4C 1 2 /end IF_DATA BIT_MASK 0xFFFF /end MEASUREMENT
/begin MEASUREMENT udkp1a "Spannung Drosselklappen-Poti 1 am (unteren) Anschlag" UBYTE spg_ub_b5 0 0 0.000000 4.980469 /begin IF_DATA ASAP1B_ETK KP_BLOB 0x380ADB 1 1 /end IF_DATA BIT_MASK 0xFF /end MEASUREMENT
/begin MEASUREMENT udkp1aalt "temp. Spannung DK-Poti 1 am unteren DK-Anschlag" UWORD spg_uw_q0p001222 0 0 0.000000 80.083770 /begin IF_DATA ASAP1B_ETK KP_BLOB 0x381CEA 1 2 /end IF_DATA BIT_MASK 0xFFFF /end MEASUREMENT
/begin MEASUREMENT udkp1asr_w "Dauer-RAM: Spannung DK-Poti 1 am unteren DK-Anschlag, stationÑrer Anteil" UWORD spg_uw_q0p001222 0 0 0.000000 80.083770 /begin IF_DATA ASAP1B_ETK KP_BLOB 0x383C4E 1 2 /end IF_DATA BIT_MASK 0xFFFF /end MEASUREMENT
/begin MEASUREMENT udkp1as_w "Spannung DK-Poti 1 am unteren Anschlag, stationÑrer Anteil" UWORD spg_uw_q0p001222 0 0 0.000000 80.083770 /begin IF_DATA ASAP1B_ETK KP_BLOB 0x381CEC 1 2 /end IF_DATA BIT_MASK 0xFFFF /end MEASUREMENT
/begin MEASUREMENT udkp1a_w "Spannung DK-Poti 1 am unteren Anschlag" UWORD spg_uw_q0p001222 0 0 0.000000 80.083770 /begin IF_DATA ASAP1B_ETK KP_BLOB 0x381CEE 1 2 /end IF_DATA BIT_MASK 0xFFFF /end MEASUREMENT
/begin MEASUREMENT udkp1rob "realer DK-Poti-1-Wert am ob. Abgleichpkt." UWORD spg_uw_q0p00488 0 0 0.000000 319.995117 /begin IF_DATA ASAP1B_ETK KP_BLOB 0x381CF0 1 2 /end IF_DATA BIT_MASK 0xFFFF /end MEASUREMENT
/begin MEASUREMENT udkp1run "realer DK-Poti-1-Wert am unt. Abgleichpkt." UWORD spg_uw_q0p00488 0 0 0.000000 319.995117 /begin IF_DATA ASAP1B_ETK KP_BLOB 0x381CF2 1 2 /end IF_DATA BIT_MASK 0xFFFF /end MEASUREMENT
/begin MEASUREMENT udkp1sv "Maximalwert DK-Poti 1 fÅr Verwendung des verstÑrkten Signals" UBYTE spg_ub_b5 0 0 0.000000 4.980469 /begin IF_DATA ASAP1B_ETK KP_BLOB 0x380ADC 1 1 /end IF_DATA BIT_MASK 0xFF /end MEASUREMENT
/begin MEASUREMENT udkp1vor "Dauer-RAM: Spannungsoffset bei DK-Poti-1-VerstÑrkung" SWORD spg_sw_q0p001222 0 0 -40.042496 40.041274 /begin IF_DATA ASAP1B_ETK KP_BLOB 0x383C50 1 2 /end IF_DATA BIT_MASK 0xFFFF /end MEASUREMENT
/begin MEASUREMENT udkp1vou "Diagnose: 8 Bit Kopie von udkp1vo_w als Umweltgrî·e" SBYTE spg_q0p00977 0 0 -1.250000 1.240234 /begin IF_DATA ASAP1B_ETK KP_BLOB 0x380ACD 1 1 /end IF_DATA BIT_MASK 0xFF /end MEASUREMENT
/begin MEASUREMENT udkp1vo_w "Spannungsoffset VerstÑrker DK-Poti 1" SWORD spg_sw_q0p001222 0 0 -40.042496 40.041274 /begin IF_DATA ASAP1B_ETK KP_BLOB 0x381CF4 1 2 /end IF_DATA BIT_MASK 0xFFFF /end MEASUREMENT
/begin MEASUREMENT udkp1vrob "realer verstÑrkter DK-Poti-1-Wert am ob. Abgleichpkt." UWORD spg_uw_q0p00488 0 0 0.000000 319.995117 /begin IF_DATA ASAP1B_ETK KP_BLOB 0x381CF6 1 2 /end IF_DATA BIT_MASK 0xFFFF /end MEASUREMENT
/begin MEASUREMENT udkp1vrun "realer verstÑrkter DK-Poti-1-Wert am unt. Abgleichpkt." UWORD spg_uw_q0p00488 0 0 0.000000 319.995117 /begin IF_DATA ASAP1B_ETK KP_BLOB 0x381CF8 1 2 /end IF_DATA BIT_MASK 0xFFFF /end MEASUREMENT
/begin MEASUREMENT udkp1vv "Diagnose: 8 Bit Kopie von udkp1vv_w als Umweltgrî·e" UBYTE spg_q0p03125 0 0 0.000000 7.968750 /begin IF_DATA ASAP1B_ETK KP_BLOB 0x380ACE 1 1 /end IF_DATA BIT_MASK 0xFF /end MEASUREMENT
/begin MEASUREMENT udkp1vvr "Dauer-RAM: VerstÑrkung bei DK-Poti-1-VerstÑrkung" UWORD fak_q0p0039 0 0 0.000000 255.996094 /begin IF_DATA ASAP1B_ETK KP_BLOB 0x383C52 1 2 /end IF_DATA BIT_MASK 0xFFFF /end MEASUREMENT
/begin MEASUREMENT udkp1vv_w "VerstÑrkung DK-Poti 1" UWORD fak_q0p0039 0 0 0.000000 255.996094 /begin IF_DATA ASAP1B_ETK KP_BLOB 0x381CFA 1 2 /end IF_DATA BIT_MASK 0xFFFF /end MEASUREMENT
/begin MEASUREMENT udkp1v_w "VerstÑrkte Spannung DK-Poti 1" UWORD spg_uw_q0p00488 0 0 0.000000 319.995117 /begin IF_DATA ASAP1B_ETK KP_BLOB 0x380F80 1 2 /end IF_DATA BIT_MASK 0xFFFF /end MEASUREMENT
/begin MEASUREMENT udkp1_w "Spannung DK-Poti 1" UWORD spg_uw_q0p001222 0 0 0.000000 80.083770 /begin IF_DATA ASAP1B_ETK KP_BLOB 0x380F82 1 2 /end IF_DATA BIT_MASK 0xFFFF /end MEASUREMENT
/begin MEASUREMENT udkp2a "Spannung Drosselklappen-Poti 2 am (unteren) Anschlag" UBYTE spg_ub_b5 0 0 0.000000 4.980469 /begin IF_DATA ASAP1B_ETK KP_BLOB 0x380ADD 1 1 /end IF_DATA BIT_MASK 0xFF /end MEASUREMENT
/begin MEASUREMENT udkp2aalt "temp. Spannung DK-Poti 2 am unteren DK-Anschlag" UWORD spg_uw_q0p001222 0 0 0.000000 80.083770 /begin IF_DATA ASAP1B_ETK KP_BLOB 0x381CFC 1 2 /end IF_DATA BIT_MASK 0xFFFF /end MEASUREMENT
/begin MEASUREMENT udkp2asr_w "Dauer-RAM: Spannung DK-Poti 2 am unteren DK-Anschlag, stationÑrer Anteil" UWORD spg_uw_q0p001222 0 0 0.000000 80.083770 /begin IF_DATA ASAP1B_ETK KP_BLOB 0x383C54 1 2 /end IF_DATA BIT_MASK 0xFFFF /end MEASUREMENT
/begin MEASUREMENT udkp2as_w "Spannung DK-Poti 2 am unteren Anschlag, stationÑrer Anteil" UWORD spg_uw_q0p001222 0 0 0.000000 80.083770 /begin IF_DATA ASAP1B_ETK KP_BLOB 0x383C56 1 2 /end IF_DATA BIT_MASK 0xFFFF /end MEASUREMENT
/begin MEASUREMENT udkp2a_w "Spannung DK-Poti 2 am unteren Anschlag" UWORD spg_uw_q0p001222 0 0 0.000000 80.083770 /begin IF_DATA ASAP1B_ETK KP_BLOB 0x381CFE 1 2 /end IF_DATA BIT_MASK 0xFFFF /end MEASUREMENT
/begin MEASUREMENT udkp2_w "Spannung DK-Poti 2" UWORD spg_uw_q0p001222 0 0 0.000000 80.083770 /begin IF_DATA ASAP1B_ETK KP_BLOB 0x380F84 1 2 /end IF_DATA BIT_MASK 0xFFFF /end MEASUREMENT
/begin MEASUREMENT udkpat_w "temporÑrer UEA-Offset des DK-Poti" UWORD spg_uw_q0p001222 0 0 0.000000 80.083770 /begin IF_DATA ASAP1B_ETK KP_BLOB 0x381D00 1 2 /end IF_DATA BIT_MASK 0xFFFF /end MEASUREMENT
/begin MEASUREMENT udsl_w "Spannung Drucksensor Ladedruck (word)" UWORD spg_uw_q0p00488 0 0 0.000000 319.995117 /begin IF_DATA ASAP1B_ETK KP_BLOB 0x380F86 1 2 /end IF_DATA BIT_MASK 0xFFFF /end MEASUREMENT
/begin MEASUREMENT udst_w "Ausgangsspannung Tankdrucksensor nach AD-Wandler" UWORD spg_uw_q0p00488 0 0 0.000000 319.995117 /begin IF_DATA ASAP1B_ETK KP_BLOB 0x380F88 1 2 /end IF_DATA BIT_MASK 0xFFFF /end MEASUREMENT
/begin MEASUREMENT udsu_w "Spannung Umgebungsdrucksensor (word 10-Bit von ADC)" UWORD spg_uw_q0p00488 0 0 0.000000 319.995117 /begin IF_DATA ASAP1B_ETK KP_BLOB 0x380F8A 1 2 /end IF_DATA BIT_MASK 0xFFFF /end MEASUREMENT
/begin MEASUREMENT uefktget "öbertragungsfunktion (Mrad/Mkurbelwelle) von der Getriebesteuerung" UBYTE uefktget_ub_b25p4 0 0 0.000000 25.500000 /begin IF_DATA ASAP1B_ETK KP_BLOB 0x3809D1 1 1 /end IF_DATA BIT_MASK 0xFF /end MEASUREMENT
/begin MEASUREMENT uhsv "Spannung an der Heizerendstufe vor Kat" UBYTE spg_ub_b5 0 0 0.000000 4.980469 /begin IF_DATA ASAP1B_ETK KP_BLOB 0x3809B7 1 1 /end IF_DATA BIT_MASK 0xFF /end MEASUREMENT
/begin MEASUREMENT uhsv2 "Spannung an der Heizerendstufe 2 vor Kat" UBYTE spg_ub_b5 0 0 0.000000 4.980469 /begin IF_DATA ASAP1B_ETK KP_BLOB 0x3809B8 1 1 /end IF_DATA BIT_MASK 0xFF /end MEASUREMENT
/begin MEASUREMENT uldpe "Ausgangsspannung der LDP-Endstufe" UBYTE spg_ub_q0p019 0 0 0.000000 4.980469 /begin IF_DATA ASAP1B_ETK KP_BLOB 0x3809B9 1 1 /end IF_DATA BIT_MASK 0xFF /end MEASUREMENT
/begin MEASUREMENT umsrln_w "KUMSRL * nmot_w" UWORD m_uw_q0p0005 0 0 0.000000 32.767500 /begin IF_DATA ASAP1B_ETK KP_BLOB 0x381E80 1 2 /end IF_DATA BIT_MASK 0xFFFF /end MEASUREMENT
/begin MEASUREMENT upwg1_w "Spannung PWG-Poti 1 (Word)" UWORD spg_uw_q0p00488 0 0 0.000000 319.995117 /begin IF_DATA ASAP1B_ETK KP_BLOB 0x380F8E 1 2 /end IF_DATA BIT_MASK 0xFFFF /end MEASUREMENT
/begin MEASUREMENT upwg2d_w "Verdoppelte PWG-Poti-2-Spannung (Word)" UWORD spg_uw_q0p00488 0 0 0.000000 319.995117 /begin IF_DATA ASAP1B_ETK KP_BLOB 0x381CA4 1 2 /end IF_DATA BIT_MASK 0xFFFF /end MEASUREMENT
/begin MEASUREMENT upwg2_w "Spannung PWG-Poti 2 (Word)" UWORD spg_uw_q0p00488 0 0 0.000000 319.995117 /begin IF_DATA ASAP1B_ETK KP_BLOB 0x380F90 1 2 /end IF_DATA BIT_MASK 0xFFFF /end MEASUREMENT
/begin MEASUREMENT upwgej_w "Entjitterte PWG-Poti-Spannung" UWORD spg_uw_q0p00488 0 0 0.000000 319.995117 /begin IF_DATA ASAP1B_ETK KP_BLOB 0x381CA8 1 2 /end IF_DATA BIT_MASK 0xFFFF /end MEASUREMENT
/begin MEASUREMENT upwkdo_w "Schwelle PWG-Poti-Spannung zum Setzen der Kick-Down-Information" UWORD spg_uw_q0p004888 0 0 0.000000 320.335080 /begin IF_DATA ASAP1B_ETK KP_BLOB 0x381CCA 1 2 /end IF_DATA BIT_MASK 0xFFFF /end MEASUREMENT
/begin MEASUREMENT upwkdt_w "PWG-Poti-Spannung in der Kick-Down-Position temporÑr" UWORD spg_uw_q0p004888 0 0 0.000000 320.335080 /begin IF_DATA ASAP1B_ETK KP_BLOB 0x381CCC 1 2 /end IF_DATA BIT_MASK 0xFFFF /end MEASUREMENT
/begin MEASUREMENT upwkdu_w "Schwelle PWG-Poti-Spannung zum RÅcksetzen der Kick-Down-Information" UWORD spg_uw_q0p004888 0 0 0.000000 320.335080 /begin IF_DATA ASAP1B_ETK KP_BLOB 0x381CCE 1 2 /end IF_DATA BIT_MASK 0xFFFF /end MEASUREMENT
/begin MEASUREMENT upwkd_w "Gelernte Spannung von PWG-Poti 1 in der Kick-Down-Position" UWORD spg_uw_q0p004888 0 0 0.000000 320.335080 /begin IF_DATA ASAP1B_ETK KP_BLOB 0x383C48 1 2 /end IF_DATA BIT_MASK 0xFFFF /end MEASUREMENT
/begin MEASUREMENT uulsuv2_w "Sondenspannung vor Kat einer Breitbandlambdasonde Bank2 (ADC-Wert)" UWORD spg_uw_b5 0 0 0.000000 319.995117 /begin IF_DATA ASAP1B_ETK KP_BLOB 0x380F92 1 2 /end IF_DATA BIT_MASK 0xFFFF /end MEASUREMENT
/begin MEASUREMENT uulsuv_w "Sondenspannung vor Kat einer Breitbandlambdasonde (ADC-Wert)" UWORD spg_uw_b5 0 0 0.000000 319.995117 /begin IF_DATA ASAP1B_ETK KP_BLOB 0x380F94 1 2 /end IF_DATA BIT_MASK 0xFFFF /end MEASUREMENT
/begin MEASUREMENT uushk_w "ADC-Spannung Lambdasonde hinter Katalysator (Word)" UWORD spg_uw_q0p00488 0 0 0.000000 319.995117 /begin IF_DATA ASAP1B_ETK KP_BLOB 0x380F96 1 2 /end IF_DATA BIT_MASK 0xFFFF /end MEASUREMENT
/begin MEASUREMENT uusvk_w "ADC-Spannung Lambdasonde vor Katalysator (Word)" UWORD spg_uw_q0p00488 0 0 0.000000 319.995117 /begin IF_DATA ASAP1B_ETK KP_BLOB 0x380F98 1 2 /end IF_DATA BIT_MASK 0xFFFF /end MEASUREMENT
/begin MEASUREMENT u_immo "" UBYTE spg_ub_b5 0 0 0.000000 4.980469 /begin IF_DATA ASAP1B_ETK KP_BLOB 0x3809BA 1 1 /end IF_DATA BIT_MASK 0xFF /end MEASUREMENT
/begin MEASUREMENT vfzg2_w "Fahrzeuggeschwindigkeit 2. Signal" UWORD vfzg_uw_q0p00781 0 0 0.000000 511.992188 /begin IF_DATA ASAP1B_ETK KP_BLOB 0x38250C 1 2 /end IF_DATA BIT_MASK 0xFFFF /end MEASUREMENT
/begin MEASUREMENT vfzg_u "Fahrzeuggeschwindigkeit, mit def. Quantisierung fÅr Tester" UBYTE vfzg_q1p0 0 0 0.000000 255.000000 /begin IF_DATA ASAP1B_ETK KP_BLOB 0x380A51 1 1 /end IF_DATA BIT_MASK 0xFF /end MEASUREMENT
/begin MEASUREMENT vplspu "DruckverhÑltnis Solladedruck zu Umgebungsdruck (8 Bit)" UBYTE fak_ub_b4 0 0 0.000000 3.984375 /begin IF_DATA ASAP1B_ETK KP_BLOB 0x380BFF 1 1 /end IF_DATA BIT_MASK 0xFF /end MEASUREMENT
/begin MEASUREMENT vplspu_w "DruckverhÑltnis Solladedruck zu Umgebungsdruck" UWORD fak_uw_b4 0 0 0.000000 3.999939 /begin IF_DATA ASAP1B_ETK KP_BLOB 0x382294 1 2 /end IF_DATA BIT_MASK 0xFFFF /end MEASUREMENT
/begin MEASUREMENT vsfpses "Faktor zur Verstellung Saugrohrdruck zur Applikation Einspritzung" UBYTE fak_ub_b2 0 0 0.000000 1.992188 /begin IF_DATA ASAP1B_ETK KP_BLOB 0x3809A6 1 1 /end IF_DATA BIT_MASK 0xFF /end MEASUREMENT
/begin MEASUREMENT wdkada_w "Sollwert DK-Winkel, aus DV-E Adaption- und PrÅffunktion" UWORD relDK_uw_b100 0 0 0.000000 100.000000 /begin IF_DATA ASAP1B_ETK KP_BLOB 0x381D02 1 2 /end IF_DATA BIT_MASK 0xFFFF /end MEASUREMENT
/begin MEASUREMENT wdkba_w "Drosselklappenwinkel bezogen auf unteren Anschlag" SWORD relDK_q0p02441 0 0 -800.000000 799.975586 /begin IF_DATA ASAP1B_ETK KP_BLOB 0xF8F2 0 2 /end IF_DATA BIT_MASK 0xFFFF /end MEASUREMENT
/begin MEASUREMENT wdkdlra_w "Alter Sollwert DK-Winkel in 12 Bit-Auflîsung" UWORD relDK_q0p02441___UW 0 0 0.000000 1599.975586 /begin IF_DATA ASAP1B_ETK KP_BLOB 0x381D14 1 2 /end IF_DATA BIT_MASK 0xFFFF /end MEASUREMENT
/begin MEASUREMENT wdkdlr_w "Sollwert DK-Winkel in 12 Bit-Auflîsung" UWORD relDK_q0p02441___UW 0 0 0.000000 1599.975586 /begin IF_DATA ASAP1B_ETK KP_BLOB 0xF906 0 2 /end IF_DATA BIT_MASK 0xFFFF /end MEASUREMENT
/begin MEASUREMENT wdknlp "Diagnose: 8 Bit Kopie von wdknlp_w als Umweltgrî·e" UBYTE relDK_q0p3922 0 0 0.000000 100.000000 /begin IF_DATA ASAP1B_ETK KP_BLOB 0x380ACF 1 1 /end IF_DATA BIT_MASK 0xFF /end MEASUREMENT
/begin MEASUREMENT wdknlpr "Diagnose: 8 Bit Kopie von wdknlpr_w als Umweltgrî·e" UBYTE relDK_q0p3922 0 0 0.000000 100.000000 /begin IF_DATA ASAP1B_ETK KP_BLOB 0x380AD0 1 1 /end IF_DATA BIT_MASK 0xFF /end MEASUREMENT
/begin MEASUREMENT wdknlpr_w "Dauer-RAM: Sollwert DK-Winkel in NLP-Stellung, bez. auf UMA" UWORD relDK_uw_b100 0 0 0.000000 100.000000 /begin IF_DATA ASAP1B_ETK KP_BLOB 0x383C58 1 2 /end IF_DATA BIT_MASK 0xFFFF /end MEASUREMENT
/begin MEASUREMENT wdknlp_w "DK-Winkel der Notluftposition" UWORD relDK_uw_b100 0 0 0.000000 100.000000 /begin IF_DATA ASAP1B_ETK KP_BLOB 0x381D04 1 2 /end IF_DATA BIT_MASK 0xFFFF /end MEASUREMENT
/begin MEASUREMENT wdksfi_w "aus wdks_w prÑdizierter DK-Winkel" SWORD relDK_q0p02441 0 0 -800.000000 799.975586 /begin IF_DATA ASAP1B_ETK KP_BLOB 0x381D16 1 2 /end IF_DATA BIT_MASK 0xFFFF /end MEASUREMENT
/begin MEASUREMENT wdks_w "Sollwert Drosselklappenwinkel, bezogen auf (unteren) Anschlag" UWORD relDK_uw_b100 0 0 0.000000 100.000000 /begin IF_DATA ASAP1B_ETK KP_BLOB 0x381F70 1 2 /end IF_DATA BIT_MASK 0xFFFF /end MEASUREMENT
/begin MEASUREMENT wdkugd_w "Drosselklappenwinkel, bei dem 95% FÅllung erreicht wird" UWORD rel_uw_b100 0 0 0.000000 99.998474 /begin IF_DATA ASAP1B_ETK KP_BLOB 0x381E84 1 2 /end IF_DATA BIT_MASK 0xFFFF /end MEASUREMENT
/begin MEASUREMENT wdkvabob "DK-Sollwert fÅr oberen Abgleichpunkt" UWORD relDK_uw_b100 0 0 0.000000 100.000000 /begin IF_DATA ASAP1B_ETK KP_BLOB 0x381D06 1 2 /end IF_DATA BIT_MASK 0xFFFF /end MEASUREMENT
/begin MEASUREMENT wdkvabub "DK-Sollwert fÅr unteren Abgleichpunkt" UWORD relDK_uw_b100 0 0 0.000000 100.000000 /begin IF_DATA ASAP1B_ETK KP_BLOB 0x381D08 1 2 /end IF_DATA BIT_MASK 0xFFFF /end MEASUREMENT
/begin MEASUREMENT weer "Winkel Einspritzende resultierend" UBYTE kw_q2p8125 0 0 0.000000 717.187500 /begin IF_DATA ASAP1B_ETK KP_BLOB 0x380B2C 1 1 /end IF_DATA BIT_MASK 0xFF /end MEASUREMENT
/begin MEASUREMENT weests_r "" UBYTE kw_q2p8125 0 0 0.000000 717.187500 /begin IF_DATA ASAP1B_ETK KP_BLOB 0xF93E 0 1 /end IF_DATA BIT_MASK 0xFF /end MEASUREMENT
/begin MEASUREMENT winkl_b1 "" UWORD dez___UW 0 0 0.000000 65535.000000 /begin IF_DATA ASAP1B_ETK KP_BLOB 0xF97E 0 2 /end IF_DATA BIT_MASK 0xFFFF /end MEASUREMENT
/begin MEASUREMENT winkl_b2 "" UWORD dez___UW 0 0 0.000000 65535.000000 /begin IF_DATA ASAP1B_ETK KP_BLOB 0xF980 0 2 /end IF_DATA BIT_MASK 0xFFFF /end MEASUREMENT
/begin MEASUREMENT wkw0rale_w "Winkel Kurbelwelle am Nullpunkt des Arbeitsspieles bei 1. rÅckdrehendem Zahn" UWORD kw_q6___UW 0 0 0.000000 393210.000000 /begin IF_DATA ASAP1B_ETK KP_BLOB 0x381AC2 1 2 /end IF_DATA BIT_MASK 0xFFFF /end MEASUREMENT
/begin MEASUREMENT wkwas_kor "Kurbelwinkel im Arbeitsspiel mit LÅckenkorrektur" UBYTE kw_q6 0 0 0.000000 1530.000000 /begin IF_DATA ASAP1B_ETK KP_BLOB 0x380A59 1 1 /end IF_DATA BIT_MASK 0xFF /end MEASUREMENT
/begin MEASUREMENT wkwbzm0_w "Winkel Kurbelwelle am Nullpunkt des Arbeitsspiels: R_syn & zzyl = 0 (word)" UWORD kw_q6___UW 0 0 0.000000 393210.000000 /begin IF_DATA ASAP1B_ETK KP_BLOB 0xF89E 0 2 /end IF_DATA BIT_MASK 0xFFFF /end MEASUREMENT
/begin MEASUREMENT wkwrale_w "Winkel Kurbelwelle beim ersten rÅckdrehenden Zahn (word)" UWORD kw_q6___UW 0 0 0.000000 393210.000000 /begin IF_DATA ASAP1B_ETK KP_BLOB 0x381AC4 1 2 /end IF_DATA BIT_MASK 0xFFFF /end MEASUREMENT
/begin MEASUREMENT wkwstop "Motorabstellposition im Arbeitsspiel" UBYTE kw_q6 0 0 0.000000 1530.000000 /begin IF_DATA ASAP1B_ETK KP_BLOB 0x383316 1 1 /end IF_DATA BIT_MASK 0xFF /end MEASUREMENT
/begin MEASUREMENT wkw_w "Winkel Kurbelwelle (word)" UWORD kw_q6___UW 0 0 0.000000 393210.000000 /begin IF_DATA ASAP1B_ETK KP_BLOB 0xFE50 0 2 /end IF_DATA BIT_MASK 0xFFFF /end MEASUREMENT
/begin MEASUREMENT wouta_0_A "ausgegebener ZÅndwinkel bei DoppelzÅndung: erster ZÅndkreis" UBYTE zw_ub_q0p75 0 0 0.000000 191.250000 /begin IF_DATA ASAP1B_ETK KP_BLOB 0xF7BF 0 1 /end IF_DATA BIT_MASK 0xFF /end MEASUREMENT
/begin MEASUREMENT wouta_1_A "ausgegebener ZÅndwinkel bei DoppelzÅndung: erster ZÅndkreis" UBYTE zw_ub_q0p75 0 0 0.000000 191.250000 /begin IF_DATA ASAP1B_ETK KP_BLOB 0xF7C0 0 1 /end IF_DATA BIT_MASK 0xFF /end MEASUREMENT
/begin MEASUREMENT wouta_2_A "ausgegebener ZÅndwinkel bei DoppelzÅndung: erster ZÅndkreis" UBYTE zw_ub_q0p75 0 0 0.000000 191.250000 /begin IF_DATA ASAP1B_ETK KP_BLOB 0xF7C1 0 1 /end IF_DATA BIT_MASK 0xFF /end MEASUREMENT
/begin MEASUREMENT wouta_3_A "ausgegebener ZÅndwinkel bei DoppelzÅndung: erster ZÅndkreis" UBYTE zw_ub_q0p75 0 0 0.000000 191.250000 /begin IF_DATA ASAP1B_ETK KP_BLOB 0xF7C2 0 1 /end IF_DATA BIT_MASK 0xFF /end MEASUREMENT
/begin MEASUREMENT woutst_0_A "" UBYTE zw_ub_q0p75 0 0 0.000000 191.250000 /begin IF_DATA ASAP1B_ETK KP_BLOB 0xF7C3 0 1 /end IF_DATA BIT_MASK 0xFF /end MEASUREMENT
/begin MEASUREMENT woutst_1_A "" UBYTE zw_ub_q0p75 0 0 0.000000 191.250000 /begin IF_DATA ASAP1B_ETK KP_BLOB 0xF7C4 0 1 /end IF_DATA BIT_MASK 0xFF /end MEASUREMENT
/begin MEASUREMENT woutst_2_A "" UBYTE zw_ub_q0p75 0 0 0.000000 191.250000 /begin IF_DATA ASAP1B_ETK KP_BLOB 0xF7C5 0 1 /end IF_DATA BIT_MASK 0xFF /end MEASUREMENT
/begin MEASUREMENT woutst_3_A "" UBYTE zw_ub_q0p75 0 0 0.000000 191.250000 /begin IF_DATA ASAP1B_ETK KP_BLOB 0xF7C6 0 1 /end IF_DATA BIT_MASK 0xFF /end MEASUREMENT
/begin MEASUREMENT wtaus_w "" UWORD spg_uw_b5 0 0 0.000000 319.995117 /begin IF_DATA ASAP1B_ETK KP_BLOB 0x380F9A 1 2 /end IF_DATA BIT_MASK 0xFFFF /end MEASUREMENT
/begin MEASUREMENT wtmot2_w "" UWORD spg_uw_b5 0 0 0.000000 319.995117 /begin IF_DATA ASAP1B_ETK KP_BLOB 0x380F9C 1 2 /end IF_DATA BIT_MASK 0xFFFF /end MEASUREMENT
/begin MEASUREMENT wtvkat "" UBYTE spg_ub_q0p019 0 0 0.000000 4.980469 /begin IF_DATA ASAP1B_ETK KP_BLOB 0x3809BC 1 1 /end IF_DATA BIT_MASK 0xFF /end MEASUREMENT
/begin MEASUREMENT wub "Batteriespannung; vom AD-Wandler erfa·ter Wert" UBYTE spg_ubatt 0 0 0.000000 17.952000 /begin IF_DATA ASAP1B_ETK KP_BLOB 0x3809BD 1 1 /end IF_DATA BIT_MASK 0xFF /end MEASUREMENT
/begin MEASUREMENT zkvek "Shiftkonstante fÅr die ZÅndmaskenberechnung" UBYTE dez 0 0 0.000000 255.000000 /begin IF_DATA ASAP1B_ETK KP_BLOB 0xF7C7 0 1 /end IF_DATA BIT_MASK 0xFF /end MEASUREMENT
/begin MEASUREMENT zlkd "Zustand Kick-Down-Lernen" UBYTE dez 0 0 0.000000 255.000000 /begin IF_DATA ASAP1B_ETK KP_BLOB 0x380ABC 1 1 /end IF_DATA BIT_MASK 0xFF /end MEASUREMENT
/begin MEASUREMENT znachanz "Anzahl der ZÅndungen im Nachlauf" UBYTE dez 0 0 0.000000 255.000000 /begin IF_DATA ASAP1B_ETK KP_BLOB 0xF7C8 0 1 /end IF_DATA BIT_MASK 0xFF /end MEASUREMENT
/begin MEASUREMENT znostend "Anzahl ZÅndung=ein ohne Erreichen von Startende" UBYTE dez 0 0 0.000000 255.000000 /begin IF_DATA ASAP1B_ETK KP_BLOB 0x383441 1 1 /end IF_DATA BIT_MASK 0xFF /end MEASUREMENT
/begin MEASUREMENT znzkvek "NÑchster zu zÅndender ZÅndkreis" UWORD dez___UW 0 0 0.000000 65535.000000 /begin IF_DATA ASAP1B_ETK KP_BLOB 0xF7D6 0 2 /end IF_DATA BIT_MASK 0xFFFF /end MEASUREMENT
/begin MEASUREMENT zouttmx "Maximale Programmlaufzeit von der TR Marke bis Ende AZUE" UWORD tsquant 0 0 0.000000 78642.031457 /begin IF_DATA ASAP1B_ETK KP_BLOB 0xF7D8 0 2 /end IF_DATA BIT_MASK 0xFFFF /end MEASUREMENT
/begin MEASUREMENT zueninkr "Inkrementverfeinerung ZÅndwinkel" UBYTE dez 0 0 0.000000 255.000000 /begin IF_DATA ASAP1B_ETK KP_BLOB 0xF7C9 0 1 /end IF_DATA BIT_MASK 0xFF /end MEASUREMENT
/begin MEASUREMENT zuentmx "Maximale Laufzeit von der TR-Marke bis zur Berechnung des ZÅndereignisses" UWORD tsquant 0 0 0.000000 78642.031457 /begin IF_DATA ASAP1B_ETK KP_BLOB 0xF7DA 0 2 /end IF_DATA BIT_MASK 0xFFFF /end MEASUREMENT
/begin MEASUREMENT zuenzahn "ZÅndwinkel in Zahnquantisierung" UBYTE dez 0 0 0.000000 255.000000 /begin IF_DATA ASAP1B_ETK KP_BLOB 0xF7CA 0 1 /end IF_DATA BIT_MASK 0xFF /end MEASUREMENT
/begin MEASUREMENT zuen_beg "Zylinder, bei dem erste Einspritzung stattgefunden hat" UBYTE dez 0 0 0.000000 255.000000 /begin IF_DATA ASAP1B_ETK KP_BLOB 0xF93F 0 1 /end IF_DATA BIT_MASK 0xFF /end MEASUREMENT
/begin MEASUREMENT zwmatm "ZÑhler fÅr ATM-Wiederholstart und Faktor fÅr WÑrmemengen-Schwellen" UBYTE dez 0 0 0.000000 255.000000 /begin IF_DATA ASAP1B_ETK KP_BLOB 0x38331B 1 1 /end IF_DATA BIT_MASK 0xFF /end MEASUREMENT
/begin MEASUREMENT zwmatmf "ZÑhler fÅr ATM-Wiederholstart und Faktor fÅr WÑrmemengen-Schwellwert upstream" UBYTE dez 0 0 0.000000 255.000000 /begin IF_DATA ASAP1B_ETK KP_BLOB 0x38331C 1 1 /end IF_DATA BIT_MASK 0xFF /end MEASUREMENT
/begin MEASUREMENT zwoutar_0_A "ZÅndwinkel-Ausgabe Array" SBYTE zw_sb_q0p75 0 0 -96.000000 95.250000 /begin IF_DATA ASAP1B_ETK KP_BLOB 0x380D0E 1 1 /end IF_DATA BIT_MASK 0xFF /end MEASUREMENT
/begin MEASUREMENT zwoutar_1_A "ZÅndwinkel-Ausgabe Array" SBYTE zw_sb_q0p75 0 0 -96.000000 95.250000 /begin IF_DATA ASAP1B_ETK KP_BLOB 0x380D0F 1 1 /end IF_DATA BIT_MASK 0xFF /end MEASUREMENT
/begin MEASUREMENT zwoutar_2_A "ZÅndwinkel-Ausgabe Array" SBYTE zw_sb_q0p75 0 0 -96.000000 95.250000 /begin IF_DATA ASAP1B_ETK KP_BLOB 0x380D10 1 1 /end IF_DATA BIT_MASK 0xFF /end MEASUREMENT
/begin MEASUREMENT zwoutar_3_A "ZÅndwinkel-Ausgabe Array" SBYTE zw_sb_q0p75 0 0 -96.000000 95.250000 /begin IF_DATA ASAP1B_ETK KP_BLOB 0x380D11 1 1 /end IF_DATA BIT_MASK 0xFF /end MEASUREMENT
/begin MEASUREMENT zylvek_a "" UBYTE dez 0 0 0.000000 255.000000 /begin IF_DATA ASAP1B_ETK KP_BLOB 0xF940 0 1 /end IF_DATA BIT_MASK 0xFF /end MEASUREMENT
/begin MEASUREMENT zylvirt "Stand ZylinderzÑhler vor Umsynchronisation aus Schnellstart" UBYTE dez 0 0 0.000000 255.000000 /begin IF_DATA ASAP1B_ETK KP_BLOB 0x380A5E 1 1 /end IF_DATA BIT_MASK 0xFF /end MEASUREMENT
/begin MEASUREMENT zzbank "Zylinderzuordnung zu EinspritzbÑnken" UBYTE dez 0 0 0.000000 255.000000 /begin IF_DATA ASAP1B_ETK KP_BLOB 0x380B17 1 1 /end IF_DATA BIT_MASK 0xFF /end MEASUREMENT
/begin MEASUREMENT zzvirt "virtueller ZahnzÑhler im Start bis zur Synchronisation" UBYTE dez 0 0 0.000000 255.000000 /begin IF_DATA ASAP1B_ETK KP_BLOB 0x380A60 1 1 /end IF_DATA BIT_MASK 0xFF /end MEASUREMENT
/begin MEASUREMENT zzyl "SW-ZylinderzÑhler" UBYTE dez 0 0 0.000000 255.000000 /begin IF_DATA ASAP1B_ETK KP_BLOB 0xF89A 0 1 /end IF_DATA BIT_MASK 0xFF /end MEASUREMENT
/begin FUNCTION ACIFI "9.30      Ausgabe fÅr zylinderindividuelle Einspritzung"
 /begin REF_CHARACTERISTIC WESSTO WESBM WEESTS TVFZNW TMESP SNM16CIUB NMIN FZNWN3 FZNWN2 FZNWN1 FZNWN0 FZN3 FZN2 FZN1 FZN0 FWEMXT FWEAUF FWEAB DTIREL DTIABS CWESWEZ /end REF_CHARACTERISTIC
 /begin LOC_MEASUREMENT zzyl zzvirt zylvirt zylvek_a zuen_beg winkl_b2 winkl_b1 weests_r weer tvfznw_t tn2 tmot ti_tvu_w ti_sto_7 ti_sto_6 ti_sto_5 ti_sto_4 ti_sto_3 ti_sto_2 ti_sto_1 ti_sto_0 ti_ev7 ti_ev6 ti_ev5 ti_ev4 ti_ev3 ti_ev2 ti_ev1 ti_ev0 ti_b2 ti_b1 tistzyl synstate_o synstate segz_7_A segz_6_A segz_5_A segz_4_A segz_3_A segz_2_A segz_1_A segz_0_A restw_b2 restw_b1 pd_we_zy nmot_w nmot na_rel_c na_abs_c fwez7 fwez6 fwez5 fwez4 fwez3 fwez2 fwez1 fwez0 fweg fgezs7 fgezs6 fgezs5 fgezs4 fgezs3 fgezs2 fgezs1 fgezs0 evz_austot esst_snm16ciub deltaseg_w cc_cha_7 cc_cha_6 cc_cha_5 cc_cha_4 cc_cha_3 cc_cha_2 cc_cha_1 cc_cha_0 B_ti_wai7 B_ti_wai6 B_ti_wai5 B_ti_wai4 B_ti_wai3 B_ti_wai2 B_ti_wai1 B_ti_wai0 B_ti_out7 B_ti_out6 B_ti_out5 B_ti_out4 B_ti_out3 B_ti_out2 B_ti_out1 B_ti_out0 B_ti_cha7 B_ti_cha6 B_ti_cha5 B_ti_cha4 B_ti_cha3 B_ti_cha2 B_ti_cha1 B_ti_cha0 B_synti B_spontan7 B_spontan6 B_spontan5 B_spontan4 B_spontan3 B_spontan2 B_spontan1 B_spontan0 B_sa B_nwsalt B_nwsaktiv B_nsp B_kl15 B_encifi B_cwesakt anzti_w anzti /end LOC_MEASUREMENT
/end FUNCTION
/begin FUNCTION ADC ""
 /begin LOC_MEASUREMENT wub wtvkat wtmot_w wtmot2_w wtaus_w wtans u_immo uusvk_w uushk_w uulsuv_w uulsuv2_w upwg2_w upwg1_w uldpe uhsv2 uhsv uhfm_w udsu_w udst_w udsl_w udkp2_w udkp1_w udkp1v_w uagrvh_w S_fgrhs S_fgrat S_bls iUspoti2_w iUspoti1_w iUipoti2_w iUipoti1_w iasp1plaus_w /end LOC_MEASUREMENT
/end FUNCTION
/begin FUNCTION ADVE "3.30      Ansteuerung der DV-E mit dem DLR"
 /begin REF_CHARACTERISTIC ZKWDKSPT1 ZKUBDLR WDKSTGROB WDKSTFEIN WDKSAPNOL WDKREIB WDKNLPTOL WDKETE WDKBEWS UDKNLPTOL TPWRSV TDLRPIDC TDKLAGDE KDLRIDDVE DWDKSIKLS DWDKSBAMX DVEEST DLRUMAIINI DLRUMABAND DLRUBSOLL DLRPIDMIN DLRPIDMAX DLRPID2T DLRPID1T DLRPID0T DLRNLPD DLRKREISST DLRKREIS DLRKPUNLP2 DLRKPUNLP1 DLRKPUNLP0 DLRKPONLP0 DLRKIUNLP2 DLRKIUNLP1 DLRKIUNLP0 DLRKIONLP0 DLRKDUNLP2 DLRKDUNLP1 DLRKDUNLP0 DLRKDONLP0 DLRININI DLRIKLPAR DLRIAMAXA DLRDWDKSS2 DLRDWDKSS1 DKLAGERT DANTSCHWV DANTSCHWNV DANTGESWV DANTGESWNV CWDLRIKL CWDKNOLU /end REF_CHARACTERISTIC
 /begin LOC_MEASUREMENT wped wdks_w wdksfi_w wdknlp_w wdkdlr_w wdkdlra_w wdkba_w wdkada_w udkp2_w udkp1_w udknlp2 udknlp1 ub nmot gwdk_kge gwdkdlr_w dynPeriod dwdkdlr_w dveesc dpwrsvc dlrspid_w dlrpidc dlrp dlrndif_w dlrkomp dlrikl_w dlriklst_w dlriant_w dlriamax dlri dlrd dklagerc B_wdksive B_wdksauf B_wdk2sel B_wdk1v B_ub_ok B_ubpvg B_ubdve B_st B_pwrsv B_pwf B_nlpne B_lrnrdy B_kl15 B_i_ska_um B_iklstar B_iklrest B_dvete B_dveeson B_dveesh B_dveese B_dlrumzu B_dlrspid B_dlrpide B_dlrparc B_dlriklst B_dlrikla B_dlrbe B_dkpiu B_dkp2e B_dkp1e B_dknot B_dknolu B_dkbew B_dkaden B_dcdisr B_dcdisfr B_appnolu B_apnoluv /end LOC_MEASUREMENT
/end FUNCTION
/begin FUNCTION AEKP "4.10      Ausgabe EKP-Ansteuerung" /begin REF_CHARACTERISTIC ZNOSTMX UBSTS TZMIN TPVL TNLEKPVL TEBF TAPVLTM /end REF_CHARACTERISTIC
 /begin LOC_MEASUREMENT znostend ub tnachl_w tmotab tabst_w swOffDlBits lokBits_Aekp dekpub B_uhrrsec B_tpvl B_stend B_st B_pvlnl B_pvl2 B_pvl1 B_nmin B_nachlend B_kstebfa B_kstebf B_ekpvl B_ekpubn B_ekpn B_ekpd B_ekp AEKPintbits /end LOC_MEASUREMENT
/end FUNCTION
/begin FUNCTION AES "1.50      Ausgabe Einspritzung" /begin REF_CHARACTERISTIC TVUB PSAPES KRKTE FRLFSDP CWPKAPP /end REF_CHARACTERISTIC /begin LOC_MEASUREMENT vsfpses ub tvu_w pu_w ps_w pses_w frkte dpus_w /end LOC_MEASUREMENT /end FUNCTION
/begin FUNCTION AEVAB "4.10      Ausgabe Einspritzung Ev-Ausblendung" /begin REF_CHARACTERISTIC REDABM NMXSKA /end REF_CHARACTERISTIC
 /begin LOC_MEASUREMENT zzyl zzbank tvrnr redsol_one redsolr redsol redist redbas nmot flgtiab evz_austot evz_aus evz_ags evrbgn_one evrbgn eevx devoff B_skaevab B_nmaxd B_i_ska_um B_faevz B_evloc B_evasel B_evabu B_dveada B_dkuevab B_dkpu B_dknolu B_bevab2 B_bevab abmf /end LOC_MEASUREMENT
/end FUNCTION
/begin FUNCTION ALE "6.10      Auslauferkennung" /begin REF_CHARACTERISTIC TRD RALEZMAX /end REF_CHARACTERISTIC
 /begin LOC_MEASUREMENT wkw_w wkwstop wkwrale_w wkwbzm0_w wkwas_kor wkw0rale_w ttooth10ms tooth_rale B_zprel B_stend B_raleok B_ralectr B_nmot B_nldg B_nlale B_mluecke B_luecke B_enabale B_ale aleNvBits /end LOC_MEASUREMENT
/end FUNCTION
/begin FUNCTION ARMD "3.41      Momentenbasierte Antiruckelfunktion"
 /begin REF_CHARACTERISTIC VARAU_3_A VARAU_2_A VARAU_1_A VARAU_0_A TZSPINI_3_A TZSPINI_2_A TZSPINI_1_A TZSPINI_0_A TVKUPRS TVKUPHS TMLAST TMAR_3_A TMAR_2_A TMAR_1_A TMAR_0_A TAREIN_3_A TAREIN_2_A TAREIN_1_A TAREIN_0_A SMK08MDSW SGA06MDUB NDIFFOG NDFILOG NARLL_3_A NARLL_2_A NARLL_1_A NARLL_0_A NARASTG_3_A NARASTG_2_A NARASTG_1_A NARASTG_0_A NARAO_3_A NARAO_2_A NARAO_1_A NARAO_0_A KIFZGHG_3_A KIFZGHG_2_A KIFZGHG_1_A KIFZGHG_0_A KIFZGAWG KIFZGAG KFDMDARU_3_A KFDMDARU_2_A KFDMDARU_1_A KFDMDARU_0_A KFDMDARO_3_A KFDMDARO_2_A KFDMDARO_1_A KFDMDARO_0_A FRARHG_3_A FRARHG_2_A FRARHG_1_A FRARHG_0_A FRARAWG FRARAG FLRHG_3_A FLRHG_2_A FLRHG_1_A FLRHG_0_A FLRAWG FLRAG DVFZAR_3_A DVFZAR_2_A DVFZAR_1_A DVFZAR_0_A DNFILO_3_A DNFILO_2_A DNFILO_1_A DNFILO_0_A CWARMD B2_3_A B2_2_A B2_1_A B2_0_A B1_3_A B1_2_A B1_1_A B1_0_A A2_3_A A2_2_A A2_1_A A2_0_A A1_3_A A1_2_A A1_1_A A1_0_A A0_3_A A0_2_A A0_1_A A0_0_A /end REF_CHARACTERISTIC
 /begin LOC_MEASUREMENT vfzg tzarni tnmst2z tnmst1z tmot tmlastz nmot_w nmotk2_w nmotk1_w nmot nmod_w ndiff_w ndiffog_w ndfil_w ndfibet_w ndar_w mlast_w mkar_w misolv_w mifa_w mdverl_w mdbes_w kifz_w gangi flrar fdar esst_smk08mdsw esst_sga06mdub dmar_w B_wk B_tpnmot B_stend B_sa B_mdein B_ll B_kuppl B_kupgw B_iniarv B_iniar B_hpnmot B_gwhs B_brems B_autget B_ar /end LOC_MEASUREMENT
/end FUNCTION
/begin FUNCTION ASC0F "" /begin REF_CHARACTERISTIC TIDLEMIN TIDLEMAX /end REF_CHARACTERISTIC
 /begin LOC_MEASUREMENT t_idle_ctr nmot_w kwp71_bits B_0101_switch B_0101_notadr B_0101_ident B_0101_ack /end LOC_MEASUREMENT
/end FUNCTION
/begin FUNCTION ATEV "3.10      Ansteuerung TankentlÅftungsventil (Periodendauer)" /begin REF_CHARACTERISTIC TATEMSN TATEGRDU TATEGRDO TATEGMX KFTVTEV KFTEVP /end REF_CHARACTERISTIC
 /begin LOC_MEASUREMENT ub tevper tatesoll tateroh tateout tans tadtea nmot mstesoll_w msteo_w msntev_w msntevo_w B_tevtstp B_evloc B_dtes /end LOC_MEASUREMENT
/end FUNCTION
/begin FUNCTION ATM "22.40     Abgastemperaturmodell"
 /begin REF_CHARACTERISTIC ZATMRML ZATMKML ZATMAML WMABGKH VTUMTAT TUMTAIT TNLATMTU TNLATMTM TNLATM TKSTBFA TKATMOE TATMWMK TATMTP TATMTMOT TATMSTI TATMSA TATMKW TATMKH TASTBFA TABGMEX STS06TMUW STM05TMUB ST307TMUB ST107TMUB SML07TMUW SML06TMUB SLX06TMUW SEZ06TMUB NTUMTAT KLATMZWE KLATMLAE KFWMKAT KFWMABG KFTATM KFATMZW KFATMLA KATMEXML IMTUMTAT FWMKATW FWMABGW FATMRML DTUMTAT ATMTANS ATMABKK ATMABKA /end REF_CHARACTERISTIC
 /begin LOC_MEASUREMENT zwmatmf zwmatm vfzg tumg tmst tmot tkatm_w tkatmst tkatmab tkatm tatu tatmsta tatmkf tans tabst_w tabstmx_w tabstatm_w tabgm_w tabgmst tabgmab tabgm rl nmot ml_w ml lamsbg_w iwmatm_w imlatm_w imlatm etazwist etazwimt esst_sts06tmuw esst_stm05tmub esst_st307tmub esst_st107tmub esst_sml07tmuw esst_sml06tmub esst_slx06tmuw esst_sez06tmub B_uhrrsec B_uhrrmin B_trkh B_tfu B_stndnl B_stend B_st B_sa B_pwf B_nmot B_nlatm B_nachlend B_kw B_kh B_faatm B_atmtpl B_atmtpk B_atmtpf B_atmtpa B_atmst ATMbits /end LOC_MEASUREMENT
/end FUNCTION
/begin FUNCTION AZUE "5.10      Ausgabe ZÅndung" /begin REF_CHARACTERISTIC NACHANZ /end REF_CHARACTERISTIC
 /begin LOC_MEASUREMENT zwoutar_3_A zwoutar_2_A zwoutar_1_A zwoutar_0_A zuenzahn zuentmx zueninkr zouttmx znzkvek znachanz zkvek woutst_3_A woutst_2_A woutst_1_A woutst_0_A wouta_3_A wouta_2_A wouta_1_A wouta_0_A tznd tinkr swout snzkvek sn2zkvek slsnzahn2 slsnzahn slsninkr2 slsninkr ovlCtr minzahn dzaCtr B_zws0 B_zesync B_z1 B_sw1 B_sw0 B_slsn2 B_nachl B_kl15 B_dzai B_dopzue_i B_dopzue /end LOC_MEASUREMENT
/end FUNCTION
/begin FUNCTION BBDLS "1.10      Betriebsbereich digitale Leerlaufstabilisierung" /begin REF_CHARACTERISTIC NDLSU NDLSO CLSDKH /end REF_CHARACTERISTIC
 /begin LOC_MEASUREMENT nstat nmotll B_st B_sa B_llr B_kh B_dnn B_dls B_dkpu B_dknolu B_buf /end LOC_MEASUREMENT
/end FUNCTION
/begin FUNCTION BBFGR "2.10      Ein- und Ausschaltbedingungen Fahrgeschwindigkeitsregler"
 /begin REF_CHARACTERISTIC VREGLMIN VREGLMAX VFGRMIN VFGRMAX VBGFGRAQ TFGRUNUB TFGRUM TFGRUEOB TFGRARLG TFGRAQU TDVZVI TDVIVZ NFGRMAX_1_A NFGRMAX_0_A GAFGRU GAFGRO_1_A GAFGRO_0_A DVZVIMX DVIVZMX DVFGREU DVFGREO DVAQUKMX DVAQUGMX CWBBFGR BFGRU BFGRO /end REF_CHARACTERISTIC
 /begin LOC_MEASUREMENT vziel_w vfzg_w vfzg2_w nmot gangi B_pwgnotfr B_kuppl B_gwhs B_fgr_um B_fgrtwa B_fgrtve B_fgrtse B_fgrtbe B_fgrkf B_fgrhsa B_fgrhe B_fgresv B_fgres B_fgrenv B_fgren B_fgrat B_fgras B_fgrars B_fgral B_fgrai B_fgrabz B_fgrab B_fgr B_dkpiu B_dknolu B_brems B_asr B_acc bfzgl_b BBFGRlokBits /end LOC_MEASUREMENT
/end FUNCTION
/begin FUNCTION BBGANG "14.40     Betriebsbereich Gang"
 /begin REF_CHARACTERISTIC NVQUOT6U NVQUOT6O NVQUOT5U_1_A NVQUOT5U_0_A NVQUOT5O_1_A NVQUOT5O_0_A NVQUOT4U_1_A NVQUOT4U_0_A NVQUOT4O_1_A NVQUOT4O_0_A NVQUOT3U_1_A NVQUOT3U_0_A NVQUOT3O_1_A NVQUOT3O_0_A NVQUOT2U_1_A NVQUOT2U_0_A NVQUOT2O_1_A NVQUOT2O_0_A NVQUOT1U_1_A NVQUOT1U_0_A NVQUOT1O_1_A NVQUOT1O_0_A NGANGMIN_1_A NGANGMIN_0_A IGESGA /end REF_CHARACTERISTIC
 /begin LOC_MEASUREMENT vfzg_w uevges uefktget S_fs nvquot_w nmot_w gangi gangauti B_vnull B_tippg B_gwhs B_fs B_cvt B_autget /end LOC_MEASUREMENT
/end FUNCTION
/begin FUNCTION BBKD "1.20      Berechnung der Kick-Down-Information"
 /begin REF_CHARACTERISTIC WPKDMN UPWKDDF UPWGKDU UPWGKDO UPWGKDMX UPWGKDMN TLKD TKD DUPWKDU DUPWKDO DUPWKDLB DUPWGLKD DUPW12KD CWBBKD /end REF_CHARACTERISTIC
 /begin LOC_MEASUREMENT zlkd wped_w upwkd_w upwkdu_w upwkdt_w upwkdo_w upwgej_w upwg2d_w upwg1_w B_pwgnotfr B_pwf B_lkdfrg B_lkderf B_kdpos B_kd B_fakd B_autget bblkderf BBKDbits /end LOC_MEASUREMENT
/end FUNCTION
/begin FUNCTION BBKHZ "18.50     Betriebsbereich motorisches Katheizen"
 /begin REF_CHARACTERISTIC ZKLAMKH ZKHABB TNSDMRKH TMSLOF TKHMX TKHLLMX TKHLLAB TKHLL TKHFSAB TKHABB TKATW TKATMN TABSTKH STM04__UB NLLKT NLLKHM NFSKHM MLSUS_2_A MLSUS_1_A MLSUS_0_A MLKHMX KTNDMRKH IMLKHTMS IMLKHMX IMLATWS FTMLAKH FNSKHLL FKHMD FKHLA FKHABMN FHOKH DTMABKH DTKH DTKATMN CWKHZ BTRKHTMS /end REF_CHARACTERISTIC
 /begin LOC_MEASUREMENT tnst_w tmst tmotab tmot tkatm tans tabst_w nllkh nfskh mlsu ml imlpr_w imlpr imlatm_w imlatmw_w fmdkhtns_w fmdkh flamkh flakh fkhab fho_w fhost_w esst_stm04__ub B_wst B_trkh B_stend B_st B_slsfz B_slpoff B_slkhof B_pwf B_nmot B_msloff B_mlsu B_lmsslof B_ll B_kw B_khstc B_khset B_khres B_khn B_khllmx B_khlle B_khll B_kherr B_khaset B_khares B_khab B_kha B_kh B_katfz B_imlprini B_hag B_fs B_fasla B_fa B_dsla BBKHZlokBits BBKHZBits /end LOC_MEASUREMENT
/end FUNCTION
/begin FUNCTION BBLDR "3.10      Betriebsbedingungen LDR"
 /begin LOC_MEASUREMENT vplspu_w vplspu pu_w plsol_w flgtiab B_stend B_mdarv B_ll B_lds B_ldrbu B_ldra B_ldr B_ldb B_dkpu B_dknolu B_blduff B_bldsff B_bldrff /end LOC_MEASUREMENT
/end FUNCTION
/begin FUNCTION BBSAWE "28.20     Betriebsbereich Schubabschalten/Wiedereinsetzen"
 /begin REF_CHARACTERISTIC VSAA TVSATM TKATSA STM05SAUB SNM08__UB SGA08MDUB NWENG NWECVTM NGDNSA KFTVSA KFNWEGM ENASAG DVSA DNWEK DNVSA DNSLL DNSATIP DNSAL DNSAH CWSAWE /end REF_CHARACTERISTIC
 /begin LOC_MEASUREMENT vfzg tmst tmot tkatm nwenga nwema nwecvt nwe nsa nmot ngfil gangi esst_stm05saub esst_snm08__ub esst_sga08mdub dnsa B_tippg B_stend B_savmsr B_savfgr B_sacvt B_sabt B_sab B_msr B_ll B_kuppl B_koe B_kh B_dsls B_dnsll B_dash B_cvt BBSAWElokbits /end LOC_MEASUREMENT
/end FUNCTION
/begin FUNCTION BBSTT "11.20     Betriebsbereich: Start" /begin REF_CHARACTERISTIC NSTNM NNSTA /end REF_CHARACTERISTIC /begin LOC_MEASUREMENT tnst_w tnse_w tmot tans nmot B_stend B_st B_nmot /end LOC_MEASUREMENT /end FUNCTION
/begin FUNCTION BBTEGA "3.50      Phasensteuerung fÅr TankentlÅftung und Gemischadaption"
 /begin REF_CHARACTERISTIC TTEZAU TTEZAO TTEPRIO TTEMN TTEINI TTEGAZU TTEGAZO TTEGAI TTEGA TTEBSTP TTEAE TTE TMSNOGA TATELL FTEDS FTEADZU DFTEDS /end REF_CHARACTERISTIC
 /begin LOC_MEASUREMENT tnse_w tmst tephc tans ftead_w B_tteae B_tezstp B_teza B_tesstp B_tepzus B_tepi B_tep B_tehbxf B_tehbx B_teabb B_te B_nmot B_lr B_ll B_grdst B_gasp B_gap B_gaefra B_gae B_fraoan B_frao B_edkvs B_dtes B_dmtltz B_dldpte /end LOC_MEASUREMENT
/end FUNCTION
/begin FUNCTION BBZMS "1.20      Betriebsbereich ZMS-Schutz" /begin REF_CHARACTERISTIC TZMSST TZMSAS TVZMSE NZMSMX NZMSMN NZMSE /end REF_CHARACTERISTIC /begin LOC_MEASUREMENT tzms_w nmot_w B_zmsoff B_zmse B_zms B_stend /end LOC_MEASUREMENT /end FUNCTION
/begin FUNCTION BGAGR "1.100     FÅllungserfassung Einrechnung AbgasrÅckfÅhrung"
 /begin REF_CHARACTERISTIC ZTAGRV ZTAGR PAGAVML KLAF KFTAGAV KFMSNTAG KFFTDAG KFFTAGRV FDVAGR CWAGRT AGRPMX AGRPMN /end REF_CHARACTERISTIC
 /begin LOC_MEASUREMENT umsrln_w tmot tans tags_w tagrv_w tagrv tagav tabgm_w rl rfagr_w rfagrroh_w pu_w ps_w pspa_w psagr_w pa_w nmot_w nmot msntagr_w msagr_w msagr ml_w ml klaf_kge hagr_w hagr fvisrm_w fpag_w B_stend B_pagr B_agr /end LOC_MEASUREMENT
/end FUNCTION
/begin FUNCTION BGDVE "3.60      Grî·en fÅr DV-E-Ansteuerung aus Lern- und PrÅfroutinen"
 /begin REF_CHARACTERISTIC WDKSTMUMA WDKSFPRO WDKSFPR WDKNLPMI WDKNLPMA WDKFPRZ2 WDKFPRZ1 WDKFPRO2 WDKFPRO1 UPVGNENN UDKPATMX UDKPAOFF UDKPALOS UDKP2AURI UDKP2AMIN UDKP2AMAX UDKP1VVMI UDKP1VVMA UDKP1VUSC UDKP1VOSC UDKP1VOMI UDKP1VOMA UDKP1VID UDKP1NHUB UDKP1DUS UDKP1AURI UDKP1AMIN UDKP1AMAX UDKNLP2N UDKNLP1N UB_UANL UAN_U_MT UAN_STORE UAN_O_MT UANZURP UANVFZG UANUATS UANPIDMINA UANPIDMIN UANPEDMAX UANNMAX UANAUFRP TTMUMASTA TMSUTMUMA TDLRPIDMX TDKNLPE NLPST2T NLPST1T LRNVB_T LRNST9_T LRNST7_T LRNST3_T LRNST1_T FPRTIM4_T FPRTIM3_T FPRTIM2_T FPRTIM1_T FPRNMAX FPRMT FPRAT DUDKPTMP DUDKP1HY DUDKNLPU DUDKNLPO DLRPIDSTMN DKPSTGMIN /end REF_CHARACTERISTIC
 /begin LOC_MEASUREMENT wped wdkvabub wdkvabob wdks_w wdknlp_w wdknlpr_w wdknlpr wdknlp wdkba_w wdkada_w vfzg udkpat_w udkp2_w udkp2a_w udkp2as_w udkp2asr_w udkp2aalt udkp2a udkp1_w udkp1v_w udkp1vv_w udkp1vvr udkp1vv udkp1vrun udkp1vrob udkp1vo_w udkp1vou udkp1vor udkp1sv udkp1run udkp1rob udkp1a_w udkp1as_w udkp1asr_w udkp1aalt udkp1a udknlp2r udknlp2 udknlp1r udknlp1 ub ttmumad tnachl_w tmpumast tmot tloop tans nmotll nlp1tim lrnvb_c lrntim_c lrnstep_c fprtim_c fprstep_c dveadchst dlrspid_w dlrmxt dkpstg_w B_wdk2sel B_umauab B_umardr B_umaerf B_umae B_ubdve B_stend B_pwf B_nlpreq B_nlpnew B_nlperft B_nlperf B_nlpe B_nlnlpl B_lrnws B_lrnvb B_lrntesa B_lrnrdy B_lrnfg B_lrnerf B_lrndia B_lrnakt B_i_ska_um B_fprzvb B_fprzok B_fprze B_fprzab B_fprrdy B_fprovb B_fprordy B_fprook B_fproe B_fproab B_fprakt B_dvetv B_dvete B_dveada B_dlrspid B_dkpiu B_dknot B_dknolu B_dkaden B_dcdisr B_dcdisfr B_abgle BGDVEintbits /end LOC_MEASUREMENT
/end FUNCTION
/begin FUNCTION BGGNSOL "1.10      Berechnete Grî·e Getriebesolldrehzahlbeeinflussung" /begin REF_CHARACTERISTIC KFGNSOL /end REF_CHARACTERISTIC /begin LOC_MEASUREMENT tnst_w tmot fgnsol B_stend /end LOC_MEASUREMENT /end FUNCTION
/begin FUNCTION BGKMST "1.10      Berechnete Grî·e: Kilometerstand" /begin LOC_MEASUREMENT vfzg_u kmst_w kmstmil_w FCMTab fcmEnd B_mil /end LOC_MEASUREMENT /end FUNCTION
/begin FUNCTION BGLBZ "4.1       Berechnete Grî·e Ladebilanz der Batterie" /begin REF_CHARACTERISTIC ZKLBZ ZKFUB UBSOLMX UBSOLMN NRUBMX DUBLBZ /end REF_CHARACTERISTIC /begin LOC_MEASUREMENT ubsol ubf ub nmotll lbz dub B_st /end LOC_MEASUREMENT /end FUNCTION
/begin FUNCTION BGMSABG "2.10      Berechnung Abgasmassenstrom - bankabhÑngig" /begin LOC_MEASUREMENT msl msabg_w msabg ml_w mlbb_w mlbb ml /end LOC_MEASUREMENT /end FUNCTION
/begin FUNCTION BGMSZS "12.50     FÅllungserfassung Berechnung Massenstrîme zum Saugrohr"
 /begin REF_CHARACTERISTIC ZKPVDKT ZKMSDKT WDKUGDN TDMSDKS SNM12FEUB RLNOT PSPVDKUG MSLG MSALLMX MSALLMN MLFKMSDK LADFIL KVLAD KUMSRL KLAF KIMSALL KFMSNWDK FKPVDKMX FKPVDKMN FKMSDKMX FKMSDKMN DFKPVMX DFKPVMN DFKMSMX DFKMSMN CWFKMSDKA /end REF_CHARACTERISTIC
 /begin LOC_MEASUREMENT wdkugd_w wdkba_w wdkbab_w umsrln_w rlroh_w rldvs_w pvdk_w pvdkds_w pvdk pu_w ps_w pspvds_w pspvdk_w pspvdb_w nmot_w nmot mste mss_w mssaug_w mssaug msnwdk_kge msnsaug_w msndk_w msndko_w msndkoo_w mshfm_w msdk_w msdkue_w msdkalm_w msdif_w ml_w klaf_kge ftvdk frhodk_w fpvdk_w fpvdkds_w fpvdk fkpvdk_w fkmsdk_w fkmsdks_w fklaf_w esst_snm12feub drllad_w dfuelsan_w B_ugd B_pwf B_hfm B_fkpvmx B_fkpvmn B_fkpvdk B_fkmsmx B_fkmsmn B_fkmsdks B_dsuv B_dssv B_dslvh /end LOC_MEASUREMENT
/end FUNCTION
/begin FUNCTION BGNG "5.20      Berechnete Grî·e Drehzahlgradient" /begin REF_CHARACTERISTIC ZNGFIL /end REF_CHARACTERISTIC
 /begin LOC_MEASUREMENT tseg_w tsegrsp_w_5__A tsegrsp_w_4__A tsegrsp_w_3__A tsegrsp_w_2__A tsegrsp_w_1__A tsegrsp_w_0__A tseghi tsas_w nmot_w nmotrsp_w_5__A nmotrsp_w_4__A nmotrsp_w_3__A nmotrsp_w_2__A nmotrsp_w_1__A nmotrsp_w_0__A nmotas_w ngfil_w ngfil ngas_w irspsyn dnmot_w dnmotas_w B_syn2nd B_ngasok /end LOC_MEASUREMENT
/end FUNCTION
/begin FUNCTION BGNMOT "5.30      Berechnete Grî·e Drehzahl"
 /begin LOC_MEASUREMENT tseg_w tseghi tr_zeit_msb tr_zeit tnbm_w tnbm1_w nmot_w nmot B_nmin B_bm /end LOC_MEASUREMENT
/end FUNCTION
/begin FUNCTION BGPUK "1.10      Berechnungsgrî·e Umgebungsdruck korrigiert (Bergabfahrterkennung)" /begin REF_CHARACTERISTIC TPUKOR PUSMIN PUSMAX PUKORRV DIFFMAX /end REF_CHARACTERISTIC
 /begin LOC_MEASUREMENT vfzg_w pus_w pumean_w pukor_w pukorf_w pukBits B_puerr B_add /end LOC_MEASUREMENT
/end FUNCTION
/end MODULE
/end PROJECT
