ASAP2_VERSION 1 21
/begin PROJECT Pro4017 "R4 1.8l 5V T lÑngs FR5ROM F5051"
/begin HEADER "" PROJECT_NO Pro4017 VERSION "PrV = F21dc mit 00" /end HEADER
/begin MODULE DIM " "
/begin MOD_COMMON " " S_REC_LAYOUT ME7 BYTE_ORDER MSB_LAST /end MOD_COMMON
/begin COMPU_METHOD B_TRUE "boolsche ZustÑnde, positive Logik" TAB_VERB "%6.3" "" COMPU_TAB_REF B_TRUE /end COMPU_METHOD
/begin COMPU_METHOD B_TRUE___UW "boolsche ZustÑnde, positive Logik" TAB_VERB "%6.3" "" COMPU_TAB_REF B_TRUE /end COMPU_METHOD
/begin COMPU_METHOD dez "1 : 1 Umrechnug (dez/hex)" RAT_FUNC "%6.2" "" COEFFS 0 1.000000 0.000000 0 0.000000 1.000000 /end COMPU_METHOD
/begin COMPU_METHOD dez___UW "1 : 1 Umrechnug (dez/hex)" RAT_FUNC "%6.2" "" COEFFS 0 1.000000 0.000000 0 0.000000 1.000000 /end COMPU_METHOD
/begin COMPU_METHOD fak_q0p1 "" RAT_FUNC "%6.3" "" COEFFS 0 1.000000 0.000000 0 0.000000 1.000000e-01 /end COMPU_METHOD
/begin COMPU_METHOD fak_sw_b1 "" RAT_FUNC "%7.6" "-" COEFFS 0 6.553600e+04 0.000000 0 0.000000 2.000000 /end COMPU_METHOD
/begin COMPU_METHOD fak_ub_b1 "" RAT_FUNC "%6.4" "-" COEFFS 0 256.000000 0.000000 0 0.000000 1.000000 /end COMPU_METHOD
/begin COMPU_METHOD fak_ub_b16 "" RAT_FUNC "%6.4" "-" COEFFS 0 256.000000 0.000000 0 0.000000 16.000000 /end COMPU_METHOD
/begin COMPU_METHOD fak_ub_b2 "" RAT_FUNC "%6.4" "-" COEFFS 0 256.000000 0.000000 0 0.000000 2.000000 /end COMPU_METHOD
/begin COMPU_METHOD fak_ub_b4 "" RAT_FUNC "%6.4" "-" COEFFS 0 256.000000 0.000000 0 0.000000 4.000000 /end COMPU_METHOD
/begin COMPU_METHOD fak_ub_b8 "" RAT_FUNC "%6.4" "-" COEFFS 0 256.000000 0.000000 0 0.000000 8.000000 /end COMPU_METHOD
/begin COMPU_METHOD fak_uw_b16 "" RAT_FUNC "%6.5" "-" COEFFS 0 6.553600e+04 0.000000 0 0.000000 16.000000 /end COMPU_METHOD
/begin COMPU_METHOD fak_uw_b2 "" RAT_FUNC "%7.6" "-" COEFFS 0 6.553600e+04 0.000000 0 0.000000 2.000000 /end COMPU_METHOD
/begin COMPU_METHOD fak_uw_b4 "" RAT_FUNC "%7.6" "-" COEFFS 0 6.553600e+04 0.000000 0 0.000000 4.000000 /end COMPU_METHOD
/begin COMPU_METHOD fak_uw_b8 "" RAT_FUNC "%6.5" "-" COEFFS 0 6.553600e+04 0.000000 0 0.000000 8.000000 /end COMPU_METHOD
/begin COMPU_METHOD kw_q0p0019 "" RAT_FUNC "%6.4" "∞KW" COEFFS 0 512.000000 0.000000 0 0.000000 1.000000 /end COMPU_METHOD
/begin COMPU_METHOD kw_q0p0039 "" RAT_FUNC "%6.4" "∞KW" COEFFS 0 256.000000 0.000000 0 0.000000 1.000000 /end COMPU_METHOD
/begin COMPU_METHOD kw_q0p25 "" RAT_FUNC "%6.3" "∞KW" COEFFS 0 4.000000 0.000000 0 0.000000 1.000000 /end COMPU_METHOD
/begin COMPU_METHOD kw_sw_b128 "" RAT_FUNC "%6.4" "∞KW" COEFFS 0 6.553600e+04 0.000000 0 0.000000 256.000000 /end COMPU_METHOD
/begin COMPU_METHOD kw_ub_q0p5 "" RAT_FUNC "%6.3" "∞KW" COEFFS 0 256.000000 0.000000 0 0.000000 128.000000 /end COMPU_METHOD
/begin COMPU_METHOD lw_sb_q11p2 "" RAT_FUNC "%6.1" "∞" COEFFS 0 127.000000 0.000000 0 0.000000 1434.000000 /end COMPU_METHOD
/begin COMPU_METHOD lw_sw_q0p04375 "" RAT_FUNC "%6.4" "∞" COEFFS 0 32767.000000 0.000000 0 0.000000 1434.000000 /end COMPU_METHOD
/begin COMPU_METHOD m_ub_b1020 "" RAT_FUNC "%6.2" "kg/h" COEFFS 0 1.000000 0.000000 0 0.000000 4.000000 /end COMPU_METHOD
/begin COMPU_METHOD m_ub_q0p4 "" RAT_FUNC "%6.3" "kg" COEFFS 0 1.000000 0.000000 0 0.000000 4.000000e-01 /end COMPU_METHOD
/begin COMPU_METHOD m_uw_b4660 "" RAT_FUNC "%6.4" "g" COEFFS 0 3600.000000 0.000000 0 0.000000 256.000000 /end COMPU_METHOD
/begin COMPU_METHOD m_uw_b6553p5 "" RAT_FUNC "%6.3" "kg/h" COEFFS 0 1.000000 0.000000 0 0.000000 1.000000e-01 /end COMPU_METHOD
/begin COMPU_METHOD m_uw_b7281 "" RAT_FUNC "%6.3" "g" COEFFS 0 9.000000 0.000000 0 0.000000 1.000000 /end COMPU_METHOD
/begin COMPU_METHOD nmotg_sb_q100 "" RAT_FUNC "%6.0" "U/min/s" COEFFS 0 1.000000 0.000000 0 0.000000 100.000000 /end COMPU_METHOD
/begin COMPU_METHOD nmotg_sw_q0p39 "" RAT_FUNC "%6.3" "U/min/s" COEFFS 0 1.000000 0.000000 0 0.000000 3.906300e-01 /end COMPU_METHOD
/begin COMPU_METHOD nmot_q10 "" RAT_FUNC "%6.1" "" COEFFS 0 1.000000 0.000000 0 0.000000 10.000000 /end COMPU_METHOD
/begin COMPU_METHOD nmot_q10___UB "" RAT_FUNC "%6.1" "" COEFFS 0 1.000000 0.000000 0 0.000000 10.000000 /end COMPU_METHOD
/begin COMPU_METHOD nmot_sw_q0p25 "" RAT_FUNC "%6.3" "U/min" COEFFS 0 1.000000 0.000000 0 0.000000 2.500000e-01 /end COMPU_METHOD
/begin COMPU_METHOD nmot_ub_q10 "" RAT_FUNC "%6.1" "U/min" COEFFS 0 1.000000 0.000000 0 0.000000 10.000000 /end COMPU_METHOD
/begin COMPU_METHOD nmot_ub_q40 "" RAT_FUNC "%6.1" "Upm" COEFFS 0 1.000000 0.000000 0 0.000000 40.000000 /end COMPU_METHOD
/begin COMPU_METHOD nmot_uw_q0p25 "" RAT_FUNC "%6.3" "U/min" COEFFS 0 1.000000 0.000000 0 0.000000 2.500000e-01 /end COMPU_METHOD
/begin COMPU_METHOD p_sb_q10 "" RAT_FUNC "%6.1" "hPa" COEFFS 0 1.000000 0.000000 0 0.000000 10.000000 /end COMPU_METHOD
/begin COMPU_METHOD p_ub_q5 "" RAT_FUNC "%6.2" "hPa" COEFFS 0 1.000000 0.000000 0 0.000000 5.000000 /end COMPU_METHOD
/begin COMPU_METHOD p_uw_q0p039 "" RAT_FUNC "%6.4" "hPa" COEFFS 0 256.000000 0.000000 0 0.000000 10.000000 /end COMPU_METHOD
/begin COMPU_METHOD relDK_ub_b100 "" RAT_FUNC "%6.3" "% DK" COEFFS 0 255.000000 0.000000 0 0.000000 100.000000 /end COMPU_METHOD
/begin COMPU_METHOD relnmot_q0p0039 "" RAT_FUNC "%6.4" "%/(U/min)" COEFFS 0 256.000000 0.000000 0 0.000000 1.000000 /end COMPU_METHOD
/begin COMPU_METHOD relnmot_q0p02 "" RAT_FUNC "%6.4" "%/(U/min)/s" COEFFS 0 1.000000 0.000000 0 0.000000 2.000000e-02 /end COMPU_METHOD
/begin COMPU_METHOD relPED_ub_b100 "" RAT_FUNC "%6.3" "% PED" COEFFS 0 255.000000 0.000000 0 0.000000 100.000000 /end COMPU_METHOD
/begin COMPU_METHOD relPED_uw_b100 "" RAT_FUNC "%6.4" "% PED" COEFFS 0 65535.000000 0.000000 0 0.000000 100.000000 /end COMPU_METHOD
/begin COMPU_METHOD rel_q0p025 "" RAT_FUNC "%6.4" "%" COEFFS 0 1.000000 0.000000 0 0.000000 2.500000e-02 /end COMPU_METHOD
/begin COMPU_METHOD rel_sb_q0p02 "" RAT_FUNC "%6.4" "%" COEFFS 0 50.000000 0.000000 0 0.000000 1.000000 /end COMPU_METHOD
/begin COMPU_METHOD rel_sw_b100 "" RAT_FUNC "%6.4" "%" COEFFS 0 3.276800e+04 0.000000 0 0.000000 100.000000 /end COMPU_METHOD
/begin COMPU_METHOD rel_sw_b50 "" RAT_FUNC "%6.4" "%" COEFFS 0 6.553600e+04 0.000000 0 0.000000 100.000000 /end COMPU_METHOD
/begin COMPU_METHOD rel_sw_q0p0234 "" RAT_FUNC "%6.4" "%/seg" COEFFS 0 32.000000 0.000000 0 0.000000 7.500000e-01 /end COMPU_METHOD
/begin COMPU_METHOD rel_ub_b127p5 "" RAT_FUNC "%6.3" "%" COEFFS 0 2.000000 0.000000 0 0.000000 1.000000 /end COMPU_METHOD
/begin COMPU_METHOD rel_ub_b99p6 "" RAT_FUNC "%6.3" "%" COEFFS 0 256.000000 0.000000 0 0.000000 100.000000 /end COMPU_METHOD
/begin COMPU_METHOD rel_ub_q0p3906___UB "" RAT_FUNC "%6.3" "%" COEFFS 0 256.000000 0.000000 0 0.000000 100.000000 /end COMPU_METHOD
/begin COMPU_METHOD rel_ub_q0p75 "" RAT_FUNC "%6.3" "%" COEFFS 0 1.000000 0.000000 0 0.000000 7.500000e-01 /end COMPU_METHOD
/begin COMPU_METHOD rel_uw_b100 "" RAT_FUNC "%6.4" "%" COEFFS 0 6.553600e+04 0.000000 0 0.000000 100.000000 /end COMPU_METHOD
/begin COMPU_METHOD rel_uw_b200 "" RAT_FUNC "%6.4" "%" COEFFS 0 6.553600e+04 0.000000 0 0.000000 200.000000 /end COMPU_METHOD
/begin COMPU_METHOD rel_uw_b3072 "" RAT_FUNC "%6.4" "%" COEFFS 0 6.553600e+04 0.000000 0 0.000000 3072.000000 /end COMPU_METHOD
/begin COMPU_METHOD rel_uw_b728 "" RAT_FUNC "%4.2" "%/s" COEFFS 0 6.553600 0.000000 0 0.000000 1.000000 /end COMPU_METHOD
/begin COMPU_METHOD rel_uw_q0p001 "" RAT_FUNC "%6.4" "%" COEFFS 0 1000.000000 0.000000 0 0.000000 1.000000 /end COMPU_METHOD
/begin COMPU_METHOD rel_uw_q0p0234 "" RAT_FUNC "%6.4" "%" COEFFS 0 32.000000 0.000000 0 0.000000 7.500000e-01 /end COMPU_METHOD
/begin COMPU_METHOD rkti_sy "" RAT_FUNC "%6.4" "ms/%" COEFFS 0 468.750000 0.000000 0 0.000000 1.000000 /end COMPU_METHOD
/begin COMPU_METHOD runtime1_sy "" RAT_FUNC "%6.2" "us" COEFFS 0 1.250000 0.000000 0 0.000000 1.000000 /end COMPU_METHOD
/begin COMPU_METHOD runtime2_sy "" RAT_FUNC "%6.1" "us" COEFFS 0 7.812500e-02 0.000000 0 0.000000 1.000000 /end COMPU_METHOD
/begin COMPU_METHOD spg_ubatt "" RAT_FUNC "%6.4" "V" COEFFS 0 1.000000 0.000000 0 0.000000 7.040000e-02 /end COMPU_METHOD
/begin COMPU_METHOD spg_ub_q0p0052_o0p2 "" RAT_FUNC "%6.3" "V" COEFFS 0 255.000000 51.000000 0 0.000000 1.330000 /end COMPU_METHOD
/begin COMPU_METHOD spg_uw_q0p00488_o1 "" RAT_FUNC "%6.3" "V" COEFFS 0 1024.000000 1024.000000 0 0.000000 5.000000 /end COMPU_METHOD
/begin COMPU_METHOD t100msxs_sb_q0p01 "" RAT_FUNC "%6.4" "s" COEFFS 0 1.000000 0.000000 0 0.000000 1.000000e-02 /end COMPU_METHOD
/begin COMPU_METHOD t100msxs_uw_b6553p6 "" RAT_FUNC "%6.3" "s" COEFFS 0 10.000000 0.000000 0 0.000000 1.000000 /end COMPU_METHOD
/begin COMPU_METHOD t10msxs_uw_b655p35 "" RAT_FUNC "%6.4" "s" COEFFS 0 1.000000 0.000000 0 0.000000 1.000000e-02 /end COMPU_METHOD
/begin COMPU_METHOD t1sxs_uw_q1 "" RAT_FUNC "%6.2" "s" COEFFS 0 1.000000 0.000000 0 0.000000 1.000000 /end COMPU_METHOD
/begin COMPU_METHOD t20msxs_ub_b5p1 "" RAT_FUNC "%6.4" "s" COEFFS 0 1.000000 0.000000 0 0.000000 2.000000e-02 /end COMPU_METHOD
/begin COMPU_METHOD t20msxs_uw_q0p02 "" RAT_FUNC "%6.4" "s" COEFFS 0 1.000000 0.000000 0 0.000000 2.000000e-02 /end COMPU_METHOD
/begin COMPU_METHOD temp_ub_q0p75_o48 "" RAT_FUNC "%6.2" "Grad C" COEFFS 0 1.000000 48.000000 0 0.000000 7.500000e-01 /end COMPU_METHOD
/begin COMPU_METHOD temp_ub_q5_o50 "" RAT_FUNC "%6.2" "Grad C" COEFFS 0 1.000000 50.000000 0 0.000000 5.000000 /end COMPU_METHOD
/begin COMPU_METHOD temp_uw_q0p0195_o50 "" RAT_FUNC "%6.2" "Grad C" COEFFS 0 256.000000 12800.000000 0 0.000000 5.000000 /end COMPU_METHOD
/begin COMPU_METHOD tgrad_ub_q0p039 "" RAT_FUNC "%6.4" "ms/s" COEFFS 0 256.000000 0.000000 0 0.000000 10.000000 /end COMPU_METHOD
/begin COMPU_METHOD tinjection5_sy "" RAT_FUNC "%6.4" "ms" COEFFS 0 62.500000 0.000000 0 0.000000 1.000000 /end COMPU_METHOD
/begin COMPU_METHOD tinjection_sy "" RAT_FUNC "%6.4" "ms" COEFFS 0 312.500000 0.000000 0 0.000000 1.000000 /end COMPU_METHOD
/begin COMPU_METHOD vfzg_ub_q1p25___UB "" RAT_FUNC "%6.2" "km/h" COEFFS 0 1.000000 0.000000 0 0.000000 1.250000 /end COMPU_METHOD
/begin COMPU_METHOD vfzg_uw_b512 "" RAT_FUNC "%6.4" "km/h" COEFFS 0 6.553600e+04 0.000000 0 0.000000 512.000000 /end COMPU_METHOD
/begin COMPU_METHOD zk10msxs_uw_b655 "" RAT_FUNC "%10.4" "s" COEFFS 0 0.000000 6.553600e+04 0 100.000000 0.000000 /end COMPU_METHOD
/begin COMPU_METHOD zw_sb_q0p75 "" RAT_FUNC "%6.3" "grad KW" COEFFS 0 255.000000 0.000000 0 0.000000 191.250000 /end COMPU_METHOD
/begin COMPU_METHOD zw_ub_q0p75 "" RAT_FUNC "%6.3" "Grad KW" COEFFS 0 255.000000 0.000000 0 0.000000 191.250000 /end COMPU_METHOD
/begin COMPU_VTAB B_TRUE "" TAB_VERB 2 0 "----" 1 "TRUE" /end COMPU_VTAB
/begin MEASUREMENT tmot "Motor-Temperatur" UBYTE temp_ub_q0p75_o48 0 0 -48.000000 143.250000 /begin IF_DATA ASAP1B_ETK KP_BLOB 0x380B61 1 1 /end IF_DATA BIT_MASK 0xFF /end MEASUREMENT
/begin MEASUREMENT rl "relative LuftfÅllung" UBYTE rel_ub_q0p75 0 0 0.000000 191.250000 /begin IF_DATA ASAP1B_ETK KP_BLOB 0xF997 0 1 /end IF_DATA BIT_MASK 0xFF /end MEASUREMENT
/begin MEASUREMENT nmot "Motordrehzahl" UBYTE nmot_ub_q40 0 0 0.000000 10200.000000 /begin IF_DATA ASAP1B_ETK KP_BLOB 0xF876 0 1 /end IF_DATA BIT_MASK 0xFF /end MEASUREMENT
/begin MEASUREMENT tans "Ansauglufttemperatur" UBYTE temp_ub_q0p75_o48 0 0 -48.000000 143.250000 /begin IF_DATA ASAP1B_ETK KP_BLOB 0x380B59 1 1 /end IF_DATA BIT_MASK 0xFF /end MEASUREMENT
/begin MEASUREMENT fho "Korrekturfaktor Hîhe" UBYTE fak_ub_b4 0 0 0.000000 3.984375 /begin IF_DATA ASAP1B_ETK KP_BLOB 0x380AEB 1 1 /end IF_DATA BIT_MASK 0xFF /end MEASUREMENT
/begin MEASUREMENT anztib_w "ti-EinspritzzÑhler mit Begrenzung" UWORD dez___UW 0 0 0.000000 65535.000000 /begin IF_DATA ASAP1B_ETK KP_BLOB 0x381F88 1 2 /end IF_DATA BIT_MASK 0xFFFF /end MEASUREMENT
/begin MEASUREMENT wped "Normierter Fahrpedalwinkel" UBYTE relPED_ub_b100 0 0 0.000000 100.000000 /begin IF_DATA ASAP1B_ETK KP_BLOB 0x380ABA 1 1 /end IF_DATA BIT_MASK 0xFF /end MEASUREMENT
/begin MEASUREMENT nmot_w "Motordrehzahl" UWORD nmot_uw_q0p25 0 0 0.000000 16383.750000 /begin IF_DATA ASAP1B_ETK KP_BLOB 0xF878 0 2 /end IF_DATA BIT_MASK 0xFFFF /end MEASUREMENT
/begin MEASUREMENT ml "Luftmassenflu·" UBYTE m_ub_b1020 0 0 0.000000 1020.000000 /begin IF_DATA ASAP1B_ETK KP_BLOB 0xF996 0 1 /end IF_DATA BIT_MASK 0xFF /end MEASUREMENT
/begin MEASUREMENT kstaa "Aktueller Startmengenadaptionsfaktor" UBYTE fak_ub_b2 0 0 0.000000 1.992188 /begin IF_DATA ASAP1B_ETK KP_BLOB 0x380B35 1 1 /end IF_DATA BIT_MASK 0xFF /end MEASUREMENT
/begin MEASUREMENT ngfil "gefilterter Drehzahlgradient" SBYTE nmotg_sb_q100 0 0 -12800.000000 12700.000000 /begin IF_DATA ASAP1B_ETK KP_BLOB 0x380A53 1 1 /end IF_DATA BIT_MASK 0xFF /end MEASUREMENT
/begin MEASUREMENT mifa_w "indiziertes Motormoment Fahrerwunsch" UWORD rel_uw_b100 0 0 0.000000 99.998474 /begin IF_DATA ASAP1B_ETK KP_BLOB 0x38243C 1 2 /end IF_DATA BIT_MASK 0xFFFF /end MEASUREMENT
/begin MEASUREMENT uevges "öbersetzungsverhÑltnis gesamt" UBYTE fak_q0p1 0 0 0.000000 25.500000 /begin IF_DATA ASAP1B_ETK KP_BLOB 0x380AB6 1 1 /end IF_DATA BIT_MASK 0xFF /end MEASUREMENT
/begin MEASUREMENT qmsdyn "Quotient aus ml_w und mssgin_w" UBYTE fak_ub_b16 0 0 0.000000 15.937500 /begin IF_DATA ASAP1B_ETK KP_BLOB 0x380CB0 1 1 /end IF_DATA BIT_MASK 0xFF /end MEASUREMENT
/begin MEASUREMENT lde "LDR-Regelabweichung (Sollwert - Istwert)" SBYTE p_sb_q10 0 0 -1280.000000 1270.000000 /begin IF_DATA ASAP1B_ETK KP_BLOB 0x380C01 1 1 /end IF_DATA BIT_MASK 0xFF /end MEASUREMENT
/begin MEASUREMENT plsolr_w "Relativer Solladedruck LDR" UWORD p_uw_q0p039 0 0 0.000000 2559.960938 /begin IF_DATA ASAP1B_ETK KP_BLOB 0x3822B8 1 2 /end IF_DATA BIT_MASK 0xFFFF /end MEASUREMENT
/begin MEASUREMENT wkrmstat "QuasistationÑrer Mittelwert der zylinderindividuellen ZW SpÑtverstellwerte" UBYTE zw_ub_q0p75 0 0 0.000000 191.250000 /begin IF_DATA ASAP1B_ETK KP_BLOB 0x380C0B 1 1 /end IF_DATA BIT_MASK 0xFF /end MEASUREMENT
/begin MEASUREMENT wkrmdy "Dynamischer Mittelwert der zylinderindividuellen ZW SpÑtverstellungen" UBYTE zw_ub_q0p75 0 0 0.000000 191.250000 /begin IF_DATA ASAP1B_ETK KP_BLOB 0x380C0A 1 1 /end IF_DATA BIT_MASK 0xFF /end MEASUREMENT
/begin MEASUREMENT wkrmsu "Summenwert aus dynamischem und statischem Mittelwert der KR Verstellwinkel" UBYTE zw_ub_q0p75 0 0 0.000000 191.250000 /begin IF_DATA ASAP1B_ETK KP_BLOB 0x380C0C 1 1 /end IF_DATA BIT_MASK 0xFF /end MEASUREMENT
/begin MEASUREMENT pu "Umgebungsdruck" UBYTE p_ub_q5 0 0 0.000000 1275.000000 /begin IF_DATA ASAP1B_ETK KP_BLOB 0x380AEC 1 1 /end IF_DATA BIT_MASK 0xFF /end MEASUREMENT
/begin MEASUREMENT vpsspu_w "SolldruckverhÑltnis Umgebung/Saugrohr" UWORD fak_uw_b4 0 0 0.000000 3.999939 /begin IF_DATA ASAP1B_ETK KP_BLOB 0x38229A 1 2 /end IF_DATA BIT_MASK 0xFFFF /end MEASUREMENT
/begin MEASUREMENT wdkba "Drosselklappenwinkel bezogen auf unteren Anschlag" UBYTE relDK_ub_b100 0 0 0.000000 100.000000 /begin IF_DATA ASAP1B_ETK KP_BLOB 0x380ACB 1 1 /end IF_DATA BIT_MASK 0xFF /end MEASUREMENT
/begin MEASUREMENT frmit "Bei Stereo-LR: Mittelwert des fr,fr2 oder bei Ausfall einer Bank: fr der i.O. Bk" UBYTE fak_ub_b2 0 0 0.000000 1.992188 /begin IF_DATA ASAP1B_ETK KP_BLOB 0x380CAB 1 1 /end IF_DATA BIT_MASK 0xFF /end MEASUREMENT
/begin MEASUREMENT gangi "Ist-Gang" UBYTE dez 0 0 0.000000 255.000000 /begin IF_DATA ASAP1B_ETK KP_BLOB 0x380AB5 1 1 /end IF_DATA BIT_MASK 0xFF /end MEASUREMENT
/begin MEASUREMENT tmst "Motorstarttemperatur" UBYTE temp_ub_q0p75_o48 0 0 -48.000000 143.250000 /begin IF_DATA ASAP1B_ETK KP_BLOB 0x380B5F 1 1 /end IF_DATA BIT_MASK 0xFF /end MEASUREMENT
/begin MEASUREMENT ml_w "Luftmassenflu· gefiltert (Word)" UWORD m_uw_b6553p5 0 0 0.000000 6553.500000 /begin IF_DATA ASAP1B_ETK KP_BLOB 0xF998 0 2 /end IF_DATA BIT_MASK 0xFFFF /end MEASUREMENT
/begin MEASUREMENT lamsbg_w "Lambdasoll Begrenzung (word)" UWORD fak_uw_b16 0 0 0.000000 15.999756 /begin IF_DATA ASAP1B_ETK KP_BLOB 0x381FE2 1 2 /end IF_DATA BIT_MASK 0xFFFF /end MEASUREMENT
/begin MEASUREMENT etazwimt "Ist_ZÅndwinkelwirkungsgrad fÅr ATM gemittelt (200 ms)" UBYTE rel_ub_b127p5 0 0 0.000000 127.500000 /begin IF_DATA ASAP1B_ETK KP_BLOB 0x380A66 1 1 /end IF_DATA BIT_MASK 0xFF /end MEASUREMENT
/begin MEASUREMENT tabgmst "Abgastemperatur bei Motorstart" UBYTE temp_ub_q5_o50 0 0 -50.000000 1225.000000 /begin IF_DATA ASAP1B_ETK KP_BLOB 0x380A69 1 1 /end IF_DATA BIT_MASK 0xFF /end MEASUREMENT
/begin MEASUREMENT tkatmst "Katalysatortemperatur Modell Startwert = f(Abstellwert, Abstellzeit)" UBYTE temp_ub_q5_o50 0 0 -50.000000 1225.000000 /begin IF_DATA ASAP1B_ETK KP_BLOB 0x380A6E 1 1 /end IF_DATA BIT_MASK 0xFF /end MEASUREMENT
/begin MEASUREMENT tabstatm_w "Abstellzeit im SG-Nachlauf fÅr ATM" UWORD t1sxs_uw_q1 0 0 0.000000 65535.000000 /begin IF_DATA ASAP1B_ETK KP_BLOB 0x381B0E 1 2 /end IF_DATA BIT_MASK 0xFFFF /end MEASUREMENT
/begin MEASUREMENT rl_w_kge "Eingang relative FÅllung (Word) fÅr mehrfach verwendete Kenngr." UWORD rel_uw_q0p0234 0 0 0.000000 1535.976562 /begin IF_DATA ASAP1B_ETK KP_BLOB 0x38249A 1 2 /end IF_DATA BIT_MASK 0xFFFF /end MEASUREMENT
/begin MEASUREMENT mizuvfil "ZulÑssiges indiziertes Moment vor Filter" UBYTE rel_ub_b99p6 0 0 0.000000 99.609375 /begin IF_DATA ASAP1B_ETK KP_BLOB 0x380C53 1 1 /end IF_DATA BIT_MASK 0xFF /end MEASUREMENT
/begin MEASUREMENT rl_w "relative LuftfÅllung (Word)" UWORD rel_uw_q0p0234 0 0 0.000000 1535.976562 /begin IF_DATA ASAP1B_ETK KP_BLOB 0xF99C 0 2 /end IF_DATA BIT_MASK 0xFFFF /end MEASUREMENT
/begin MEASUREMENT vfzg "Fahrzeuggeschwindigkeit" UBYTE vfzg_ub_q1p25___UB 0 0 0.000000 318.750000 /begin IF_DATA ASAP1B_ETK KP_BLOB 0x380982 1 1 /end IF_DATA BIT_MASK 0xFF /end MEASUREMENT
/begin MEASUREMENT frhol_w "Faktor Luftdichte f(Ansauglufttemp., Hîhe) 16-Bit" UWORD fak_uw_b2 0 0 0.000000 1.999969 /begin IF_DATA ASAP1B_ETK KP_BLOB 0x381E9E 1 2 /end IF_DATA BIT_MASK 0xFFFF /end MEASUREMENT
/begin MEASUREMENT ubf "gefilterte Batteriespannung fÅr Batteriespannungsregelung" UBYTE spg_ubatt 0 0 0.000000 17.952000 /begin IF_DATA ASAP1B_ETK KP_BLOB 0x380AAF 1 1 /end IF_DATA BIT_MASK 0xFF /end MEASUREMENT
/begin MEASUREMENT tkatm "Katalysatortemperatur aus Modell" UBYTE temp_ub_q5_o50 0 0 -50.000000 1225.000000 /begin IF_DATA ASAP1B_ETK KP_BLOB 0x380A6D 1 1 /end IF_DATA BIT_MASK 0xFF /end MEASUREMENT
/begin MEASUREMENT vfzg_w "Fahrzeuggeschwindigkeit, gefiltert" UWORD vfzg_uw_b512 0 0 0.000000 511.992188 /begin IF_DATA ASAP1B_ETK KP_BLOB 0x380DA6 1 2 /end IF_DATA BIT_MASK 0xFFFF /end MEASUREMENT
/begin MEASUREMENT mrfgr_w "Relative Momentenanforderung von FGR" UWORD rel_uw_b200 0 0 0.000000 199.996948 /begin IF_DATA ASAP1B_ETK KP_BLOB 0x381D92 1 2 /end IF_DATA BIT_MASK 0xFFFF /end MEASUREMENT
/begin MEASUREMENT wnwue "Winkel Nockenwellenueberschneidung" UBYTE kw_ub_q0p5 0 0 0.000000 127.500000 /begin IF_DATA ASAP1B_ETK KP_BLOB 0x380B00 1 1 /end IF_DATA BIT_MASK 0xFF /end MEASUREMENT
/begin MEASUREMENT nmotll "Motordrehzahl im Leerlaufbereich" UBYTE nmot_ub_q10 0 0 0.000000 2550.000000 /begin IF_DATA ASAP1B_ETK KP_BLOB 0x380C2D 1 1 /end IF_DATA BIT_MASK 0xFF /end MEASUREMENT
/begin MEASUREMENT wped_w "Normierter Fahrpedalwinkel" UWORD relPED_uw_b100 0 0 0.000000 100.000000 /begin IF_DATA ASAP1B_ETK KP_BLOB 0x381CAE 1 2 /end IF_DATA BIT_MASK 0xFFFF /end MEASUREMENT
/begin MEASUREMENT fho_w "Korrekturfaktor Hîhe (word)" UWORD fak_uw_b4 0 0 0.000000 3.999939 /begin IF_DATA ASAP1B_ETK KP_BLOB 0x381E9A 1 2 /end IF_DATA BIT_MASK 0xFFFF /end MEASUREMENT
/begin MEASUREMENT misopl1_w "Solluftmoment, rÅckgerechnet auf Lambda=1 und zwopt" UWORD rel_uw_b100 0 0 0.000000 99.998474 /begin IF_DATA ASAP1B_ETK KP_BLOB 0x381F4A 1 2 /end IF_DATA BIT_MASK 0xFFFF /end MEASUREMENT
/begin MEASUREMENT rlsnwtm "rel.SollfÅllung zur Adressierung von KFNWS gewichtet mit tmot" UBYTE rel_ub_q0p75 0 0 0.000000 191.250000 /begin IF_DATA ASAP1B_ETK KP_BLOB 0x380AFE 1 1 /end IF_DATA BIT_MASK 0xFF /end MEASUREMENT
/begin MEASUREMENT tevfa_w_kge "" UWORD tinjection_sy 0 0 0.000000 209.712000 /begin IF_DATA ASAP1B_ETK KP_BLOB 0x381FB2 1 2 /end IF_DATA BIT_MASK 0xFFFF /end MEASUREMENT
/begin MEASUREMENT ub "Batteriespannung" UBYTE spg_ubatt 0 0 0.000000 17.952000 /begin IF_DATA ASAP1B_ETK KP_BLOB 0x380AB1 1 1 /end IF_DATA BIT_MASK 0xFF /end MEASUREMENT
/begin MEASUREMENT mrfa_w "Relatives Fahrerwunschmoment aus FGR und Pedal" UWORD rel_uw_b200 0 0 0.000000 199.996948 /begin IF_DATA ASAP1B_ETK KP_BLOB 0x38244C 1 2 /end IF_DATA BIT_MASK 0xFFFF /end MEASUREMENT
/begin MEASUREMENT tmrw "Motortemperatur-Referenzwert aus Modell" UBYTE temp_ub_q0p75_o48 0 0 -48.000000 143.250000 /begin IF_DATA ASAP1B_ETK KP_BLOB 0x380B5D 1 1 /end IF_DATA BIT_MASK 0xFF /end MEASUREMENT
/begin MEASUREMENT imlpr "Relatives Luftmassenintegral bei Katheizung" UBYTE fak_ub_b1 0 0 0.000000 0.996094 /begin IF_DATA ASAP1B_ETK KP_BLOB 0x380B68 1 1 /end IF_DATA BIT_MASK 0xFF /end MEASUREMENT
/begin MEASUREMENT evtmod "Einla·ventiltemperatur modelliert (Temperaturmodell)" UBYTE temp_ub_q0p75_o48 0 0 -48.000000 143.250000 /begin IF_DATA ASAP1B_ETK KP_BLOB 0x380AF0 1 1 /end IF_DATA BIT_MASK 0xFF /end MEASUREMENT
/begin MEASUREMENT tnst_w "Zeit nach Startende" UWORD t10msxs_uw_b655p35 0 0 0.000000 655.350000 /begin IF_DATA ASAP1B_ETK KP_BLOB 0x382672 1 2 /end IF_DATA BIT_MASK 0xFFFF /end MEASUREMENT
/begin MEASUREMENT qntns "Quotient aus Turbinendrehzahl des Wandlers und Solldrehzahl der LLR" UBYTE fak_ub_b8 0 0 0.000000 7.968750 /begin IF_DATA ASAP1B_ETK KP_BLOB 0x380C29 1 1 /end IF_DATA BIT_MASK 0xFF /end MEASUREMENT
/begin MEASUREMENT nver_w "DrehzahlverhÑltnis" UWORD fak_uw_b8 0 0 0.000000 7.999878 /begin IF_DATA ASAP1B_ETK KP_BLOB 0x3823A4 1 2 /end IF_DATA BIT_MASK 0xFFFF /end MEASUREMENT
/begin MEASUREMENT lws "Lenkwinkel" SBYTE lw_sb_q11p2 0 0 -1445.291339 1434.000000 /begin IF_DATA ASAP1B_ETK KP_BLOB 0x380C2F 1 1 /end IF_DATA BIT_MASK 0xFF /end MEASUREMENT
/begin MEASUREMENT mkfanb_w "Kupplungsmoment aus begrenztem Fahrerwunsch" SWORD rel_sw_b100 0 0 -100.000000 99.996948 /begin IF_DATA ASAP1B_ETK KP_BLOB 0x382446 1 2 /end IF_DATA BIT_MASK 0xFFFF /end MEASUREMENT
/begin MEASUREMENT mkfa_w "Fahrerwunschmoment (Kupplung) nach énderungsbegrenzung" SWORD rel_sw_b50 0 0 -50.000000 49.998474 /begin IF_DATA ASAP1B_ETK KP_BLOB 0x382448 1 2 /end IF_DATA BIT_MASK 0xFFFF /end MEASUREMENT
/begin MEASUREMENT mivbeb_w "Indiziertes Moment vor énderungsbegrenzung, nach oben auf mimax_w begrenzt" UWORD rel_uw_b100 0 0 0.000000 99.998474 /begin IF_DATA ASAP1B_ETK KP_BLOB 0x382442 1 2 /end IF_DATA BIT_MASK 0xFFFF /end MEASUREMENT
/begin MEASUREMENT lambas "Basis-Lambda" UBYTE fak_ub_b2 0 0 0.000000 1.992188 /begin IF_DATA ASAP1B_ETK KP_BLOB 0x380B2E 1 1 /end IF_DATA BIT_MASK 0xFF /end MEASUREMENT
/begin MEASUREMENT dzw_kge "Eingang Delta-ZÅndwinkel fÅr mehrfach verwendete Kenngrî·en" SBYTE zw_sb_q0p75 0 0 -96.000000 95.250000 /begin IF_DATA ASAP1B_ETK KP_BLOB 0x380C42 1 1 /end IF_DATA BIT_MASK 0xFF /end MEASUREMENT
/begin MEASUREMENT etazwist "Ist-ZÅndwinkelwirkungsgrad" UBYTE rel_ub_b127p5 0 0 0.000000 127.500000 /begin IF_DATA ASAP1B_ETK KP_BLOB 0x380C4B 1 1 /end IF_DATA BIT_MASK 0xFF /end MEASUREMENT
/begin MEASUREMENT tkatm_w "Katalysatortemperatur aus Modell (Word)" UWORD temp_uw_q0p0195_o50 0 0 -50.000000 1229.980469 /begin IF_DATA ASAP1B_ETK KP_BLOB 0x381B10 1 2 /end IF_DATA BIT_MASK 0xFFFF /end MEASUREMENT
/begin MEASUREMENT avkatf "AmplitudenVerhÑltnis laafh/laafv gefiltert" UBYTE fak_ub_b1 0 0 0.000000 0.996094 /begin IF_DATA ASAP1B_ETK KP_BLOB 0x38333A 1 1 /end IF_DATA BIT_MASK 0xFF /end MEASUREMENT
/begin MEASUREMENT idlashkm_w "KL-Source: Delta-Lambda aus Lambdareg. h. Kat (Ist-Wert fr-synchron gemittelt)" SWORD fak_sw_b1 0 0 -1.000000 0.999969 /begin IF_DATA ASAP1B_ETK KP_BLOB 0x382852 1 2 /end IF_DATA BIT_MASK 0xFFFF /end MEASUREMENT
/begin MEASUREMENT ushk_w "Spannung Lambdasonde (4.88mV/LSB) hinter Katalysator" UWORD spg_uw_q0p00488_o1 0 0 -1.000000 318.995117 /begin IF_DATA ASAP1B_ETK KP_BLOB 0x381B4E 1 2 /end IF_DATA BIT_MASK 0xFFFF /end MEASUREMENT
/begin MEASUREMENT usrhk "aktuelle Regelschwelle Lambdasignal h.K." UBYTE spg_ub_q0p0052_o0p2 0 0 -0.200000 1.130000 /begin IF_DATA ASAP1B_ETK KP_BLOB 0x380CF0 1 1 /end IF_DATA BIT_MASK 0xFF /end MEASUREMENT
/begin MEASUREMENT iavkatf "Kl-Source: gef. AmplitudenverhÑltnis hinter/vor Katalysator" UBYTE fak_ub_b1 0 0 0.000000 0.996094 /begin IF_DATA ASAP1B_ETK KP_BLOB 0x380CE7 1 1 /end IF_DATA BIT_MASK 0xFF /end MEASUREMENT
/begin MEASUREMENT etazws "SollzÅndwinkelwirkungsgrad" UBYTE rel_ub_b127p5 0 0 0.000000 127.500000 /begin IF_DATA ASAP1B_ETK KP_BLOB 0x380D15 1 1 /end IF_DATA BIT_MASK 0xFF /end MEASUREMENT
/begin MEASUREMENT ngfil_w "gefilterter Drehzahlgradient" SWORD nmotg_sw_q0p39 0 0 -12800.163840 12799.773210 /begin IF_DATA ASAP1B_ETK KP_BLOB 0x381A9E 1 2 /end IF_DATA BIT_MASK 0xFFFF /end MEASUREMENT
/begin MEASUREMENT agrr "AbgasrÅckfÅhrrate" UBYTE rel_ub_b99p6 0 0 0.000000 99.609375 /begin IF_DATA ASAP1B_ETK KP_BLOB 0x380AE7 1 1 /end IF_DATA BIT_MASK 0xFF /end MEASUREMENT
/begin MEASUREMENT ATMbits "" UBYTE dez 0 0 0.000000 255.000000 /begin IF_DATA ASAP1B_ETK KP_BLOB 0x383318 1 1 /end IF_DATA BIT_MASK 0xFF /end MEASUREMENT
/begin MEASUREMENT atv "LRHK: aktueller Lernkennfeld-Integratorwert der Regelung h.K." SBYTE t100msxs_sb_q0p01 0 0 -1.280000 1.270000 /begin IF_DATA ASAP1B_ETK KP_BLOB 0x38343F 1 1 /end IF_DATA BIT_MASK 0xFF /end MEASUREMENT
/begin MEASUREMENT atv2 "LRHK (Bank2): aktueller Lernkennfeld-Integratorwert der Regelung h.K." SBYTE t100msxs_sb_q0p01 0 0 -1.280000 1.270000 /begin IF_DATA ASAP1B_ETK KP_BLOB 0x383440 1 1 /end IF_DATA BIT_MASK 0xFF /end MEASUREMENT
/begin MEASUREMENT atvinii "Initialisierungswert fÅr Integrator atv" SBYTE t100msxs_sb_q0p01 0 0 -1.280000 1.270000 /begin IF_DATA ASAP1B_ETK KP_BLOB 0x380CE5 1 1 /end IF_DATA BIT_MASK 0xFF /end MEASUREMENT
/begin MEASUREMENT bbm8te "Byte fÅr Bedingung Fkt-Anforderung TankentlÅftung nach SAE J1979 Mode 8 TID $01" UBYTE dez 0 0 0.000000 255.000000 /begin IF_DATA ASAP1B_ETK KP_BLOB 0x380A37 1 1 /end IF_DATA BIT_MASK 0xFF /end MEASUREMENT
/begin MEASUREMENT B_4wd "Bedingung Allrad-Antrieb" UWORD B_TRUE___UW 0 0 0.000000 0.000000 /begin IF_DATA ASAP1B_ETK KP_BLOB 0xFD00 0 2 /end IF_DATA BIT_MASK 0x1 /end MEASUREMENT
/begin MEASUREMENT B_abstnl "Bedingung Abstellzeitermittlung Åber SG-Nachlauf" UWORD B_TRUE___UW 0 0 0.000000 0.000000 /begin IF_DATA ASAP1B_ETK KP_BLOB 0xFD00 0 2 /end IF_DATA BIT_MASK 0x2 /end MEASUREMENT
/begin MEASUREMENT B_acres "Bedingung fÅr Aufbau einer Drehmomentenreserve bei Klimabereitschaft" UWORD B_TRUE___UW 0 0 0.000000 0.000000 /begin IF_DATA ASAP1B_ETK KP_BLOB 0xFDA0 0 2 /end IF_DATA BIT_MASK 0x4 /end MEASUREMENT
/begin MEASUREMENT B_adwfk "Bedingung Adaptionswert Fahrstufe und Kompressor ein verwenden" UBYTE B_TRUE 0 0 0.000000 0.000000 /begin IF_DATA ASAP1B_ETK KP_BLOB 0x380C24 1 1 /end IF_DATA BIT_MASK 0x10 /end MEASUREMENT
/begin MEASUREMENT B_adwfs "Bedingung Adaptionswert Fahrstufe ein verwenden" UBYTE B_TRUE 0 0 0.000000 0.000000 /begin IF_DATA ASAP1B_ETK KP_BLOB 0x380C24 1 1 /end IF_DATA BIT_MASK 0x20 /end MEASUREMENT
/begin MEASUREMENT B_adwko "Bedingung Adaptionswert Klimakompressor ein verwenden" UBYTE B_TRUE 0 0 0.000000 0.000000 /begin IF_DATA ASAP1B_ETK KP_BLOB 0x380C24 1 1 /end IF_DATA BIT_MASK 0x40 /end MEASUREMENT
/begin MEASUREMENT B_agr "Bedingung AGR ein" UWORD B_TRUE___UW 0 0 0.000000 0.000000 /begin IF_DATA ASAP1B_ETK KP_BLOB 0xFD06 0 2 /end IF_DATA BIT_MASK 0x80 /end MEASUREMENT
/begin MEASUREMENT B_appnolu "Bedingung: DK-Notluftfahren durch Applikation angefordert" UWORD B_TRUE___UW 0 0 0.000000 0.000000 /begin IF_DATA ASAP1B_ETK KP_BLOB 0xFD44 0 2 /end IF_DATA BIT_MASK 0x4 /end MEASUREMENT
/begin MEASUREMENT B_asr "Bedingung fÅr ASR aktiv" UWORD B_TRUE___UW 0 0 0.000000 0.000000 /begin IF_DATA ASAP1B_ETK KP_BLOB 0xFD82 0 2 /end IF_DATA BIT_MASK 0x8 /end MEASUREMENT
/begin MEASUREMENT B_asrfz "Bedingung fÅr ASR im Fahrzeug" UWORD B_TRUE___UW 0 0 0.000000 0.000000 /begin IF_DATA ASAP1B_ETK KP_BLOB 0xFD00 0 2 /end IF_DATA BIT_MASK 0x4 /end MEASUREMENT
/begin MEASUREMENT B_atmtpl "Bedingung Taupunktendezeit abgelaufen (last trip)" UBYTE B_TRUE 0 0 0.000000 0.000000 /begin IF_DATA ASAP1B_ETK KP_BLOB 0x383318 1 1 /end IF_DATA BIT_MASK 0x1 /end MEASUREMENT
/begin MEASUREMENT B_atvini "Bedingung Integrator atv initialisieren" UBYTE B_TRUE 0 0 0.000000 0.000000 /begin IF_DATA ASAP1B_ETK KP_BLOB 0x380CE9 1 1 /end IF_DATA BIT_MASK 0x1 /end MEASUREMENT
/begin MEASUREMENT B_autget "Bedingung Automatikgetriebe" UWORD B_TRUE___UW 0 0 0.000000 0.000000 /begin IF_DATA ASAP1B_ETK KP_BLOB 0xFD00 0 2 /end IF_DATA BIT_MASK 0x8 /end MEASUREMENT
/begin MEASUREMENT B_bag "Bedingung starke Beschleunigungsanreicherung" UWORD B_TRUE___UW 0 0 0.000000 0.000000 /begin IF_DATA ASAP1B_ETK KP_BLOB 0xFD62 0 2 /end IF_DATA BIT_MASK 0x1000 /end MEASUREMENT
/begin MEASUREMENT B_bevab "Bedingung EV-Abschaltung auf Bank/Bank1" UWORD B_TRUE___UW 0 0 0.000000 0.000000 /begin IF_DATA ASAP1B_ETK KP_BLOB 0xFD5C 0 2 /end IF_DATA BIT_MASK 0x2 /end MEASUREMENT
/begin MEASUREMENT B_blrka "Bedingung gesteuertes Katalysator-AusrÑumen angefordert" UWORD B_TRUE___UW 0 0 0.000000 0.000000 /begin IF_DATA ASAP1B_ETK KP_BLOB 0xFD98 0 2 /end IF_DATA BIT_MASK 0x40 /end MEASUREMENT
/begin MEASUREMENT B_bm "Bedingung Bezugsmarke erkannt" UWORD B_TRUE___UW 0 0 0.000000 0.000000 /begin IF_DATA ASAP1B_ETK KP_BLOB 0xFD1E 0 2 /end IF_DATA BIT_MASK 0x20 /end MEASUREMENT
/begin MEASUREMENT B_brems "Bedingung Bremse betÑtigt" UWORD B_TRUE___UW 0 0 0.000000 0.000000 /begin IF_DATA ASAP1B_ETK KP_BLOB 0xFD48 0 2 /end IF_DATA BIT_MASK 0x8 /end MEASUREMENT
/begin MEASUREMENT B_bvdel "ODER-VerknÅpfung der verzîgerten Sperrbedingungen B_bag / B_vag" UWORD B_TRUE___UW 0 0 0.000000 0.000000 /begin IF_DATA ASAP1B_ETK KP_BLOB 0xFD92 0 2 /end IF_DATA BIT_MASK 0x1000 /end MEASUREMENT
/begin MEASUREMENT B_cdagr "Funktion Åber Codewort CDAGR freigegeben" UWORD B_TRUE___UW 0 0 0.000000 0.000000 /begin IF_DATA ASAP1B_ETK KP_BLOB 0x380D30 1 2 /end IF_DATA BIT_MASK 0x8000 /end MEASUREMENT
/begin MEASUREMENT B_cdagrl "Funktion Åber Codewort CDAGRL freigeben" UWORD B_TRUE___UW 0 0 0.000000 0.000000 /begin IF_DATA ASAP1B_ETK KP_BLOB 0x380D32 1 2 /end IF_DATA BIT_MASK 0x200 /end MEASUREMENT
/begin MEASUREMENT B_cdatr "Bedingung: Diagnose Abgastemperaturregelung freigegeben" UWORD B_TRUE___UW 0 0 0.000000 0.000000 /begin IF_DATA ASAP1B_ETK KP_BLOB 0x380D30 1 2 /end IF_DATA BIT_MASK 0x400 /end MEASUREMENT
/begin MEASUREMENT B_cdats "Bedingung Diagnose Abgastemperatursensor freigegeben" UWORD B_TRUE___UW 0 0 0.000000 0.000000 /begin IF_DATA ASAP1B_ETK KP_BLOB 0x380D30 1 2 /end IF_DATA BIT_MASK 0x200 /end MEASUREMENT
/begin MEASUREMENT B_cddst "Funktion Åber Codewort CDDST freigegeben" UWORD B_TRUE___UW 0 0 0.000000 0.000000 /begin IF_DATA ASAP1B_ETK KP_BLOB 0x380D30 1 2 /end IF_DATA BIT_MASK 0x1000 /end MEASUREMENT
/begin MEASUREMENT B_cdhsh "Funktion Åber Codewort CDHSH freigegeben" UWORD B_TRUE___UW 0 0 0.000000 0.000000 /begin IF_DATA ASAP1B_ETK KP_BLOB 0x380D30 1 2 /end IF_DATA BIT_MASK 0x80 /end MEASUREMENT
/begin MEASUREMENT B_cdhshe "Funktion Åber Codewort CDHSHE freigegeben" UWORD B_TRUE___UW 0 0 0.000000 0.000000 /begin IF_DATA ASAP1B_ETK KP_BLOB 0x380D32 1 2 /end IF_DATA BIT_MASK 0x80 /end MEASUREMENT
/begin MEASUREMENT B_cdhsv "Funktion Åber Codewort CDHSV freigegeben" UWORD B_TRUE___UW 0 0 0.000000 0.000000 /begin IF_DATA ASAP1B_ETK KP_BLOB 0x380D30 1 2 /end IF_DATA BIT_MASK 0x40 /end MEASUREMENT
/begin MEASUREMENT B_cdhsve "Funktion Åber Codewort CDHSVE freigegeben" UWORD B_TRUE___UW 0 0 0.000000 0.000000 /begin IF_DATA ASAP1B_ETK KP_BLOB 0x380D32 1 2 /end IF_DATA BIT_MASK 0x100 /end MEASUREMENT
/begin MEASUREMENT B_cdkat "Funktion Åber Codewort CDKAT freigegeben" UWORD B_TRUE___UW 0 0 0.000000 0.000000 /begin IF_DATA ASAP1B_ETK KP_BLOB 0x380D30 1 2 /end IF_DATA BIT_MASK 0x100 /end MEASUREMENT
/begin MEASUREMENT B_cdkvs "Funktion Åber Codewort CDKVS freigegeben" UWORD B_TRUE___UW 0 0 0.000000 0.000000 /begin IF_DATA ASAP1B_ETK KP_BLOB 0x380D30 1 2 /end IF_DATA BIT_MASK 0x800 /end MEASUREMENT
/begin MEASUREMENT B_cdlash "Funktion Åber Codewort CDLASH freigegeben" UWORD B_TRUE___UW 0 0 0.000000 0.000000 /begin IF_DATA ASAP1B_ETK KP_BLOB 0x380D32 1 2 /end IF_DATA BIT_MASK 0x40 /end MEASUREMENT
/begin MEASUREMENT B_cdlatp "Funktion Åber Codewort CDLATP freigegeben" UWORD B_TRUE___UW 0 0 0.000000 0.000000 /begin IF_DATA ASAP1B_ETK KP_BLOB 0x380D32 1 2 /end IF_DATA BIT_MASK 0x10 /end MEASUREMENT
/begin MEASUREMENT B_cdlatv "Funktion Åber Codewort CDLATV freigeben" UWORD B_TRUE___UW 0 0 0.000000 0.000000 /begin IF_DATA ASAP1B_ETK KP_BLOB 0x380D32 1 2 /end IF_DATA BIT_MASK 0x20 /end MEASUREMENT
/begin MEASUREMENT B_cdldp "Funktion Åber Codewort CDLDP freigegeben" UWORD B_TRUE___UW 0 0 0.000000 0.000000 /begin IF_DATA ASAP1B_ETK KP_BLOB 0x380D30 1 2 /end IF_DATA BIT_MASK 0x4000 /end MEASUREMENT
/begin MEASUREMENT B_cdllr "Funktion Åber Codewort CDLLR freigegeben" UWORD B_TRUE___UW 0 0 0.000000 0.000000 /begin IF_DATA ASAP1B_ETK KP_BLOB 0x380D32 1 2 /end IF_DATA BIT_MASK 0x8 /end MEASUREMENT
/begin MEASUREMENT B_cdlsa "Funktion Åber Codewort CDLSA freigegeben" UWORD B_TRUE___UW 0 0 0.000000 0.000000 /begin IF_DATA ASAP1B_ETK KP_BLOB 0x380D30 1 2 /end IF_DATA BIT_MASK 0x20 /end MEASUREMENT
/begin MEASUREMENT B_cdlsh "Funktion Åber Codewort CDLSH freigegeben" UWORD B_TRUE___UW 0 0 0.000000 0.000000 /begin IF_DATA ASAP1B_ETK KP_BLOB 0x380D30 1 2 /end IF_DATA BIT_MASK 0x10 /end MEASUREMENT
/begin MEASUREMENT B_cdlsv "Funktion Åber Codewort CDLSV freigegeben" UWORD B_TRUE___UW 0 0 0.000000 0.000000 /begin IF_DATA ASAP1B_ETK KP_BLOB 0x380D30 1 2 /end IF_DATA BIT_MASK 0x8 /end MEASUREMENT
/begin MEASUREMENT B_cdmd "Funktion Åber Codewort CDMD freigegeben" UWORD B_TRUE___UW 0 0 0.000000 0.000000 /begin IF_DATA ASAP1B_ETK KP_BLOB 0x380D30 1 2 /end IF_DATA BIT_MASK 0x1 /end MEASUREMENT
/begin MEASUREMENT B_cdnws "Funktion Åber Codewort CDNWS freigegeben" UWORD B_TRUE___UW 0 0 0.000000 0.000000 /begin IF_DATA ASAP1B_ETK KP_BLOB 0x380D32 1 2 /end IF_DATA BIT_MASK 0x4 /end MEASUREMENT
/begin MEASUREMENT B_cdsls "Funktion Åber Codewort CDSLS freigegeben" UWORD B_TRUE___UW 0 0 0.000000 0.000000 /begin IF_DATA ASAP1B_ETK KP_BLOB 0x380D32 1 2 /end IF_DATA BIT_MASK 0x1 /end MEASUREMENT
/begin MEASUREMENT B_cdslse "Funktion Åber Codewort CDSLSE freigegeben" UWORD B_TRUE___UW 0 0 0.000000 0.000000 /begin IF_DATA ASAP1B_ETK KP_BLOB 0x380D32 1 2 /end IF_DATA BIT_MASK 0x2 /end MEASUREMENT
/begin MEASUREMENT B_cdswe "Funktion Åber Codewort CDSWE freigegeben" UWORD B_TRUE___UW 0 0 0.000000 0.000000 /begin IF_DATA ASAP1B_ETK KP_BLOB 0x380D30 1 2 /end IF_DATA BIT_MASK 0x2 /end MEASUREMENT
/begin MEASUREMENT B_cdtankl "Funktion Åber Codewort CDTANKL freigegeben" UWORD B_TRUE___UW 0 0 0.000000 0.000000 /begin IF_DATA ASAP1B_ETK KP_BLOB 0x380D30 1 2 /end IF_DATA BIT_MASK 0x4 /end MEASUREMENT
/begin MEASUREMENT B_cdtes "Funktion Åber Codewort CDTES freigegeben" UWORD B_TRUE___UW 0 0 0.000000 0.000000 /begin IF_DATA ASAP1B_ETK KP_BLOB 0x380D30 1 2 /end IF_DATA BIT_MASK 0x2000 /end MEASUREMENT
/begin MEASUREMENT B_craus "Ausgewertet durch LREB: Werkstattbit zum Stillegen LR" UWORD B_TRUE___UW 0 0 0.000000 0.000000 /begin IF_DATA ASAP1B_ETK KP_BLOB 0xFD74 0 2 /end IF_DATA BIT_MASK 0x80 /end MEASUREMENT
/begin MEASUREMENT B_cscatt "Funktion Åber Codewort CSCATT abgeschaltet" UWORD B_TRUE___UW 0 0 0.000000 0.000000 /begin IF_DATA ASAP1B_ETK KP_BLOB 0xFD00 0 2 /end IF_DATA BIT_MASK 0x10 /end MEASUREMENT
/begin MEASUREMENT B_cvt "Bedingung continuously variable transmission" UWORD B_TRUE___UW 0 0 0.000000 0.000000 /begin IF_DATA ASAP1B_ETK KP_BLOB 0xFD00 0 2 /end IF_DATA BIT_MASK 0x20 /end MEASUREMENT
/begin MEASUREMENT B_cvtad "Bedingung Adaptionsfreigabe bei CVT-Getriebe" UWORD B_TRUE___UW 0 0 0.000000 0.000000 /begin IF_DATA ASAP1B_ETK KP_BLOB 0xFD0E 0 2 /end IF_DATA BIT_MASK 0x4000 /end MEASUREMENT
/begin MEASUREMENT B_cwlshdyn "Beding. Abschaltung fÅr Teilfunktion DynamikprÅfung Sonde hinter KAT in %DLSAHK" UWORD B_TRUE___UW 0 0 0.000000 0.000000 /begin IF_DATA ASAP1B_ETK KP_BLOB 0xFD00 0 2 /end IF_DATA BIT_MASK 0x40 /end MEASUREMENT
/begin MEASUREMENT B_cwlshsch "Bedingung Abschaltung fÅr Teilfunktion im Schub Sonde hinter KAT in %DLSAHK" UWORD B_TRUE___UW 0 0 0.000000 0.000000 /begin IF_DATA ASAP1B_ETK KP_BLOB 0xFD00 0 2 /end IF_DATA BIT_MASK 0x80 /end MEASUREMENT
/begin MEASUREMENT B_dash "Bedingung: Dashpot-énderungsbegrenzung aktiv" UWORD B_TRUE___UW 0 0 0.000000 0.000000 /begin IF_DATA ASAP1B_ETK KP_BLOB 0xFD7E 0 2 /end IF_DATA BIT_MASK 0x20 /end MEASUREMENT
/begin MEASUREMENT B_dashv "Bedingung Dashpot verzîgert" UWORD B_TRUE___UW 0 0 0.000000 0.000000 /begin IF_DATA ASAP1B_ETK KP_BLOB 0xFD7E 0 2 /end IF_DATA BIT_MASK 0x40 /end MEASUREMENT
/begin MEASUREMENT B_delaysyn "Flag fÅr eine Verzîgerung um 1 LÅcke zur Neusynchronisierung" UWORD B_TRUE___UW 0 0 0.000000 0.000000 /begin IF_DATA ASAP1B_ETK KP_BLOB 0xFD1E 0 2 /end IF_DATA BIT_MASK 0x4 /end MEASUREMENT
/begin MEASUREMENT B_dknolu "Bedingung Drosselklappensteller stromlos" UWORD B_TRUE___UW 0 0 0.000000 0.000000 /begin IF_DATA ASAP1B_ETK KP_BLOB 0xFD46 0 2 /end IF_DATA BIT_MASK 0x100 /end MEASUREMENT
/begin MEASUREMENT B_dknot "Bedingung DK-Poti-Notfahren aktiv" UWORD B_TRUE___UW 0 0 0.000000 0.000000 /begin IF_DATA ASAP1B_ETK KP_BLOB 0xFD46 0 2 /end IF_DATA BIT_MASK 0x200 /end MEASUREMENT
/begin MEASUREMENT B_dkp1e "Bedingung Fehler DK-Poti 1" UWORD B_TRUE___UW 0 0 0.000000 0.000000 /begin IF_DATA ASAP1B_ETK KP_BLOB 0xFD3C 0 2 /end IF_DATA BIT_MASK 0x8000 /end MEASUREMENT
/begin MEASUREMENT B_dkp2e "Bedingung Fehler DK-Poti 2" UWORD B_TRUE___UW 0 0 0.000000 0.000000 /begin IF_DATA ASAP1B_ETK KP_BLOB 0xFD3E 0 2 /end IF_DATA BIT_MASK 0x10 /end MEASUREMENT
/begin MEASUREMENT B_dkpiu "Bedingung: irreversible SKA" UWORD B_TRUE___UW 0 0 0.000000 0.000000 /begin IF_DATA ASAP1B_ETK KP_BLOB 0xFD46 0 2 /end IF_DATA BIT_MASK 0x400 /end MEASUREMENT
/begin MEASUREMENT B_dkpru "Bedingung: reversible SKA" UWORD B_TRUE___UW 0 0 0.000000 0.000000 /begin IF_DATA ASAP1B_ETK KP_BLOB 0xFD46 0 2 /end IF_DATA BIT_MASK 0x800 /end MEASUREMENT
/begin MEASUREMENT B_dkpu "Bedingung Sicherheitskraftstoffabschaltung (SKA)" UWORD B_TRUE___UW 0 0 0.000000 0.000000 /begin IF_DATA ASAP1B_ETK KP_BLOB 0xFD46 0 2 /end IF_DATA BIT_MASK 0x1000 /end MEASUREMENT
/begin MEASUREMENT B_dkunb "Bedingung: Drosselklappenposition unbekannt" UWORD B_TRUE___UW 0 0 0.000000 0.000000 /begin IF_DATA ASAP1B_ETK KP_BLOB 0xFD46 0 2 /end IF_DATA BIT_MASK 0x2000 /end MEASUREMENT
/begin MEASUREMENT B_dlrbe "Bedingung: DLR-Stellbereich wurde Åberschritten" UWORD B_TRUE___UW 0 0 0.000000 0.000000 /begin IF_DATA ASAP1B_ETK KP_BLOB 0xFD44 0 2 /end IF_DATA BIT_MASK 0x20 /end MEASUREMENT
/begin MEASUREMENT B_dlrpide "Bedingung: Fehler, DLR-Stellbereich am Anschlag" UWORD B_TRUE___UW 0 0 0.000000 0.000000 /begin IF_DATA ASAP1B_ETK KP_BLOB 0xFD44 0 2 /end IF_DATA BIT_MASK 0x200 /end MEASUREMENT
/begin MEASUREMENT B_dmrwan "Bedingung Aufbau Momentenreserve fÅr Wandlermoment" UWORD B_TRUE___UW 0 0 0.000000 0.000000 /begin IF_DATA ASAP1B_ETK KP_BLOB 0xFD7A 0 2 /end IF_DATA BIT_MASK 0x4000 /end MEASUREMENT
/begin MEASUREMENT B_dp "Bedingung: Dashpotwert grî·er Fahrerwunsch (=1)" UWORD B_TRUE___UW 0 0 0.000000 0.000000 /begin IF_DATA ASAP1B_ETK KP_BLOB 0xFD7E 0 2 /end IF_DATA BIT_MASK 0x80 /end MEASUREMENT
/begin MEASUREMENT B_dslfa "Bedingung: Anforderung SL-System fÅr Kurztest" UWORD B_TRUE___UW 0 0 0.000000 0.000000 /begin IF_DATA ASAP1B_ETK KP_BLOB 0xFD0C 0 2 /end IF_DATA BIT_MASK 0x1 /end MEASUREMENT
/begin MEASUREMENT B_dslreset "Bedingung: ZurÅcksetzen SekundÑrluftadaption/Kurztest" UWORD B_TRUE___UW 0 0 0.000000 0.000000 /begin IF_DATA ASAP1B_ETK KP_BLOB 0x380ED2 1 2 /end IF_DATA BIT_MASK 0x2 /end MEASUREMENT
/begin MEASUREMENT B_dsls "Aktive Diagnose: SekundÑrluft-System" UWORD B_TRUE___UW 0 0 0.000000 0.000000 /begin IF_DATA ASAP1B_ETK KP_BLOB 0xFD0C 0 2 /end IF_DATA BIT_MASK 0x2 /end MEASUREMENT
/begin MEASUREMENT B_dslset "Bedingung: Setzen SekundÑrluftadaption/Kurztest" UWORD B_TRUE___UW 0 0 0.000000 0.000000 /begin IF_DATA ASAP1B_ETK KP_BLOB 0x380ED2 1 2 /end IF_DATA BIT_MASK 0x1 /end MEASUREMENT
/begin MEASUREMENT B_dslsk "Bedingung Diagnose SekundÑrluftsystem fÅr Kurztest" UWORD B_TRUE___UW 0 0 0.000000 0.000000 /begin IF_DATA ASAP1B_ETK KP_BLOB 0xFD06 0 2 /end IF_DATA BIT_MASK 0x4000 /end MEASUREMENT
/begin MEASUREMENT B_dslsp4 "Bedingung: Anforderung SL-System fÅr SekundÑrluftadaption/Zusatzdiagnose" UWORD B_TRUE___UW 0 0 0.000000 0.000000 /begin IF_DATA ASAP1B_ETK KP_BLOB 0xFD0C 0 2 /end IF_DATA BIT_MASK 0x4 /end MEASUREMENT
/begin MEASUREMENT B_dslvh "Bedingung Ladedrucksensor vorhanden" UWORD B_TRUE___UW 0 0 0.000000 0.000000 /begin IF_DATA ASAP1B_ETK KP_BLOB 0xFD00 0 2 /end IF_DATA BIT_MASK 0x100 /end MEASUREMENT
/begin MEASUREMENT B_dspe "Bedingung Diagnose SekundÑrluft ein" UWORD B_TRUE___UW 0 0 0.000000 0.000000 /begin IF_DATA ASAP1B_ETK KP_BLOB 0xFD0C 0 2 /end IF_DATA BIT_MASK 0x8 /end MEASUREMENT
/begin MEASUREMENT B_dssv "Bedingung Saugrohr-Drucksensor vorhanden als Hauptlastsensor" UWORD B_TRUE___UW 0 0 0.000000 0.000000 /begin IF_DATA ASAP1B_ETK KP_BLOB 0xFD00 0 2 /end IF_DATA BIT_MASK 0x200 /end MEASUREMENT
/begin MEASUREMENT B_dssvnl "Bedingung Saugrohr-Drucksensor als Nebenlastsensor vorhanden" UWORD B_TRUE___UW 0 0 0.000000 0.000000 /begin IF_DATA ASAP1B_ETK KP_BLOB 0xFD00 0 2 /end IF_DATA BIT_MASK 0x400 /end MEASUREMENT
/begin MEASUREMENT B_dsuv "Umgebungsdrucksensor ist vorhanden" UWORD B_TRUE___UW 0 0 0.000000 0.000000 /begin IF_DATA ASAP1B_ETK KP_BLOB 0xFD00 0 2 /end IF_DATA BIT_MASK 0x800 /end MEASUREMENT
/begin MEASUREMENT B_dtefrr "Bedingung Lambdareglerreset bei TankentlÅftungsdiagnose" UWORD B_TRUE___UW 0 0 0.000000 0.000000 /begin IF_DATA ASAP1B_ETK KP_BLOB 0xFD8A 0 2 /end IF_DATA BIT_MASK 0x2000 /end MEASUREMENT
/begin MEASUREMENT B_dtes "Aktive Diagnose: TankentlÅftungssystem" UWORD B_TRUE___UW 0 0 0.000000 0.000000 /begin IF_DATA ASAP1B_ETK KP_BLOB 0xFD8C 0 2 /end IF_DATA BIT_MASK 0x800 /end MEASUREMENT
/begin MEASUREMENT B_dwg "Bedingung fÅr Diagnose Waste- Gate" UWORD B_TRUE___UW 0 0 0.000000 0.000000 /begin IF_DATA ASAP1B_ETK KP_BLOB 0xFD7A 0 2 /end IF_DATA BIT_MASK 0x80 /end MEASUREMENT
/begin MEASUREMENT B_edkvs "Bedingung Adaptionsfehlerschwellen aktuell Åberschritten" UWORD B_TRUE___UW 0 0 0.000000 0.000000 /begin IF_DATA ASAP1B_ETK KP_BLOB 0xFD64 0 2 /end IF_DATA BIT_MASK 0x4000 /end MEASUREMENT
/begin MEASUREMENT B_edp "Bedingung Erlaubnis Dashpot" UWORD B_TRUE___UW 0 0 0.000000 0.000000 /begin IF_DATA ASAP1B_ETK KP_BLOB 0xFD7E 0 2 /end IF_DATA BIT_MASK 0x100 /end MEASUREMENT
/begin MEASUREMENT B_eev "Bedingung Endstufenfehler EV" UWORD B_TRUE___UW 0 0 0.000000 0.000000 /begin IF_DATA ASAP1B_ETK KP_BLOB 0xFD54 0 2 /end IF_DATA BIT_MASK 0x400 /end MEASUREMENT
/begin MEASUREMENT B_elsd "Bedingung Erlaubnis LastschlagdÑmpfung" UWORD B_TRUE___UW 0 0 0.000000 0.000000 /begin IF_DATA ASAP1B_ETK KP_BLOB 0xFD7E 0 2 /end IF_DATA BIT_MASK 0x200 /end MEASUREMENT
/begin MEASUREMENT B_eobdlr "OBDII-Summenfehler. sperrt die LR" UWORD B_TRUE___UW 0 0 0.000000 0.000000 /begin IF_DATA ASAP1B_ETK KP_BLOB 0xFD92 0 2 /end IF_DATA BIT_MASK 0x2000 /end MEASUREMENT
/begin MEASUREMENT B_eobdlr2 "OBDII-Summenfehler. sperrt die LR, Bank 2" UWORD B_TRUE___UW 0 0 0.000000 0.000000 /begin IF_DATA ASAP1B_ETK KP_BLOB 0xFD92 0 2 /end IF_DATA BIT_MASK 0x4000 /end MEASUREMENT
/begin MEASUREMENT B_esls "Bedingung Falschluft durch Fehler im SekundÑrluftsystem" UWORD B_TRUE___UW 0 0 0.000000 0.000000 /begin IF_DATA ASAP1B_ETK KP_BLOB 0xFD0C 0 2 /end IF_DATA BIT_MASK 0x10 /end MEASUREMENT
/begin MEASUREMENT B_evloc "Status alle lokalen Einspritzventile werden angesteuert, = B_EVTOT bei einen SG" UWORD B_TRUE___UW 0 0 0.000000 0.000000 /begin IF_DATA ASAP1B_ETK KP_BLOB 0xFD5C 0 2 /end IF_DATA BIT_MASK 0x40 /end MEASUREMENT
/begin MEASUREMENT B_fa "Bedingung Funktionsanforderung allgemein" UWORD B_TRUE___UW 0 0 0.000000 0.000000 /begin IF_DATA ASAP1B_ETK KP_BLOB 0xFD74 0 2 /end IF_DATA BIT_MASK 0x100 /end MEASUREMENT
/begin MEASUREMENT B_falsh "Bedingung Funktionsanforderung Lambda-Sonde hinter KAT" UWORD B_TRUE___UW 0 0 0.000000 0.000000 /begin IF_DATA ASAP1B_ETK KP_BLOB 0xFD76 0 2 /end IF_DATA BIT_MASK 0x4 /end MEASUREMENT
/begin MEASUREMENT B_fanws "Bedingung Funktionsanforderung Diagnose Nockenwellensteuerung" UWORD B_TRUE___UW 0 0 0.000000 0.000000 /begin IF_DATA ASAP1B_ETK KP_BLOB 0xFD76 0 2 /end IF_DATA BIT_MASK 0x10 /end MEASUREMENT
/begin MEASUREMENT B_fasla "Bedingung: externe Anforderung an SekundÑrluft aktiv" UWORD B_TRUE___UW 0 0 0.000000 0.000000 /begin IF_DATA ASAP1B_ETK KP_BLOB 0xFD0A 0 2 /end IF_DATA BIT_MASK 0x10 /end MEASUREMENT
/begin MEASUREMENT B_fasls "Bedingung Funktionsanforderung SekundÑrluftsystem" UWORD B_TRUE___UW 0 0 0.000000 0.000000 /begin IF_DATA ASAP1B_ETK KP_BLOB 0xFD76 0 2 /end IF_DATA BIT_MASK 0x80 /end MEASUREMENT
/begin MEASUREMENT B_fgr "Bedingung FGR (Tempomat) aktiv" UWORD B_TRUE___UW 0 0 0.000000 0.000000 /begin IF_DATA ASAP1B_ETK KP_BLOB 0xFD7E 0 2 /end IF_DATA BIT_MASK 0x400 /end MEASUREMENT
/begin MEASUREMENT B_fil "Bedingung PT1-Filter fÅr SAWE aktiv" UWORD B_TRUE___UW 0 0 0.000000 0.000000 /begin IF_DATA ASAP1B_ETK KP_BLOB 0xFD7E 0 2 /end IF_DATA BIT_MASK 0x800 /end MEASUREMENT
/begin MEASUREMENT B_fproab "Bedingung: DV-E-PrÅfung îffnende Feder Abbruch, Feder îffnet nicht" UWORD B_TRUE___UW 0 0 0.000000 0.000000 /begin IF_DATA ASAP1B_ETK KP_BLOB 0xFD40 0 2 /end IF_DATA BIT_MASK 0x400 /end MEASUREMENT
/begin MEASUREMENT B_fprzab "Bedingung: DV-E-RÅckstellfederprÅfung Abbruch, Feder schlie·t nicht" UWORD B_TRUE___UW 0 0 0.000000 0.000000 /begin IF_DATA ASAP1B_ETK KP_BLOB 0xFD42 0 2 /end IF_DATA BIT_MASK 0x1 /end MEASUREMENT
/begin MEASUREMENT B_fpwdkap "DK-Steuerung direkt Åber Fahrpedal" UWORD B_TRUE___UW 0 0 0.000000 0.000000 /begin IF_DATA ASAP1B_ETK KP_BLOB 0xFD00 0 2 /end IF_DATA BIT_MASK 0x1000 /end MEASUREMENT
/begin MEASUREMENT B_frini "Bedingung Regelfaktor fr initialisieren" UWORD B_TRUE___UW 0 0 0.000000 0.000000 /begin IF_DATA ASAP1B_ETK KP_BLOB 0xFD98 0 2 /end IF_DATA BIT_MASK 0x10 /end MEASUREMENT
/begin MEASUREMENT B_frini2 "Bedingung Regelfaktor fr initialisieren, Bank 2" UWORD B_TRUE___UW 0 0 0.000000 0.000000 /begin IF_DATA ASAP1B_ETK KP_BLOB 0xFD98 0 2 /end IF_DATA BIT_MASK 0x20 /end MEASUREMENT
/begin MEASUREMENT B_fs "Bedingung Fahrstufe" UWORD B_TRUE___UW 0 0 0.000000 0.000000 /begin IF_DATA ASAP1B_ETK KP_BLOB 0xFD3A 0 2 /end IF_DATA BIT_MASK 0x200 /end MEASUREMENT
/begin MEASUREMENT B_fslr "Bed. LR aktiv/inaktiv bei Fettschutz (lamsons_w < 1.0)" UWORD B_TRUE___UW 0 0 0.000000 0.000000 /begin IF_DATA ASAP1B_ETK KP_BLOB 0xFD92 0 2 /end IF_DATA BIT_MASK 0x8000 /end MEASUREMENT
/begin MEASUREMENT B_fslr2 "Bed. LR aktiv/inaktiv wÑhrend Fettschutz (lamsons_w < 1.0), Bank 2" UWORD B_TRUE___UW 0 0 0.000000 0.000000 /begin IF_DATA ASAP1B_ETK KP_BLOB 0xFD94 0 2 /end IF_DATA BIT_MASK 0x1 /end MEASUREMENT
/begin MEASUREMENT B_fsu "Bedingung Fahrstufe, Umschaltung" UWORD B_TRUE___UW 0 0 0.000000 0.000000 /begin IF_DATA ASAP1B_ETK KP_BLOB 0xFD7A 0 2 /end IF_DATA BIT_MASK 0x8000 /end MEASUREMENT
/begin MEASUREMENT B_gsch "Bedingung Getriebeschaltung aktiv" UWORD B_TRUE___UW 0 0 0.000000 0.000000 /begin IF_DATA ASAP1B_ETK KP_BLOB 0xFD10 0 2 /end IF_DATA BIT_MASK 0x100 /end MEASUREMENT
/begin MEASUREMENT B_gwhs "Bedingung Gangwechsel bei Handschalter" UWORD B_TRUE___UW 0 0 0.000000 0.000000 /begin IF_DATA ASAP1B_ETK KP_BLOB 0xFD3A 0 2 /end IF_DATA BIT_MASK 0x400 /end MEASUREMENT
/begin MEASUREMENT B_hfmv "Bedingung HFM vorhanden" UWORD B_TRUE___UW 0 0 0.000000 0.000000 /begin IF_DATA ASAP1B_ETK KP_BLOB 0xFD00 0 2 /end IF_DATA BIT_MASK 0x2000 /end MEASUREMENT
/begin MEASUREMENT B_iflsd "Bedingung Initialisierung Filter LastschlagdÑmpfung" UWORD B_TRUE___UW 0 0 0.000000 0.000000 /begin IF_DATA ASAP1B_ETK KP_BLOB 0xFD7E 0 2 /end IF_DATA BIT_MASK 0x1000 /end MEASUREMENT
/begin MEASUREMENT B_ilmlkat "Bedingung gÅltige Messung des Sauerstoffspeichers" UWORD B_TRUE___UW 0 0 0.000000 0.000000 /begin IF_DATA ASAP1B_ETK KP_BLOB 0xFD98 0 2 /end IF_DATA BIT_MASK 0x80 /end MEASUREMENT
/begin MEASUREMENT B_i_ska_fr "irrev. Sicherheitskraftstoffabschaltung vom FR" UWORD B_TRUE___UW 0 0 0.000000 0.000000 /begin IF_DATA ASAP1B_ETK KP_BLOB 0xFD46 0 2 /end IF_DATA BIT_MASK 0x4000 /end MEASUREMENT
/begin MEASUREMENT B_i_ska_um "Fehlerreaktion irrev. SKA (Sicherheitskraftstoffabschaltg) vom öberwachungsmodul" UWORD B_TRUE___UW 0 0 0.000000 0.000000 /begin IF_DATA ASAP1B_ETK KP_BLOB 0xFD84 0 2 /end IF_DATA BIT_MASK 0x400 /end MEASUREMENT
/begin MEASUREMENT B_katfz "Bedingung Kat in Fahrzeug eingebaut" UWORD B_TRUE___UW 0 0 0.000000 0.000000 /begin IF_DATA ASAP1B_ETK KP_BLOB 0xFD00 0 2 /end IF_DATA BIT_MASK 0x4000 /end MEASUREMENT
/begin MEASUREMENT B_kath "Bedingung Kat Heizung in Fahrzeug eingebaut" UWORD B_TRUE___UW 0 0 0.000000 0.000000 /begin IF_DATA ASAP1B_ETK KP_BLOB 0xFD00 0 2 /end IF_DATA BIT_MASK 0x8000 /end MEASUREMENT
/begin MEASUREMENT B_kawe "Faktor fwe aktiv wÑhrend Kat-AusrÑumen, Bank 1" UWORD B_TRUE___UW 0 0 0.000000 0.000000 /begin IF_DATA ASAP1B_ETK KP_BLOB 0xFD98 0 2 /end IF_DATA BIT_MASK 0x100 /end MEASUREMENT
/begin MEASUREMENT B_kh "Bedingung Kat-Heizung" UWORD B_TRUE___UW 0 0 0.000000 0.000000 /begin IF_DATA ASAP1B_ETK KP_BLOB 0xFD6E 0 2 /end IF_DATA BIT_MASK 0x1 /end MEASUREMENT
/begin MEASUREMENT B_kha "Anforderung Katheizen" UWORD B_TRUE___UW 0 0 0.000000 0.000000 /begin IF_DATA ASAP1B_ETK KP_BLOB 0xFD6E 0 2 /end IF_DATA BIT_MASK 0x2 /end MEASUREMENT
/begin MEASUREMENT B_khab "Bedingung Katheizen Abbruch" UWORD B_TRUE___UW 0 0 0.000000 0.000000 /begin IF_DATA ASAP1B_ETK KP_BLOB 0xFD6E 0 2 /end IF_DATA BIT_MASK 0x4 /end MEASUREMENT
/begin MEASUREMENT B_kl15 "Bedingung Klemme 15" UWORD B_TRUE___UW 0 0 0.000000 0.000000 /begin IF_DATA ASAP1B_ETK KP_BLOB 0xFD84 0 2 /end IF_DATA BIT_MASK 0x80 /end MEASUREMENT
/begin MEASUREMENT B_klima "Bedingung Klimaanlage" UWORD B_TRUE___UW 0 0 0.000000 0.000000 /begin IF_DATA ASAP1B_ETK KP_BLOB 0xFD02 0 2 /end IF_DATA BIT_MASK 0x1 /end MEASUREMENT
/begin MEASUREMENT B_koe "Bedingung fÅr Kompressoreinschalten" UWORD B_TRUE___UW 0 0 0.000000 0.000000 /begin IF_DATA ASAP1B_ETK KP_BLOB 0xFDA0 0 2 /end IF_DATA BIT_MASK 0x100 /end MEASUREMENT
/begin MEASUREMENT B_kr "Bedingung Klopfregelung aktiv" UWORD B_TRUE___UW 0 0 0.000000 0.000000 /begin IF_DATA ASAP1B_ETK KP_BLOB 0xFD70 0 2 /end IF_DATA BIT_MASK 0x40 /end MEASUREMENT
/begin MEASUREMENT B_kuppl "Bedingung Kupplung betÑtigt" UWORD B_TRUE___UW 0 0 0.000000 0.000000 /begin IF_DATA ASAP1B_ETK KP_BLOB 0xFD48 0 2 /end IF_DATA BIT_MASK 0x20 /end MEASUREMENT
/begin MEASUREMENT B_kupplv "Bedingung Kupplung betÑtigt verzîgert" UWORD B_TRUE___UW 0 0 0.000000 0.000000 /begin IF_DATA ASAP1B_ETK KP_BLOB 0xFD48 0 2 /end IF_DATA BIT_MASK 0x40 /end MEASUREMENT
/begin MEASUREMENT B_kw "Bedingung Kat warmhalten" UWORD B_TRUE___UW 0 0 0.000000 0.000000 /begin IF_DATA ASAP1B_ETK KP_BLOB 0xFD6E 0 2 /end IF_DATA BIT_MASK 0x8 /end MEASUREMENT
/begin MEASUREMENT B_ldr "Flag fÅr Bedingung LDR aktiv" UWORD B_TRUE___UW 0 0 0.000000 0.000000 /begin IF_DATA ASAP1B_ETK KP_BLOB 0xFD78 0 2 /end IF_DATA BIT_MASK 0x100 /end MEASUREMENT
/begin MEASUREMENT B_ldsafw "LDR lÑuft auf Steuerung mit Festwert LDRAPP" UWORD B_TRUE___UW 0 0 0.000000 0.000000 /begin IF_DATA ASAP1B_ETK KP_BLOB 0xFD02 0 2 /end IF_DATA BIT_MASK 0x2 /end MEASUREMENT
/begin MEASUREMENT B_ldsapp "LDR lÑuft auf Steuerung mit KFLDRAPP" UWORD B_TRUE___UW 0 0 0.000000 0.000000 /begin IF_DATA ASAP1B_ETK KP_BLOB 0xFD02 0 2 /end IF_DATA BIT_MASK 0x4 /end MEASUREMENT
/begin MEASUREMENT B_ll "Bedingung Leerlauf" UWORD B_TRUE___UW 0 0 0.000000 0.000000 /begin IF_DATA ASAP1B_ETK KP_BLOB 0xFD7E 0 2 /end IF_DATA BIT_MASK 0x2000 /end MEASUREMENT
/begin MEASUREMENT B_llr "Bedingung Leerlaufregelung" UWORD B_TRUE___UW 0 0 0.000000 0.000000 /begin IF_DATA ASAP1B_ETK KP_BLOB 0xFD7C 0 2 /end IF_DATA BIT_MASK 0x4 /end MEASUREMENT
/begin MEASUREMENT B_llrein "Bedingung LLR ist aktiv" UWORD B_TRUE___UW 0 0 0.000000 0.000000 /begin IF_DATA ASAP1B_ETK KP_BLOB 0xFD7C 0 2 /end IF_DATA BIT_MASK 0x8 /end MEASUREMENT
/begin MEASUREMENT B_llvfgr "Bedingung Leerlauf-Verbot vom FGR" UWORD B_TRUE___UW 0 0 0.000000 0.000000 /begin IF_DATA ASAP1B_ETK KP_BLOB 0xFD4E 0 2 /end IF_DATA BIT_MASK 0x2000 /end MEASUREMENT
/begin MEASUREMENT B_lmsslof "Bedingung Lambda-Motor-Soll-SekundÑrluftanteil, Aus" UWORD B_TRUE___UW 0 0 0.000000 0.000000 /begin IF_DATA ASAP1B_ETK KP_BLOB 0xFD0A 0 2 /end IF_DATA BIT_MASK 0x20 /end MEASUREMENT
/begin MEASUREMENT B_lr "LREB: Bedingung Lambdaregelung (vor Kat); (Bank 1)" UWORD B_TRUE___UW 0 0 0.000000 0.000000 /begin IF_DATA ASAP1B_ETK KP_BLOB 0xFD94 0 2 /end IF_DATA BIT_MASK 0x2 /end MEASUREMENT
/begin MEASUREMENT B_lr2 "Bedingung Lambdaregelung (vor Kat); Bank 2" UWORD B_TRUE___UW 0 0 0.000000 0.000000 /begin IF_DATA ASAP1B_ETK KP_BLOB 0xFD94 0 2 /end IF_DATA BIT_MASK 0x4 /end MEASUREMENT
/begin MEASUREMENT B_lr2s "CARB FREEZE FRAME, Bank1 bit 1, LR: Regelbetrieb mit zwei Sonden" UBYTE B_TRUE 0 0 0.000000 0.000000 /begin IF_DATA ASAP1B_ETK KP_BLOB 0x380CDD 1 1 /end IF_DATA BIT_MASK 0x2 /end MEASUREMENT
/begin MEASUREMENT B_lr2s2 "CARB FREEZE FRAME, Bank2 Bit 1, LR: Regelbetrieb mit zwei Sonden" UBYTE B_TRUE 0 0 0.000000 0.000000 /begin IF_DATA ASAP1B_ETK KP_BLOB 0x380CDE 1 1 /end IF_DATA BIT_MASK 0x2 /end MEASUREMENT
/begin MEASUREMENT B_lreb100 "Sammelbit der im 100 ms-Raster gebildeten Sperrbedingungen" UWORD B_TRUE___UW 0 0 0.000000 0.000000 /begin IF_DATA ASAP1B_ETK KP_BLOB 0xFD94 0 2 /end IF_DATA BIT_MASK 0x8 /end MEASUREMENT
/begin MEASUREMENT B_lreble "Bedingung LR inaktiv bei Abmagerung und Sonde zeigt'fett'" UWORD B_TRUE___UW 0 0 0.000000 0.000000 /begin IF_DATA ASAP1B_ETK KP_BLOB 0xFD94 0 2 /end IF_DATA BIT_MASK 0x10 /end MEASUREMENT
/begin MEASUREMENT B_lreble2 "Bedingung LR inaktiv bei Abmagerung und Sonde zeigt'fett', Bank 2" UWORD B_TRUE___UW 0 0 0.000000 0.000000 /begin IF_DATA ASAP1B_ETK KP_BLOB 0xFD94 0 2 /end IF_DATA BIT_MASK 0x20 /end MEASUREMENT
/begin MEASUREMENT B_lrebpr "Bedingung LR inaktiv bei Anfettung, Sonde 'mager' oder Abmagerung, Sonde 'fett'" UWORD B_TRUE___UW 0 0 0.000000 0.000000 /begin IF_DATA ASAP1B_ETK KP_BLOB 0xFD94 0 2 /end IF_DATA BIT_MASK 0x40 /end MEASUREMENT
/begin MEASUREMENT B_lrebpr2 "Bedingung LR inaktiv bei Anfett. Sonde 'mager' oder Abmager. Sonde 'fett', Bank2" UWORD B_TRUE___UW 0 0 0.000000 0.000000 /begin IF_DATA ASAP1B_ETK KP_BLOB 0xFD94 0 2 /end IF_DATA BIT_MASK 0x80 /end MEASUREMENT
/begin MEASUREMENT B_lrebri "Bedingung LR inaktiv bei Anfettung: lamsons_w < 1, B_vl, B_vag oder B_bag" UWORD B_TRUE___UW 0 0 0.000000 0.000000 /begin IF_DATA ASAP1B_ETK KP_BLOB 0xFD94 0 2 /end IF_DATA BIT_MASK 0x100 /end MEASUREMENT
/begin MEASUREMENT B_lrebri2 "Bedingung LR inaktiv bei Anfettung: lamsons_w < 1, B_vl, B_vag oder B_bag, Bank2" UWORD B_TRUE___UW 0 0 0.000000 0.000000 /begin IF_DATA ASAP1B_ETK KP_BLOB 0xFD94 0 2 /end IF_DATA BIT_MASK 0x200 /end MEASUREMENT
/begin MEASUREMENT B_lrhk "LRHK: Bedingung Lambdaregelung hinter Kat (Bank 1)" UWORD B_TRUE___UW 0 0 0.000000 0.000000 /begin IF_DATA ASAP1B_ETK KP_BLOB 0xFD9A 0 2 /end IF_DATA BIT_MASK 0x1 /end MEASUREMENT
/begin MEASUREMENT B_lrhk2 "Bedingung Lambdaregelung hinter Kat (Bank 2)" UWORD B_TRUE___UW 0 0 0.000000 0.000000 /begin IF_DATA ASAP1B_ETK KP_BLOB 0xFD9A 0 2 /end IF_DATA BIT_MASK 0x2 /end MEASUREMENT
/begin MEASUREMENT B_lrhkb "LRHK: Bedingung Lambdaregelung h. Kat, bankspez. Parameter Bank 1" UBYTE B_TRUE 0 0 0.000000 0.000000 /begin IF_DATA ASAP1B_ETK KP_BLOB 0x380CE9 1 1 /end IF_DATA BIT_MASK 0x4 /end MEASUREMENT
/begin MEASUREMENT B_lrhkg "LRHK: bankunabhÑngige Bedingung Lambdaregelung hinter Kat" UBYTE B_TRUE 0 0 0.000000 0.000000 /begin IF_DATA ASAP1B_ETK KP_BLOB 0x380CE9 1 1 /end IF_DATA BIT_MASK 0x10 /end MEASUREMENT
/begin MEASUREMENT B_lrhkgi "LRHK: bankunabhÑngige Bedingung I-Anteil Lambdaregelung hinter Kat" UBYTE B_TRUE 0 0 0.000000 0.000000 /begin IF_DATA ASAP1B_ETK KP_BLOB 0x380CE9 1 1 /end IF_DATA BIT_MASK 0x20 /end MEASUREMENT
/begin MEASUREMENT B_lrhkp "LRHK: Freigabebedingung P-Anteil Lambdaregelung hinter Kat" UBYTE B_TRUE 0 0 0.000000 0.000000 /begin IF_DATA ASAP1B_ETK KP_BLOB 0x380CE9 1 1 /end IF_DATA BIT_MASK 0x40 /end MEASUREMENT
/begin MEASUREMENT B_lrka "Bedingung Katalysator-AusrÑumen" UWORD B_TRUE___UW 0 0 0.000000 0.000000 /begin IF_DATA ASAP1B_ETK KP_BLOB 0xFD98 0 2 /end IF_DATA BIT_MASK 0x200 /end MEASUREMENT
/begin MEASUREMENT B_lrkaa "Bedingung Katalysator-AusrÑumen auf-/abregeln" UWORD B_TRUE___UW 0 0 0.000000 0.000000 /begin IF_DATA ASAP1B_ETK KP_BLOB 0xFD98 0 2 /end IF_DATA BIT_MASK 0x400 /end MEASUREMENT
/begin MEASUREMENT B_lrkae "Bedingung gesteuertes Katalysator-AusrÑumen mîglich" UWORD B_TRUE___UW 0 0 0.000000 0.000000 /begin IF_DATA ASAP1B_ETK KP_BLOB 0xFD98 0 2 /end IF_DATA BIT_MASK 0x800 /end MEASUREMENT
/begin MEASUREMENT B_lrkaei "Bedingung gesteuertes Katalysator-AusrÑumen mîglich (ALRKAGST)" UWORD B_TRUE___UW 0 0 0.000000 0.000000 /begin IF_DATA ASAP1B_ETK KP_BLOB 0xFD98 0 2 /end IF_DATA BIT_MASK 0x1000 /end MEASUREMENT
/begin MEASUREMENT B_lrkaon "Status aktives AusrÑumen wird durch erneute AusrÑumbedingung unterbrochen" UWORD B_TRUE___UW 0 0 0.000000 0.000000 /begin IF_DATA ASAP1B_ETK KP_BLOB 0xFD98 0 2 /end IF_DATA BIT_MASK 0x2000 /end MEASUREMENT
/begin MEASUREMENT B_lrkarg "Bedingung Katalysator-AusrÑumen, geregelt" UWORD B_TRUE___UW 0 0 0.000000 0.000000 /begin IF_DATA ASAP1B_ETK KP_BLOB 0xFD98 0 2 /end IF_DATA BIT_MASK 0x4000 /end MEASUREMENT
/begin MEASUREMENT B_lrkast "Bedingung Katalysator-AusrÑumen, gesteuert" UWORD B_TRUE___UW 0 0 0.000000 0.000000 /begin IF_DATA ASAP1B_ETK KP_BLOB 0xFD98 0 2 /end IF_DATA BIT_MASK 0x8000 /end MEASUREMENT
/begin MEASUREMENT B_lrnd "Steuerbit LR aktiv setzen; Anforderung 'NORMAL-' oder 'DIAGNOSE-Betrieb'" UWORD B_TRUE___UW 0 0 0.000000 0.000000 /begin IF_DATA ASAP1B_ETK KP_BLOB 0xFD94 0 2 /end IF_DATA BIT_MASK 0x400 /end MEASUREMENT
/begin MEASUREMENT B_lrnd2 "Steuerbit LR aktiv setzen; Anforderung 'NORMAL-' oder 'DIAGNOSE' z.B. bei SLS" UWORD B_TRUE___UW 0 0 0.000000 0.000000 /begin IF_DATA ASAP1B_ETK KP_BLOB 0xFD94 0 2 /end IF_DATA BIT_MASK 0x800 /end MEASUREMENT
/begin MEASUREMENT B_lrnda "LR Bank1 aktiv bei Bedingungen : B_lrpspa & B_lrkasn & !E_obdlr" UWORD B_TRUE___UW 0 0 0.000000 0.000000 /begin IF_DATA ASAP1B_ETK KP_BLOB 0xFD94 0 2 /end IF_DATA BIT_MASK 0x1000 /end MEASUREMENT
/begin MEASUREMENT B_lrnda2 "LR Bank2 aktiv bei Bedingungen : B_lrpspa & B_lrkasn & !E_obdlr" UWORD B_TRUE___UW 0 0 0.000000 0.000000 /begin IF_DATA ASAP1B_ETK KP_BLOB 0xFD94 0 2 /end IF_DATA BIT_MASK 0x2000 /end MEASUREMENT
/begin MEASUREMENT B_lrpspa "LREB: Projektspezifische Ausschaltbedingung Lambdaregelung (vor Kat)" UWORD B_TRUE___UW 0 0 0.000000 0.000000 /begin IF_DATA ASAP1B_ETK KP_BLOB 0xFD94 0 2 /end IF_DATA BIT_MASK 0x4000 /end MEASUREMENT
/begin MEASUREMENT B_lrrl "LREB: Von Last abhÑngige Bedingung Lambdaregelung (vor Kat)" UWORD B_TRUE___UW 0 0 0.000000 0.000000 /begin IF_DATA ASAP1B_ETK KP_BLOB 0xFD94 0 2 /end IF_DATA BIT_MASK 0x8000 /end MEASUREMENT
/begin MEASUREMENT B_lrsp "Bedingung Sondensprung" UWORD B_TRUE___UW 0 0 0.000000 0.000000 /begin IF_DATA ASAP1B_ETK KP_BLOB 0xFD9C 0 2 /end IF_DATA BIT_MASK 0x10 /end MEASUREMENT
/begin MEASUREMENT B_lrsp2 "Bedingung Sondensprung Zylinderbank 2" UWORD B_TRUE___UW 0 0 0.000000 0.000000 /begin IF_DATA ASAP1B_ETK KP_BLOB 0xFD9C 0 2 /end IF_DATA BIT_MASK 0x20 /end MEASUREMENT
/begin MEASUREMENT B_lrvk "CARB FREEZE FRAME, Bank1 Bit 4, LR: Regelung nur mit einer Sonde (vor KAT)" UBYTE B_TRUE 0 0 0.000000 0.000000 /begin IF_DATA ASAP1B_ETK KP_BLOB 0x380CDD 1 1 /end IF_DATA BIT_MASK 0x10 /end MEASUREMENT
/begin MEASUREMENT B_lrvk2 "CARB FREEZE FRAME, Bank2 Bit 4, LR: Regelung nur mit einer Sonde (vor KAT)" UBYTE B_TRUE 0 0 0.000000 0.000000 /begin IF_DATA ASAP1B_ETK KP_BLOB 0x380CDE 1 1 /end IF_DATA BIT_MASK 0x10 /end MEASUREMENT
/begin MEASUREMENT B_lrwla "LR aktiv bei Bedingungen : B_lrrl & B_tmlr & B_pspwl & Bstend" UWORD B_TRUE___UW 0 0 0.000000 0.000000 /begin IF_DATA ASAP1B_ETK KP_BLOB 0xFD96 0 2 /end IF_DATA BIT_MASK 0x1 /end MEASUREMENT
/begin MEASUREMENT B_ls "Bedingung: Lastschlagbegrenzung kleiner Fahrerwunsch (=1)" UWORD B_TRUE___UW 0 0 0.000000 0.000000 /begin IF_DATA ASAP1B_ETK KP_BLOB 0xFD7E 0 2 /end IF_DATA BIT_MASK 0x4000 /end MEASUREMENT
/begin MEASUREMENT B_ls3 "Bedingung 3. Lambda-Sonde nach Ausla· vorbaut (Bank1)" UWORD B_TRUE___UW 0 0 0.000000 0.000000 /begin IF_DATA ASAP1B_ETK KP_BLOB 0xFD02 0 2 /end IF_DATA BIT_MASK 0x8 /end MEASUREMENT
/begin MEASUREMENT B_ls32 "Bedingung 3. Lambda-Sonde nach Ausla· vorbaut (Bank2)" UWORD B_TRUE___UW 0 0 0.000000 0.000000 /begin IF_DATA ASAP1B_ETK KP_BLOB 0xFD02 0 2 /end IF_DATA BIT_MASK 0x10 /end MEASUREMENT
/begin MEASUREMENT B_ls4 "Bedingung 4. Lambda-Sonde nach Ausla· vorbaut (Bank1)" UWORD B_TRUE___UW 0 0 0.000000 0.000000 /begin IF_DATA ASAP1B_ETK KP_BLOB 0xFD02 0 2 /end IF_DATA BIT_MASK 0x20 /end MEASUREMENT
/begin MEASUREMENT B_ls42 "Bedingung 4. Lambda-Sonde nach Ausla· vorbaut (Bank2)" UWORD B_TRUE___UW 0 0 0.000000 0.000000 /begin IF_DATA ASAP1B_ETK KP_BLOB 0xFD02 0 2 /end IF_DATA BIT_MASK 0x40 /end MEASUREMENT
/begin MEASUREMENT B_lsd "Bedingung: Pos. LastschlagdÑmpfung aktiv" UWORD B_TRUE___UW 0 0 0.000000 0.000000 /begin IF_DATA ASAP1B_ETK KP_BLOB 0xFD7E 0 2 /end IF_DATA BIT_MASK 0x8000 /end MEASUREMENT
/begin MEASUREMENT B_lsh "Bedingung Lambda-Sonde hinter Kat verbaut, 2. Sonde nach Ausla· (Bank1)" UWORD B_TRUE___UW 0 0 0.000000 0.000000 /begin IF_DATA ASAP1B_ETK KP_BLOB 0xFD02 0 2 /end IF_DATA BIT_MASK 0x80 /end MEASUREMENT
/begin MEASUREMENT B_lsh2 "Bedingung Lambda-Sonde hinter Kat verbaut, 2. Sonde nach Ausla· (Bank2)" UWORD B_TRUE___UW 0 0 0.000000 0.000000 /begin IF_DATA ASAP1B_ETK KP_BLOB 0xFD02 0 2 /end IF_DATA BIT_MASK 0x100 /end MEASUREMENT
/begin MEASUREMENT B_lsv "Bedingung Lambda-Sonde vor Kat verbaut, 1. Sonde nach Ausla· (Bank1)" UWORD B_TRUE___UW 0 0 0.000000 0.000000 /begin IF_DATA ASAP1B_ETK KP_BLOB 0xFD02 0 2 /end IF_DATA BIT_MASK 0x200 /end MEASUREMENT
/begin MEASUREMENT B_lsv2 "Bedingung Lambda-Sonde vor Kat verbaut, 1. Sonde nach Ausla· (Bank2)" UWORD B_TRUE___UW 0 0 0.000000 0.000000 /begin IF_DATA ASAP1B_ETK KP_BLOB 0xFD02 0 2 /end IF_DATA BIT_MASK 0x400 /end MEASUREMENT
/begin MEASUREMENT B_lwser "Fehler im Lenkwinkelsensorpfad" UWORD B_TRUE___UW 0 0 0.000000 0.000000 /begin IF_DATA ASAP1B_ETK KP_BLOB 0xFD10 0 2 /end IF_DATA BIT_MASK 0x200 /end MEASUREMENT
/begin MEASUREMENT B_m8te "Bedingung Fkt-Anforderung TankentlÅftung nach SAE J1979 Mode 8 TID $01" UBYTE B_TRUE 0 0 0.000000 0.000000 /begin IF_DATA ASAP1B_ETK KP_BLOB 0x380A37 1 1 /end IF_DATA BIT_MASK 0x1 /end MEASUREMENT
/begin MEASUREMENT B_madfk "Bedingung Momentenadaption Fahrstufe und Klimakompressor ein" UBYTE B_TRUE 0 0 0.000000 0.000000 /begin IF_DATA ASAP1B_ETK KP_BLOB 0x380C24 1 1 /end IF_DATA BIT_MASK 0x1 /end MEASUREMENT
/begin MEASUREMENT B_madfs "Bedingung Momentenadaption Fahrstufe ein" UBYTE B_TRUE 0 0 0.000000 0.000000 /begin IF_DATA ASAP1B_ETK KP_BLOB 0x380C24 1 1 /end IF_DATA BIT_MASK 0x2 /end MEASUREMENT
/begin MEASUREMENT B_madko "Bedingung Momentenadaption Klimakompressor ein" UBYTE B_TRUE 0 0 0.000000 0.000000 /begin IF_DATA ASAP1B_ETK KP_BLOB 0x380C24 1 1 /end IF_DATA BIT_MASK 0x4 /end MEASUREMENT
/begin MEASUREMENT B_madll "Bedingung Momentenadaption ohne Last" UBYTE B_TRUE 0 0 0.000000 0.000000 /begin IF_DATA ASAP1B_ETK KP_BLOB 0x380C24 1 1 /end IF_DATA BIT_MASK 0x8 /end MEASUREMENT
/begin MEASUREMENT B_mdarv "kritische Aussetzerrate vorhanden" UWORD B_TRUE___UW 0 0 0.000000 0.000000 /begin IF_DATA ASAP1B_ETK KP_BLOB 0xFD1A 0 2 /end IF_DATA BIT_MASK 0x4 /end MEASUREMENT
/begin MEASUREMENT B_mdee "Bedingung Momentenreduzierung Åber Einspritzausblendung erlaubt" UWORD B_TRUE___UW 0 0 0.000000 0.000000 /begin IF_DATA ASAP1B_ETK KP_BLOB 0xFD82 0 2 /end IF_DATA BIT_MASK 0x8000 /end MEASUREMENT
/begin MEASUREMENT B_mdein "Bedingung Momenteneingriff aktiv" UWORD B_TRUE___UW 0 0 0.000000 0.000000 /begin IF_DATA ASAP1B_ETK KP_BLOB 0xFD82 0 2 /end IF_DATA BIT_MASK 0x10 /end MEASUREMENT
/begin MEASUREMENT B_mdkat "KatschÑdigende Aussetzerrate Åberschritten (zur Ausblendung anderer Funktionen)" UWORD B_TRUE___UW 0 0 0.000000 0.000000 /begin IF_DATA ASAP1B_ETK KP_BLOB 0xFD1A 0 2 /end IF_DATA BIT_MASK 0x8 /end MEASUREMENT
/begin MEASUREMENT B_mdmin "Bedingung minimal erreichbares indiziertes Moment erreicht" UWORD B_TRUE___UW 0 0 0.000000 0.000000 /begin IF_DATA ASAP1B_ETK KP_BLOB 0xFD5A 0 2 /end IF_DATA BIT_MASK 0x4 /end MEASUREMENT
/begin MEASUREMENT B_mdnstab "Bedingung Drehzahlstabilisierung aktiv" UWORD B_TRUE___UW 0 0 0.000000 0.000000 /begin IF_DATA ASAP1B_ETK KP_BLOB 0xFD7C 0 2 /end IF_DATA BIT_MASK 0x400 /end MEASUREMENT
/begin MEASUREMENT B_mdredhyein "" UWORD B_TRUE___UW 0 0 0.000000 0.000000 /begin IF_DATA ASAP1B_ETK KP_BLOB 0xFD84 0 2 /end IF_DATA BIT_MASK 0x1 /end MEASUREMENT
/begin MEASUREMENT B_mdwaner "Bedingung Fehler auf mdwan_w" UWORD B_TRUE___UW 0 0 0.000000 0.000000 /begin IF_DATA ASAP1B_ETK KP_BLOB 0xFD10 0 2 /end IF_DATA BIT_MASK 0x1000 /end MEASUREMENT
/begin MEASUREMENT B_mgbgakt "Bedingung Momentengradientenbegrenzung aktiv" UWORD B_TRUE___UW 0 0 0.000000 0.000000 /begin IF_DATA ASAP1B_ETK KP_BLOB 0xFD80 0 2 /end IF_DATA BIT_MASK 0x1 /end MEASUREMENT
/begin MEASUREMENT B_mgbget "Bedingung Momentengradientenbegrenzung aktiv" UWORD B_TRUE___UW 0 0 0.000000 0.000000 /begin IF_DATA ASAP1B_ETK KP_BLOB 0xFD10 0 2 /end IF_DATA BIT_MASK 0x2000 /end MEASUREMENT
/begin MEASUREMENT B_mibeg "Bedingung Momentenbegrenzung ist aktiv" UWORD B_TRUE___UW 0 0 0.000000 0.000000 /begin IF_DATA ASAP1B_ETK KP_BLOB 0xFD82 0 2 /end IF_DATA BIT_MASK 0x20 /end MEASUREMENT
/begin MEASUREMENT B_mibegdau "Bedingung: MomentenÅberwachung begrenzt dauerhaft" UWORD B_TRUE___UW 0 0 0.000000 0.000000 /begin IF_DATA ASAP1B_ETK KP_BLOB 0xFD82 0 2 /end IF_DATA BIT_MASK 0x40 /end MEASUREMENT
/begin MEASUREMENT B_mifabg "Bedingung Begrenzung mifa" UWORD B_TRUE___UW 0 0 0.000000 0.000000 /begin IF_DATA ASAP1B_ETK KP_BLOB 0xFD80 0 2 /end IF_DATA BIT_MASK 0x2 /end MEASUREMENT
/begin MEASUREMENT B_mlrsa "LRSEB: Ausschaltbed. fÅr Lambdareg. auf bei und nach Schub Åber Luftmassenschw." UWORD B_TRUE___UW 0 0 0.000000 0.000000 /begin IF_DATA ASAP1B_ETK KP_BLOB 0xFD96 0 2 /end IF_DATA BIT_MASK 0x2 /end MEASUREMENT
/begin MEASUREMENT B_msfslr "Bed. LR aktiv/inaktiv bei Fett/Magerschutz" UWORD B_TRUE___UW 0 0 0.000000 0.000000 /begin IF_DATA ASAP1B_ETK KP_BLOB 0xFD96 0 2 /end IF_DATA BIT_MASK 0x4 /end MEASUREMENT
/begin MEASUREMENT B_msfslr2 "Bed. LR aktiv/inaktiv wÑhrend Fett-/Magerschutz, Bank 2" UWORD B_TRUE___UW 0 0 0.000000 0.000000 /begin IF_DATA ASAP1B_ETK KP_BLOB 0xFD96 0 2 /end IF_DATA BIT_MASK 0x8 /end MEASUREMENT
/begin MEASUREMENT B_mslmn "Bedingung zu wenig SekundÑrluftmasse" UWORD B_TRUE___UW 0 0 0.000000 0.000000 /begin IF_DATA ASAP1B_ETK KP_BLOB 0xFD0C 0 2 /end IF_DATA BIT_MASK 0x20 /end MEASUREMENT
/begin MEASUREMENT B_msloff "SekundÑrluftmasse ausgerÑumt nach SekundÑrluftphase" UWORD B_TRUE___UW 0 0 0.000000 0.000000 /begin IF_DATA ASAP1B_ETK KP_BLOB 0xFD0A 0 2 /end IF_DATA BIT_MASK 0x40 /end MEASUREMENT
/begin MEASUREMENT B_mslon "SekundÑrluftmasse eingeschwungen nach Start der SekundÑrluft" UWORD B_TRUE___UW 0 0 0.000000 0.000000 /begin IF_DATA ASAP1B_ETK KP_BLOB 0xFD0A 0 2 /end IF_DATA BIT_MASK 0x80 /end MEASUREMENT
/begin MEASUREMENT B_mslr "Bed. LR aktiv/inaktiv bei Fett/Magerschutz" UWORD B_TRUE___UW 0 0 0.000000 0.000000 /begin IF_DATA ASAP1B_ETK KP_BLOB 0xFD96 0 2 /end IF_DATA BIT_MASK 0x10 /end MEASUREMENT
/begin MEASUREMENT B_mslr2 "Bed. LR aktiv/inaktiv wÑhrend Fett-/Magerschutz" UWORD B_TRUE___UW 0 0 0.000000 0.000000 /begin IF_DATA ASAP1B_ETK KP_BLOB 0xFD96 0 2 /end IF_DATA BIT_MASK 0x20 /end MEASUREMENT
/begin MEASUREMENT B_msr "Bedingung fÅr Momentenschlupfregelung" UWORD B_TRUE___UW 0 0 0.000000 0.000000 /begin IF_DATA ASAP1B_ETK KP_BLOB 0xFD82 0 2 /end IF_DATA BIT_MASK 0x80 /end MEASUREMENT
/begin MEASUREMENT B_mt "Bedingung Handschaltgetriebe" UWORD B_TRUE___UW 0 0 0.000000 0.000000 /begin IF_DATA ASAP1B_ETK KP_BLOB 0xFD02 0 2 /end IF_DATA BIT_MASK 0x800 /end MEASUREMENT
/begin MEASUREMENT B_mzns "Nachstartaufweitung des zul. Moments aktiv" UWORD B_TRUE___UW 0 0 0.000000 0.000000 /begin IF_DATA ASAP1B_ETK KP_BLOB 0xFD84 0 2 /end IF_DATA BIT_MASK 0x4 /end MEASUREMENT
/begin MEASUREMENT B_mzns_um "Nachstartaufweitung des zul. Moments aktiv fÅr die Fkt.-öberwachung" UWORD B_TRUE___UW 0 0 0.000000 0.000000 /begin IF_DATA ASAP1B_ETK KP_BLOB 0xFD84 0 2 /end IF_DATA BIT_MASK 0x1000 /end MEASUREMENT
/begin MEASUREMENT B_nachl "Steuerung SG-Nachlauf" UWORD B_TRUE___UW 0 0 0.000000 0.000000 /begin IF_DATA ASAP1B_ETK KP_BLOB 0x383CCE 1 2 /end IF_DATA BIT_MASK 0x8000 /end MEASUREMENT
/begin MEASUREMENT B_nachlend "Bedingung SG-Nachlauf regulÑr beendet" UWORD B_TRUE___UW 0 0 0.000000 0.000000 /begin IF_DATA ASAP1B_ETK KP_BLOB 0x383CCE 1 2 /end IF_DATA BIT_MASK 0x4000 /end MEASUREMENT
/begin MEASUREMENT B_nachlstp "Bedingung SG-Nachlauf beendet" UWORD B_TRUE___UW 0 0 0.000000 0.000000 /begin IF_DATA ASAP1B_ETK KP_BLOB 0x383CCE 1 2 /end IF_DATA BIT_MASK 0x2000 /end MEASUREMENT
/begin MEASUREMENT B_nlacls "Anforderung SteuergerÑtenachlauf von AC-LÅftersteuerung" UWORD B_TRUE___UW 0 0 0.000000 0.000000 /begin IF_DATA ASAP1B_ETK KP_BLOB 0x383CCE 1 2 /end IF_DATA BIT_MASK 0x2 /end MEASUREMENT
/begin MEASUREMENT B_nlale "Anforderung SteuergerÑtenachlauf von Funktion ALE" UWORD B_TRUE___UW 0 0 0.000000 0.000000 /begin IF_DATA ASAP1B_ETK KP_BLOB 0x383CCE 1 2 /end IF_DATA BIT_MASK 0x1 /end MEASUREMENT
/begin MEASUREMENT B_nlatm "Anforderung SteuergerÑtenachlauf fÅr Abgastemp.Modell Sondenschutz" UWORD B_TRUE___UW 0 0 0.000000 0.000000 /begin IF_DATA ASAP1B_ETK KP_BLOB 0x383CCE 1 2 /end IF_DATA BIT_MASK 0x800 /end MEASUREMENT
/begin MEASUREMENT B_nlcan "Bedingung fÅr SG-Nachlauf von CAN" UWORD B_TRUE___UW 0 0 0.000000 0.000000 /begin IF_DATA ASAP1B_ETK KP_BLOB 0x383CCE 1 2 /end IF_DATA BIT_MASK 0x200 /end MEASUREMENT
/begin MEASUREMENT B_nldg "Bedingung Drehzahlgeber-Notlauf" UWORD B_TRUE___UW 0 0 0.000000 0.000000 /begin IF_DATA ASAP1B_ETK KP_BLOB 0xFD22 0 2 /end IF_DATA BIT_MASK 0x1 /end MEASUREMENT
/begin MEASUREMENT B_nldte "Anforderung SteuergerÑtenachlauf Diagnose TankentlÅftung" UWORD B_TRUE___UW 0 0 0.000000 0.000000 /begin IF_DATA ASAP1B_ETK KP_BLOB 0x383CCE 1 2 /end IF_DATA BIT_MASK 0x100 /end MEASUREMENT
/begin MEASUREMENT B_nlEEPR "Bedingung Nachlauf EEPROM schreiben" UWORD B_TRUE___UW 0 0 0.000000 0.000000 /begin IF_DATA ASAP1B_ETK KP_BLOB 0x383CCE 1 2 /end IF_DATA BIT_MASK 0x20 /end MEASUREMENT
/begin MEASUREMENT B_nlmls "Anforderung SteuergerÑtenachlauf von Motor-LÅftersteuerung" UWORD B_TRUE___UW 0 0 0.000000 0.000000 /begin IF_DATA ASAP1B_ETK KP_BLOB 0x383CCE 1 2 /end IF_DATA BIT_MASK 0x8 /end MEASUREMENT
/begin MEASUREMENT B_nlobd "Anforderung SteuergerÑtenachlauf von OBD" UWORD B_TRUE___UW 0 0 0.000000 0.000000 /begin IF_DATA ASAP1B_ETK KP_BLOB 0x383CCE 1 2 /end IF_DATA BIT_MASK 0x10 /end MEASUREMENT
/begin MEASUREMENT B_nlpne "Bedingung: Bei gefordertem DK-Notluftfahren wurde NLP nicht erreicht" UWORD B_TRUE___UW 0 0 0.000000 0.000000 /begin IF_DATA ASAP1B_ETK KP_BLOB 0xFD46 0 2 /end IF_DATA BIT_MASK 0x2 /end MEASUREMENT
/begin MEASUREMENT B_nlsgls "Anforderung SteuergerÑtenachlauf von SteuergerÑte-LÅftersteuerung" UWORD B_TRUE___UW 0 0 0.000000 0.000000 /begin IF_DATA ASAP1B_ETK KP_BLOB 0x383CCE 1 2 /end IF_DATA BIT_MASK 0x40 /end MEASUREMENT
/begin MEASUREMENT B_nlsiko "Bedingung Nachlauf EGAS-öberwachung" UWORD B_TRUE___UW 0 0 0.000000 0.000000 /begin IF_DATA ASAP1B_ETK KP_BLOB 0x383CCE 1 2 /end IF_DATA BIT_MASK 0x80 /end MEASUREMENT
/begin MEASUREMENT B_nlwfs "SG-Bedingung SG-Nachlauf durch WegfahrsperrensteuergerÑt" UWORD B_TRUE___UW 0 0 0.000000 0.000000 /begin IF_DATA ASAP1B_ETK KP_BLOB 0x383CCE 1 2 /end IF_DATA BIT_MASK 0x400 /end MEASUREMENT
/begin MEASUREMENT B_nlwst "Anforderung SteuergerÑtenachlauf fÅr Wiederholstarterkennung" UWORD B_TRUE___UW 0 0 0.000000 0.000000 /begin IF_DATA ASAP1B_ETK KP_BLOB 0x383CCE 1 2 /end IF_DATA BIT_MASK 0x4 /end MEASUREMENT
/begin MEASUREMENT B_nmax "1 = Maximaldrehzahl ueberschritten" UWORD B_TRUE___UW 0 0 0.000000 0.000000 /begin IF_DATA ASAP1B_ETK KP_BLOB 0xFD82 0 2 /end IF_DATA BIT_MASK 0x1000 /end MEASUREMENT
/begin MEASUREMENT B_nmaxd "Bedingung Drehzahlbegrenzung mit Einspritzausblendung" UWORD B_TRUE___UW 0 0 0.000000 0.000000 /begin IF_DATA ASAP1B_ETK KP_BLOB 0xFD82 0 2 /end IF_DATA BIT_MASK 0x2000 /end MEASUREMENT
/begin MEASUREMENT B_nmot "Bedingung Motordrehzahl: n > NMIN" UWORD B_TRUE___UW 0 0 0.000000 0.000000 /begin IF_DATA ASAP1B_ETK KP_BLOB 0xFD1E 0 2 /end IF_DATA BIT_MASK 0x800 /end MEASUREMENT
/begin MEASUREMENT B_nolrb "CARB FREEZE FRAME, Bank1 Bit 2, LR: Steuerbetrieb durch Betriebsbedingungen" UBYTE B_TRUE 0 0 0.000000 0.000000 /begin IF_DATA ASAP1B_ETK KP_BLOB 0x380CDD 1 1 /end IF_DATA BIT_MASK 0x4 /end MEASUREMENT
/begin MEASUREMENT B_nolrb2 "CARB FREEZE FRAME, Bank2 Bit 2, LR: Steuerung durch Betriebsbedingung" UBYTE B_TRUE 0 0 0.000000 0.000000 /begin IF_DATA ASAP1B_ETK KP_BLOB 0x380CDE 1 1 /end IF_DATA BIT_MASK 0x4 /end MEASUREMENT
/begin MEASUREMENT B_nolre "CARB FREEZE FRAME, Bank1 Bit 3, LR: Steuerung nach Systemfehler" UBYTE B_TRUE 0 0 0.000000 0.000000 /begin IF_DATA ASAP1B_ETK KP_BLOB 0x380CDD 1 1 /end IF_DATA BIT_MASK 0x8 /end MEASUREMENT
/begin MEASUREMENT B_nolre2 "CARB FREEZE FRAME, Bank2 Bit 3, LR: Steuerung nach Systemfehler" UBYTE B_TRUE 0 0 0.000000 0.000000 /begin IF_DATA ASAP1B_ETK KP_BLOB 0x380CDE 1 1 /end IF_DATA BIT_MASK 0x8 /end MEASUREMENT
/begin MEASUREMENT B_nolrw "CARB FREEZE FRAME, Bank1 Bit 0, LR: Steuerbetrieb, Startbed. noch nicht erfÅllt" UBYTE B_TRUE 0 0 0.000000 0.000000 /begin IF_DATA ASAP1B_ETK KP_BLOB 0x380CDD 1 1 /end IF_DATA BIT_MASK 0x1 /end MEASUREMENT
/begin MEASUREMENT B_nolrw2 "CARB FREEZE FRAME, Bank2 Bit 0, LR: Steuerbetrieb, Startbed. noch nicht erfÅllt" UBYTE B_TRUE 0 0 0.000000 0.000000 /begin IF_DATA ASAP1B_ETK KP_BLOB 0x380CDE 1 1 /end IF_DATA BIT_MASK 0x1 /end MEASUREMENT
/begin MEASUREMENT B_nosynph "Flag fÅr falsche Zylinderzuordnung bei SynchronisierlÅcke" UWORD B_TRUE___UW 0 0 0.000000 0.000000 /begin IF_DATA ASAP1B_ETK KP_BLOB 0xFD1E 0 2 /end IF_DATA BIT_MASK 0x8 /end MEASUREMENT
/begin MEASUREMENT B_notlu_fr "Notluftfahren vom FR" UWORD B_TRUE___UW 0 0 0.000000 0.000000 /begin IF_DATA ASAP1B_ETK KP_BLOB 0xFD46 0 2 /end IF_DATA BIT_MASK 0x8000 /end MEASUREMENT
/begin MEASUREMENT B_nozwe "Bedingung kein ZÅndwinkeleingriff der Drehmomentstruktur" UWORD B_TRUE___UW 0 0 0.000000 0.000000 /begin IF_DATA ASAP1B_ETK KP_BLOB 0xFD9E 0 2 /end IF_DATA BIT_MASK 0x1000 /end MEASUREMENT
/begin MEASUREMENT B_nsakt "Nachstart aktiv fÅr Nachstartaufweitung" UWORD B_TRUE___UW 0 0 0.000000 0.000000 /begin IF_DATA ASAP1B_ETK KP_BLOB 0xFD84 0 2 /end IF_DATA BIT_MASK 0x8 /end MEASUREMENT
/begin MEASUREMENT B_nsend "NachstartÅberwachungszeit abgelaufen" UWORD B_TRUE___UW 0 0 0.000000 0.000000 /begin IF_DATA ASAP1B_ETK KP_BLOB 0xFD84 0 2 /end IF_DATA BIT_MASK 0x10 /end MEASUREMENT
/begin MEASUREMENT B_nswo1 "Bedingung Drehzahl > NSWO1" UWORD B_TRUE___UW 0 0 0.000000 0.000000 /begin IF_DATA ASAP1B_ETK KP_BLOB 0xFD02 0 2 /end IF_DATA BIT_MASK 0x1000 /end MEASUREMENT
/begin MEASUREMENT B_nswo2 "Bedingung Drehzahl > NSWO2" UWORD B_TRUE___UW 0 0 0.000000 0.000000 /begin IF_DATA ASAP1B_ETK KP_BLOB 0xFD02 0 2 /end IF_DATA BIT_MASK 0x2000 /end MEASUREMENT
/begin MEASUREMENT B_nws "Nockenwellenverstellung nicht aktiv/aktiv" UWORD B_TRUE___UW 0 0 0.000000 0.000000 /begin IF_DATA ASAP1B_ETK KP_BLOB 0xFD5A 0 2 /end IF_DATA BIT_MASK 0x8 /end MEASUREMENT
/begin MEASUREMENT B_nwsa "Bedingung Nockenwellensteuerung aktiv" UWORD B_TRUE___UW 0 0 0.000000 0.000000 /begin IF_DATA ASAP1B_ETK KP_BLOB 0xFD5A 0 2 /end IF_DATA BIT_MASK 0x10 /end MEASUREMENT
/begin MEASUREMENT B_nwsb "Bedingung Nockenwellensteuerung vor B_fa Bedingung               |" UWORD B_TRUE___UW 0 0 0.000000 0.000000 /begin IF_DATA ASAP1B_ETK KP_BLOB 0xFD5A 0 2 /end IF_DATA BIT_MASK 0x20 /end MEASUREMENT
/begin MEASUREMENT B_nw_s "Zustandsinformation NW sicher in SpÑtstellung" UWORD B_TRUE___UW 0 0 0.000000 0.000000 /begin IF_DATA ASAP1B_ETK KP_BLOB 0xFD5A 0 2 /end IF_DATA BIT_MASK 0x40 /end MEASUREMENT
/begin MEASUREMENT B_phase "Bedingung Phase low/high" UWORD B_TRUE___UW 0 0 0.000000 0.000000 /begin IF_DATA ASAP1B_ETK KP_BLOB 0xFD1E 0 2 /end IF_DATA BIT_MASK 0x8000 /end MEASUREMENT
/begin MEASUREMENT B_phnldg "Phasenlage aus Notlauf DG" UWORD B_TRUE___UW 0 0 0.000000 0.000000 /begin IF_DATA ASAP1B_ETK KP_BLOB 0xFD22 0 2 /end IF_DATA BIT_MASK 0x2 /end MEASUREMENT
/begin MEASUREMENT B_phsok "Bedingung Phasensignal ok" UWORD B_TRUE___UW 0 0 0.000000 0.000000 /begin IF_DATA ASAP1B_ETK KP_BLOB 0xFD1C 0 2 /end IF_DATA BIT_MASK 0x1000 /end MEASUREMENT
/begin MEASUREMENT B_pspaus "Bedingung LR inaktiv bei projektspez. AUS-Bedingungen" UWORD B_TRUE___UW 0 0 0.000000 0.000000 /begin IF_DATA ASAP1B_ETK KP_BLOB 0xFD96 0 2 /end IF_DATA BIT_MASK 0x40 /end MEASUREMENT
/begin MEASUREMENT B_pspwl "Bedingung LR inaktiv bei projektspez. Warmlauf-Bedingungen" UWORD B_TRUE___UW 0 0 0.000000 0.000000 /begin IF_DATA ASAP1B_ETK KP_BLOB 0xFD96 0 2 /end IF_DATA BIT_MASK 0x80 /end MEASUREMENT
/begin MEASUREMENT B_pwf "Bedingung Powerfail" UWORD B_TRUE___UW 0 0 0.000000 0.000000 /begin IF_DATA ASAP1B_ETK KP_BLOB 0xFD88 0 2 /end IF_DATA BIT_MASK 0x10 /end MEASUREMENT
/begin MEASUREMENT B_rgang "Bedingung RÅckwÑrtsgang eingelegt" UWORD B_TRUE___UW 0 0 0.000000 0.000000 /begin IF_DATA ASAP1B_ETK KP_BLOB 0xFD7C 0 2 /end IF_DATA BIT_MASK 0x1 /end MEASUREMENT
/begin MEASUREMENT B_sa "Schubabschaltung" UWORD B_TRUE___UW 0 0 0.000000 0.000000 /begin IF_DATA ASAP1B_ETK KP_BLOB 0xFD84 0 2 /end IF_DATA BIT_MASK 0x2 /end MEASUREMENT
/begin MEASUREMENT B_sab "Bedingung Schubabschaltebereitschaft" UWORD B_TRUE___UW 0 0 0.000000 0.000000 /begin IF_DATA ASAP1B_ETK KP_BLOB 0xFD7A 0 2 /end IF_DATA BIT_MASK 0x100 /end MEASUREMENT
/begin MEASUREMENT B_sbbhk "Bedingung Sonde betriebsbereit hinter Kat" UWORD B_TRUE___UW 0 0 0.000000 0.000000 /begin IF_DATA ASAP1B_ETK KP_BLOB 0xFD22 0 2 /end IF_DATA BIT_MASK 0x2000 /end MEASUREMENT
/begin MEASUREMENT B_sbbvk "Bedingung Sonde betriebsbereit vor Kat" UWORD B_TRUE___UW 0 0 0.000000 0.000000 /begin IF_DATA ASAP1B_ETK KP_BLOB 0xFD32 0 2 /end IF_DATA BIT_MASK 0x40 /end MEASUREMENT
/begin MEASUREMENT B_sl "Bedingung Servo-Lenkung" UWORD B_TRUE___UW 0 0 0.000000 0.000000 /begin IF_DATA ASAP1B_ETK KP_BLOB 0xFD08 0 2 /end IF_DATA BIT_MASK 0x8000 /end MEASUREMENT
/begin MEASUREMENT B_sla "Anforderung SekundÑrluftadaptionsphase" UWORD B_TRUE___UW 0 0 0.000000 0.000000 /begin IF_DATA ASAP1B_ETK KP_BLOB 0xFD0C 0 2 /end IF_DATA BIT_MASK 0x40 /end MEASUREMENT
/begin MEASUREMENT B_sldsl4 "Bedingung: Freigabe SekundÑrluft fÅr Diagnosephase 4" UWORD B_TRUE___UW 0 0 0.000000 0.000000 /begin IF_DATA ASAP1B_ETK KP_BLOB 0x380ED2 1 2 /end IF_DATA BIT_MASK 0x4 /end MEASUREMENT
/begin MEASUREMENT B_slkhof "Bedingung Abschalten der SekundÑrluftpumpe durch imlpr-Schwelle" UWORD B_TRUE___UW 0 0 0.000000 0.000000 /begin IF_DATA ASAP1B_ETK KP_BLOB 0xFD0A 0 2 /end IF_DATA BIT_MASK 0x100 /end MEASUREMENT
/begin MEASUREMENT B_slkt "Bedingung: Freigabe SekundÑrluft fÅr Kurztest" UWORD B_TRUE___UW 0 0 0.000000 0.000000 /begin IF_DATA ASAP1B_ETK KP_BLOB 0x380ED2 1 2 /end IF_DATA BIT_MASK 0x8 /end MEASUREMENT
/begin MEASUREMENT B_slp "Bedingung fÅr SekundÑrluftpumpe" UWORD B_TRUE___UW 0 0 0.000000 0.000000 /begin IF_DATA ASAP1B_ETK KP_BLOB 0xFD0A 0 2 /end IF_DATA BIT_MASK 0x200 /end MEASUREMENT
/begin MEASUREMENT B_slpena "Bedingung Einschalten der SekundÑrluftpumpe" UWORD B_TRUE___UW 0 0 0.000000 0.000000 /begin IF_DATA ASAP1B_ETK KP_BLOB 0x380ED2 1 2 /end IF_DATA BIT_MASK 0x10 /end MEASUREMENT
/begin MEASUREMENT B_slpoff "SekundÑrluftpumpe abgeschaltet" UWORD B_TRUE___UW 0 0 0.000000 0.000000 /begin IF_DATA ASAP1B_ETK KP_BLOB 0xFD0A 0 2 /end IF_DATA BIT_MASK 0x400 /end MEASUREMENT
/begin MEASUREMENT B_slpofst "Bedingung fÅr Setzen Flip Flop  B_slpoff" UWORD B_TRUE___UW 0 0 0.000000 0.000000 /begin IF_DATA ASAP1B_ETK KP_BLOB 0x380ED2 1 2 /end IF_DATA BIT_MASK 0x20 /end MEASUREMENT
/begin MEASUREMENT B_sls "Bedingung SekundÑrluft aktiv" UWORD B_TRUE___UW 0 0 0.000000 0.000000 /begin IF_DATA ASAP1B_ETK KP_BLOB 0xFD0A 0 2 /end IF_DATA BIT_MASK 0x800 /end MEASUREMENT
/begin MEASUREMENT B_slsadap "Bedingung: SekundÑrluftmassenadaption" UWORD B_TRUE___UW 0 0 0.000000 0.000000 /begin IF_DATA ASAP1B_ETK KP_BLOB 0xFD0A 0 2 /end IF_DATA BIT_MASK 0x1000 /end MEASUREMENT
/begin MEASUREMENT B_slsdis "Bedingung fÅr  Abschalten der SekundÑrluftpumpe" UWORD B_TRUE___UW 0 0 0.000000 0.000000 /begin IF_DATA ASAP1B_ETK KP_BLOB 0x380ED2 1 2 /end IF_DATA BIT_MASK 0x80 /end MEASUREMENT
/begin MEASUREMENT B_slserr "Bedingungen sperren Einschalten der SekundÑrluftpumpe" UWORD B_TRUE___UW 0 0 0.000000 0.000000 /begin IF_DATA ASAP1B_ETK KP_BLOB 0x380ED2 1 2 /end IF_DATA BIT_MASK 0x100 /end MEASUREMENT
/begin MEASUREMENT B_slsfz "Bedingung SLS in Fahrzeug eingebaut" UWORD B_TRUE___UW 0 0 0.000000 0.000000 /begin IF_DATA ASAP1B_ETK KP_BLOB 0xFD02 0 2 /end IF_DATA BIT_MASK 0x4000 /end MEASUREMENT
/begin MEASUREMENT B_slsinhi "Bedingung sperrt Setzen von Bit B_sls" UWORD B_TRUE___UW 0 0 0.000000 0.000000 /begin IF_DATA ASAP1B_ETK KP_BLOB 0x380ED2 1 2 /end IF_DATA BIT_MASK 0x40 /end MEASUREMENT
/begin MEASUREMENT B_slsoff "SekundÑrlufteinblasung nach AusrÑumen der SekundÑrluft beendet" UWORD B_TRUE___UW 0 0 0.000000 0.000000 /begin IF_DATA ASAP1B_ETK KP_BLOB 0xFD0A 0 2 /end IF_DATA BIT_MASK 0x2000 /end MEASUREMENT
/begin MEASUREMENT B_slv "Bedingung fÅr SekundÑrluftventil" UWORD B_TRUE___UW 0 0 0.000000 0.000000 /begin IF_DATA ASAP1B_ETK KP_BLOB 0xFD0A 0 2 /end IF_DATA BIT_MASK 0x4000 /end MEASUREMENT
/begin MEASUREMENT B_st "Bedingung Start" UWORD B_TRUE___UW 0 0 0.000000 0.000000 /begin IF_DATA ASAP1B_ETK KP_BLOB 0xFD88 0 2 /end IF_DATA BIT_MASK 0x20 /end MEASUREMENT
/begin MEASUREMENT B_stend "1 = Startende erkannt" UWORD B_TRUE___UW 0 0 0.000000 0.000000 /begin IF_DATA ASAP1B_ETK KP_BLOB 0xFD88 0 2 /end IF_DATA BIT_MASK 0x40 /end MEASUREMENT
/begin MEASUREMENT B_su "Bedingung Saugrohrumschaltung" UWORD B_TRUE___UW 0 0 0.000000 0.000000 /begin IF_DATA ASAP1B_ETK KP_BLOB 0xFD0A 0 2 /end IF_DATA BIT_MASK 0x1 /end MEASUREMENT
/begin MEASUREMENT B_synnldg "Bedingung: Motorposition im Notlauf DG aus PG-Signal erkannt" UWORD B_TRUE___UW 0 0 0.000000 0.000000 /begin IF_DATA ASAP1B_ETK KP_BLOB 0xFD22 0 2 /end IF_DATA BIT_MASK 0x4 /end MEASUREMENT
/begin MEASUREMENT B_tarau "LREB: Bedingung Start bei niedrigen Ansauglufttemperaturen" UWORD B_TRUE___UW 0 0 0.000000 0.000000 /begin IF_DATA ASAP1B_ETK KP_BLOB 0xFD96 0 2 /end IF_DATA BIT_MASK 0x100 /end MEASUREMENT
/begin MEASUREMENT B_tehb "Bedingung TankentlÅftung mit hoher Beladung" UWORD B_TRUE___UW 0 0 0.000000 0.000000 /begin IF_DATA ASAP1B_ETK KP_BLOB 0xFD8A 0 2 /end IF_DATA BIT_MASK 0x1 /end MEASUREMENT
/begin MEASUREMENT B_temin "Bedingung TEMIN-Begrenzung aktiv, Bank 1" UWORD B_TRUE___UW 0 0 0.000000 0.000000 /begin IF_DATA ASAP1B_ETK KP_BLOB 0xFD5C 0 2 /end IF_DATA BIT_MASK 0x100 /end MEASUREMENT
/begin MEASUREMENT B_tfu "Bedingung TemperaturfÅhler Umgebung vorhanden" UWORD B_TRUE___UW 0 0 0.000000 0.000000 /begin IF_DATA ASAP1B_ETK KP_BLOB 0xFD02 0 2 /end IF_DATA BIT_MASK 0x8000 /end MEASUREMENT
/begin MEASUREMENT B_tmlr "LREB: Von Motortemp. abhÑngige Bedingungen Lambdaregelung (vor Kat)" UWORD B_TRUE___UW 0 0 0.000000 0.000000 /begin IF_DATA ASAP1B_ETK KP_BLOB 0xFD96 0 2 /end IF_DATA BIT_MASK 0x200 /end MEASUREMENT
/begin MEASUREMENT B_tnmax "Bit, Timer fÅr Parameterumschaltung abgelaufen" UWORD B_TRUE___UW 0 0 0.000000 0.000000 /begin IF_DATA ASAP1B_ETK KP_BLOB 0xFD82 0 2 /end IF_DATA BIT_MASK 0x4000 /end MEASUREMENT
/begin MEASUREMENT B_ubdve "Bedingung: Batteriespannung fÅr DV-E-Ansteuerung i.O." UWORD B_TRUE___UW 0 0 0.000000 0.000000 /begin IF_DATA ASAP1B_ETK KP_BLOB 0xFD46 0 2 /end IF_DATA BIT_MASK 0x8 /end MEASUREMENT
/begin MEASUREMENT B_uhrrmin "Bedingung Uhr mit relativem MinutenzÑhler" UWORD B_TRUE___UW 0 0 0.000000 0.000000 /begin IF_DATA ASAP1B_ETK KP_BLOB 0xFD04 0 2 /end IF_DATA BIT_MASK 0x1 /end MEASUREMENT
/begin MEASUREMENT B_uhrrsec "Bedingung Uhr mit relativem SekundenzÑhler" UWORD B_TRUE___UW 0 0 0.000000 0.000000 /begin IF_DATA ASAP1B_ETK KP_BLOB 0xFD04 0 2 /end IF_DATA BIT_MASK 0x2 /end MEASUREMENT
/begin MEASUREMENT B_umauab "Bedingung: UMA-Lernen wÑhrend Urinitialisierung abgebrochen (SKA)" UWORD B_TRUE___UW 0 0 0.000000 0.000000 /begin IF_DATA ASAP1B_ETK KP_BLOB 0xFD44 0 2 /end IF_DATA BIT_MASK 0x1 /end MEASUREMENT
/begin MEASUREMENT B_va "Bedingung Verzîgerungsabmagerung (Anzeige)" UWORD B_TRUE___UW 0 0 0.000000 0.000000 /begin IF_DATA ASAP1B_ETK KP_BLOB 0xFD64 0 2 /end IF_DATA BIT_MASK 0x8 /end MEASUREMENT
/begin MEASUREMENT B_vag "Bedingung starke Verzîgerungsabmagerung" UWORD B_TRUE___UW 0 0 0.000000 0.000000 /begin IF_DATA ASAP1B_ETK KP_BLOB 0xFD64 0 2 /end IF_DATA BIT_MASK 0x20 /end MEASUREMENT
/begin MEASUREMENT B_vl "Vollgasbit wird gesetzt, wenn Pedalwert swpd grî·er als Schwelle SW_VG wird." UWORD B_TRUE___UW 0 0 0.000000 0.000000 /begin IF_DATA ASAP1B_ETK KP_BLOB 0xFD80 0 2 /end IF_DATA BIT_MASK 0x4 /end MEASUREMENT
/begin MEASUREMENT B_vllr "Bedingung Fahrzeug rollt mit eingelegtem Gang" UWORD B_TRUE___UW 0 0 0.000000 0.000000 /begin IF_DATA ASAP1B_ETK KP_BLOB 0xFD7C 0 2 /end IF_DATA BIT_MASK 0x40 /end MEASUREMENT
/begin MEASUREMENT B_vnull "Bedingung Fahrzeug steht" UWORD B_TRUE___UW 0 0 0.000000 0.000000 /begin IF_DATA ASAP1B_ETK KP_BLOB 0xFD04 0 2 /end IF_DATA BIT_MASK 0x10 /end MEASUREMENT
/begin MEASUREMENT B_wdksap "DK-Steuerung Åber Festwert, Bit 1 hat PrioritÑt" UWORD B_TRUE___UW 0 0 0.000000 0.000000 /begin IF_DATA ASAP1B_ETK KP_BLOB 0xFD04 0 2 /end IF_DATA BIT_MASK 0x4 /end MEASUREMENT
/begin MEASUREMENT B_wdksive "Bedingung: Fehler im Vergleich DK-Winkel-Sollwert/-Istwert" UWORD B_TRUE___UW 0 0 0.000000 0.000000 /begin IF_DATA ASAP1B_ETK KP_BLOB 0xFD46 0 2 /end IF_DATA BIT_MASK 0x80 /end MEASUREMENT
/begin MEASUREMENT B_zmsoff "Bedingung Motorabstellen wegen ZMS-Resonanz" UWORD B_TRUE___UW 0 0 0.000000 0.000000 /begin IF_DATA ASAP1B_ETK KP_BLOB 0xFDA6 0 2 /end IF_DATA BIT_MASK 0x2000 /end MEASUREMENT
/begin MEASUREMENT B_zwappl "Bedingung ZÅndwinkelapplikation ohne Drehmomenteingriffe" UWORD B_TRUE___UW 0 0 0.000000 0.000000 /begin IF_DATA ASAP1B_ETK KP_BLOB 0xFD04 0 2 /end IF_DATA BIT_MASK 0x8 /end MEASUREMENT
/begin MEASUREMENT B_zwget "ZÅndwinkeleingriff durch Getriebeeingriff" UWORD B_TRUE___UW 0 0 0.000000 0.000000 /begin IF_DATA ASAP1B_ETK KP_BLOB 0xFD82 0 2 /end IF_DATA BIT_MASK 0x100 /end MEASUREMENT
/begin MEASUREMENT B_zwnget "ZÅndwinkeleingriff nicht durch Getriebeeingriff" UWORD B_TRUE___UW 0 0 0.000000 0.000000 /begin IF_DATA ASAP1B_ETK KP_BLOB 0xFD82 0 2 /end IF_DATA BIT_MASK 0x200 /end MEASUREMENT
/begin MEASUREMENT B_zwvs "Bedingung fÅr schnellen Ñu·eren ZW-Eingriff der Momentenschnittstelle" UWORD B_TRUE___UW 0 0 0.000000 0.000000 /begin IF_DATA ASAP1B_ETK KP_BLOB 0xFD82 0 2 /end IF_DATA BIT_MASK 0x400 /end MEASUREMENT
/begin MEASUREMENT B_zwvz "Bedingung fÅr ZÅndwinkeleingriff der Momentenschnittstelle" UWORD B_TRUE___UW 0 0 0.000000 0.000000 /begin IF_DATA ASAP1B_ETK KP_BLOB 0xFD82 0 2 /end IF_DATA BIT_MASK 0x800 /end MEASUREMENT
/begin MEASUREMENT B_zwvzm "" UWORD B_TRUE___UW 0 0 0.000000 0.000000 /begin IF_DATA ASAP1B_ETK KP_BLOB 0xFD9E 0 2 /end IF_DATA BIT_MASK 0x2000 /end MEASUREMENT
/begin MEASUREMENT cd_bits1_w "" UWORD dez___UW 0 0 0.000000 65535.000000 /begin IF_DATA ASAP1B_ETK KP_BLOB 0x380D30 1 2 /end IF_DATA BIT_MASK 0xFFFF /end MEASUREMENT
/begin MEASUREMENT cd_bits2_w "" UWORD dez___UW 0 0 0.000000 65535.000000 /begin IF_DATA ASAP1B_ETK KP_BLOB 0x380D32 1 2 /end IF_DATA BIT_MASK 0xFFFF /end MEASUREMENT
/begin MEASUREMENT cw_erfil "Status Codewort Filtervariante fÅr Ausgabe der AS-Fehler an GST" UBYTE dez 0 0 0.000000 255.000000 /begin IF_DATA ASAP1B_ETK KP_BLOB 0x380980 1 1 /end IF_DATA BIT_MASK 0xFF /end MEASUREMENT
/begin MEASUREMENT cw_obd "Status Codewort CWOBD" UBYTE dez 0 0 0.000000 255.000000 /begin IF_DATA ASAP1B_ETK KP_BLOB 0x380981 1 1 /end IF_DATA BIT_MASK 0xFF /end MEASUREMENT
/begin MEASUREMENT cyclebg_w "" UWORD runtime2_sy 0 0 0.000000 838848.000000 /begin IF_DATA ASAP1B_ETK KP_BLOB 0x38253C 1 2 /end IF_DATA BIT_MASK 0xFFFF /end MEASUREMENT
/begin MEASUREMENT dlahkab_w "Dynamische öberhîhung des Pseudo Lambda-Sollwertes hinter Kat" SWORD fak_sw_b1 0 0 -1.000000 0.999969 /begin IF_DATA ASAP1B_ETK KP_BLOB 0x38284A 1 2 /end IF_DATA BIT_MASK 0xFFFF /end MEASUREMENT
/begin MEASUREMENT dlashki_w "Delta-Lambda gewichtet fÅr I-Anteil LRSHK" SWORD fak_sw_b1 0 0 -1.000000 0.999969 /begin IF_DATA ASAP1B_ETK KP_BLOB 0x38284C 1 2 /end IF_DATA BIT_MASK 0xFFFF /end MEASUREMENT
/begin MEASUREMENT dlashkm_w "Delta-Lambda aus Lambdaregelung hinter Kat (Ist-Wert fr-synchron gemittelt)" SWORD fak_sw_b1 0 0 -1.000000 0.999969 /begin IF_DATA ASAP1B_ETK KP_BLOB 0x38284E 1 2 /end IF_DATA BIT_MASK 0xFFFF /end MEASUREMENT
/begin MEASUREMENT dlashkp_w "Delta-Lambda gewichtet fÅr P-Anteil LRSHK5.30" SWORD fak_sw_b1 0 0 -1.000000 0.999969 /begin IF_DATA ASAP1B_ETK KP_BLOB 0x382850 1 2 /end IF_DATA BIT_MASK 0xFFFF /end MEASUREMENT
/begin MEASUREMENT dlsd_w "DÑmpfung PT2-Filter in LastschlagdÑmpfung" UWORD fak_uw_b2 0 0 0.000000 1.999969 /begin IF_DATA ASAP1B_ETK KP_BLOB 0x382426 1 2 /end IF_DATA BIT_MASK 0xFFFF /end MEASUREMENT
/begin MEASUREMENT dmar_w "Delta Drehmoment antiruckel" SWORD rel_sw_b100 0 0 -100.000000 99.996948 /begin IF_DATA ASAP1B_ETK KP_BLOB 0x3823D8 1 2 /end IF_DATA BIT_MASK 0xFFFF /end MEASUREMENT
/begin MEASUREMENT dmaufr_w "Delta Aufregelmoment" UWORD rel_uw_b100 0 0 0.000000 99.998474 /begin IF_DATA ASAP1B_ETK KP_BLOB 0x3828D6 1 2 /end IF_DATA BIT_MASK 0xFFFF /end MEASUREMENT
/begin MEASUREMENT dmbebl_w "Delta-Moment fÅr Auslîsung LastschlagdÑmpfung" UWORD rel_uw_b100 0 0 0.000000 99.998474 /begin IF_DATA ASAP1B_ETK KP_BLOB 0x382428 1 2 /end IF_DATA BIT_MASK 0xFFFF /end MEASUREMENT
/begin MEASUREMENT dmdpo_w "delta Moment Dashpot-Ausloesung" UWORD rel_uw_b100 0 0 0.000000 99.998474 /begin IF_DATA ASAP1B_ETK KP_BLOB 0x38242A 1 2 /end IF_DATA BIT_MASK 0xFFFF /end MEASUREMENT
/begin MEASUREMENT dmdpu_w "delta Moment Dashpot-Ende" UWORD rel_uw_b100 0 0 0.000000 99.998474 /begin IF_DATA ASAP1B_ETK KP_BLOB 0x38242C 1 2 /end IF_DATA BIT_MASK 0xFFFF /end MEASUREMENT
/begin MEASUREMENT dmdwan_w "" SWORD rel_sw_b100 0 0 -100.000000 99.996948 /begin IF_DATA ASAP1B_ETK KP_BLOB 0x38233A 1 2 /end IF_DATA BIT_MASK 0xFFFF /end MEASUREMENT
/begin MEASUREMENT dmgbeg_w "Delta-Moment fÅr Gradientenbegrenzung" UWORD rel_uw_b100 0 0 0.000000 99.998474 /begin IF_DATA ASAP1B_ETK KP_BLOB 0x38242E 1 2 /end IF_DATA BIT_MASK 0xFFFF /end MEASUREMENT
/begin MEASUREMENT dmllri_w "geforderte DrehmomentÑnderung von der LLR (I-Anteil)" SWORD rel_sw_b100 0 0 -100.000000 99.996948 /begin IF_DATA ASAP1B_ETK KP_BLOB 0x382368 1 2 /end IF_DATA BIT_MASK 0xFFFF /end MEASUREMENT
/begin MEASUREMENT dmllrl_w "geforderte DrehmomentÑnderung von der LLR (Anteil Luftpfad)" SWORD rel_sw_b100 0 0 -100.000000 99.996948 /begin IF_DATA ASAP1B_ETK KP_BLOB 0x38236A 1 2 /end IF_DATA BIT_MASK 0xFFFF /end MEASUREMENT
/begin MEASUREMENT dmllr_w "geforderte DrehmomentÑnderung von der LLR (PD-Anteil)" SWORD rel_sw_b100 0 0 -100.000000 99.996948 /begin IF_DATA ASAP1B_ETK KP_BLOB 0x38236E 1 2 /end IF_DATA BIT_MASK 0xFFFF /end MEASUREMENT
/begin MEASUREMENT dmlsdo_w "Delta Moment Auslîsung LastschlagdÑmpfung" UWORD rel_uw_b100 0 0 0.000000 99.998474 /begin IF_DATA ASAP1B_ETK KP_BLOB 0x382430 1 2 /end IF_DATA BIT_MASK 0xFFFF /end MEASUREMENT
/begin MEASUREMENT dmlsdu_w "Delta Moment Ende LastschlagdÑmpfung" UWORD rel_uw_b100 0 0 0.000000 99.998474 /begin IF_DATA ASAP1B_ETK KP_BLOB 0x382432 1 2 /end IF_DATA BIT_MASK 0xFFFF /end MEASUREMENT
/begin MEASUREMENT dmnmxi_w "Drehmoment-I-Anteil bei NMAX-Regelung" SWORD rel_sw_b100 0 0 -100.000000 99.996948 /begin IF_DATA ASAP1B_ETK KP_BLOB 0x3824B0 1 2 /end IF_DATA BIT_MASK 0xFFFF /end MEASUREMENT
/begin MEASUREMENT dmnmxp_w "Drehmoment-P-Anteil bei NMAX-Regelung" SWORD rel_sw_b100 0 0 -100.000000 99.996948 /begin IF_DATA ASAP1B_ETK KP_BLOB 0x3824B2 1 2 /end IF_DATA BIT_MASK 0xFFFF /end MEASUREMENT
/begin MEASUREMENT dmrac "Reservemoment fÅr AC-Kompressor" UBYTE rel_ub_b99p6 0 0 0.000000 99.609375 /begin IF_DATA ASAP1B_ETK KP_BLOB 0x380C2E 1 1 /end IF_DATA BIT_MASK 0xFF /end MEASUREMENT
/begin MEASUREMENT dmrdagr_w "Momentenreserve fÅr Diagnose AGR" UWORD rel_uw_b100 0 0 0.000000 99.998474 /begin IF_DATA ASAP1B_ETK KP_BLOB 0x380EB6 1 2 /end IF_DATA BIT_MASK 0xFFFF /end MEASUREMENT
/begin MEASUREMENT dmrdkt_w "Momenten-Reserve fÅr Katalysatordiagnose" UWORD rel_uw_b100 0 0 0.000000 99.998474 /begin IF_DATA ASAP1B_ETK KP_BLOB 0x381C06 1 2 /end IF_DATA BIT_MASK 0xFFFF /end MEASUREMENT
/begin MEASUREMENT dmrdsls_w "Momentenreserve fÅr Diagnose SekundÑrluft" UWORD rel_uw_b100 0 0 0.000000 99.998474 /begin IF_DATA ASAP1B_ETK KP_BLOB 0x38212E 1 2 /end IF_DATA BIT_MASK 0xFFFF /end MEASUREMENT
/begin MEASUREMENT dmrkh "Momenten-Reserve fÅr Katheizen" UBYTE rel_ub_b99p6 0 0 0.000000 99.609375 /begin IF_DATA ASAP1B_ETK KP_BLOB 0x380B6B 1 1 /end IF_DATA BIT_MASK 0xFF /end MEASUREMENT
/begin MEASUREMENT dmrkt_w "Momentenreserve im Kurztrip" UWORD rel_uw_b100 0 0 0.000000 99.998474 /begin IF_DATA ASAP1B_ETK KP_BLOB 0x3824FC 1 2 /end IF_DATA BIT_MASK 0xFFFF /end MEASUREMENT
/begin MEASUREMENT dmrlash_w "Momenten-Reserve fÅr Lambdasonden-AlterungsÅberwachung hinter Kat" UWORD rel_uw_b100 0 0 0.000000 99.998474 /begin IF_DATA ASAP1B_ETK KP_BLOB 0x381B82 1 2 /end IF_DATA BIT_MASK 0xFFFF /end MEASUREMENT
/begin MEASUREMENT dmrllr_w "Momenten-Reserve fÅr Leerlaufregelung" UWORD rel_uw_b100 0 0 0.000000 99.998474 /begin IF_DATA ASAP1B_ETK KP_BLOB 0x382360 1 2 /end IF_DATA BIT_MASK 0xFFFF /end MEASUREMENT
/begin MEASUREMENT dmrlsh_w "Momenten-Reserve fÅr Sondendiagnose hinter Kat" UWORD rel_uw_b100 0 0 0.000000 99.998474 /begin IF_DATA ASAP1B_ETK KP_BLOB 0x381B2E 1 2 /end IF_DATA BIT_MASK 0xFFFF /end MEASUREMENT
/begin MEASUREMENT dmrlsv_w "Momenten-Reserve fÅr Sondendiagnose vor Kat" UWORD rel_uw_b100 0 0 0.000000 99.998474 /begin IF_DATA ASAP1B_ETK KP_BLOB 0x380EB8 1 2 /end IF_DATA BIT_MASK 0xFFFF /end MEASUREMENT
/begin MEASUREMENT dmrwan "Momentreserve fÅr Drehmomentaufnahme des Wandlers" UBYTE rel_ub_b99p6 0 0 0.000000 99.609375 /begin IF_DATA ASAP1B_ETK KP_BLOB 0x380C25 1 1 /end IF_DATA BIT_MASK 0xFF /end MEASUREMENT
/begin MEASUREMENT dmvadfk_w "Delta-Motordrehmoment aus Verlustmoment-Adaption (B_fs=1 & B_ko=1)" SWORD rel_sw_b100 0 0 -100.000000 99.996948 /begin IF_DATA ASAP1B_ETK KP_BLOB 0x383CB6 1 2 /end IF_DATA BIT_MASK 0xFFFF /end MEASUREMENT
/begin MEASUREMENT dmvadfs_w "Delta-Motordrehmoment aus Verlustmoment-Adaption (B_fs=1)" SWORD rel_sw_b100 0 0 -100.000000 99.996948 /begin IF_DATA ASAP1B_ETK KP_BLOB 0x383CB8 1 2 /end IF_DATA BIT_MASK 0xFFFF /end MEASUREMENT
/begin MEASUREMENT dmvadko_w "Delta-Motordrehmoment aus Verlustmoment-Adaption (B_ko=1)" SWORD rel_sw_b100 0 0 -100.000000 99.996948 /begin IF_DATA ASAP1B_ETK KP_BLOB 0x383CBA 1 2 /end IF_DATA BIT_MASK 0xFFFF /end MEASUREMENT
/begin MEASUREMENT dmvadll_w "Delta-Motordrehmoment aus Verlustmoment-Adaption (B_ll=1)" SWORD rel_sw_b100 0 0 -100.000000 99.996948 /begin IF_DATA ASAP1B_ETK KP_BLOB 0x383CBC 1 2 /end IF_DATA BIT_MASK 0xFFFF /end MEASUREMENT
/begin MEASUREMENT dmvad_w "Delta-Motordrehmoment aus Verlustmoment-Adaption" SWORD rel_sw_b100 0 0 -100.000000 99.996948 /begin IF_DATA ASAP1B_ETK KP_BLOB 0x382326 1 2 /end IF_DATA BIT_MASK 0xFFFF /end MEASUREMENT
/begin MEASUREMENT dmvamnfk_w "Minimalbegrenzung der Verlustmomentadaption (B_fs=1 & B_ko=1)" SWORD rel_sw_b100 0 0 -100.000000 99.996948 /begin IF_DATA ASAP1B_ETK KP_BLOB 0x382328 1 2 /end IF_DATA BIT_MASK 0xFFFF /end MEASUREMENT
/begin MEASUREMENT dmvamnfs_w "Minimalbegrenzung der Verlustmomentadaption (B_fs=1)" SWORD rel_sw_b100 0 0 -100.000000 99.996948 /begin IF_DATA ASAP1B_ETK KP_BLOB 0x38232A 1 2 /end IF_DATA BIT_MASK 0xFFFF /end MEASUREMENT
/begin MEASUREMENT dmvamnko_w "Minimalbegrenzung der Verlustmomentadaption (B_ko=1)" SWORD rel_sw_b100 0 0 -100.000000 99.996948 /begin IF_DATA ASAP1B_ETK KP_BLOB 0x38232C 1 2 /end IF_DATA BIT_MASK 0xFFFF /end MEASUREMENT
/begin MEASUREMENT dmvamnll_w "Minimalbegrenzung der Verlustmomentadaption (B_ll=1)" SWORD rel_sw_b100 0 0 -100.000000 99.996948 /begin IF_DATA ASAP1B_ETK KP_BLOB 0x38232E 1 2 /end IF_DATA BIT_MASK 0xFFFF /end MEASUREMENT
/begin MEASUREMENT dmvamxfk_w "0aximalbegrenzung der Verlustmomentadaption (B_fs=1 & B_ko=1)" SWORD rel_sw_b100 0 0 -100.000000 99.996948 /begin IF_DATA ASAP1B_ETK KP_BLOB 0x382330 1 2 /end IF_DATA BIT_MASK 0xFFFF /end MEASUREMENT
/begin MEASUREMENT dmvamxfs_w "Maximalbegrenzung der Verlustmomentadaption (B_fs=1)" SWORD rel_sw_b100 0 0 -100.000000 99.996948 /begin IF_DATA ASAP1B_ETK KP_BLOB 0x382332 1 2 /end IF_DATA BIT_MASK 0xFFFF /end MEASUREMENT
/begin MEASUREMENT dmvamxko_w "Maximalbegrenzung der Verlustmomentadaption (B_ko=1)" SWORD rel_sw_b100 0 0 -100.000000 99.996948 /begin IF_DATA ASAP1B_ETK KP_BLOB 0x382334 1 2 /end IF_DATA BIT_MASK 0xFFFF /end MEASUREMENT
/begin MEASUREMENT dmvamxll_w "Maximalbegrenzung der Verlustmomentadaption (B_ll=1)" SWORD rel_sw_b100 0 0 -100.000000 99.996948 /begin IF_DATA ASAP1B_ETK KP_BLOB 0x382336 1 2 /end IF_DATA BIT_MASK 0xFFFF /end MEASUREMENT
/begin MEASUREMENT dmverl_w "Verlustmoment nach DT1-Filter" SWORD rel_sw_b100 0 0 -100.000000 99.996948 /begin IF_DATA ASAP1B_ETK KP_BLOB 0x3823B6 1 2 /end IF_DATA BIT_MASK 0xFFFF /end MEASUREMENT
/begin MEASUREMENT dmzms_w "Abstand des indizierten Sollmoments vom zulÑssigen Sollmoment" SWORD rel_sw_b100 0 0 -100.000000 99.996948 /begin IF_DATA ASAP1B_ETK KP_BLOB 0x382478 1 2 /end IF_DATA BIT_MASK 0xFFFF /end MEASUREMENT
/begin MEASUREMENT dnsi_w "Differenz zwischen Soll- und Ist-Motordrehzahl" SWORD nmot_sw_q0p25 0 0 -8192.000000 8191.750000 /begin IF_DATA ASAP1B_ETK KP_BLOB 0x3824B4 1 2 /end IF_DATA BIT_MASK 0xFFFF /end MEASUREMENT
/begin MEASUREMENT dnturb "Turbinendrehzahldifferenz des Wandlers" SBYTE nmot_q10 0 0 -1280.000000 1270.000000 /begin IF_DATA ASAP1B_ETK KP_BLOB 0x380C26 1 1 /end IF_DATA BIT_MASK 0xFF /end MEASUREMENT
/begin MEASUREMENT drlsolf_w "gefilterte énderung SollfÅllung" SWORD rel_sw_q0p0234 0 0 -768.000000 767.976562 /begin IF_DATA ASAP1B_ETK KP_BLOB 0x381F46 1 2 /end IF_DATA BIT_MASK 0xFFFF /end MEASUREMENT
/begin MEASUREMENT drlsol_w "énderung SollfÅllung" SWORD rel_sw_q0p0234 0 0 -768.000000 767.976562 /begin IF_DATA ASAP1B_ETK KP_BLOB 0x381F48 1 2 /end IF_DATA BIT_MASK 0xFFFF /end MEASUREMENT
/begin MEASUREMENT dtvka "Delta-tv fÅr Katalysator-AusrÑumen" SBYTE t100msxs_sb_q0p01 0 0 -1.280000 1.270000 /begin IF_DATA ASAP1B_ETK KP_BLOB 0x380CE1 1 1 /end IF_DATA BIT_MASK 0xFF /end MEASUREMENT
/begin MEASUREMENT dtvkai "Delta-tv fÅr Katalysator-AusrÑumen, lokale Verwendung" SBYTE t100msxs_sb_q0p01 0 0 -1.280000 1.270000 /begin IF_DATA ASAP1B_ETK KP_BLOB 0x380CE2 1 1 /end IF_DATA BIT_MASK 0xFF /end MEASUREMENT
/begin MEASUREMENT dzwb "Differenz BasisZW optimaler ZÅndwinkel" SBYTE zw_sb_q0p75 0 0 -96.000000 95.250000 /begin IF_DATA ASAP1B_ETK KP_BLOB 0x380C3E 1 1 /end IF_DATA BIT_MASK 0xFF /end MEASUREMENT
/begin MEASUREMENT dzwi "Delta ZÅndwinkel zwischen zwopt und zwout" SBYTE zw_sb_q0p75 0 0 -96.000000 95.250000 /begin IF_DATA ASAP1B_ETK KP_BLOB 0x380C49 1 1 /end IF_DATA BIT_MASK 0xFF /end MEASUREMENT
/begin MEASUREMENT dzwnwsu "" SBYTE zw_sb_q0p75 0 0 -96.000000 95.250000 /begin IF_DATA ASAP1B_ETK KP_BLOB 0x380D1D 1 1 /end IF_DATA BIT_MASK 0xFF /end MEASUREMENT
/begin MEASUREMENT dzwoag "abgasrÅckfÅhrratenabh. ZÅndwinkelkorrektur des optimalen ZW" SBYTE zw_sb_q0p75 0 0 -96.000000 95.250000 /begin IF_DATA ASAP1B_ETK KP_BLOB 0x380C3F 1 1 /end IF_DATA BIT_MASK 0xFF /end MEASUREMENT
/begin MEASUREMENT dzwol "lambdaabh. ZÅndwinkelkorrektur des optimalen ZW" SBYTE zw_sb_q0p75 0 0 -96.000000 95.250000 /begin IF_DATA ASAP1B_ETK KP_BLOB 0x380C40 1 1 /end IF_DATA BIT_MASK 0xFF /end MEASUREMENT
/begin MEASUREMENT dzwotm "temperaturabhÑngige ZÅndwinkelkorrektur des optimalen ZW" SBYTE zw_sb_q0p75 0 0 -96.000000 95.250000 /begin IF_DATA ASAP1B_ETK KP_BLOB 0x380C41 1 1 /end IF_DATA BIT_MASK 0xFF /end MEASUREMENT
/begin MEASUREMENT dzws "Delta ZÅndwinekl zwischen zwopt und zwsol" SBYTE zw_sb_q0p75 0 0 -96.000000 95.250000 /begin IF_DATA ASAP1B_ETK KP_BLOB 0x380D14 1 1 /end IF_DATA BIT_MASK 0xFF /end MEASUREMENT
/begin MEASUREMENT esst_fho04esub "" UWORD dez___UW 0 0 0.000000 65535.000000 /begin IF_DATA ASAP1B_ETK KP_BLOB 0x380E5C 1 2 /end IF_DATA BIT_MASK 0xFFFF /end MEASUREMENT
/begin MEASUREMENT esst_san12esuw "" UWORD dez___UW 0 0 0.000000 65535.000000 /begin IF_DATA ASAP1B_ETK KP_BLOB 0x380E5E 1 2 /end IF_DATA BIT_MASK 0xFFFF /end MEASUREMENT
/begin MEASUREMENT esst_sdk10teub "" UWORD dez___UW 0 0 0.000000 65535.000000 /begin IF_DATA ASAP1B_ETK KP_BLOB 0x380E08 1 2 /end IF_DATA BIT_MASK 0xFFFF /end MEASUREMENT
/begin MEASUREMENT esst_sez06tmub "" UWORD dez___UW 0 0 0.000000 65535.000000 /begin IF_DATA ASAP1B_ETK KP_BLOB 0x380E0A 1 2 /end IF_DATA BIT_MASK 0xFFFF /end MEASUREMENT
/begin MEASUREMENT esst_sfr05teub "" UWORD dez___UW 0 0 0.000000 65535.000000 /begin IF_DATA ASAP1B_ETK KP_BLOB 0x380E0C 1 2 /end IF_DATA BIT_MASK 0xFFFF /end MEASUREMENT
/begin MEASUREMENT esst_sga06mdub "" UWORD dez___UW 0 0 0.000000 65535.000000 /begin IF_DATA ASAP1B_ETK KP_BLOB 0x380E0E 1 2 /end IF_DATA BIT_MASK 0xFFFF /end MEASUREMENT
/begin MEASUREMENT esst_sga08mdub "" UWORD dez___UW 0 0 0.000000 65535.000000 /begin IF_DATA ASAP1B_ETK KP_BLOB 0x380E60 1 2 /end IF_DATA BIT_MASK 0xFFFF /end MEASUREMENT
/begin MEASUREMENT esst_sks06esub "" UWORD dez___UW 0 0 0.000000 65535.000000 /begin IF_DATA ASAP1B_ETK KP_BLOB 0x380E62 1 2 /end IF_DATA BIT_MASK 0xFFFF /end MEASUREMENT
/begin MEASUREMENT esst_sld04ldub "" UWORD dez___UW 0 0 0.000000 65535.000000 /begin IF_DATA ASAP1B_ETK KP_BLOB 0x380E64 1 2 /end IF_DATA BIT_MASK 0xFFFF /end MEASUREMENT
/begin MEASUREMENT esst_slx06tmuw "" UWORD dez___UW 0 0 0.000000 65535.000000 /begin IF_DATA ASAP1B_ETK KP_BLOB 0x380E10 1 2 /end IF_DATA BIT_MASK 0xFFFF /end MEASUREMENT
/begin MEASUREMENT esst_smi04llub "" UWORD dez___UW 0 0 0.000000 65535.000000 /begin IF_DATA ASAP1B_ETK KP_BLOB 0x380E66 1 2 /end IF_DATA BIT_MASK 0xFFFF /end MEASUREMENT
/begin MEASUREMENT esst_sml05dkub "" UWORD dez___UW 0 0 0.000000 65535.000000 /begin IF_DATA ASAP1B_ETK KP_BLOB 0x380E12 1 2 /end IF_DATA BIT_MASK 0xFFFF /end MEASUREMENT
/begin MEASUREMENT esst_sml05lkub "" UWORD dez___UW 0 0 0.000000 65535.000000 /begin IF_DATA ASAP1B_ETK KP_BLOB 0x380E14 1 2 /end IF_DATA BIT_MASK 0xFFFF /end MEASUREMENT
/begin MEASUREMENT esst_sml06teub "" UWORD dez___UW 0 0 0.000000 65535.000000 /begin IF_DATA ASAP1B_ETK KP_BLOB 0x380E16 1 2 /end IF_DATA BIT_MASK 0xFFFF /end MEASUREMENT
/begin MEASUREMENT esst_sml06tmub "" UWORD dez___UW 0 0 0.000000 65535.000000 /begin IF_DATA ASAP1B_ETK KP_BLOB 0x380E18 1 2 /end IF_DATA BIT_MASK 0xFFFF /end MEASUREMENT
/begin MEASUREMENT esst_sml07tmuw "" UWORD dez___UW 0 0 0.000000 65535.000000 /begin IF_DATA ASAP1B_ETK KP_BLOB 0x380E1A 1 2 /end IF_DATA BIT_MASK 0xFFFF /end MEASUREMENT
/begin MEASUREMENT esst_sml08lhub "" UWORD dez___UW 0 0 0.000000 65535.000000 /begin IF_DATA ASAP1B_ETK KP_BLOB 0x380E1C 1 2 /end IF_DATA BIT_MASK 0xFFFF /end MEASUREMENT
/begin MEASUREMENT esst_smo08opub "" UWORD dez___UW 0 0 0.000000 65535.000000 /begin IF_DATA ASAP1B_ETK KP_BLOB 0x3824D6 1 2 /end IF_DATA BIT_MASK 0xFFFF /end MEASUREMENT
/begin MEASUREMENT esst_sng06llsb "" UWORD dez___UW 0 0 0.000000 65535.000000 /begin IF_DATA ASAP1B_ETK KP_BLOB 0x380E68 1 2 /end IF_DATA BIT_MASK 0xFFFF /end MEASUREMENT
/begin MEASUREMENT esst_snm05dkub "" UWORD dez___UW 0 0 0.000000 65535.000000 /begin IF_DATA ASAP1B_ETK KP_BLOB 0x380E1E 1 2 /end IF_DATA BIT_MASK 0xFFFF /end MEASUREMENT
/begin MEASUREMENT esst_snm06lhub "" UWORD dez___UW 0 0 0.000000 65535.000000 /begin IF_DATA ASAP1B_ETK KP_BLOB 0x380E20 1 2 /end IF_DATA BIT_MASK 0xFFFF /end MEASUREMENT
/begin MEASUREMENT esst_snm06llub "" UWORD dez___UW 0 0 0.000000 65535.000000 /begin IF_DATA ASAP1B_ETK KP_BLOB 0x380E6A 1 2 /end IF_DATA BIT_MASK 0xFFFF /end MEASUREMENT
/begin MEASUREMENT esst_snm06mduw "" UWORD dez___UW 0 0 0.000000 65535.000000 /begin IF_DATA ASAP1B_ETK KP_BLOB 0x380E22 1 2 /end IF_DATA BIT_MASK 0xFFFF /end MEASUREMENT
/begin MEASUREMENT esst_snm07esub "" UWORD dez___UW 0 0 0.000000 65535.000000 /begin IF_DATA ASAP1B_ETK KP_BLOB 0x380E24 1 2 /end IF_DATA BIT_MASK 0xFFFF /end MEASUREMENT
/begin MEASUREMENT esst_snm07lrub "" UWORD dez___UW 0 0 0.000000 65535.000000 /begin IF_DATA ASAP1B_ETK KP_BLOB 0x380E26 1 2 /end IF_DATA BIT_MASK 0xFFFF /end MEASUREMENT
/begin MEASUREMENT esst_snm08dmub "" UWORD dez___UW 0 0 0.000000 65535.000000 /begin IF_DATA ASAP1B_ETK KP_BLOB 0x380E6C 1 2 /end IF_DATA BIT_MASK 0xFFFF /end MEASUREMENT
/begin MEASUREMENT esst_snm08feub "" UWORD dez___UW 0 0 0.000000 65535.000000 /begin IF_DATA ASAP1B_ETK KP_BLOB 0x380E28 1 2 /end IF_DATA BIT_MASK 0xFFFF /end MEASUREMENT
/begin MEASUREMENT esst_snm08ldub "" UWORD dez___UW 0 0 0.000000 65535.000000 /begin IF_DATA ASAP1B_ETK KP_BLOB 0x380E6E 1 2 /end IF_DATA BIT_MASK 0xFFFF /end MEASUREMENT
/begin MEASUREMENT esst_snm08lduw "" UWORD dez___UW 0 0 0.000000 65535.000000 /begin IF_DATA ASAP1B_ETK KP_BLOB 0x380E70 1 2 /end IF_DATA BIT_MASK 0xFFFF /end MEASUREMENT
/begin MEASUREMENT esst_snm08lhub "" UWORD dez___UW 0 0 0.000000 65535.000000 /begin IF_DATA ASAP1B_ETK KP_BLOB 0x380E2A 1 2 /end IF_DATA BIT_MASK 0xFFFF /end MEASUREMENT
/begin MEASUREMENT esst_snm08opub "" UWORD dez___UW 0 0 0.000000 65535.000000 /begin IF_DATA ASAP1B_ETK KP_BLOB 0x380E72 1 2 /end IF_DATA BIT_MASK 0xFFFF /end MEASUREMENT
/begin MEASUREMENT esst_snm08__ub "" UWORD dez___UW 0 0 0.000000 65535.000000 /begin IF_DATA ASAP1B_ETK KP_BLOB 0x380E2C 1 2 /end IF_DATA BIT_MASK 0xFFFF /end MEASUREMENT
/begin MEASUREMENT esst_snm10teub "" UWORD dez___UW 0 0 0.000000 65535.000000 /begin IF_DATA ASAP1B_ETK KP_BLOB 0x380E2E 1 2 /end IF_DATA BIT_MASK 0xFFFF /end MEASUREMENT
/begin MEASUREMENT esst_snm12esub "" UWORD dez___UW 0 0 0.000000 65535.000000 /begin IF_DATA ASAP1B_ETK KP_BLOB 0x380E74 1 2 /end IF_DATA BIT_MASK 0xFFFF /end MEASUREMENT
/begin MEASUREMENT esst_snm12feub "" UWORD dez___UW 0 0 0.000000 65535.000000 /begin IF_DATA ASAP1B_ETK KP_BLOB 0x380E76 1 2 /end IF_DATA BIT_MASK 0xFFFF /end MEASUREMENT
/begin MEASUREMENT esst_snm12lduw "" UWORD dez___UW 0 0 0.000000 65535.000000 /begin IF_DATA ASAP1B_ETK KP_BLOB 0x380E78 1 2 /end IF_DATA BIT_MASK 0xFFFF /end MEASUREMENT
/begin MEASUREMENT esst_snm16ciub "" UWORD dez___UW 0 0 0.000000 65535.000000 /begin IF_DATA ASAP1B_ETK KP_BLOB 0x380E30 1 2 /end IF_DATA BIT_MASK 0xFFFF /end MEASUREMENT
/begin MEASUREMENT esst_snm16gkub "" UWORD dez___UW 0 0 0.000000 65535.000000 /begin IF_DATA ASAP1B_ETK KP_BLOB 0x380E32 1 2 /end IF_DATA BIT_MASK 0xFFFF /end MEASUREMENT
/begin MEASUREMENT esst_snm16krdyub "" UWORD dez___UW 0 0 0.000000 65535.000000 /begin IF_DATA ASAP1B_ETK KP_BLOB 0x380E34 1 2 /end IF_DATA BIT_MASK 0xFFFF /end MEASUREMENT
/begin MEASUREMENT esst_snm16krub "" UWORD dez___UW 0 0 0.000000 65535.000000 /begin IF_DATA ASAP1B_ETK KP_BLOB 0x380E36 1 2 /end IF_DATA BIT_MASK 0xFFFF /end MEASUREMENT
/begin MEASUREMENT esst_snm16ldub "" UWORD dez___UW 0 0 0.000000 65535.000000 /begin IF_DATA ASAP1B_ETK KP_BLOB 0x380E7A 1 2 /end IF_DATA BIT_MASK 0xFFFF /end MEASUREMENT
/begin MEASUREMENT esst_snm16lduw "" UWORD dez___UW 0 0 0.000000 65535.000000 /begin IF_DATA ASAP1B_ETK KP_BLOB 0x380E7C 1 2 /end IF_DATA BIT_MASK 0xFFFF /end MEASUREMENT
/begin MEASUREMENT esst_snm16opuw "" UWORD dez___UW 0 0 0.000000 65535.000000 /begin IF_DATA ASAP1B_ETK KP_BLOB 0x380E7E 1 2 /end IF_DATA BIT_MASK 0xFFFF /end MEASUREMENT
/begin MEASUREMENT esst_snm16zuub "" UWORD dez___UW 0 0 0.000000 65535.000000 /begin IF_DATA ASAP1B_ETK KP_BLOB 0x380E80 1 2 /end IF_DATA BIT_MASK 0xFFFF /end MEASUREMENT
/begin MEASUREMENT esst_spl08lduw "" UWORD dez___UW 0 0 0.000000 65535.000000 /begin IF_DATA ASAP1B_ETK KP_BLOB 0x380E82 1 2 /end IF_DATA BIT_MASK 0xFFFF /end MEASUREMENT
/begin MEASUREMENT esst_spu08ldub "" UWORD dez___UW 0 0 0.000000 65535.000000 /begin IF_DATA ASAP1B_ETK KP_BLOB 0x380E84 1 2 /end IF_DATA BIT_MASK 0xFFFF /end MEASUREMENT
/begin MEASUREMENT esst_sqm05teub "" UWORD dez___UW 0 0 0.000000 65535.000000 /begin IF_DATA ASAP1B_ETK KP_BLOB 0x380E86 1 2 /end IF_DATA BIT_MASK 0xFFFF /end MEASUREMENT
/begin MEASUREMENT esst_srl03krub "" UWORD dez___UW 0 0 0.000000 65535.000000 /begin IF_DATA ASAP1B_ETK KP_BLOB 0x380E38 1 2 /end IF_DATA BIT_MASK 0xFFFF /end MEASUREMENT
/begin MEASUREMENT esst_srl04krub "" UWORD dez___UW 0 0 0.000000 65535.000000 /begin IF_DATA ASAP1B_ETK KP_BLOB 0x380E3A 1 2 /end IF_DATA BIT_MASK 0xFFFF /end MEASUREMENT
/begin MEASUREMENT esst_srl06esub "" UWORD dez___UW 0 0 0.000000 65535.000000 /begin IF_DATA ASAP1B_ETK KP_BLOB 0x380E88 1 2 /end IF_DATA BIT_MASK 0xFFFF /end MEASUREMENT
/begin MEASUREMENT esst_srl06krub "" UWORD dez___UW 0 0 0.000000 65535.000000 /begin IF_DATA ASAP1B_ETK KP_BLOB 0x380E3C 1 2 /end IF_DATA BIT_MASK 0xFFFF /end MEASUREMENT
/begin MEASUREMENT esst_srl06lhub "" UWORD dez___UW 0 0 0.000000 65535.000000 /begin IF_DATA ASAP1B_ETK KP_BLOB 0x380E3E 1 2 /end IF_DATA BIT_MASK 0xFFFF /end MEASUREMENT
/begin MEASUREMENT esst_srl06lrub "" UWORD dez___UW 0 0 0.000000 65535.000000 /begin IF_DATA ASAP1B_ETK KP_BLOB 0x380E40 1 2 /end IF_DATA BIT_MASK 0xFFFF /end MEASUREMENT
/begin MEASUREMENT esst_srl08dmub "" UWORD dez___UW 0 0 0.000000 65535.000000 /begin IF_DATA ASAP1B_ETK KP_BLOB 0x380E8A 1 2 /end IF_DATA BIT_MASK 0xFFFF /end MEASUREMENT
/begin MEASUREMENT esst_srl08nxub "" UWORD dez___UW 0 0 0.000000 65535.000000 /begin IF_DATA ASAP1B_ETK KP_BLOB 0x380E42 1 2 /end IF_DATA BIT_MASK 0xFFFF /end MEASUREMENT
/begin MEASUREMENT esst_srl11opuw "" UWORD dez___UW 0 0 0.000000 65535.000000 /begin IF_DATA ASAP1B_ETK KP_BLOB 0x382492 1 2 /end IF_DATA BIT_MASK 0xFFFF /end MEASUREMENT
/begin MEASUREMENT esst_srl12esub "" UWORD dez___UW 0 0 0.000000 65535.000000 /begin IF_DATA ASAP1B_ETK KP_BLOB 0x380E8C 1 2 /end IF_DATA BIT_MASK 0xFFFF /end MEASUREMENT
/begin MEASUREMENT esst_srl12gkub "" UWORD dez___UW 0 0 0.000000 65535.000000 /begin IF_DATA ASAP1B_ETK KP_BLOB 0x380E44 1 2 /end IF_DATA BIT_MASK 0xFFFF /end MEASUREMENT
/begin MEASUREMENT esst_srl12zuub "" UWORD dez___UW 0 0 0.000000 65535.000000 /begin IF_DATA ASAP1B_ETK KP_BLOB 0x380E8E 1 2 /end IF_DATA BIT_MASK 0xFFFF /end MEASUREMENT
/begin MEASUREMENT esst_st107tmub "" UWORD dez___UW 0 0 0.000000 65535.000000 /begin IF_DATA ASAP1B_ETK KP_BLOB 0x380E46 1 2 /end IF_DATA BIT_MASK 0xFFFF /end MEASUREMENT
/begin MEASUREMENT esst_st307tmub "" UWORD dez___UW 0 0 0.000000 65535.000000 /begin IF_DATA ASAP1B_ETK KP_BLOB 0x380E48 1 2 /end IF_DATA BIT_MASK 0xFFFF /end MEASUREMENT
/begin MEASUREMENT esst_sta04llub "" UWORD dez___UW 0 0 0.000000 65535.000000 /begin IF_DATA ASAP1B_ETK KP_BLOB 0x380E90 1 2 /end IF_DATA BIT_MASK 0xFFFF /end MEASUREMENT
/begin MEASUREMENT esst_sta06esub "" UWORD dez___UW 0 0 0.000000 65535.000000 /begin IF_DATA ASAP1B_ETK KP_BLOB 0x380E4A 1 2 /end IF_DATA BIT_MASK 0xFFFF /end MEASUREMENT
/begin MEASUREMENT esst_sta08ldub "" UWORD dez___UW 0 0 0.000000 65535.000000 /begin IF_DATA ASAP1B_ETK KP_BLOB 0x380E92 1 2 /end IF_DATA BIT_MASK 0xFFFF /end MEASUREMENT
/begin MEASUREMENT esst_sta12esub "" UWORD dez___UW 0 0 0.000000 65535.000000 /begin IF_DATA ASAP1B_ETK KP_BLOB 0x380E94 1 2 /end IF_DATA BIT_MASK 0xFFFF /end MEASUREMENT
/begin MEASUREMENT esst_sta12wlub "" UWORD dez___UW 0 0 0.000000 65535.000000 /begin IF_DATA ASAP1B_ETK KP_BLOB 0x380E96 1 2 /end IF_DATA BIT_MASK 0xFFFF /end MEASUREMENT
/begin MEASUREMENT esst_stm04feub "" UWORD dez___UW 0 0 0.000000 65535.000000 /begin IF_DATA ASAP1B_ETK KP_BLOB 0x380E98 1 2 /end IF_DATA BIT_MASK 0xFFFF /end MEASUREMENT
/begin MEASUREMENT esst_stm04saub "" UWORD dez___UW 0 0 0.000000 65535.000000 /begin IF_DATA ASAP1B_ETK KP_BLOB 0x380E9A 1 2 /end IF_DATA BIT_MASK 0xFFFF /end MEASUREMENT
/begin MEASUREMENT esst_stm04__ub "" UWORD dez___UW 0 0 0.000000 65535.000000 /begin IF_DATA ASAP1B_ETK KP_BLOB 0x380E4C 1 2 /end IF_DATA BIT_MASK 0xFFFF /end MEASUREMENT
/begin MEASUREMENT esst_stm05saub "" UWORD dez___UW 0 0 0.000000 65535.000000 /begin IF_DATA ASAP1B_ETK KP_BLOB 0x380E4E 1 2 /end IF_DATA BIT_MASK 0xFFFF /end MEASUREMENT
/begin MEASUREMENT esst_stm05tmub "" UWORD dez___UW 0 0 0.000000 65535.000000 /begin IF_DATA ASAP1B_ETK KP_BLOB 0x380E50 1 2 /end IF_DATA BIT_MASK 0xFFFF /end MEASUREMENT
/begin MEASUREMENT esst_stm06llub "" UWORD dez___UW 0 0 0.000000 65535.000000 /begin IF_DATA ASAP1B_ETK KP_BLOB 0x380E52 1 2 /end IF_DATA BIT_MASK 0xFFFF /end MEASUREMENT
/begin MEASUREMENT esst_stm06__ub "" UWORD dez___UW 0 0 0.000000 65535.000000 /begin IF_DATA ASAP1B_ETK KP_BLOB 0x380E54 1 2 /end IF_DATA BIT_MASK 0xFFFF /end MEASUREMENT
/begin MEASUREMENT esst_stm08dmub "" UWORD dez___UW 0 0 0.000000 65535.000000 /begin IF_DATA ASAP1B_ETK KP_BLOB 0x380E9C 1 2 /end IF_DATA BIT_MASK 0xFFFF /end MEASUREMENT
/begin MEASUREMENT esst_stm08leub "" UWORD dez___UW 0 0 0.000000 65535.000000 /begin IF_DATA ASAP1B_ETK KP_BLOB 0x380E56 1 2 /end IF_DATA BIT_MASK 0xFFFF /end MEASUREMENT
/begin MEASUREMENT esst_stm08mdub "" UWORD dez___UW 0 0 0.000000 65535.000000 /begin IF_DATA ASAP1B_ETK KP_BLOB 0x380E58 1 2 /end IF_DATA BIT_MASK 0xFFFF /end MEASUREMENT
/begin MEASUREMENT esst_stm08opub "" UWORD dez___UW 0 0 0.000000 65535.000000 /begin IF_DATA ASAP1B_ETK KP_BLOB 0x380E9E 1 2 /end IF_DATA BIT_MASK 0xFFFF /end MEASUREMENT
/begin MEASUREMENT esst_stm09esub "" UWORD dez___UW 0 0 0.000000 65535.000000 /begin IF_DATA ASAP1B_ETK KP_BLOB 0x380E5A 1 2 /end IF_DATA BIT_MASK 0xFFFF /end MEASUREMENT
/begin MEASUREMENT esst_stm12esub "" UWORD dez___UW 0 0 0.000000 65535.000000 /begin IF_DATA ASAP1B_ETK KP_BLOB 0x380EA0 1 2 /end IF_DATA BIT_MASK 0xFFFF /end MEASUREMENT
/begin MEASUREMENT esst_sts12esub "" UWORD dez___UW 0 0 0.000000 65535.000000 /begin IF_DATA ASAP1B_ETK KP_BLOB 0x380EA2 1 2 /end IF_DATA BIT_MASK 0xFFFF /end MEASUREMENT
/begin MEASUREMENT esst_sts14esub "" UWORD dez___UW 0 0 0.000000 65535.000000 /begin IF_DATA ASAP1B_ETK KP_BLOB 0x380EA4 1 2 /end IF_DATA BIT_MASK 0xFFFF /end MEASUREMENT
/begin MEASUREMENT esst_sue08mfub "" UWORD dez___UW 0 0 0.000000 65535.000000 /begin IF_DATA ASAP1B_ETK KP_BLOB 0x380EA6 1 2 /end IF_DATA BIT_MASK 0xFFFF /end MEASUREMENT
/begin MEASUREMENT esst_svp12lduw "" UWORD dez___UW 0 0 0.000000 65535.000000 /begin IF_DATA ASAP1B_ETK KP_BLOB 0x380EA8 1 2 /end IF_DATA BIT_MASK 0xFFFF /end MEASUREMENT
/begin MEASUREMENT esst_swk08ldub "" UWORD dez___UW 0 0 0.000000 65535.000000 /begin IF_DATA ASAP1B_ETK KP_BLOB 0x380EAA 1 2 /end IF_DATA BIT_MASK 0xFFFF /end MEASUREMENT
/begin MEASUREMENT esst_swk108ldub "" UWORD dez___UW 0 0 0.000000 65535.000000 /begin IF_DATA ASAP1B_ETK KP_BLOB 0x380EAC 1 2 /end IF_DATA BIT_MASK 0xFFFF /end MEASUREMENT
/begin MEASUREMENT esst_swk208ldub "" UWORD dez___UW 0 0 0.000000 65535.000000 /begin IF_DATA ASAP1B_ETK KP_BLOB 0x380EAE 1 2 /end IF_DATA BIT_MASK 0xFFFF /end MEASUREMENT
/begin MEASUREMENT esst_swp08opub "" UWORD dez___UW 0 0 0.000000 65535.000000 /begin IF_DATA ASAP1B_ETK KP_BLOB 0x380EB0 1 2 /end IF_DATA BIT_MASK 0xFFFF /end MEASUREMENT
/begin MEASUREMENT etalab "Lambda-Wirkungsgrad ohne Eingriff bezogen auf optimales Moment bei Lambda=1" UBYTE rel_ub_b127p5 0 0 0.000000 127.500000 /begin IF_DATA ASAP1B_ETK KP_BLOB 0x380C43 1 1 /end IF_DATA BIT_MASK 0xFF /end MEASUREMENT
/begin MEASUREMENT etatrmn "minimaler Wert in der Wirkungsgradtrommel" UBYTE rel_ub_b127p5 0 0 0.000000 127.500000 /begin IF_DATA ASAP1B_ETK KP_BLOB 0x380C44 1 1 /end IF_DATA BIT_MASK 0xFF /end MEASUREMENT
/begin MEASUREMENT etazaist "Ist-Zylinderausblendungswirkungsgrad" UBYTE rel_ub_b127p5 0 0 0.000000 127.500000 /begin IF_DATA ASAP1B_ETK KP_BLOB 0x380C4A 1 1 /end IF_DATA BIT_MASK 0xFF /end MEASUREMENT
/begin MEASUREMENT etazwb "ZÅndwinkelwirkungsgrad des BasiszÅndwinkels" UBYTE rel_ub_b127p5 0 0 0.000000 127.500000 /begin IF_DATA ASAP1B_ETK KP_BLOB 0x380C45 1 1 /end IF_DATA BIT_MASK 0xFF /end MEASUREMENT
/begin MEASUREMENT etazwbm "gemittelter ZÅndwinkelwirkungsgrad des BasiszÅndwinkels" UBYTE rel_ub_b127p5 0 0 0.000000 127.500000 /begin IF_DATA ASAP1B_ETK KP_BLOB 0x380C46 1 1 /end IF_DATA BIT_MASK 0xFF /end MEASUREMENT
/begin MEASUREMENT etazwmn "Minimum-ZÅndwinkelwirkungsgrad" UBYTE rel_ub_b127p5 0 0 0.000000 127.500000 /begin IF_DATA ASAP1B_ETK KP_BLOB 0xF9FA 0 1 /end IF_DATA BIT_MASK 0xFF /end MEASUREMENT
/begin MEASUREMENT E_hsh "Errorflag: Lambdasonden-Heizung hinter Katalysator" UWORD B_TRUE___UW 0 0 0.000000 0.000000 /begin IF_DATA ASAP1B_ETK KP_BLOB 0x383B56 1 2 /end IF_DATA BIT_MASK 0x1 /end MEASUREMENT
/begin MEASUREMENT E_hsv "Errorflag: Lambdasonden-Heizung vor Katalysator" UWORD B_TRUE___UW 0 0 0.000000 0.000000 /begin IF_DATA ASAP1B_ETK KP_BLOB 0x383B5C 1 2 /end IF_DATA BIT_MASK 0x1 /end MEASUREMENT
/begin MEASUREMENT E_hsv2 "Errorflag: Lambdasonden-Heizung vor Katalysator Bank 2" UWORD B_TRUE___UW 0 0 0.000000 0.000000 /begin IF_DATA ASAP1B_ETK KP_BLOB 0x383B5E 1 2 /end IF_DATA BIT_MASK 0x1 /end MEASUREMENT
/begin MEASUREMENT E_kat "Errorflag: Katalysator-Konvertierung" UWORD B_TRUE___UW 0 0 0.000000 0.000000 /begin IF_DATA ASAP1B_ETK KP_BLOB 0x383B60 1 2 /end IF_DATA BIT_MASK 0x1 /end MEASUREMENT
/begin MEASUREMENT E_lash "Errorflag: Lambda-Sondenalterung hinter Kat." UWORD B_TRUE___UW 0 0 0.000000 0.000000 /begin IF_DATA ASAP1B_ETK KP_BLOB 0x383B84 1 2 /end IF_DATA BIT_MASK 0x1 /end MEASUREMENT
/begin MEASUREMENT E_lash2 "Errorflag: Lambda-Sondenalterung hinter Kat. (Bank 2)" UWORD B_TRUE___UW 0 0 0.000000 0.000000 /begin IF_DATA ASAP1B_ETK KP_BLOB 0x383B86 1 2 /end IF_DATA BIT_MASK 0x1 /end MEASUREMENT
/begin MEASUREMENT E_lm "Errorflag: Hauptlastsensor" UWORD B_TRUE___UW 0 0 0.000000 0.000000 /begin IF_DATA ASAP1B_ETK KP_BLOB 0x383B9C 1 2 /end IF_DATA BIT_MASK 0x1 /end MEASUREMENT
/begin MEASUREMENT E_sls "Errorflag: SekundÑrluft-System" UWORD B_TRUE___UW 0 0 0.000000 0.000000 /begin IF_DATA ASAP1B_ETK KP_BLOB 0x383BD4 1 2 /end IF_DATA BIT_MASK 0x1 /end MEASUREMENT
/begin MEASUREMENT E_tes "Errorflag: TankentlÅftungssystem" UWORD B_TRUE___UW 0 0 0.000000 0.000000 /begin IF_DATA ASAP1B_ETK KP_BLOB 0x383BE4 1 2 /end IF_DATA BIT_MASK 0x1 /end MEASUREMENT
/begin MEASUREMENT E_teve "Errorflag: TankentlÅftungsventil Endstufe" UWORD B_TRUE___UW 0 0 0.000000 0.000000 /begin IF_DATA ASAP1B_ETK KP_BLOB 0x383BEA 1 2 /end IF_DATA BIT_MASK 0x1 /end MEASUREMENT
/begin MEASUREMENT E_teve2 "Errorflag: TankentlÅftungsventil Endstufe, Bank 2" UWORD B_TRUE___UW 0 0 0.000000 0.000000 /begin IF_DATA ASAP1B_ETK KP_BLOB 0x383BEC 1 2 /end IF_DATA BIT_MASK 0x1 /end MEASUREMENT
/begin MEASUREMENT favkatmx "Gewichtungsfaktor Sauerstoffspeicher Åber avkatf" UBYTE fak_ub_b1 0 0 0.000000 0.996094 /begin IF_DATA ASAP1B_ETK KP_BLOB 0x380CE0 1 1 /end IF_DATA BIT_MASK 0xFF /end MEASUREMENT
/begin MEASUREMENT fcmEnd "Anzahl EintrÑge im Fehlerspeicher" UBYTE dez 0 0 0.000000 255.000000 /begin IF_DATA ASAP1B_ETK KP_BLOB 0x383307 1 1 /end IF_DATA BIT_MASK 0xFF /end MEASUREMENT
/begin MEASUREMENT flamsl2_w "Faktor LambdaÑnderung durch SekundÑrluft, Bank 2" UWORD fak_uw_b16 0 0 0.000000 15.999756 /begin IF_DATA ASAP1B_ETK KP_BLOB 0x380ECA 1 2 /end IF_DATA BIT_MASK 0xFFFF /end MEASUREMENT
/begin MEASUREMENT flamsl_w "Faktor LambdaÑnderung durch SekundÑrluft" UWORD fak_uw_b16 0 0 0.000000 15.999756 /begin IF_DATA ASAP1B_ETK KP_BLOB 0x380ECC 1 2 /end IF_DATA BIT_MASK 0xFFFF /end MEASUREMENT
/begin MEASUREMENT flglrs "CARB FREEZE FRAME Byte, Bank 1, fÅr LR" UBYTE dez 0 0 0.000000 255.000000 /begin IF_DATA ASAP1B_ETK KP_BLOB 0x380CDD 1 1 /end IF_DATA BIT_MASK 0xFF /end MEASUREMENT
/begin MEASUREMENT flglrs2 "CARB FREEZE FRAME Byte, Bank 2, fÅr LR" UBYTE dez 0 0 0.000000 255.000000 /begin IF_DATA ASAP1B_ETK KP_BLOB 0x380CDE 1 1 /end IF_DATA BIT_MASK 0xFF /end MEASUREMENT
/begin MEASUREMENT flmssl "Faktor Lambda-Motor-Soll-SekundÑrluftanteil" UBYTE fak_ub_b1 0 0 0.000000 0.996094 /begin IF_DATA ASAP1B_ETK KP_BLOB 0x380991 1 1 /end IF_DATA BIT_MASK 0xFF /end MEASUREMENT
/begin MEASUREMENT fmsagd "Korrekturfaktor Abgasgegendruck der SekundÑrluftmasse" UBYTE fak_ub_b2 0 0 0.000000 1.992188 /begin IF_DATA ASAP1B_ETK KP_BLOB 0x380992 1 1 /end IF_DATA BIT_MASK 0xFF /end MEASUREMENT
/begin MEASUREMENT fmsla "Korrekturfaktor SekundÑrluftmasse adaptiv" UBYTE fak_ub_b2 0 0 0.000000 1.992188 /begin IF_DATA ASAP1B_ETK KP_BLOB 0x38099D 1 1 /end IF_DATA BIT_MASK 0xFF /end MEASUREMENT
/begin MEASUREMENT fmsldyn "Faktor Dynamikbeschreibung SekundÑrluft" UBYTE fak_ub_b1 0 0 0.000000 0.996094 /begin IF_DATA ASAP1B_ETK KP_BLOB 0x380993 1 1 /end IF_DATA BIT_MASK 0xFF /end MEASUREMENT
/begin MEASUREMENT fmslrho "Dichtekorrektur der SekundÑrluftmasse" UBYTE fak_ub_b2 0 0 0.000000 1.992188 /begin IF_DATA ASAP1B_ETK KP_BLOB 0x380994 1 1 /end IF_DATA BIT_MASK 0xFF /end MEASUREMENT
/begin MEASUREMENT fmsltm "tmot- Korrektur der SekundÑrluftmasse" UBYTE fak_ub_b2 0 0 0.000000 1.992188 /begin IF_DATA ASAP1B_ETK KP_BLOB 0x380995 1 1 /end IF_DATA BIT_MASK 0xFF /end MEASUREMENT
/begin MEASUREMENT fnstab_w "Faktor zur Stabilisierung mittels Drehzahlquotient" UWORD fak_uw_b8 0 0 0.000000 7.999878 /begin IF_DATA ASAP1B_ETK KP_BLOB 0x3823A2 1 2 /end IF_DATA BIT_MASK 0xFFFF /end MEASUREMENT
/begin MEASUREMENT fnwue "Gewichtungsfaktor NockenwellenÅberschneidung (Einla·)" UBYTE fak_ub_b1 0 0 0.000000 0.996094 /begin IF_DATA ASAP1B_ETK KP_BLOB 0x380AFB 1 1 /end IF_DATA BIT_MASK 0xFF /end MEASUREMENT
/begin MEASUREMENT fr2_w "Lambda-Regler-Ausgang; Bank2 (Word)" UWORD fak_uw_b2 0 0 0.000000 1.999969 /begin IF_DATA ASAP1B_ETK KP_BLOB 0x38288A 1 2 /end IF_DATA BIT_MASK 0xFFFF /end MEASUREMENT
/begin MEASUREMENT frdter_w "Faktor Regelung Referenz fÅr TE-Diagnose" UWORD fak_uw_b2 0 0 0.000000 1.999969 /begin IF_DATA ASAP1B_ETK KP_BLOB 0x382722 1 2 /end IF_DATA BIT_MASK 0xFFFF /end MEASUREMENT
/begin MEASUREMENT frini2_w "Initialisierungswert fÅr Regelfaktor Lambdaregelung, Bank 2" UWORD fak_uw_b2 0 0 0.000000 1.999969 /begin IF_DATA ASAP1B_ETK KP_BLOB 0x382802 1 2 /end IF_DATA BIT_MASK 0xFFFF /end MEASUREMENT
/begin MEASUREMENT frini_w "Initialisierungswert fÅr Regelfaktor Lambdaregelung" UWORD fak_uw_b2 0 0 0.000000 1.999969 /begin IF_DATA ASAP1B_ETK KP_BLOB 0x382804 1 2 /end IF_DATA BIT_MASK 0xFFFF /end MEASUREMENT
/begin MEASUREMENT frkte "Faktor Umrechnung rel. Kraftstoffmasse rk effekt. Einspritzzeit te" UBYTE rkti_sy 0 0 0.000000 0.544000 /begin IF_DATA ASAP1B_ETK KP_BLOB 0x380B40 1 1 /end IF_DATA BIT_MASK 0xFF /end MEASUREMENT
/begin MEASUREMENT fr_w "Lambda-Regler-Ausgang (Word)" UWORD fak_uw_b2 0 0 0.000000 1.999969 /begin IF_DATA ASAP1B_ETK KP_BLOB 0x3828A8 1 2 /end IF_DATA BIT_MASK 0xFFFF /end MEASUREMENT
/begin MEASUREMENT fslpdyn "Faktor Dynamikbeschreibung SekundÑrluftpumpe" UBYTE fak_ub_b1 0 0 0.000000 0.996094 /begin IF_DATA ASAP1B_ETK KP_BLOB 0x380996 1 1 /end IF_DATA BIT_MASK 0xFF /end MEASUREMENT
/begin MEASUREMENT ftek_w "Korrekturfaktor fÅr effektive Einspritzzeit" UWORD fak_uw_b2 0 0 0.000000 1.999969 /begin IF_DATA ASAP1B_ETK KP_BLOB 0x381FAE 1 2 /end IF_DATA BIT_MASK 0xFFFF /end MEASUREMENT
/begin MEASUREMENT ftv "Faktor Bewertung tv-Korrektur Regelung hinter Kat" UBYTE fak_ub_b2 0 0 0.000000 1.992188 /begin IF_DATA ASAP1B_ETK KP_BLOB 0x380CE6 1 1 /end IF_DATA BIT_MASK 0xFF /end MEASUREMENT
/begin MEASUREMENT fwe "Faktor Wiedereinsetzen" UBYTE fak_ub_b2 0 0 0.000000 1.992188 /begin IF_DATA ASAP1B_ETK KP_BLOB 0x380B43 1 1 /end IF_DATA BIT_MASK 0xFF /end MEASUREMENT
/begin MEASUREMENT ilmlkah_w "Gewichteter Integrator FettflÑche fÅr AusrÑumen Haupt-kat" UWORD m_uw_b4660 0 0 0.000000 4660.266667 /begin IF_DATA ASAP1B_ETK KP_BLOB 0x382806 1 2 /end IF_DATA BIT_MASK 0xFFFF /end MEASUREMENT
/begin MEASUREMENT ilmlkam_w "Gewichteter Integrator Sauerstoffeintrag in den Hauptkat" UWORD m_uw_b4660 0 0 0.000000 4660.266667 /begin IF_DATA ASAP1B_ETK KP_BLOB 0x382808 1 2 /end IF_DATA BIT_MASK 0xFFFF /end MEASUREMENT
/begin MEASUREMENT ilmlkat_w "GÅltig gemessener Wert des Sauerstoffspeichers" UWORD m_uw_b4660 0 0 0.000000 4660.266667 /begin IF_DATA ASAP1B_ETK KP_BLOB 0x38280A 1 2 /end IF_DATA BIT_MASK 0xFFFF /end MEASUREMENT
/begin MEASUREMENT ilmlkav_w "Gewichteter Integrator FettflÑche nach Ende AusrÑumen Vorkat" UWORD m_uw_b4660 0 0 0.000000 4660.266667 /begin IF_DATA ASAP1B_ETK KP_BLOB 0x38280C 1 2 /end IF_DATA BIT_MASK 0xFFFF /end MEASUREMENT
/begin MEASUREMENT ilmlkax_w "FettflÑchenschwelle gesteuertes Kat-AusrÑumen f(tkatm), Bank 1" UWORD m_uw_b4660 0 0 0.000000 4660.266667 /begin IF_DATA ASAP1B_ETK KP_BLOB 0x38280E 1 2 /end IF_DATA BIT_MASK 0xFFFF /end MEASUREMENT
/begin MEASUREMENT ilmlka_w "Integrator FettflÑche fÅr Katalysator-AusrÑumen" UWORD m_uw_b4660 0 0 0.000000 4660.266667 /begin IF_DATA ASAP1B_ETK KP_BLOB 0x382810 1 2 /end IF_DATA BIT_MASK 0xFFFF /end MEASUREMENT
/begin MEASUREMENT imlkav_w "Gewichteter Integrator Luftmasse bei Ende AusrÑumen Vorkat" UWORD m_uw_b4660 0 0 0.000000 4660.266667 /begin IF_DATA ASAP1B_ETK KP_BLOB 0x382812 1 2 /end IF_DATA BIT_MASK 0xFFFF /end MEASUREMENT
/begin MEASUREMENT imlkax_w "Luftmassenschwelle geregeltes Kat-AusrÑumen f(tkatm), Bank 1" UWORD m_uw_b4660 0 0 0.000000 4660.266667 /begin IF_DATA ASAP1B_ETK KP_BLOB 0x382814 1 2 /end IF_DATA BIT_MASK 0xFFFF /end MEASUREMENT
/begin MEASUREMENT imlka_w "Integrator Luftmasse fÅr Katalysator-AusrÑumen" UWORD m_uw_b4660 0 0 0.000000 4660.266667 /begin IF_DATA ASAP1B_ETK KP_BLOB 0x382816 1 2 /end IF_DATA BIT_MASK 0xFFFF /end MEASUREMENT
/begin MEASUREMENT imlrsa_w "Luftmasse nach SA fÅr stetige Lambdaregelung" UWORD m_uw_b4660 0 0 0.000000 4660.266667 /begin IF_DATA ASAP1B_ETK KP_BLOB 0x3827EE 1 2 /end IF_DATA BIT_MASK 0xFFFF /end MEASUREMENT
/begin MEASUREMENT imlsla_w "Luftmassenintegral fÅr Einbringen der SekundÑrluft" UWORD m_uw_b4660 0 0 0.000000 4660.266667 /begin IF_DATA ASAP1B_ETK KP_BLOB 0x380ECE 1 2 /end IF_DATA BIT_MASK 0xFFFF /end MEASUREMENT
/begin MEASUREMENT imlsle_w "Luftmassenintegral fÅr Ende der SekundÑrluft im Abgas" UWORD m_uw_b4660 0 0 0.000000 4660.266667 /begin IF_DATA ASAP1B_ETK KP_BLOB 0x380ED0 1 2 /end IF_DATA BIT_MASK 0xFFFF /end MEASUREMENT
/begin MEASUREMENT itnmaxp_w "Timer abwÑrts fÅr Aktivierungsdauer der alternativen Reglerabstimmung" UWORD t10msxs_uw_b655p35 0 0 0.000000 655.350000 /begin IF_DATA ASAP1B_ETK KP_BLOB 0x3824B6 1 2 /end IF_DATA BIT_MASK 0xFFFF /end MEASUREMENT
/begin MEASUREMENT itnmxh_w "Timer abwÑrts, Zeitdauer unterhalb unterer Drehzahlgrenze" UWORD t10msxs_uw_b655p35 0 0 0.000000 655.350000 /begin IF_DATA ASAP1B_ETK KP_BLOB 0x3824B8 1 2 /end IF_DATA BIT_MASK 0xFFFF /end MEASUREMENT
/begin MEASUREMENT kinmx "öbertragungsfaktor I-Regler fÅr NMAX-Regelung" UBYTE relnmot_q0p02 0 0 0.000000 5.100000 /begin IF_DATA ASAP1B_ETK KP_BLOB 0x380C4C 1 1 /end IF_DATA BIT_MASK 0xFF /end MEASUREMENT
/begin MEASUREMENT lahkmz "Zustandsbyte des Automaten: fr-synchrone Mittelung Pseodo-Lambda hinter Kat" UBYTE dez 0 0 0.000000 255.000000 /begin IF_DATA ASAP1B_ETK KP_BLOB 0x380CE8 1 1 /end IF_DATA BIT_MASK 0xFF /end MEASUREMENT
/begin MEASUREMENT lamhf_w "Pseudolinearisietes Lambda hinter Kat, PT1-gefiltert, Word" UWORD fak_uw_b16 0 0 0.000000 15.999756 /begin IF_DATA ASAP1B_ETK KP_BLOB 0x382854 1 2 /end IF_DATA BIT_MASK 0xFFFF /end MEASUREMENT
/begin MEASUREMENT lamhm_w "fr-synchron gemittelter Pseudo Lambda-Istwert gem. mit Nernst-Sonde h.Kat, Word" UWORD fak_uw_b16 0 0 0.000000 15.999756 /begin IF_DATA ASAP1B_ETK KP_BLOB 0x382856 1 2 /end IF_DATA BIT_MASK 0xFFFF /end MEASUREMENT
/begin MEASUREMENT lamkaii_w "Lambdasollwert KatausrÑumen, lokaler Zwischenwert" UWORD fak_uw_b16 0 0 0.000000 15.999756 /begin IF_DATA ASAP1B_ETK KP_BLOB 0x382818 1 2 /end IF_DATA BIT_MASK 0xFFFF /end MEASUREMENT
/begin MEASUREMENT lamkai_w "Lambdasollwert KatausrÑumen, Kennfeldwert" UWORD fak_uw_b16 0 0 0.000000 15.999756 /begin IF_DATA ASAP1B_ETK KP_BLOB 0x38281A 1 2 /end IF_DATA BIT_MASK 0xFFFF /end MEASUREMENT
/begin MEASUREMENT lamka_w "Lambdasollwert KatausrÑumen" UWORD fak_uw_b16 0 0 0.000000 15.999756 /begin IF_DATA ASAP1B_ETK KP_BLOB 0x38281C 1 2 /end IF_DATA BIT_MASK 0xFFFF /end MEASUREMENT
/begin MEASUREMENT lamsnka_w "Lambda-Sollwert interne Auswertung in LRKA" UWORD fak_uw_b16 0 0 0.000000 15.999756 /begin IF_DATA ASAP1B_ETK KP_BLOB 0x38281E 1 2 /end IF_DATA BIT_MASK 0xFFFF /end MEASUREMENT
/begin MEASUREMENT lamsolh2_w "Pseudo Lambda-Sollwert hinter Kat, Bank2" UWORD fak_uw_b16 0 0 0.000000 15.999756 /begin IF_DATA ASAP1B_ETK KP_BLOB 0x382858 1 2 /end IF_DATA BIT_MASK 0xFFFF /end MEASUREMENT
/begin MEASUREMENT lamsolh_w "Pseudo Lambda-Sollwert hinter Kat" UWORD fak_uw_b16 0 0 0.000000 15.999756 /begin IF_DATA ASAP1B_ETK KP_BLOB 0x38285A 1 2 /end IF_DATA BIT_MASK 0xFFFF /end MEASUREMENT
/begin MEASUREMENT lamsonh2_w "Pseudo Lambda-Istwert gemessen mit Nernst-Sonde hinter Kat (word), Bank2" UWORD fak_uw_b16 0 0 0.000000 15.999756 /begin IF_DATA ASAP1B_ETK KP_BLOB 0x38285C 1 2 /end IF_DATA BIT_MASK 0xFFFF /end MEASUREMENT
/begin MEASUREMENT lamsonh_w "Pseudo Lambda-Istwert gemessen mit Nernst-Sonde hinter Kat (word)" UWORD fak_uw_b16 0 0 0.000000 15.999756 /begin IF_DATA ASAP1B_ETK KP_BLOB 0x38285E 1 2 /end IF_DATA BIT_MASK 0xFFFF /end MEASUREMENT
/begin MEASUREMENT lamsons_w "Lambda-Sollwert bezogen auf Einbauort Lambda-Sensor" UWORD fak_uw_b16 0 0 0.000000 15.999756 /begin IF_DATA ASAP1B_ETK KP_BLOB 0x381FE4 1 2 /end IF_DATA BIT_MASK 0xFFFF /end MEASUREMENT
/begin MEASUREMENT laufz100_w "" UWORD runtime1_sy 0 0 0.000000 52428.000000 /begin IF_DATA ASAP1B_ETK KP_BLOB 0x38253E 1 2 /end IF_DATA BIT_MASK 0xFFFF /end MEASUREMENT
/begin MEASUREMENT laufz10m_w "" UWORD runtime1_sy 0 0 0.000000 52428.000000 /begin IF_DATA ASAP1B_ETK KP_BLOB 0x382540 1 2 /end IF_DATA BIT_MASK 0xFFFF /end MEASUREMENT
/begin MEASUREMENT laufz1m_w "" UWORD runtime1_sy 0 0 0.000000 52428.000000 /begin IF_DATA ASAP1B_ETK KP_BLOB 0x382542 1 2 /end IF_DATA BIT_MASK 0xFFFF /end MEASUREMENT
/begin MEASUREMENT laufz1s_w "" UWORD runtime1_sy 0 0 0.000000 52428.000000 /begin IF_DATA ASAP1B_ETK KP_BLOB 0x382544 1 2 /end IF_DATA BIT_MASK 0xFFFF /end MEASUREMENT
/begin MEASUREMENT laufz200_w "" UWORD runtime1_sy 0 0 0.000000 52428.000000 /begin IF_DATA ASAP1B_ETK KP_BLOB 0x382546 1 2 /end IF_DATA BIT_MASK 0xFFFF /end MEASUREMENT
/begin MEASUREMENT laufz20m_w "" UWORD runtime1_sy 0 0 0.000000 52428.000000 /begin IF_DATA ASAP1B_ETK KP_BLOB 0x382548 1 2 /end IF_DATA BIT_MASK 0xFFFF /end MEASUREMENT
/begin MEASUREMENT laufz2m_w "" UWORD runtime1_sy 0 0 0.000000 52428.000000 /begin IF_DATA ASAP1B_ETK KP_BLOB 0x38254A 1 2 /end IF_DATA BIT_MASK 0xFFFF /end MEASUREMENT
/begin MEASUREMENT laufz50m_w "" UWORD runtime1_sy 0 0 0.000000 52428.000000 /begin IF_DATA ASAP1B_ETK KP_BLOB 0x38254C 1 2 /end IF_DATA BIT_MASK 0xFFFF /end MEASUREMENT
/begin MEASUREMENT laufzbg_w "" UWORD runtime1_sy 0 0 0.000000 52428.000000 /begin IF_DATA ASAP1B_ETK KP_BLOB 0x38254E 1 2 /end IF_DATA BIT_MASK 0xFFFF /end MEASUREMENT
/begin MEASUREMENT laufzsyn_w "" UWORD runtime1_sy 0 0 0.000000 52428.000000 /begin IF_DATA ASAP1B_ETK KP_BLOB 0x382550 1 2 /end IF_DATA BIT_MASK 0xFFFF /end MEASUREMENT
/begin MEASUREMENT LRHKlokbits "" UBYTE dez 0 0 0.000000 255.000000 /begin IF_DATA ASAP1B_ETK KP_BLOB 0x380CE9 1 1 /end IF_DATA BIT_MASK 0xFF /end MEASUREMENT
/begin MEASUREMENT lrkaz "Zustandsbyte des Automaten Kat-AusrÑumen" UBYTE dez 0 0 0.000000 255.000000 /begin IF_DATA ASAP1B_ETK KP_BLOB 0x380CE3 1 1 /end IF_DATA BIT_MASK 0xFF /end MEASUREMENT
/begin MEASUREMENT lws_w "Lenkwinkel" SWORD lw_sw_q0p04375 0 0 -1434.043764 1434.000000 /begin IF_DATA ASAP1B_ETK KP_BLOB 0x380FF0 1 2 /end IF_DATA BIT_MASK 0xFFFF /end MEASUREMENT
/begin MEASUREMENT lzmaxnmot "" UBYTE nmot_ub_q40 0 0 0.000000 10200.000000 /begin IF_DATA ASAP1B_ETK KP_BLOB 0x380C5C 1 1 /end IF_DATA BIT_MASK 0xFF /end MEASUREMENT
/begin MEASUREMENT lzmaxrl "" UBYTE rel_ub_b99p6 0 0 0.000000 99.609375 /begin IF_DATA ASAP1B_ETK KP_BLOB 0x380C5D 1 1 /end IF_DATA BIT_MASK 0xFF /end MEASUREMENT
/begin MEASUREMENT lzmaxstate "" UBYTE dez 0 0 0.000000 255.000000 /begin IF_DATA ASAP1B_ETK KP_BLOB 0x380C5E 1 1 /end IF_DATA BIT_MASK 0xFF /end MEASUREMENT
/begin MEASUREMENT lzmaxwdkba "" UBYTE relDK_ub_b100 0 0 0.000000 100.000000 /begin IF_DATA ASAP1B_ETK KP_BLOB 0x380C5F 1 1 /end IF_DATA BIT_MASK 0xFF /end MEASUREMENT
/begin MEASUREMENT lzmaxwped "" UBYTE rel_ub_b99p6 0 0 0.000000 99.609375 /begin IF_DATA ASAP1B_ETK KP_BLOB 0x380C60 1 1 /end IF_DATA BIT_MASK 0xFF /end MEASUREMENT
/begin MEASUREMENT lzs_dash "" UBYTE B_TRUE 0 0 0.000000 0.000000 /begin IF_DATA ASAP1B_ETK KP_BLOB 0x380C5E 1 1 /end IF_DATA BIT_MASK 0x10 /end MEASUREMENT
/begin MEASUREMENT lzs_kr "" UBYTE B_TRUE 0 0 0.000000 0.000000 /begin IF_DATA ASAP1B_ETK KP_BLOB 0x380C5E 1 1 /end IF_DATA BIT_MASK 0x1 /end MEASUREMENT
/begin MEASUREMENT lzs_ldr "" UBYTE B_TRUE 0 0 0.000000 0.000000 /begin IF_DATA ASAP1B_ETK KP_BLOB 0x380C5E 1 1 /end IF_DATA BIT_MASK 0x4 /end MEASUREMENT
/begin MEASUREMENT lzs_lr "" UBYTE B_TRUE 0 0 0.000000 0.000000 /begin IF_DATA ASAP1B_ETK KP_BLOB 0x380C5E 1 1 /end IF_DATA BIT_MASK 0x2 /end MEASUREMENT
/begin MEASUREMENT lzs_lsd "" UBYTE B_TRUE 0 0 0.000000 0.000000 /begin IF_DATA ASAP1B_ETK KP_BLOB 0x380C5E 1 1 /end IF_DATA BIT_MASK 0x8 /end MEASUREMENT
/begin MEASUREMENT lzs_sa "" UBYTE B_TRUE 0 0 0.000000 0.000000 /begin IF_DATA ASAP1B_ETK KP_BLOB 0x380C5E 1 1 /end IF_DATA BIT_MASK 0x20 /end MEASUREMENT
/begin MEASUREMENT mdgrad_w "Momentengradientenbegrenzung durch Getriebe" UWORD rel_uw_b728 0 0 0.000000 9999.847412 /begin IF_DATA ASAP1B_ETK KP_BLOB 0x380FF2 1 2 /end IF_DATA BIT_MASK 0xFFFF /end MEASUREMENT
/begin MEASUREMENT mdindg_w "indiziertes Motormoment Hochdruckphase wenn alle Zylinder befeuert" UWORD rel_uw_b100 0 0 0.000000 99.998474 /begin IF_DATA ASAP1B_ETK KP_BLOB 0x3824A4 1 2 /end IF_DATA BIT_MASK 0xFFFF /end MEASUREMENT
/begin MEASUREMENT mdko "Momentenaufnahme Klimakompressor" UBYTE rel_ub_b99p6 0 0 0.000000 99.609375 /begin IF_DATA ASAP1B_ETK KP_BLOB 0x380C30 1 1 /end IF_DATA BIT_MASK 0xFF /end MEASUREMENT
/begin MEASUREMENT mdslpf "Momentenaufnahme der SekundÑrluftpumpe" UBYTE rel_ub_b99p6 0 0 0.000000 99.609375 /begin IF_DATA ASAP1B_ETK KP_BLOB 0x380C31 1 1 /end IF_DATA BIT_MASK 0xFF /end MEASUREMENT
/begin MEASUREMENT mds_w "Motorschleppmoment" UWORD rel_uw_b100 0 0 0.000000 99.998474 /begin IF_DATA ASAP1B_ETK KP_BLOB 0x3823B8 1 2 /end IF_DATA BIT_MASK 0xFFFF /end MEASUREMENT
/begin MEASUREMENT MDVERADlokbits "" UBYTE dez 0 0 0.000000 255.000000 /begin IF_DATA ASAP1B_ETK KP_BLOB 0x380C24 1 1 /end IF_DATA BIT_MASK 0xFF /end MEASUREMENT
/begin MEASUREMENT mdverb "Momentenbedarf der Nebenaggregate" UBYTE rel_ub_b99p6 0 0 0.000000 99.609375 /begin IF_DATA ASAP1B_ETK KP_BLOB 0x380C32 1 1 /end IF_DATA BIT_MASK 0xFF /end MEASUREMENT
/begin MEASUREMENT mdverf_w "Gefiltertes Verlustmoment" UWORD rel_uw_b100 0 0 0.000000 99.998474 /begin IF_DATA ASAP1B_ETK KP_BLOB 0x3823BA 1 2 /end IF_DATA BIT_MASK 0xFFFF /end MEASUREMENT
/begin MEASUREMENT mdverl_w "Motor-Verlustmoment" UWORD rel_uw_b100 0 0 0.000000 99.998474 /begin IF_DATA ASAP1B_ETK KP_BLOB 0x3823BC 1 2 /end IF_DATA BIT_MASK 0xFFFF /end MEASUREMENT
/begin MEASUREMENT mdwancan "Drehmomentaufnahme des Wandlers Åber CAN" UBYTE rel_ub_b99p6 0 0 0.000000 99.609375 /begin IF_DATA ASAP1B_ETK KP_BLOB 0x3809C4 1 1 /end IF_DATA BIT_MASK 0xFF /end MEASUREMENT
/begin MEASUREMENT mdwanvf_w "" SWORD rel_sw_b100 0 0 -100.000000 99.996948 /begin IF_DATA ASAP1B_ETK KP_BLOB 0x38233C 1 2 /end IF_DATA BIT_MASK 0xFFFF /end MEASUREMENT
/begin MEASUREMENT mdwan_w "Drehmomentaufnahme des Wandlers" SWORD rel_sw_b100 0 0 -100.000000 99.996948 /begin IF_DATA ASAP1B_ETK KP_BLOB 0x38233E 1 2 /end IF_DATA BIT_MASK 0xFFFF /end MEASUREMENT
/begin MEASUREMENT miasrl_w "Indiziertes Soll-Motormoment ASR fÅr langsamen Eingriff" UWORD rel_uw_b100 0 0 0.000000 99.998474 /begin IF_DATA ASAP1B_ETK KP_BLOB 0x380FF4 1 2 /end IF_DATA BIT_MASK 0xFFFF /end MEASUREMENT
/begin MEASUREMENT miasrs_w "Indiziertes Soll-Motormoment ASR fÅr schnellen Eingriff" UWORD rel_uw_b100 0 0 0.000000 99.998474 /begin IF_DATA ASAP1B_ETK KP_BLOB 0x380FF6 1 2 /end IF_DATA BIT_MASK 0xFFFF /end MEASUREMENT
/begin MEASUREMENT miautget_w "Motormoment ohne Getriebeeingriff" UWORD rel_uw_b100 0 0 0.000000 99.998474 /begin IF_DATA ASAP1B_ETK KP_BLOB 0x3824F4 1 2 /end IF_DATA BIT_MASK 0xFFFF /end MEASUREMENT
/begin MEASUREMENT miautgs_w "Motorsollmoment ohne Getriebeeingriff" UWORD rel_uw_b100 0 0 0.000000 99.998474 /begin IF_DATA ASAP1B_ETK KP_BLOB 0x3824F6 1 2 /end IF_DATA BIT_MASK 0xFFFF /end MEASUREMENT
/begin MEASUREMENT mibas_w "indiziertes Basis-Moment" UWORD rel_uw_b100 0 0 0.000000 99.998474 /begin IF_DATA ASAP1B_ETK KP_BLOB 0x382494 1 2 /end IF_DATA BIT_MASK 0xFFFF /end MEASUREMENT
/begin MEASUREMENT mibdp_w "indiziertes Soll-Motormoment Dashpot" UWORD rel_uw_b100 0 0 0.000000 99.998474 /begin IF_DATA ASAP1B_ETK KP_BLOB 0x382434 1 2 /end IF_DATA BIT_MASK 0xFFFF /end MEASUREMENT
/begin MEASUREMENT mibeg_w "Begrenzungsmoment" UWORD rel_uw_b100 0 0 0.000000 99.998474 /begin IF_DATA ASAP1B_ETK KP_BLOB 0x38247A 1 2 /end IF_DATA BIT_MASK 0xFFFF /end MEASUREMENT
/begin MEASUREMENT mibgr_w "indiziertes soll-Moment fÅr gangabhÑngige Kupplungsmomentbegrenzung" UWORD rel_uw_b100 0 0 0.000000 99.998474 /begin IF_DATA ASAP1B_ETK KP_BLOB 0x3824F2 1 2 /end IF_DATA BIT_MASK 0xFFFF /end MEASUREMENT
/begin MEASUREMENT miblsd_w "Begrenztes indiziertes Moment aus LastschlagdÑmpfung" UWORD rel_uw_b100 0 0 0.000000 99.998474 /begin IF_DATA ASAP1B_ETK KP_BLOB 0x382436 1 2 /end IF_DATA BIT_MASK 0xFFFF /end MEASUREMENT
/begin MEASUREMENT miextv_w "von extern gefordertes Moment vor AbwÅrgeschutz" UWORD rel_uw_b100 0 0 0.000000 99.998474 /begin IF_DATA ASAP1B_ETK KP_BLOB 0x38247C 1 2 /end IF_DATA BIT_MASK 0xFFFF /end MEASUREMENT
/begin MEASUREMENT miext_w "von au·en (ASR, GS, usw.) angefordertes indiziertes Motormoment" UWORD rel_uw_b100 0 0 0.000000 99.998474 /begin IF_DATA ASAP1B_ETK KP_BLOB 0x38247E 1 2 /end IF_DATA BIT_MASK 0xFFFF /end MEASUREMENT
/begin MEASUREMENT mifa "indiziertes Motormoment Fahrerwunsch" UBYTE rel_ub_b99p6 0 0 0.000000 99.609375 /begin IF_DATA ASAP1B_ETK KP_BLOB 0x380C3C 1 1 /end IF_DATA BIT_MASK 0xFF /end MEASUREMENT
/begin MEASUREMENT mifabg_w "Gradientenbegrenztes Fahrerwunschmoment" UWORD rel_uw_b100 0 0 0.000000 99.998474 /begin IF_DATA ASAP1B_ETK KP_BLOB 0x382438 1 2 /end IF_DATA BIT_MASK 0xFFFF /end MEASUREMENT
/begin MEASUREMENT mifabh_w "begrenztes ind. Motormoment Fahrerwunsch (sample & hold)" UWORD rel_uw_b100 0 0 0.000000 99.998474 /begin IF_DATA ASAP1B_ETK KP_BLOB 0x3824A8 1 2 /end IF_DATA BIT_MASK 0xFFFF /end MEASUREMENT
/begin MEASUREMENT mifab_w "begrenztes indiziertes Motormoment Fahrerwunsch" UWORD rel_uw_b100 0 0 0.000000 99.998474 /begin IF_DATA ASAP1B_ETK KP_BLOB 0x382480 1 2 /end IF_DATA BIT_MASK 0xFFFF /end MEASUREMENT
/begin MEASUREMENT mifafu_w "Fahrermomentenwunsch fÅr FÅllung" UWORD rel_uw_b100 0 0 0.000000 99.998474 /begin IF_DATA ASAP1B_ETK KP_BLOB 0x38248C 1 2 /end IF_DATA BIT_MASK 0xFFFF /end MEASUREMENT
/begin MEASUREMENT mifal_w "Indiziertes Fahrerwunschmoment fÅr Momentenkoordination FÅllung" UWORD rel_uw_b100 0 0 0.000000 99.998474 /begin IF_DATA ASAP1B_ETK KP_BLOB 0x38243A 1 2 /end IF_DATA BIT_MASK 0xFFFF /end MEASUREMENT
/begin MEASUREMENT migef_w "Gefiltertes indiziertes Fahrerwunschmoment" UWORD rel_uw_b100 0 0 0.000000 99.998474 /begin IF_DATA ASAP1B_ETK KP_BLOB 0x38243E 1 2 /end IF_DATA BIT_MASK 0xFFFF /end MEASUREMENT
/begin MEASUREMENT miges_w "Indiziertes Soll-Motormoment fÅr Getriebeschutz" UWORD rel_uw_b100 0 0 0.000000 99.998474 /begin IF_DATA ASAP1B_ETK KP_BLOB 0x380FFA 1 2 /end IF_DATA BIT_MASK 0xFFFF /end MEASUREMENT
/begin MEASUREMENT migs_w "Indiziertes Soll-Motormoment GS fÅr schnellen Eingriff" UWORD rel_uw_b100 0 0 0.000000 99.998474 /begin IF_DATA ASAP1B_ETK KP_BLOB 0x380FFC 1 2 /end IF_DATA BIT_MASK 0xFFFF /end MEASUREMENT
/begin MEASUREMENT miistoar_w "Istmoment ohne Antiruckel-Anteil" UWORD rel_uw_b100 0 0 0.000000 99.998474 /begin IF_DATA ASAP1B_ETK KP_BLOB 0x3824F8 1 2 /end IF_DATA BIT_MASK 0xFFFF /end MEASUREMENT
/begin MEASUREMENT miist_w "indiziertes Motormoment Hochdruckphase Istwert" UWORD rel_uw_b100 0 0 0.000000 99.998474 /begin IF_DATA ASAP1B_ETK KP_BLOB 0x3824A6 1 2 /end IF_DATA BIT_MASK 0xFFFF /end MEASUREMENT
/begin MEASUREMENT mill_w "Indiziertes Motormoment im Leerlauf" UWORD rel_uw_b100 0 0 0.000000 99.998474 /begin IF_DATA ASAP1B_ETK KP_BLOB 0x3823A6 1 2 /end IF_DATA BIT_MASK 0xFFFF /end MEASUREMENT
/begin MEASUREMENT milres_w "Momentenanforderung fÅr Luftpfad mit allen Reserven" UWORD rel_uw_b100 0 0 0.000000 99.998474 /begin IF_DATA ASAP1B_ETK KP_BLOB 0x38248E 1 2 /end IF_DATA BIT_MASK 0xFFFF /end MEASUREMENT
/begin MEASUREMENT milsol_w "Fahrermomentenwunsch fÅr FÅllung" UWORD rel_uw_b100 0 0 0.000000 99.998474 /begin IF_DATA ASAP1B_ETK KP_BLOB 0x382490 1 2 /end IF_DATA BIT_MASK 0xFFFF /end MEASUREMENT
/begin MEASUREMENT mimax_w "maximal erreichbares indiziertes Moment" UWORD rel_uw_b100 0 0 0.000000 99.998474 /begin IF_DATA ASAP1B_ETK KP_BLOB 0x382472 1 2 /end IF_DATA BIT_MASK 0xFFFF /end MEASUREMENT
/begin MEASUREMENT mimins_w "minimales Schubmoment" UWORD rel_uw_b100 0 0 0.000000 99.998474 /begin IF_DATA ASAP1B_ETK KP_BLOB 0x3823A8 1 2 /end IF_DATA BIT_MASK 0xFFFF /end MEASUREMENT
/begin MEASUREMENT mimin_w "Minimales Motor-Moment" UWORD rel_uw_b100 0 0 0.000000 99.998474 /begin IF_DATA ASAP1B_ETK KP_BLOB 0x3823AA 1 2 /end IF_DATA BIT_MASK 0xFFFF /end MEASUREMENT
/begin MEASUREMENT mimsr_w "Indiziertes Soll-Motormoment MSR" UWORD rel_uw_b100 0 0 0.000000 99.998474 /begin IF_DATA ASAP1B_ETK KP_BLOB 0x380FFE 1 2 /end IF_DATA BIT_MASK 0xFFFF /end MEASUREMENT
/begin MEASUREMENT mimxl1_w "Maximales optimales Moment bei Lambda = 1" UWORD rel_uw_b100 0 0 0.000000 99.998474 /begin IF_DATA ASAP1B_ETK KP_BLOB 0x382474 1 2 /end IF_DATA BIT_MASK 0xFFFF /end MEASUREMENT
/begin MEASUREMENT minbeg_w "Indiziertes Fahrerwunschmoment nach énderungsbegrenzung" UWORD rel_uw_b100 0 0 0.000000 99.998474 /begin IF_DATA ASAP1B_ETK KP_BLOB 0x382440 1 2 /end IF_DATA BIT_MASK 0xFFFF /end MEASUREMENT
/begin MEASUREMENT minmxb_w "indiziertes Soll-Moment fÅr NMAX-Begrenzung ohne Begrenzung" SWORD rel_sw_b100 0 0 -100.000000 99.996948 /begin IF_DATA ASAP1B_ETK KP_BLOB 0x3824BA 1 2 /end IF_DATA BIT_MASK 0xFFFF /end MEASUREMENT
/begin MEASUREMENT minmx_w "indiziertes Soll-Moment fÅr NMAX-Begrenzung" UWORD rel_uw_b100 0 0 0.000000 99.998474 /begin IF_DATA ASAP1B_ETK KP_BLOB 0x3824BC 1 2 /end IF_DATA BIT_MASK 0xFFFF /end MEASUREMENT
/begin MEASUREMENT mioptl1_w "optimales indiziertes Motormoment bei Lambda = 1" UWORD rel_uw_b100 0 0 0.000000 99.998474 /begin IF_DATA ASAP1B_ETK KP_BLOB 0x382496 1 2 /end IF_DATA BIT_MASK 0xFFFF /end MEASUREMENT
/begin MEASUREMENT miopt_w "optimales indiziertes Moment" UWORD rel_uw_b100 0 0 0.000000 99.998474 /begin IF_DATA ASAP1B_ETK KP_BLOB 0x382498 1 2 /end IF_DATA BIT_MASK 0xFFFF /end MEASUREMENT
/begin MEASUREMENT misolv_w "Indiziertes resultierendes Sollmoment vor Momentenbegrenzung" UWORD rel_uw_b100 0 0 0.000000 99.998474 /begin IF_DATA ASAP1B_ETK KP_BLOB 0x382482 1 2 /end IF_DATA BIT_MASK 0xFFFF /end MEASUREMENT
/begin MEASUREMENT misol_w "Indiziertes resultierendes Sollmoment" UWORD rel_uw_b100 0 0 0.000000 99.998474 /begin IF_DATA ASAP1B_ETK KP_BLOB 0xF9D0 0 2 /end IF_DATA BIT_MASK 0xFFFF /end MEASUREMENT
/begin MEASUREMENT mistt "Startmoment" UBYTE rel_ub_b99p6 0 0 0.000000 99.609375 /begin IF_DATA ASAP1B_ETK KP_BLOB 0x380C33 1 1 /end IF_DATA BIT_MASK 0xFF /end MEASUREMENT
/begin MEASUREMENT miszul_w "Maximal zulÑssiges indiziertes Moment" UWORD rel_uw_b100 0 0 0.000000 99.998474 /begin IF_DATA ASAP1B_ETK KP_BLOB 0x3824D8 1 2 /end IF_DATA BIT_MASK 0xFFFF /end MEASUREMENT
/begin MEASUREMENT mitebg_w "Momentvorgabe fÅr MindestfÅllung TankentlÅftung" UWORD rel_uw_b100 0 0 0.000000 99.998474 /begin IF_DATA ASAP1B_ETK KP_BLOB 0x38269A 1 2 /end IF_DATA BIT_MASK 0xFFFF /end MEASUREMENT
/begin MEASUREMENT mivbeg_w "inidziertes Fahrerwunschmoment vor énderungsbegrenzung" UWORD rel_uw_b100 0 0 0.000000 99.998474 /begin IF_DATA ASAP1B_ETK KP_BLOB 0x382444 1 2 /end IF_DATA BIT_MASK 0xFFFF /end MEASUREMENT
/begin MEASUREMENT mivmx_w "indiziertes Soll-Moment fÅr VMAX-Begrenzung" UWORD rel_uw_b100 0 0 0.000000 99.998474 /begin IF_DATA ASAP1B_ETK KP_BLOB 0x3824EA 1 2 /end IF_DATA BIT_MASK 0xFFFF /end MEASUREMENT
/begin MEASUREMENT mizsolv_w "Indiziertes resultierendes Sollmoment fÅr ZW-Eingriff vor Momentenbegrenzung" UWORD rel_uw_b100 0 0 0.000000 99.998474 /begin IF_DATA ASAP1B_ETK KP_BLOB 0x382484 1 2 /end IF_DATA BIT_MASK 0xFFFF /end MEASUREMENT
/begin MEASUREMENT mizsol_w "Indiziertes resultierendes Sollmoment fÅr ZW-Eingriff" UWORD rel_uw_b100 0 0 0.000000 99.998474 /begin IF_DATA ASAP1B_ETK KP_BLOB 0x382486 1 2 /end IF_DATA BIT_MASK 0xFFFF /end MEASUREMENT
/begin MEASUREMENT mizufil_w "ZulÑssiges indiziertes Moment nach Filter" UWORD rel_uw_b100 0 0 0.000000 99.998474 /begin IF_DATA ASAP1B_ETK KP_BLOB 0x3824DA 1 2 /end IF_DATA BIT_MASK 0xFFFF /end MEASUREMENT
/begin MEASUREMENT mizuofil "ZulÑssiges indiziertes Moment ohne Filter" UBYTE rel_ub_b99p6 0 0 0.000000 99.609375 /begin IF_DATA ASAP1B_ETK KP_BLOB 0x380C52 1 1 /end IF_DATA BIT_MASK 0xFF /end MEASUREMENT
/begin MEASUREMENT mizwmn_w "indiziertes Motormoment beim spÑtesten ZÅndwinkel" UWORD rel_uw_b100 0 0 0.000000 99.998474 /begin IF_DATA ASAP1B_ETK KP_BLOB 0x3824D2 1 2 /end IF_DATA BIT_MASK 0xFFFF /end MEASUREMENT
/begin MEASUREMENT mlbb_w "Luftmassenflu· gefiltert (Word), Bank1 bezogen" UWORD m_uw_b6553p5 0 0 0.000000 6553.500000 /begin IF_DATA ASAP1B_ETK KP_BLOB 0x381B7E 1 2 /end IF_DATA BIT_MASK 0xFFFF /end MEASUREMENT
/begin MEASUREMENT mlnka_w "Luftmasse nach Kat-AusrÑumen" UWORD m_uw_b7281 0 0 0.000000 7281.666667 /begin IF_DATA ASAP1B_ETK KP_BLOB 0x382860 1 2 /end IF_DATA BIT_MASK 0xFFFF /end MEASUREMENT
/begin MEASUREMENT mrfamx_w "Relatives Fahrerwunschmoment Maximalwert" UWORD rel_uw_b200 0 0 0.000000 199.996948 /begin IF_DATA ASAP1B_ETK KP_BLOB 0x38244A 1 2 /end IF_DATA BIT_MASK 0xFFFF /end MEASUREMENT
/begin MEASUREMENT mrped_w "relatives Fahrerwunschmoment aus Fahrpedal" UWORD rel_uw_b200 0 0 0.000000 199.996948 /begin IF_DATA ASAP1B_ETK KP_BLOB 0x38244E 1 2 /end IF_DATA BIT_MASK 0xFFFF /end MEASUREMENT
/begin MEASUREMENT msabg "Abgasmassenflu· gefiltert, Bank 1" UBYTE m_ub_b1020 0 0 0.000000 1020.000000 /begin IF_DATA ASAP1B_ETK KP_BLOB 0x380A75 1 1 /end IF_DATA BIT_MASK 0xFF /end MEASUREMENT
/begin MEASUREMENT msl "SekundÑrluftmasse" UBYTE m_ub_q0p4 0 0 0.000000 102.000000 /begin IF_DATA ASAP1B_ETK KP_BLOB 0x380997 1 1 /end IF_DATA BIT_MASK 0xFF /end MEASUREMENT
/begin MEASUREMENT msl2 "SekundÑrluftmasse Bank 2" UBYTE m_ub_q0p4 0 0 0.000000 102.000000 /begin IF_DATA ASAP1B_ETK KP_BLOB 0x380998 1 1 /end IF_DATA BIT_MASK 0xFF /end MEASUREMENT
/begin MEASUREMENT mslpub "SekundÑrluftmasse, batteriespannungsabhÑngig" UBYTE m_ub_q0p4 0 0 0.000000 102.000000 /begin IF_DATA ASAP1B_ETK KP_BLOB 0x380999 1 1 /end IF_DATA BIT_MASK 0xFF /end MEASUREMENT
/begin MEASUREMENT mslstat "statische SekundÑrluftmasse" UBYTE m_ub_q0p4 0 0 0.000000 102.000000 /begin IF_DATA ASAP1B_ETK KP_BLOB 0x38099A 1 1 /end IF_DATA BIT_MASK 0xFF /end MEASUREMENT
/begin MEASUREMENT nmaxdvg_w "gangabhÑngige Drehzahlbegrenzung bei Fehlererkennung Geschwindigkeitssignal" UWORD nmot_uw_q0p25 0 0 0.000000 16383.750000 /begin IF_DATA ASAP1B_ETK KP_BLOB 0x3824AA 1 2 /end IF_DATA BIT_MASK 0xFFFF /end MEASUREMENT
/begin MEASUREMENT nmax_w "Aktuelles Drehzahlmaximum" UWORD nmot_uw_q0p25 0 0 0.000000 16383.750000 /begin IF_DATA ASAP1B_ETK KP_BLOB 0x3824AC 1 2 /end IF_DATA BIT_MASK 0xFFFF /end MEASUREMENT
/begin MEASUREMENT nmotpr_w "prÑdizierte Motordrehzahl" UWORD nmot_uw_q0p25 0 0 0.000000 16383.750000 /begin IF_DATA ASAP1B_ETK KP_BLOB 0x3824BE 1 2 /end IF_DATA BIT_MASK 0xFFFF /end MEASUREMENT
/begin MEASUREMENT nmxpr "P-Glied bei NMAX-Regelung" UBYTE relnmot_q0p0039 0 0 0.000000 0.996094 /begin IF_DATA ASAP1B_ETK KP_BLOB 0x380C4D 1 1 /end IF_DATA BIT_MASK 0xFF /end MEASUREMENT
/begin MEASUREMENT nsber_w "Berechnete Solldrehzahl fÅr NMAX-Regler" UWORD nmot_uw_q0p25 0 0 0.000000 16383.750000 /begin IF_DATA ASAP1B_ETK KP_BLOB 0x3824C0 1 2 /end IF_DATA BIT_MASK 0xFFFF /end MEASUREMENT
/begin MEASUREMENT nstat "Solldrehzahl stationÑr" UBYTE nmot_ub_q10 0 0 0.000000 2550.000000 /begin IF_DATA ASAP1B_ETK KP_BLOB 0x380C20 1 1 /end IF_DATA BIT_MASK 0xFF /end MEASUREMENT
/begin MEASUREMENT nturb "Turbinendrehzahl des Wandlers" UBYTE nmot_q10___UB 0 0 0.000000 2550.000000 /begin IF_DATA ASAP1B_ETK KP_BLOB 0x380C27 1 1 /end IF_DATA BIT_MASK 0xFF /end MEASUREMENT
/begin MEASUREMENT nturbv "Voraussichtliche Turbinendrehzahl des Wandlers" UBYTE nmot_q10___UB 0 0 0.000000 2550.000000 /begin IF_DATA ASAP1B_ETK KP_BLOB 0x380C28 1 1 /end IF_DATA BIT_MASK 0xFF /end MEASUREMENT
/begin MEASUREMENT nwskf "Ergebniss der KFNW-Interpolation" UBYTE fak_ub_b2 0 0 0.000000 1.992188 /begin IF_DATA ASAP1B_ETK KP_BLOB 0x380AFC 1 1 /end IF_DATA BIT_MASK 0xFF /end MEASUREMENT
/begin MEASUREMENT percnt_w "ZÑhler 10-ms-Schritte fÅr fr-synchrone lamsolh-Mittelung" UWORD dez___UW 0 0 0.000000 65535.000000 /begin IF_DATA ASAP1B_ETK KP_BLOB 0x382862 1 2 /end IF_DATA BIT_MASK 0xFFFF /end MEASUREMENT
/begin MEASUREMENT perffilt_w "" UWORD rel_q0p025 0 0 0.000000 1638.375000 /begin IF_DATA ASAP1B_ETK KP_BLOB 0x382552 1 2 /end IF_DATA BIT_MASK 0xFFFF /end MEASUREMENT
/begin MEASUREMENT perfmax_w "" UWORD rel_q0p025 0 0 0.000000 1638.375000 /begin IF_DATA ASAP1B_ETK KP_BLOB 0x382554 1 2 /end IF_DATA BIT_MASK 0xFFFF /end MEASUREMENT
/begin MEASUREMENT perfmin_w "" UWORD rel_q0p025 0 0 0.000000 1638.375000 /begin IF_DATA ASAP1B_ETK KP_BLOB 0x382556 1 2 /end IF_DATA BIT_MASK 0xFFFF /end MEASUREMENT
/begin MEASUREMENT perform_w "" UWORD rel_q0p025 0 0 0.000000 1638.375000 /begin IF_DATA ASAP1B_ETK KP_BLOB 0x382558 1 2 /end IF_DATA BIT_MASK 0xFFFF /end MEASUREMENT
/begin MEASUREMENT peri50ms_w "" UWORD runtime2_sy 0 0 0.000000 838848.000000 /begin IF_DATA ASAP1B_ETK KP_BLOB 0x38255A 1 2 /end IF_DATA BIT_MASK 0xFFFF /end MEASUREMENT
/begin MEASUREMENT phLosCtr_w "ZÑhler Neusynchronisation durch falsche Synchronisation an BM (word)" UWORD dez___UW 0 0 0.000000 65535.000000 /begin IF_DATA ASAP1B_ETK KP_BLOB 0x383C2E 1 2 /end IF_DATA BIT_MASK 0xFFFF /end MEASUREMENT
/begin MEASUREMENT ps_w "Saugrohr-Absolutdruck (Word)" UWORD p_uw_q0p039 0 0 0.000000 2559.960938 /begin IF_DATA ASAP1B_ETK KP_BLOB 0xF99A 0 2 /end IF_DATA BIT_MASK 0xFFFF /end MEASUREMENT
/begin MEASUREMENT ptv "LRHK: P-Anteil fÅr verzîgerte Reglerumschaltung tv, ungewichtet" SBYTE t100msxs_sb_q0p01 0 0 -1.280000 1.270000 /begin IF_DATA ASAP1B_ETK KP_BLOB 0x380CEA 1 1 /end IF_DATA BIT_MASK 0xFF /end MEASUREMENT
/begin MEASUREMENT redhyst "Reduzierstufenhysterese" SBYTE rel_sb_q0p02 0 0 -2.560000 2.540000 /begin IF_DATA ASAP1B_ETK KP_BLOB 0x380C4E 1 1 /end IF_DATA BIT_MASK 0xFF /end MEASUREMENT
/begin MEASUREMENT redist "Ist-Reduzierstufe" UBYTE dez 0 0 0.000000 255.000000 /begin IF_DATA ASAP1B_ETK KP_BLOB 0x380B20 1 1 /end IF_DATA BIT_MASK 0xFF /end MEASUREMENT
/begin MEASUREMENT redneu "neu berechnete Reduzierstufe" UBYTE dez 0 0 0.000000 255.000000 /begin IF_DATA ASAP1B_ETK KP_BLOB 0x380C4F 1 1 /end IF_DATA BIT_MASK 0xFF /end MEASUREMENT
/begin MEASUREMENT redsol "Berechnete Soll-Reduzierstufe" UBYTE dez 0 0 0.000000 255.000000 /begin IF_DATA ASAP1B_ETK KP_BLOB 0x380C50 1 1 /end IF_DATA BIT_MASK 0xFF /end MEASUREMENT
/begin MEASUREMENT redze "Schwelle in Reduzierstufe zwischen ZÅnd- und Einspritzeingriff" UBYTE dez 0 0 0.000000 255.000000 /begin IF_DATA ASAP1B_ETK KP_BLOB 0x380C51 1 1 /end IF_DATA BIT_MASK 0xFF /end MEASUREMENT
/begin MEASUREMENT redzst_w "Reduzierstufe ohne Hysterese und Rundung" UWORD rel_uw_q0p001 0 0 0.000000 65.535000 /begin IF_DATA ASAP1B_ETK KP_BLOB 0x3824D4 1 2 /end IF_DATA BIT_MASK 0xFFFF /end MEASUREMENT
/begin MEASUREMENT resetMonIdx "" UWORD dez___UW 0 0 0.000000 65535.000000 /begin IF_DATA ASAP1B_ETK KP_BLOB 0x383E1C 1 2 /end IF_DATA BIT_MASK 0xFFFF /end MEASUREMENT
/begin MEASUREMENT rk_w "relative Kraftstoffmasse" UWORD rel_uw_b3072 0 0 0.000000 3071.953125 /begin IF_DATA ASAP1B_ETK KP_BLOB 0x381FA6 1 2 /end IF_DATA BIT_MASK 0xFFFF /end MEASUREMENT
/begin MEASUREMENT rlmax_w "maximal erreichbare FÅllung bei Turbo" UWORD rel_uw_q0p0234 0 0 0.000000 1535.976562 /begin IF_DATA ASAP1B_ETK KP_BLOB 0x3822D8 1 2 /end IF_DATA BIT_MASK 0xFFFF /end MEASUREMENT
/begin MEASUREMENT rlmindp_w "Minimale relative FÅllung fÅr Dashpot-Abschaltung" UWORD rel_uw_q0p0234 0 0 0.000000 1535.976562 /begin IF_DATA ASAP1B_ETK KP_BLOB 0x382450 1 2 /end IF_DATA BIT_MASK 0xFFFF /end MEASUREMENT
/begin MEASUREMENT rlmin_w "minimal zulÑssiges rl" UWORD rel_uw_q0p0234 0 0 0.000000 1535.976562 /begin IF_DATA ASAP1B_ETK KP_BLOB 0x381F4C 1 2 /end IF_DATA BIT_MASK 0xFFFF /end MEASUREMENT
/begin MEASUREMENT rlossCtr_w "" UWORD dez___UW 0 0 0.000000 65535.000000 /begin IF_DATA ASAP1B_ETK KP_BLOB 0x38255C 1 2 /end IF_DATA BIT_MASK 0xFFFF /end MEASUREMENT
/begin MEASUREMENT rlshk "Soll-FÅllung hîhenkorrigiert" UBYTE rel_ub_q0p75 0 0 0.000000 191.250000 /begin IF_DATA ASAP1B_ETK KP_BLOB 0x380AFA 1 1 /end IF_DATA BIT_MASK 0xFF /end MEASUREMENT
/begin MEASUREMENT rlsnw "Auswahl zwischen rlsol_w und rlshk zur Adressierung von KFNW" UBYTE rel_ub_q0p75 0 0 0.000000 191.250000 /begin IF_DATA ASAP1B_ETK KP_BLOB 0x380AFD 1 1 /end IF_DATA BIT_MASK 0xFF /end MEASUREMENT
/begin MEASUREMENT rlsol_w "Soll-FÅllung" UWORD rel_uw_q0p0234 0 0 0.000000 1535.976562 /begin IF_DATA ASAP1B_ETK KP_BLOB 0x381F4E 1 2 /end IF_DATA BIT_MASK 0xFFFF /end MEASUREMENT
/begin MEASUREMENT rltedte_w "Aus DTEV ermittelte relative FÅllung Åber das TankentlÅftungsventil" UWORD rel_uw_q0p0234 0 0 0.000000 1535.976562 /begin IF_DATA ASAP1B_ETK KP_BLOB 0x382736 1 2 /end IF_DATA BIT_MASK 0xFFFF /end MEASUREMENT
/begin MEASUREMENT rlugd_w "FÅllung im ungedrosselten Zustand" UWORD rel_uw_q0p0234 0 0 0.000000 1535.976562 /begin IF_DATA ASAP1B_ETK KP_BLOB 0x382476 1 2 /end IF_DATA BIT_MASK 0xFFFF /end MEASUREMENT
/begin MEASUREMENT rlvugd "unkorrigierte FÅllung im ungedrosselten Zustand" UBYTE rel_ub_q0p75 0 0 0.000000 191.250000 /begin IF_DATA ASAP1B_ETK KP_BLOB 0x380C3D 1 1 /end IF_DATA BIT_MASK 0xFF /end MEASUREMENT
/begin MEASUREMENT rstMon_0_A "" UWORD dez___UW 0 0 0.000000 65535.000000 /begin IF_DATA ASAP1B_ETK KP_BLOB 0x383E1E 1 2 /end IF_DATA BIT_MASK 0xFFFF /end MEASUREMENT
/begin MEASUREMENT rstMon_10_A "" UWORD dez___UW 0 0 0.000000 65535.000000 /begin IF_DATA ASAP1B_ETK KP_BLOB 0x383E32 1 2 /end IF_DATA BIT_MASK 0xFFFF /end MEASUREMENT
/begin MEASUREMENT rstMon_11_A "" UWORD dez___UW 0 0 0.000000 65535.000000 /begin IF_DATA ASAP1B_ETK KP_BLOB 0x383E34 1 2 /end IF_DATA BIT_MASK 0xFFFF /end MEASUREMENT
/begin MEASUREMENT rstMon_1_A "" UWORD dez___UW 0 0 0.000000 65535.000000 /begin IF_DATA ASAP1B_ETK KP_BLOB 0x383E20 1 2 /end IF_DATA BIT_MASK 0xFFFF /end MEASUREMENT
/begin MEASUREMENT rstMon_2_A "" UWORD dez___UW 0 0 0.000000 65535.000000 /begin IF_DATA ASAP1B_ETK KP_BLOB 0x383E22 1 2 /end IF_DATA BIT_MASK 0xFFFF /end MEASUREMENT
/begin MEASUREMENT rstMon_3_A "" UWORD dez___UW 0 0 0.000000 65535.000000 /begin IF_DATA ASAP1B_ETK KP_BLOB 0x383E24 1 2 /end IF_DATA BIT_MASK 0xFFFF /end MEASUREMENT
/begin MEASUREMENT rstMon_4_A "" UWORD dez___UW 0 0 0.000000 65535.000000 /begin IF_DATA ASAP1B_ETK KP_BLOB 0x383E26 1 2 /end IF_DATA BIT_MASK 0xFFFF /end MEASUREMENT
/begin MEASUREMENT rstMon_5_A "" UWORD dez___UW 0 0 0.000000 65535.000000 /begin IF_DATA ASAP1B_ETK KP_BLOB 0x383E28 1 2 /end IF_DATA BIT_MASK 0xFFFF /end MEASUREMENT
/begin MEASUREMENT rstMon_6_A "" UWORD dez___UW 0 0 0.000000 65535.000000 /begin IF_DATA ASAP1B_ETK KP_BLOB 0x383E2A 1 2 /end IF_DATA BIT_MASK 0xFFFF /end MEASUREMENT
/begin MEASUREMENT rstMon_7_A "" UWORD dez___UW 0 0 0.000000 65535.000000 /begin IF_DATA ASAP1B_ETK KP_BLOB 0x383E2C 1 2 /end IF_DATA BIT_MASK 0xFFFF /end MEASUREMENT
/begin MEASUREMENT rstMon_8_A "" UWORD dez___UW 0 0 0.000000 65535.000000 /begin IF_DATA ASAP1B_ETK KP_BLOB 0x383E2E 1 2 /end IF_DATA BIT_MASK 0xFFFF /end MEASUREMENT
/begin MEASUREMENT rstMon_9_A "" UWORD dez___UW 0 0 0.000000 65535.000000 /begin IF_DATA ASAP1B_ETK KP_BLOB 0x383E30 1 2 /end IF_DATA BIT_MASK 0xFFFF /end MEASUREMENT
/begin MEASUREMENT SLSlokBits "" UWORD dez___UW 0 0 0.000000 65535.000000 /begin IF_DATA ASAP1B_ETK KP_BLOB 0x380ED2 1 2 /end IF_DATA BIT_MASK 0xFFFF /end MEASUREMENT
/begin MEASUREMENT swOffDlBits "" UWORD dez___UW 0 0 0.000000 65535.000000 /begin IF_DATA ASAP1B_ETK KP_BLOB 0x383CCE 1 2 /end IF_DATA BIT_MASK 0xFFFF /end MEASUREMENT
/begin MEASUREMENT tansst "Ansaugluft - Temperatur bei start" UBYTE temp_ub_q0p75_o48 0 0 -48.000000 143.250000 /begin IF_DATA ASAP1B_ETK KP_BLOB 0x380CDF 1 1 /end IF_DATA BIT_MASK 0xFF /end MEASUREMENT
/begin MEASUREMENT tevfa_w "effektive Einspritzzeit vor Feinabgleich (word)" UWORD tinjection_sy 0 0 0.000000 209.712000 /begin IF_DATA ASAP1B_ETK KP_BLOB 0x381FB0 1 2 /end IF_DATA BIT_MASK 0xFFFF /end MEASUREMENT
/begin MEASUREMENT te_w "effektive Einspritzzeit (word)" UWORD tinjection_sy 0 0 0.000000 209.712000 /begin IF_DATA ASAP1B_ETK KP_BLOB 0x381FB4 1 2 /end IF_DATA BIT_MASK 0xFFFF /end MEASUREMENT
/begin MEASUREMENT ti2_w "Einspritzzeit fÅr Zylinder 2 (word)" UWORD tinjection5_sy 0 0 0.000000 1048.560000 /begin IF_DATA ASAP1B_ETK KP_BLOB 0x381FB6 1 2 /end IF_DATA BIT_MASK 0xFFFF /end MEASUREMENT
/begin MEASUREMENT ti_b1 "Einspritzzeit fÅr EV's auf Bank1" UWORD tinjection_sy 0 0 0.000000 209.712000 /begin IF_DATA ASAP1B_ETK KP_BLOB 0x381FB8 1 2 /end IF_DATA BIT_MASK 0xFFFF /end MEASUREMENT
/begin MEASUREMENT ti_b2 "Einspritzzeit fÅr EV's auf Bank2" UWORD tinjection_sy 0 0 0.000000 209.712000 /begin IF_DATA ASAP1B_ETK KP_BLOB 0x381FBA 1 2 /end IF_DATA BIT_MASK 0xFFFF /end MEASUREMENT
/begin MEASUREMENT ti_tvu_w "BatteriespannungsabhÑngige Einspritzzeitkorrektur CPU-Quantisierung" UWORD tinjection_sy 0 0 0.000000 209.712000 /begin IF_DATA ASAP1B_ETK KP_BLOB 0xF9B0 0 2 /end IF_DATA BIT_MASK 0xFFFF /end MEASUREMENT
/begin MEASUREMENT ti_w "Einspritzzeit fÅr Zylinder 1 (word)" UWORD tinjection5_sy 0 0 0.000000 1048.560000 /begin IF_DATA ASAP1B_ETK KP_BLOB 0x381FBC 1 2 /end IF_DATA BIT_MASK 0xFFFF /end MEASUREMENT
/begin MEASUREMENT tmotlin "Motortemperatur, linearisiert und umgerechnet" UBYTE temp_ub_q0p75_o48 0 0 -48.000000 143.250000 /begin IF_DATA ASAP1B_ETK KP_BLOB 0x380B5B 1 1 /end IF_DATA BIT_MASK 0xFF /end MEASUREMENT
/begin MEASUREMENT tnachl_w "SG-Nachlaufzeit" UWORD t100msxs_uw_b6553p6 0 0 0.000000 6553.500000 /begin IF_DATA ASAP1B_ETK KP_BLOB 0x383CD0 1 2 /end IF_DATA BIT_MASK 0xFFFF /end MEASUREMENT
/begin MEASUREMENT tnmax_w "Zeit bis zur Umschaltung der Abstimmung der Drehzahlbegrenzung" UWORD t10msxs_uw_b655p35 0 0 0.000000 655.350000 /begin IF_DATA ASAP1B_ETK KP_BLOB 0x3824AE 1 2 /end IF_DATA BIT_MASK 0xFFFF /end MEASUREMENT
/begin MEASUREMENT tnmxh_w "Timer abwÑrts fÅr Zeit oberhalb der unteren Drehzahlgrenze" UWORD t10msxs_uw_b655p35 0 0 0.000000 655.350000 /begin IF_DATA ASAP1B_ETK KP_BLOB 0x3824C2 1 2 /end IF_DATA BIT_MASK 0xFFFF /end MEASUREMENT
/begin MEASUREMENT tnscCtr_w "" UWORD t20msxs_uw_q0p02 0 0 0.000000 1310.700000 /begin IF_DATA ASAP1B_ETK KP_BLOB 0x3824DC 1 2 /end IF_DATA BIT_MASK 0xFFFF /end MEASUREMENT
/begin MEASUREMENT tnsofCtr "" UBYTE t20msxs_ub_b5p1 0 0 0.000000 5.100000 /begin IF_DATA ASAP1B_ETK KP_BLOB 0x380C54 1 1 /end IF_DATA BIT_MASK 0xFF /end MEASUREMENT
/begin MEASUREMENT tsaka "Timer Schubdauer fÅr Katalysator-AusrÑumen" UBYTE t20msxs_ub_b5p1 0 0 0.000000 5.100000 /begin IF_DATA ASAP1B_ETK KP_BLOB 0x380CE4 1 1 /end IF_DATA BIT_MASK 0xFF /end MEASUREMENT
/begin MEASUREMENT tvlrh "LRHK: Korrekturwert fÅr verzîgerte Reglerumschaltung tv" SBYTE t100msxs_sb_q0p01 0 0 -1.280000 1.270000 /begin IF_DATA ASAP1B_ETK KP_BLOB 0x380CEB 1 1 /end IF_DATA BIT_MASK 0xFF /end MEASUREMENT
/begin MEASUREMENT tvlrh2 "LRHK: Korrekturwert fÅr verzîgerte Reglerumschaltung tv 2" SBYTE t100msxs_sb_q0p01 0 0 -1.280000 1.270000 /begin IF_DATA ASAP1B_ETK KP_BLOB 0x380CEC 1 1 /end IF_DATA BIT_MASK 0xFF /end MEASUREMENT
/begin MEASUREMENT tvlrhi "I-Anteil fÅr verzîgerte Reglerumschaltung tv, gewichtet" SBYTE t100msxs_sb_q0p01 0 0 -1.280000 1.270000 /begin IF_DATA ASAP1B_ETK KP_BLOB 0x380CED 1 1 /end IF_DATA BIT_MASK 0xFF /end MEASUREMENT
/begin MEASUREMENT tvlrhi2 "Bank2: I-Anteil fÅr verzîgerte Reglerumschaltung tv, gewichtet" SBYTE t100msxs_sb_q0p01 0 0 -1.280000 1.270000 /begin IF_DATA ASAP1B_ETK KP_BLOB 0x380CEE 1 1 /end IF_DATA BIT_MASK 0xFF /end MEASUREMENT
/begin MEASUREMENT tvlrhp "P-Anteil fÅr verzîgerte Reglerumschaltung tv, gewichtet" SBYTE t100msxs_sb_q0p01 0 0 -1.280000 1.270000 /begin IF_DATA ASAP1B_ETK KP_BLOB 0x380CEF 1 1 /end IF_DATA BIT_MASK 0xFF /end MEASUREMENT
/begin MEASUREMENT tvu_w "Batteriespannungskorrektur" UWORD tinjection_sy 0 0 0.000000 209.712000 /begin IF_DATA ASAP1B_ETK KP_BLOB 0x38201C 1 2 /end IF_DATA BIT_MASK 0xFFFF /end MEASUREMENT
/begin MEASUREMENT ushk "Spannung Lambdasonde hinter Katalysator" UBYTE spg_ub_q0p0052_o0p2 0 0 -0.200000 1.130000 /begin IF_DATA ASAP1B_ETK KP_BLOB 0x380A71 1 1 /end IF_DATA BIT_MASK 0xFF /end MEASUREMENT
/begin MEASUREMENT usrhk2 "aktuelle Regelschwelle Lambdasignal h.K., Bank 2" UBYTE spg_ub_q0p0052_o0p2 0 0 -0.200000 1.130000 /begin IF_DATA ASAP1B_ETK KP_BLOB 0x380CF1 1 1 /end IF_DATA BIT_MASK 0xFF /end MEASUREMENT
/begin MEASUREMENT usvk "Spannung Lambdasonde vor Kat" UBYTE spg_ub_q0p0052_o0p2 0 0 -0.200000 1.130000 /begin IF_DATA ASAP1B_ETK KP_BLOB 0x380A81 1 1 /end IF_DATA BIT_MASK 0xFF /end MEASUREMENT
/begin MEASUREMENT usvk2 "Spannung Lambdasonde vor Kat 2" UBYTE spg_ub_q0p0052_o0p2 0 0 -0.200000 1.130000 /begin IF_DATA ASAP1B_ETK KP_BLOB 0x380A82 1 1 /end IF_DATA BIT_MASK 0xFF /end MEASUREMENT
/begin MEASUREMENT vsdmr "Vorgabe Drehmomentreserve Åber Verstellsystem VSxy" UBYTE rel_ub_q0p3906___UB 0 0 0.000000 99.609375 /begin IF_DATA ASAP1B_ETK KP_BLOB 0x3809A5 1 1 /end IF_DATA BIT_MASK 0xFF /end MEASUREMENT
/begin MEASUREMENT wnwiaw_w "adapt. Winkel wnwi_ad_w der bei Verstell. der Ausla·-NW mit -1 multipl. wird" SWORD kw_sw_b128 0 0 -128.000000 127.996094 /begin IF_DATA ASAP1B_ETK KP_BLOB 0x381F58 1 2 /end IF_DATA BIT_MASK 0xFFFF /end MEASUREMENT
/begin MEASUREMENT wnwia_w "Auswahl zwischen wnwi_w und wnwi2_w" SWORD kw_q0p0039 0 0 -128.000000 127.996094 /begin IF_DATA ASAP1B_ETK KP_BLOB 0x381F5A 1 2 /end IF_DATA BIT_MASK 0xFFFF /end MEASUREMENT
/begin MEASUREMENT wnwi_ad_w "Winkeldifferenz zwischen adaptierter und aktueller Phasenflanke (word)" SWORD kw_sw_b128 0 0 -128.000000 127.996094 /begin IF_DATA ASAP1B_ETK KP_BLOB 0x381AB0 1 2 /end IF_DATA BIT_MASK 0xFFFF /end MEASUREMENT
/begin MEASUREMENT wnwse "Sollwinkel fÅr EInla·nockenwelle" UBYTE kw_q0p25 0 0 0.000000 63.750000 /begin IF_DATA ASAP1B_ETK KP_BLOB 0x380AFF 1 1 /end IF_DATA BIT_MASK 0xFF /end MEASUREMENT
/begin MEASUREMENT wnwue_w "Winkel Nockenwellenueberschneidung" UWORD kw_q0p0019 0 0 0.000000 127.998047 /begin IF_DATA ASAP1B_ETK KP_BLOB 0x381F5C 1 2 /end IF_DATA BIT_MASK 0xFFFF /end MEASUREMENT
/begin MEASUREMENT zatv "Integrationsgeschindigkeit I-Anteil  Regelung hinter Kat" UBYTE tgrad_ub_q0p039 0 0 0.000000 9.960938 /begin IF_DATA ASAP1B_ETK KP_BLOB 0x380CF2 1 1 /end IF_DATA BIT_MASK 0xFF /end MEASUREMENT
/begin MEASUREMENT zdash_w "Zeitkonstante Dashpot" UWORD zk10msxs_uw_b655 0 0 0.010000 655.360000 /begin IF_DATA ASAP1B_ETK KP_BLOB 0x382452 1 2 /end IF_DATA BIT_MASK 0xFFFF /end MEASUREMENT
/begin MEASUREMENT zlsd_w "Zeitkonstante PT2-Filter LastschlagdÑmpfung" UWORD zk10msxs_uw_b655 0 0 0.010000 655.360000 /begin IF_DATA ASAP1B_ETK KP_BLOB 0x382454 1 2 /end IF_DATA BIT_MASK 0xFFFF /end MEASUREMENT
/begin MEASUREMENT zphflsyn "PhasenflankenzÑhler bei Erkennen der Motorposition im Notlauf DG" UBYTE dez 0 0 0.000000 255.000000 /begin IF_DATA ASAP1B_ETK KP_BLOB 0x380A62 1 1 /end IF_DATA BIT_MASK 0xFF /end MEASUREMENT
/begin MEASUREMENT zrph "ZÑhler Raster Phasensignal" UBYTE dez 0 0 0.000000 255.000000 /begin IF_DATA ASAP1B_ETK KP_BLOB 0x380A5D 1 1 /end IF_DATA BIT_MASK 0xFF /end MEASUREMENT
/begin MEASUREMENT zwbas "BasiszÅndwinkel" SBYTE zw_sb_q0p75 0 0 -96.000000 95.250000 /begin IF_DATA ASAP1B_ETK KP_BLOB 0xF9F6 0 1 /end IF_DATA BIT_MASK 0xFF /end MEASUREMENT
/begin MEASUREMENT zwist "Ist-ZÅndwinkel" SBYTE zw_sb_q0p75 0 0 -96.000000 95.250000 /begin IF_DATA ASAP1B_ETK KP_BLOB 0xF9F7 0 1 /end IF_DATA BIT_MASK 0xFF /end MEASUREMENT
/begin MEASUREMENT zwopt "optimaler ZÅndwinkel" SBYTE zw_sb_q0p75 0 0 -96.000000 95.250000 /begin IF_DATA ASAP1B_ETK KP_BLOB 0x380C47 1 1 /end IF_DATA BIT_MASK 0xFF /end MEASUREMENT
/begin MEASUREMENT zwoptl1 "optimaler ZÅndwinkel bei Lambda=1" SBYTE zw_sb_q0p75 0 0 -96.000000 95.250000 /begin IF_DATA ASAP1B_ETK KP_BLOB 0x380C48 1 1 /end IF_DATA BIT_MASK 0xFF /end MEASUREMENT
/begin MEASUREMENT zwsol "Soll-ZÅndwinkel aus Momenteneingriff" SBYTE zw_sb_q0p75 0 0 -96.000000 95.250000 /begin IF_DATA ASAP1B_ETK KP_BLOB 0x380D16 1 1 /end IF_DATA BIT_MASK 0xFF /end MEASUREMENT
/begin MEASUREMENT zzyl "SW-ZylinderzÑhler" UBYTE dez 0 0 0.000000 255.000000 /begin IF_DATA ASAP1B_ETK KP_BLOB 0xF89A 0 1 /end IF_DATA BIT_MASK 0xFF /end MEASUREMENT
/begin FUNCTION LREB "131.30    Lambdaregelung Einschaltbedingungen"
 /begin REF_CHARACTERISTIC USR TSBBVTMS TRAU TMSHS TMRAK TMRA2 TMRA1 TLRZWTMS TLRVAM TLRTMS TLRHS TLRBAM TASHS TARAU STM08LEUB RLRVAO RLLRUN RLLRTMO RLLRSHB NLRSHB IMLSALR DTMTMRW DTMR CLRZWTMS CLRMSFS /end REF_CHARACTERISTIC
 /begin LOC_MEASUREMENT usvk2 usvk tmst tmrw tmotlin tmot tansst tans rl nmot ml_w lamsons_w imlrsa_w fr_w fr2_w flglrs2 flglrs esst_stm08leub B_vag B_tmlr B_temin B_tarau B_stend B_st B_slsoff B_sls B_sbbvk B_sa B_pspwl B_pspaus B_nolrw2 B_nolrw B_nolre2 B_nolre B_nolrb2 B_nolrb B_mslr2 B_mslr B_msfslr2 B_msfslr B_mlrsa B_mdkat B_lrwla B_lrvk2 B_lrvk B_lrrl B_lrpspa B_lrnda2 B_lrnda B_lrnd2 B_lrnd B_lrebri2 B_lrebri B_lrebpr2 B_lrebpr B_lreble2 B_lreble B_lreb100 B_lr2s2 B_lr2s B_lr2 B_lr B_ll B_fslr2 B_fslr B_evloc B_esls B_eobdlr2 B_eobdlr B_eev B_dslsk B_dsls B_craus B_bvdel B_bag /end LOC_MEASUREMENT
/end FUNCTION
/begin FUNCTION LRHK "33.20     FÅhrungsregelung mit Sonde hinter KAT (OBDII)"
 /begin REF_CHARACTERISTIC ZLRHML ZLASOHML ZLASHKAB TKATMLRH2 TKATMLRH TBLRH2 TBLRH SRL06LHUB SNM08LHUB SNM06LHUB SML08LHUB RLLRHUN RLLRHON PLRHML PLRHAV NLRHU NLRHO MLNKAX LASHKAB LALIUSRH LALIUSH KFUSHK KFFTV KDLASHKP KDLASHKI CLRHK ATVMX ATVMN ATVINI2 ATVINI /end REF_CHARACTERISTIC
 /begin LOC_MEASUREMENT zatv usrhk2 usrhk ushk_w tvlrhp tvlrhi2 tvlrhi tvlrh2 tvlrh tkatm rl ptv percnt_w nmot ml_w mlnka_w ml LRHKlokbits lamsonh_w lamsonh2_w lamsolh_w lamsolh2_w lamhm_w lamhf_w lahkmz idlashkm_w iavkatf ftv E_teve2 E_teve E_tes E_sls E_lm E_lash2 E_lash E_kat E_hsv2 E_hsv E_hsh esst_srl06lhub esst_snm08lhub esst_snm06lhub esst_sml08lhub dlashkp_w dlashkm_w dlashki_w dlahkab_w B_tehb B_st B_sbbhk B_pwf B_mdarv B_lrsp2 B_lrsp B_lrka B_lrhkp B_lrhkgi B_lrhkg B_lrhkb B_lrhk2 B_lrhk B_lr2 B_lr B_falsh B_edkvs B_dsls B_atvini avkatf atvinii atv2 atv /end LOC_MEASUREMENT
/end FUNCTION
/begin FUNCTION LRINI "1.0       Lambdaregelung, Koordination der Initialisierung"
 /begin LOC_MEASUREMENT frini_w frini2_w frdter_w B_lrnd2 B_lrnd B_frini2 B_frini B_dtefrr /end LOC_MEASUREMENT
/end FUNCTION
/begin FUNCTION LRKA "15.20     Zweipunkt-Lambdaregelung mit tv : Funkt. KAT-AusrÑumen von Sauerstoff"
 /begin REF_CHARACTERISTIC USVKAMX USHKAMX USHKAMN TSAKAMN TDFRKAU TDFRKAD SML05LKUB NLRKA LAMKAML2 LAMKAML IMLKAXTK IMLAKMN ILMLKAXTK FMLKAMA FLMLKAPR FLMLKAMA FKAXAVKAT FFWEKA DTVKAML2 DTVKAML CLRKA /end REF_CHARACTERISTIC
 /begin LOC_MEASUREMENT usvk ushk tsaka tkatm_w nmot ml_w ml lrkaz lamsons_w lamsnka_w lamka_w lamkai_w lamkaii_w imlka_w imlkax_w imlkav_w ilmlka_w ilmlkax_w ilmlkav_w ilmlkat_w ilmlkam_w ilmlkah_w fwe favkatmx esst_sml05lkub dtvkai dtvka B_sls B_sbbhk B_sa B_lrkast B_lrkarg B_lrkaon B_lrkaei B_lrkae B_lrkaa B_lrka B_kawe B_ilmlkat B_blrka B_bevab avkatf /end LOC_MEASUREMENT
/end FUNCTION
/begin FUNCTION MDAUTG "2.60      Berechnung des Istmomentes fÅr die Getriebesteuerung"
 /begin LOC_MEASUREMENT mizwmn_w mivmx_w mivbeb_w miszul_w minmx_w mimsr_w miistoar_w mifa_w mibgr_w mibas_w miautgs_w miautget_w miasrs_w dmllr_w dmaufr_w B_zwvz B_sab B_mibeg B_lsd B_ll B_kw B_kh B_fil B_dash /end LOC_MEASUREMENT
/end FUNCTION
/begin FUNCTION MDBAS "8.10      Berechnung der Basisgrî·en fÅr Momentenschnittstelle"
 /begin REF_CHARACTERISTIC SRL11OPUW SNM16OPUW KFZWOP2 KFZWOP KFMIOP KFDZWOAGR ETALAM ETADZW DZWOM DZWOLA AGRRMAX /end REF_CHARACTERISTIC
 /begin LOC_MEASUREMENT zwoptl1 zwopt zwbas tmot rl_w_kge rl_w nmot_w nmot miopt_w mioptl1_w mibas_w lambas fnwue etazwbm etazwb etatrmn etalab esst_srl11opuw esst_snm16opuw dzw_kge dzwotm dzwol dzwoag dzwnwsu dzwb B_agr agrr /end LOC_MEASUREMENT
/end FUNCTION
/begin FUNCTION MDBGRG "4.30      Gear dependet torque limitation" /begin REF_CHARACTERISTIC KFMDBGRG /end REF_CHARACTERISTIC /begin LOC_MEASUREMENT nmot mibgr_w gangi /end LOC_MEASUREMENT /end FUNCTION
/begin FUNCTION MDFAW "12.90     Fahrerwunschberechnung"
 /begin REF_CHARACTERISTIC VLSD VDASH TVFSAWE TDMLSDS TDMFWEMI TDMFBWE TDMFBSA SNM06MDUW SGA08MDUB NGFSAWE MRFAVLN MRFALLU MRFALLO MKMIFABG MKFADPN MIFABGMX MDIMX KFZLSD_1_A KFZLSD_0_A KFZDASH_1_A KFZDASH_0_A KFZDASH2 KFPEDR KFPED KFMILSD_1_A KFMILSD_0_A KFMIFALS KFMIFABG KFDMLSDS KFDMLSDO_1_A KFDMLSDO_0_A KFDMDPO_1_A KFDMDPO_0_A KFDLSD_1_A KFDLSD_0_A DRLMINDP DMRFAWE DMLSDUG_1_A DMLSDUG_0_A DMIFLSD DMDPUG_1_A DMDPUG_0_A CWDMFAB /end REF_CHARACTERISTIC
 /begin LOC_MEASUREMENT zlsd_w zdash_w wped_w vfzg rl_w rlmin_w rlmindp_w nmot_w ngfil_w mrped_w mrfgr_w mrfa_w mrfamx_w mkfa_w mkfanb_w mizwmn_w mivbeg_w mivbeb_w minbeg_w mimin_w mimax_w miistoar_w migef_w mifa_w mifal_w mifabg_w mifa miblsd_w mibdp_w mdverl_w mdgrad_w gangi esst_snm06mduw esst_sga08mdub dmverl_w dmlsdu_w dmlsdo_w dmllri_w dmgbeg_w dmdpu_w dmdpo_w dmbebl_w dlsd_w B_vnull B_vl B_stend B_sab B_sa B_nmot B_mifabg B_mgbget B_mgbgakt B_lsd B_ls B_llvfgr B_ll B_kupplv B_kuppl B_iflsd B_gwhs B_fil B_fgr B_elsd B_edp B_dp B_dashv B_dash B_asr /end LOC_MEASUREMENT
/end FUNCTION
/begin FUNCTION MDFUE "8.40      Sollwertvorgabe fÅr Luftmasse aus Sollmoment"
 /begin REF_CHARACTERISTIC ZKDRLSOL STM04FEUB SNM12FEUB KFRLMNSA KFRLMN KFMIRL FRLMNHO /end REF_CHARACTERISTIC
 /begin LOC_MEASUREMENT tmot rltedte_w rlsol_w rlmin_w rlmax_w nmot_w nmot misopl1_w milsol_w fho etazwbm etalab esst_stm04feub esst_snm12feub drlsol_w drlsolf_w B_sa B_mdmin /end LOC_MEASUREMENT
/end FUNCTION
/begin FUNCTION MDIST "10.2      Motormomentenberechnung" /begin REF_CHARACTERISTIC ETADZW /end REF_CHARACTERISTIC
 /begin LOC_MEASUREMENT zwopt zwist redist miopt_w miist_w mdindg_w etazwist etazaist dzw_kge dzwi /end LOC_MEASUREMENT
/end FUNCTION
/begin FUNCTION MDKOG "14.30     Drehmomentenkoordination fÅr Gesamteingriffe" /begin REF_CHARACTERISTIC TPNSMD TMVER NASNOT MDIMX MDHYST CWZWVMX CWTEZW CWMDKOG /end REF_CHARACTERISTIC
 /begin LOC_MEASUREMENT rlsol_w rlmin_w nmot mizsol_w mizsolv_w mivmx_w mitebg_w miszul_w misol_w misolv_w miopt_w minmx_w mimsr_w mimax_w milres_w migs_w mifa_w mifab_w miext_w miextv_w mibgr_w mibeg_w mibas_w miasrs_w miasrl_w etazwb dmzms_w dmrllr_w dmrkt_w dmrkh dmllr_w dmar_w B_zwvz B_zwvs B_zwnget B_zwget B_stend B_msr B_mibegdau B_mibeg B_mgbget B_mdein B_lsd B_llrein B_ll B_kw B_kupplv B_kh B_fil B_dash B_asr /end LOC_MEASUREMENT
/end FUNCTION
/begin FUNCTION MDKOL "10.80     Momentenkoordination auf FÅllungsebene" /begin REF_CHARACTERISTIC NASNOT MDIMX /end REF_CHARACTERISTIC
 /begin LOC_MEASUREMENT vsdmr nmot mivmx_w mitebg_w miszul_w minmx_w mimsr_w milsol_w milres_w miges_w mifa_w mifal_w mifafu_w mibgr_w miasrl_w etazwmn etazwbm dmrllr_w dmrkt_w dmrkh dmllrl_w B_mifabg B_mibeg B_lsd B_llrein B_dashv /end LOC_MEASUREMENT
/end FUNCTION
/begin FUNCTION MDMAX "1.40      Berechnung maximales indiziertes Motormoment" /begin REF_CHARACTERISTIC SRL11OPUW RLVSMXN RLVMXN KFMIOP FRLKEVT FMIVL /end REF_CHARACTERISTIC
 /begin LOC_MEASUREMENT rl_w_kge rlvugd rlugd_w rlmax_w nmot mimxl1_w mimax_w fho_w evtmod esst_srl11opuw esst_snm16opuw B_su /end LOC_MEASUREMENT
/end FUNCTION
/begin FUNCTION MDMIN "1.40      Minimales Motormoment" /begin REF_CHARACTERISTIC KFMIMN /end REF_CHARACTERISTIC
 /begin LOC_MEASUREMENT nmot_w nmotll mistt mimin_w mimins_w mill_w mdverf_w gangi fnstab_w B_sab /end LOC_MEASUREMENT
/end FUNCTION
/begin FUNCTION MDNSTAB "1.10      Drehmoment: Drehzahlstabilisierung" /begin REF_CHARACTERISTIC FNSTABNV /end REF_CHARACTERISTIC /begin LOC_MEASUREMENT nver_w nstat nmot_w fnstab_w B_mdnstab /end LOC_MEASUREMENT /end FUNCTION
/begin FUNCTION MDRED "4.30      Berechnung Reduzierstufe aus Momentenanforderung" /begin REF_CHARACTERISTIC REDZEM REDMXSA REDHYUC REDHYOC MDHYEZ DMIZWMN CREDSTU /end REF_CHARACTERISTIC
 /begin LOC_MEASUREMENT tmot redzst_w redze redsol redneu redist redhyst mizwmn_w misol_w miopt_w mibas_w etazwmn B_zmsoff B_sab B_sa B_nmax B_msr B_mdredhyein B_mdee B_dkpu B_dknolu B_asr /end LOC_MEASUREMENT
/end FUNCTION
/begin FUNCTION MDTRIP "1.20      Berechnung der Momentenreserve im Kurztrip"
 /begin LOC_MEASUREMENT dmrlsv_w dmrlsh_w dmrlash_w dmrkt_w dmrdsls_w dmrdkt_w dmrdagr_w /end LOC_MEASUREMENT
/end FUNCTION
/begin FUNCTION MDVER "5.30      Motor-Verlustmoment" /begin REF_CHARACTERISTIC ZMDNSM ZFMDVERL MDSM MDSH KFMDS DMDNSM CNFMDVER /end REF_CHARACTERISTIC
 /begin LOC_MEASUREMENT tmot rl_w nmot_w mdwan_w mdverl_w mdverf_w mdverb mds_w fho esst_stm06__ub dmverl_w dmvad_w B_sa B_llrein /end LOC_MEASUREMENT
/end FUNCTION
/begin FUNCTION MDVERAD "4.50      Adaption Verlustmoment"
 /begin REF_CHARACTERISTIC ZKDMADLL ZKDMADKO ZKDMADFS ZKDMADFK TWDMAD TMDMAD DMADMXLL DMADMXKO DMADMXFS DMADMXFK DMADMNLL DMADMNKO DMADMNFS DMADMNFK DMADLL DMADKO DMADFS DMADFK CDWVERAD /end REF_CHARACTERISTIC
 /begin LOC_MEASUREMENT tmot MDVERADlokbits dmvamxll_w dmvamxko_w dmvamxfs_w dmvamxfk_w dmvamnll_w dmvamnko_w dmvamnfs_w dmvamnfk_w dmvad_w dmvadll_w dmvadko_w dmvadfs_w dmvadfk_w dmllri_w B_vllr B_pwf B_nswo1 B_madll B_madko B_madfs B_madfk B_llrein B_llr B_koe B_fs B_dtes B_cvtad B_adwko B_adwfs B_adwfk /end LOC_MEASUREMENT
/end FUNCTION
/begin FUNCTION MDVERB "12.30     Momentenbedarf der Nebenaggregate (z.B. Klimaanlage, sonst. Verbraucher)"
 /begin REF_CHARACTERISTIC ZKMDSLP ZKMDKO MDSLPE MDSLP MDSL LWSER KFMDKO KFDMDKOE DMDLWS CNFSL /end REF_CHARACTERISTIC
 /begin LOC_MEASUREMENT tans nmot mdverb mdslpf mdko lws_w lws dmrac B_slp B_sl B_lwser B_koe B_acres /end LOC_MEASUREMENT
/end FUNCTION
/begin FUNCTION MDWAN "6.50      Drehmomentaufnahme des Wandlers"
 /begin REF_CHARACTERISTIC ZKMDWF ZKMDWAUF ZKMDWAB ZKDMDW UEVERG TVFUE TVFSREM TVFSRAM TVFSEM TVFSAM STM08MDUB MDWANER MDATRM MDATNM KFMDWMX FVDMDWAN FNRAD FMDWAT FDMDWAN FABMDWA DMDWM DMDWHYS CNFMDWAN /end REF_CHARACTERISTIC
 /begin LOC_MEASUREMENT vfzg_w vfzg tmot qntns nturbv nturb nstat mdwan_w mdwanvf_w mdwancan gangi esst_stm08mdub dnturb dmrwan dmdwan_w B_rgang B_mdwaner B_fsu B_fs B_dmrwan B_autget /end LOC_MEASUREMENT
/end FUNCTION
/begin FUNCTION MDZUL "4.10      Berechnung maximal zulÑssiges indiziertes Moment"
 /begin REF_CHARACTERISTIC TNSOF TNSC TMNSMN TFMIZU TANSMN SWP08OPUB SNM08OPUB SMO08OPUB NSTEND NSTART MDIMX KFMIZUOF KFMIZUNS KFMIZUFIL /end REF_CHARACTERISTIC
 /begin LOC_MEASUREMENT wped tnsofCtr tnscCtr_w tmot tans nmot mizuvfil mizuofil mizufil_w miszul_w esst_swp08opub esst_snm08opub esst_smo08opub B_nsend B_nsakt B_mzns_um B_mzns B_msr B_fgr /end LOC_MEASUREMENT
/end FUNCTION
/begin FUNCTION MDZW "1.110     Berechnung Moment in SollzÅndwinkel" /begin REF_CHARACTERISTIC DZWETA DMAUFN /end REF_CHARACTERISTIC
 /begin LOC_MEASUREMENT zwsol zwopt redist nmot_w mizwmn_w mizsol_w misol_w miopt_w mibas_w etazws etazaist dzws dmaufr_w B_zwvzm B_zwvz B_zwvs B_nozwe /end LOC_MEASUREMENT
/end FUNCTION
/begin FUNCTION MOTAUS "5.20      Motor-Abstellen" /begin REF_CHARACTERISTIC UBNLMN TNLSGMX TNLSGMN /end REF_CHARACTERISTIC
 /begin LOC_MEASUREMENT ub tnachl_w swOffDlBits B_pwf B_nlwst B_nlwfs B_nlsiko B_nlsgls B_nlobd B_nlmls B_nlEEPR B_nldte B_nlcan B_nlatm B_nlale B_nlacls B_nachlstp B_nachlend B_nachl B_kl15 /end LOC_MEASUREMENT
/end FUNCTION
/begin FUNCTION NLDG "2.10      Notlauf Drehzahlgeber" /begin LOC_MEASUREMENT zphflsyn B_synnldg B_phnldg B_nldg /end LOC_MEASUREMENT /end FUNCTION
/begin FUNCTION NLPH "4.10      Notlauf Phasengeber"
 /begin LOC_MEASUREMENT zzyl phLosCtr_w B_pwf B_phsok B_phase B_nosynph B_nldg B_delaysyn B_bm /end LOC_MEASUREMENT
/end FUNCTION
/begin FUNCTION NMAXMD "4.40      Drehmomentanforderung von NMAX-Regelung"
 /begin REF_CHARACTERISTIC VNMX TNMXPR TNMXH TNMAXP TMOTNMX SRL08NXUB SGA08MDUB NMXPRLG NMXPG NMXDKPU NMXDAEF NMAXOG NMAXNL NMAXDVG NMAXDV NMAX MDIMX KINMXRLG KINMXG ITNMXH ITNMAXP DNMAXH DNMAX /end REF_CHARACTERISTIC
 /begin LOC_MEASUREMENT wped vfzg tnmxh_w tnmax_w tmot rl nsber_w nmxpr nmot_w nmotpr_w nmax_w nmaxdvg_w ngfil_w minmx_w minmxb_w mifab_w mifabh_w kinmx itnmxh_w itnmaxp_w gangi esst_srl08nxub esst_sga08mdub dnsi_w dmnmxp_w dmnmxi_w B_tnmax B_nmaxd B_nmax B_nldg B_dkpu B_dknolu B_autget /end LOC_MEASUREMENT
/end FUNCTION
/begin FUNCTION NWS "55.40     Nockenwellensteuerung"
 /begin REF_CHARACTERISTIC ZKWNWI WNWUEMXT WNWUEMNT WNWIMXT WNWEOA WNWASA TVNW_S TVNWSTTM TVNWS TVNWNST TVNWGE TVNWF TMNWWLU TMNWWLO TMNW TANW NWSUS NWSOS NFANWS KLNWRLTM KFNWWL KFNW DWNWEMXT CWNWS CWNWLL CWNWGE CWMDAPP /end REF_CHARACTERISTIC
 /begin LOC_MEASUREMENT wnwue_w wnwue wnwse wnwi_ad_w wnwia_w wnwiaw_w tnst_w tmot tans rlsol_w rlsnwtm rlsnw rlshk rl nwskf nmot fnwue B_vl B_nw_s B_nwsb B_nwsa B_nws B_ll B_kh B_gsch B_fanws B_fa B_dkpu B_dknolu /end LOC_MEASUREMENT
/end FUNCTION
/begin FUNCTION OBP_CAN "" /end FUNCTION
/begin FUNCTION PHAS "" /begin LOC_MEASUREMENT zrph /end LOC_MEASUREMENT /end FUNCTION
/begin FUNCTION PK "" /end FUNCTION
/begin FUNCTION PROKON "4.20      Projektkonfiguration"
 /begin REF_CHARACTERISTIC NSWO2 NSWO1 CWUHR CWTF CWSLS CWOBD CWMDAPP CWLSHA CWKONLS CWKONFZ1_3_A CWKONFZ1_2_A CWKONFZ1_1_A CWKONFZ1_0_A CWKONABG CWKLIMA CWERFIL CSCATT CDWVERAD CDTES CDTANKL CDSWE_3_A CDSWE_2_A CDSWE_1_A CDSWE_0_A CDSLSE CDSLS CDNWS CDMD CDLSV CDLSH CDLSA CDLLR CDLDP CDLATV CDLATP CDLASH CDKVS CDKAT CDHSVE CDHSV CDHSHE CDHSH CDDST CDATS CDATR CDAGRL CDAGR /end REF_CHARACTERISTIC
 /begin LOC_MEASUREMENT nmot cw_obd cw_erfil cd_bits2_w cd_bits1_w B_zwappl B_wdksap B_uhrrsec B_uhrrmin B_tfu B_slsfz B_nswo2 B_nswo1 B_mt B_lsv2 B_lsv B_lsh2 B_lsh B_ls42 B_ls4 B_ls32 B_ls3 B_ldsapp B_ldsafw B_klima B_kath B_katfz B_hfmv B_fpwdkap B_dsuv B_dssvnl B_dssv B_dslvh B_cwlshsch B_cwlshdyn B_cvt B_cscatt B_cdtes B_cdtankl B_cdswe B_cdslse B_cdsls B_cdnws B_cdmd B_cdlsv B_cdlsh B_cdlsa B_cdllr B_cdldp B_cdlatv B_cdlatp B_cdlash B_cdkvs B_cdkat B_cdhsve B_cdhsv B_cdhshe B_cdhsh B_cddst B_cdats B_cdatr B_cdagrl B_cdagr B_autget B_asrfz B_abstnl B_4wd /end LOC_MEASUREMENT
/end FUNCTION
/begin FUNCTION RKTI "1.80      Einspritzdauerberechnung ti aus relativer Kraftstoffmasse rk" /begin REF_CHARACTERISTIC TEMINVA TEMIN FKKVS /end REF_CHARACTERISTIC
 /begin LOC_MEASUREMENT tvu_w ti_w ti_tvu_w ti_b2 ti_b1 ti2_w te_w tevfa_w_kge tevfa_w rk_w nmot ftek_w frkte B_va B_temin B_stend /end LOC_MEASUREMENT
/end FUNCTION
/begin FUNCTION rstmon "Reset Monitor"
 /begin LOC_MEASUREMENT rstMon_9_A rstMon_8_A rstMon_7_A rstMon_6_A rstMon_5_A rstMon_4_A rstMon_3_A rstMon_2_A rstMon_1_A rstMon_11_A rstMon_10_A rstMon_0_A resetMonIdx /end LOC_MEASUREMENT
/end FUNCTION
/begin FUNCTION RUNTIME "" /begin REF_CHARACTERISTIC AUFWSYNC AUFW20MS AUFW10MS AUFW100M /end REF_CHARACTERISTIC
 /begin LOC_MEASUREMENT wped wdkba rlossCtr_w rl peri50ms_w perform_w perfmin_w perfmax_w perffilt_w nmot lzs_sa lzs_lsd lzs_lr lzs_ldr lzs_kr lzs_dash lzmaxwped lzmaxwdkba lzmaxstate lzmaxrl lzmaxnmot laufzsyn_w laufzbg_w laufz50m_w laufz2m_w laufz20m_w laufz200_w laufz1s_w laufz1m_w laufz10m_w laufz100_w cyclebg_w B_sa B_lsd B_lr B_llr B_ldr B_kr B_dash /end LOC_MEASUREMENT
/end FUNCTION
/begin FUNCTION SCATT "20.40     SCAN TOOL-Testerschnittstelle" /begin LOC_MEASUREMENT fcmEnd B_m8te bbm8te /end LOC_MEASUREMENT /end FUNCTION
/begin FUNCTION SLS "88.60     SekundÑrluftsteuerung"
 /begin REF_CHARACTERISTIC ZKSLSON ZKSLSOFF ZKSLPON ZKSLPOFF ZFLMSSL VSLS UBSLSTMN UBSLMX UBSLMN TVSLVON TVSLVOFF TVDSLOFF TSLUBST TSLPMN TSLABB TMSSLU TMSSLSTU TMSSLSTO TMSSLO TMFASLMN TLMSSLMX TLMSSLAB TDSLKT TDDSLA TASLSU TASLSO MSLUB MLSLMX KFFMSML IMLSLSE IMLSLSA IMLSLMX IMLSLMN FMSTMOT FMSRHOL FMSLOFF FMSL2 FMSL DPSLV CWSLS CWFASL /end REF_CHARACTERISTIC
 /begin LOC_MEASUREMENT vfzg ubf tnst_w tmst tmot tans SLSlokBits rl pu ps_w nmot mslstat mslpub msl2 msl ml_w mlbb_w ml imlsle_w imlsla_w imlpr fslpdyn frhol_w fmsltm fmslrho fmsldyn fmsla fmsagd flmssl flamsl_w flamsl2_w B_stend B_st B_slv B_slsoff B_slsinhi B_slsfz B_slserr B_slsdis B_slsadap B_sls B_slpofst B_slpoff B_slpena B_slp B_slkt B_slkhof B_sldsl4 B_sla B_nmot B_mslon B_msloff B_mslmn B_lmsslof B_ll B_kuppl B_khab B_kha B_kh B_fs B_fasls B_fasla B_fa B_dwg B_dspe B_dslsp4 B_dslset B_dslreset B_dslfa B_brems B_atmtpl ATMbits /end LOC_MEASUREMENT
/end FUNCTION
/begin FUNCTION SREAKT "7.10      EGAS: Sicherheitskonzept, Fehlerreaktionen"
 /begin LOC_MEASUREMENT B_wdksive B_umauab B_ubdve B_notlu_fr B_nlpne B_i_ska_um B_i_ska_fr B_fprzab B_fproab B_dlrpide B_dlrbe B_dkunb B_dkpu B_dkpru B_dkpiu B_dkp2e B_dkp1e B_dknot B_dknolu B_appnolu /end LOC_MEASUREMENT
/end FUNCTION
/begin FUNCTION SSTB ""
 /begin REF_CHARACTERISTIC SWP08OPUB SWK208LDUB SWK108LDUB SWK08LDUB SVP12LDUW SUE08MFUB STS14ESUB STS12ESUB STM12ESUB STM09ESUB STM08OPUB STM08MDUB STM08LEUB STM08DMUB STM06__UB STM06LLUB STM05TMUB STM05SAUB STM04__UB STM04SAUB STM04FEUB STA12WLUB STA12ESUB STA08LDUB STA06ESUB STA04LLUB ST307TMUB ST107TMUB SRL12ZUUB SRL12GKUB SRL12ESUB SRL08NXUB SRL08DMUB SRL06LRUB SRL06LHUB SRL06KRUB SRL06ESUB SRL04KRUB SRL03KRUB SQM05TEUB SPU08LDUB SPL08LDUW SNM16ZUUB SNM16OPUW SNM16LDUW SNM16LDUB SNM16KRUB SNM16KRDYUB SNM16GKUB SNM16CIUB SNM12LDUW SNM12FEUB SNM12ESUB SNM10TEUB SNM08__UB SNM08OPUB SNM08LHUB SNM08LDUW SNM08LDUB SNM08FEUB SNM08DMUB SNM07LRUB SNM07ESUB SNM06MDUW SNM06LLUB SNM06LHUB SNM05DKUB SNG06LLSB SML08LHUB SML07TMUW SML06TMUB SML06TEUB SML05LKUB SML05DKUB SMI04LLUB SLX06TMUW SLD04LDUB SKS06ESUB SGA08MDUB SGA06MDUB SFR05TEUB SEZ06TMUB SDK10TEUB SAN12ESUW FHO04ESUB /end REF_CHARACTERISTIC
 /begin LOC_MEASUREMENT wped wkrmsu wkrmstat wkrmdy wdkba vpsspu_w uevges tmst tmot tkatmst tans tabstatm_w tabgmst rl qmsdyn pu plsolr_w nmot_w nmot ngfil msabg ml_w ml mifa_w lde lamsbg_w kstaa gangi frmit fho etazwimt esst_swp08opub esst_swk208ldub esst_swk108ldub esst_swk08ldub esst_svp12lduw esst_sue08mfub esst_sts14esub esst_sts12esub esst_stm12esub esst_stm09esub esst_stm08opub esst_stm08mdub esst_stm08leub esst_stm08dmub esst_stm06__ub esst_stm06llub esst_stm05tmub esst_stm05saub esst_stm04__ub esst_stm04saub esst_stm04feub esst_sta12wlub esst_sta12esub esst_sta08ldub esst_sta06esub esst_sta04llub esst_st307tmub esst_st107tmub esst_srl12zuub esst_srl12gkub esst_srl12esub esst_srl08nxub esst_srl08dmub esst_srl06lrub esst_srl06lhub esst_srl06krub esst_srl06esub esst_srl04krub esst_srl03krub esst_sqm05teub esst_spu08ldub esst_spl08lduw esst_snm16zuub esst_snm16opuw esst_snm16lduw esst_snm16ldub esst_snm16krub esst_snm16krdyub esst_snm16gkub esst_snm16ciub esst_snm12lduw esst_snm12feub esst_snm12esub esst_snm10teub esst_snm08__ub esst_snm08opub esst_snm08lhub esst_snm08lduw esst_snm08ldub esst_snm08feub esst_snm08dmub esst_snm07lrub esst_snm07esub esst_snm06mduw esst_snm06llub esst_snm06lhub esst_snm05dkub esst_sng06llsb esst_sml08lhub esst_sml07tmuw esst_sml06tmub esst_sml06teub esst_sml05lkub esst_sml05dkub esst_smi04llub esst_slx06tmuw esst_sld04ldub esst_sks06esub esst_sga08mdub esst_sga06mdub esst_sfr05teub esst_sez06tmub esst_sdk10teub esst_san12esuw esst_fho04esub anztib_w /end LOC_MEASUREMENT
/end FUNCTION
/end MODULE
/end PROJECT
