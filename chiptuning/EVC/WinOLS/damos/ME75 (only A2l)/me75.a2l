ASAP2_VERSION 1 21
/begin PROJECT Pro4017 "R4 1.8l 5V T lÑngs FR5ROM F5051"
/begin HEADER "" PROJECT_NO Pro4017 VERSION "PrV = F21dc mit 00" /end HEADER
/begin MODULE DIM " "
/begin MOD_COMMON " " S_REC_LAYOUT ME7 BYTE_ORDER MSB_LAST /end MOD_COMMON
/begin COMPU_METHOD B_TRUE "boolsche ZustÑnde, positive Logik" TAB_VERB "%6.3" "" COMPU_TAB_REF B_TRUE /end COMPU_METHOD
/begin COMPU_METHOD B_TRUE___UW "boolsche ZustÑnde, positive Logik" TAB_VERB "%6.3" "" COMPU_TAB_REF B_TRUE /end COMPU_METHOD
/begin COMPU_METHOD dez "1 : 1 Umrechnug (dez/hex)" RAT_FUNC "%6.2" "" COEFFS 0 1.000000 0.000000 0 0.000000 1.000000 /end COMPU_METHOD
/begin COMPU_METHOD dez___UW "1 : 1 Umrechnug (dez/hex)" RAT_FUNC "%6.2" "" COEFFS 0 1.000000 0.000000 0 0.000000 1.000000 /end COMPU_METHOD
/begin COMPU_METHOD fak_sb_b1 "" RAT_FUNC "%6.4" "-" COEFFS 0 256.000000 0.000000 0 0.000000 2.000000 /end COMPU_METHOD
/begin COMPU_METHOD fak_sw_b1 "" RAT_FUNC "%7.6" "-" COEFFS 0 6.553600e+04 0.000000 0 0.000000 2.000000 /end COMPU_METHOD
/begin COMPU_METHOD fak_sw_b8 "" RAT_FUNC "%6.5" "-" COEFFS 0 6.553600e+04 0.000000 0 0.000000 16.000000 /end COMPU_METHOD
/begin COMPU_METHOD fak_ub_b1 "" RAT_FUNC "%6.4" "-" COEFFS 0 256.000000 0.000000 0 0.000000 1.000000 /end COMPU_METHOD
/begin COMPU_METHOD fak_ub_b12p45 "" RAT_FUNC "%6.4" "%" COEFFS 0 2048.000000 0.000000 0 0.000000 100.000000 /end COMPU_METHOD
/begin COMPU_METHOD fak_ub_b16 "" RAT_FUNC "%6.4" "-" COEFFS 0 256.000000 0.000000 0 0.000000 16.000000 /end COMPU_METHOD
/begin COMPU_METHOD fak_ub_b16___SB "" RAT_FUNC "%6.4" "-" COEFFS 0 256.000000 0.000000 0 0.000000 16.000000 /end COMPU_METHOD
/begin COMPU_METHOD fak_ub_b2 "" RAT_FUNC "%6.4" "-" COEFFS 0 256.000000 0.000000 0 0.000000 2.000000 /end COMPU_METHOD
/begin COMPU_METHOD fak_ub_b4 "" RAT_FUNC "%6.4" "-" COEFFS 0 256.000000 0.000000 0 0.000000 4.000000 /end COMPU_METHOD
/begin COMPU_METHOD fak_ub_b77p81 "" RAT_FUNC "%6.3" "%/s" COEFFS 0 327.680000 0.000000 0 0.000000 100.000000 /end COMPU_METHOD
/begin COMPU_METHOD fak_ub_b8 "" RAT_FUNC "%6.4" "-" COEFFS 0 256.000000 0.000000 0 0.000000 8.000000 /end COMPU_METHOD
/begin COMPU_METHOD fak_uw_b16 "" RAT_FUNC "%6.5" "-" COEFFS 0 6.553600e+04 0.000000 0 0.000000 16.000000 /end COMPU_METHOD
/begin COMPU_METHOD fak_uw_b2 "" RAT_FUNC "%7.6" "-" COEFFS 0 6.553600e+04 0.000000 0 0.000000 2.000000 /end COMPU_METHOD
/begin COMPU_METHOD fak_uw_b4 "" RAT_FUNC "%7.6" "-" COEFFS 0 6.553600e+04 0.000000 0 0.000000 4.000000 /end COMPU_METHOD
/begin COMPU_METHOD m_ub_b1020 "" RAT_FUNC "%6.2" "kg/h" COEFFS 0 1.000000 0.000000 0 0.000000 4.000000 /end COMPU_METHOD
/begin COMPU_METHOD m_uw_b6553p5 "" RAT_FUNC "%6.3" "kg/h" COEFFS 0 1.000000 0.000000 0 0.000000 1.000000e-01 /end COMPU_METHOD
/begin COMPU_METHOD nmotd_sb_q10 "" RAT_FUNC "%6.1" "U/min" COEFFS 0 1.000000 0.000000 0 0.000000 10.000000 /end COMPU_METHOD
/begin COMPU_METHOD nmotg_sb_q100 "" RAT_FUNC "%6.0" "U/min/s" COEFFS 0 1.000000 0.000000 0 0.000000 100.000000 /end COMPU_METHOD
/begin COMPU_METHOD nmotg_sw_q0p39 "" RAT_FUNC "%6.3" "U/min/s" COEFFS 0 1.000000 0.000000 0 0.000000 3.906300e-01 /end COMPU_METHOD
/begin COMPU_METHOD nmot_sb_q10 "" RAT_FUNC "%6.1" "U/min" COEFFS 0 1.000000 0.000000 0 0.000000 10.000000 /end COMPU_METHOD
/begin COMPU_METHOD nmot_sw_q0p25 "" RAT_FUNC "%6.3" "U/min" COEFFS 0 1.000000 0.000000 0 0.000000 2.500000e-01 /end COMPU_METHOD
/begin COMPU_METHOD nmot_ub_q10 "" RAT_FUNC "%6.1" "U/min" COEFFS 0 1.000000 0.000000 0 0.000000 10.000000 /end COMPU_METHOD
/begin COMPU_METHOD nmot_ub_q40 "" RAT_FUNC "%6.1" "Upm" COEFFS 0 1.000000 0.000000 0 0.000000 40.000000 /end COMPU_METHOD
/begin COMPU_METHOD nmot_uw_q0p25 "" RAT_FUNC "%6.3" "U/min" COEFFS 0 1.000000 0.000000 0 0.000000 2.500000e-01 /end COMPU_METHOD
/begin COMPU_METHOD p_sb_q10 "" RAT_FUNC "%6.1" "hPa" COEFFS 0 1.000000 0.000000 0 0.000000 10.000000 /end COMPU_METHOD
/begin COMPU_METHOD p_ub_q10 "" RAT_FUNC "%6.1" "hPa" COEFFS 0 1.000000 0.000000 0 0.000000 10.000000 /end COMPU_METHOD
/begin COMPU_METHOD p_ub_q5 "" RAT_FUNC "%6.2" "hPa" COEFFS 0 1.000000 0.000000 0 0.000000 5.000000 /end COMPU_METHOD
/begin COMPU_METHOD p_uw_q0p039 "" RAT_FUNC "%6.4" "hPa" COEFFS 0 256.000000 0.000000 0 0.000000 10.000000 /end COMPU_METHOD
/begin COMPU_METHOD relDK_ub_b100 "" RAT_FUNC "%6.3" "% DK" COEFFS 0 255.000000 0.000000 0 0.000000 100.000000 /end COMPU_METHOD
/begin COMPU_METHOD relPED_ub_b100 "" RAT_FUNC "%6.3" "% PED" COEFFS 0 255.000000 0.000000 0 0.000000 100.000000 /end COMPU_METHOD
/begin COMPU_METHOD rel_q0p002383 "" RAT_FUNC "%6.4" "%/(s*U/min)" COEFFS 0 256.000000 0.000000 0 0.000000 6.100000e-01 /end COMPU_METHOD
/begin COMPU_METHOD rel_q1p5 "" RAT_FUNC "%6.2" "%" COEFFS 0 1.000000 0.000000 0 0.000000 1.500000 /end COMPU_METHOD
/begin COMPU_METHOD rel_sb_q0p39 "" RAT_FUNC "%6.3" "%" COEFFS 0 1.000000 0.000000 0 0.000000 3.906000e-01 /end COMPU_METHOD
/begin COMPU_METHOD rel_sb_q0p75 "" RAT_FUNC "%6.3" "%" COEFFS 0 1.000000 0.000000 0 0.000000 7.500000e-01 /end COMPU_METHOD
/begin COMPU_METHOD rel_sw_b100 "" RAT_FUNC "%6.4" "%" COEFFS 0 3.276800e+04 0.000000 0 0.000000 100.000000 /end COMPU_METHOD
/begin COMPU_METHOD rel_sw_b1536 "" RAT_FUNC "%6.4" "%" COEFFS 0 6.553600e+04 0.000000 0 0.000000 3072.000000 /end COMPU_METHOD
/begin COMPU_METHOD rel_sw_b50 "" RAT_FUNC "%6.4" "%" COEFFS 0 6.553600e+04 0.000000 0 0.000000 100.000000 /end COMPU_METHOD
/begin COMPU_METHOD rel_sw_q0p0468 "" RAT_FUNC "%6.4" "%" COEFFS 0 6.553600e+04 0.000000 0 0.000000 3072.000000 /end COMPU_METHOD
/begin COMPU_METHOD rel_ub_b127p5 "" RAT_FUNC "%6.3" "%" COEFFS 0 2.000000 0.000000 0 0.000000 1.000000 /end COMPU_METHOD
/begin COMPU_METHOD rel_ub_b24p9 "" RAT_FUNC "%6.3" "%" COEFFS 0 255.000000 0.000000 0 0.000000 24.900000 /end COMPU_METHOD
/begin COMPU_METHOD rel_ub_b25 "" RAT_FUNC "%6.3" "%" COEFFS 0 256.000000 0.000000 0 0.000000 25.000000 /end COMPU_METHOD
/begin COMPU_METHOD rel_ub_b99p6 "" RAT_FUNC "%6.3" "%" COEFFS 0 256.000000 0.000000 0 0.000000 100.000000 /end COMPU_METHOD
/begin COMPU_METHOD rel_ub_q0p75 "" RAT_FUNC "%6.3" "%" COEFFS 0 1.000000 0.000000 0 0.000000 7.500000e-01 /end COMPU_METHOD
/begin COMPU_METHOD rel_uw_b0p3 "" RAT_FUNC "%8.7" "%/hPa" COEFFS 0 6.553600e+04 0.000000 0 0.000000 3.000000e-01 /end COMPU_METHOD
/begin COMPU_METHOD rel_uw_b100 "" RAT_FUNC "%6.4" "%" COEFFS 0 6.553600e+04 0.000000 0 0.000000 100.000000 /end COMPU_METHOD
/begin COMPU_METHOD rel_uw_b200 "" RAT_FUNC "%6.4" "%" COEFFS 0 6.553600e+04 0.000000 0 0.000000 200.000000 /end COMPU_METHOD
/begin COMPU_METHOD rel_uw_b3072 "" RAT_FUNC "%6.4" "%" COEFFS 0 6.553600e+04 0.000000 0 0.000000 3072.000000 /end COMPU_METHOD
/begin COMPU_METHOD rel_uw_b3276p75 "" RAT_FUNC "%6.4" "%/100hPa" COEFFS 0 1.000000 0.000000 0 0.000000 5.000000e-02 /end COMPU_METHOD
/begin COMPU_METHOD rel_uw_q0p0234 "" RAT_FUNC "%6.4" "%" COEFFS 0 32.000000 0.000000 0 0.000000 7.500000e-01 /end COMPU_METHOD
/begin COMPU_METHOD spg_ub_b320 "" RAT_FUNC "%6.2" "V" COEFFS 0 1.000000 0.000000 0 0.000000 1.250000 /end COMPU_METHOD
/begin COMPU_METHOD spg_ub_b5 "" RAT_FUNC "%6.4" "V" COEFFS 0 256.000000 0.000000 0 0.000000 5.000000 /end COMPU_METHOD
/begin COMPU_METHOD spg_ub_q0p0052_o0p2 "" RAT_FUNC "%6.3" "V" COEFFS 0 255.000000 51.000000 0 0.000000 1.330000 /end COMPU_METHOD
/begin COMPU_METHOD t100msxs_sb_q0p01 "" RAT_FUNC "%6.4" "s" COEFFS 0 1.000000 0.000000 0 0.000000 1.000000e-02 /end COMPU_METHOD
/begin COMPU_METHOD t10msxs_sb_q0p01 "" RAT_FUNC "%6.4" "s" COEFFS 0 1.000000 0.000000 0 0.000000 1.000000e-02 /end COMPU_METHOD
/begin COMPU_METHOD t10msxs_ub_b2p55 "" RAT_FUNC "%6.4" "s" COEFFS 0 1.000000 0.000000 0 0.000000 1.000000e-02 /end COMPU_METHOD
/begin COMPU_METHOD t10msxs_uw_b655p35 "" RAT_FUNC "%6.4" "s" COEFFS 0 1.000000 0.000000 0 0.000000 1.000000e-02 /end COMPU_METHOD
/begin COMPU_METHOD t1sxs_ub_b255 "" RAT_FUNC "%6.2" "s" COEFFS 0 1.000000 0.000000 0 0.000000 1.000000 /end COMPU_METHOD
/begin COMPU_METHOD temp_ub_q0p75_o48 "" RAT_FUNC "%6.2" "Grad C" COEFFS 0 1.000000 48.000000 0 0.000000 7.500000e-01 /end COMPU_METHOD
/begin COMPU_METHOD temp_uw_q0p0195_o50 "" RAT_FUNC "%6.2" "Grad C" COEFFS 0 256.000000 12800.000000 0 0.000000 5.000000 /end COMPU_METHOD
/begin COMPU_METHOD tv_sw_q0p005 "" RAT_FUNC "%6.4" "%" COEFFS 0 1.000000 0.000000 0 0.000000 5.000000e-03 /end COMPU_METHOD
/begin COMPU_METHOD tv_ub_b100 "" RAT_FUNC "%6.3" "%" COEFFS 0 256.000000 0.000000 0 0.000000 100.000000 /end COMPU_METHOD
/begin COMPU_METHOD tv_ub_b100___SW "" RAT_FUNC "%6.3" "%" COEFFS 0 256.000000 0.000000 0 0.000000 100.000000 /end COMPU_METHOD
/begin COMPU_METHOD vfzg_ub_q1p25___UB "" RAT_FUNC "%6.2" "km/h" COEFFS 0 1.000000 0.000000 0 0.000000 1.250000 /end COMPU_METHOD
/begin COMPU_METHOD zw_sb_q0p75 "" RAT_FUNC "%6.3" "grad KW" COEFFS 0 255.000000 0.000000 0 0.000000 191.250000 /end COMPU_METHOD
/begin COMPU_METHOD zw_ub_q0p75 "" RAT_FUNC "%6.3" "Grad KW" COEFFS 0 255.000000 0.000000 0 0.000000 191.250000 /end COMPU_METHOD
/begin COMPU_METHOD zw_ub_qn0p75 "" RAT_FUNC "%6.4" "grad KW" COEFFS 0 1.000000 0.000000 0 0.000000 -7.500000e-01 /end COMPU_METHOD
/begin COMPU_VTAB B_TRUE "" TAB_VERB 2 0 "----" 1 "TRUE" /end COMPU_VTAB
/begin MEASUREMENT tmot "Motor-Temperatur" UBYTE temp_ub_q0p75_o48 0 0 -48.000000 143.250000 /begin IF_DATA ASAP1B_ETK KP_BLOB 0x380B61 1 1 /end IF_DATA BIT_MASK 0xFF /end MEASUREMENT
/begin MEASUREMENT rl "relative LuftfÅllung" UBYTE rel_ub_q0p75 0 0 0.000000 191.250000 /begin IF_DATA ASAP1B_ETK KP_BLOB 0xF997 0 1 /end IF_DATA BIT_MASK 0xFF /end MEASUREMENT
/begin MEASUREMENT nmot "Motordrehzahl" UBYTE nmot_ub_q40 0 0 0.000000 10200.000000 /begin IF_DATA ASAP1B_ETK KP_BLOB 0xF876 0 1 /end IF_DATA BIT_MASK 0xFF /end MEASUREMENT
/begin MEASUREMENT tans "Ansauglufttemperatur" UBYTE temp_ub_q0p75_o48 0 0 -48.000000 143.250000 /begin IF_DATA ASAP1B_ETK KP_BLOB 0x380B59 1 1 /end IF_DATA BIT_MASK 0xFF /end MEASUREMENT
/begin MEASUREMENT fho "Korrekturfaktor Hîhe" UBYTE fak_ub_b4 0 0 0.000000 3.984375 /begin IF_DATA ASAP1B_ETK KP_BLOB 0x380AEB 1 1 /end IF_DATA BIT_MASK 0xFF /end MEASUREMENT
/begin MEASUREMENT anztib_w "ti-EinspritzzÑhler mit Begrenzung" UWORD dez___UW 0 0 0.000000 65535.000000 /begin IF_DATA ASAP1B_ETK KP_BLOB 0x381F88 1 2 /end IF_DATA BIT_MASK 0xFFFF /end MEASUREMENT
/begin MEASUREMENT wped "Normierter Fahrpedalwinkel" UBYTE relPED_ub_b100 0 0 0.000000 100.000000 /begin IF_DATA ASAP1B_ETK KP_BLOB 0x380ABA 1 1 /end IF_DATA BIT_MASK 0xFF /end MEASUREMENT
/begin MEASUREMENT nmot_w "Motordrehzahl" UWORD nmot_uw_q0p25 0 0 0.000000 16383.750000 /begin IF_DATA ASAP1B_ETK KP_BLOB 0xF878 0 2 /end IF_DATA BIT_MASK 0xFFFF /end MEASUREMENT
/begin MEASUREMENT ml "Luftmassenflu·" UBYTE m_ub_b1020 0 0 0.000000 1020.000000 /begin IF_DATA ASAP1B_ETK KP_BLOB 0xF996 0 1 /end IF_DATA BIT_MASK 0xFF /end MEASUREMENT
/begin MEASUREMENT ngfil "gefilterter Drehzahlgradient" SBYTE nmotg_sb_q100 0 0 -12800.000000 12700.000000 /begin IF_DATA ASAP1B_ETK KP_BLOB 0x380A53 1 1 /end IF_DATA BIT_MASK 0xFF /end MEASUREMENT
/begin MEASUREMENT mifa_w "indiziertes Motormoment Fahrerwunsch" UWORD rel_uw_b100 0 0 0.000000 99.998474 /begin IF_DATA ASAP1B_ETK KP_BLOB 0x38243C 1 2 /end IF_DATA BIT_MASK 0xFFFF /end MEASUREMENT
/begin MEASUREMENT lde "LDR-Regelabweichung (Sollwert - Istwert)" SBYTE p_sb_q10 0 0 -1280.000000 1270.000000 /begin IF_DATA ASAP1B_ETK KP_BLOB 0x380C01 1 1 /end IF_DATA BIT_MASK 0xFF /end MEASUREMENT
/begin MEASUREMENT plsolr_w "Relativer Solladedruck LDR" UWORD p_uw_q0p039 0 0 0.000000 2559.960938 /begin IF_DATA ASAP1B_ETK KP_BLOB 0x3822B8 1 2 /end IF_DATA BIT_MASK 0xFFFF /end MEASUREMENT
/begin MEASUREMENT wkrmstat "QuasistationÑrer Mittelwert der zylinderindividuellen ZW SpÑtverstellwerte" UBYTE zw_ub_q0p75 0 0 0.000000 191.250000 /begin IF_DATA ASAP1B_ETK KP_BLOB 0x380C0B 1 1 /end IF_DATA BIT_MASK 0xFF /end MEASUREMENT
/begin MEASUREMENT wkrmdy "Dynamischer Mittelwert der zylinderindividuellen ZW SpÑtverstellungen" UBYTE zw_ub_q0p75 0 0 0.000000 191.250000 /begin IF_DATA ASAP1B_ETK KP_BLOB 0x380C0A 1 1 /end IF_DATA BIT_MASK 0xFF /end MEASUREMENT
/begin MEASUREMENT wkrmsu "Summenwert aus dynamischem und statischem Mittelwert der KR Verstellwinkel" UBYTE zw_ub_q0p75 0 0 0.000000 191.250000 /begin IF_DATA ASAP1B_ETK KP_BLOB 0x380C0C 1 1 /end IF_DATA BIT_MASK 0xFF /end MEASUREMENT
/begin MEASUREMENT pu "Umgebungsdruck" UBYTE p_ub_q5 0 0 0.000000 1275.000000 /begin IF_DATA ASAP1B_ETK KP_BLOB 0x380AEC 1 1 /end IF_DATA BIT_MASK 0xFF /end MEASUREMENT
/begin MEASUREMENT vpsspu_w "SolldruckverhÑltnis Umgebung/Saugrohr" UWORD fak_uw_b4 0 0 0.000000 3.999939 /begin IF_DATA ASAP1B_ETK KP_BLOB 0x38229A 1 2 /end IF_DATA BIT_MASK 0xFFFF /end MEASUREMENT
/begin MEASUREMENT wdkba "Drosselklappenwinkel bezogen auf unteren Anschlag" UBYTE relDK_ub_b100 0 0 0.000000 100.000000 /begin IF_DATA ASAP1B_ETK KP_BLOB 0x380ACB 1 1 /end IF_DATA BIT_MASK 0xFF /end MEASUREMENT
/begin MEASUREMENT gangi "Ist-Gang" UBYTE dez 0 0 0.000000 255.000000 /begin IF_DATA ASAP1B_ETK KP_BLOB 0x380AB5 1 1 /end IF_DATA BIT_MASK 0xFF /end MEASUREMENT
/begin MEASUREMENT tmst "Motorstarttemperatur" UBYTE temp_ub_q0p75_o48 0 0 -48.000000 143.250000 /begin IF_DATA ASAP1B_ETK KP_BLOB 0x380B5F 1 1 /end IF_DATA BIT_MASK 0xFF /end MEASUREMENT
/begin MEASUREMENT ml_w "Luftmassenflu· gefiltert (Word)" UWORD m_uw_b6553p5 0 0 0.000000 6553.500000 /begin IF_DATA ASAP1B_ETK KP_BLOB 0xF998 0 2 /end IF_DATA BIT_MASK 0xFFFF /end MEASUREMENT
/begin MEASUREMENT lamsbg_w "Lambdasoll Begrenzung (word)" UWORD fak_uw_b16 0 0 0.000000 15.999756 /begin IF_DATA ASAP1B_ETK KP_BLOB 0x381FE2 1 2 /end IF_DATA BIT_MASK 0xFFFF /end MEASUREMENT
/begin MEASUREMENT ldtvr_w "LDR TastverhÑltnis vom Regler" SWORD tv_sw_q0p005 0 0 -163.840000 163.835000 /begin IF_DATA ASAP1B_ETK KP_BLOB 0x3822B6 1 2 /end IF_DATA BIT_MASK 0xFFFF /end MEASUREMENT
/begin MEASUREMENT dns "LLR: Drehzahlabweichung zur stationÑren Solldrehzahl" SBYTE nmotd_sb_q10 0 0 -1280.000000 1270.000000 /begin IF_DATA ASAP1B_ETK KP_BLOB 0x380C19 1 1 /end IF_DATA BIT_MASK 0xFF /end MEASUREMENT
/begin MEASUREMENT dn "Drehzahlabweichung bei Leerlaufregelung" SBYTE nmotd_sb_q10 0 0 -1280.000000 1270.000000 /begin IF_DATA ASAP1B_ETK KP_BLOB 0x380C2A 1 1 /end IF_DATA BIT_MASK 0xFF /end MEASUREMENT
/begin MEASUREMENT vfzg "Fahrzeuggeschwindigkeit" UBYTE vfzg_ub_q1p25___UB 0 0 0.000000 318.750000 /begin IF_DATA ASAP1B_ETK KP_BLOB 0x380982 1 1 /end IF_DATA BIT_MASK 0xFF /end MEASUREMENT
/begin MEASUREMENT nmotll "Motordrehzahl im Leerlaufbereich" UBYTE nmot_ub_q10 0 0 0.000000 2550.000000 /begin IF_DATA ASAP1B_ETK KP_BLOB 0x380C2D 1 1 /end IF_DATA BIT_MASK 0xFF /end MEASUREMENT
/begin MEASUREMENT lditv_w "LDR, TastverhÑltnis vom I-Regler (word)" SWORD tv_sw_q0p005 0 0 -163.840000 163.835000 /begin IF_DATA ASAP1B_ETK KP_BLOB 0x3822A8 1 2 /end IF_DATA BIT_MASK 0xFFFF /end MEASUREMENT
/begin MEASUREMENT dzwlamfaw "Delta ZÅndwinkel bei KR-Eingriff oder Warmlauf fÅr Anfettung Åber Lambda" UBYTE zw_ub_qn0p75 0 0 -191.250000 0.000000 /begin IF_DATA ASAP1B_ETK KP_BLOB 0x380B44 1 1 /end IF_DATA BIT_MASK 0xFF /end MEASUREMENT
/begin MEASUREMENT mrfa_w "Relatives Fahrerwunschmoment aus FGR und Pedal" UWORD rel_uw_b200 0 0 0.000000 199.996948 /begin IF_DATA ASAP1B_ETK KP_BLOB 0x38244C 1 2 /end IF_DATA BIT_MASK 0xFFFF /end MEASUREMENT
/begin MEASUREMENT detazwbs "Delta ZW-Wirkungsgrad fÅr Bauteileschutz" UBYTE rel_ub_b127p5 0 0 0.000000 127.500000 /begin IF_DATA ASAP1B_ETK KP_BLOB 0x380B4D 1 1 /end IF_DATA BIT_MASK 0xFF /end MEASUREMENT
/begin MEASUREMENT tabgm_w "Abgastemperatur vor Kat aus Modell (Word)" UWORD temp_uw_q0p0195_o50 0 0 -50.000000 1229.980469 /begin IF_DATA ASAP1B_ETK KP_BLOB 0x381B0C 1 2 /end IF_DATA BIT_MASK 0xFFFF /end MEASUREMENT
/begin MEASUREMENT imlpr "Relatives Luftmassenintegral bei Katheizung" UBYTE fak_ub_b1 0 0 0.000000 0.996094 /begin IF_DATA ASAP1B_ETK KP_BLOB 0x380B68 1 1 /end IF_DATA BIT_MASK 0xFF /end MEASUREMENT
/begin MEASUREMENT plsol "Soll-Ladedruck" UBYTE p_ub_q10 0 0 0.000000 2550.000000 /begin IF_DATA ASAP1B_ETK KP_BLOB 0x380AF9 1 1 /end IF_DATA BIT_MASK 0xFF /end MEASUREMENT
/begin MEASUREMENT tnst_w "Zeit nach Startende" UWORD t10msxs_uw_b655p35 0 0 0.000000 655.350000 /begin IF_DATA ASAP1B_ETK KP_BLOB 0x382672 1 2 /end IF_DATA BIT_MASK 0xFFFF /end MEASUREMENT
/begin MEASUREMENT psl "ôldruck von der Servo-Lenkung" UBYTE dez 0 0 0.000000 255.000000 /begin IF_DATA ASAP1B_ETK KP_BLOB 0x38098A 1 1 /end IF_DATA BIT_MASK 0xFF /end MEASUREMENT
/begin MEASUREMENT ngasf_w "Drehzahlgradient Åber ein Arbeitsspiel (gefiltert)" SWORD nmotg_sw_q0p39 0 0 -12800.163840 12799.773210 /begin IF_DATA ASAP1B_ETK KP_BLOB 0x38237C 1 2 /end IF_DATA BIT_MASK 0xFFFF /end MEASUREMENT
/begin MEASUREMENT lambas "Basis-Lambda" UBYTE fak_ub_b2 0 0 0.000000 1.992188 /begin IF_DATA ASAP1B_ETK KP_BLOB 0x380B2E 1 1 /end IF_DATA BIT_MASK 0xFF /end MEASUREMENT
/begin MEASUREMENT dzw_kge "Eingang Delta-ZÅndwinkel fÅr mehrfach verwendete Kenngrî·en" SBYTE zw_sb_q0p75 0 0 -96.000000 95.250000 /begin IF_DATA ASAP1B_ETK KP_BLOB 0x380C42 1 1 /end IF_DATA BIT_MASK 0xFF /end MEASUREMENT
/begin MEASUREMENT etazwist "Ist-ZÅndwinkelwirkungsgrad" UBYTE rel_ub_b127p5 0 0 0.000000 127.500000 /begin IF_DATA ASAP1B_ETK KP_BLOB 0x380C4B 1 1 /end IF_DATA BIT_MASK 0xFF /end MEASUREMENT
/begin MEASUREMENT tkatm_w "Katalysatortemperatur aus Modell (Word)" UWORD temp_uw_q0p0195_o50 0 0 -50.000000 1229.980469 /begin IF_DATA ASAP1B_ETK KP_BLOB 0x381B10 1 2 /end IF_DATA BIT_MASK 0xFFFF /end MEASUREMENT
/begin MEASUREMENT fkatei "Faktor Kraftstoffanteil TankentlÅftung (aktueller Istwert)" SBYTE fak_sb_b1 0 0 -1.000000 0.992188 /begin IF_DATA ASAP1B_ETK KP_BLOB 0x380CA8 1 1 /end IF_DATA BIT_MASK 0xFF /end MEASUREMENT
/begin MEASUREMENT B_asr "Bedingung fÅr ASR aktiv" UWORD B_TRUE___UW 0 0 0.000000 0.000000 /begin IF_DATA ASAP1B_ETK KP_BLOB 0xFD82 0 2 /end IF_DATA BIT_MASK 0x8 /end MEASUREMENT
/begin MEASUREMENT B_atmtpa "Bedingung Taupunkt vor Kat ueberschritten" UWORD B_TRUE___UW 0 0 0.000000 0.000000 /begin IF_DATA ASAP1B_ETK KP_BLOB 0xFD22 0 2 /end IF_DATA BIT_MASK 0x40 /end MEASUREMENT
/begin MEASUREMENT B_atrf "Bedingung Fehler Abgastemperaturregelung" UWORD B_TRUE___UW 0 0 0.000000 0.000000 /begin IF_DATA ASAP1B_ETK KP_BLOB 0xFD06 0 2 /end IF_DATA BIT_MASK 0x200 /end MEASUREMENT
/begin MEASUREMENT B_atsb "Bedingung: Abgastemperatursensor betriebsbereit" UWORD B_TRUE___UW 0 0 0.000000 0.000000 /begin IF_DATA ASAP1B_ETK KP_BLOB 0xFD06 0 2 /end IF_DATA BIT_MASK 0x400 /end MEASUREMENT
/begin MEASUREMENT B_autget "Bedingung Automatikgetriebe" UWORD B_TRUE___UW 0 0 0.000000 0.000000 /begin IF_DATA ASAP1B_ETK KP_BLOB 0xFD00 0 2 /end IF_DATA BIT_MASK 0x8 /end MEASUREMENT
/begin MEASUREMENT B_bevab "Bedingung EV-Abschaltung auf Bank/Bank1" UWORD B_TRUE___UW 0 0 0.000000 0.000000 /begin IF_DATA ASAP1B_ETK KP_BLOB 0xFD5C 0 2 /end IF_DATA BIT_MASK 0x2 /end MEASUREMENT
/begin MEASUREMENT B_brems "Bedingung Bremse betÑtigt" UWORD B_TRUE___UW 0 0 0.000000 0.000000 /begin IF_DATA ASAP1B_ETK KP_BLOB 0xFD48 0 2 /end IF_DATA BIT_MASK 0x8 /end MEASUREMENT
/begin MEASUREMENT B_brlmx "Bedingung LDR Begrenzung der Maximalfuellung" UWORD B_TRUE___UW 0 0 0.000000 0.000000 /begin IF_DATA ASAP1B_ETK KP_BLOB 0xFD7A 0 2 /end IF_DATA BIT_MASK 0x8 /end MEASUREMENT
/begin MEASUREMENT B_c95ks3 "Ansteuersignal fÅr den Nulltest des CC195" UWORD B_TRUE___UW 0 0 0.000000 0.000000 /begin IF_DATA ASAP1B_ETK KP_BLOB 0xFD6E 0 2 /end IF_DATA BIT_MASK 0x400 /end MEASUREMENT
/begin MEASUREMENT B_c95_g0 "Ansteuerung der VerstÑrkerstufe des CC195 (PIN G0)" UWORD B_TRUE___UW 0 0 0.000000 0.000000 /begin IF_DATA ASAP1B_ETK KP_BLOB 0xFD70 0 2 /end IF_DATA BIT_MASK 0x4 /end MEASUREMENT
/begin MEASUREMENT B_c95_g1 "Ansteuerung der VerstÑrkerstufe des CC195 (Pin G1)" UWORD B_TRUE___UW 0 0 0.000000 0.000000 /begin IF_DATA ASAP1B_ETK KP_BLOB 0xFD70 0 2 /end IF_DATA BIT_MASK 0x8 /end MEASUREMENT
/begin MEASUREMENT B_c95_g2 "Ansteuerung der VerstÑrkerstufe des CC195 (Pin G2)" UWORD B_TRUE___UW 0 0 0.000000 0.000000 /begin IF_DATA ASAP1B_ETK KP_BLOB 0xFD70 0 2 /end IF_DATA BIT_MASK 0x10 /end MEASUREMENT
/begin MEASUREMENT B_dash "Bedingung: Dashpot-énderungsbegrenzung aktiv" UWORD B_TRUE___UW 0 0 0.000000 0.000000 /begin IF_DATA ASAP1B_ETK KP_BLOB 0xFD7E 0 2 /end IF_DATA BIT_MASK 0x20 /end MEASUREMENT
/begin MEASUREMENT B_dfrf "Bedingung Anfettung in LR erkannt" UWORD B_TRUE___UW 0 0 0.000000 0.000000 /begin IF_DATA ASAP1B_ETK KP_BLOB 0xFD9A 0 2 /end IF_DATA BIT_MASK 0x4 /end MEASUREMENT
/begin MEASUREMENT B_dfrf2 "Bedingung Anfettung in LR erkannt, Bank2" UWORD B_TRUE___UW 0 0 0.000000 0.000000 /begin IF_DATA ASAP1B_ETK KP_BLOB 0xFD9A 0 2 /end IF_DATA BIT_MASK 0x8 /end MEASUREMENT
/begin MEASUREMENT B_dfrm "Bedingung Ausmagerung in LR erkannt" UWORD B_TRUE___UW 0 0 0.000000 0.000000 /begin IF_DATA ASAP1B_ETK KP_BLOB 0xFD9A 0 2 /end IF_DATA BIT_MASK 0x10 /end MEASUREMENT
/begin MEASUREMENT B_dfrm2 "Bedingung Ausmagerung in LR erkannt, Bank2" UWORD B_TRUE___UW 0 0 0.000000 0.000000 /begin IF_DATA ASAP1B_ETK KP_BLOB 0xFD9A 0 2 /end IF_DATA BIT_MASK 0x20 /end MEASUREMENT
/begin MEASUREMENT B_dknolu "Bedingung Drosselklappensteller stromlos" UWORD B_TRUE___UW 0 0 0.000000 0.000000 /begin IF_DATA ASAP1B_ETK KP_BLOB 0xFD46 0 2 /end IF_DATA BIT_MASK 0x100 /end MEASUREMENT
/begin MEASUREMENT B_dkpu "Bedingung Sicherheitskraftstoffabschaltung (SKA)" UWORD B_TRUE___UW 0 0 0.000000 0.000000 /begin IF_DATA ASAP1B_ETK KP_BLOB 0xFD46 0 2 /end IF_DATA BIT_MASK 0x1000 /end MEASUREMENT
/begin MEASUREMENT B_dktlp "Umschaltung der Lambdaregelungsparameter angefordert" UWORD B_TRUE___UW 0 0 0.000000 0.000000 /begin IF_DATA ASAP1B_ETK KP_BLOB 0xFD2E 0 2 /end IF_DATA BIT_MASK 0x8000 /end MEASUREMENT
/begin MEASUREMENT B_dllr "Aktive diagnose: Leerlaufstellerdiagnose" UWORD B_TRUE___UW 0 0 0.000000 0.000000 /begin IF_DATA ASAP1B_ETK KP_BLOB 0xFD7C 0 2 /end IF_DATA BIT_MASK 0x800 /end MEASUREMENT
/begin MEASUREMENT B_dnt "Aktive Diagnose: Klopfregelung Nulltest" UWORD B_TRUE___UW 0 0 0.000000 0.000000 /begin IF_DATA ASAP1B_ETK KP_BLOB 0xFD6E 0 2 /end IF_DATA BIT_MASK 0x800 /end MEASUREMENT
/begin MEASUREMENT B_dntb "Bedingung Diagnose: Bereitschaft zum Nulltest (Nulltest im nÑchsten MF)" UWORD B_TRUE___UW 0 0 0.000000 0.000000 /begin IF_DATA ASAP1B_ETK KP_BLOB 0xFD6E 0 2 /end IF_DATA BIT_MASK 0x1000 /end MEASUREMENT
/begin MEASUREMENT B_dsla "Adaptionsphase: Bestimmung SekundÑrluftmasse" UWORD B_TRUE___UW 0 0 0.000000 0.000000 /begin IF_DATA ASAP1B_ETK KP_BLOB 0xFD0A 0 2 /end IF_DATA BIT_MASK 0x8000 /end MEASUREMENT
/begin MEASUREMENT B_dslafa "Anfoderung Kurztest oder Adaption in DSLSXXX" UWORD B_TRUE___UW 0 0 0.000000 0.000000 /begin IF_DATA ASAP1B_ETK KP_BLOB 0xFD6E 0 2 /end IF_DATA BIT_MASK 0x20 /end MEASUREMENT
/begin MEASUREMENT B_dsls "Aktive Diagnose: SekundÑrluft-System" UWORD B_TRUE___UW 0 0 0.000000 0.000000 /begin IF_DATA ASAP1B_ETK KP_BLOB 0xFD0C 0 2 /end IF_DATA BIT_MASK 0x2 /end MEASUREMENT
/begin MEASUREMENT B_dteaam "Bedingung AufsteuerprÅfung fÅr TEV Diagnose aktiv mîglich" UWORD B_TRUE___UW 0 0 0.000000 0.000000 /begin IF_DATA ASAP1B_ETK KP_BLOB 0xFD8A 0 2 /end IF_DATA BIT_MASK 0x40 /end MEASUREMENT
/begin MEASUREMENT B_dtefrr "Bedingung Lambdareglerreset bei TankentlÅftungsdiagnose" UWORD B_TRUE___UW 0 0 0.000000 0.000000 /begin IF_DATA ASAP1B_ETK KP_BLOB 0xFD8A 0 2 /end IF_DATA BIT_MASK 0x2000 /end MEASUREMENT
/begin MEASUREMENT B_dtes "Aktive Diagnose: TankentlÅftungssystem" UWORD B_TRUE___UW 0 0 0.000000 0.000000 /begin IF_DATA ASAP1B_ETK KP_BLOB 0xFD8C 0 2 /end IF_DATA BIT_MASK 0x800 /end MEASUREMENT
/begin MEASUREMENT B_dtest "Start fÅr TEV-Ansteuerung" UWORD B_TRUE___UW 0 0 0.000000 0.000000 /begin IF_DATA ASAP1B_ETK KP_BLOB 0xFD8C 0 2 /end IF_DATA BIT_MASK 0x1000 /end MEASUREMENT
/begin MEASUREMENT B_dtp "Aktive Diagnose: Klopfregelung Testimpuls" UWORD B_TRUE___UW 0 0 0.000000 0.000000 /begin IF_DATA ASAP1B_ETK KP_BLOB 0xFD6E 0 2 /end IF_DATA BIT_MASK 0x2000 /end MEASUREMENT
/begin MEASUREMENT B_dtpb "Bedingung Diagnose: Bereitschaft zum Testpuls (Testpuls im nÑchsten MF)" UWORD B_TRUE___UW 0 0 0.000000 0.000000 /begin IF_DATA ASAP1B_ETK KP_BLOB 0xFD6E 0 2 /end IF_DATA BIT_MASK 0x4000 /end MEASUREMENT
/begin MEASUREMENT B_edkvs "Bedingung Adaptionsfehlerschwellen aktuell Åberschritten" UWORD B_TRUE___UW 0 0 0.000000 0.000000 /begin IF_DATA ASAP1B_ETK KP_BLOB 0xFD64 0 2 /end IF_DATA BIT_MASK 0x4000 /end MEASUREMENT
/begin MEASUREMENT B_fa "Bedingung Funktionsanforderung allgemein" UWORD B_TRUE___UW 0 0 0.000000 0.000000 /begin IF_DATA ASAP1B_ETK KP_BLOB 0xFD74 0 2 /end IF_DATA BIT_MASK 0x100 /end MEASUREMENT
/begin MEASUREMENT B_fakat "Bedingung Funktionsanforderung KatalysatorÅberwachung" UWORD B_TRUE___UW 0 0 0.000000 0.000000 /begin IF_DATA ASAP1B_ETK KP_BLOB 0xFD74 0 2 /end IF_DATA BIT_MASK 0x2000 /end MEASUREMENT
/begin MEASUREMENT B_fakvs "Funktionsaufforderung Diagnose Kraftstoffsystem fÅr Schnelltest" UWORD B_TRUE___UW 0 0 0.000000 0.000000 /begin IF_DATA ASAP1B_ETK KP_BLOB 0xFD76 0 2 /end IF_DATA BIT_MASK 0x1 /end MEASUREMENT
/begin MEASUREMENT B_falsh "Bedingung Funktionsanforderung Lambda-Sonde hinter KAT" UWORD B_TRUE___UW 0 0 0.000000 0.000000 /begin IF_DATA ASAP1B_ETK KP_BLOB 0xFD76 0 2 /end IF_DATA BIT_MASK 0x4 /end MEASUREMENT
/begin MEASUREMENT B_fash "Bedingung Funktionsanforderung SchwingungsprÅfung" UWORD B_TRUE___UW 0 0 0.000000 0.000000 /begin IF_DATA ASAP1B_ETK KP_BLOB 0xFD76 0 2 /end IF_DATA BIT_MASK 0x20 /end MEASUREMENT
/begin MEASUREMENT B_fasla "Bedingung: externe Anforderung an SekundÑrluft aktiv" UWORD B_TRUE___UW 0 0 0.000000 0.000000 /begin IF_DATA ASAP1B_ETK KP_BLOB 0xFD0A 0 2 /end IF_DATA BIT_MASK 0x10 /end MEASUREMENT
/begin MEASUREMENT B_fbstabgm "Bedingung: Faktor Bauteileschutz Åber Abgastemperaturmodell" UWORD B_TRUE___UW 0 0 0.000000 0.000000 /begin IF_DATA ASAP1B_ETK KP_BLOB 0xFD66 0 2 /end IF_DATA BIT_MASK 0x4000 /end MEASUREMENT
/begin MEASUREMENT B_fhz "Bedingung Frontscheibenheizung" UWORD B_TRUE___UW 0 0 0.000000 0.000000 /begin IF_DATA ASAP1B_ETK KP_BLOB 0xFD08 0 2 /end IF_DATA BIT_MASK 0x2 /end MEASUREMENT
/begin MEASUREMENT B_fil "Bedingung PT1-Filter fÅr SAWE aktiv" UWORD B_TRUE___UW 0 0 0.000000 0.000000 /begin IF_DATA ASAP1B_ETK KP_BLOB 0xFD7E 0 2 /end IF_DATA BIT_MASK 0x800 /end MEASUREMENT
/begin MEASUREMENT B_frab "Bedingung Regelfaktor fr au·erhalb adaptierten Band" UWORD B_TRUE___UW 0 0 0.000000 0.000000 /begin IF_DATA ASAP1B_ETK KP_BLOB 0xFD9A 0 2 /end IF_DATA BIT_MASK 0x40 /end MEASUREMENT
/begin MEASUREMENT B_frab2 "Bedingung Regelfaktor fr au·erhalb adaptierten Band, Bank 2" UWORD B_TRUE___UW 0 0 0.000000 0.000000 /begin IF_DATA ASAP1B_ETK KP_BLOB 0xFD9A 0 2 /end IF_DATA BIT_MASK 0x80 /end MEASUREMENT
/begin MEASUREMENT B_frao "Einschaltbedingung fÅr Adaption von frao" UWORD B_TRUE___UW 0 0 0.000000 0.000000 /begin IF_DATA ASAP1B_ETK KP_BLOB 0xFD5E 0 2 /end IF_DATA BIT_MASK 0x40 /end MEASUREMENT
/begin MEASUREMENT B_fraor "Bedingung frao-Integrator au·erhalb reduzierter Bereich" UWORD B_TRUE___UW 0 0 0.000000 0.000000 /begin IF_DATA ASAP1B_ETK KP_BLOB 0xFD5E 0 2 /end IF_DATA BIT_MASK 0x80 /end MEASUREMENT
/begin MEASUREMENT B_frau "Einschaltbedingung fÅr Adaption von frau" UWORD B_TRUE___UW 0 0 0.000000 0.000000 /begin IF_DATA ASAP1B_ETK KP_BLOB 0xFD5E 0 2 /end IF_DATA BIT_MASK 0x100 /end MEASUREMENT
/begin MEASUREMENT B_fraur "Bedingung frau-Integrator au·erhalb reduzierter Bereich" UWORD B_TRUE___UW 0 0 0.000000 0.000000 /begin IF_DATA ASAP1B_ETK KP_BLOB 0xFD5E 0 2 /end IF_DATA BIT_MASK 0x200 /end MEASUREMENT
/begin MEASUREMENT B_frini "Bedingung Regelfaktor fr initialisieren" UWORD B_TRUE___UW 0 0 0.000000 0.000000 /begin IF_DATA ASAP1B_ETK KP_BLOB 0xFD98 0 2 /end IF_DATA BIT_MASK 0x10 /end MEASUREMENT
/begin MEASUREMENT B_frini2 "Bedingung Regelfaktor fr initialisieren, Bank 2" UWORD B_TRUE___UW 0 0 0.000000 0.000000 /begin IF_DATA ASAP1B_ETK KP_BLOB 0xFD98 0 2 /end IF_DATA BIT_MASK 0x20 /end MEASUREMENT
/begin MEASUREMENT B_frmax "Lambda-Regelung setzt Bit sobald FR am Anschlag FRMAX" UWORD B_TRUE___UW 0 0 0.000000 0.000000 /begin IF_DATA ASAP1B_ETK KP_BLOB 0xFD9A 0 2 /end IF_DATA BIT_MASK 0x100 /end MEASUREMENT
/begin MEASUREMENT B_frmax2 "Lambda-Regelung setzt Bit sobald FR am Anschlag FRMAX, Bank 2" UWORD B_TRUE___UW 0 0 0.000000 0.000000 /begin IF_DATA ASAP1B_ETK KP_BLOB 0xFD9A 0 2 /end IF_DATA BIT_MASK 0x200 /end MEASUREMENT
/begin MEASUREMENT B_frmin "Lambda-Regelung setzt Bit sobald FR am Anschlag FRMIN" UWORD B_TRUE___UW 0 0 0.000000 0.000000 /begin IF_DATA ASAP1B_ETK KP_BLOB 0xFD9A 0 2 /end IF_DATA BIT_MASK 0x400 /end MEASUREMENT
/begin MEASUREMENT B_frmin2 "Lambda-Regelung setzt Bit sobald FR am Anschlag FRMIN, Bank 2" UWORD B_TRUE___UW 0 0 0.000000 0.000000 /begin IF_DATA ASAP1B_ETK KP_BLOB 0xFD9A 0 2 /end IF_DATA BIT_MASK 0x800 /end MEASUREMENT
/begin MEASUREMENT B_frmini "Bildung fr-Mittelwert: Bed. Initialisieren von frm_w" UWORD B_TRUE___UW 0 0 0.000000 0.000000 /begin IF_DATA ASAP1B_ETK KP_BLOB 0xFD9A 0 2 /end IF_DATA BIT_MASK 0x1000 /end MEASUREMENT
/begin MEASUREMENT B_frmini2 "Bildung fr-Mittelwert: Bed. Initialisieren von frm_w, Bank 2" UWORD B_TRUE___UW 0 0 0.000000 0.000000 /begin IF_DATA ASAP1B_ETK KP_BLOB 0xFD9A 0 2 /end IF_DATA BIT_MASK 0x2000 /end MEASUREMENT
/begin MEASUREMENT B_frsp "Bedingung Reglersprung" UWORD B_TRUE___UW 0 0 0.000000 0.000000 /begin IF_DATA ASAP1B_ETK KP_BLOB 0xFD9A 0 2 /end IF_DATA BIT_MASK 0x4000 /end MEASUREMENT
/begin MEASUREMENT B_frsp2 "Bedingung Reglersprung, Bank 2" UWORD B_TRUE___UW 0 0 0.000000 0.000000 /begin IF_DATA ASAP1B_ETK KP_BLOB 0xFD9A 0 2 /end IF_DATA BIT_MASK 0x8000 /end MEASUREMENT
/begin MEASUREMENT B_fs "Bedingung Fahrstufe" UWORD B_TRUE___UW 0 0 0.000000 0.000000 /begin IF_DATA ASAP1B_ETK KP_BLOB 0xFD3A 0 2 /end IF_DATA BIT_MASK 0x200 /end MEASUREMENT
/begin MEASUREMENT B_gap "Bedingung Gemischadaptionsphase aktiv" UWORD B_TRUE___UW 0 0 0.000000 0.000000 /begin IF_DATA ASAP1B_ETK KP_BLOB 0xFD60 0 2 /end IF_DATA BIT_MASK 0x4000 /end MEASUREMENT
/begin MEASUREMENT B_gasp "; 1 = Gemischadaption gesperrt" UWORD B_TRUE___UW 0 0 0.000000 0.000000 /begin IF_DATA ASAP1B_ETK KP_BLOB 0xFD62 0 2 /end IF_DATA BIT_MASK 0x200 /end MEASUREMENT
/begin MEASUREMENT B_gsaf "Bedingung Getriebe-Schalteingriff-Anforderung" UWORD B_TRUE___UW 0 0 0.000000 0.000000 /begin IF_DATA ASAP1B_ETK KP_BLOB 0xFD10 0 2 /end IF_DATA BIT_MASK 0x80 /end MEASUREMENT
/begin MEASUREMENT B_hll "Bedingung Hei·leerlauf" UWORD B_TRUE___UW 0 0 0.000000 0.000000 /begin IF_DATA ASAP1B_ETK KP_BLOB 0xFD7A 0 2 /end IF_DATA BIT_MASK 0x200 /end MEASUREMENT
/begin MEASUREMENT B_inifrm "Bildung fr-Mittelwert: Bed. Auswahl Initialisierungswert von frm_w" UWORD B_TRUE___UW 0 0 0.000000 0.000000 /begin IF_DATA ASAP1B_ETK KP_BLOB 0xFD9C 0 2 /end IF_DATA BIT_MASK 0x1 /end MEASUREMENT
/begin MEASUREMENT B_inifrm2 "Bildung fr-Mittelwert: Bed. Auswahl Initialisierungswert von frm_w, Bank 2" UWORD B_TRUE___UW 0 0 0.000000 0.000000 /begin IF_DATA ASAP1B_ETK KP_BLOB 0xFD9C 0 2 /end IF_DATA BIT_MASK 0x2 /end MEASUREMENT
/begin MEASUREMENT B_int "LR: Bedingung Integration erlaubt" UWORD B_TRUE___UW 0 0 0.000000 0.000000 /begin IF_DATA ASAP1B_ETK KP_BLOB 0xFD9C 0 2 /end IF_DATA BIT_MASK 0x4 /end MEASUREMENT
/begin MEASUREMENT B_int2 "LR Bank2: Bedingung Integration erlaubt" UWORD B_TRUE___UW 0 0 0.000000 0.000000 /begin IF_DATA ASAP1B_ETK KP_BLOB 0xFD9C 0 2 /end IF_DATA BIT_MASK 0x8 /end MEASUREMENT
/begin MEASUREMENT B_kfzk "Bedingung Kennfeld Klopfschutz" UWORD B_TRUE___UW 0 0 0.000000 0.000000 /begin IF_DATA ASAP1B_ETK KP_BLOB 0xFDA0 0 2 /end IF_DATA BIT_MASK 0x1 /end MEASUREMENT
/begin MEASUREMENT B_kh "Bedingung Kat-Heizung" UWORD B_TRUE___UW 0 0 0.000000 0.000000 /begin IF_DATA ASAP1B_ETK KP_BLOB 0xFD6E 0 2 /end IF_DATA BIT_MASK 0x1 /end MEASUREMENT
/begin MEASUREMENT B_khn "Bedingung Katheiz-Drehzahl" UBYTE B_TRUE 0 0 0.000000 0.000000 /begin IF_DATA ASAP1B_ETK KP_BLOB 0x380B63 1 1 /end IF_DATA BIT_MASK 0x1 /end MEASUREMENT
/begin MEASUREMENT B_kl "Bedingung fÅr erkannte Klopfer" UWORD B_TRUE___UW 0 0 0.000000 0.000000 /begin IF_DATA ASAP1B_ETK KP_BLOB 0xFD70 0 2 /end IF_DATA BIT_MASK 0x20 /end MEASUREMENT
/begin MEASUREMENT B_ko "Bedingung Kompressor freigegeben" UWORD B_TRUE___UW 0 0 0.000000 0.000000 /begin IF_DATA ASAP1B_ETK KP_BLOB 0xFDA0 0 2 /end IF_DATA BIT_MASK 0x10 /end MEASUREMENT
/begin MEASUREMENT B_kr "Bedingung Klopfregelung aktiv" UWORD B_TRUE___UW 0 0 0.000000 0.000000 /begin IF_DATA ASAP1B_ETK KP_BLOB 0xFD70 0 2 /end IF_DATA BIT_MASK 0x40 /end MEASUREMENT
/begin MEASUREMENT B_kra "KR-Adaption aktiv" UWORD B_TRUE___UW 0 0 0.000000 0.000000 /begin IF_DATA ASAP1B_ETK KP_BLOB 0xFD70 0 2 /end IF_DATA BIT_MASK 0x80 /end MEASUREMENT
/begin MEASUREMENT B_krafrz "Bedingung: KR-Adaption ist eingefroren" UWORD B_TRUE___UW 0 0 0.000000 0.000000 /begin IF_DATA ASAP1B_ETK KP_BLOB 0xFD70 0 2 /end IF_DATA BIT_MASK 0x100 /end MEASUREMENT
/begin MEASUREMENT B_krdws "Bedingung Klopfregelung SicherheitsspÑtverstellung" UWORD B_TRUE___UW 0 0 0.000000 0.000000 /begin IF_DATA ASAP1B_ETK KP_BLOB 0xFD70 0 2 /end IF_DATA BIT_MASK 0x200 /end MEASUREMENT
/begin MEASUREMENT B_krfdks "Bedingung Freigabe Diagnose KS" UWORD B_TRUE___UW 0 0 0.000000 0.000000 /begin IF_DATA ASAP1B_ETK KP_BLOB 0xFD70 0 2 /end IF_DATA BIT_MASK 0x400 /end MEASUREMENT
/begin MEASUREMENT B_krfrz "Bedingung: KR ist eingefroren" UWORD B_TRUE___UW 0 0 0.000000 0.000000 /begin IF_DATA ASAP1B_ETK KP_BLOB 0xFD70 0 2 /end IF_DATA BIT_MASK 0x800 /end MEASUREMENT
/begin MEASUREMENT B_krldy "Bedingung Lastdynamik fÅr Klopferkennung aktiv" UWORD B_TRUE___UW 0 0 0.000000 0.000000 /begin IF_DATA ASAP1B_ETK KP_BLOB 0xFD72 0 2 /end IF_DATA BIT_MASK 0x200 /end MEASUREMENT
/begin MEASUREMENT B_krldya "Bedingung Lastdynamikvorhalt und -adaption aktiv" UWORD B_TRUE___UW 0 0 0.000000 0.000000 /begin IF_DATA ASAP1B_ETK KP_BLOB 0xFD72 0 2 /end IF_DATA BIT_MASK 0x400 /end MEASUREMENT
/begin MEASUREMENT B_krldyn "Bedingung Lastdynamik fÅr StationÑradaption aktiv" UWORD B_TRUE___UW 0 0 0.000000 0.000000 /begin IF_DATA ASAP1B_ETK KP_BLOB 0xFD72 0 2 /end IF_DATA BIT_MASK 0x1000 /end MEASUREMENT
/begin MEASUREMENT B_krlz "KR-Leitzylinderfunktion aktiv" UWORD B_TRUE___UW 0 0 0.000000 0.000000 /begin IF_DATA ASAP1B_ETK KP_BLOB 0xFD70 0 2 /end IF_DATA BIT_MASK 0x1000 /end MEASUREMENT
/begin MEASUREMENT B_krndy "Bedingung Drehzahldynamik fÅr Klopferkennung aktiv" UWORD B_TRUE___UW 0 0 0.000000 0.000000 /begin IF_DATA ASAP1B_ETK KP_BLOB 0xFD72 0 2 /end IF_DATA BIT_MASK 0x4000 /end MEASUREMENT
/begin MEASUREMENT B_krndyn "Bedingung Drehzahldynamik fÅr StationÑradaption aktiv" UWORD B_TRUE___UW 0 0 0.000000 0.000000 /begin IF_DATA ASAP1B_ETK KP_BLOB 0xFD72 0 2 /end IF_DATA BIT_MASK 0x8000 /end MEASUREMENT
/begin MEASUREMENT B_krnl "Notlauf Klopferkennung bei Phasennotlauf und/oder DoppelzÅndung" UWORD B_TRUE___UW 0 0 0.000000 0.000000 /begin IF_DATA ASAP1B_ETK KP_BLOB 0xFD70 0 2 /end IF_DATA BIT_MASK 0x2000 /end MEASUREMENT
/begin MEASUREMENT B_krnlr "Notlauf KR fÅr V6, V8 mit 2 KS bei Fehler eines KS" UWORD B_TRUE___UW 0 0 0.000000 0.000000 /begin IF_DATA ASAP1B_ETK KP_BLOB 0xFD70 0 2 /end IF_DATA BIT_MASK 0x4000 /end MEASUREMENT
/begin MEASUREMENT B_krwa "Klopfregelung am Anschlag" UWORD B_TRUE___UW 0 0 0.000000 0.000000 /begin IF_DATA ASAP1B_ETK KP_BLOB 0xFD70 0 2 /end IF_DATA BIT_MASK 0x8000 /end MEASUREMENT
/begin MEASUREMENT B_kseb1 "Bedingung KS-Fehler Bank 1" UWORD B_TRUE___UW 0 0 0.000000 0.000000 /begin IF_DATA ASAP1B_ETK KP_BLOB 0xFD72 0 2 /end IF_DATA BIT_MASK 0x1 /end MEASUREMENT
/begin MEASUREMENT B_kseb2 "Bedingung KS-Fehler Bank 2" UWORD B_TRUE___UW 0 0 0.000000 0.000000 /begin IF_DATA ASAP1B_ETK KP_BLOB 0xFD72 0 2 /end IF_DATA BIT_MASK 0x2 /end MEASUREMENT
/begin MEASUREMENT B_kuppl "Bedingung Kupplung betÑtigt" UWORD B_TRUE___UW 0 0 0.000000 0.000000 /begin IF_DATA ASAP1B_ETK KP_BLOB 0xFD48 0 2 /end IF_DATA BIT_MASK 0x20 /end MEASUREMENT
/begin MEASUREMENT B_kvakbi "Bedingung aufsummierter Kraftstoffverbrauch ist Åbergelaufen" UWORD B_TRUE___UW 0 0 0.000000 0.000000 /begin IF_DATA ASAP1B_ETK KP_BLOB 0xFDA6 0 2 /end IF_DATA BIT_MASK 0x80 /end MEASUREMENT
/begin MEASUREMENT B_lalgf "Bedingung Laufgrenze 'Lambda fett' aktiv" UWORD B_TRUE___UW 0 0 0.000000 0.000000 /begin IF_DATA ASAP1B_ETK KP_BLOB 0xFD5E 0 2 /end IF_DATA BIT_MASK 0x1 /end MEASUREMENT
/begin MEASUREMENT B_lambts "Lambda fÅr Bauteileschutz ist aktiv" UWORD B_TRUE___UW 0 0 0.000000 0.000000 /begin IF_DATA ASAP1B_ETK KP_BLOB 0xFD5E 0 2 /end IF_DATA BIT_MASK 0x2 /end MEASUREMENT
/begin MEASUREMENT B_lamdkt "Lambdasoll Eingriff fÅr Katdiagnose aktiv" UWORD B_TRUE___UW 0 0 0.000000 0.000000 /begin IF_DATA ASAP1B_ETK KP_BLOB 0xFD08 0 2 /end IF_DATA BIT_MASK 0x10 /end MEASUREMENT
/begin MEASUREMENT B_lamfas "HîhenabhÑngige Sperrzeit fÅr Lambda Fahrerwunsch aktiv" UWORD B_TRUE___UW 0 0 0.000000 0.000000 /begin IF_DATA ASAP1B_ETK KP_BLOB 0xFD62 0 2 /end IF_DATA BIT_MASK 0x100 /end MEASUREMENT
/begin MEASUREMENT B_lamka "Lambda fÅr Kat-AusrÑumen aktiv" UWORD B_TRUE___UW 0 0 0.000000 0.000000 /begin IF_DATA ASAP1B_ETK KP_BLOB 0xFD5E 0 2 /end IF_DATA BIT_MASK 0x4 /end MEASUREMENT
/begin MEASUREMENT B_lamkh "Bedingung Lambdasoll fÅr Katheizen aktiv" UBYTE B_TRUE 0 0 0.000000 0.000000 /begin IF_DATA ASAP1B_ETK KP_BLOB 0x380B2F 1 1 /end IF_DATA BIT_MASK 0x1 /end MEASUREMENT
/begin MEASUREMENT B_lamlash "Bedingung fÅr Abmagern in %LAMKO" UWORD B_TRUE___UW 0 0 0.000000 0.000000 /begin IF_DATA ASAP1B_ETK KP_BLOB 0xFD28 0 2 /end IF_DATA BIT_MASK 0x20 /end MEASUREMENT
/begin MEASUREMENT B_lamnse "Bedingung Ende lamns_w-Berechnung" UWORD B_TRUE___UW 0 0 0.000000 0.000000 /begin IF_DATA ASAP1B_ETK KP_BLOB 0xFD5C 0 2 /end IF_DATA BIT_MASK 0x1 /end MEASUREMENT
/begin MEASUREMENT B_lamnswl "Lambda-Motor-Soll fÅr Nachstart und Warmlauf aktiv" UWORD B_TRUE___UW 0 0 0.000000 0.000000 /begin IF_DATA ASAP1B_ETK KP_BLOB 0xFD5E 0 2 /end IF_DATA BIT_MASK 0x8 /end MEASUREMENT
/begin MEASUREMENT B_lamsdef "Bedingung : definierte Soll-Lambda" UWORD B_TRUE___UW 0 0 0.000000 0.000000 /begin IF_DATA ASAP1B_ETK KP_BLOB 0xFD5E 0 2 /end IF_DATA BIT_MASK 0x10 /end MEASUREMENT
/begin MEASUREMENT B_ldb "Bedingung fÅr Ladedruckregelbereitschaft" UWORD B_TRUE___UW 0 0 0.000000 0.000000 /begin IF_DATA ASAP1B_ETK KP_BLOB 0xFD78 0 2 /end IF_DATA BIT_MASK 0x80 /end MEASUREMENT
/begin MEASUREMENT B_lddy "Flag fÅr Bedingung LDR-Dynamikbetrieb" UWORD B_TRUE___UW 0 0 0.000000 0.000000 /begin IF_DATA ASAP1B_ETK KP_BLOB 0xFD78 0 2 /end IF_DATA BIT_MASK 0x800 /end MEASUREMENT
/begin MEASUREMENT B_ldef "Bedingung : definierte Soll-Lambda Bank1" UWORD B_TRUE___UW 0 0 0.000000 0.000000 /begin IF_DATA ASAP1B_ETK KP_BLOB 0xFD5E 0 2 /end IF_DATA BIT_MASK 0x20 /end MEASUREMENT
/begin MEASUREMENT B_ldimxa "Bedingung fÅr Adaption Begrenzungswert I-Anteil LDR" UWORD B_TRUE___UW 0 0 0.000000 0.000000 /begin IF_DATA ASAP1B_ETK KP_BLOB 0xFD78 0 2 /end IF_DATA BIT_MASK 0x1000 /end MEASUREMENT
/begin MEASUREMENT B_ldimxn "Bedingung fÅr Negativ-Korrektur ldimxr" UWORD B_TRUE___UW 0 0 0.000000 0.000000 /begin IF_DATA ASAP1B_ETK KP_BLOB 0xFD78 0 2 /end IF_DATA BIT_MASK 0x2000 /end MEASUREMENT
/begin MEASUREMENT B_ldimxp "Bedingung fÅr Positiv-Korrektur ldimxr" UWORD B_TRUE___UW 0 0 0.000000 0.000000 /begin IF_DATA ASAP1B_ETK KP_BLOB 0xFD78 0 2 /end IF_DATA BIT_MASK 0x4000 /end MEASUREMENT
/begin MEASUREMENT B_ldob "Bedingung: Overboost aktiv" UWORD B_TRUE___UW 0 0 0.000000 0.000000 /begin IF_DATA ASAP1B_ETK KP_BLOB 0xFD7A 0 2 /end IF_DATA BIT_MASK 0x2 /end MEASUREMENT
/begin MEASUREMENT B_ldobsp "Bedingung LDR Overboost innerhalb Sperrzeit" UWORD B_TRUE___UW 0 0 0.000000 0.000000 /begin IF_DATA ASAP1B_ETK KP_BLOB 0xFD7A 0 2 /end IF_DATA BIT_MASK 0x4 /end MEASUREMENT
/begin MEASUREMENT B_ldr "Flag fÅr Bedingung LDR aktiv" UWORD B_TRUE___UW 0 0 0.000000 0.000000 /begin IF_DATA ASAP1B_ETK KP_BLOB 0xFD78 0 2 /end IF_DATA BIT_MASK 0x100 /end MEASUREMENT
/begin MEASUREMENT B_ldrbu "Flag fÅr Bedingung LDR backup Regler aktiv" UWORD B_TRUE___UW 0 0 0.000000 0.000000 /begin IF_DATA ASAP1B_ETK KP_BLOB 0xFD78 0 2 /end IF_DATA BIT_MASK 0x200 /end MEASUREMENT
/begin MEASUREMENT B_lds "Flag fÅr Bedingung LDR Steuerung" UWORD B_TRUE___UW 0 0 0.000000 0.000000 /begin IF_DATA ASAP1B_ETK KP_BLOB 0xFD78 0 2 /end IF_DATA BIT_MASK 0x400 /end MEASUREMENT
/begin MEASUREMENT B_ldsafw "LDR lÑuft auf Steuerung mit Festwert LDRAPP" UWORD B_TRUE___UW 0 0 0.000000 0.000000 /begin IF_DATA ASAP1B_ETK KP_BLOB 0xFD02 0 2 /end IF_DATA BIT_MASK 0x2 /end MEASUREMENT
/begin MEASUREMENT B_ldsapp "LDR lÑuft auf Steuerung mit KFLDRAPP" UWORD B_TRUE___UW 0 0 0.000000 0.000000 /begin IF_DATA ASAP1B_ETK KP_BLOB 0xFD02 0 2 /end IF_DATA BIT_MASK 0x4 /end MEASUREMENT
/begin MEASUREMENT B_ldsua "Bedingung LDR Schubumluftventil aktiv (offen)" UWORD B_TRUE___UW 0 0 0.000000 0.000000 /begin IF_DATA ASAP1B_ETK KP_BLOB 0xFD78 0 2 /end IF_DATA BIT_MASK 0x2 /end MEASUREMENT
/begin MEASUREMENT B_ldsuad "Bedingung Turbo Umluftsteuerung dynamisch aktiv" UWORD B_TRUE___UW 0 0 0.000000 0.000000 /begin IF_DATA ASAP1B_ETK KP_BLOB 0xFD78 0 2 /end IF_DATA BIT_MASK 0x4 /end MEASUREMENT
/begin MEASUREMENT B_ldsuas "Bedingung Turbo Umluftsteuerung stationÑr aktiv" UWORD B_TRUE___UW 0 0 0.000000 0.000000 /begin IF_DATA ASAP1B_ETK KP_BLOB 0xFD78 0 2 /end IF_DATA BIT_MASK 0x8 /end MEASUREMENT
/begin MEASUREMENT B_ldvl "Bedingung fÅr LDR-Vollast" UWORD B_TRUE___UW 0 0 0.000000 0.000000 /begin IF_DATA ASAP1B_ETK KP_BLOB 0xFD78 0 2 /end IF_DATA BIT_MASK 0x8000 /end MEASUREMENT
/begin MEASUREMENT B_ll "Bedingung Leerlauf" UWORD B_TRUE___UW 0 0 0.000000 0.000000 /begin IF_DATA ASAP1B_ETK KP_BLOB 0xFD7E 0 2 /end IF_DATA BIT_MASK 0x2000 /end MEASUREMENT
/begin MEASUREMENT B_llr "Bedingung Leerlaufregelung" UWORD B_TRUE___UW 0 0 0.000000 0.000000 /begin IF_DATA ASAP1B_ETK KP_BLOB 0xFD7C 0 2 /end IF_DATA BIT_MASK 0x4 /end MEASUREMENT
/begin MEASUREMENT B_llrein "Bedingung LLR ist aktiv" UWORD B_TRUE___UW 0 0 0.000000 0.000000 /begin IF_DATA ASAP1B_ETK KP_BLOB 0xFD7C 0 2 /end IF_DATA BIT_MASK 0x8 /end MEASUREMENT
/begin MEASUREMENT B_llri "Bedingung I-Anteil der LLR aktiv" UWORD B_TRUE___UW 0 0 0.000000 0.000000 /begin IF_DATA ASAP1B_ETK KP_BLOB 0xFD7C 0 2 /end IF_DATA BIT_MASK 0x10 /end MEASUREMENT
/begin MEASUREMENT B_llrpd "Bedingung PD-Anteil der LLR aktiv" UWORD B_TRUE___UW 0 0 0.000000 0.000000 /begin IF_DATA ASAP1B_ETK KP_BLOB 0xFD7C 0 2 /end IF_DATA BIT_MASK 0x20 /end MEASUREMENT
/begin MEASUREMENT B_lr "LREB: Bedingung Lambdaregelung (vor Kat); (Bank 1)" UWORD B_TRUE___UW 0 0 0.000000 0.000000 /begin IF_DATA ASAP1B_ETK KP_BLOB 0xFD94 0 2 /end IF_DATA BIT_MASK 0x2 /end MEASUREMENT
/begin MEASUREMENT B_lra " 1 = LRA enable" UWORD B_TRUE___UW 0 0 0.000000 0.000000 /begin IF_DATA ASAP1B_ETK KP_BLOB 0xFD62 0 2 /end IF_DATA BIT_MASK 0x400 /end MEASUREMENT
/begin MEASUREMENT B_lrar "Bedingung reduzierte Korrekturbereiche in der LRA" UWORD B_TRUE___UW 0 0 0.000000 0.000000 /begin IF_DATA ASAP1B_ETK KP_BLOB 0xFD88 0 2 /end IF_DATA BIT_MASK 0x2000 /end MEASUREMENT
/begin MEASUREMENT B_lrare "Bedingung Reset LRA" UWORD B_TRUE___UW 0 0 0.000000 0.000000 /begin IF_DATA ASAP1B_ETK KP_BLOB 0xFD5E 0 2 /end IF_DATA BIT_MASK 0x400 /end MEASUREMENT
/begin MEASUREMENT B_lrare2 "Bedingung Reset LRA Bank 2" UWORD B_TRUE___UW 0 0 0.000000 0.000000 /begin IF_DATA ASAP1B_ETK KP_BLOB 0xFD5E 0 2 /end IF_DATA BIT_MASK 0x800 /end MEASUREMENT
/begin MEASUREMENT B_lrareb "Bedingung Resetbereitschaft LRA" UWORD B_TRUE___UW 0 0 0.000000 0.000000 /begin IF_DATA ASAP1B_ETK KP_BLOB 0xFD5E 0 2 /end IF_DATA BIT_MASK 0x1000 /end MEASUREMENT
/begin MEASUREMENT B_lrnd "Steuerbit LR aktiv setzen; Anforderung 'NORMAL-' oder 'DIAGNOSE-Betrieb'" UWORD B_TRUE___UW 0 0 0.000000 0.000000 /begin IF_DATA ASAP1B_ETK KP_BLOB 0xFD94 0 2 /end IF_DATA BIT_MASK 0x400 /end MEASUREMENT
/begin MEASUREMENT B_lrnd2 "Steuerbit LR aktiv setzen; Anforderung 'NORMAL-' oder 'DIAGNOSE' z.B. bei SLS" UWORD B_TRUE___UW 0 0 0.000000 0.000000 /begin IF_DATA ASAP1B_ETK KP_BLOB 0xFD94 0 2 /end IF_DATA BIT_MASK 0x800 /end MEASUREMENT
/begin MEASUREMENT B_lrsp "Bedingung Sondensprung" UWORD B_TRUE___UW 0 0 0.000000 0.000000 /begin IF_DATA ASAP1B_ETK KP_BLOB 0xFD9C 0 2 /end IF_DATA BIT_MASK 0x10 /end MEASUREMENT
/begin MEASUREMENT B_lrsp2 "Bedingung Sondensprung Zylinderbank 2" UWORD B_TRUE___UW 0 0 0.000000 0.000000 /begin IF_DATA ASAP1B_ETK KP_BLOB 0xFD9C 0 2 /end IF_DATA BIT_MASK 0x20 /end MEASUREMENT
/begin MEASUREMENT B_lrstat "Bedingung Lambdaregler arbeitet stationÑr" UWORD B_TRUE___UW 0 0 0.000000 0.000000 /begin IF_DATA ASAP1B_ETK KP_BLOB 0xFD9C 0 2 /end IF_DATA BIT_MASK 0x40 /end MEASUREMENT
/begin MEASUREMENT B_lrstat2 "Bedingung Lambdaregler arbeitet stationÑr, Bank2" UWORD B_TRUE___UW 0 0 0.000000 0.000000 /begin IF_DATA ASAP1B_ETK KP_BLOB 0xFD9C 0 2 /end IF_DATA BIT_MASK 0x80 /end MEASUREMENT
/begin MEASUREMENT B_lrstta "Bedingung Lambdaregler arbeitet stationÑr, Zeit und Amplitudenbedingung" UWORD B_TRUE___UW 0 0 0.000000 0.000000 /begin IF_DATA ASAP1B_ETK KP_BLOB 0xFD9C 0 2 /end IF_DATA BIT_MASK 0x100 /end MEASUREMENT
/begin MEASUREMENT B_lrstta2 "Bedingung Lambdaregler arbeitet stationÑr, Zeit und Amplitudenbedingung Bank 2" UWORD B_TRUE___UW 0 0 0.000000 0.000000 /begin IF_DATA ASAP1B_ETK KP_BLOB 0xFD9C 0 2 /end IF_DATA BIT_MASK 0x200 /end MEASUREMENT
/begin MEASUREMENT B_lrtpp "Periodendauer gÅltig, Bed. LR arbeitet stationÑr (Amplitude/Periode) erfÅllt" UWORD B_TRUE___UW 0 0 0.000000 0.000000 /begin IF_DATA ASAP1B_ETK KP_BLOB 0xFD9C 0 2 /end IF_DATA BIT_MASK 0x400 /end MEASUREMENT
/begin MEASUREMENT B_lrtpp2 "Bedingung Lambdaregler arbeitet stationÑr (Amplitude/Periode) Bank2" UWORD B_TRUE___UW 0 0 0.000000 0.000000 /begin IF_DATA ASAP1B_ETK KP_BLOB 0xFD9C 0 2 /end IF_DATA BIT_MASK 0x800 /end MEASUREMENT
/begin MEASUREMENT B_lsvvsp "Bedingung Vertauschte Lambda-Sonden, Regelung sperren" UWORD B_TRUE___UW 0 0 0.000000 0.000000 /begin IF_DATA ASAP1B_ETK KP_BLOB 0xFD08 0 2 /end IF_DATA BIT_MASK 0x200 /end MEASUREMENT
/begin MEASUREMENT B_mdarv "kritische Aussetzerrate vorhanden" UWORD B_TRUE___UW 0 0 0.000000 0.000000 /begin IF_DATA ASAP1B_ETK KP_BLOB 0xFD1A 0 2 /end IF_DATA BIT_MASK 0x4 /end MEASUREMENT
/begin MEASUREMENT B_mdein "Bedingung Momenteneingriff aktiv" UWORD B_TRUE___UW 0 0 0.000000 0.000000 /begin IF_DATA ASAP1B_ETK KP_BLOB 0xFD82 0 2 /end IF_DATA BIT_MASK 0x10 /end MEASUREMENT
/begin MEASUREMENT B_mdmin "Bedingung minimal erreichbares indiziertes Moment erreicht" UWORD B_TRUE___UW 0 0 0.000000 0.000000 /begin IF_DATA ASAP1B_ETK KP_BLOB 0xFD5A 0 2 /end IF_DATA BIT_MASK 0x4 /end MEASUREMENT
/begin MEASUREMENT B_nac "Bedingung fÅr erhîhte LL-Drehzahl bei Klimaanlage" UWORD B_TRUE___UW 0 0 0.000000 0.000000 /begin IF_DATA ASAP1B_ETK KP_BLOB 0xFDA2 0 2 /end IF_DATA BIT_MASK 0x80 /end MEASUREMENT
/begin MEASUREMENT B_nftev "Bedingung Drehzahlanhebung fÅr erhîhte TE-SpÅlrate" UWORD B_TRUE___UW 0 0 0.000000 0.000000 /begin IF_DATA ASAP1B_ETK KP_BLOB 0xFD08 0 2 /end IF_DATA BIT_MASK 0x2000 /end MEASUREMENT
/begin MEASUREMENT B_nldg "Bedingung Drehzahlgeber-Notlauf" UWORD B_TRUE___UW 0 0 0.000000 0.000000 /begin IF_DATA ASAP1B_ETK KP_BLOB 0xFD22 0 2 /end IF_DATA BIT_MASK 0x1 /end MEASUREMENT
/begin MEASUREMENT B_nmax "1 = Maximaldrehzahl ueberschritten" UWORD B_TRUE___UW 0 0 0.000000 0.000000 /begin IF_DATA ASAP1B_ETK KP_BLOB 0xFD82 0 2 /end IF_DATA BIT_MASK 0x1000 /end MEASUREMENT
/begin MEASUREMENT B_nmot "Bedingung Motordrehzahl: n > NMIN" UWORD B_TRUE___UW 0 0 0.000000 0.000000 /begin IF_DATA ASAP1B_ETK KP_BLOB 0xFD1E 0 2 /end IF_DATA BIT_MASK 0x800 /end MEASUREMENT
/begin MEASUREMENT B_nofra "Bedingung Sperren der multiplikativen Gemischkorrektur" UWORD B_TRUE___UW 0 0 0.000000 0.000000 /begin IF_DATA ASAP1B_ETK KP_BLOB 0xFD5E 0 2 /end IF_DATA BIT_MASK 0x2000 /end MEASUREMENT
/begin MEASUREMENT B_norkat "Bedingung additive Korrektur der Gemischadaption pro Zeit abgeschaltet" UWORD B_TRUE___UW 0 0 0.000000 0.000000 /begin IF_DATA ASAP1B_ETK KP_BLOB 0xFD5E 0 2 /end IF_DATA BIT_MASK 0x4000 /end MEASUREMENT
/begin MEASUREMENT B_norkaz "Bedingung additive Korrektur der Gemischadaption pro ZÅndung abgeschaltet" UWORD B_TRUE___UW 0 0 0.000000 0.000000 /begin IF_DATA ASAP1B_ETK KP_BLOB 0xFD5E 0 2 /end IF_DATA BIT_MASK 0x8000 /end MEASUREMENT
/begin MEASUREMENT B_ns2 "Bedingung Solldrehzahl 2 aktiv" UWORD B_TRUE___UW 0 0 0.000000 0.000000 /begin IF_DATA ASAP1B_ETK KP_BLOB 0xFD7A 0 2 /end IF_DATA BIT_MASK 0x400 /end MEASUREMENT
/begin MEASUREMENT B_ns2a "Bedingung Solldrehzahl 2 angefordert" UWORD B_TRUE___UW 0 0 0.000000 0.000000 /begin IF_DATA ASAP1B_ETK KP_BLOB 0xFD7A 0 2 /end IF_DATA BIT_MASK 0x800 /end MEASUREMENT
/begin MEASUREMENT B_nsks "Bedingung fÅr Solldrehzahlanhebung (Kochschutz)" UWORD B_TRUE___UW 0 0 0.000000 0.000000 /begin IF_DATA ASAP1B_ETK KP_BLOB 0xFD7A 0 2 /end IF_DATA BIT_MASK 0x1000 /end MEASUREMENT
/begin MEASUREMENT B_nssl "Bedingung Soll-Drehzahlanhebung bei Servo-Lenkung" UWORD B_TRUE___UW 0 0 0.000000 0.000000 /begin IF_DATA ASAP1B_ETK KP_BLOB 0xFD7A 0 2 /end IF_DATA BIT_MASK 0x2000 /end MEASUREMENT
/begin MEASUREMENT B_nswo1 "Bedingung Drehzahl > NSWO1" UWORD B_TRUE___UW 0 0 0.000000 0.000000 /begin IF_DATA ASAP1B_ETK KP_BLOB 0xFD02 0 2 /end IF_DATA BIT_MASK 0x1000 /end MEASUREMENT
/begin MEASUREMENT B_pwf "Bedingung Powerfail" UWORD B_TRUE___UW 0 0 0.000000 0.000000 /begin IF_DATA ASAP1B_ETK KP_BLOB 0xFD88 0 2 /end IF_DATA BIT_MASK 0x10 /end MEASUREMENT
/begin MEASUREMENT B_rkat "Bedingung Lernbereich additive Korrektur pro Zeit aktiv" UWORD B_TRUE___UW 0 0 0.000000 0.000000 /begin IF_DATA ASAP1B_ETK KP_BLOB 0xFD60 0 2 /end IF_DATA BIT_MASK 0x1 /end MEASUREMENT
/begin MEASUREMENT B_rkatr "Bedingung rkat-Integrator au·erhalb reduzierten Bereich" UWORD B_TRUE___UW 0 0 0.000000 0.000000 /begin IF_DATA ASAP1B_ETK KP_BLOB 0xFD60 0 2 /end IF_DATA BIT_MASK 0x2 /end MEASUREMENT
/begin MEASUREMENT B_rkaz "Bedingung Lernbereich additive Korrektur pro ZÅndung aktiv" UWORD B_TRUE___UW 0 0 0.000000 0.000000 /begin IF_DATA ASAP1B_ETK KP_BLOB 0xFD60 0 2 /end IF_DATA BIT_MASK 0x4 /end MEASUREMENT
/begin MEASUREMENT B_rkazr "Bedingung rkaz-Integrator au·erhalb reduzierten Bereich" UWORD B_TRUE___UW 0 0 0.000000 0.000000 /begin IF_DATA ASAP1B_ETK KP_BLOB 0xFD60 0 2 /end IF_DATA BIT_MASK 0x8 /end MEASUREMENT
/begin MEASUREMENT B_sa "Schubabschaltung" UWORD B_TRUE___UW 0 0 0.000000 0.000000 /begin IF_DATA ASAP1B_ETK KP_BLOB 0xFD84 0 2 /end IF_DATA BIT_MASK 0x2 /end MEASUREMENT
/begin MEASUREMENT B_sab "Bedingung Schubabschaltebereitschaft" UWORD B_TRUE___UW 0 0 0.000000 0.000000 /begin IF_DATA ASAP1B_ETK KP_BLOB 0xFD7A 0 2 /end IF_DATA BIT_MASK 0x100 /end MEASUREMENT
/begin MEASUREMENT B_sgnalt "Vorzeichen fÅr Gemisch vor Kat (Bool), 1 Rechenraster verzîgert" UWORD B_TRUE___UW 0 0 0.000000 0.000000 /begin IF_DATA ASAP1B_ETK KP_BLOB 0xFD9C 0 2 /end IF_DATA BIT_MASK 0x1000 /end MEASUREMENT
/begin MEASUREMENT B_sgnalt2 "Vorzeichen fÅr Gemisch vor Kat (Bool), 1 Rechenraster verzîgert" UWORD B_TRUE___UW 0 0 0.000000 0.000000 /begin IF_DATA ASAP1B_ETK KP_BLOB 0xFD9C 0 2 /end IF_DATA BIT_MASK 0x2000 /end MEASUREMENT
/begin MEASUREMENT B_sgnlr "Vorzeichen fÅr Gemisch vor Kat (Bool)" UWORD B_TRUE___UW 0 0 0.000000 0.000000 /begin IF_DATA ASAP1B_ETK KP_BLOB 0xFD9C 0 2 /end IF_DATA BIT_MASK 0x4000 /end MEASUREMENT
/begin MEASUREMENT B_sgnlr2 "Vorzeichen fÅr Gemisch vor Kat (Bool), Bank 2" UWORD B_TRUE___UW 0 0 0.000000 0.000000 /begin IF_DATA ASAP1B_ETK KP_BLOB 0xFD9C 0 2 /end IF_DATA BIT_MASK 0x8000 /end MEASUREMENT
/begin MEASUREMENT B_sgnra "Vorzeichen fÅr Gemisch vor Kat gem. Sperrzeitsteuerung (Bool)" UWORD B_TRUE___UW 0 0 0.000000 0.000000 /begin IF_DATA ASAP1B_ETK KP_BLOB 0xFD9E 0 2 /end IF_DATA BIT_MASK 0x1 /end MEASUREMENT
/begin MEASUREMENT B_sgnra2 "Vorzeichen fÅr Gemisch vor Kat gem. Sperrzeitsteuerung (Bool), Bank 2" UWORD B_TRUE___UW 0 0 0.000000 0.000000 /begin IF_DATA ASAP1B_ETK KP_BLOB 0xFD9E 0 2 /end IF_DATA BIT_MASK 0x2 /end MEASUREMENT
/begin MEASUREMENT B_sl "Bedingung Servo-Lenkung" UWORD B_TRUE___UW 0 0 0.000000 0.000000 /begin IF_DATA ASAP1B_ETK KP_BLOB 0xFD08 0 2 /end IF_DATA BIT_MASK 0x8000 /end MEASUREMENT
/begin MEASUREMENT B_sls "Bedingung SekundÑrluft aktiv" UWORD B_TRUE___UW 0 0 0.000000 0.000000 /begin IF_DATA ASAP1B_ETK KP_BLOB 0xFD0A 0 2 /end IF_DATA BIT_MASK 0x800 /end MEASUREMENT
/begin MEASUREMENT B_slsfz "Bedingung SLS in Fahrzeug eingebaut" UWORD B_TRUE___UW 0 0 0.000000 0.000000 /begin IF_DATA ASAP1B_ETK KP_BLOB 0xFD02 0 2 /end IF_DATA BIT_MASK 0x4000 /end MEASUREMENT
/begin MEASUREMENT B_spsmin "Mitteilung an SR: '1'= PWG-Notfahren mit SPSMIN" UWORD B_TRUE___UW 0 0 0.000000 0.000000 /begin IF_DATA ASAP1B_ETK KP_BLOB 0xFD3C 0 2 /end IF_DATA BIT_MASK 0x800 /end MEASUREMENT
/begin MEASUREMENT B_st "Bedingung Start" UWORD B_TRUE___UW 0 0 0.000000 0.000000 /begin IF_DATA ASAP1B_ETK KP_BLOB 0xFD88 0 2 /end IF_DATA BIT_MASK 0x20 /end MEASUREMENT
/begin MEASUREMENT B_stend "1 = Startende erkannt" UWORD B_TRUE___UW 0 0 0.000000 0.000000 /begin IF_DATA ASAP1B_ETK KP_BLOB 0xFD88 0 2 /end IF_DATA BIT_MASK 0x40 /end MEASUREMENT
/begin MEASUREMENT B_stldw "Bedingung StÅtzstellenwechsel LDR Adaption" UWORD B_TRUE___UW 0 0 0.000000 0.000000 /begin IF_DATA ASAP1B_ETK KP_BLOB 0xFD7A 0 2 /end IF_DATA BIT_MASK 0x1 /end MEASUREMENT
/begin MEASUREMENT B_synph "Bedingung Synchronisation Phase" UWORD B_TRUE___UW 0 0 0.000000 0.000000 /begin IF_DATA ASAP1B_ETK KP_BLOB 0xFD20 0 2 /end IF_DATA BIT_MASK 0x40 /end MEASUREMENT
/begin MEASUREMENT B_tabgbts "Bedingung Abgastemperatur fÅr Bauteileschutz Åberschritten" UWORD B_TRUE___UW 0 0 0.000000 0.000000 /begin IF_DATA ASAP1B_ETK KP_BLOB 0xFD66 0 2 /end IF_DATA BIT_MASK 0x8000 /end MEASUREMENT
/begin MEASUREMENT B_te "TankentlÅftung aktiv" UWORD B_TRUE___UW 0 0 0.000000 0.000000 /begin IF_DATA ASAP1B_ETK KP_BLOB 0xFD88 0 2 /end IF_DATA BIT_MASK 0x100 /end MEASUREMENT
/begin MEASUREMENT B_tehbx "Bedingung Beladungsintegrator ftead am Maximalanschlag" UWORD B_TRUE___UW 0 0 0.000000 0.000000 /begin IF_DATA ASAP1B_ETK KP_BLOB 0xFD8A 0 2 /end IF_DATA BIT_MASK 0x2 /end MEASUREMENT
/begin MEASUREMENT B_tisum "Bedingung Reset Ti-SummenzÑhler" UWORD B_TRUE___UW 0 0 0.000000 0.000000 /begin IF_DATA ASAP1B_ETK KP_BLOB 0xFDA6 0 2 /end IF_DATA BIT_MASK 0x100 /end MEASUREMENT
/begin MEASUREMENT B_tkatbts "Bedingung Katalysatortemperatur fÅr Bauteileschutz Åberschritten" UWORD B_TRUE___UW 0 0 0.000000 0.000000 /begin IF_DATA ASAP1B_ETK KP_BLOB 0xFD68 0 2 /end IF_DATA BIT_MASK 0x1 /end MEASUREMENT
/begin MEASUREMENT B_tmkib "Bedingung: Motortemperatur vom Kombiinstrument betriebsbereit" UBYTE B_TRUE 0 0 0.000000 0.000000 /begin IF_DATA ASAP1B_ETK KP_BLOB 0x38098D 1 1 /end IF_DATA BIT_MASK 0x1 /end MEASUREMENT
/begin MEASUREMENT B_tmkr "Bedingung Temperatur (tmot) fuer KR aktiv erreicht" UWORD B_TRUE___UW 0 0 0.000000 0.000000 /begin IF_DATA ASAP1B_ETK KP_BLOB 0xFD72 0 2 /end IF_DATA BIT_MASK 0x4 /end MEASUREMENT
/begin MEASUREMENT B_tsper "LR: Bedingung Starten der Sperrzeit" UWORD B_TRUE___UW 0 0 0.000000 0.000000 /begin IF_DATA ASAP1B_ETK KP_BLOB 0xFD9E 0 2 /end IF_DATA BIT_MASK 0x4 /end MEASUREMENT
/begin MEASUREMENT B_tsper2 "LR Bank2 : Bedingung Starten der Sperrzeit" UWORD B_TRUE___UW 0 0 0.000000 0.000000 /begin IF_DATA ASAP1B_ETK KP_BLOB 0xFD9E 0 2 /end IF_DATA BIT_MASK 0x8 /end MEASUREMENT
/begin MEASUREMENT B_tspon "Bedingung Entstîrsperrzeit in der Lambdaregelung starten" UWORD B_TRUE___UW 0 0 0.000000 0.000000 /begin IF_DATA ASAP1B_ETK KP_BLOB 0xFD9E 0 2 /end IF_DATA BIT_MASK 0x10 /end MEASUREMENT
/begin MEASUREMENT B_tspon2 "Bedingung Entstîrsperrzeit in der Lambdaregelung starten, Bank 2" UWORD B_TRUE___UW 0 0 0.000000 0.000000 /begin IF_DATA ASAP1B_ETK KP_BLOB 0xFD9E 0 2 /end IF_DATA BIT_MASK 0x20 /end MEASUREMENT
/begin MEASUREMENT B_ukg "Bedingung ök wirkt stark" UWORD B_TRUE___UW 0 0 0.000000 0.000000 /begin IF_DATA ASAP1B_ETK KP_BLOB 0xFD64 0 2 /end IF_DATA BIT_MASK 0x1 /end MEASUREMENT
/begin MEASUREMENT B_vl "Vollgasbit wird gesetzt, wenn Pedalwert swpd grî·er als Schwelle SW_VG wird." UWORD B_TRUE___UW 0 0 0.000000 0.000000 /begin IF_DATA ASAP1B_ETK KP_BLOB 0xFD80 0 2 /end IF_DATA BIT_MASK 0x4 /end MEASUREMENT
/begin MEASUREMENT B_vllr "Bedingung Fahrzeug rollt mit eingelegtem Gang" UWORD B_TRUE___UW 0 0 0.000000 0.000000 /begin IF_DATA ASAP1B_ETK KP_BLOB 0xFD7C 0 2 /end IF_DATA BIT_MASK 0x40 /end MEASUREMENT
/begin MEASUREMENT B_vmax "Flag VMAX-Begrenzung aktiv" UWORD dez___UW 0 0 0.000000 65535.000000 /begin IF_DATA ASAP1B_ETK KP_BLOB 0xFD84 0 2 /end IF_DATA BIT_MASK 0x20 /end MEASUREMENT
/begin MEASUREMENT B_wkauf "Bedingung Wandlerkupplung offen" UWORD B_TRUE___UW 0 0 0.000000 0.000000 /begin IF_DATA ASAP1B_ETK KP_BLOB 0xFD14 0 2 /end IF_DATA BIT_MASK 0x400 /end MEASUREMENT
/begin MEASUREMENT B_wkral "Bedingung wkr aus KR-Adaptionskennfeld einlesen" UWORD B_TRUE___UW 0 0 0.000000 0.000000 /begin IF_DATA ASAP1B_ETK KP_BLOB 0xFD72 0 2 /end IF_DATA BIT_MASK 0x8 /end MEASUREMENT
/begin MEASUREMENT B_zwkraa "Bedingung ZÅndwinkel der KR wird ausgegeben" UWORD B_TRUE___UW 0 0 0.000000 0.000000 /begin IF_DATA ASAP1B_ETK KP_BLOB 0xFD72 0 2 /end IF_DATA BIT_MASK 0x10 /end MEASUREMENT
/begin MEASUREMENT B_zwkrum "Flag: schnelle FrÅhverstellung" UWORD B_TRUE___UW 0 0 0.000000 0.000000 /begin IF_DATA ASAP1B_ETK KP_BLOB 0xFD72 0 2 /end IF_DATA BIT_MASK 0x20 /end MEASUREMENT
/begin MEASUREMENT dfrm_w "Abweichung schneller Mittelwert des Lambdareglers von 1.0 (Word)" SWORD fak_sw_b1 0 0 -1.000000 0.999969 /begin IF_DATA ASAP1B_ETK KP_BLOB 0x381FF2 1 2 /end IF_DATA BIT_MASK 0xFFFF /end MEASUREMENT
/begin MEASUREMENT dfrsp2_w "delta Spitzenwert Lambdaregelfaktor frsp Bank 2" SWORD fak_sw_b1 0 0 -1.000000 0.999969 /begin IF_DATA ASAP1B_ETK KP_BLOB 0x382882 1 2 /end IF_DATA BIT_MASK 0xFFFF /end MEASUREMENT
/begin MEASUREMENT dfrsp_w "delta Spitzenwert Lambdaregelfaktor frsp" SWORD fak_sw_b1 0 0 -1.000000 0.999969 /begin IF_DATA ASAP1B_ETK KP_BLOB 0x382884 1 2 /end IF_DATA BIT_MASK 0xFFFF /end MEASUREMENT
/begin MEASUREMENT dfrst2_w "fr-Regelhub im StationÑrzustand (Zylinderbank 2)" SWORD fak_sw_b1 0 0 -1.000000 0.999969 /begin IF_DATA ASAP1B_ETK KP_BLOB 0x382886 1 2 /end IF_DATA BIT_MASK 0xFFFF /end MEASUREMENT
/begin MEASUREMENT dfrstga2_w "Regelhub im StationÑrbetrieb (Grundadaptions-Phase), Bank 2" SWORD fak_sw_b1 0 0 -1.000000 0.999969 /begin IF_DATA ASAP1B_ETK KP_BLOB 0x383E4E 1 2 /end IF_DATA BIT_MASK 0xFFFF /end MEASUREMENT
/begin MEASUREMENT dfrstga_w "Regelhub im StationÑrbetrieb (Grundadaptions-Phase)" SWORD fak_sw_b1 0 0 -1.000000 0.999969 /begin IF_DATA ASAP1B_ETK KP_BLOB 0x383E50 1 2 /end IF_DATA BIT_MASK 0xFFFF /end MEASUREMENT
/begin MEASUREMENT dfrstte2_w "Regelhub im StationÑrbetrieb (TankentlÅftung-SpÅlphase), Bank 2" SWORD fak_sw_b1 0 0 -1.000000 0.999969 /begin IF_DATA ASAP1B_ETK KP_BLOB 0x383E52 1 2 /end IF_DATA BIT_MASK 0xFFFF /end MEASUREMENT
/begin MEASUREMENT dfrstte_w "Regelhub im StationÑrbetrieb (TankentlÅftung-SpÅlphase)" SWORD fak_sw_b1 0 0 -1.000000 0.999969 /begin IF_DATA ASAP1B_ETK KP_BLOB 0x383E54 1 2 /end IF_DATA BIT_MASK 0xFFFF /end MEASUREMENT
/begin MEASUREMENT dfrst_w "fr-Regelhub im StationÑrzustand" SWORD fak_sw_b1 0 0 -1.000000 0.999969 /begin IF_DATA ASAP1B_ETK KP_BLOB 0x382888 1 2 /end IF_DATA BIT_MASK 0xFFFF /end MEASUREMENT
/begin MEASUREMENT dlambts_w "Delta Lambda fÅr Bauteileschutz" SWORD fak_sw_b8 0 0 -8.000000 7.999756 /begin IF_DATA ASAP1B_ETK KP_BLOB 0x3820A2 1 2 /end IF_DATA BIT_MASK 0xFFFF /end MEASUREMENT
/begin MEASUREMENT dmllrd_w "geforderte DrehmomentÑnderung von der LLR (D-Anteil)" SWORD rel_sw_b100 0 0 -100.000000 99.996948 /begin IF_DATA ASAP1B_ETK KP_BLOB 0x382366 1 2 /end IF_DATA BIT_MASK 0xFFFF /end MEASUREMENT
/begin MEASUREMENT dmllri_w "geforderte DrehmomentÑnderung von der LLR (I-Anteil)" SWORD rel_sw_b100 0 0 -100.000000 99.996948 /begin IF_DATA ASAP1B_ETK KP_BLOB 0x382368 1 2 /end IF_DATA BIT_MASK 0xFFFF /end MEASUREMENT
/begin MEASUREMENT dmllrl_w "geforderte DrehmomentÑnderung von der LLR (Anteil Luftpfad)" SWORD rel_sw_b100 0 0 -100.000000 99.996948 /begin IF_DATA ASAP1B_ETK KP_BLOB 0x38236A 1 2 /end IF_DATA BIT_MASK 0xFFFF /end MEASUREMENT
/begin MEASUREMENT dmllrp_w "geforderte DrehmomentÑnderung von der LLR (P-Anteil)" SWORD rel_sw_b100 0 0 -100.000000 99.996948 /begin IF_DATA ASAP1B_ETK KP_BLOB 0x38236C 1 2 /end IF_DATA BIT_MASK 0xFFFF /end MEASUREMENT
/begin MEASUREMENT dmllr_w "geforderte DrehmomentÑnderung von der LLR (PD-Anteil)" SWORD rel_sw_b100 0 0 -100.000000 99.996948 /begin IF_DATA ASAP1B_ETK KP_BLOB 0x38236E 1 2 /end IF_DATA BIT_MASK 0xFFFF /end MEASUREMENT
/begin MEASUREMENT dmrac "Reservemoment fÅr AC-Kompressor" UBYTE rel_ub_b99p6 0 0 0.000000 99.609375 /begin IF_DATA ASAP1B_ETK KP_BLOB 0x380C2E 1 1 /end IF_DATA BIT_MASK 0xFF /end MEASUREMENT
/begin MEASUREMENT dmrllr_w "Momenten-Reserve fÅr Leerlaufregelung" UWORD rel_uw_b100 0 0 0.000000 99.998474 /begin IF_DATA ASAP1B_ETK KP_BLOB 0x382360 1 2 /end IF_DATA BIT_MASK 0xFFFF /end MEASUREMENT
/begin MEASUREMENT dmrwan "Momentreserve fÅr Drehmomentaufnahme des Wandlers" UBYTE rel_ub_b99p6 0 0 0.000000 99.609375 /begin IF_DATA ASAP1B_ETK KP_BLOB 0x380C25 1 1 /end IF_DATA BIT_MASK 0xFF /end MEASUREMENT
/begin MEASUREMENT dnikorr_w "Korrekturwert auf den Integrator nach Diagnose" UWORD nmot_uw_q0p25 0 0 0.000000 16383.750000 /begin IF_DATA ASAP1B_ETK KP_BLOB 0x382370 1 2 /end IF_DATA BIT_MASK 0xFFFF /end MEASUREMENT
/begin MEASUREMENT dn_w "Drehzahlabweichung bei Leerlaufregelung" SWORD nmot_sw_q0p25 0 0 -8192.000000 8191.750000 /begin IF_DATA ASAP1B_ETK KP_BLOB 0x382372 1 2 /end IF_DATA BIT_MASK 0xFFFF /end MEASUREMENT
/begin MEASUREMENT drlmaxo "Delta Maximalfuellung bei Overboost" UBYTE rel_ub_q0p75 0 0 0.000000 191.250000 /begin IF_DATA ASAP1B_ETK KP_BLOB 0x380C03 1 1 /end IF_DATA BIT_MASK 0xFF /end MEASUREMENT
/begin MEASUREMENT dtvka "Delta-tv fÅr Katalysator-AusrÑumen" SBYTE t100msxs_sb_q0p01 0 0 -1.280000 1.270000 /begin IF_DATA ASAP1B_ETK KP_BLOB 0x380CE1 1 1 /end IF_DATA BIT_MASK 0xFF /end MEASUREMENT
/begin MEASUREMENT dwkr "zylinderindividuelle ZÅndwinkelspÑtverstellung KR" SBYTE zw_sb_q0p75 0 0 -96.000000 95.250000 /begin IF_DATA ASAP1B_ETK KP_BLOB 0x380BB8 1 1 /end IF_DATA BIT_MASK 0xFF /end MEASUREMENT
/begin MEASUREMENT dwkrm "Differenz wkrm-wkrmstat" UBYTE zw_ub_q0p75 0 0 0.000000 191.250000 /begin IF_DATA ASAP1B_ETK KP_BLOB 0x380C04 1 1 /end IF_DATA BIT_MASK 0xFF /end MEASUREMENT
/begin MEASUREMENT dwkrmsw "aktueller Wert fÅr Mittelwertbegrenzung der SpÑtverstellung" UBYTE zw_ub_qn0p75 0 0 -191.250000 0.000000 /begin IF_DATA ASAP1B_ETK KP_BLOB 0x380BB9 1 1 /end IF_DATA BIT_MASK 0xFF /end MEASUREMENT
/begin MEASUREMENT dwkrz_0_A "zyl.ind. ZW-SpÑtverstellung inkl. Dyn.vorhalt" SBYTE zw_sb_q0p75 0 0 -96.000000 95.250000 /begin IF_DATA ASAP1B_ETK KP_BLOB 0x380BBA 1 1 /end IF_DATA BIT_MASK 0xFF /end MEASUREMENT
/begin MEASUREMENT dwkrz_1_A "zyl.ind. ZW-SpÑtverstellung inkl. Dyn.vorhalt" SBYTE zw_sb_q0p75 0 0 -96.000000 95.250000 /begin IF_DATA ASAP1B_ETK KP_BLOB 0x380BBB 1 1 /end IF_DATA BIT_MASK 0xFF /end MEASUREMENT
/begin MEASUREMENT dwkrz_2_A "zyl.ind. ZW-SpÑtverstellung inkl. Dyn.vorhalt" SBYTE zw_sb_q0p75 0 0 -96.000000 95.250000 /begin IF_DATA ASAP1B_ETK KP_BLOB 0x380BBC 1 1 /end IF_DATA BIT_MASK 0xFF /end MEASUREMENT
/begin MEASUREMENT dwkrz_3_A "zyl.ind. ZW-SpÑtverstellung inkl. Dyn.vorhalt" SBYTE zw_sb_q0p75 0 0 -96.000000 95.250000 /begin IF_DATA ASAP1B_ETK KP_BLOB 0x380BBD 1 1 /end IF_DATA BIT_MASK 0xFF /end MEASUREMENT
/begin MEASUREMENT dwkrz_4_A "zyl.ind. ZW-SpÑtverstellung inkl. Dyn.vorhalt" SBYTE zw_sb_q0p75 0 0 -96.000000 95.250000 /begin IF_DATA ASAP1B_ETK KP_BLOB 0x380BBE 1 1 /end IF_DATA BIT_MASK 0xFF /end MEASUREMENT
/begin MEASUREMENT dwkrz_5_A "zyl.ind. ZW-SpÑtverstellung inkl. Dyn.vorhalt" SBYTE zw_sb_q0p75 0 0 -96.000000 95.250000 /begin IF_DATA ASAP1B_ETK KP_BLOB 0x380BBF 1 1 /end IF_DATA BIT_MASK 0xFF /end MEASUREMENT
/begin MEASUREMENT dwkrz_6_A "zyl.ind. ZW-SpÑtverstellung inkl. Dyn.vorhalt" SBYTE zw_sb_q0p75 0 0 -96.000000 95.250000 /begin IF_DATA ASAP1B_ETK KP_BLOB 0x380BC0 1 1 /end IF_DATA BIT_MASK 0xFF /end MEASUREMENT
/begin MEASUREMENT dwkrz_7_A "zyl.ind. ZW-SpÑtverstellung inkl. Dyn.vorhalt" SBYTE zw_sb_q0p75 0 0 -96.000000 95.250000 /begin IF_DATA ASAP1B_ETK KP_BLOB 0x380BC1 1 1 /end IF_DATA BIT_MASK 0xFF /end MEASUREMENT
/begin MEASUREMENT dwped "Gradient des normierten Fahrpedalwinkels" SBYTE rel_sb_q0p39 0 0 -49.996800 49.606200 /begin IF_DATA ASAP1B_ETK KP_BLOB 0x380AB8 1 1 /end IF_DATA BIT_MASK 0xFF /end MEASUREMENT
/begin MEASUREMENT dzwg "Delta ZÅndwinkel Grund-ZW zu Optimal-ZW" SBYTE zw_sb_q0p75 0 0 -96.000000 95.250000 /begin IF_DATA ASAP1B_ETK KP_BLOB 0x380B4E 1 1 /end IF_DATA BIT_MASK 0xFF /end MEASUREMENT
/begin MEASUREMENT dzwwl "Delta Zuendwinkel aus Warmlauf" SBYTE zw_sb_q0p75 0 0 -96.000000 95.250000 /begin IF_DATA ASAP1B_ETK KP_BLOB 0x380D21 1 1 /end IF_DATA BIT_MASK 0xFF /end MEASUREMENT
/begin MEASUREMENT esst_sdn06llsb "" UWORD dez___UW 0 0 0.000000 65535.000000 /begin IF_DATA ASAP1B_ETK KP_BLOB 0x382374 1 2 /end IF_DATA BIT_MASK 0xFFFF /end MEASUREMENT
/begin MEASUREMENT esst_sld04ldub "" UWORD dez___UW 0 0 0.000000 65535.000000 /begin IF_DATA ASAP1B_ETK KP_BLOB 0x380E64 1 2 /end IF_DATA BIT_MASK 0xFFFF /end MEASUREMENT
/begin MEASUREMENT esst_smi04llub "" UWORD dez___UW 0 0 0.000000 65535.000000 /begin IF_DATA ASAP1B_ETK KP_BLOB 0x380E66 1 2 /end IF_DATA BIT_MASK 0xFFFF /end MEASUREMENT
/begin MEASUREMENT esst_sng06llsb "" UWORD dez___UW 0 0 0.000000 65535.000000 /begin IF_DATA ASAP1B_ETK KP_BLOB 0x380E68 1 2 /end IF_DATA BIT_MASK 0xFFFF /end MEASUREMENT
/begin MEASUREMENT esst_snm06llub "" UWORD dez___UW 0 0 0.000000 65535.000000 /begin IF_DATA ASAP1B_ETK KP_BLOB 0x380E6A 1 2 /end IF_DATA BIT_MASK 0xFFFF /end MEASUREMENT
/begin MEASUREMENT esst_snm07lrub "" UWORD dez___UW 0 0 0.000000 65535.000000 /begin IF_DATA ASAP1B_ETK KP_BLOB 0x380E26 1 2 /end IF_DATA BIT_MASK 0xFFFF /end MEASUREMENT
/begin MEASUREMENT esst_snm08ldub "" UWORD dez___UW 0 0 0.000000 65535.000000 /begin IF_DATA ASAP1B_ETK KP_BLOB 0x380E6E 1 2 /end IF_DATA BIT_MASK 0xFFFF /end MEASUREMENT
/begin MEASUREMENT esst_snm08lduw "" UWORD dez___UW 0 0 0.000000 65535.000000 /begin IF_DATA ASAP1B_ETK KP_BLOB 0x380E70 1 2 /end IF_DATA BIT_MASK 0xFFFF /end MEASUREMENT
/begin MEASUREMENT esst_snm12lduw "" UWORD dez___UW 0 0 0.000000 65535.000000 /begin IF_DATA ASAP1B_ETK KP_BLOB 0x380E78 1 2 /end IF_DATA BIT_MASK 0xFFFF /end MEASUREMENT
/begin MEASUREMENT esst_snm16gkub "" UWORD dez___UW 0 0 0.000000 65535.000000 /begin IF_DATA ASAP1B_ETK KP_BLOB 0x380E32 1 2 /end IF_DATA BIT_MASK 0xFFFF /end MEASUREMENT
/begin MEASUREMENT esst_snm16krub "" UWORD dez___UW 0 0 0.000000 65535.000000 /begin IF_DATA ASAP1B_ETK KP_BLOB 0x380E36 1 2 /end IF_DATA BIT_MASK 0xFFFF /end MEASUREMENT
/begin MEASUREMENT esst_snm16ldub "" UWORD dez___UW 0 0 0.000000 65535.000000 /begin IF_DATA ASAP1B_ETK KP_BLOB 0x380E7A 1 2 /end IF_DATA BIT_MASK 0xFFFF /end MEASUREMENT
/begin MEASUREMENT esst_snm16lduw "" UWORD dez___UW 0 0 0.000000 65535.000000 /begin IF_DATA ASAP1B_ETK KP_BLOB 0x380E7C 1 2 /end IF_DATA BIT_MASK 0xFFFF /end MEASUREMENT
/begin MEASUREMENT esst_sns06llsb "" UWORD dez___UW 0 0 0.000000 65535.000000 /begin IF_DATA ASAP1B_ETK KP_BLOB 0x382316 1 2 /end IF_DATA BIT_MASK 0xFFFF /end MEASUREMENT
/begin MEASUREMENT esst_sns206llsb "" UWORD dez___UW 0 0 0.000000 65535.000000 /begin IF_DATA ASAP1B_ETK KP_BLOB 0x382376 1 2 /end IF_DATA BIT_MASK 0xFFFF /end MEASUREMENT
/begin MEASUREMENT esst_spl08lduw "" UWORD dez___UW 0 0 0.000000 65535.000000 /begin IF_DATA ASAP1B_ETK KP_BLOB 0x380E82 1 2 /end IF_DATA BIT_MASK 0xFFFF /end MEASUREMENT
/begin MEASUREMENT esst_spu08ldub "" UWORD dez___UW 0 0 0.000000 65535.000000 /begin IF_DATA ASAP1B_ETK KP_BLOB 0x380E84 1 2 /end IF_DATA BIT_MASK 0xFFFF /end MEASUREMENT
/begin MEASUREMENT esst_srl03krub "" UWORD dez___UW 0 0 0.000000 65535.000000 /begin IF_DATA ASAP1B_ETK KP_BLOB 0x380E38 1 2 /end IF_DATA BIT_MASK 0xFFFF /end MEASUREMENT
/begin MEASUREMENT esst_srl06lrub "" UWORD dez___UW 0 0 0.000000 65535.000000 /begin IF_DATA ASAP1B_ETK KP_BLOB 0x380E40 1 2 /end IF_DATA BIT_MASK 0xFFFF /end MEASUREMENT
/begin MEASUREMENT esst_srl12gkub "" UWORD dez___UW 0 0 0.000000 65535.000000 /begin IF_DATA ASAP1B_ETK KP_BLOB 0x380E44 1 2 /end IF_DATA BIT_MASK 0xFFFF /end MEASUREMENT
/begin MEASUREMENT esst_sta04llub "" UWORD dez___UW 0 0 0.000000 65535.000000 /begin IF_DATA ASAP1B_ETK KP_BLOB 0x380E90 1 2 /end IF_DATA BIT_MASK 0xFFFF /end MEASUREMENT
/begin MEASUREMENT esst_sta08ldub "" UWORD dez___UW 0 0 0.000000 65535.000000 /begin IF_DATA ASAP1B_ETK KP_BLOB 0x380E92 1 2 /end IF_DATA BIT_MASK 0xFFFF /end MEASUREMENT
/begin MEASUREMENT esst_stm04saub "" UWORD dez___UW 0 0 0.000000 65535.000000 /begin IF_DATA ASAP1B_ETK KP_BLOB 0x380E9A 1 2 /end IF_DATA BIT_MASK 0xFFFF /end MEASUREMENT
/begin MEASUREMENT esst_stm06llub "" UWORD dez___UW 0 0 0.000000 65535.000000 /begin IF_DATA ASAP1B_ETK KP_BLOB 0x380E52 1 2 /end IF_DATA BIT_MASK 0xFFFF /end MEASUREMENT
/begin MEASUREMENT esst_stm12esub "" UWORD dez___UW 0 0 0.000000 65535.000000 /begin IF_DATA ASAP1B_ETK KP_BLOB 0x380EA0 1 2 /end IF_DATA BIT_MASK 0xFFFF /end MEASUREMENT
/begin MEASUREMENT esst_stv10ldsw "" UWORD dez___UW 0 0 0.000000 65535.000000 /begin IF_DATA ASAP1B_ETK KP_BLOB 0x38229E 1 2 /end IF_DATA BIT_MASK 0xFFFF /end MEASUREMENT
/begin MEASUREMENT esst_svp12lduw "" UWORD dez___UW 0 0 0.000000 65535.000000 /begin IF_DATA ASAP1B_ETK KP_BLOB 0x380EA8 1 2 /end IF_DATA BIT_MASK 0xFFFF /end MEASUREMENT
/begin MEASUREMENT esst_swk08ldub "" UWORD dez___UW 0 0 0.000000 65535.000000 /begin IF_DATA ASAP1B_ETK KP_BLOB 0x380EAA 1 2 /end IF_DATA BIT_MASK 0xFFFF /end MEASUREMENT
/begin MEASUREMENT esst_swk108ldub "" UWORD dez___UW 0 0 0.000000 65535.000000 /begin IF_DATA ASAP1B_ETK KP_BLOB 0x380EAC 1 2 /end IF_DATA BIT_MASK 0xFFFF /end MEASUREMENT
/begin MEASUREMENT esst_swk208ldub "" UWORD dez___UW 0 0 0.000000 65535.000000 /begin IF_DATA ASAP1B_ETK KP_BLOB 0x380EAE 1 2 /end IF_DATA BIT_MASK 0xFFFF /end MEASUREMENT
/begin MEASUREMENT etazwg "Wirkungsgrad beim GrundzÅndwinkel" UBYTE rel_ub_b127p5 0 0 0.000000 127.500000 /begin IF_DATA ASAP1B_ETK KP_BLOB 0x380B4F 1 1 /end IF_DATA BIT_MASK 0xFF /end MEASUREMENT
/begin MEASUREMENT etazwim "Gemittelter Wirkungsgrad beim Ist-ZÅndwinkel" UBYTE rel_ub_b127p5 0 0 0.000000 127.500000 /begin IF_DATA ASAP1B_ETK KP_BLOB 0x380B50 1 1 /end IF_DATA BIT_MASK 0xFF /end MEASUREMENT
/begin MEASUREMENT falrdkt "Anforderung Katdiagnose: Modifikation der Lambdregelungsamplitude" UBYTE fak_ub_b8 0 0 0.000000 7.968750 /begin IF_DATA ASAP1B_ETK KP_BLOB 0x380A8B 1 1 /end IF_DATA BIT_MASK 0xFF /end MEASUREMENT
/begin MEASUREMENT fcmEnd "Anzahl EintrÑge im Fehlerspeicher" UBYTE dez 0 0 0.000000 255.000000 /begin IF_DATA ASAP1B_ETK KP_BLOB 0x383307 1 1 /end IF_DATA BIT_MASK 0xFF /end MEASUREMENT
/begin MEASUREMENT FCMTab "" UWORD dez___UW 0 0 0.000000 65535.000000 /begin IF_DATA ASAP1B_ETK KP_BLOB 0x383846 1 2 /end IF_DATA BIT_MASK 0xFFFF /end MEASUREMENT
/begin MEASUREMENT ffri "LR mit Integratorstop : Gewichtungsfaktor I-Steigung bei langsamer Sonde" UBYTE fak_ub_b4 0 0 0.000000 3.984375 /begin IF_DATA ASAP1B_ETK KP_BLOB 0x380CF3 1 1 /end IF_DATA BIT_MASK 0xFF /end MEASUREMENT
/begin MEASUREMENT ffri2 "LR mit Integratorstop : Gewichtungsfaktor I-Steigung bei langsamer Sonde Bank 2" UBYTE fak_ub_b4 0 0 0.000000 3.984375 /begin IF_DATA ASAP1B_ETK KP_BLOB 0x380CF4 1 1 /end IF_DATA BIT_MASK 0xFF /end MEASUREMENT
/begin MEASUREMENT ffzdfp "Fehlerpfadidentifikationsnummer (dfp) zum Freeze-Frame Zero" UBYTE dez 0 0 0.000000 255.000000 /begin IF_DATA ASAP1B_ETK KP_BLOB 0x380A34 1 1 /end IF_DATA BIT_MASK 0xFF /end MEASUREMENT
/begin MEASUREMENT flakh "Faktor Lambda-Steuerung bei Katheizen" UBYTE fak_ub_b1 0 0 0.000000 0.996094 /begin IF_DATA ASAP1B_ETK KP_BLOB 0x380B65 1 1 /end IF_DATA BIT_MASK 0xFF /end MEASUREMENT
/begin MEASUREMENT flamkh "Faktor Aufregelung Lambda-Motor-Soll bei Katheizen" UBYTE fak_ub_b1 0 0 0.000000 0.996094 /begin IF_DATA ASAP1B_ETK KP_BLOB 0x380B66 1 1 /end IF_DATA BIT_MASK 0xFF /end MEASUREMENT
/begin MEASUREMENT flamsl_w "Faktor LambdaÑnderung durch SekundÑrluft" UWORD fak_uw_b16 0 0 0.000000 15.999756 /begin IF_DATA ASAP1B_ETK KP_BLOB 0x380ECC 1 2 /end IF_DATA BIT_MASK 0xFFFF /end MEASUREMENT
/begin MEASUREMENT flaskh "Faktor öbergang zu Lambda-Abgas bei SekundÑrluft" UBYTE fak_ub_b1 0 0 0.000000 0.996094 /begin IF_DATA ASAP1B_ETK KP_BLOB 0x380B6D 1 1 /end IF_DATA BIT_MASK 0xFF /end MEASUREMENT
/begin MEASUREMENT fldrrx_w "Korrekturfaktor Maximalfuellung aus Klopfregelung" UWORD fak_uw_b2 0 0 0.000000 1.999969 /begin IF_DATA ASAP1B_ETK KP_BLOB 0x383CB0 1 2 /end IF_DATA BIT_MASK 0xFFFF /end MEASUREMENT
/begin MEASUREMENT fldrxk "Faktor zur LDR rlmax-Korrektur durch den Kurzzeitanteil" UBYTE fak_ub_b2 0 0 0.000000 1.992188 /begin IF_DATA ASAP1B_ETK KP_BLOB 0x380C05 1 1 /end IF_DATA BIT_MASK 0xFF /end MEASUREMENT
/begin MEASUREMENT fldrxl "Faktor zur LDR rlmax-Korrektur durch den Langzeitanteil" UBYTE fak_ub_b2 0 0 0.000000 1.992188 /begin IF_DATA ASAP1B_ETK KP_BLOB 0x380C06 1 1 /end IF_DATA BIT_MASK 0xFF /end MEASUREMENT
/begin MEASUREMENT fldrxo "Faktor zur Ladedruckabsenkung des Overboostwertes (drlmaxo)" UBYTE fak_ub_b1 0 0 0.000000 0.996094 /begin IF_DATA ASAP1B_ETK KP_BLOB 0x380C07 1 1 /end IF_DATA BIT_MASK 0xFF /end MEASUREMENT
/begin MEASUREMENT flmssl "Faktor Lambda-Motor-Soll-SekundÑrluftanteil" UBYTE fak_ub_b1 0 0 0.000000 0.996094 /begin IF_DATA ASAP1B_ETK KP_BLOB 0x380991 1 1 /end IF_DATA BIT_MASK 0xFF /end MEASUREMENT
/begin MEASUREMENT flmsslkh "Faktor Lambda-Motor-Soll-SekundÑrluftanteil, resultierend" UBYTE fak_ub_b1 0 0 0.000000 0.996094 /begin IF_DATA ASAP1B_ETK KP_BLOB 0x380B6E 1 1 /end IF_DATA BIT_MASK 0xFF /end MEASUREMENT
/begin MEASUREMENT fmsldyn "Faktor Dynamikbeschreibung SekundÑrluft" UBYTE fak_ub_b1 0 0 0.000000 0.996094 /begin IF_DATA ASAP1B_ETK KP_BLOB 0x380993 1 1 /end IF_DATA BIT_MASK 0xFF /end MEASUREMENT
/begin MEASUREMENT fmvp_w "Faktor fÅr Mittelwertbildung SolldruckverhÑltnis DK" UWORD fak_uw_b2 0 0 0.000000 1.999969 /begin IF_DATA ASAP1B_ETK KP_BLOB 0x382296 1 2 /end IF_DATA BIT_MASK 0xFFFF /end MEASUREMENT
/begin MEASUREMENT fr2_w "Lambda-Regler-Ausgang; Bank2 (Word)" UWORD fak_uw_b2 0 0 0.000000 1.999969 /begin IF_DATA ASAP1B_ETK KP_BLOB 0x38288A 1 2 /end IF_DATA BIT_MASK 0xFFFF /end MEASUREMENT
/begin MEASUREMENT frao2_w "multipl. Gemischadaptionsfaktor oberer Lastbereich Bank 2 (Word)" UWORD fak_uw_b2 0 0 0.000000 1.999969 /begin IF_DATA ASAP1B_ETK KP_BLOB 0x383C62 1 2 /end IF_DATA BIT_MASK 0xFFFF /end MEASUREMENT
/begin MEASUREMENT frao_w "multiplikativer Gemischadaptionsfaktor oberer Lastbereich (Word)" UWORD fak_uw_b2 0 0 0.000000 1.999969 /begin IF_DATA ASAP1B_ETK KP_BLOB 0x383C64 1 2 /end IF_DATA BIT_MASK 0xFFFF /end MEASUREMENT
/begin MEASUREMENT frau2_w "multipl. Gemischadaptionsfaktor unterer mult. Bereich der Bank 2 (Word)" UWORD fak_uw_b2 0 0 0.000000 1.999969 /begin IF_DATA ASAP1B_ETK KP_BLOB 0x383C66 1 2 /end IF_DATA BIT_MASK 0xFFFF /end MEASUREMENT
/begin MEASUREMENT frau_w "multiplikativer Gemischadaptionsfaktor unterer mult. Bereich (Word)" UWORD fak_uw_b2 0 0 0.000000 1.999969 /begin IF_DATA ASAP1B_ETK KP_BLOB 0x383C68 1 2 /end IF_DATA BIT_MASK 0xFFFF /end MEASUREMENT
/begin MEASUREMENT fra_w "multiplikative Gemischkorrektur der Gemischadaption (Word)" UWORD fak_uw_b2 0 0 0.000000 1.999969 /begin IF_DATA ASAP1B_ETK KP_BLOB 0x381FF4 1 2 /end IF_DATA BIT_MASK 0xFFFF /end MEASUREMENT
/begin MEASUREMENT frband2_w "Lambdaregelung (Zwei-Punkt) frm-Bildung, lokale Var. im Zustandsautomat, Bank 2" SWORD fak_sw_b1 0 0 -1.000000 0.999969 /begin IF_DATA ASAP1B_ETK KP_BLOB 0x38288C 1 2 /end IF_DATA BIT_MASK 0xFFFF /end MEASUREMENT
/begin MEASUREMENT frband_w "Lambdaregelung (Zwei-Punkt) frm-Bildung,  lokale Variable im Zustandsautomat" SWORD fak_sw_b1 0 0 -1.000000 0.999969 /begin IF_DATA ASAP1B_ETK KP_BLOB 0x38288E 1 2 /end IF_DATA BIT_MASK 0xFFFF /end MEASUREMENT
/begin MEASUREMENT fri "LR mit Integratorstop : I-Steigung aus KFRI(n,tL) oder gemÑ· DSLS" UBYTE fak_ub_b77p81 0 0 0.000000 77.819824 /begin IF_DATA ASAP1B_ETK KP_BLOB 0x380CF5 1 1 /end IF_DATA BIT_MASK 0xFF /end MEASUREMENT
/begin MEASUREMENT fri2 "Bank2: LR mit Integratorst. : I-Steigung aus KFRI(n,tL) oder gem. DSLS" UBYTE fak_ub_b77p81 0 0 0.000000 77.819824 /begin IF_DATA ASAP1B_ETK KP_BLOB 0x380CF6 1 1 /end IF_DATA BIT_MASK 0xFF /end MEASUREMENT
/begin MEASUREMENT friband2_w "Lambdaregelung (Zwei-Punkt) frm-Bildung, lokale Var. im Zustandsautomat, Bank 2" SWORD fak_sw_b1 0 0 -1.000000 0.999969 /begin IF_DATA ASAP1B_ETK KP_BLOB 0x382890 1 2 /end IF_DATA BIT_MASK 0xFFFF /end MEASUREMENT
/begin MEASUREMENT friband_w "Lambdaregelung (Zwei-Punkt) frm-Bildung,  lokale Variable im Zustandsautomat" SWORD fak_sw_b1 0 0 -1.000000 0.999969 /begin IF_DATA ASAP1B_ETK KP_BLOB 0x382892 1 2 /end IF_DATA BIT_MASK 0xFFFF /end MEASUREMENT
/begin MEASUREMENT friint "I-Steigung aus KFRI(nmot,rL) oder gemÑ· DSLS, lokale Hilfsgrî·e" UBYTE fak_ub_b77p81 0 0 0.000000 77.819824 /begin IF_DATA ASAP1B_ETK KP_BLOB 0x380CF7 1 1 /end IF_DATA BIT_MASK 0xFF /end MEASUREMENT
/begin MEASUREMENT friint2 "I-Steigung aus KFRI(nmot,rL) oder gemÑ· DSLS, lokale Hilfsgrî·e, Bank 2" UBYTE fak_ub_b77p81 0 0 0.000000 77.819824 /begin IF_DATA ASAP1B_ETK KP_BLOB 0x380CF8 1 1 /end IF_DATA BIT_MASK 0xFF /end MEASUREMENT
/begin MEASUREMENT frini2_w "Initialisierungswert fÅr Regelfaktor Lambdaregelung, Bank 2" UWORD fak_uw_b2 0 0 0.000000 1.999969 /begin IF_DATA ASAP1B_ETK KP_BLOB 0x382802 1 2 /end IF_DATA BIT_MASK 0xFFFF /end MEASUREMENT
/begin MEASUREMENT frini_w "Initialisierungswert fÅr Regelfaktor Lambdaregelung" UWORD fak_uw_b2 0 0 0.000000 1.999969 /begin IF_DATA ASAP1B_ETK KP_BLOB 0x382804 1 2 /end IF_DATA BIT_MASK 0xFFFF /end MEASUREMENT
/begin MEASUREMENT frint2_w "Regelfaktor Lambdaregelung Bank 2, Integratorausgang" UWORD fak_uw_b2 0 0 0.000000 1.999969 /begin IF_DATA ASAP1B_ETK KP_BLOB 0x382894 1 2 /end IF_DATA BIT_MASK 0xFFFF /end MEASUREMENT
/begin MEASUREMENT frint_w "Regelfaktor Lambdaregelung, Integratorausgang" UWORD fak_uw_b2 0 0 0.000000 1.999969 /begin IF_DATA ASAP1B_ETK KP_BLOB 0x382896 1 2 /end IF_DATA BIT_MASK 0xFFFF /end MEASUREMENT
/begin MEASUREMENT frm2_w "schneller Mittelwert des Lambdaregelfaktors Bank 2(Word)" UWORD fak_uw_b2 0 0 0.000000 1.999969 /begin IF_DATA ASAP1B_ETK KP_BLOB 0x382898 1 2 /end IF_DATA BIT_MASK 0xFFFF /end MEASUREMENT
/begin MEASUREMENT frmn2_w "Lambda-Regler-Ausgang Minimalwert, Bank 2" UWORD fak_uw_b2 0 0 0.000000 1.999969 /begin IF_DATA ASAP1B_ETK KP_BLOB 0x38289A 1 2 /end IF_DATA BIT_MASK 0xFFFF /end MEASUREMENT
/begin MEASUREMENT frmn_w "Lambda-Regler-Ausgang Minimalwert" UWORD fak_uw_b2 0 0 0.000000 1.999969 /begin IF_DATA ASAP1B_ETK KP_BLOB 0x38289C 1 2 /end IF_DATA BIT_MASK 0xFFFF /end MEASUREMENT
/begin MEASUREMENT frmx2_w "LR Bank 2: Max. Begrenzung Integrator fr,; FRMAX / angehoben d.DSLS" UWORD fak_uw_b2 0 0 0.000000 1.999969 /begin IF_DATA ASAP1B_ETK KP_BLOB 0x38289E 1 2 /end IF_DATA BIT_MASK 0xFFFF /end MEASUREMENT
/begin MEASUREMENT frmx_w "LR mit Integratorstop : Max. Begrenzung Integrator fr,; FRMAX / angehoben d.DSLS" UWORD fak_uw_b2 0 0 0.000000 1.999969 /begin IF_DATA ASAP1B_ETK KP_BLOB 0x3828A0 1 2 /end IF_DATA BIT_MASK 0xFFFF /end MEASUREMENT
/begin MEASUREMENT frm_w "schneller Mittelwert des Lambdaregelfaktors (Word)" UWORD fak_uw_b2 0 0 0.000000 1.999969 /begin IF_DATA ASAP1B_ETK KP_BLOB 0x3828A2 1 2 /end IF_DATA BIT_MASK 0xFFFF /end MEASUREMENT
/begin MEASUREMENT frp "LR mit Integratorstop : P-Sprung aus KFRP(n,tL) oder 0 bei DSLS aktiv" UBYTE fak_ub_b12p45 0 0 0.000000 12.451172 /begin IF_DATA ASAP1B_ETK KP_BLOB 0x380CF9 1 1 /end IF_DATA BIT_MASK 0xFF /end MEASUREMENT
/begin MEASUREMENT frp2 "Bank2: LR mit Integratorstop : Kennfeldwert aus KFRP(n,tL) oder 0 bei DSLS aktiv" UBYTE fak_ub_b12p45 0 0 0.000000 12.451172 /begin IF_DATA ASAP1B_ETK KP_BLOB 0x380CFA 1 1 /end IF_DATA BIT_MASK 0xFF /end MEASUREMENT
/begin MEASUREMENT frpint "P-Sprung aus KFRP(nmot,rL) oder gemÑ· DSLS, lokale Hilfsgrî·e" UBYTE fak_ub_b12p45 0 0 0.000000 12.451172 /begin IF_DATA ASAP1B_ETK KP_BLOB 0x380CFB 1 1 /end IF_DATA BIT_MASK 0xFF /end MEASUREMENT
/begin MEASUREMENT frpint2 "P-Sprung aus KFRP(nmot,rL) oder gemÑ· DSLS, lokale Hilfsgrî·e, Bank 2" UBYTE fak_ub_b12p45 0 0 0.000000 12.451172 /begin IF_DATA ASAP1B_ETK KP_BLOB 0x380CFC 1 1 /end IF_DATA BIT_MASK 0xFF /end MEASUREMENT
/begin MEASUREMENT frsp2_w "Zweipunktregelung: Regelfaktor fr vor Sprung (Max-/Min-Wert) Bank 2" UWORD fak_uw_b2 0 0 0.000000 1.999969 /begin IF_DATA ASAP1B_ETK KP_BLOB 0x3828A4 1 2 /end IF_DATA BIT_MASK 0xFFFF /end MEASUREMENT
/begin MEASUREMENT frsp_w "Zweipunktregelung: Regelfaktor fr vor Sprung (Max-/Min-Wert)" UWORD fak_uw_b2 0 0 0.000000 1.999969 /begin IF_DATA ASAP1B_ETK KP_BLOB 0x3828A6 1 2 /end IF_DATA BIT_MASK 0xFFFF /end MEASUREMENT
/begin MEASUREMENT frtv "tv-Zeit aus KFRTV(nmot,rL) oder gemÑ· DSLS" SBYTE t10msxs_sb_q0p01 0 0 -1.280000 1.270000 /begin IF_DATA ASAP1B_ETK KP_BLOB 0x380CFD 1 1 /end IF_DATA BIT_MASK 0xFF /end MEASUREMENT
/begin MEASUREMENT frtv2 "tv-Zeit aus KFRTV(nmot,rL) oder gemÑ· DSLS, Bank 2" SBYTE t10msxs_sb_q0p01 0 0 -1.280000 1.270000 /begin IF_DATA ASAP1B_ETK KP_BLOB 0x380CFE 1 1 /end IF_DATA BIT_MASK 0xFF /end MEASUREMENT
/begin MEASUREMENT frxt "Faktor zur Korrektur rlmx als Funktion von tmki und tol" UBYTE fak_ub_b2 0 0 0.000000 1.992188 /begin IF_DATA ASAP1B_ETK KP_BLOB 0x380C08 1 1 /end IF_DATA BIT_MASK 0xFF /end MEASUREMENT
/begin MEASUREMENT frxta "Faktor zur Korrektur rlmx als Funktion von tans" UBYTE fak_ub_b2 0 0 0.000000 1.992188 /begin IF_DATA ASAP1B_ETK KP_BLOB 0x380C09 1 1 /end IF_DATA BIT_MASK 0xFF /end MEASUREMENT
/begin MEASUREMENT fr_w "Lambda-Regler-Ausgang (Word)" UWORD fak_uw_b2 0 0 0.000000 1.999969 /begin IF_DATA ASAP1B_ETK KP_BLOB 0x3828A8 1 2 /end IF_DATA BIT_MASK 0xFFFF /end MEASUREMENT
/begin MEASUREMENT fslpdyn "Faktor Dynamikbeschreibung SekundÑrluftpumpe" UBYTE fak_ub_b1 0 0 0.000000 0.996094 /begin IF_DATA ASAP1B_ETK KP_BLOB 0x380996 1 1 /end IF_DATA BIT_MASK 0xFF /end MEASUREMENT
/begin MEASUREMENT fslsdyn "Faktor Dynamikbeschreibung SekundÑrluftsystem" UBYTE fak_ub_b1 0 0 0.000000 0.996094 /begin IF_DATA ASAP1B_ETK KP_BLOB 0x380B6F 1 1 /end IF_DATA BIT_MASK 0xFF /end MEASUREMENT
/begin MEASUREMENT fupsrl_w "Faktor systembezogene Umrechnung Druck auf FÅllung (16-Bit)" UWORD rel_uw_b0p3 0 0 0.000000 0.299995 /begin IF_DATA ASAP1B_ETK KP_BLOB 0x381E34 1 2 /end IF_DATA BIT_MASK 0xFFFF /end MEASUREMENT
/begin MEASUREMENT gggtsBit "" UBYTE dez 0 0 0.000000 255.000000 /begin IF_DATA ASAP1B_ETK KP_BLOB 0x38098D 1 1 /end IF_DATA BIT_MASK 0xFF /end MEASUREMENT
/begin MEASUREMENT ikrma "Integratorwert Klopfregelung Me·fensteranfang" UBYTE spg_ub_b5 0 0 0.000000 4.980469 /begin IF_DATA ASAP1B_ETK KP_BLOB 0x380B70 1 1 /end IF_DATA BIT_MASK 0xFF /end MEASUREMENT
/begin MEASUREMENT ikrme_0_A "Integratorwert Klopfregelung Me·fensterende" UBYTE spg_ub_b5 0 0 0.000000 4.980469 /begin IF_DATA ASAP1B_ETK KP_BLOB 0xE3E9 0 1 /end IF_DATA BIT_MASK 0xFF /end MEASUREMENT
/begin MEASUREMENT ikrme_1_A "Integratorwert Klopfregelung Me·fensterende" UBYTE spg_ub_b5 0 0 0.000000 4.980469 /begin IF_DATA ASAP1B_ETK KP_BLOB 0xE3EA 0 1 /end IF_DATA BIT_MASK 0xFF /end MEASUREMENT
/begin MEASUREMENT ikrme_2_A "Integratorwert Klopfregelung Me·fensterende" UBYTE spg_ub_b5 0 0 0.000000 4.980469 /begin IF_DATA ASAP1B_ETK KP_BLOB 0xE3EB 0 1 /end IF_DATA BIT_MASK 0xFF /end MEASUREMENT
/begin MEASUREMENT ikrme_3_A "Integratorwert Klopfregelung Me·fensterende" UBYTE spg_ub_b5 0 0 0.000000 4.980469 /begin IF_DATA ASAP1B_ETK KP_BLOB 0xE3EC 0 1 /end IF_DATA BIT_MASK 0xFF /end MEASUREMENT
/begin MEASUREMENT ikrme_4_A "Integratorwert Klopfregelung Me·fensterende" UBYTE spg_ub_b5 0 0 0.000000 4.980469 /begin IF_DATA ASAP1B_ETK KP_BLOB 0xE3ED 0 1 /end IF_DATA BIT_MASK 0xFF /end MEASUREMENT
/begin MEASUREMENT ikrme_5_A "Integratorwert Klopfregelung Me·fensterende" UBYTE spg_ub_b5 0 0 0.000000 4.980469 /begin IF_DATA ASAP1B_ETK KP_BLOB 0xE3EE 0 1 /end IF_DATA BIT_MASK 0xFF /end MEASUREMENT
/begin MEASUREMENT ikrme_6_A "Integratorwert Klopfregelung Me·fensterende" UBYTE spg_ub_b5 0 0 0.000000 4.980469 /begin IF_DATA ASAP1B_ETK KP_BLOB 0xE3EF 0 1 /end IF_DATA BIT_MASK 0xFF /end MEASUREMENT
/begin MEASUREMENT ikrme_7_A "Integratorwert Klopfregelung Me·fensterende" UBYTE spg_ub_b5 0 0 0.000000 4.980469 /begin IF_DATA ASAP1B_ETK KP_BLOB 0xE3F0 0 1 /end IF_DATA BIT_MASK 0xFF /end MEASUREMENT
/begin MEASUREMENT ikrrkr_wert "" UBYTE dez 0 0 0.000000 255.000000 /begin IF_DATA ASAP1B_ETK KP_BLOB 0x380B8B 1 1 /end IF_DATA BIT_MASK 0xFF /end MEASUREMENT
/begin MEASUREMENT ikr_0_A "Integratorwert Klopfregelung offsetkorrigiert" UBYTE spg_ub_b5 0 0 0.000000 4.980469 /begin IF_DATA ASAP1B_ETK KP_BLOB 0xE3E1 0 1 /end IF_DATA BIT_MASK 0xFF /end MEASUREMENT
/begin MEASUREMENT ikr_1_A "Integratorwert Klopfregelung offsetkorrigiert" UBYTE spg_ub_b5 0 0 0.000000 4.980469 /begin IF_DATA ASAP1B_ETK KP_BLOB 0xE3E2 0 1 /end IF_DATA BIT_MASK 0xFF /end MEASUREMENT
/begin MEASUREMENT ikr_2_A "Integratorwert Klopfregelung offsetkorrigiert" UBYTE spg_ub_b5 0 0 0.000000 4.980469 /begin IF_DATA ASAP1B_ETK KP_BLOB 0xE3E3 0 1 /end IF_DATA BIT_MASK 0xFF /end MEASUREMENT
/begin MEASUREMENT ikr_3_A "Integratorwert Klopfregelung offsetkorrigiert" UBYTE spg_ub_b5 0 0 0.000000 4.980469 /begin IF_DATA ASAP1B_ETK KP_BLOB 0xE3E4 0 1 /end IF_DATA BIT_MASK 0xFF /end MEASUREMENT
/begin MEASUREMENT ikr_4_A "Integratorwert Klopfregelung offsetkorrigiert" UBYTE spg_ub_b5 0 0 0.000000 4.980469 /begin IF_DATA ASAP1B_ETK KP_BLOB 0xE3E5 0 1 /end IF_DATA BIT_MASK 0xFF /end MEASUREMENT
/begin MEASUREMENT ikr_5_A "Integratorwert Klopfregelung offsetkorrigiert" UBYTE spg_ub_b5 0 0 0.000000 4.980469 /begin IF_DATA ASAP1B_ETK KP_BLOB 0xE3E6 0 1 /end IF_DATA BIT_MASK 0xFF /end MEASUREMENT
/begin MEASUREMENT ikr_6_A "Integratorwert Klopfregelung offsetkorrigiert" UBYTE spg_ub_b5 0 0 0.000000 4.980469 /begin IF_DATA ASAP1B_ETK KP_BLOB 0xE3E7 0 1 /end IF_DATA BIT_MASK 0xFF /end MEASUREMENT
/begin MEASUREMENT ikr_7_A "Integratorwert Klopfregelung offsetkorrigiert" UBYTE spg_ub_b5 0 0 0.000000 4.980469 /begin IF_DATA ASAP1B_ETK KP_BLOB 0xE3E8 0 1 /end IF_DATA BIT_MASK 0xFF /end MEASUREMENT
/begin MEASUREMENT ikr_kek_wert "" UBYTE dez 0 0 0.000000 255.000000 /begin IF_DATA ASAP1B_ETK KP_BLOB 0x380B8C 1 1 /end IF_DATA BIT_MASK 0xFF /end MEASUREMENT
/begin MEASUREMENT int_ctr "" UBYTE dez 0 0 0.000000 255.000000 /begin IF_DATA ASAP1B_ETK KP_BLOB 0x380D2C 1 1 /end IF_DATA BIT_MASK 0xFF /end MEASUREMENT
/begin MEASUREMENT iver "IntegratorverstÑrkung" UBYTE rel_q0p002383 0 0 0.000000 0.607617 /begin IF_DATA ASAP1B_ETK KP_BLOB 0x380C2B 1 1 /end IF_DATA BIT_MASK 0xFF /end MEASUREMENT
/begin MEASUREMENT kek_0_A "Klopferkennungsschwelle korrigiert" UBYTE fak_ub_b16 0 0 0.000000 15.937500 /begin IF_DATA ASAP1B_ETK KP_BLOB 0x380B8D 1 1 /end IF_DATA BIT_MASK 0xFF /end MEASUREMENT
/begin MEASUREMENT kek_1_A "Klopferkennungsschwelle korrigiert" UBYTE fak_ub_b16 0 0 0.000000 15.937500 /begin IF_DATA ASAP1B_ETK KP_BLOB 0x380B8E 1 1 /end IF_DATA BIT_MASK 0xFF /end MEASUREMENT
/begin MEASUREMENT kek_2_A "Klopferkennungsschwelle korrigiert" UBYTE fak_ub_b16 0 0 0.000000 15.937500 /begin IF_DATA ASAP1B_ETK KP_BLOB 0x380B8F 1 1 /end IF_DATA BIT_MASK 0xFF /end MEASUREMENT
/begin MEASUREMENT kek_3_A "Klopferkennungsschwelle korrigiert" UBYTE fak_ub_b16 0 0 0.000000 15.937500 /begin IF_DATA ASAP1B_ETK KP_BLOB 0x380B90 1 1 /end IF_DATA BIT_MASK 0xFF /end MEASUREMENT
/begin MEASUREMENT kek_4_A "Klopferkennungsschwelle korrigiert" UBYTE fak_ub_b16 0 0 0.000000 15.937500 /begin IF_DATA ASAP1B_ETK KP_BLOB 0x380B91 1 1 /end IF_DATA BIT_MASK 0xFF /end MEASUREMENT
/begin MEASUREMENT kek_5_A "Klopferkennungsschwelle korrigiert" UBYTE fak_ub_b16 0 0 0.000000 15.937500 /begin IF_DATA ASAP1B_ETK KP_BLOB 0x380B92 1 1 /end IF_DATA BIT_MASK 0xFF /end MEASUREMENT
/begin MEASUREMENT kek_6_A "Klopferkennungsschwelle korrigiert" UBYTE fak_ub_b16 0 0 0.000000 15.937500 /begin IF_DATA ASAP1B_ETK KP_BLOB 0x380B93 1 1 /end IF_DATA BIT_MASK 0xFF /end MEASUREMENT
/begin MEASUREMENT kek_7_A "Klopferkennungsschwelle korrigiert" UBYTE fak_ub_b16 0 0 0.000000 15.937500 /begin IF_DATA ASAP1B_ETK KP_BLOB 0x380B94 1 1 /end IF_DATA BIT_MASK 0xFF /end MEASUREMENT
/begin MEASUREMENT kek_tst "Klopferkennungsschwelle korrigiert rollierend mit Zyl.zÑhler" UBYTE fak_ub_b16 0 0 0.000000 15.937500 /begin IF_DATA ASAP1B_ETK KP_BLOB 0x380B95 1 1 /end IF_DATA BIT_MASK 0xFF /end MEASUREMENT
/begin MEASUREMENT ke_0_A "Klopferkennungsschwelle aus Kennlinie" UBYTE fak_ub_b16 0 0 0.000000 15.937500 /begin IF_DATA ASAP1B_ETK KP_BLOB 0x380B81 1 1 /end IF_DATA BIT_MASK 0xFF /end MEASUREMENT
/begin MEASUREMENT ke_1_A "Klopferkennungsschwelle aus Kennlinie" UBYTE fak_ub_b16 0 0 0.000000 15.937500 /begin IF_DATA ASAP1B_ETK KP_BLOB 0x380B82 1 1 /end IF_DATA BIT_MASK 0xFF /end MEASUREMENT
/begin MEASUREMENT ke_2_A "Klopferkennungsschwelle aus Kennlinie" UBYTE fak_ub_b16 0 0 0.000000 15.937500 /begin IF_DATA ASAP1B_ETK KP_BLOB 0x380B83 1 1 /end IF_DATA BIT_MASK 0xFF /end MEASUREMENT
/begin MEASUREMENT ke_3_A "Klopferkennungsschwelle aus Kennlinie" UBYTE fak_ub_b16 0 0 0.000000 15.937500 /begin IF_DATA ASAP1B_ETK KP_BLOB 0x380B84 1 1 /end IF_DATA BIT_MASK 0xFF /end MEASUREMENT
/begin MEASUREMENT ke_4_A "Klopferkennungsschwelle aus Kennlinie" UBYTE fak_ub_b16 0 0 0.000000 15.937500 /begin IF_DATA ASAP1B_ETK KP_BLOB 0x380B85 1 1 /end IF_DATA BIT_MASK 0xFF /end MEASUREMENT
/begin MEASUREMENT ke_5_A "Klopferkennungsschwelle aus Kennlinie" UBYTE fak_ub_b16 0 0 0.000000 15.937500 /begin IF_DATA ASAP1B_ETK KP_BLOB 0x380B86 1 1 /end IF_DATA BIT_MASK 0xFF /end MEASUREMENT
/begin MEASUREMENT ke_6_A "Klopferkennungsschwelle aus Kennlinie" UBYTE fak_ub_b16 0 0 0.000000 15.937500 /begin IF_DATA ASAP1B_ETK KP_BLOB 0x380B87 1 1 /end IF_DATA BIT_MASK 0xFF /end MEASUREMENT
/begin MEASUREMENT ke_7_A "Klopferkennungsschwelle aus Kennlinie" UBYTE fak_ub_b16 0 0 0.000000 15.937500 /begin IF_DATA ASAP1B_ETK KP_BLOB 0x380B88 1 1 /end IF_DATA BIT_MASK 0xFF /end MEASUREMENT
/begin MEASUREMENT kral1w "aktueller Wert Last-Adaptionsbereich 1" UBYTE rel_ub_q0p75 0 0 0.000000 191.250000 /begin IF_DATA ASAP1B_ETK KP_BLOB 0x380BB3 1 1 /end IF_DATA BIT_MASK 0xFF /end MEASUREMENT
/begin MEASUREMENT kral2w "aktueller Wert Last-Adaptionsbereich 2" UBYTE rel_ub_q0p75 0 0 0.000000 191.250000 /begin IF_DATA ASAP1B_ETK KP_BLOB 0x380BB4 1 1 /end IF_DATA BIT_MASK 0xFF /end MEASUREMENT
/begin MEASUREMENT kral3w "aktueller Wert Last-Adaptionsbereich 3" UBYTE rel_ub_q0p75 0 0 0.000000 191.250000 /begin IF_DATA ASAP1B_ETK KP_BLOB 0x380BB5 1 1 /end IF_DATA BIT_MASK 0xFF /end MEASUREMENT
/begin MEASUREMENT krdwsw "aktueller KL-Wert der SicherheitsspÑtverstellung" UBYTE zw_ub_qn0p75 0 0 -191.250000 0.000000 /begin IF_DATA ASAP1B_ETK KP_BLOB 0x380BC2 1 1 /end IF_DATA BIT_MASK 0xFF /end MEASUREMENT
/begin MEASUREMENT krfkw "Aktueller Wert aus KRFKN" UBYTE zw_ub_qn0p75 0 0 -191.250000 0.000000 /begin IF_DATA ASAP1B_ETK KP_BLOB 0x380BC3 1 1 /end IF_DATA BIT_MASK 0xFF /end MEASUREMENT
/begin MEASUREMENT krmxw "aktueller Wert fÅr SpÑtbegrenzung der SpÑtverstellung" UBYTE zw_ub_qn0p75 0 0 -191.250000 0.000000 /begin IF_DATA ASAP1B_ETK KP_BLOB 0x380BC4 1 1 /end IF_DATA BIT_MASK 0xFF /end MEASUREMENT
/begin MEASUREMENT krvfakt "" UBYTE dez 0 0 0.000000 255.000000 /begin IF_DATA ASAP1B_ETK KP_BLOB 0x380BC5 1 1 /end IF_DATA BIT_MASK 0xFF /end MEASUREMENT
/begin MEASUREMENT krvfsw "Initwert fÅr schnelle FrÅhverstellung" UBYTE dez 0 0 0.000000 255.000000 /begin IF_DATA ASAP1B_ETK KP_BLOB 0x380BC6 1 1 /end IF_DATA BIT_MASK 0xFF /end MEASUREMENT
/begin MEASUREMENT krvfw "Initwert fÅr normale FrÅhverstellung" UBYTE dez 0 0 0.000000 255.000000 /begin IF_DATA ASAP1B_ETK KP_BLOB 0x380BC7 1 1 /end IF_DATA BIT_MASK 0xFF /end MEASUREMENT
/begin MEASUREMENT kvakbi_w "aufsummierter Kraftstoffverbrauch fÅr Kombiausgabe" UWORD dez___UW 0 0 0.000000 65535.000000 /begin IF_DATA ASAP1B_ETK KP_BLOB 0x38290A 1 2 /end IF_DATA BIT_MASK 0xFFFF /end MEASUREMENT
/begin MEASUREMENT lambts_w "Lambda fÅr Bauteileschutz" UWORD fak_uw_b16 0 0 0.000000 15.999756 /begin IF_DATA ASAP1B_ETK KP_BLOB 0x3820A4 1 2 /end IF_DATA BIT_MASK 0xFFFF /end MEASUREMENT
/begin MEASUREMENT lamdkt_w "Lambdasoll fÅr Katdiagnose" UWORD fak_uw_b16 0 0 0.000000 15.999756 /begin IF_DATA ASAP1B_ETK KP_BLOB 0x380EBE 1 2 /end IF_DATA BIT_MASK 0xFFFF /end MEASUREMENT
/begin MEASUREMENT lamelsh_w "Lambdasoll fÅr elektrische Sondendiagnose hinter KAT (Kurztrip)" UWORD fak_uw_b16 0 0 0.000000 15.999756 /begin IF_DATA ASAP1B_ETK KP_BLOB 0x381B30 1 2 /end IF_DATA BIT_MASK 0xFFFF /end MEASUREMENT
/begin MEASUREMENT lamfawkr_w "Lambdasoll Fahrerwunsch bei ZÅndwinkelspÑtverstellung KR, WL" UWORD fak_uw_b16 0 0 0.000000 15.999756 /begin IF_DATA ASAP1B_ETK KP_BLOB 0x382036 1 2 /end IF_DATA BIT_MASK 0xFFFF /end MEASUREMENT
/begin MEASUREMENT lamfaws_w "Lambdasoll Fahrerwunsch stationÑrer Anteil" UWORD fak_uw_b16 0 0 0.000000 15.999756 /begin IF_DATA ASAP1B_ETK KP_BLOB 0x382038 1 2 /end IF_DATA BIT_MASK 0xFFFF /end MEASUREMENT
/begin MEASUREMENT lamfa_w "Lambdasoll Fahrerwunsch (word)" UWORD fak_uw_b16 0 0 0.000000 15.999756 /begin IF_DATA ASAP1B_ETK KP_BLOB 0x38203A 1 2 /end IF_DATA BIT_MASK 0xFFFF /end MEASUREMENT
/begin MEASUREMENT lamka_w "Lambdasollwert KatausrÑumen" UWORD fak_uw_b16 0 0 0.000000 15.999756 /begin IF_DATA ASAP1B_ETK KP_BLOB 0x38281C 1 2 /end IF_DATA BIT_MASK 0xFFFF /end MEASUREMENT
/begin MEASUREMENT lamkh2_w "Lambda-Motor-Soll bei Katheizen, Bank 2 (word)" UWORD fak_uw_b16 0 0 0.000000 15.999756 /begin IF_DATA ASAP1B_ETK KP_BLOB 0x38213E 1 2 /end IF_DATA BIT_MASK 0xFFFF /end MEASUREMENT
/begin MEASUREMENT lamkhe_w "Lambda-Motor-Soll bei Katheizen, effektiv" UWORD fak_uw_b16 0 0 0.000000 15.999756 /begin IF_DATA ASAP1B_ETK KP_BLOB 0x381FE0 1 2 /end IF_DATA BIT_MASK 0xFFFF /end MEASUREMENT
/begin MEASUREMENT lamkhg2_w "Lambda-Motor-Soll bei Katheizen (word) gewichtet mit flakh, Bank 2" UWORD fak_uw_b16 0 0 0.000000 15.999756 /begin IF_DATA ASAP1B_ETK KP_BLOB 0x382140 1 2 /end IF_DATA BIT_MASK 0xFFFF /end MEASUREMENT
/begin MEASUREMENT lamkhg_w "Lambda-Motor-Soll bei Katheizen (word) gewichtet mit flakh" UWORD fak_uw_b16 0 0 0.000000 15.999756 /begin IF_DATA ASAP1B_ETK KP_BLOB 0x382142 1 2 /end IF_DATA BIT_MASK 0xFFFF /end MEASUREMENT
/begin MEASUREMENT lamkhr2_w "Lambda-Motor-Soll resultierend bei Katheizen, Bank 2 (word)" UWORD fak_uw_b4 0 0 0.000000 3.999939 /begin IF_DATA ASAP1B_ETK KP_BLOB 0x382144 1 2 /end IF_DATA BIT_MASK 0xFFFF /end MEASUREMENT
/begin MEASUREMENT lamkhr_w "Lambda-Motor-Soll resultierend bei Katheizen (word)" UWORD fak_uw_b4 0 0 0.000000 3.999939 /begin IF_DATA ASAP1B_ETK KP_BLOB 0x382146 1 2 /end IF_DATA BIT_MASK 0xFFFF /end MEASUREMENT
/begin MEASUREMENT lamkh_w "Lambda-Motor-Soll bei Katheizen (word)" UWORD fak_uw_b16 0 0 0.000000 15.999756 /begin IF_DATA ASAP1B_ETK KP_BLOB 0x382148 1 2 /end IF_DATA BIT_MASK 0xFFFF /end MEASUREMENT
/begin MEASUREMENT LAMKOBits "" UBYTE dez 0 0 0.000000 255.000000 /begin IF_DATA ASAP1B_ETK KP_BLOB 0x380B2F 1 1 /end IF_DATA BIT_MASK 0xFF /end MEASUREMENT
/begin MEASUREMENT lamlash_w "Lambdasoll fÅr Test SchwingungsprÅfung hinter KAT" UWORD fak_uw_b16 0 0 0.000000 15.999756 /begin IF_DATA ASAP1B_ETK KP_BLOB 0x381B8E 1 2 /end IF_DATA BIT_MASK 0xFFFF /end MEASUREMENT
/begin MEASUREMENT lamlgm "Laufgrenze 'Lambda mager'" UBYTE fak_ub_b2 0 0 0.000000 1.992188 /begin IF_DATA ASAP1B_ETK KP_BLOB 0x380B30 1 1 /end IF_DATA BIT_MASK 0xFF /end MEASUREMENT
/begin MEASUREMENT lamnswl_w "Lambda-Motor-Soll fÅr Nachstart und Warmlauf" UWORD fak_uw_b16 0 0 0.000000 15.999756 /begin IF_DATA ASAP1B_ETK KP_BLOB 0x38200A 1 2 /end IF_DATA BIT_MASK 0xFFFF /end MEASUREMENT
/begin MEASUREMENT lamsons_w "Lambda-Sollwert bezogen auf Einbauort Lambda-Sensor" UWORD fak_uw_b16 0 0 0.000000 15.999756 /begin IF_DATA ASAP1B_ETK KP_BLOB 0x381FE4 1 2 /end IF_DATA BIT_MASK 0xFFFF /end MEASUREMENT
/begin MEASUREMENT lamsos_w "Lambda-Sollwert bezogen auf Einbauort Lambda-Sensor" UWORD fak_uw_b16 0 0 0.000000 15.999756 /begin IF_DATA ASAP1B_ETK KP_BLOB 0x381FE6 1 2 /end IF_DATA BIT_MASK 0xFFFF /end MEASUREMENT
/begin MEASUREMENT lamsubg_w "Lambdasoll unbegrenzt (word)" UWORD fak_uw_b16 0 0 0.000000 15.999756 /begin IF_DATA ASAP1B_ETK KP_BLOB 0x381FE8 1 2 /end IF_DATA BIT_MASK 0xFFFF /end MEASUREMENT
/begin MEASUREMENT lams_w "Lambdasoll (word)" UWORD fak_uw_b16 0 0 0.000000 15.999756 /begin IF_DATA ASAP1B_ETK KP_BLOB 0x381FEA 1 2 /end IF_DATA BIT_MASK 0xFFFF /end MEASUREMENT
/begin MEASUREMENT lamvoa_w "Lambdavorsteuerung ohne additive Anteile" UWORD fak_uw_b16 0 0 0.000000 15.999756 /begin IF_DATA ASAP1B_ETK KP_BLOB 0x381FEC 1 2 /end IF_DATA BIT_MASK 0xFFFF /end MEASUREMENT
/begin MEASUREMENT lanskh_w "Lambda-Motor-Soll im Nachstart bei Katheizen" UWORD fak_uw_b16 0 0 0.000000 15.999756 /begin IF_DATA ASAP1B_ETK KP_BLOB 0x38214A 1 2 /end IF_DATA BIT_MASK 0xFFFF /end MEASUREMENT
/begin MEASUREMENT lasdslg2_w "Lambda-Abgas-Soll fÅr SekundÑrluftdiagnose Bank 2 gewichtet mit flamsl2" UWORD fak_uw_b16 0 0 0.000000 15.999756 /begin IF_DATA ASAP1B_ETK KP_BLOB 0x38214C 1 2 /end IF_DATA BIT_MASK 0xFFFF /end MEASUREMENT
/begin MEASUREMENT lasdslg_w "Lambda-Abgas-Soll fÅr SekundÑrluftdiagnose gewichtet mit flamsl" UWORD fak_uw_b16 0 0 0.000000 15.999756 /begin IF_DATA ASAP1B_ETK KP_BLOB 0x38214E 1 2 /end IF_DATA BIT_MASK 0xFFFF /end MEASUREMENT
/begin MEASUREMENT lasdsl_w "Lambda-Abgas-Soll fÅr SekundÑrluftdiagnose" UWORD fak_uw_b4 0 0 0.000000 3.999939 /begin IF_DATA ASAP1B_ETK KP_BLOB 0x382150 1 2 /end IF_DATA BIT_MASK 0xFFFF /end MEASUREMENT
/begin MEASUREMENT laskh_w "Lambda-Abgas-Soll bei Katheizen (word)" UWORD fak_uw_b4 0 0 0.000000 3.999939 /begin IF_DATA ASAP1B_ETK KP_BLOB 0x382152 1 2 /end IF_DATA BIT_MASK 0xFFFF /end MEASUREMENT
/begin MEASUREMENT lbts_w "Lambda fÅr Bauteileschutz aus StationÑrkennfeld" UWORD fak_uw_b16 0 0 0.000000 15.999756 /begin IF_DATA ASAP1B_ETK KP_BLOB 0x3820A6 1 2 /end IF_DATA BIT_MASK 0xFFFF /end MEASUREMENT
/begin MEASUREMENT lbz "Ladebilanz der Batterie" UBYTE rel_ub_b99p6 0 0 0.000000 99.609375 /begin IF_DATA ASAP1B_ETK KP_BLOB 0x380AAE 1 1 /end IF_DATA BIT_MASK 0xFF /end MEASUREMENT
/begin MEASUREMENT ldebu "Regelabweichung LDR im back up Betrieb" SWORD rel_q1p5 0 0 -49152.000000 49150.500000 /begin IF_DATA ASAP1B_ETK KP_BLOB 0x3822E2 1 2 /end IF_DATA BIT_MASK 0xFFFF /end MEASUREMENT
/begin MEASUREMENT ldimn "Aktueller Wert zur Minimalwertbegrenzung I-Anteil LDR" SWORD tv_sw_q0p005 0 0 -163.840000 163.835000 /begin IF_DATA ASAP1B_ETK KP_BLOB 0x3822A0 1 2 /end IF_DATA BIT_MASK 0xFFFF /end MEASUREMENT
/begin MEASUREMENT ldimx "Aktueller Wert zur Maximalwertbegrenzung I-Anteil LDR" SWORD tv_sw_q0p005 0 0 -163.840000 163.835000 /begin IF_DATA ASAP1B_ETK KP_BLOB 0x3822A2 1 2 /end IF_DATA BIT_MASK 0xFFFF /end MEASUREMENT
/begin MEASUREMENT ldimxak "Aktueller korrigierter Begrenzungswert I-Anteil LDR" SWORD tv_sw_q0p005 0 0 -163.840000 163.835000 /begin IF_DATA ASAP1B_ETK KP_BLOB 0x3822A4 1 2 /end IF_DATA BIT_MASK 0xFFFF /end MEASUREMENT
/begin MEASUREMENT ldimxa_0_A "Adaptive Korrektur der LDR I-Regler Maximalwertbegrenzung" SWORD tv_sw_q0p005 0 0 -163.840000 163.835000 /begin IF_DATA ASAP1B_ETK KP_BLOB 0x383CA6 1 2 /end IF_DATA BIT_MASK 0xFFFF /end MEASUREMENT
/begin MEASUREMENT ldimxa_1_A "Adaptive Korrektur der LDR I-Regler Maximalwertbegrenzung" SWORD tv_sw_q0p005 0 0 -163.840000 163.835000 /begin IF_DATA ASAP1B_ETK KP_BLOB 0x383CA8 1 2 /end IF_DATA BIT_MASK 0xFFFF /end MEASUREMENT
/begin MEASUREMENT ldimxa_2_A "Adaptive Korrektur der LDR I-Regler Maximalwertbegrenzung" SWORD tv_sw_q0p005 0 0 -163.840000 163.835000 /begin IF_DATA ASAP1B_ETK KP_BLOB 0x383CAA 1 2 /end IF_DATA BIT_MASK 0xFFFF /end MEASUREMENT
/begin MEASUREMENT ldimxa_3_A "Adaptive Korrektur der LDR I-Regler Maximalwertbegrenzung" SWORD tv_sw_q0p005 0 0 -163.840000 163.835000 /begin IF_DATA ASAP1B_ETK KP_BLOB 0x383CAC 1 2 /end IF_DATA BIT_MASK 0xFFFF /end MEASUREMENT
/begin MEASUREMENT ldimxa_4_A "Adaptive Korrektur der LDR I-Regler Maximalwertbegrenzung" SWORD tv_sw_q0p005 0 0 -163.840000 163.835000 /begin IF_DATA ASAP1B_ETK KP_BLOB 0x383CAE 1 2 /end IF_DATA BIT_MASK 0xFFFF /end MEASUREMENT
/begin MEASUREMENT ldimxr "Aktueller Referenzwert zur Maximalwertbegrenzung I-Anteil LDR" SWORD tv_sw_q0p005 0 0 -163.840000 163.835000 /begin IF_DATA ASAP1B_ETK KP_BLOB 0x3822A6 1 2 /end IF_DATA BIT_MASK 0xFFFF /end MEASUREMENT
/begin MEASUREMENT ldptv "LDR, TastverhÑltnis vom P-Regler" SWORD tv_sw_q0p005 0 0 -163.840000 163.835000 /begin IF_DATA ASAP1B_ETK KP_BLOB 0x3822AA 1 2 /end IF_DATA BIT_MASK 0xFFFF /end MEASUREMENT
/begin MEASUREMENT ldrdtv "LDR TastverhÑltnis vom D-Regler" SWORD tv_sw_q0p005 0 0 -163.840000 163.835000 /begin IF_DATA ASAP1B_ETK KP_BLOB 0x3822AC 1 2 /end IF_DATA BIT_MASK 0xFFFF /end MEASUREMENT
/begin MEASUREMENT ldrkd "LDR-Reglerparameter fÅr D-Anteil" UWORD rel_uw_b3276p75 0 0 0.000000 3276.750000 /begin IF_DATA ASAP1B_ETK KP_BLOB 0x3822AE 1 2 /end IF_DATA BIT_MASK 0xFFFF /end MEASUREMENT
/begin MEASUREMENT ldrki "LDR-Reglerparameter fÅr I-Anteil" UWORD rel_uw_b3276p75 0 0 0.000000 3276.750000 /begin IF_DATA ASAP1B_ETK KP_BLOB 0x3822B0 1 2 /end IF_DATA BIT_MASK 0xFFFF /end MEASUREMENT
/begin MEASUREMENT ldrkp "LDR-Reglerparameter fÅr P-Anteil" UWORD rel_uw_b3276p75 0 0 0.000000 3276.750000 /begin IF_DATA ASAP1B_ETK KP_BLOB 0x3822B2 1 2 /end IF_DATA BIT_MASK 0xFFFF /end MEASUREMENT
/begin MEASUREMENT ldrlms_w "Begrenzungswert fÅr maximale FÅllung LDR fÅr Motorschutz" UWORD rel_uw_q0p0234 0 0 0.000000 1535.976562 /begin IF_DATA ASAP1B_ETK KP_BLOB 0x3822D4 1 2 /end IF_DATA BIT_MASK 0xFFFF /end MEASUREMENT
/begin MEASUREMENT ldrlts_w "Begrenzungswert fÅr maximale FÅllung LDR fÅr ATL-Schutz" UWORD rel_uw_q0p0234 0 0 0.000000 1535.976562 /begin IF_DATA ASAP1B_ETK KP_BLOB 0x3822D6 1 2 /end IF_DATA BIT_MASK 0xFFFF /end MEASUREMENT
/begin MEASUREMENT ldtv "LDR TastverhÑltnis" SWORD tv_sw_q0p005 0 0 -163.840000 163.835000 /begin IF_DATA ASAP1B_ETK KP_BLOB 0x3822B4 1 2 /end IF_DATA BIT_MASK 0xFFFF /end MEASUREMENT
/begin MEASUREMENT ldtvbu_w "LDR TastverhÑltnis vom back up Regler" SWORD rel_sw_b50 0 0 -50.000000 49.998474 /begin IF_DATA ASAP1B_ETK KP_BLOB 0x3822E4 1 2 /end IF_DATA BIT_MASK 0xFFFF /end MEASUREMENT
/begin MEASUREMENT ldtvm "LDR TastverhÑltnis , moduliert (Endergebnis)" UBYTE tv_ub_b100 0 0 0.000000 99.609375 /begin IF_DATA ASAP1B_ETK KP_BLOB 0x380C0D 1 1 /end IF_DATA BIT_MASK 0xFF /end MEASUREMENT
/begin MEASUREMENT ldtvmd "LDR-TastverhÑltnis aus Md-Koordination" SWORD tv_ub_b100___SW 0 0 -12800.000000 12799.609375 /begin IF_DATA ASAP1B_ETK KP_BLOB 0x3822E6 1 2 /end IF_DATA BIT_MASK 0xFFFF /end MEASUREMENT
/begin MEASUREMENT limax_w "LLR-Integrator-Maximalwert" SWORD rel_sw_b100 0 0 -100.000000 99.996948 /begin IF_DATA ASAP1B_ETK KP_BLOB 0x382378 1 2 /end IF_DATA BIT_MASK 0xFFFF /end MEASUREMENT
/begin MEASUREMENT limin_w "LLR-Integrator-Minimalwert" SWORD rel_sw_b100 0 0 -100.000000 99.996948 /begin IF_DATA ASAP1B_ETK KP_BLOB 0x38237A 1 2 /end IF_DATA BIT_MASK 0xFFFF /end MEASUREMENT
/begin MEASUREMENT limnst "LLR-Integrator-Minimalwert wÑhrend Nachstart" UBYTE rel_ub_b24p9 0 0 0.000000 24.900000 /begin IF_DATA ASAP1B_ETK KP_BLOB 0x380C2C 1 1 /end IF_DATA BIT_MASK 0xFF /end MEASUREMENT
/begin MEASUREMENT lkraw "aktueller Wert der Lastschwelle Klopfregel-Adaption" UBYTE rel_ub_q0p75 0 0 0.000000 191.250000 /begin IF_DATA ASAP1B_ETK KP_BLOB 0x380BB6 1 1 /end IF_DATA BIT_MASK 0xFF /end MEASUREMENT
/begin MEASUREMENT lkrw "aktueller Wert der Lastschwelle Klopfregelung" UBYTE rel_ub_q0p75 0 0 0.000000 191.250000 /begin IF_DATA ASAP1B_ETK KP_BLOB 0x380BB7 1 1 /end IF_DATA BIT_MASK 0xFF /end MEASUREMENT
/begin MEASUREMENT lmskh_w "Lambda-Motor-Soll bei katheizen (word)" UWORD fak_uw_b4 0 0 0.000000 3.999939 /begin IF_DATA ASAP1B_ETK KP_BLOB 0x382154 1 2 /end IF_DATA BIT_MASK 0xFFFF /end MEASUREMENT
/begin MEASUREMENT lmssl2_w "Lambda-Motor-Soll wegen SekundÑrluft bei Kathezen, Bank 2" UWORD fak_uw_b4 0 0 0.000000 3.999939 /begin IF_DATA ASAP1B_ETK KP_BLOB 0x382156 1 2 /end IF_DATA BIT_MASK 0xFFFF /end MEASUREMENT
/begin MEASUREMENT lmssl_w "Lambda-Motor-Soll wegen SekundÑrluft bei Katheizen (word)" UWORD fak_uw_b4 0 0 0.000000 3.999939 /begin IF_DATA ASAP1B_ETK KP_BLOB 0x382158 1 2 /end IF_DATA BIT_MASK 0xFFFF /end MEASUREMENT
/begin MEASUREMENT lrfrmz "Zustandsbyte des Automaten Bildung des fr-Mittelwert frm_w" UBYTE dez 0 0 0.000000 255.000000 /begin IF_DATA ASAP1B_ETK KP_BLOB 0x380CFF 1 1 /end IF_DATA BIT_MASK 0xFF /end MEASUREMENT
/begin MEASUREMENT lrfrmz2 "Zustandsbyte des Automaten Bildung des fr-Mittelwert frm_w, Bank 2" UBYTE dez 0 0 0.000000 255.000000 /begin IF_DATA ASAP1B_ETK KP_BLOB 0x380D00 1 1 /end IF_DATA BIT_MASK 0xFF /end MEASUREMENT
/begin MEASUREMENT lrfrz "Zustandsbyte des LR-Automaten" UBYTE dez 0 0 0.000000 255.000000 /begin IF_DATA ASAP1B_ETK KP_BLOB 0x380D01 1 1 /end IF_DATA BIT_MASK 0xFF /end MEASUREMENT
/begin MEASUREMENT lrfrz2 "Zustandsbyte des LR-Automaten, Bank 2" UBYTE dez 0 0 0.000000 255.000000 /begin IF_DATA ASAP1B_ETK KP_BLOB 0x380D02 1 1 /end IF_DATA BIT_MASK 0xFF /end MEASUREMENT
/begin MEASUREMENT lzist_0_A "Array: aktuelle Zuordnung fÅhrende - gefÅhrte Zylinder" UBYTE dez 0 0 0.000000 255.000000 /begin IF_DATA ASAP1B_ETK KP_BLOB 0x383363 1 1 /end IF_DATA BIT_MASK 0xFF /end MEASUREMENT
/begin MEASUREMENT lzist_1_A "Array: aktuelle Zuordnung fÅhrende - gefÅhrte Zylinder" UBYTE dez 0 0 0.000000 255.000000 /begin IF_DATA ASAP1B_ETK KP_BLOB 0x383364 1 1 /end IF_DATA BIT_MASK 0xFF /end MEASUREMENT
/begin MEASUREMENT lzist_2_A "Array: aktuelle Zuordnung fÅhrende - gefÅhrte Zylinder" UBYTE dez 0 0 0.000000 255.000000 /begin IF_DATA ASAP1B_ETK KP_BLOB 0x383365 1 1 /end IF_DATA BIT_MASK 0xFF /end MEASUREMENT
/begin MEASUREMENT lzist_3_A "Array: aktuelle Zuordnung fÅhrende - gefÅhrte Zylinder" UBYTE dez 0 0 0.000000 255.000000 /begin IF_DATA ASAP1B_ETK KP_BLOB 0x383366 1 1 /end IF_DATA BIT_MASK 0xFF /end MEASUREMENT
/begin MEASUREMENT lzist_4_A "Array: aktuelle Zuordnung fÅhrende - gefÅhrte Zylinder" UBYTE dez 0 0 0.000000 255.000000 /begin IF_DATA ASAP1B_ETK KP_BLOB 0x383367 1 1 /end IF_DATA BIT_MASK 0xFF /end MEASUREMENT
/begin MEASUREMENT lzist_5_A "Array: aktuelle Zuordnung fÅhrende - gefÅhrte Zylinder" UBYTE dez 0 0 0.000000 255.000000 /begin IF_DATA ASAP1B_ETK KP_BLOB 0x383368 1 1 /end IF_DATA BIT_MASK 0xFF /end MEASUREMENT
/begin MEASUREMENT lzist_6_A "Array: aktuelle Zuordnung fÅhrende - gefÅhrte Zylinder" UBYTE dez 0 0 0.000000 255.000000 /begin IF_DATA ASAP1B_ETK KP_BLOB 0x383369 1 1 /end IF_DATA BIT_MASK 0xFF /end MEASUREMENT
/begin MEASUREMENT lzist_7_A "Array: aktuelle Zuordnung fÅhrende - gefÅhrte Zylinder" UBYTE dez 0 0 0.000000 255.000000 /begin IF_DATA ASAP1B_ETK KP_BLOB 0x38336A 1 1 /end IF_DATA BIT_MASK 0xFF /end MEASUREMENT
/begin MEASUREMENT mill_w "Indiziertes Motormoment im Leerlauf" UWORD rel_uw_b100 0 0 0.000000 99.998474 /begin IF_DATA ASAP1B_ETK KP_BLOB 0x3823A6 1 2 /end IF_DATA BIT_MASK 0xFFFF /end MEASUREMENT
/begin MEASUREMENT mistt "Startmoment" UBYTE rel_ub_b99p6 0 0 0.000000 99.609375 /begin IF_DATA ASAP1B_ETK KP_BLOB 0x380C33 1 1 /end IF_DATA BIT_MASK 0xFF /end MEASUREMENT
/begin MEASUREMENT nfskh "Leerlaufdrehzahl Fahrstufe bei Katheizen" UBYTE nmot_ub_q10 0 0 0.000000 2550.000000 /begin IF_DATA ASAP1B_ETK KP_BLOB 0x380B69 1 1 /end IF_DATA BIT_MASK 0xFF /end MEASUREMENT
/begin MEASUREMENT ngas_w "Drehzahlgradient Åber ein Arbeitsspiel" SWORD nmotg_sw_q0p39 0 0 -12800.163840 12799.773210 /begin IF_DATA ASAP1B_ETK KP_BLOB 0x381A9C 1 2 /end IF_DATA BIT_MASK 0xFFFF /end MEASUREMENT
/begin MEASUREMENT nllcvt1 " Drehzahlvorgabe aus CVT-Getriebe" UBYTE nmot_ub_q10 0 0 0.000000 2550.000000 /begin IF_DATA ASAP1B_ETK KP_BLOB 0x3809CB 1 1 /end IF_DATA BIT_MASK 0xFF /end MEASUREMENT
/begin MEASUREMENT nllcvt2 "Drehzahlvorgabe aus CVT-Getriebe nach Begrenzung" UBYTE nmot_ub_q10 0 0 0.000000 2550.000000 /begin IF_DATA ASAP1B_ETK KP_BLOB 0x380C1A 1 1 /end IF_DATA BIT_MASK 0xFF /end MEASUREMENT
/begin MEASUREMENT nlldagkt "Drehzahlerhîhung bei Diagnose im Kurztest" UBYTE nmot_ub_q40 0 0 0.000000 10200.000000 /begin IF_DATA ASAP1B_ETK KP_BLOB 0x380989 1 1 /end IF_DATA BIT_MASK 0xFF /end MEASUREMENT
/begin MEASUREMENT nllkh "Leerlaufdrehzahl bei Katheizen" UBYTE nmot_ub_q10 0 0 0.000000 2550.000000 /begin IF_DATA ASAP1B_ETK KP_BLOB 0x380B6A 1 1 /end IF_DATA BIT_MASK 0xFF /end MEASUREMENT
/begin MEASUREMENT nsfsm "LLR: MotortemperaturabhÑngige Solldrehzahl im LL bei S_fs=1" UBYTE nmot_ub_q10 0 0 0.000000 2550.000000 /begin IF_DATA ASAP1B_ETK KP_BLOB 0x380C16 1 1 /end IF_DATA BIT_MASK 0xFF /end MEASUREMENT
/begin MEASUREMENT nsfsmn "LLR: Minimale Solldrehzahl bei eingelegter Fahrstufe" UBYTE nmot_ub_q10 0 0 0.000000 2550.000000 /begin IF_DATA ASAP1B_ETK KP_BLOB 0x380C1B 1 1 /end IF_DATA BIT_MASK 0xFF /end MEASUREMENT
/begin MEASUREMENT nslbz "Solldrehtahl abhÑngig von lbz" UBYTE nmot_ub_q10 0 0 0.000000 2550.000000 /begin IF_DATA ASAP1B_ETK KP_BLOB 0x380C17 1 1 /end IF_DATA BIT_MASK 0xFF /end MEASUREMENT
/begin MEASUREMENT nslfa "Solldrehzahl bei Kurztrip" UBYTE nmot_ub_q10 0 0 0.000000 2550.000000 /begin IF_DATA ASAP1B_ETK KP_BLOB 0x380C35 1 1 /end IF_DATA BIT_MASK 0xFF /end MEASUREMENT
/begin MEASUREMENT nsllm "LLR: MotortemperaturabhÑngige Solldrehzahl im LL" UBYTE nmot_ub_q10 0 0 0.000000 2550.000000 /begin IF_DATA ASAP1B_ETK KP_BLOB 0x380C18 1 1 /end IF_DATA BIT_MASK 0xFF /end MEASUREMENT
/begin MEASUREMENT nsllmn "LLR: Minimale Solldrehzahl im LL" UBYTE nmot_ub_q10 0 0 0.000000 2550.000000 /begin IF_DATA ASAP1B_ETK KP_BLOB 0x380C1C 1 1 /end IF_DATA BIT_MASK 0xFF /end MEASUREMENT
/begin MEASUREMENT nsnf "LLR: NachgefÅhrte Solldrehzahl" UBYTE nmot_ub_q10 0 0 0.000000 2550.000000 /begin IF_DATA ASAP1B_ETK KP_BLOB 0x380C1D 1 1 /end IF_DATA BIT_MASK 0xFF /end MEASUREMENT
/begin MEASUREMENT nsol "Leerlaufsolldrehzahl" UBYTE nmot_ub_q10 0 0 0.000000 2550.000000 /begin IF_DATA ASAP1B_ETK KP_BLOB 0x380C1E 1 1 /end IF_DATA BIT_MASK 0xFF /end MEASUREMENT
/begin MEASUREMENT nsst "Initialisierungswert der Solldrehzahl im Start" UBYTE nmot_ub_q10 0 0 0.000000 2550.000000 /begin IF_DATA ASAP1B_ETK KP_BLOB 0x380C1F 1 1 /end IF_DATA BIT_MASK 0xFF /end MEASUREMENT
/begin MEASUREMENT nstat "Solldrehzahl stationÑr" UBYTE nmot_ub_q10 0 0 0.000000 2550.000000 /begin IF_DATA ASAP1B_ETK KP_BLOB 0x380C20 1 1 /end IF_DATA BIT_MASK 0xFF /end MEASUREMENT
/begin MEASUREMENT nstat2 "Stationnaire Solldrehzahl nach Begrenzung" UBYTE nmot_ub_q10 0 0 0.000000 2550.000000 /begin IF_DATA ASAP1B_ETK KP_BLOB 0x380C21 1 1 /end IF_DATA BIT_MASK 0xFF /end MEASUREMENT
/begin MEASUREMENT nstat3 "Stationnaire Solldrehzahl vor Filterung" UBYTE nmot_ub_q10 0 0 0.000000 2550.000000 /begin IF_DATA ASAP1B_ETK KP_BLOB 0x380C22 1 1 /end IF_DATA BIT_MASK 0xFF /end MEASUREMENT
/begin MEASUREMENT nstatfil "Solldrehzahl stationaÑr gefiltert" UBYTE nmot_ub_q10 0 0 0.000000 2550.000000 /begin IF_DATA ASAP1B_ETK KP_BLOB 0x380C23 1 1 /end IF_DATA BIT_MASK 0xFF /end MEASUREMENT
/begin MEASUREMENT pdpld "PrÑdizierter Delta Druck (öberschwinger Soll-Ist)" UBYTE p_ub_q10 0 0 0.000000 2550.000000 /begin IF_DATA ASAP1B_ETK KP_BLOB 0x380BFE 1 1 /end IF_DATA BIT_MASK 0xFF /end MEASUREMENT
/begin MEASUREMENT pirg_w "Partialdruck Restgas interne AGR (16-Bit)" UWORD p_uw_q0p039 0 0 0.000000 2559.960938 /begin IF_DATA ASAP1B_ETK KP_BLOB 0x381E3A 1 2 /end IF_DATA BIT_MASK 0xFFFF /end MEASUREMENT
/begin MEASUREMENT plsol_w "Soll-Ladedruck" UWORD p_uw_q0p039 0 0 0.000000 2559.960938 /begin IF_DATA ASAP1B_ETK KP_BLOB 0x381F24 1 2 /end IF_DATA BIT_MASK 0xFFFF /end MEASUREMENT
/begin MEASUREMENT pssol_w "Sollsaugrohrdruck" UWORD p_uw_q0p039 0 0 0.000000 2559.960938 /begin IF_DATA ASAP1B_ETK KP_BLOB 0x381F28 1 2 /end IF_DATA BIT_MASK 0xFFFF /end MEASUREMENT
/begin MEASUREMENT pu_w "Umgebungsdruck 16-Bit" UWORD p_uw_q0p039 0 0 0.000000 2559.960938 /begin IF_DATA ASAP1B_ETK KP_BLOB 0x381EA2 1 2 /end IF_DATA BIT_MASK 0xFFFF /end MEASUREMENT
/begin MEASUREMENT pvdkds "Druck vor Drosselklappe von Drucksensor" UBYTE p_ub_q10 0 0 0.000000 2550.000000 /begin IF_DATA ASAP1B_ETK KP_BLOB 0x380AEF 1 1 /end IF_DATA BIT_MASK 0xFF /end MEASUREMENT
/begin MEASUREMENT rkat2_w "additive Gemischkorrektur (pro Zeit) der Gemischadaption Bank 2 (Word)" SWORD rel_sw_b1536 0 0 -1536.000000 1535.953125 /begin IF_DATA ASAP1B_ETK KP_BLOB 0x383C6A 1 2 /end IF_DATA BIT_MASK 0xFFFF /end MEASUREMENT
/begin MEASUREMENT rkat_w "additive Gemischkorrektur (pro Zeit) der Gemischdaption (Word)" SWORD rel_sw_b1536 0 0 -1536.000000 1535.953125 /begin IF_DATA ASAP1B_ETK KP_BLOB 0x383C6C 1 2 /end IF_DATA BIT_MASK 0xFFFF /end MEASUREMENT
/begin MEASUREMENT rkaz2_w "additive Gemischkorrektur (pro ZÅndung) der Gemischadaption Bank2 (Word)" SWORD rel_sw_b1536 0 0 -1536.000000 1535.953125 /begin IF_DATA ASAP1B_ETK KP_BLOB 0x383C6E 1 2 /end IF_DATA BIT_MASK 0xFFFF /end MEASUREMENT
/begin MEASUREMENT rkaz_w "additive Gemischkorrektur (pro ZÅndung) der Gemischadaption" SWORD rel_sw_b1536 0 0 -1536.000000 1535.953125 /begin IF_DATA ASAP1B_ETK KP_BLOB 0x383C70 1 2 /end IF_DATA BIT_MASK 0xFFFF /end MEASUREMENT
/begin MEASUREMENT rka_w "Additive adaptive Korrektur der relativen Kraftstoffmasse" SWORD rel_sw_b1536 0 0 -1536.000000 1535.953125 /begin IF_DATA ASAP1B_ETK KP_BLOB 0x381FF6 1 2 /end IF_DATA BIT_MASK 0xFFFF /end MEASUREMENT
/begin MEASUREMENT rkrmx "nach oben begrenzter Referenzpegel" UBYTE spg_ub_b5 0 0 0.000000 4.980469 /begin IF_DATA ASAP1B_ETK KP_BLOB 0xF9B8 0 1 /end IF_DATA BIT_MASK 0xFF /end MEASUREMENT
/begin MEASUREMENT rkrmx1w "aktueller Wert der KL RKRMX1N" UBYTE spg_ub_b320 0 0 0.000000 318.750000 /begin IF_DATA ASAP1B_ETK KP_BLOB 0x380B89 1 1 /end IF_DATA BIT_MASK 0xFF /end MEASUREMENT
/begin MEASUREMENT rkrmx2w "aktueller Wert der KL RKRMX2N" UBYTE spg_ub_b320 0 0 0.000000 318.750000 /begin IF_DATA ASAP1B_ETK KP_BLOB 0x380B8A 1 1 /end IF_DATA BIT_MASK 0xFF /end MEASUREMENT
/begin MEASUREMENT rkr_0_A "Referenzpegel Klopfregelung" UBYTE spg_ub_b5 0 0 0.000000 4.980469 /begin IF_DATA ASAP1B_ETK KP_BLOB 0x380B96 1 1 /end IF_DATA BIT_MASK 0xFF /end MEASUREMENT
/begin MEASUREMENT rkr_1_A "Referenzpegel Klopfregelung" UBYTE spg_ub_b5 0 0 0.000000 4.980469 /begin IF_DATA ASAP1B_ETK KP_BLOB 0x380B97 1 1 /end IF_DATA BIT_MASK 0xFF /end MEASUREMENT
/begin MEASUREMENT rkr_2_A "Referenzpegel Klopfregelung" UBYTE spg_ub_b5 0 0 0.000000 4.980469 /begin IF_DATA ASAP1B_ETK KP_BLOB 0x380B98 1 1 /end IF_DATA BIT_MASK 0xFF /end MEASUREMENT
/begin MEASUREMENT rkr_3_A "Referenzpegel Klopfregelung" UBYTE spg_ub_b5 0 0 0.000000 4.980469 /begin IF_DATA ASAP1B_ETK KP_BLOB 0x380B99 1 1 /end IF_DATA BIT_MASK 0xFF /end MEASUREMENT
/begin MEASUREMENT rkr_4_A "Referenzpegel Klopfregelung" UBYTE spg_ub_b5 0 0 0.000000 4.980469 /begin IF_DATA ASAP1B_ETK KP_BLOB 0x380B9A 1 1 /end IF_DATA BIT_MASK 0xFF /end MEASUREMENT
/begin MEASUREMENT rkr_5_A "Referenzpegel Klopfregelung" UBYTE spg_ub_b5 0 0 0.000000 4.980469 /begin IF_DATA ASAP1B_ETK KP_BLOB 0x380B9B 1 1 /end IF_DATA BIT_MASK 0xFF /end MEASUREMENT
/begin MEASUREMENT rkr_6_A "Referenzpegel Klopfregelung" UBYTE spg_ub_b5 0 0 0.000000 4.980469 /begin IF_DATA ASAP1B_ETK KP_BLOB 0x380B9C 1 1 /end IF_DATA BIT_MASK 0xFF /end MEASUREMENT
/begin MEASUREMENT rkr_7_A "Referenzpegel Klopfregelung" UBYTE spg_ub_b5 0 0 0.000000 4.980469 /begin IF_DATA ASAP1B_ETK KP_BLOB 0x380B9D 1 1 /end IF_DATA BIT_MASK 0xFF /end MEASUREMENT
/begin MEASUREMENT rkr_tst "Referenzpegel Klopfregelung rollierend mit Zyl.zÑhler" UBYTE spg_ub_b5 0 0 0.000000 4.980469 /begin IF_DATA ASAP1B_ETK KP_BLOB 0x380B9E 1 1 /end IF_DATA BIT_MASK 0xFF /end MEASUREMENT
/begin MEASUREMENT rkte_w "Relativer Gemischanteil TankentlÅftung" SWORD rel_sw_q0p0468 0 0 -1536.000000 1535.953125 /begin IF_DATA ASAP1B_ETK KP_BLOB 0x3826A6 1 2 /end IF_DATA BIT_MASK 0xFFFF /end MEASUREMENT
/begin MEASUREMENT rk_w "relative Kraftstoffmasse" UWORD rel_uw_b3072 0 0 0.000000 3071.953125 /begin IF_DATA ASAP1B_ETK KP_BLOB 0x381FA6 1 2 /end IF_DATA BIT_MASK 0xFFFF /end MEASUREMENT
/begin MEASUREMENT rlmax_w "maximal erreichbare FÅllung bei Turbo" UWORD rel_uw_q0p0234 0 0 0.000000 1535.976562 /begin IF_DATA ASAP1B_ETK KP_BLOB 0x3822D8 1 2 /end IF_DATA BIT_MASK 0xFFFF /end MEASUREMENT
/begin MEASUREMENT rlmxko_w "MaximalfÅllung korrigiert (ohne Begrenzungen)" UWORD rel_uw_q0p0234 0 0 0.000000 1535.976562 /begin IF_DATA ASAP1B_ETK KP_BLOB 0x3822DA 1 2 /end IF_DATA BIT_MASK 0xFFFF /end MEASUREMENT
/begin MEASUREMENT rlmx_w "Rohwert Maximalfuellung" UWORD rel_uw_q0p0234 0 0 0.000000 1535.976562 /begin IF_DATA ASAP1B_ETK KP_BLOB 0x3822DC 1 2 /end IF_DATA BIT_MASK 0xFFFF /end MEASUREMENT
/begin MEASUREMENT rlsol_w "Soll-FÅllung" UWORD rel_uw_q0p0234 0 0 0.000000 1535.976562 /begin IF_DATA ASAP1B_ETK KP_BLOB 0x381F4E 1 2 /end IF_DATA BIT_MASK 0xFFFF /end MEASUREMENT
/begin MEASUREMENT stkrlx "LaststÅtzstelle fÅr die KR-Adaption" UBYTE dez 0 0 0.000000 255.000000 /begin IF_DATA ASAP1B_ETK KP_BLOB 0x380BC8 1 1 /end IF_DATA BIT_MASK 0xFF /end MEASUREMENT
/begin MEASUREMENT stkrnx "DrehzahlstÅtzstelle fÅr die KR-Adaption" UBYTE dez 0 0 0.000000 255.000000 /begin IF_DATA ASAP1B_ETK KP_BLOB 0x380BC9 1 1 /end IF_DATA BIT_MASK 0xFF /end MEASUREMENT
/begin MEASUREMENT stldia "Aktuelle StÅtzstelle fÅr LDR Adaption" UBYTE dez 0 0 0.000000 255.000000 /begin IF_DATA ASAP1B_ETK KP_BLOB 0x380C02 1 1 /end IF_DATA BIT_MASK 0xFF /end MEASUREMENT
/begin MEASUREMENT S_ac "Klima-Anforderung aktiv" UWORD B_TRUE___UW 0 0 0.000000 0.000000 /begin IF_DATA ASAP1B_ETK KP_BLOB 0xFD6C 0 2 /end IF_DATA BIT_MASK 0x8 /end MEASUREMENT
/begin MEASUREMENT S_ko "Kompressoranforderung aktiv" UWORD B_TRUE___UW 0 0 0.000000 0.000000 /begin IF_DATA ASAP1B_ETK KP_BLOB 0xFD6C 0 2 /end IF_DATA BIT_MASK 0x100 /end MEASUREMENT
/begin MEASUREMENT temp_b_wert "" UBYTE dez 0 0 0.000000 255.000000 /begin IF_DATA ASAP1B_ETK KP_BLOB 0x380B9F 1 1 /end IF_DATA BIT_MASK 0xFF /end MEASUREMENT
/begin MEASUREMENT tfrn2_w "Zeitdauer Lambdaregler I-Anteil negative Steigung, Bank 2" UWORD t10msxs_uw_b655p35 0 0 0.000000 655.350000 /begin IF_DATA ASAP1B_ETK KP_BLOB 0x3828AA 1 2 /end IF_DATA BIT_MASK 0xFFFF /end MEASUREMENT
/begin MEASUREMENT tfrnint2_w "ZÑhler zum Ausmessen Zeitdauer Lambdaregler I-Anteil negative Steigung, Bank 2" UWORD t10msxs_uw_b655p35 0 0 0.000000 655.350000 /begin IF_DATA ASAP1B_ETK KP_BLOB 0x3828AC 1 2 /end IF_DATA BIT_MASK 0xFFFF /end MEASUREMENT
/begin MEASUREMENT tfrnint_w "ZÑhler zum Ausmessen Zeitdauer Lambdaregler I-Anteil negative Steigung" UWORD t10msxs_uw_b655p35 0 0 0.000000 655.350000 /begin IF_DATA ASAP1B_ETK KP_BLOB 0x3828AE 1 2 /end IF_DATA BIT_MASK 0xFFFF /end MEASUREMENT
/begin MEASUREMENT tfrn_w "Zeitdauer Lambdaregler I-Anteil negative Steigung" UWORD t10msxs_uw_b655p35 0 0 0.000000 655.350000 /begin IF_DATA ASAP1B_ETK KP_BLOB 0x3828B0 1 2 /end IF_DATA BIT_MASK 0xFFFF /end MEASUREMENT
/begin MEASUREMENT tfrp2_w "Zeitdauer Lambdaregler I-Anteil positive Steigung, Bank2" UWORD t10msxs_uw_b655p35 0 0 0.000000 655.350000 /begin IF_DATA ASAP1B_ETK KP_BLOB 0x3828B2 1 2 /end IF_DATA BIT_MASK 0xFFFF /end MEASUREMENT
/begin MEASUREMENT tfrpint2_w "ZÑhler zur Messung der Zeitdauer Lambdaregler I-Anteil positive Steigung, Bank 2" UWORD t10msxs_uw_b655p35 0 0 0.000000 655.350000 /begin IF_DATA ASAP1B_ETK KP_BLOB 0x3828B4 1 2 /end IF_DATA BIT_MASK 0xFFFF /end MEASUREMENT
/begin MEASUREMENT tfrpint_w "ZÑhler zur Messung der Zeitdauer Lambdaregler I-Anteil positive Steigung" UWORD t10msxs_uw_b655p35 0 0 0.000000 655.350000 /begin IF_DATA ASAP1B_ETK KP_BLOB 0x3828B6 1 2 /end IF_DATA BIT_MASK 0xFFFF /end MEASUREMENT
/begin MEASUREMENT tfrp_w "Zeitdauer Lambdaregler I-Anteil positive Steigung" UWORD t10msxs_uw_b655p35 0 0 0.000000 655.350000 /begin IF_DATA ASAP1B_ETK KP_BLOB 0x3828B8 1 2 /end IF_DATA BIT_MASK 0xFFFF /end MEASUREMENT
/begin MEASUREMENT tisum_w "Einspritzzeitsummierer" UWORD dez___UW 0 0 0.000000 65535.000000 /begin IF_DATA ASAP1B_ETK KP_BLOB 0x38290C 1 2 /end IF_DATA BIT_MASK 0xFFFF /end MEASUREMENT
/begin MEASUREMENT tkvad "" UBYTE dez 0 0 0.000000 255.000000 /begin IF_DATA ASAP1B_ETK KP_BLOB 0x380D2A 1 1 /end IF_DATA BIT_MASK 0xFF /end MEASUREMENT
/begin MEASUREMENT tkvag_w "" UWORD dez___UW 0 0 0.000000 65535.000000 /begin IF_DATA ASAP1B_ETK KP_BLOB 0x382908 1 2 /end IF_DATA BIT_MASK 0xFFFF /end MEASUREMENT
/begin MEASUREMENT tkvar "" UBYTE dez 0 0 0.000000 255.000000 /begin IF_DATA ASAP1B_ETK KP_BLOB 0x380D2B 1 1 /end IF_DATA BIT_MASK 0xFF /end MEASUREMENT
/begin MEASUREMENT tkva_h "" UWORD dez___UW 0 0 0.000000 65535.000000 /begin IF_DATA ASAP1B_ETK KP_BLOB 0x38290E 1 2 /end IF_DATA BIT_MASK 0xFFFF /end MEASUREMENT
/begin MEASUREMENT tmki "Motortemperatur aus Kombiinstrument" UBYTE temp_ub_q0p75_o48 0 0 -48.000000 143.250000 /begin IF_DATA ASAP1B_ETK KP_BLOB 0x38098E 1 1 /end IF_DATA BIT_MASK 0xFF /end MEASUREMENT
/begin MEASUREMENT tplrvk2_w "Periodendauerwert Rohwert der Sonde vor Kat, ermittelt in %LR, Bank 2" UWORD t10msxs_uw_b655p35 0 0 0.000000 655.350000 /begin IF_DATA ASAP1B_ETK KP_BLOB 0x3828BA 1 2 /end IF_DATA BIT_MASK 0xFFFF /end MEASUREMENT
/begin MEASUREMENT tplrvk_w "Periodendauerwert Rohwert der Sonde vor Kat, ermittelt in %LR" UWORD t10msxs_uw_b655p35 0 0 0.000000 655.350000 /begin IF_DATA ASAP1B_ETK KP_BLOB 0x3828BC 1 2 /end IF_DATA BIT_MASK 0xFFFF /end MEASUREMENT
/begin MEASUREMENT tsperr "Sperrzeit fÅr Lambdaregelung" UBYTE t10msxs_ub_b2p55 0 0 0.000000 2.550000 /begin IF_DATA ASAP1B_ETK KP_BLOB 0x380D03 1 1 /end IF_DATA BIT_MASK 0xFF /end MEASUREMENT
/begin MEASUREMENT tsperr2 "Sperrzeit fÅr Lambdaregelung, Bank 2" UBYTE t10msxs_ub_b2p55 0 0 0.000000 2.550000 /begin IF_DATA ASAP1B_ETK KP_BLOB 0x380D04 1 1 /end IF_DATA BIT_MASK 0xFF /end MEASUREMENT
/begin MEASUREMENT tv "LR: Integratorstopzeit-ZÑhler / ES: Bereitstellung Spannungskorrektur" SBYTE t10msxs_sb_q0p01 0 0 -1.280000 1.270000 /begin IF_DATA ASAP1B_ETK KP_BLOB 0x380D05 1 1 /end IF_DATA BIT_MASK 0xFF /end MEASUREMENT
/begin MEASUREMENT tv2 "LR Bank 2: Integratorstopzeit-ZÑhler / ES: Bereitstellung Spannungskorrektur" SBYTE t10msxs_sb_q0p01 0 0 -1.280000 1.270000 /begin IF_DATA ASAP1B_ETK KP_BLOB 0x380D06 1 1 /end IF_DATA BIT_MASK 0xFF /end MEASUREMENT
/begin MEASUREMENT tvlr "LR: Summenwert fÅr verzîgerte Reglerumschaltung tv" SBYTE t10msxs_sb_q0p01 0 0 -1.280000 1.270000 /begin IF_DATA ASAP1B_ETK KP_BLOB 0x380D07 1 1 /end IF_DATA BIT_MASK 0xFF /end MEASUREMENT
/begin MEASUREMENT tvlr2 "LR: Summenwert fÅr verzîgerte Reglerumschaltung tv 2" SBYTE t10msxs_sb_q0p01 0 0 -1.280000 1.270000 /begin IF_DATA ASAP1B_ETK KP_BLOB 0x380D08 1 1 /end IF_DATA BIT_MASK 0xFF /end MEASUREMENT
/begin MEASUREMENT tvlrh "LRHK: Korrekturwert fÅr verzîgerte Reglerumschaltung tv" SBYTE t100msxs_sb_q0p01 0 0 -1.280000 1.270000 /begin IF_DATA ASAP1B_ETK KP_BLOB 0x380CEB 1 1 /end IF_DATA BIT_MASK 0xFF /end MEASUREMENT
/begin MEASUREMENT tvlrh2 "LRHK: Korrekturwert fÅr verzîgerte Reglerumschaltung tv 2" SBYTE t100msxs_sb_q0p01 0 0 -1.280000 1.270000 /begin IF_DATA ASAP1B_ETK KP_BLOB 0x380CEC 1 1 /end IF_DATA BIT_MASK 0xFF /end MEASUREMENT
/begin MEASUREMENT tvlrhi "I-Anteil fÅr verzîgerte Reglerumschaltung tv, gewichtet" SBYTE t100msxs_sb_q0p01 0 0 -1.280000 1.270000 /begin IF_DATA ASAP1B_ETK KP_BLOB 0x380CED 1 1 /end IF_DATA BIT_MASK 0xFF /end MEASUREMENT
/begin MEASUREMENT tvlrhi2 "Bank2: I-Anteil fÅr verzîgerte Reglerumschaltung tv, gewichtet" SBYTE t100msxs_sb_q0p01 0 0 -1.280000 1.270000 /begin IF_DATA ASAP1B_ETK KP_BLOB 0x380CEE 1 1 /end IF_DATA BIT_MASK 0xFF /end MEASUREMENT
/begin MEASUREMENT usvk "Spannung Lambdasonde vor Kat" UBYTE spg_ub_q0p0052_o0p2 0 0 -0.200000 1.130000 /begin IF_DATA ASAP1B_ETK KP_BLOB 0x380A81 1 1 /end IF_DATA BIT_MASK 0xFF /end MEASUREMENT
/begin MEASUREMENT usvk2 "Spannung Lambdasonde vor Kat 2" UBYTE spg_ub_q0p0052_o0p2 0 0 -0.200000 1.130000 /begin IF_DATA ASAP1B_ETK KP_BLOB 0x380A82 1 1 /end IF_DATA BIT_MASK 0xFF /end MEASUREMENT
/begin MEASUREMENT virkr "VerhÑltnis Integrator / Referenzpegel Klopfregelung" UBYTE fak_ub_b16 0 0 0.000000 15.937500 /begin IF_DATA ASAP1B_ETK KP_BLOB 0xF9B9 0 1 /end IF_DATA BIT_MASK 0xFF /end MEASUREMENT
/begin MEASUREMENT vkr_0_A "VerstÑrkungsstufe fÅr EingangsverstÑrkung Klopf-IC" UBYTE dez 0 0 0.000000 255.000000 /begin IF_DATA ASAP1B_ETK KP_BLOB 0x380BA0 1 1 /end IF_DATA BIT_MASK 0xFF /end MEASUREMENT
/begin MEASUREMENT vkr_1_A "VerstÑrkungsstufe fÅr EingangsverstÑrkung Klopf-IC" UBYTE dez 0 0 0.000000 255.000000 /begin IF_DATA ASAP1B_ETK KP_BLOB 0x380BA1 1 1 /end IF_DATA BIT_MASK 0xFF /end MEASUREMENT
/begin MEASUREMENT vkr_2_A "VerstÑrkungsstufe fÅr EingangsverstÑrkung Klopf-IC" UBYTE dez 0 0 0.000000 255.000000 /begin IF_DATA ASAP1B_ETK KP_BLOB 0x380BA2 1 1 /end IF_DATA BIT_MASK 0xFF /end MEASUREMENT
/begin MEASUREMENT vkr_3_A "VerstÑrkungsstufe fÅr EingangsverstÑrkung Klopf-IC" UBYTE dez 0 0 0.000000 255.000000 /begin IF_DATA ASAP1B_ETK KP_BLOB 0x380BA3 1 1 /end IF_DATA BIT_MASK 0xFF /end MEASUREMENT
/begin MEASUREMENT vkr_4_A "VerstÑrkungsstufe fÅr EingangsverstÑrkung Klopf-IC" UBYTE dez 0 0 0.000000 255.000000 /begin IF_DATA ASAP1B_ETK KP_BLOB 0x380BA4 1 1 /end IF_DATA BIT_MASK 0xFF /end MEASUREMENT
/begin MEASUREMENT vkr_5_A "VerstÑrkungsstufe fÅr EingangsverstÑrkung Klopf-IC" UBYTE dez 0 0 0.000000 255.000000 /begin IF_DATA ASAP1B_ETK KP_BLOB 0x380BA5 1 1 /end IF_DATA BIT_MASK 0xFF /end MEASUREMENT
/begin MEASUREMENT vkr_6_A "VerstÑrkungsstufe fÅr EingangsverstÑrkung Klopf-IC" UBYTE dez 0 0 0.000000 255.000000 /begin IF_DATA ASAP1B_ETK KP_BLOB 0x380BA6 1 1 /end IF_DATA BIT_MASK 0xFF /end MEASUREMENT
/begin MEASUREMENT vkr_7_A "VerstÑrkungsstufe fÅr EingangsverstÑrkung Klopf-IC" UBYTE dez 0 0 0.000000 255.000000 /begin IF_DATA ASAP1B_ETK KP_BLOB 0x380BA7 1 1 /end IF_DATA BIT_MASK 0xFF /end MEASUREMENT
/begin MEASUREMENT vkr_tst "VerstÑrkungsstufe fÅr EingangsverstÑrkung Klopf-IC rollierend mit Zyl.zÑhler" UBYTE dez 0 0 0.000000 255.000000 /begin IF_DATA ASAP1B_ETK KP_BLOB 0x380BA8 1 1 /end IF_DATA BIT_MASK 0xFF /end MEASUREMENT
/begin MEASUREMENT vpsspls_w "VerhÑltnis Soll-Saugrohrdruck zu Druck Sollladedruck" UWORD fak_uw_b2 0 0 0.000000 1.999969 /begin IF_DATA ASAP1B_ETK KP_BLOB 0x382298 1 2 /end IF_DATA BIT_MASK 0xFFFF /end MEASUREMENT
/begin MEASUREMENT vrlsol "Verhaeltnis relative Soll-FÅllung zu Maximalfuellung" UBYTE fak_ub_b1 0 0 0.000000 0.996094 /begin IF_DATA ASAP1B_ETK KP_BLOB 0x380C00 1 1 /end IF_DATA BIT_MASK 0xFF /end MEASUREMENT
/begin MEASUREMENT vske "verstellbarer Offset fÅr Klopferkennungsschwelle Åber VS20" SBYTE fak_ub_b16___SB 0 0 -8.000000 7.937500 /begin IF_DATA ASAP1B_ETK KP_BLOB 0x3809A8 1 1 /end IF_DATA BIT_MASK 0xFF /end MEASUREMENT
/begin MEASUREMENT vsldtv "Verstellgrî·e LDR-TastverhÑltnis vom VSx-System zur Applikation" UBYTE tv_ub_b100 0 0 0.000000 99.609375 /begin IF_DATA ASAP1B_ETK KP_BLOB 0x3809A9 1 1 /end IF_DATA BIT_MASK 0xFF /end MEASUREMENT
/begin MEASUREMENT vsns "énderung der Solldrehzahl Åber Verstellsystem VSxy" UBYTE nmot_ub_q10 0 0 0.000000 2550.000000 /begin IF_DATA ASAP1B_ETK KP_BLOB 0x3809AA 1 1 /end IF_DATA BIT_MASK 0xFF /end MEASUREMENT
/begin MEASUREMENT vsrlmx "Additive FÅllungskorrektur fÅr rlmx vom Verstellsystem" SBYTE rel_sb_q0p75 0 0 -96.000000 95.250000 /begin IF_DATA ASAP1B_ETK KP_BLOB 0x3809AB 1 1 /end IF_DATA BIT_MASK 0xFF /end MEASUREMENT
/begin MEASUREMENT vstcns "Anpassung Codewort LL-Solldrehzahl-Umschaltung" UBYTE dez 0 0 0.000000 255.000000 /begin IF_DATA ASAP1B_ETK KP_BLOB 0x380BF1 1 1 /end IF_DATA BIT_MASK 0xFF /end MEASUREMENT
/begin MEASUREMENT vstlr "Anpassung tv-Zeit  (Testerschnittstelle)" SBYTE t10msxs_sb_q0p01 0 0 -1.280000 1.270000 /begin IF_DATA ASAP1B_ETK KP_BLOB 0x380BF9 1 1 /end IF_DATA BIT_MASK 0xFF /end MEASUREMENT
/begin MEASUREMENT vstmdr "Anpassung Momentenreserve Leerlaufregelung (Testerschnitst.)" UBYTE rel_ub_b25 0 0 0.000000 24.902344 /begin IF_DATA ASAP1B_ETK KP_BLOB 0x380BFA 1 1 /end IF_DATA BIT_MASK 0xFF /end MEASUREMENT
/begin MEASUREMENT vstnls "Anpassung LL-Solldrehzahl (Testerschittstelle)" SBYTE nmot_sb_q10 0 0 -1280.000000 1270.000000 /begin IF_DATA ASAP1B_ETK KP_BLOB 0x380BFB 1 1 /end IF_DATA BIT_MASK 0xFF /end MEASUREMENT
/begin MEASUREMENT vstrlx "Verstellgrî·e MaximalfÅllung vom Tester" UBYTE fak_ub_b1 0 0 0.000000 0.996094 /begin IF_DATA ASAP1B_ETK KP_BLOB 0x380BFC 1 1 /end IF_DATA BIT_MASK 0xFF /end MEASUREMENT
/begin MEASUREMENT vszwkr_0_A "Zylinderindividuelle ZW-Verstellung durch Verstellsystem" SBYTE zw_sb_q0p75 0 0 -96.000000 95.250000 /begin IF_DATA ASAP1B_ETK KP_BLOB 0x3809AF 1 1 /end IF_DATA BIT_MASK 0xFF /end MEASUREMENT
/begin MEASUREMENT vszwkr_1_A "Zylinderindividuelle ZW-Verstellung durch Verstellsystem" SBYTE zw_sb_q0p75 0 0 -96.000000 95.250000 /begin IF_DATA ASAP1B_ETK KP_BLOB 0x3809B0 1 1 /end IF_DATA BIT_MASK 0xFF /end MEASUREMENT
/begin MEASUREMENT vszwkr_2_A "Zylinderindividuelle ZW-Verstellung durch Verstellsystem" SBYTE zw_sb_q0p75 0 0 -96.000000 95.250000 /begin IF_DATA ASAP1B_ETK KP_BLOB 0x3809B1 1 1 /end IF_DATA BIT_MASK 0xFF /end MEASUREMENT
/begin MEASUREMENT vszwkr_3_A "Zylinderindividuelle ZW-Verstellung durch Verstellsystem" SBYTE zw_sb_q0p75 0 0 -96.000000 95.250000 /begin IF_DATA ASAP1B_ETK KP_BLOB 0x3809B2 1 1 /end IF_DATA BIT_MASK 0xFF /end MEASUREMENT
/begin MEASUREMENT vszwkr_4_A "Zylinderindividuelle ZW-Verstellung durch Verstellsystem" SBYTE zw_sb_q0p75 0 0 -96.000000 95.250000 /begin IF_DATA ASAP1B_ETK KP_BLOB 0x3809B3 1 1 /end IF_DATA BIT_MASK 0xFF /end MEASUREMENT
/begin MEASUREMENT vszwkr_5_A "Zylinderindividuelle ZW-Verstellung durch Verstellsystem" SBYTE zw_sb_q0p75 0 0 -96.000000 95.250000 /begin IF_DATA ASAP1B_ETK KP_BLOB 0x3809B4 1 1 /end IF_DATA BIT_MASK 0xFF /end MEASUREMENT
/begin MEASUREMENT vszwkr_6_A "Zylinderindividuelle ZW-Verstellung durch Verstellsystem" SBYTE zw_sb_q0p75 0 0 -96.000000 95.250000 /begin IF_DATA ASAP1B_ETK KP_BLOB 0x3809B5 1 1 /end IF_DATA BIT_MASK 0xFF /end MEASUREMENT
/begin MEASUREMENT vszwkr_7_A "Zylinderindividuelle ZW-Verstellung durch Verstellsystem" SBYTE zw_sb_q0p75 0 0 -96.000000 95.250000 /begin IF_DATA ASAP1B_ETK KP_BLOB 0x3809B6 1 1 /end IF_DATA BIT_MASK 0xFF /end MEASUREMENT
/begin MEASUREMENT vszwm "Mittelwert der ZW-Verstellung Åber VS2x" SBYTE zw_sb_q0p75 0 0 -96.000000 95.250000 /begin IF_DATA ASAP1B_ETK KP_BLOB 0x380BCA 1 1 /end IF_DATA BIT_MASK 0xFF /end MEASUREMENT
/begin MEASUREMENT wkraa_0_A "Monitor der wkra des aktuellen Adaptionsbereiches, wkra_0, _1..." UBYTE zw_ub_qn0p75 0 0 -191.250000 0.000000 /begin IF_DATA ASAP1B_ETK KP_BLOB 0x380BCB 1 1 /end IF_DATA BIT_MASK 0xFF /end MEASUREMENT
/begin MEASUREMENT wkraa_1_A "Monitor der wkra des aktuellen Adaptionsbereiches, wkra_0, _1..." UBYTE zw_ub_qn0p75 0 0 -191.250000 0.000000 /begin IF_DATA ASAP1B_ETK KP_BLOB 0x380BCC 1 1 /end IF_DATA BIT_MASK 0xFF /end MEASUREMENT
/begin MEASUREMENT wkraa_2_A "Monitor der wkra des aktuellen Adaptionsbereiches, wkra_0, _1..." UBYTE zw_ub_qn0p75 0 0 -191.250000 0.000000 /begin IF_DATA ASAP1B_ETK KP_BLOB 0x380BCD 1 1 /end IF_DATA BIT_MASK 0xFF /end MEASUREMENT
/begin MEASUREMENT wkraa_3_A "Monitor der wkra des aktuellen Adaptionsbereiches, wkra_0, _1..." UBYTE zw_ub_qn0p75 0 0 -191.250000 0.000000 /begin IF_DATA ASAP1B_ETK KP_BLOB 0x380BCE 1 1 /end IF_DATA BIT_MASK 0xFF /end MEASUREMENT
/begin MEASUREMENT wkraa_4_A "Monitor der wkra des aktuellen Adaptionsbereiches, wkra_0, _1..." UBYTE zw_ub_qn0p75 0 0 -191.250000 0.000000 /begin IF_DATA ASAP1B_ETK KP_BLOB 0x380BCF 1 1 /end IF_DATA BIT_MASK 0xFF /end MEASUREMENT
/begin MEASUREMENT wkraa_5_A "Monitor der wkra des aktuellen Adaptionsbereiches, wkra_0, _1..." UBYTE zw_ub_qn0p75 0 0 -191.250000 0.000000 /begin IF_DATA ASAP1B_ETK KP_BLOB 0x380BD0 1 1 /end IF_DATA BIT_MASK 0xFF /end MEASUREMENT
/begin MEASUREMENT wkraa_6_A "Monitor der wkra des aktuellen Adaptionsbereiches, wkra_0, _1..." UBYTE zw_ub_qn0p75 0 0 -191.250000 0.000000 /begin IF_DATA ASAP1B_ETK KP_BLOB 0x380BD1 1 1 /end IF_DATA BIT_MASK 0xFF /end MEASUREMENT
/begin MEASUREMENT wkraa_7_A "Monitor der wkra des aktuellen Adaptionsbereiches, wkra_0, _1..." UBYTE zw_ub_qn0p75 0 0 -191.250000 0.000000 /begin IF_DATA ASAP1B_ETK KP_BLOB 0x380BD2 1 1 /end IF_DATA BIT_MASK 0xFF /end MEASUREMENT
/begin MEASUREMENT wkratst "wkra mit Synchro-Raster rollierend" UBYTE zw_ub_qn0p75 0 0 -191.250000 0.000000 /begin IF_DATA ASAP1B_ETK KP_BLOB 0x380BD3 1 1 /end IF_DATA BIT_MASK 0xFF /end MEASUREMENT
/begin MEASUREMENT wkra_0_A "last und drehzahlabh. Adaptionskennfeld f. wkr" UBYTE zw_ub_qn0p75 0 0 -191.250000 0.000000 /begin IF_DATA ASAP1B_ETK KP_BLOB 0x38336B 1 1 /end IF_DATA BIT_MASK 0xFF /end MEASUREMENT
/begin MEASUREMENT wkra_100_A "last und drehzahlabh. Adaptionskennfeld f. wkr" UBYTE zw_ub_qn0p75 0 0 -191.250000 0.000000 /begin IF_DATA ASAP1B_ETK KP_BLOB 0x3833CF 1 1 /end IF_DATA BIT_MASK 0xFF /end MEASUREMENT
/begin MEASUREMENT wkra_101_A "last und drehzahlabh. Adaptionskennfeld f. wkr" UBYTE zw_ub_qn0p75 0 0 -191.250000 0.000000 /begin IF_DATA ASAP1B_ETK KP_BLOB 0x3833D0 1 1 /end IF_DATA BIT_MASK 0xFF /end MEASUREMENT
/begin MEASUREMENT wkra_102_A "last und drehzahlabh. Adaptionskennfeld f. wkr" UBYTE zw_ub_qn0p75 0 0 -191.250000 0.000000 /begin IF_DATA ASAP1B_ETK KP_BLOB 0x3833D1 1 1 /end IF_DATA BIT_MASK 0xFF /end MEASUREMENT
/begin MEASUREMENT wkra_103_A "last und drehzahlabh. Adaptionskennfeld f. wkr" UBYTE zw_ub_qn0p75 0 0 -191.250000 0.000000 /begin IF_DATA ASAP1B_ETK KP_BLOB 0x3833D2 1 1 /end IF_DATA BIT_MASK 0xFF /end MEASUREMENT
/begin MEASUREMENT wkra_104_A "last und drehzahlabh. Adaptionskennfeld f. wkr" UBYTE zw_ub_qn0p75 0 0 -191.250000 0.000000 /begin IF_DATA ASAP1B_ETK KP_BLOB 0x3833D3 1 1 /end IF_DATA BIT_MASK 0xFF /end MEASUREMENT
/begin MEASUREMENT wkra_105_A "last und drehzahlabh. Adaptionskennfeld f. wkr" UBYTE zw_ub_qn0p75 0 0 -191.250000 0.000000 /begin IF_DATA ASAP1B_ETK KP_BLOB 0x3833D4 1 1 /end IF_DATA BIT_MASK 0xFF /end MEASUREMENT
/begin MEASUREMENT wkra_106_A "last und drehzahlabh. Adaptionskennfeld f. wkr" UBYTE zw_ub_qn0p75 0 0 -191.250000 0.000000 /begin IF_DATA ASAP1B_ETK KP_BLOB 0x3833D5 1 1 /end IF_DATA BIT_MASK 0xFF /end MEASUREMENT
/begin MEASUREMENT wkra_107_A "last und drehzahlabh. Adaptionskennfeld f. wkr" UBYTE zw_ub_qn0p75 0 0 -191.250000 0.000000 /begin IF_DATA ASAP1B_ETK KP_BLOB 0x3833D6 1 1 /end IF_DATA BIT_MASK 0xFF /end MEASUREMENT
/begin MEASUREMENT wkra_108_A "last und drehzahlabh. Adaptionskennfeld f. wkr" UBYTE zw_ub_qn0p75 0 0 -191.250000 0.000000 /begin IF_DATA ASAP1B_ETK KP_BLOB 0x3833D7 1 1 /end IF_DATA BIT_MASK 0xFF /end MEASUREMENT
/begin MEASUREMENT wkra_109_A "last und drehzahlabh. Adaptionskennfeld f. wkr" UBYTE zw_ub_qn0p75 0 0 -191.250000 0.000000 /begin IF_DATA ASAP1B_ETK KP_BLOB 0x3833D8 1 1 /end IF_DATA BIT_MASK 0xFF /end MEASUREMENT
/begin MEASUREMENT wkra_10_A "last und drehzahlabh. Adaptionskennfeld f. wkr" UBYTE zw_ub_qn0p75 0 0 -191.250000 0.000000 /begin IF_DATA ASAP1B_ETK KP_BLOB 0x383375 1 1 /end IF_DATA BIT_MASK 0xFF /end MEASUREMENT
/begin MEASUREMENT wkra_110_A "last und drehzahlabh. Adaptionskennfeld f. wkr" UBYTE zw_ub_qn0p75 0 0 -191.250000 0.000000 /begin IF_DATA ASAP1B_ETK KP_BLOB 0x3833D9 1 1 /end IF_DATA BIT_MASK 0xFF /end MEASUREMENT
/begin MEASUREMENT wkra_111_A "last und drehzahlabh. Adaptionskennfeld f. wkr" UBYTE zw_ub_qn0p75 0 0 -191.250000 0.000000 /begin IF_DATA ASAP1B_ETK KP_BLOB 0x3833DA 1 1 /end IF_DATA BIT_MASK 0xFF /end MEASUREMENT
/begin MEASUREMENT wkra_112_A "last und drehzahlabh. Adaptionskennfeld f. wkr" UBYTE zw_ub_qn0p75 0 0 -191.250000 0.000000 /begin IF_DATA ASAP1B_ETK KP_BLOB 0x3833DB 1 1 /end IF_DATA BIT_MASK 0xFF /end MEASUREMENT
/begin MEASUREMENT wkra_113_A "last und drehzahlabh. Adaptionskennfeld f. wkr" UBYTE zw_ub_qn0p75 0 0 -191.250000 0.000000 /begin IF_DATA ASAP1B_ETK KP_BLOB 0x3833DC 1 1 /end IF_DATA BIT_MASK 0xFF /end MEASUREMENT
/begin MEASUREMENT wkra_114_A "last und drehzahlabh. Adaptionskennfeld f. wkr" UBYTE zw_ub_qn0p75 0 0 -191.250000 0.000000 /begin IF_DATA ASAP1B_ETK KP_BLOB 0x3833DD 1 1 /end IF_DATA BIT_MASK 0xFF /end MEASUREMENT
/begin MEASUREMENT wkra_115_A "last und drehzahlabh. Adaptionskennfeld f. wkr" UBYTE zw_ub_qn0p75 0 0 -191.250000 0.000000 /begin IF_DATA ASAP1B_ETK KP_BLOB 0x3833DE 1 1 /end IF_DATA BIT_MASK 0xFF /end MEASUREMENT
/begin MEASUREMENT wkra_116_A "last und drehzahlabh. Adaptionskennfeld f. wkr" UBYTE zw_ub_qn0p75 0 0 -191.250000 0.000000 /begin IF_DATA ASAP1B_ETK KP_BLOB 0x3833DF 1 1 /end IF_DATA BIT_MASK 0xFF /end MEASUREMENT
/begin MEASUREMENT wkra_117_A "last und drehzahlabh. Adaptionskennfeld f. wkr" UBYTE zw_ub_qn0p75 0 0 -191.250000 0.000000 /begin IF_DATA ASAP1B_ETK KP_BLOB 0x3833E0 1 1 /end IF_DATA BIT_MASK 0xFF /end MEASUREMENT
/begin MEASUREMENT wkra_118_A "last und drehzahlabh. Adaptionskennfeld f. wkr" UBYTE zw_ub_qn0p75 0 0 -191.250000 0.000000 /begin IF_DATA ASAP1B_ETK KP_BLOB 0x3833E1 1 1 /end IF_DATA BIT_MASK 0xFF /end MEASUREMENT
/begin MEASUREMENT wkra_119_A "last und drehzahlabh. Adaptionskennfeld f. wkr" UBYTE zw_ub_qn0p75 0 0 -191.250000 0.000000 /begin IF_DATA ASAP1B_ETK KP_BLOB 0x3833E2 1 1 /end IF_DATA BIT_MASK 0xFF /end MEASUREMENT
/begin MEASUREMENT wkra_11_A "last und drehzahlabh. Adaptionskennfeld f. wkr" UBYTE zw_ub_qn0p75 0 0 -191.250000 0.000000 /begin IF_DATA ASAP1B_ETK KP_BLOB 0x383376 1 1 /end IF_DATA BIT_MASK 0xFF /end MEASUREMENT
/begin MEASUREMENT wkra_120_A "last und drehzahlabh. Adaptionskennfeld f. wkr" UBYTE zw_ub_qn0p75 0 0 -191.250000 0.000000 /begin IF_DATA ASAP1B_ETK KP_BLOB 0x3833E3 1 1 /end IF_DATA BIT_MASK 0xFF /end MEASUREMENT
/begin MEASUREMENT wkra_121_A "last und drehzahlabh. Adaptionskennfeld f. wkr" UBYTE zw_ub_qn0p75 0 0 -191.250000 0.000000 /begin IF_DATA ASAP1B_ETK KP_BLOB 0x3833E4 1 1 /end IF_DATA BIT_MASK 0xFF /end MEASUREMENT
/begin MEASUREMENT wkra_122_A "last und drehzahlabh. Adaptionskennfeld f. wkr" UBYTE zw_ub_qn0p75 0 0 -191.250000 0.000000 /begin IF_DATA ASAP1B_ETK KP_BLOB 0x3833E5 1 1 /end IF_DATA BIT_MASK 0xFF /end MEASUREMENT
/begin MEASUREMENT wkra_123_A "last und drehzahlabh. Adaptionskennfeld f. wkr" UBYTE zw_ub_qn0p75 0 0 -191.250000 0.000000 /begin IF_DATA ASAP1B_ETK KP_BLOB 0x3833E6 1 1 /end IF_DATA BIT_MASK 0xFF /end MEASUREMENT
/begin MEASUREMENT wkra_124_A "last und drehzahlabh. Adaptionskennfeld f. wkr" UBYTE zw_ub_qn0p75 0 0 -191.250000 0.000000 /begin IF_DATA ASAP1B_ETK KP_BLOB 0x3833E7 1 1 /end IF_DATA BIT_MASK 0xFF /end MEASUREMENT
/begin MEASUREMENT wkra_125_A "last und drehzahlabh. Adaptionskennfeld f. wkr" UBYTE zw_ub_qn0p75 0 0 -191.250000 0.000000 /begin IF_DATA ASAP1B_ETK KP_BLOB 0x3833E8 1 1 /end IF_DATA BIT_MASK 0xFF /end MEASUREMENT
/begin MEASUREMENT wkra_126_A "last und drehzahlabh. Adaptionskennfeld f. wkr" UBYTE zw_ub_qn0p75 0 0 -191.250000 0.000000 /begin IF_DATA ASAP1B_ETK KP_BLOB 0x3833E9 1 1 /end IF_DATA BIT_MASK 0xFF /end MEASUREMENT
/begin MEASUREMENT wkra_127_A "last und drehzahlabh. Adaptionskennfeld f. wkr" UBYTE zw_ub_qn0p75 0 0 -191.250000 0.000000 /begin IF_DATA ASAP1B_ETK KP_BLOB 0x3833EA 1 1 /end IF_DATA BIT_MASK 0xFF /end MEASUREMENT
/begin MEASUREMENT wkra_128_A "last und drehzahlabh. Adaptionskennfeld f. wkr" UBYTE zw_ub_qn0p75 0 0 -191.250000 0.000000 /begin IF_DATA ASAP1B_ETK KP_BLOB 0x3833EB 1 1 /end IF_DATA BIT_MASK 0xFF /end MEASUREMENT
/begin MEASUREMENT wkra_129_A "last und drehzahlabh. Adaptionskennfeld f. wkr" UBYTE zw_ub_qn0p75 0 0 -191.250000 0.000000 /begin IF_DATA ASAP1B_ETK KP_BLOB 0x3833EC 1 1 /end IF_DATA BIT_MASK 0xFF /end MEASUREMENT
/begin MEASUREMENT wkra_12_A "last und drehzahlabh. Adaptionskennfeld f. wkr" UBYTE zw_ub_qn0p75 0 0 -191.250000 0.000000 /begin IF_DATA ASAP1B_ETK KP_BLOB 0x383377 1 1 /end IF_DATA BIT_MASK 0xFF /end MEASUREMENT
/begin MEASUREMENT wkra_130_A "last und drehzahlabh. Adaptionskennfeld f. wkr" UBYTE zw_ub_qn0p75 0 0 -191.250000 0.000000 /begin IF_DATA ASAP1B_ETK KP_BLOB 0x3833ED 1 1 /end IF_DATA BIT_MASK 0xFF /end MEASUREMENT
/begin MEASUREMENT wkra_131_A "last und drehzahlabh. Adaptionskennfeld f. wkr" UBYTE zw_ub_qn0p75 0 0 -191.250000 0.000000 /begin IF_DATA ASAP1B_ETK KP_BLOB 0x3833EE 1 1 /end IF_DATA BIT_MASK 0xFF /end MEASUREMENT
/begin MEASUREMENT wkra_132_A "last und drehzahlabh. Adaptionskennfeld f. wkr" UBYTE zw_ub_qn0p75 0 0 -191.250000 0.000000 /begin IF_DATA ASAP1B_ETK KP_BLOB 0x3833EF 1 1 /end IF_DATA BIT_MASK 0xFF /end MEASUREMENT
/begin MEASUREMENT wkra_133_A "last und drehzahlabh. Adaptionskennfeld f. wkr" UBYTE zw_ub_qn0p75 0 0 -191.250000 0.000000 /begin IF_DATA ASAP1B_ETK KP_BLOB 0x3833F0 1 1 /end IF_DATA BIT_MASK 0xFF /end MEASUREMENT
/begin MEASUREMENT wkra_134_A "last und drehzahlabh. Adaptionskennfeld f. wkr" UBYTE zw_ub_qn0p75 0 0 -191.250000 0.000000 /begin IF_DATA ASAP1B_ETK KP_BLOB 0x3833F1 1 1 /end IF_DATA BIT_MASK 0xFF /end MEASUREMENT
/begin MEASUREMENT wkra_135_A "last und drehzahlabh. Adaptionskennfeld f. wkr" UBYTE zw_ub_qn0p75 0 0 -191.250000 0.000000 /begin IF_DATA ASAP1B_ETK KP_BLOB 0x3833F2 1 1 /end IF_DATA BIT_MASK 0xFF /end MEASUREMENT
/begin MEASUREMENT wkra_136_A "last und drehzahlabh. Adaptionskennfeld f. wkr" UBYTE zw_ub_qn0p75 0 0 -191.250000 0.000000 /begin IF_DATA ASAP1B_ETK KP_BLOB 0x3833F3 1 1 /end IF_DATA BIT_MASK 0xFF /end MEASUREMENT
/begin MEASUREMENT wkra_137_A "last und drehzahlabh. Adaptionskennfeld f. wkr" UBYTE zw_ub_qn0p75 0 0 -191.250000 0.000000 /begin IF_DATA ASAP1B_ETK KP_BLOB 0x3833F4 1 1 /end IF_DATA BIT_MASK 0xFF /end MEASUREMENT
/begin MEASUREMENT wkra_138_A "last und drehzahlabh. Adaptionskennfeld f. wkr" UBYTE zw_ub_qn0p75 0 0 -191.250000 0.000000 /begin IF_DATA ASAP1B_ETK KP_BLOB 0x3833F5 1 1 /end IF_DATA BIT_MASK 0xFF /end MEASUREMENT
/begin MEASUREMENT wkra_139_A "last und drehzahlabh. Adaptionskennfeld f. wkr" UBYTE zw_ub_qn0p75 0 0 -191.250000 0.000000 /begin IF_DATA ASAP1B_ETK KP_BLOB 0x3833F6 1 1 /end IF_DATA BIT_MASK 0xFF /end MEASUREMENT
/begin MEASUREMENT wkra_13_A "last und drehzahlabh. Adaptionskennfeld f. wkr" UBYTE zw_ub_qn0p75 0 0 -191.250000 0.000000 /begin IF_DATA ASAP1B_ETK KP_BLOB 0x383378 1 1 /end IF_DATA BIT_MASK 0xFF /end MEASUREMENT
/begin MEASUREMENT wkra_140_A "last und drehzahlabh. Adaptionskennfeld f. wkr" UBYTE zw_ub_qn0p75 0 0 -191.250000 0.000000 /begin IF_DATA ASAP1B_ETK KP_BLOB 0x3833F7 1 1 /end IF_DATA BIT_MASK 0xFF /end MEASUREMENT
/begin MEASUREMENT wkra_141_A "last und drehzahlabh. Adaptionskennfeld f. wkr" UBYTE zw_ub_qn0p75 0 0 -191.250000 0.000000 /begin IF_DATA ASAP1B_ETK KP_BLOB 0x3833F8 1 1 /end IF_DATA BIT_MASK 0xFF /end MEASUREMENT
/begin MEASUREMENT wkra_142_A "last und drehzahlabh. Adaptionskennfeld f. wkr" UBYTE zw_ub_qn0p75 0 0 -191.250000 0.000000 /begin IF_DATA ASAP1B_ETK KP_BLOB 0x3833F9 1 1 /end IF_DATA BIT_MASK 0xFF /end MEASUREMENT
/begin MEASUREMENT wkra_143_A "last und drehzahlabh. Adaptionskennfeld f. wkr" UBYTE zw_ub_qn0p75 0 0 -191.250000 0.000000 /begin IF_DATA ASAP1B_ETK KP_BLOB 0x3833FA 1 1 /end IF_DATA BIT_MASK 0xFF /end MEASUREMENT
/begin MEASUREMENT wkra_144_A "last und drehzahlabh. Adaptionskennfeld f. wkr" UBYTE zw_ub_qn0p75 0 0 -191.250000 0.000000 /begin IF_DATA ASAP1B_ETK KP_BLOB 0x3833FB 1 1 /end IF_DATA BIT_MASK 0xFF /end MEASUREMENT
/begin MEASUREMENT wkra_145_A "last und drehzahlabh. Adaptionskennfeld f. wkr" UBYTE zw_ub_qn0p75 0 0 -191.250000 0.000000 /begin IF_DATA ASAP1B_ETK KP_BLOB 0x3833FC 1 1 /end IF_DATA BIT_MASK 0xFF /end MEASUREMENT
/begin MEASUREMENT wkra_146_A "last und drehzahlabh. Adaptionskennfeld f. wkr" UBYTE zw_ub_qn0p75 0 0 -191.250000 0.000000 /begin IF_DATA ASAP1B_ETK KP_BLOB 0x3833FD 1 1 /end IF_DATA BIT_MASK 0xFF /end MEASUREMENT
/begin MEASUREMENT wkra_147_A "last und drehzahlabh. Adaptionskennfeld f. wkr" UBYTE zw_ub_qn0p75 0 0 -191.250000 0.000000 /begin IF_DATA ASAP1B_ETK KP_BLOB 0x3833FE 1 1 /end IF_DATA BIT_MASK 0xFF /end MEASUREMENT
/begin MEASUREMENT wkra_148_A "last und drehzahlabh. Adaptionskennfeld f. wkr" UBYTE zw_ub_qn0p75 0 0 -191.250000 0.000000 /begin IF_DATA ASAP1B_ETK KP_BLOB 0x3833FF 1 1 /end IF_DATA BIT_MASK 0xFF /end MEASUREMENT
/begin MEASUREMENT wkra_149_A "last und drehzahlabh. Adaptionskennfeld f. wkr" UBYTE zw_ub_qn0p75 0 0 -191.250000 0.000000 /begin IF_DATA ASAP1B_ETK KP_BLOB 0x383400 1 1 /end IF_DATA BIT_MASK 0xFF /end MEASUREMENT
/begin MEASUREMENT wkra_14_A "last und drehzahlabh. Adaptionskennfeld f. wkr" UBYTE zw_ub_qn0p75 0 0 -191.250000 0.000000 /begin IF_DATA ASAP1B_ETK KP_BLOB 0x383379 1 1 /end IF_DATA BIT_MASK 0xFF /end MEASUREMENT
/begin MEASUREMENT wkra_150_A "last und drehzahlabh. Adaptionskennfeld f. wkr" UBYTE zw_ub_qn0p75 0 0 -191.250000 0.000000 /begin IF_DATA ASAP1B_ETK KP_BLOB 0x383401 1 1 /end IF_DATA BIT_MASK 0xFF /end MEASUREMENT
/begin MEASUREMENT wkra_151_A "last und drehzahlabh. Adaptionskennfeld f. wkr" UBYTE zw_ub_qn0p75 0 0 -191.250000 0.000000 /begin IF_DATA ASAP1B_ETK KP_BLOB 0x383402 1 1 /end IF_DATA BIT_MASK 0xFF /end MEASUREMENT
/begin MEASUREMENT wkra_152_A "last und drehzahlabh. Adaptionskennfeld f. wkr" UBYTE zw_ub_qn0p75 0 0 -191.250000 0.000000 /begin IF_DATA ASAP1B_ETK KP_BLOB 0x383403 1 1 /end IF_DATA BIT_MASK 0xFF /end MEASUREMENT
/begin MEASUREMENT wkra_153_A "last und drehzahlabh. Adaptionskennfeld f. wkr" UBYTE zw_ub_qn0p75 0 0 -191.250000 0.000000 /begin IF_DATA ASAP1B_ETK KP_BLOB 0x383404 1 1 /end IF_DATA BIT_MASK 0xFF /end MEASUREMENT
/begin MEASUREMENT wkra_154_A "last und drehzahlabh. Adaptionskennfeld f. wkr" UBYTE zw_ub_qn0p75 0 0 -191.250000 0.000000 /begin IF_DATA ASAP1B_ETK KP_BLOB 0x383405 1 1 /end IF_DATA BIT_MASK 0xFF /end MEASUREMENT
/begin MEASUREMENT wkra_155_A "last und drehzahlabh. Adaptionskennfeld f. wkr" UBYTE zw_ub_qn0p75 0 0 -191.250000 0.000000 /begin IF_DATA ASAP1B_ETK KP_BLOB 0x383406 1 1 /end IF_DATA BIT_MASK 0xFF /end MEASUREMENT
/begin MEASUREMENT wkra_156_A "last und drehzahlabh. Adaptionskennfeld f. wkr" UBYTE zw_ub_qn0p75 0 0 -191.250000 0.000000 /begin IF_DATA ASAP1B_ETK KP_BLOB 0x383407 1 1 /end IF_DATA BIT_MASK 0xFF /end MEASUREMENT
/begin MEASUREMENT wkra_157_A "last und drehzahlabh. Adaptionskennfeld f. wkr" UBYTE zw_ub_qn0p75 0 0 -191.250000 0.000000 /begin IF_DATA ASAP1B_ETK KP_BLOB 0x383408 1 1 /end IF_DATA BIT_MASK 0xFF /end MEASUREMENT
/begin MEASUREMENT wkra_158_A "last und drehzahlabh. Adaptionskennfeld f. wkr" UBYTE zw_ub_qn0p75 0 0 -191.250000 0.000000 /begin IF_DATA ASAP1B_ETK KP_BLOB 0x383409 1 1 /end IF_DATA BIT_MASK 0xFF /end MEASUREMENT
/begin MEASUREMENT wkra_159_A "last und drehzahlabh. Adaptionskennfeld f. wkr" UBYTE zw_ub_qn0p75 0 0 -191.250000 0.000000 /begin IF_DATA ASAP1B_ETK KP_BLOB 0x38340A 1 1 /end IF_DATA BIT_MASK 0xFF /end MEASUREMENT
/begin MEASUREMENT wkra_15_A "last und drehzahlabh. Adaptionskennfeld f. wkr" UBYTE zw_ub_qn0p75 0 0 -191.250000 0.000000 /begin IF_DATA ASAP1B_ETK KP_BLOB 0x38337A 1 1 /end IF_DATA BIT_MASK 0xFF /end MEASUREMENT
/begin MEASUREMENT wkra_16_A "last und drehzahlabh. Adaptionskennfeld f. wkr" UBYTE zw_ub_qn0p75 0 0 -191.250000 0.000000 /begin IF_DATA ASAP1B_ETK KP_BLOB 0x38337B 1 1 /end IF_DATA BIT_MASK 0xFF /end MEASUREMENT
/begin MEASUREMENT wkra_17_A "last und drehzahlabh. Adaptionskennfeld f. wkr" UBYTE zw_ub_qn0p75 0 0 -191.250000 0.000000 /begin IF_DATA ASAP1B_ETK KP_BLOB 0x38337C 1 1 /end IF_DATA BIT_MASK 0xFF /end MEASUREMENT
/begin MEASUREMENT wkra_18_A "last und drehzahlabh. Adaptionskennfeld f. wkr" UBYTE zw_ub_qn0p75 0 0 -191.250000 0.000000 /begin IF_DATA ASAP1B_ETK KP_BLOB 0x38337D 1 1 /end IF_DATA BIT_MASK 0xFF /end MEASUREMENT
/begin MEASUREMENT wkra_19_A "last und drehzahlabh. Adaptionskennfeld f. wkr" UBYTE zw_ub_qn0p75 0 0 -191.250000 0.000000 /begin IF_DATA ASAP1B_ETK KP_BLOB 0x38337E 1 1 /end IF_DATA BIT_MASK 0xFF /end MEASUREMENT
/begin MEASUREMENT wkra_1_A "last und drehzahlabh. Adaptionskennfeld f. wkr" UBYTE zw_ub_qn0p75 0 0 -191.250000 0.000000 /begin IF_DATA ASAP1B_ETK KP_BLOB 0x38336C 1 1 /end IF_DATA BIT_MASK 0xFF /end MEASUREMENT
/begin MEASUREMENT wkra_20_A "last und drehzahlabh. Adaptionskennfeld f. wkr" UBYTE zw_ub_qn0p75 0 0 -191.250000 0.000000 /begin IF_DATA ASAP1B_ETK KP_BLOB 0x38337F 1 1 /end IF_DATA BIT_MASK 0xFF /end MEASUREMENT
/begin MEASUREMENT wkra_21_A "last und drehzahlabh. Adaptionskennfeld f. wkr" UBYTE zw_ub_qn0p75 0 0 -191.250000 0.000000 /begin IF_DATA ASAP1B_ETK KP_BLOB 0x383380 1 1 /end IF_DATA BIT_MASK 0xFF /end MEASUREMENT
/begin MEASUREMENT wkra_22_A "last und drehzahlabh. Adaptionskennfeld f. wkr" UBYTE zw_ub_qn0p75 0 0 -191.250000 0.000000 /begin IF_DATA ASAP1B_ETK KP_BLOB 0x383381 1 1 /end IF_DATA BIT_MASK 0xFF /end MEASUREMENT
/begin MEASUREMENT wkra_23_A "last und drehzahlabh. Adaptionskennfeld f. wkr" UBYTE zw_ub_qn0p75 0 0 -191.250000 0.000000 /begin IF_DATA ASAP1B_ETK KP_BLOB 0x383382 1 1 /end IF_DATA BIT_MASK 0xFF /end MEASUREMENT
/begin MEASUREMENT wkra_24_A "last und drehzahlabh. Adaptionskennfeld f. wkr" UBYTE zw_ub_qn0p75 0 0 -191.250000 0.000000 /begin IF_DATA ASAP1B_ETK KP_BLOB 0x383383 1 1 /end IF_DATA BIT_MASK 0xFF /end MEASUREMENT
/begin MEASUREMENT wkra_25_A "last und drehzahlabh. Adaptionskennfeld f. wkr" UBYTE zw_ub_qn0p75 0 0 -191.250000 0.000000 /begin IF_DATA ASAP1B_ETK KP_BLOB 0x383384 1 1 /end IF_DATA BIT_MASK 0xFF /end MEASUREMENT
/begin MEASUREMENT wkra_26_A "last und drehzahlabh. Adaptionskennfeld f. wkr" UBYTE zw_ub_qn0p75 0 0 -191.250000 0.000000 /begin IF_DATA ASAP1B_ETK KP_BLOB 0x383385 1 1 /end IF_DATA BIT_MASK 0xFF /end MEASUREMENT
/begin MEASUREMENT wkra_27_A "last und drehzahlabh. Adaptionskennfeld f. wkr" UBYTE zw_ub_qn0p75 0 0 -191.250000 0.000000 /begin IF_DATA ASAP1B_ETK KP_BLOB 0x383386 1 1 /end IF_DATA BIT_MASK 0xFF /end MEASUREMENT
/begin MEASUREMENT wkra_28_A "last und drehzahlabh. Adaptionskennfeld f. wkr" UBYTE zw_ub_qn0p75 0 0 -191.250000 0.000000 /begin IF_DATA ASAP1B_ETK KP_BLOB 0x383387 1 1 /end IF_DATA BIT_MASK 0xFF /end MEASUREMENT
/begin MEASUREMENT wkra_29_A "last und drehzahlabh. Adaptionskennfeld f. wkr" UBYTE zw_ub_qn0p75 0 0 -191.250000 0.000000 /begin IF_DATA ASAP1B_ETK KP_BLOB 0x383388 1 1 /end IF_DATA BIT_MASK 0xFF /end MEASUREMENT
/begin MEASUREMENT wkra_2_A "last und drehzahlabh. Adaptionskennfeld f. wkr" UBYTE zw_ub_qn0p75 0 0 -191.250000 0.000000 /begin IF_DATA ASAP1B_ETK KP_BLOB 0x38336D 1 1 /end IF_DATA BIT_MASK 0xFF /end MEASUREMENT
/begin MEASUREMENT wkra_30_A "last und drehzahlabh. Adaptionskennfeld f. wkr" UBYTE zw_ub_qn0p75 0 0 -191.250000 0.000000 /begin IF_DATA ASAP1B_ETK KP_BLOB 0x383389 1 1 /end IF_DATA BIT_MASK 0xFF /end MEASUREMENT
/begin MEASUREMENT wkra_31_A "last und drehzahlabh. Adaptionskennfeld f. wkr" UBYTE zw_ub_qn0p75 0 0 -191.250000 0.000000 /begin IF_DATA ASAP1B_ETK KP_BLOB 0x38338A 1 1 /end IF_DATA BIT_MASK 0xFF /end MEASUREMENT
/begin MEASUREMENT wkra_32_A "last und drehzahlabh. Adaptionskennfeld f. wkr" UBYTE zw_ub_qn0p75 0 0 -191.250000 0.000000 /begin IF_DATA ASAP1B_ETK KP_BLOB 0x38338B 1 1 /end IF_DATA BIT_MASK 0xFF /end MEASUREMENT
/begin MEASUREMENT wkra_33_A "last und drehzahlabh. Adaptionskennfeld f. wkr" UBYTE zw_ub_qn0p75 0 0 -191.250000 0.000000 /begin IF_DATA ASAP1B_ETK KP_BLOB 0x38338C 1 1 /end IF_DATA BIT_MASK 0xFF /end MEASUREMENT
/begin MEASUREMENT wkra_34_A "last und drehzahlabh. Adaptionskennfeld f. wkr" UBYTE zw_ub_qn0p75 0 0 -191.250000 0.000000 /begin IF_DATA ASAP1B_ETK KP_BLOB 0x38338D 1 1 /end IF_DATA BIT_MASK 0xFF /end MEASUREMENT
/begin MEASUREMENT wkra_35_A "last und drehzahlabh. Adaptionskennfeld f. wkr" UBYTE zw_ub_qn0p75 0 0 -191.250000 0.000000 /begin IF_DATA ASAP1B_ETK KP_BLOB 0x38338E 1 1 /end IF_DATA BIT_MASK 0xFF /end MEASUREMENT
/begin MEASUREMENT wkra_36_A "last und drehzahlabh. Adaptionskennfeld f. wkr" UBYTE zw_ub_qn0p75 0 0 -191.250000 0.000000 /begin IF_DATA ASAP1B_ETK KP_BLOB 0x38338F 1 1 /end IF_DATA BIT_MASK 0xFF /end MEASUREMENT
/begin MEASUREMENT wkra_37_A "last und drehzahlabh. Adaptionskennfeld f. wkr" UBYTE zw_ub_qn0p75 0 0 -191.250000 0.000000 /begin IF_DATA ASAP1B_ETK KP_BLOB 0x383390 1 1 /end IF_DATA BIT_MASK 0xFF /end MEASUREMENT
/begin MEASUREMENT wkra_38_A "last und drehzahlabh. Adaptionskennfeld f. wkr" UBYTE zw_ub_qn0p75 0 0 -191.250000 0.000000 /begin IF_DATA ASAP1B_ETK KP_BLOB 0x383391 1 1 /end IF_DATA BIT_MASK 0xFF /end MEASUREMENT
/begin MEASUREMENT wkra_39_A "last und drehzahlabh. Adaptionskennfeld f. wkr" UBYTE zw_ub_qn0p75 0 0 -191.250000 0.000000 /begin IF_DATA ASAP1B_ETK KP_BLOB 0x383392 1 1 /end IF_DATA BIT_MASK 0xFF /end MEASUREMENT
/begin MEASUREMENT wkra_3_A "last und drehzahlabh. Adaptionskennfeld f. wkr" UBYTE zw_ub_qn0p75 0 0 -191.250000 0.000000 /begin IF_DATA ASAP1B_ETK KP_BLOB 0x38336E 1 1 /end IF_DATA BIT_MASK 0xFF /end MEASUREMENT
/begin MEASUREMENT wkra_40_A "last und drehzahlabh. Adaptionskennfeld f. wkr" UBYTE zw_ub_qn0p75 0 0 -191.250000 0.000000 /begin IF_DATA ASAP1B_ETK KP_BLOB 0x383393 1 1 /end IF_DATA BIT_MASK 0xFF /end MEASUREMENT
/begin MEASUREMENT wkra_41_A "last und drehzahlabh. Adaptionskennfeld f. wkr" UBYTE zw_ub_qn0p75 0 0 -191.250000 0.000000 /begin IF_DATA ASAP1B_ETK KP_BLOB 0x383394 1 1 /end IF_DATA BIT_MASK 0xFF /end MEASUREMENT
/begin MEASUREMENT wkra_42_A "last und drehzahlabh. Adaptionskennfeld f. wkr" UBYTE zw_ub_qn0p75 0 0 -191.250000 0.000000 /begin IF_DATA ASAP1B_ETK KP_BLOB 0x383395 1 1 /end IF_DATA BIT_MASK 0xFF /end MEASUREMENT
/begin MEASUREMENT wkra_43_A "last und drehzahlabh. Adaptionskennfeld f. wkr" UBYTE zw_ub_qn0p75 0 0 -191.250000 0.000000 /begin IF_DATA ASAP1B_ETK KP_BLOB 0x383396 1 1 /end IF_DATA BIT_MASK 0xFF /end MEASUREMENT
/begin MEASUREMENT wkra_44_A "last und drehzahlabh. Adaptionskennfeld f. wkr" UBYTE zw_ub_qn0p75 0 0 -191.250000 0.000000 /begin IF_DATA ASAP1B_ETK KP_BLOB 0x383397 1 1 /end IF_DATA BIT_MASK 0xFF /end MEASUREMENT
/begin MEASUREMENT wkra_45_A "last und drehzahlabh. Adaptionskennfeld f. wkr" UBYTE zw_ub_qn0p75 0 0 -191.250000 0.000000 /begin IF_DATA ASAP1B_ETK KP_BLOB 0x383398 1 1 /end IF_DATA BIT_MASK 0xFF /end MEASUREMENT
/begin MEASUREMENT wkra_46_A "last und drehzahlabh. Adaptionskennfeld f. wkr" UBYTE zw_ub_qn0p75 0 0 -191.250000 0.000000 /begin IF_DATA ASAP1B_ETK KP_BLOB 0x383399 1 1 /end IF_DATA BIT_MASK 0xFF /end MEASUREMENT
/begin MEASUREMENT wkra_47_A "last und drehzahlabh. Adaptionskennfeld f. wkr" UBYTE zw_ub_qn0p75 0 0 -191.250000 0.000000 /begin IF_DATA ASAP1B_ETK KP_BLOB 0x38339A 1 1 /end IF_DATA BIT_MASK 0xFF /end MEASUREMENT
/begin MEASUREMENT wkra_48_A "last und drehzahlabh. Adaptionskennfeld f. wkr" UBYTE zw_ub_qn0p75 0 0 -191.250000 0.000000 /begin IF_DATA ASAP1B_ETK KP_BLOB 0x38339B 1 1 /end IF_DATA BIT_MASK 0xFF /end MEASUREMENT
/begin MEASUREMENT wkra_49_A "last und drehzahlabh. Adaptionskennfeld f. wkr" UBYTE zw_ub_qn0p75 0 0 -191.250000 0.000000 /begin IF_DATA ASAP1B_ETK KP_BLOB 0x38339C 1 1 /end IF_DATA BIT_MASK 0xFF /end MEASUREMENT
/begin MEASUREMENT wkra_4_A "last und drehzahlabh. Adaptionskennfeld f. wkr" UBYTE zw_ub_qn0p75 0 0 -191.250000 0.000000 /begin IF_DATA ASAP1B_ETK KP_BLOB 0x38336F 1 1 /end IF_DATA BIT_MASK 0xFF /end MEASUREMENT
/begin MEASUREMENT wkra_50_A "last und drehzahlabh. Adaptionskennfeld f. wkr" UBYTE zw_ub_qn0p75 0 0 -191.250000 0.000000 /begin IF_DATA ASAP1B_ETK KP_BLOB 0x38339D 1 1 /end IF_DATA BIT_MASK 0xFF /end MEASUREMENT
/begin MEASUREMENT wkra_51_A "last und drehzahlabh. Adaptionskennfeld f. wkr" UBYTE zw_ub_qn0p75 0 0 -191.250000 0.000000 /begin IF_DATA ASAP1B_ETK KP_BLOB 0x38339E 1 1 /end IF_DATA BIT_MASK 0xFF /end MEASUREMENT
/begin MEASUREMENT wkra_52_A "last und drehzahlabh. Adaptionskennfeld f. wkr" UBYTE zw_ub_qn0p75 0 0 -191.250000 0.000000 /begin IF_DATA ASAP1B_ETK KP_BLOB 0x38339F 1 1 /end IF_DATA BIT_MASK 0xFF /end MEASUREMENT
/begin MEASUREMENT wkra_53_A "last und drehzahlabh. Adaptionskennfeld f. wkr" UBYTE zw_ub_qn0p75 0 0 -191.250000 0.000000 /begin IF_DATA ASAP1B_ETK KP_BLOB 0x3833A0 1 1 /end IF_DATA BIT_MASK 0xFF /end MEASUREMENT
/begin MEASUREMENT wkra_54_A "last und drehzahlabh. Adaptionskennfeld f. wkr" UBYTE zw_ub_qn0p75 0 0 -191.250000 0.000000 /begin IF_DATA ASAP1B_ETK KP_BLOB 0x3833A1 1 1 /end IF_DATA BIT_MASK 0xFF /end MEASUREMENT
/begin MEASUREMENT wkra_55_A "last und drehzahlabh. Adaptionskennfeld f. wkr" UBYTE zw_ub_qn0p75 0 0 -191.250000 0.000000 /begin IF_DATA ASAP1B_ETK KP_BLOB 0x3833A2 1 1 /end IF_DATA BIT_MASK 0xFF /end MEASUREMENT
/begin MEASUREMENT wkra_56_A "last und drehzahlabh. Adaptionskennfeld f. wkr" UBYTE zw_ub_qn0p75 0 0 -191.250000 0.000000 /begin IF_DATA ASAP1B_ETK KP_BLOB 0x3833A3 1 1 /end IF_DATA BIT_MASK 0xFF /end MEASUREMENT
/begin MEASUREMENT wkra_57_A "last und drehzahlabh. Adaptionskennfeld f. wkr" UBYTE zw_ub_qn0p75 0 0 -191.250000 0.000000 /begin IF_DATA ASAP1B_ETK KP_BLOB 0x3833A4 1 1 /end IF_DATA BIT_MASK 0xFF /end MEASUREMENT
/begin MEASUREMENT wkra_58_A "last und drehzahlabh. Adaptionskennfeld f. wkr" UBYTE zw_ub_qn0p75 0 0 -191.250000 0.000000 /begin IF_DATA ASAP1B_ETK KP_BLOB 0x3833A5 1 1 /end IF_DATA BIT_MASK 0xFF /end MEASUREMENT
/begin MEASUREMENT wkra_59_A "last und drehzahlabh. Adaptionskennfeld f. wkr" UBYTE zw_ub_qn0p75 0 0 -191.250000 0.000000 /begin IF_DATA ASAP1B_ETK KP_BLOB 0x3833A6 1 1 /end IF_DATA BIT_MASK 0xFF /end MEASUREMENT
/begin MEASUREMENT wkra_5_A "last und drehzahlabh. Adaptionskennfeld f. wkr" UBYTE zw_ub_qn0p75 0 0 -191.250000 0.000000 /begin IF_DATA ASAP1B_ETK KP_BLOB 0x383370 1 1 /end IF_DATA BIT_MASK 0xFF /end MEASUREMENT
/begin MEASUREMENT wkra_60_A "last und drehzahlabh. Adaptionskennfeld f. wkr" UBYTE zw_ub_qn0p75 0 0 -191.250000 0.000000 /begin IF_DATA ASAP1B_ETK KP_BLOB 0x3833A7 1 1 /end IF_DATA BIT_MASK 0xFF /end MEASUREMENT
/begin MEASUREMENT wkra_61_A "last und drehzahlabh. Adaptionskennfeld f. wkr" UBYTE zw_ub_qn0p75 0 0 -191.250000 0.000000 /begin IF_DATA ASAP1B_ETK KP_BLOB 0x3833A8 1 1 /end IF_DATA BIT_MASK 0xFF /end MEASUREMENT
/begin MEASUREMENT wkra_62_A "last und drehzahlabh. Adaptionskennfeld f. wkr" UBYTE zw_ub_qn0p75 0 0 -191.250000 0.000000 /begin IF_DATA ASAP1B_ETK KP_BLOB 0x3833A9 1 1 /end IF_DATA BIT_MASK 0xFF /end MEASUREMENT
/begin MEASUREMENT wkra_63_A "last und drehzahlabh. Adaptionskennfeld f. wkr" UBYTE zw_ub_qn0p75 0 0 -191.250000 0.000000 /begin IF_DATA ASAP1B_ETK KP_BLOB 0x3833AA 1 1 /end IF_DATA BIT_MASK 0xFF /end MEASUREMENT
/begin MEASUREMENT wkra_64_A "last und drehzahlabh. Adaptionskennfeld f. wkr" UBYTE zw_ub_qn0p75 0 0 -191.250000 0.000000 /begin IF_DATA ASAP1B_ETK KP_BLOB 0x3833AB 1 1 /end IF_DATA BIT_MASK 0xFF /end MEASUREMENT
/begin MEASUREMENT wkra_65_A "last und drehzahlabh. Adaptionskennfeld f. wkr" UBYTE zw_ub_qn0p75 0 0 -191.250000 0.000000 /begin IF_DATA ASAP1B_ETK KP_BLOB 0x3833AC 1 1 /end IF_DATA BIT_MASK 0xFF /end MEASUREMENT
/begin MEASUREMENT wkra_66_A "last und drehzahlabh. Adaptionskennfeld f. wkr" UBYTE zw_ub_qn0p75 0 0 -191.250000 0.000000 /begin IF_DATA ASAP1B_ETK KP_BLOB 0x3833AD 1 1 /end IF_DATA BIT_MASK 0xFF /end MEASUREMENT
/begin MEASUREMENT wkra_67_A "last und drehzahlabh. Adaptionskennfeld f. wkr" UBYTE zw_ub_qn0p75 0 0 -191.250000 0.000000 /begin IF_DATA ASAP1B_ETK KP_BLOB 0x3833AE 1 1 /end IF_DATA BIT_MASK 0xFF /end MEASUREMENT
/begin MEASUREMENT wkra_68_A "last und drehzahlabh. Adaptionskennfeld f. wkr" UBYTE zw_ub_qn0p75 0 0 -191.250000 0.000000 /begin IF_DATA ASAP1B_ETK KP_BLOB 0x3833AF 1 1 /end IF_DATA BIT_MASK 0xFF /end MEASUREMENT
/begin MEASUREMENT wkra_69_A "last und drehzahlabh. Adaptionskennfeld f. wkr" UBYTE zw_ub_qn0p75 0 0 -191.250000 0.000000 /begin IF_DATA ASAP1B_ETK KP_BLOB 0x3833B0 1 1 /end IF_DATA BIT_MASK 0xFF /end MEASUREMENT
/begin MEASUREMENT wkra_6_A "last und drehzahlabh. Adaptionskennfeld f. wkr" UBYTE zw_ub_qn0p75 0 0 -191.250000 0.000000 /begin IF_DATA ASAP1B_ETK KP_BLOB 0x383371 1 1 /end IF_DATA BIT_MASK 0xFF /end MEASUREMENT
/begin MEASUREMENT wkra_70_A "last und drehzahlabh. Adaptionskennfeld f. wkr" UBYTE zw_ub_qn0p75 0 0 -191.250000 0.000000 /begin IF_DATA ASAP1B_ETK KP_BLOB 0x3833B1 1 1 /end IF_DATA BIT_MASK 0xFF /end MEASUREMENT
/begin MEASUREMENT wkra_71_A "last und drehzahlabh. Adaptionskennfeld f. wkr" UBYTE zw_ub_qn0p75 0 0 -191.250000 0.000000 /begin IF_DATA ASAP1B_ETK KP_BLOB 0x3833B2 1 1 /end IF_DATA BIT_MASK 0xFF /end MEASUREMENT
/begin MEASUREMENT wkra_72_A "last und drehzahlabh. Adaptionskennfeld f. wkr" UBYTE zw_ub_qn0p75 0 0 -191.250000 0.000000 /begin IF_DATA ASAP1B_ETK KP_BLOB 0x3833B3 1 1 /end IF_DATA BIT_MASK 0xFF /end MEASUREMENT
/begin MEASUREMENT wkra_73_A "last und drehzahlabh. Adaptionskennfeld f. wkr" UBYTE zw_ub_qn0p75 0 0 -191.250000 0.000000 /begin IF_DATA ASAP1B_ETK KP_BLOB 0x3833B4 1 1 /end IF_DATA BIT_MASK 0xFF /end MEASUREMENT
/begin MEASUREMENT wkra_74_A "last und drehzahlabh. Adaptionskennfeld f. wkr" UBYTE zw_ub_qn0p75 0 0 -191.250000 0.000000 /begin IF_DATA ASAP1B_ETK KP_BLOB 0x3833B5 1 1 /end IF_DATA BIT_MASK 0xFF /end MEASUREMENT
/begin MEASUREMENT wkra_75_A "last und drehzahlabh. Adaptionskennfeld f. wkr" UBYTE zw_ub_qn0p75 0 0 -191.250000 0.000000 /begin IF_DATA ASAP1B_ETK KP_BLOB 0x3833B6 1 1 /end IF_DATA BIT_MASK 0xFF /end MEASUREMENT
/begin MEASUREMENT wkra_76_A "last und drehzahlabh. Adaptionskennfeld f. wkr" UBYTE zw_ub_qn0p75 0 0 -191.250000 0.000000 /begin IF_DATA ASAP1B_ETK KP_BLOB 0x3833B7 1 1 /end IF_DATA BIT_MASK 0xFF /end MEASUREMENT
/begin MEASUREMENT wkra_77_A "last und drehzahlabh. Adaptionskennfeld f. wkr" UBYTE zw_ub_qn0p75 0 0 -191.250000 0.000000 /begin IF_DATA ASAP1B_ETK KP_BLOB 0x3833B8 1 1 /end IF_DATA BIT_MASK 0xFF /end MEASUREMENT
/begin MEASUREMENT wkra_78_A "last und drehzahlabh. Adaptionskennfeld f. wkr" UBYTE zw_ub_qn0p75 0 0 -191.250000 0.000000 /begin IF_DATA ASAP1B_ETK KP_BLOB 0x3833B9 1 1 /end IF_DATA BIT_MASK 0xFF /end MEASUREMENT
/begin MEASUREMENT wkra_79_A "last und drehzahlabh. Adaptionskennfeld f. wkr" UBYTE zw_ub_qn0p75 0 0 -191.250000 0.000000 /begin IF_DATA ASAP1B_ETK KP_BLOB 0x3833BA 1 1 /end IF_DATA BIT_MASK 0xFF /end MEASUREMENT
/begin MEASUREMENT wkra_7_A "last und drehzahlabh. Adaptionskennfeld f. wkr" UBYTE zw_ub_qn0p75 0 0 -191.250000 0.000000 /begin IF_DATA ASAP1B_ETK KP_BLOB 0x383372 1 1 /end IF_DATA BIT_MASK 0xFF /end MEASUREMENT
/begin MEASUREMENT wkra_80_A "last und drehzahlabh. Adaptionskennfeld f. wkr" UBYTE zw_ub_qn0p75 0 0 -191.250000 0.000000 /begin IF_DATA ASAP1B_ETK KP_BLOB 0x3833BB 1 1 /end IF_DATA BIT_MASK 0xFF /end MEASUREMENT
/begin MEASUREMENT wkra_81_A "last und drehzahlabh. Adaptionskennfeld f. wkr" UBYTE zw_ub_qn0p75 0 0 -191.250000 0.000000 /begin IF_DATA ASAP1B_ETK KP_BLOB 0x3833BC 1 1 /end IF_DATA BIT_MASK 0xFF /end MEASUREMENT
/begin MEASUREMENT wkra_82_A "last und drehzahlabh. Adaptionskennfeld f. wkr" UBYTE zw_ub_qn0p75 0 0 -191.250000 0.000000 /begin IF_DATA ASAP1B_ETK KP_BLOB 0x3833BD 1 1 /end IF_DATA BIT_MASK 0xFF /end MEASUREMENT
/begin MEASUREMENT wkra_83_A "last und drehzahlabh. Adaptionskennfeld f. wkr" UBYTE zw_ub_qn0p75 0 0 -191.250000 0.000000 /begin IF_DATA ASAP1B_ETK KP_BLOB 0x3833BE 1 1 /end IF_DATA BIT_MASK 0xFF /end MEASUREMENT
/begin MEASUREMENT wkra_84_A "last und drehzahlabh. Adaptionskennfeld f. wkr" UBYTE zw_ub_qn0p75 0 0 -191.250000 0.000000 /begin IF_DATA ASAP1B_ETK KP_BLOB 0x3833BF 1 1 /end IF_DATA BIT_MASK 0xFF /end MEASUREMENT
/begin MEASUREMENT wkra_85_A "last und drehzahlabh. Adaptionskennfeld f. wkr" UBYTE zw_ub_qn0p75 0 0 -191.250000 0.000000 /begin IF_DATA ASAP1B_ETK KP_BLOB 0x3833C0 1 1 /end IF_DATA BIT_MASK 0xFF /end MEASUREMENT
/begin MEASUREMENT wkra_86_A "last und drehzahlabh. Adaptionskennfeld f. wkr" UBYTE zw_ub_qn0p75 0 0 -191.250000 0.000000 /begin IF_DATA ASAP1B_ETK KP_BLOB 0x3833C1 1 1 /end IF_DATA BIT_MASK 0xFF /end MEASUREMENT
/begin MEASUREMENT wkra_87_A "last und drehzahlabh. Adaptionskennfeld f. wkr" UBYTE zw_ub_qn0p75 0 0 -191.250000 0.000000 /begin IF_DATA ASAP1B_ETK KP_BLOB 0x3833C2 1 1 /end IF_DATA BIT_MASK 0xFF /end MEASUREMENT
/begin MEASUREMENT wkra_88_A "last und drehzahlabh. Adaptionskennfeld f. wkr" UBYTE zw_ub_qn0p75 0 0 -191.250000 0.000000 /begin IF_DATA ASAP1B_ETK KP_BLOB 0x3833C3 1 1 /end IF_DATA BIT_MASK 0xFF /end MEASUREMENT
/begin MEASUREMENT wkra_89_A "last und drehzahlabh. Adaptionskennfeld f. wkr" UBYTE zw_ub_qn0p75 0 0 -191.250000 0.000000 /begin IF_DATA ASAP1B_ETK KP_BLOB 0x3833C4 1 1 /end IF_DATA BIT_MASK 0xFF /end MEASUREMENT
/begin MEASUREMENT wkra_8_A "last und drehzahlabh. Adaptionskennfeld f. wkr" UBYTE zw_ub_qn0p75 0 0 -191.250000 0.000000 /begin IF_DATA ASAP1B_ETK KP_BLOB 0x383373 1 1 /end IF_DATA BIT_MASK 0xFF /end MEASUREMENT
/begin MEASUREMENT wkra_90_A "last und drehzahlabh. Adaptionskennfeld f. wkr" UBYTE zw_ub_qn0p75 0 0 -191.250000 0.000000 /begin IF_DATA ASAP1B_ETK KP_BLOB 0x3833C5 1 1 /end IF_DATA BIT_MASK 0xFF /end MEASUREMENT
/begin MEASUREMENT wkra_91_A "last und drehzahlabh. Adaptionskennfeld f. wkr" UBYTE zw_ub_qn0p75 0 0 -191.250000 0.000000 /begin IF_DATA ASAP1B_ETK KP_BLOB 0x3833C6 1 1 /end IF_DATA BIT_MASK 0xFF /end MEASUREMENT
/begin MEASUREMENT wkra_92_A "last und drehzahlabh. Adaptionskennfeld f. wkr" UBYTE zw_ub_qn0p75 0 0 -191.250000 0.000000 /begin IF_DATA ASAP1B_ETK KP_BLOB 0x3833C7 1 1 /end IF_DATA BIT_MASK 0xFF /end MEASUREMENT
/begin MEASUREMENT wkra_93_A "last und drehzahlabh. Adaptionskennfeld f. wkr" UBYTE zw_ub_qn0p75 0 0 -191.250000 0.000000 /begin IF_DATA ASAP1B_ETK KP_BLOB 0x3833C8 1 1 /end IF_DATA BIT_MASK 0xFF /end MEASUREMENT
/begin MEASUREMENT wkra_94_A "last und drehzahlabh. Adaptionskennfeld f. wkr" UBYTE zw_ub_qn0p75 0 0 -191.250000 0.000000 /begin IF_DATA ASAP1B_ETK KP_BLOB 0x3833C9 1 1 /end IF_DATA BIT_MASK 0xFF /end MEASUREMENT
/begin MEASUREMENT wkra_95_A "last und drehzahlabh. Adaptionskennfeld f. wkr" UBYTE zw_ub_qn0p75 0 0 -191.250000 0.000000 /begin IF_DATA ASAP1B_ETK KP_BLOB 0x3833CA 1 1 /end IF_DATA BIT_MASK 0xFF /end MEASUREMENT
/begin MEASUREMENT wkra_96_A "last und drehzahlabh. Adaptionskennfeld f. wkr" UBYTE zw_ub_qn0p75 0 0 -191.250000 0.000000 /begin IF_DATA ASAP1B_ETK KP_BLOB 0x3833CB 1 1 /end IF_DATA BIT_MASK 0xFF /end MEASUREMENT
/begin MEASUREMENT wkra_97_A "last und drehzahlabh. Adaptionskennfeld f. wkr" UBYTE zw_ub_qn0p75 0 0 -191.250000 0.000000 /begin IF_DATA ASAP1B_ETK KP_BLOB 0x3833CC 1 1 /end IF_DATA BIT_MASK 0xFF /end MEASUREMENT
/begin MEASUREMENT wkra_98_A "last und drehzahlabh. Adaptionskennfeld f. wkr" UBYTE zw_ub_qn0p75 0 0 -191.250000 0.000000 /begin IF_DATA ASAP1B_ETK KP_BLOB 0x3833CD 1 1 /end IF_DATA BIT_MASK 0xFF /end MEASUREMENT
/begin MEASUREMENT wkra_99_A "last und drehzahlabh. Adaptionskennfeld f. wkr" UBYTE zw_ub_qn0p75 0 0 -191.250000 0.000000 /begin IF_DATA ASAP1B_ETK KP_BLOB 0x3833CE 1 1 /end IF_DATA BIT_MASK 0xFF /end MEASUREMENT
/begin MEASUREMENT wkra_9_A "last und drehzahlabh. Adaptionskennfeld f. wkr" UBYTE zw_ub_qn0p75 0 0 -191.250000 0.000000 /begin IF_DATA ASAP1B_ETK KP_BLOB 0x383374 1 1 /end IF_DATA BIT_MASK 0xFF /end MEASUREMENT
/begin MEASUREMENT wkrm "Mittleres wkr ueber alle Zylinder" UBYTE zw_ub_qn0p75 0 0 -191.250000 0.000000 /begin IF_DATA ASAP1B_ETK KP_BLOB 0xF9C2 0 1 /end IF_DATA BIT_MASK 0xFF /end MEASUREMENT
/begin MEASUREMENT wkrma "Mittelwert der ZW-SpÑtverstellungen KR, allgemein (im Notlauf mit Sicherheit)" UBYTE zw_ub_qn0p75 0 0 -191.250000 0.000000 /begin IF_DATA ASAP1B_ETK KP_BLOB 0xF9C3 0 1 /end IF_DATA BIT_MASK 0xFF /end MEASUREMENT
/begin MEASUREMENT wkr_0_A "zylinderindividuelle ZÅndwinkelspÑtverstellung KR" UBYTE zw_ub_qn0p75 0 0 -191.250000 0.000000 /begin IF_DATA ASAP1B_ETK KP_BLOB 0xF9BA 0 1 /end IF_DATA BIT_MASK 0xFF /end MEASUREMENT
/begin MEASUREMENT wkr_1_A "zylinderindividuelle ZÅndwinkelspÑtverstellung KR" UBYTE zw_ub_qn0p75 0 0 -191.250000 0.000000 /begin IF_DATA ASAP1B_ETK KP_BLOB 0xF9BB 0 1 /end IF_DATA BIT_MASK 0xFF /end MEASUREMENT
/begin MEASUREMENT wkr_2_A "zylinderindividuelle ZÅndwinkelspÑtverstellung KR" UBYTE zw_ub_qn0p75 0 0 -191.250000 0.000000 /begin IF_DATA ASAP1B_ETK KP_BLOB 0xF9BC 0 1 /end IF_DATA BIT_MASK 0xFF /end MEASUREMENT
/begin MEASUREMENT wkr_3_A "zylinderindividuelle ZÅndwinkelspÑtverstellung KR" UBYTE zw_ub_qn0p75 0 0 -191.250000 0.000000 /begin IF_DATA ASAP1B_ETK KP_BLOB 0xF9BD 0 1 /end IF_DATA BIT_MASK 0xFF /end MEASUREMENT
/begin MEASUREMENT wkr_4_A "zylinderindividuelle ZÅndwinkelspÑtverstellung KR" UBYTE zw_ub_qn0p75 0 0 -191.250000 0.000000 /begin IF_DATA ASAP1B_ETK KP_BLOB 0xF9BE 0 1 /end IF_DATA BIT_MASK 0xFF /end MEASUREMENT
/begin MEASUREMENT wkr_5_A "zylinderindividuelle ZÅndwinkelspÑtverstellung KR" UBYTE zw_ub_qn0p75 0 0 -191.250000 0.000000 /begin IF_DATA ASAP1B_ETK KP_BLOB 0xF9BF 0 1 /end IF_DATA BIT_MASK 0xFF /end MEASUREMENT
/begin MEASUREMENT wkr_6_A "zylinderindividuelle ZÅndwinkelspÑtverstellung KR" UBYTE zw_ub_qn0p75 0 0 -191.250000 0.000000 /begin IF_DATA ASAP1B_ETK KP_BLOB 0xF9C0 0 1 /end IF_DATA BIT_MASK 0xFF /end MEASUREMENT
/begin MEASUREMENT wkr_7_A "zylinderindividuelle ZÅndwinkelspÑtverstellung KR" UBYTE zw_ub_qn0p75 0 0 -191.250000 0.000000 /begin IF_DATA ASAP1B_ETK KP_BLOB 0xF9C1 0 1 /end IF_DATA BIT_MASK 0xFF /end MEASUREMENT
/begin MEASUREMENT wkr_tst "zyl.ind. ZW-SpÑtverstellung, rollierend" UBYTE zw_ub_qn0p75 0 0 -191.250000 0.000000 /begin IF_DATA ASAP1B_ETK KP_BLOB 0x380BD4 1 1 /end IF_DATA BIT_MASK 0xFF /end MEASUREMENT
/begin MEASUREMENT zhll "ZeitzÑhler fÅr Hei·leerlauf" UBYTE t1sxs_ub_b255 0 0 0.000000 255.000000 /begin IF_DATA ASAP1B_ETK KP_BLOB 0x383CB4 1 1 /end IF_DATA BIT_MASK 0xFF /end MEASUREMENT
/begin MEASUREMENT zkrvf_0_A "ZÑhler bestimmt die Frequenz der zylinderindividuellen ZÅndwinkelfrÅhverstellung" UBYTE dez 0 0 0.000000 255.000000 /begin IF_DATA ASAP1B_ETK KP_BLOB 0x380BD5 1 1 /end IF_DATA BIT_MASK 0xFF /end MEASUREMENT
/begin MEASUREMENT zkrvf_1_A "ZÑhler bestimmt die Frequenz der zylinderindividuellen ZÅndwinkelfrÅhverstellung" UBYTE dez 0 0 0.000000 255.000000 /begin IF_DATA ASAP1B_ETK KP_BLOB 0x380BD6 1 1 /end IF_DATA BIT_MASK 0xFF /end MEASUREMENT
/begin MEASUREMENT zkrvf_2_A "ZÑhler bestimmt die Frequenz der zylinderindividuellen ZÅndwinkelfrÅhverstellung" UBYTE dez 0 0 0.000000 255.000000 /begin IF_DATA ASAP1B_ETK KP_BLOB 0x380BD7 1 1 /end IF_DATA BIT_MASK 0xFF /end MEASUREMENT
/begin MEASUREMENT zkrvf_3_A "ZÑhler bestimmt die Frequenz der zylinderindividuellen ZÅndwinkelfrÅhverstellung" UBYTE dez 0 0 0.000000 255.000000 /begin IF_DATA ASAP1B_ETK KP_BLOB 0x380BD8 1 1 /end IF_DATA BIT_MASK 0xFF /end MEASUREMENT
/begin MEASUREMENT zkrvf_4_A "ZÑhler bestimmt die Frequenz der zylinderindividuellen ZÅndwinkelfrÅhverstellung" UBYTE dez 0 0 0.000000 255.000000 /begin IF_DATA ASAP1B_ETK KP_BLOB 0x380BD9 1 1 /end IF_DATA BIT_MASK 0xFF /end MEASUREMENT
/begin MEASUREMENT zkrvf_5_A "ZÑhler bestimmt die Frequenz der zylinderindividuellen ZÅndwinkelfrÅhverstellung" UBYTE dez 0 0 0.000000 255.000000 /begin IF_DATA ASAP1B_ETK KP_BLOB 0x380BDA 1 1 /end IF_DATA BIT_MASK 0xFF /end MEASUREMENT
/begin MEASUREMENT zkrvf_6_A "ZÑhler bestimmt die Frequenz der zylinderindividuellen ZÅndwinkelfrÅhverstellung" UBYTE dez 0 0 0.000000 255.000000 /begin IF_DATA ASAP1B_ETK KP_BLOB 0x380BDB 1 1 /end IF_DATA BIT_MASK 0xFF /end MEASUREMENT
/begin MEASUREMENT zkrvf_7_A "ZÑhler bestimmt die Frequenz der zylinderindividuellen ZÅndwinkelfrÅhverstellung" UBYTE dez 0 0 0.000000 255.000000 /begin IF_DATA ASAP1B_ETK KP_BLOB 0x380BDC 1 1 /end IF_DATA BIT_MASK 0xFF /end MEASUREMENT
/begin MEASUREMENT zwgru "GrundzÅndwinkel" SBYTE zw_sb_q0p75 0 0 -96.000000 95.250000 /begin IF_DATA ASAP1B_ETK KP_BLOB 0x380D1F 1 1 /end IF_DATA BIT_MASK 0xFF /end MEASUREMENT
/begin MEASUREMENT zwkrafld "Bitmuster des zyl.ind. abgelegten B_zwkra" UBYTE dez 0 0 0.000000 255.000000 /begin IF_DATA ASAP1B_ETK KP_BLOB 0xF9F8 0 1 /end IF_DATA BIT_MASK 0xFF /end MEASUREMENT
/begin MEASUREMENT zwopt "optimaler ZÅndwinkel" SBYTE zw_sb_q0p75 0 0 -96.000000 95.250000 /begin IF_DATA ASAP1B_ETK KP_BLOB 0x380C47 1 1 /end IF_DATA BIT_MASK 0xFF /end MEASUREMENT
/begin MEASUREMENT zzylkr "ZylinderzÑhler fÅr die KR" UBYTE dez 0 0 0.000000 255.000000 /begin IF_DATA ASAP1B_ETK KP_BLOB 0xF9B4 0 1 /end IF_DATA BIT_MASK 0xFF /end MEASUREMENT
/begin FUNCTION KRKE "16.10     Klopferkennung"
 /begin REF_CHARACTERISTIC ZYRKR SRL03KRUB SNM16KRUB RKRMX2N RKRMX1N REFINI KSZA KRVST KRKFKS KRFTP3 KRFTP2 KRFTP1 KFKEF8 KFKEF7 KFKEF6 KFKEF5 KFKEF4 KFKEF3 KFKEF2 KFKEF1 FKENDY FKELDY CWREFI CWKRREF /end REF_CHARACTERISTIC
 /begin LOC_MEASUREMENT zzylkr vske vkr_tst vkr_7_A vkr_6_A vkr_5_A vkr_4_A vkr_3_A vkr_2_A vkr_1_A vkr_0_A virkr temp_b_wert rl rkr_tst rkr_7_A rkr_6_A rkr_5_A rkr_4_A rkr_3_A rkr_2_A rkr_1_A rkr_0_A rkrmx2w rkrmx1w rkrmx nmot ke_7_A ke_6_A ke_5_A ke_4_A ke_3_A ke_2_A ke_1_A ke_0_A kek_tst kek_7_A kek_6_A kek_5_A kek_4_A kek_3_A kek_2_A kek_1_A kek_0_A ikr_kek_wert ikr_7_A ikr_6_A ikr_5_A ikr_4_A ikr_3_A ikr_2_A ikr_1_A ikr_0_A ikrrkr_wert ikrme_7_A ikrme_6_A ikrme_5_A ikrme_4_A ikrme_3_A ikrme_2_A ikrme_1_A ikrme_0_A ikrma esst_srl03krub esst_snm16krub B_synph B_st B_krndy B_krldy B_kr B_kl B_dtpb B_dtp B_dntb B_dnt B_c95_g2 B_c95_g1 B_c95_g0 B_c95ks3 /end LOC_MEASUREMENT
/end FUNCTION
/begin FUNCTION KRRA "15.80     Klopfregelung mit Adaption der zylinderindividuellen SpÑtverstellung"
 /begin REF_CHARACTERISTIC WKRLZOF TMKRAS TMKRA TMKR SNM16KRUB SENZZYL0 NKRMAX NKRF NKRAMIN NKRAMAX LZFUER LZB2 LZB1 LKRN LKRAN KSZA KRVFSN KRVFN KRNLZ KRMXN KRFKN KRDWSN KRDWSA KRDWKLA KRDWAA KRDWA KRANH KRAN4 KRAN3 KRAN2 KRAN1 KRALH KRAL3N KRAL2N KRAL1N DWKRMSN CWKRNLR /end REF_CHARACTERISTIC
 /begin LOC_MEASUREMENT zzylkr zwkrafld zkrvf_7_A zkrvf_6_A zkrvf_5_A zkrvf_4_A zkrvf_3_A zkrvf_2_A zkrvf_1_A zkrvf_0_A wkr_tst wkr_7_A wkr_6_A wkr_5_A wkr_4_A wkr_3_A wkr_2_A wkr_1_A wkr_0_A wkrma wkrm wkra_9_A wkra_99_A wkra_98_A wkra_97_A wkra_96_A wkra_95_A wkra_94_A wkra_93_A wkra_92_A wkra_91_A wkra_90_A wkra_8_A wkra_89_A wkra_88_A wkra_87_A wkra_86_A wkra_85_A wkra_84_A wkra_83_A wkra_82_A wkra_81_A wkra_80_A wkra_7_A wkra_79_A wkra_78_A wkra_77_A wkra_76_A wkra_75_A wkra_74_A wkra_73_A wkra_72_A wkra_71_A wkra_70_A wkra_6_A wkra_69_A wkra_68_A wkra_67_A wkra_66_A wkra_65_A wkra_64_A wkra_63_A wkra_62_A wkra_61_A wkra_60_A wkra_5_A wkra_59_A wkra_58_A wkra_57_A wkra_56_A wkra_55_A wkra_54_A wkra_53_A wkra_52_A wkra_51_A wkra_50_A wkra_4_A wkra_49_A wkra_48_A wkra_47_A wkra_46_A wkra_45_A wkra_44_A wkra_43_A wkra_42_A wkra_41_A wkra_40_A wkra_3_A wkra_39_A wkra_38_A wkra_37_A wkra_36_A wkra_35_A wkra_34_A wkra_33_A wkra_32_A wkra_31_A wkra_30_A wkra_2_A wkra_29_A wkra_28_A wkra_27_A wkra_26_A wkra_25_A wkra_24_A wkra_23_A wkra_22_A wkra_21_A wkra_20_A wkra_1_A wkra_19_A wkra_18_A wkra_17_A wkra_16_A wkra_15_A wkra_159_A wkra_158_A wkra_157_A wkra_156_A wkra_155_A wkra_154_A wkra_153_A wkra_152_A wkra_151_A wkra_150_A wkra_14_A wkra_149_A wkra_148_A wkra_147_A wkra_146_A wkra_145_A wkra_144_A wkra_143_A wkra_142_A wkra_141_A wkra_140_A wkra_13_A wkra_139_A wkra_138_A wkra_137_A wkra_136_A wkra_135_A wkra_134_A wkra_133_A wkra_132_A wkra_131_A wkra_130_A wkra_12_A wkra_129_A wkra_128_A wkra_127_A wkra_126_A wkra_125_A wkra_124_A wkra_123_A wkra_122_A wkra_121_A wkra_120_A wkra_11_A wkra_119_A wkra_118_A wkra_117_A wkra_116_A wkra_115_A wkra_114_A wkra_113_A wkra_112_A wkra_111_A wkra_110_A wkra_10_A wkra_109_A wkra_108_A wkra_107_A wkra_106_A wkra_105_A wkra_104_A wkra_103_A wkra_102_A wkra_101_A wkra_100_A wkra_0_A wkratst wkraa_7_A wkraa_6_A wkraa_5_A wkraa_4_A wkraa_3_A wkraa_2_A wkraa_1_A wkraa_0_A vszwm vszwkr_7_A vszwkr_6_A vszwkr_5_A vszwkr_4_A vszwkr_3_A vszwkr_2_A vszwkr_1_A vszwkr_0_A tmot stkrnx stkrlx rl nmot lzist_7_A lzist_6_A lzist_5_A lzist_4_A lzist_3_A lzist_2_A lzist_1_A lzist_0_A lkrw lkraw krvfw krvfsw krvfakt krmxw krfkw krdwsw kral3w kral2w kral1w esst_snm16krub dwkrz_7_A dwkrz_6_A dwkrz_5_A dwkrz_4_A dwkrz_3_A dwkrz_2_A dwkrz_1_A dwkrz_0_A dwkrmsw dwkr B_zwkrum B_zwkraa B_wkral B_vmax B_tmkr B_synph B_stend B_pwf B_nmax B_nldg B_llr B_kseb2 B_kseb1 B_krwa B_krnlr B_krnl B_krndyn B_krndy B_krlz B_krldyn B_krldya B_krldy B_krfrz B_krfdks B_krdws B_krafrz B_kra B_kr B_kl B_asr /end LOC_MEASUREMENT
/end FUNCTION
/begin FUNCTION KVA "41.30     Ausgangssignal: Kraftstoff-Verbrauchs-Anzeige" /begin REF_CHARACTERISTIC KVB KRKTE KD FKVA CWCKBI /end REF_CHARACTERISTIC
 /begin LOC_MEASUREMENT tkva_h tkvar tkvag_w tkvad tisum_w rk_w rkte_w kvakbi_w int_ctr B_tisum B_sa B_kvakbi /end LOC_MEASUREMENT
/end FUNCTION
/begin FUNCTION KWP2000F "" /begin LOC_MEASUREMENT nmot /end LOC_MEASUREMENT /end FUNCTION
/begin FUNCTION KWPDATR "" /end FUNCTION
/begin FUNCTION KWPDIAG "" /end FUNCTION
/begin FUNCTION KWPSTDA "" /begin LOC_MEASUREMENT ffzdfp FCMTab fcmEnd /end LOC_MEASUREMENT /end FUNCTION
/begin FUNCTION LAKH "4.20      Lambda-Koordination bei Katheizen"
 /begin REF_CHARACTERISTIC ZFLASKH LMSTMOT LASTMOT LASDSLA KFLMSKH KFLASKH KFLANSKH IMLLASKH /end REF_CHARACTERISTIC
 /begin LOC_MEASUREMENT tmst tmot rl nmot ml lmssl_w lmssl2_w lmskh_w laskh_w lasdsl_w lasdslg_w lasdslg2_w lanskh_w lamkh_w lamkhr_w lamkhr2_w lamkhg_w lamkhg2_w lamkh2_w imlpr fslsdyn fslpdyn fmsldyn flmsslkh flmssl flaskh flamsl_w flakh B_slsfz B_kh B_fasla B_dslafa B_dsla anztib_w /end LOC_MEASUREMENT
/end FUNCTION
/begin FUNCTION LAMBTS "4.10      Lambda Bauteileschutz"
 /begin REF_CHARACTERISTIC ZDLBTS TKATBTS TABGBTS SRL12GKUB SNM16GKUB KFLBTS KFFDLBTS FBSTABGM ETADZW DTBTS DLBTS CWLAMBTS /end REF_CHARACTERISTIC
 /begin LOC_MEASUREMENT zwopt zwgru tkatm_w tabgm_w rl nmot lbts_w lambts_w etazwist etazwim etazwg esst_srl12gkub esst_snm16gkub dzw_kge dzwg dlambts_w detazwbs B_tkatbts B_tabgbts B_gsaf B_fbstabgm B_dash /end LOC_MEASUREMENT
/end FUNCTION
/begin FUNCTION LAMFAW "7.10      Lambda Fahrerwunsch"
 /begin REF_CHARACTERISTIC ZKLAMKR TLAMFAS TLAFA LAMFAS LAMFA KFLAMKRL FLAMKRN DLAMOB DLAMKR /end REF_CHARACTERISTIC
 /begin LOC_MEASUREMENT wkrma rl nmot mrfa_w lamfa_w lamfaws_w lamfawkr_w fho dzwwl dzwlamfaw B_ldob B_lamfas B_kh /end LOC_MEASUREMENT
/end FUNCTION
/begin FUNCTION LAMKO "9.20      Lambdakoordination"
 /begin REF_CHARACTERISTIC STM12ESUB LASOAB LAMSOSUF LAMSOSOF LAMLGMTM LAMLGFSL LAMLGF CWLAMKH /end REF_CHARACTERISTIC
 /begin LOC_MEASUREMENT tmot lamvoa_w lams_w lamsubg_w lamsos_w lamsons_w lamsbg_w lamnswl_w lamlgm lamlash_w LAMKOBits lamkh_w lamkhe_w lamka_w lamfa_w lamelsh_w lamdkt_w lambts_w lambas flamsl_w flamkh esst_stm12esub B_slsfz B_sls B_ldef B_lamsdef B_lamnswl B_lamnse B_lamlash B_lamkh B_lamka B_lamdkt B_lambts B_lalgf B_kh B_fasla B_falsh B_dsla B_bevab /end LOC_MEASUREMENT
/end FUNCTION
/begin FUNCTION LDOB "31.10     LDR Overboost" /begin REF_CHARACTERISTIC TLDOBN TLDOBAN TABLDOBN SNM08LDUB KFLDRXO GWPLDOB ELDOB /end REF_CHARACTERISTIC
 /begin LOC_MEASUREMENT wped tans nmot lde esst_snm08ldub drlmaxo B_ldr B_ldobsp B_ldob B_kuppl /end LOC_MEASUREMENT
/end FUNCTION
/begin FUNCTION LDRLMX "3.30      Berechnung LDR Maximalfuellung rlmax"
 /begin REF_CHARACTERISTIC TSKRLDAU TSKRLDAB TLKRLDAU TLKRLDAB SWK208LDUB SWK108LDUB SWK08LDUB STA08LDUB SNM08LDUW SNM08LDUB RLKRLDA LDRXNZK LDRXN LDPBN LDORXN KFTARXZK KFTARX KFLDHBN KFFSLDE KFFLLDE KFFLDEO /end REF_CHARACTERISTIC
 /begin LOC_MEASUREMENT wkrmsu wkrmstat wkrmdy wkrma vstrlx vsrlmx tmki tans rlmx_w rlmxko_w rlmax_w rl pu pirg_w nmot_w nmot ldrlts_w ldrlms_w gggtsBit fupsrl_w frxta frxt fldrxo fldrxl fldrxk fldrrx_w esst_swk208ldub esst_swk108ldub esst_swk08ldub esst_sta08ldub esst_snm08lduw esst_snm08ldub dwkrm drlmaxo B_tmkib B_pwf B_ll B_kfzk B_brlmx B_atsb B_atrf /end LOC_MEASUREMENT
/end FUNCTION
/begin FUNCTION LDRPID "21.40     LDR PID-Regler"
 /begin REF_CHARACTERISTIC UMDYLDR TVLDMX TLDIAPN TLDIAN STV10LDSW STLDIA4 STLDIA3 STLDIA2 STLDIA1 STA08LDUB SPU08LDUB SPL08LDUW SNM16LDUW SNM16LDUB SNM08LDUW SNM08LDUB SLD04LDUB NLDIAPU LDRVL LDRQ1ST LDRQ1DY LDRQ0S LDRQ0DY LDMXNP LDMXNN LDIATA LDHIA LDEIAU LDEIAPS LDEIAP LDEIAO LDDIMXN LDDIMNN LDDIAP LDDIAN LDAMN KFLDRQ2 KFLDRL KFLDIOPU KFLDIMX FTLDIAP FTLDIA CWLDIMX /end REF_CHARACTERISTIC
 /begin LOC_MEASUREMENT vrlsol tans stldia pvdkds pu_w pu plsol_w plsolr_w plsol nmot_w nmot ldtvr_w ldtv ldrkp ldrki ldrkd ldrdtv ldptv lditv_w ldimxr ldimxa_4_A ldimxa_3_A ldimxa_2_A ldimxa_1_A ldimxa_0_A ldimxak ldimx ldimn lde esst_stv10ldsw esst_sta08ldub esst_spu08ldub esst_spl08lduw esst_snm16lduw esst_snm16ldub esst_snm08lduw esst_snm08ldub esst_sld04ldub B_stldw B_pwf B_ldvl B_ldr B_ldimxp B_ldimxn B_ldimxa B_lddy /end LOC_MEASUREMENT
/end FUNCTION
/begin FUNCTION LDRPLS "2.30      Berechnung Druckabfall fÅr LDR-Sollwert" /begin REF_CHARACTERISTIC TDPDK SVP12LDUW SNM12LDUW KFVPDKSE KFVPDKSD /end REF_CHARACTERISTIC
 /begin LOC_MEASUREMENT vrlsol vpsspu_w vpsspls_w rlsol_w rlmax_w pu_w pssol_w nmot_w fmvp_w esst_svp12lduw esst_snm12lduw B_ldobsp B_ldob B_asr /end LOC_MEASUREMENT
/end FUNCTION
/begin FUNCTION LDTVMA "21.10     Aufbereitung und Ausgabe TastverhÑltnis" /begin REF_CHARACTERISTIC TVLDMX TVLDMN LDRPBU LDRAPP KFTVLDRE KFLDRAPP /end REF_CHARACTERISTIC
 /begin LOC_MEASUREMENT wped vsldtv rlsol_w rl plsol nmot ldtvmd ldtvm ldtvbu_w ldtv ldebu B_ldsapp B_ldsafw B_lds B_ldrbu B_ldb /end LOC_MEASUREMENT
/end FUNCTION
/begin FUNCTION LDUVST "2.50      LDR-Schubumluftventilsteuerung"
 /begin REF_CHARACTERISTIC THLDUVD TALDUVSE SVDLDUVS SDLDSUA PIDLDSUA LDUVRS HSSLDSUA HSLDSUA GWPLDUR GWPLDU /end REF_CHARACTERISTIC
 /begin LOC_MEASUREMENT pvdkds pu_w pu plsol_w plsol pdpld nmot dwped B_stend B_ll B_ldsuas B_ldsuad B_ldsua /end LOC_MEASUREMENT
/end FUNCTION
/begin FUNCTION LLRBB "3.30      Leerlaufregelung Betriebsbedingungen" /begin REF_CHARACTERISTIC VLLR TVLLRPD TVLLRI TVKUPPL TVDK DNLLR CNFKUPPL /end REF_CHARACTERISTIC
 /begin LOC_MEASUREMENT vfzg tmot nstat nmotll nmot mistt mill_w gangi dn dmllri_w B_vllr B_stend B_sab B_sa B_nmot B_mdein B_llrpd B_llri B_llrein B_llr B_ll B_kuppl B_fs B_fil B_dash /end LOC_MEASUREMENT
/end FUNCTION
/begin FUNCTION LLRMR "2.100     Momentenreserve Leerlaufregelung"
 /begin REF_CHARACTERISTIC VANF TVRESLL TDMRESLL STM04SAUB STA04LLUB SNS06LLSB SNM06LLUB SMI04LLUB MRESSL MRESLL KFMRESTA KFMRESNL KFMRESKH KFMRESK KFMRES DNLLRES DMRESLL /end REF_CHARACTERISTIC
 /begin LOC_MEASUREMENT vstmdr vfzg tmot tans nmot_w mifa_w esst_stm04saub esst_sta04llub esst_sns06llsb esst_snm06llub esst_smi04llub dns dn dmrwan dmrllr_w dmrac B_stend B_sl B_nswo1 B_ll B_kuppl B_kh /end LOC_MEASUREMENT
/end FUNCTION
/begin FUNCTION LLRNFA "1.50      Solldrehzahlanhebung bei Kurztrip" /begin REF_CHARACTERISTIC ZNSLFA NSLLSH NSLKVS NSLFASH NSLFAKAT /end REF_CHARACTERISTIC
 /begin LOC_MEASUREMENT vfzg nslfa nlldagkt B_ll B_fs B_fash B_falsh B_fakvs B_fakat B_brems B_autget /end LOC_MEASUREMENT
/end FUNCTION
/begin FUNCTION LLRNS "516.150   Leerlaufregelung-Solldrehzahl"
 /begin REF_CHARACTERISTIC ZNSUB ZKNS ZHLLE ZHLLA VSL TMRZHLL TMLLX TMHLL TAHLL STM06LLUB SNS06LLSB NZHITL NZHDTL NTEBFS NTEB NSNOT NSLPWG NSLPPFS NSLPP NSLBZS NSLBZLL NSLBZFS NSL NSKS NSKO_3_A NSKO_2_A NSKO_1_A NSKO_0_A NSHLL NSAC_1_A NSAC_0_A NSACFS_1_A NSACFS_0_A NLLMIN_3_A NLLMIN_2_A NLLMIN_1_A NLLMIN_0_A NLLM NLLCVTMXV NLL2M NGNSNF NFSSL NFSMIN_3_A NFSMIN_2_A NFSMIN_1_A NFSMIN_0_A NFSM NFSLPWG NFSKS NFSKO_3_A NFSKO_2_A NFSKO_1_A NFSKO_0_A NFS2M NFHZFS NFHZ LBZU LBZO2 LBZO1 KNSNF KFZNSM FNSSTM FNSSTKM FNSNF DTMHLL DTAHLL DNSNFX DNLLAKH DNFSAKH CWNSTAT CNFLLRNS /end REF_CHARACTERISTIC
 /begin LOC_MEASUREMENT zhll vstnls vstcns vsns vfzg tmst tmot tans S_ko S_ac rl psl nstatfil nstat3 nstat2 nstat nsst nsol nsnf nsllmn nsllm nslfa nslbz nsfsmn nsfsm nmotll nmot nllkh nllcvt2 nllcvt1 ngfil nfskh lbz esst_stm06llub esst_sns06llsb dns B_wkauf B_stend B_st B_spsmin B_sl B_pwf B_nswo1 B_nssl B_nsks B_ns2a B_ns2 B_nftev B_nac B_llrein B_ll B_ko B_khn B_hll B_fs B_fhz B_dkpu B_dknolu /end LOC_MEASUREMENT
/end FUNCTION
/begin FUNCTION LLRRM "6.90      Leerlaufregelung Reglereingriff Drehmoment"
 /begin REF_CHARACTERISTIC ZNFNGLL ZLIBG ZKLLRD TVLISTU STM06LLUB SRKTEVS SNS206LLSB SNS06LLSB SNM06LLUB SNG06LLSB SDN06LLSB PVLDNV PVLDN PVDNV PVDN LLRICNF LISTM LIMXVDNS LIMXDNS LIMNV LIMNDTES LIMNDLLR LIMN IVDNV IVDNDTE IVDN GFDLDN FDNIKOR FDDN DVNGV DVNG DNMNI DNLLRIST DMLLRMXN DMLLRMNN DMLLRLMXN DMLLRLMNN DMLLNGV DMLLNG /end REF_CHARACTERISTIC
 /begin LOC_MEASUREMENT tmot nsol nmot_w ngfil ngas_w ngasf_w limnst limin_w limax_w iver esst_stm06llub esst_sns206llsb esst_sns06llsb esst_snm06llub esst_sng06llsb esst_sdn06llsb dn_w dns dnikorr_w dn dmllr_w dmllrp_w dmllrl_w dmllri_w dmllrd_w B_vllr B_stend B_st B_nswo1 B_mdmin B_llrpd B_llri B_llrein B_llr B_dtest B_dteaam B_dllr /end LOC_MEASUREMENT
/end FUNCTION
/begin FUNCTION LR "83.50     Lambdaregelung"
 /begin REF_CHARACTERISTIC ZLRFRI ZDFR USR TSPERN2 TSPERN SRL06LRUB SNM07LRUB QUFRMX QUFRMN KFRTV2 KFRTV KFRP2 KFRP KFRI2 KFRI KFFRMIN FRTEMX FRMAX FRIPTES FRIPDTES FLRM FLRFKATE FFRITMS DFRSPS DFRMN CFRA /end REF_CHARACTERISTIC
 /begin LOC_MEASUREMENT vstlr usvk2 usvk tvlrhi2 tvlrhi tvlrh2 tvlrh tvlr2 tvlr tv2 tv tsperr2 tsperr tplrvk_w tplrvk2_w tnst_w tmst tmot tfrp_w tfrpint_w tfrpint2_w tfrp2_w tfrn_w tfrnint_w tfrnint2_w tfrn2_w rl nmot lrfrz2 lrfrz lrfrmz2 lrfrmz fr_w frtv2 frtv frsp_w frsp2_w frpint2 frpint frp2 frp frm_w frmx_w frmx2_w frmn_w frmn2_w frm2_w frint_w frint2_w frini_w frini2_w friint2 friint friband_w friband2_w fri2 fri frband_w frband2_w fr2_w fkatei ffri2 ffri falrdkt esst_srl06lrub esst_snm07lrub dtvka dfrst_w dfrstte_w dfrstte2_w dfrstga_w dfrstga2_w dfrst2_w dfrsp_w dfrsp2_w B_tspon2 B_tspon B_tsper2 B_tsper B_tehbx B_te B_sgnra2 B_sgnra B_sgnlr2 B_sgnlr B_sgnalt2 B_sgnalt B_pwf B_lrtpp2 B_lrtpp B_lrstta2 B_lrstta B_lrstat2 B_lrstat B_lrsp2 B_lrsp B_lrnd2 B_lrnd B_ll B_int2 B_int B_inifrm2 B_inifrm B_frsp2 B_frsp B_frmini2 B_frmini B_frmin2 B_frmin B_frmax2 B_frmax B_frini2 B_frini B_frab2 B_frab B_dtest B_dtes B_dtefrr B_dktlp B_dfrm2 B_dfrm B_dfrf2 B_dfrf B_atmtpa /end LOC_MEASUREMENT
/end FUNCTION
/begin FUNCTION LRA "93.40     Adaptive Vorsteuerung fÅr Lambdaregelung"
 /begin REF_CHARACTERISTIC ZKRKAZ ZKRKAT ZKFRAU ZKFRAO RLU4 RLU3 RLU2 RLO3 RLO2 RKAZRX RKAZRN RKAZMX RKAZMN RKATRX RKATRN RKATMX RKATMN NU3 NRKAB NOLRA NO1 N0 MLU4 MLU2 MLO3 MLO2 MLO1 FRAURX FRAURN FRAUMX FRAUMN FRAORX FRAORN FRAOMX FRAOMN /end REF_CHARACTERISTIC
 /begin LOC_MEASUREMENT rl rka_w rkaz_w rkaz2_w rkat_w rkat2_w nmot ml_w frm_w fra_w frau_w frau2_w frao_w frao2_w dfrm_w B_rkazr B_rkaz B_rkatr B_rkat B_pwf B_norkaz B_norkat B_nofra B_lsvvsp B_lrareb B_lrare2 B_lrare B_lrar B_lra B_fraur B_frau B_fraor B_frao B_fakvs B_fa B_edkvs /end LOC_MEASUREMENT
/end FUNCTION
/begin FUNCTION LRAEB "4.50      Einschaltbedingungen Gemischadaption" /begin REF_CHARACTERISTIC WDKARN TVLRA TMRAA TARA /end REF_CHARACTERISTIC
 /begin LOC_MEASUREMENT wdkba tmot tans nmot B_vl B_ukg B_te B_sls B_mdarv B_lra B_lr B_gasp B_gap B_fakvs B_fa B_dtest B_dsls B_brems /end LOC_MEASUREMENT
/end FUNCTION
/end MODULE
/end PROJECT
