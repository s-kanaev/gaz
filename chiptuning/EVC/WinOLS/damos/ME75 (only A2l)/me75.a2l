ASAP2_VERSION 1 21
/begin PROJECT Pro4017 "R4 1.8l 5V T lÑngs FR5ROM F5051"
/begin HEADER "" PROJECT_NO Pro4017 VERSION "PrV = F21dc mit 00" /end HEADER
/begin MODULE DIM " "
/begin MOD_COMMON " " S_REC_LAYOUT ME7 BYTE_ORDER MSB_LAST /end MOD_COMMON
/begin COMPU_METHOD B_TRUE "boolsche ZustÑnde, positive Logik" TAB_VERB "%6.3" "" COMPU_TAB_REF B_TRUE /end COMPU_METHOD
/begin COMPU_METHOD B_TRUE___UW "boolsche ZustÑnde, positive Logik" TAB_VERB "%6.3" "" COMPU_TAB_REF B_TRUE /end COMPU_METHOD
/begin COMPU_METHOD default "" RAT_FUNC "%6.2" "" COEFFS 0 1.000000 0.000000 0 0.000000 1.000000 /end COMPU_METHOD
/begin COMPU_METHOD dez "1 : 1 Umrechnug (dez/hex)" RAT_FUNC "%6.2" "" COEFFS 0 1.000000 0.000000 0 0.000000 1.000000 /end COMPU_METHOD
/begin COMPU_METHOD dezsub1 "" RAT_FUNC "%6.2" "-" COEFFS 0 1.000000 -1.000000 0 0.000000 1.000000 /end COMPU_METHOD
/begin COMPU_METHOD dez___UW "1 : 1 Umrechnug (dez/hex)" RAT_FUNC "%6.2" "" COEFFS 0 1.000000 0.000000 0 0.000000 1.000000 /end COMPU_METHOD
/begin COMPU_METHOD fak_sb_b1 "" RAT_FUNC "%6.4" "-" COEFFS 0 256.000000 0.000000 0 0.000000 2.000000 /end COMPU_METHOD
/begin COMPU_METHOD fak_ub_b1 "" RAT_FUNC "%6.4" "-" COEFFS 0 256.000000 0.000000 0 0.000000 1.000000 /end COMPU_METHOD
/begin COMPU_METHOD fak_ub_b8 "" RAT_FUNC "%6.4" "-" COEFFS 0 256.000000 0.000000 0 0.000000 8.000000 /end COMPU_METHOD
/begin COMPU_METHOD fak_ub_q0p01 "" RAT_FUNC "%6.4" "-" COEFFS 0 1.000000 0.000000 0 0.000000 1.000000e-02 /end COMPU_METHOD
/begin COMPU_METHOD fak_uw_b2 "" RAT_FUNC "%7.6" "-" COEFFS 0 6.553600e+04 0.000000 0 0.000000 2.000000 /end COMPU_METHOD
/begin COMPU_METHOD freq_sw_b512 "" RAT_FUNC "%6.4" "1/s" COEFFS 0 6.553600e+04 0.000000 0 0.000000 1024.000000 /end COMPU_METHOD
/begin COMPU_METHOD mgrad_sw_b28p44 "" RAT_FUNC "%6.5" "g/s" COEFFS 0 230.400000 0.000000 0 0.000000 2.000000e-01 /end COMPU_METHOD
/begin COMPU_METHOD m_q0p1___SW "" RAT_FUNC "%6.3" "kg/h" COEFFS 0 10.000000 0.000000 0 0.000000 1.000000 /end COMPU_METHOD
/begin COMPU_METHOD m_q0p1___UW "" RAT_FUNC "%6.3" "kg/h" COEFFS 0 10.000000 0.000000 0 0.000000 1.000000 /end COMPU_METHOD
/begin COMPU_METHOD m_ub_b1020 "" RAT_FUNC "%6.2" "kg/h" COEFFS 0 1.000000 0.000000 0 0.000000 4.000000 /end COMPU_METHOD
/begin COMPU_METHOD m_uw_b6553p5 "" RAT_FUNC "%6.3" "kg/h" COEFFS 0 1.000000 0.000000 0 0.000000 1.000000e-01 /end COMPU_METHOD
/begin COMPU_METHOD nmot_ub_q40 "" RAT_FUNC "%6.1" "Upm" COEFFS 0 1.000000 0.000000 0 0.000000 40.000000 /end COMPU_METHOD
/begin COMPU_METHOD nmot_uw_q0p25 "" RAT_FUNC "%6.3" "U/min" COEFFS 0 1.000000 0.000000 0 0.000000 2.500000e-01 /end COMPU_METHOD
/begin COMPU_METHOD relDK_q0p02441 "" RAT_FUNC "%6.4" "% DK" COEFFS 0 6.553600e+04 0.000000 0 0.000000 1600.000000 /end COMPU_METHOD
/begin COMPU_METHOD rel_sb_q0p75 "" RAT_FUNC "%6.3" "%" COEFFS 0 1.000000 0.000000 0 0.000000 7.500000e-01 /end COMPU_METHOD
/begin COMPU_METHOD rel_ub_q0p75 "" RAT_FUNC "%6.3" "%" COEFFS 0 1.000000 0.000000 0 0.000000 7.500000e-01 /end COMPU_METHOD
/begin COMPU_METHOD rel_uw_b100 "" RAT_FUNC "%6.4" "%" COEFFS 0 6.553600e+04 0.000000 0 0.000000 100.000000 /end COMPU_METHOD
/begin COMPU_METHOD r_q8 "" RAT_FUNC "%6.2" "Ohm" COEFFS 0 1.000000 0.000000 0 0.000000 8.000000 /end COMPU_METHOD
/begin COMPU_METHOD r_uw_q2 "" RAT_FUNC "%6.2" "Ohm" COEFFS 0 1.000000 0.000000 0 0.000000 2.000000 /end COMPU_METHOD
/begin COMPU_METHOD spgg_sw_b3052 "" RAT_FUNC "%6.3" "V/s" COEFFS 0 1.000000 0.000000 0 0.000000 9.313230e-02 /end COMPU_METHOD
/begin COMPU_METHOD spg_sb_q0p01043 "" RAT_FUNC "%6.4" "V" COEFFS 0 255.000000 0.000000 0 0.000000 2.660000 /end COMPU_METHOD
/begin COMPU_METHOD spg_ubatt "" RAT_FUNC "%6.4" "V" COEFFS 0 1.000000 0.000000 0 0.000000 7.040000e-02 /end COMPU_METHOD
/begin COMPU_METHOD spg_ub_b5 "" RAT_FUNC "%6.4" "V" COEFFS 0 256.000000 0.000000 0 0.000000 5.000000 /end COMPU_METHOD
/begin COMPU_METHOD spg_ub_q0p0052 "" RAT_FUNC "%6.4" "V" COEFFS 0 255.000000 0.000000 0 0.000000 1.330000 /end COMPU_METHOD
/begin COMPU_METHOD spg_ub_q0p0052_o0p2 "" RAT_FUNC "%6.3" "V" COEFFS 0 255.000000 51.000000 0 0.000000 1.330000 /end COMPU_METHOD
/begin COMPU_METHOD spg_uw_b1280 "" RAT_FUNC "%6.4" "V" COEFFS 0 1000.000000 0.000000 0 0.000000 19.531300 /end COMPU_METHOD
/begin COMPU_METHOD t50msxs_q2 "" RAT_FUNC "%6.2" "s" COEFFS 0 1.000000 0.000000 0 0.000000 2.000000 /end COMPU_METHOD
/begin COMPU_METHOD t50msxs_uw_b3276p75 "" RAT_FUNC "%6.4" "s" COEFFS 0 1.000000 0.000000 0 0.000000 5.000000e-02 /end COMPU_METHOD
/begin COMPU_METHOD t50msxs_uw_b819p2 "" RAT_FUNC "%6.4" "s" COEFFS 0 1.000000 0.000000 0 0.000000 1.250000e-02 /end COMPU_METHOD
/begin COMPU_METHOD temp_ub_q0p75_o48 "" RAT_FUNC "%6.2" "Grad C" COEFFS 0 1.000000 48.000000 0 0.000000 7.500000e-01 /end COMPU_METHOD
/begin COMPU_METHOD temp_ub_q5 "" RAT_FUNC "%6.2" "Grad C" COEFFS 0 1.000000 0.000000 0 0.000000 5.000000 /end COMPU_METHOD
/begin COMPU_METHOD temp_ub_q5_o50 "" RAT_FUNC "%6.2" "Grad C" COEFFS 0 1.000000 50.000000 0 0.000000 5.000000 /end COMPU_METHOD
/begin COMPU_METHOD vfzg_ub_q1p25___UB "" RAT_FUNC "%6.2" "km/h" COEFFS 0 1.000000 0.000000 0 0.000000 1.250000 /end COMPU_METHOD
/begin COMPU_VTAB B_TRUE "" TAB_VERB 2 0 "----" 1 "TRUE" /end COMPU_VTAB
/begin MEASUREMENT rl "relative LuftfÅllung" UBYTE rel_ub_q0p75 0 0 0.000000 191.250000 /begin IF_DATA ASAP1B_ETK KP_BLOB 0xF997 0 1 /end IF_DATA BIT_MASK 0xFF /end MEASUREMENT
/begin MEASUREMENT nmot "Motordrehzahl" UBYTE nmot_ub_q40 0 0 0.000000 10200.000000 /begin IF_DATA ASAP1B_ETK KP_BLOB 0xF876 0 1 /end IF_DATA BIT_MASK 0xFF /end MEASUREMENT
/begin MEASUREMENT nmot_w "Motordrehzahl" UWORD nmot_uw_q0p25 0 0 0.000000 16383.750000 /begin IF_DATA ASAP1B_ETK KP_BLOB 0xF878 0 2 /end IF_DATA BIT_MASK 0xFFFF /end MEASUREMENT
/begin MEASUREMENT ml "Luftmassenflu·" UBYTE m_ub_b1020 0 0 0.000000 1020.000000 /begin IF_DATA ASAP1B_ETK KP_BLOB 0xF996 0 1 /end IF_DATA BIT_MASK 0xFF /end MEASUREMENT
/begin MEASUREMENT gangi "Ist-Gang" UBYTE dez 0 0 0.000000 255.000000 /begin IF_DATA ASAP1B_ETK KP_BLOB 0x380AB5 1 1 /end IF_DATA BIT_MASK 0xFF /end MEASUREMENT
/begin MEASUREMENT tmst "Motorstarttemperatur" UBYTE temp_ub_q0p75_o48 0 0 -48.000000 143.250000 /begin IF_DATA ASAP1B_ETK KP_BLOB 0x380B5F 1 1 /end IF_DATA BIT_MASK 0xFF /end MEASUREMENT
/begin MEASUREMENT ml_w "Luftmassenflu· gefiltert (Word)" UWORD m_uw_b6553p5 0 0 0.000000 6553.500000 /begin IF_DATA ASAP1B_ETK KP_BLOB 0xF998 0 2 /end IF_DATA BIT_MASK 0xFFFF /end MEASUREMENT
/begin MEASUREMENT wdkbad_w "Winkel Drosselklappe bezogen auf DK-Anschlag fÅr Diagnose (16-Bit)" SWORD relDK_q0p02441 0 0 -800.000000 799.975586 /begin IF_DATA ASAP1B_ETK KP_BLOB 0x381E26 1 2 /end IF_DATA BIT_MASK 0xFFFF /end MEASUREMENT
/begin MEASUREMENT vfzg "Fahrzeuggeschwindigkeit" UBYTE vfzg_ub_q1p25___UB 0 0 0.000000 318.750000 /begin IF_DATA ASAP1B_ETK KP_BLOB 0x380982 1 1 /end IF_DATA BIT_MASK 0xFF /end MEASUREMENT
/begin MEASUREMENT tkatmf "gefilterte Katalysatortemperatur aus Modell" UBYTE temp_ub_q5_o50 0 0 -50.000000 1225.000000 /begin IF_DATA ASAP1B_ETK KP_BLOB 0x380A65 1 1 /end IF_DATA BIT_MASK 0xFF /end MEASUREMENT
/begin MEASUREMENT phlsnhf "normierte Heizleistung der Lambdasonde hinter Kat, gefiltert" UBYTE fak_ub_q0p01 0 0 0.000000 2.550000 /begin IF_DATA ASAP1B_ETK KP_BLOB 0x380A63 1 1 /end IF_DATA BIT_MASK 0xFF /end MEASUREMENT
/begin MEASUREMENT tkdkth "hochpa·gefilterte Katalysator-Temperatur nach Halteglied" UBYTE temp_ub_q5 0 0 0.000000 1275.000000 /begin IF_DATA ASAP1B_ETK KP_BLOB 0x380A90 1 1 /end IF_DATA BIT_MASK 0xFF /end MEASUREMENT
/begin MEASUREMENT tkatm "Katalysatortemperatur aus Modell" UBYTE temp_ub_q5_o50 0 0 -50.000000 1225.000000 /begin IF_DATA ASAP1B_ETK KP_BLOB 0x380A6D 1 1 /end IF_DATA BIT_MASK 0xFF /end MEASUREMENT
/begin MEASUREMENT tabgm "Abgastemperatur vor Kat aus Modell" UBYTE temp_ub_q5_o50 0 0 -50.000000 1225.000000 /begin IF_DATA ASAP1B_ETK KP_BLOB 0x380A68 1 1 /end IF_DATA BIT_MASK 0xFF /end MEASUREMENT
/begin MEASUREMENT tabgmf "gefilterte Abgastemperatur aus Modell" UBYTE temp_ub_q5_o50 0 0 -50.000000 1225.000000 /begin IF_DATA ASAP1B_ETK KP_BLOB 0x380AAC 1 1 /end IF_DATA BIT_MASK 0xFF /end MEASUREMENT
/begin MEASUREMENT phlsnvf "normierte Heizleistung der Lambdasonde vor Kat, gefiltert" UBYTE fak_ub_q0p01 0 0 0.000000 2.550000 /begin IF_DATA ASAP1B_ETK KP_BLOB 0x380AAA 1 1 /end IF_DATA BIT_MASK 0xFF /end MEASUREMENT
/begin MEASUREMENT ub "Batteriespannung" UBYTE spg_ubatt 0 0 0.000000 17.952000 /begin IF_DATA ASAP1B_ETK KP_BLOB 0x380AB1 1 1 /end IF_DATA BIT_MASK 0xFF /end MEASUREMENT
/begin MEASUREMENT avkatf "AmplitudenVerhÑltnis laafh/laafv gefiltert" UBYTE fak_ub_b1 0 0 0.000000 0.996094 /begin IF_DATA ASAP1B_ETK KP_BLOB 0x38333A 1 1 /end IF_DATA BIT_MASK 0xFF /end MEASUREMENT
/begin MEASUREMENT ahkat "Mittelwert der Amplitude Sondensignal hinter Kat. korrigiert mit KB" UBYTE fak_ub_b1 0 0 0.000000 0.996094 /begin IF_DATA ASAP1B_ETK KP_BLOB 0x380A86 1 1 /end IF_DATA BIT_MASK 0xFF /end MEASUREMENT
/begin MEASUREMENT ahkatn "Amplitude Sondensignal hinter Katalysator normiert" UBYTE fak_ub_b1 0 0 0.000000 0.996094 /begin IF_DATA ASAP1B_ETK KP_BLOB 0x380A87 1 1 /end IF_DATA BIT_MASK 0xFF /end MEASUREMENT
/begin MEASUREMENT ahktki_w "Amplitude Sondensignal hinter Katalysator korrigiert und integiert" UWORD t50msxs_uw_b819p2 0 0 0.000000 819.187500 /begin IF_DATA ASAP1B_ETK KP_BLOB 0x381C08 1 2 /end IF_DATA BIT_MASK 0xFFFF /end MEASUREMENT
/begin MEASUREMENT ahktnk "Korrigierte Sondensignal-Amplitude normiert" UBYTE fak_ub_b1 0 0 0.000000 0.996094 /begin IF_DATA ASAP1B_ETK KP_BLOB 0x380A88 1 1 /end IF_DATA BIT_MASK 0xFF /end MEASUREMENT
/begin MEASUREMENT akatbn "Amplitude der Katalysatorbelastungssignal" UBYTE fak_ub_b1 0 0 0.000000 0.996094 /begin IF_DATA ASAP1B_ETK KP_BLOB 0x380A89 1 1 /end IF_DATA BIT_MASK 0xFF /end MEASUREMENT
/begin MEASUREMENT anzgangw "Anzahl erkannter Gangwechsel" UBYTE dez 0 0 0.000000 255.000000 /begin IF_DATA ASAP1B_ETK KP_BLOB 0x380AB3 1 1 /end IF_DATA BIT_MASK 0xFF /end MEASUREMENT
/begin MEASUREMENT anzkupplb "Anzahl erkannter KupplungsbetÑtigungen" UBYTE dez 0 0 0.000000 255.000000 /begin IF_DATA ASAP1B_ETK KP_BLOB 0x380AB4 1 1 /end IF_DATA BIT_MASK 0xFF /end MEASUREMENT
/begin MEASUREMENT apedkt "Anzahl der PrÅfungen mit Fehlerergebnis bei Katdiagnose" UBYTE dez 0 0 0.000000 255.000000 /begin IF_DATA ASAP1B_ETK KP_BLOB 0x380A8A 1 1 /end IF_DATA BIT_MASK 0xFF /end MEASUREMENT
/begin MEASUREMENT B_agrrdy "Bedingung AGR geprÅft fÅr 'ready-Byte'" UBYTE B_TRUE 0 0 0.000000 0.000000 /begin IF_DATA ASAP1B_ETK KP_BLOB 0x383312 1 1 /end IF_DATA BIT_MASK 0x80 /end MEASUREMENT
/begin MEASUREMENT B_atmtpa "Bedingung Taupunkt vor Kat ueberschritten" UWORD B_TRUE___UW 0 0 0.000000 0.000000 /begin IF_DATA ASAP1B_ETK KP_BLOB 0xFD22 0 2 /end IF_DATA BIT_MASK 0x40 /end MEASUREMENT
/begin MEASUREMENT B_atmtpk "Bedingung Taupunkt hinter Kat ueberschritten" UWORD B_TRUE___UW 0 0 0.000000 0.000000 /begin IF_DATA ASAP1B_ETK KP_BLOB 0xFD22 0 2 /end IF_DATA BIT_MASK 0x80 /end MEASUREMENT
/begin MEASUREMENT B_autget "Bedingung Automatikgetriebe" UWORD B_TRUE___UW 0 0 0.000000 0.000000 /begin IF_DATA ASAP1B_ETK KP_BLOB 0xFD00 0 2 /end IF_DATA BIT_MASK 0x8 /end MEASUREMENT
/begin MEASUREMENT B_avgecod "" UWORD B_TRUE___UW 0 0 0.000000 0.000000 /begin IF_DATA ASAP1B_ETK KP_BLOB 0x383B52 1 2 /end IF_DATA BIT_MASK 0x1000 /end MEASUREMENT
/begin MEASUREMENT B_avtes "Leckdiagnose ist aktiv" UWORD B_TRUE___UW 0 0 0.000000 0.000000 /begin IF_DATA ASAP1B_ETK KP_BLOB 0x383BE4 1 2 /end IF_DATA BIT_MASK 0x1000 /end MEASUREMENT
/begin MEASUREMENT B_bebrems "" UWORD B_TRUE___UW 0 0 0.000000 0.000000 /begin IF_DATA ASAP1B_ETK KP_BLOB 0x383AF8 1 2 /end IF_DATA BIT_MASK 0x20 /end MEASUREMENT
/begin MEASUREMENT B_bebwf "" UWORD B_TRUE___UW 0 0 0.000000 0.000000 /begin IF_DATA ASAP1B_ETK KP_BLOB 0x383AFA 1 2 /end IF_DATA BIT_MASK 0x20 /end MEASUREMENT
/begin MEASUREMENT B_bedpl "" UWORD B_TRUE___UW 0 0 0.000000 0.000000 /begin IF_DATA ASAP1B_ETK KP_BLOB 0x383B10 1 2 /end IF_DATA BIT_MASK 0x20 /end MEASUREMENT
/begin MEASUREMENT B_bedsl "" UWORD B_TRUE___UW 0 0 0.000000 0.000000 /begin IF_DATA ASAP1B_ETK KP_BLOB 0x383B12 1 2 /end IF_DATA BIT_MASK 0x20 /end MEASUREMENT
/begin MEASUREMENT B_bedsu "" UWORD B_TRUE___UW 0 0 0.000000 0.000000 /begin IF_DATA ASAP1B_ETK KP_BLOB 0x383B16 1 2 /end IF_DATA BIT_MASK 0x20 /end MEASUREMENT
/begin MEASUREMENT B_bedsvlu "" UWORD B_TRUE___UW 0 0 0.000000 0.000000 /begin IF_DATA ASAP1B_ETK KP_BLOB 0x383B18 1 2 /end IF_DATA BIT_MASK 0x20 /end MEASUREMENT
/begin MEASUREMENT B_beegfe "" UWORD B_TRUE___UW 0 0 0.000000 0.000000 /begin IF_DATA ASAP1B_ETK KP_BLOB 0x383B30 1 2 /end IF_DATA BIT_MASK 0x20 /end MEASUREMENT
/begin MEASUREMENT B_befp1p "" UWORD B_TRUE___UW 0 0 0.000000 0.000000 /begin IF_DATA ASAP1B_ETK KP_BLOB 0x383B46 1 2 /end IF_DATA BIT_MASK 0x20 /end MEASUREMENT
/begin MEASUREMENT B_befp2p "" UWORD B_TRUE___UW 0 0 0.000000 0.000000 /begin IF_DATA ASAP1B_ETK KP_BLOB 0x383B48 1 2 /end IF_DATA BIT_MASK 0x20 /end MEASUREMENT
/begin MEASUREMENT B_befpp "" UWORD B_TRUE___UW 0 0 0.000000 0.000000 /begin IF_DATA ASAP1B_ETK KP_BLOB 0x383B4A 1 2 /end IF_DATA BIT_MASK 0x20 /end MEASUREMENT
/begin MEASUREMENT B_begecod "" UWORD B_TRUE___UW 0 0 0.000000 0.000000 /begin IF_DATA ASAP1B_ETK KP_BLOB 0x383B52 1 2 /end IF_DATA BIT_MASK 0x20 /end MEASUREMENT
/begin MEASUREMENT B_begrbh "" UWORD B_TRUE___UW 0 0 0.000000 0.000000 /begin IF_DATA ASAP1B_ETK KP_BLOB 0x383B54 1 2 /end IF_DATA BIT_MASK 0x20 /end MEASUREMENT
/begin MEASUREMENT B_beldpe "" UWORD B_TRUE___UW 0 0 0.000000 0.000000 /begin IF_DATA ASAP1B_ETK KP_BLOB 0x383B96 1 2 /end IF_DATA BIT_MASK 0x20 /end MEASUREMENT
/begin MEASUREMENT B_bemd "" UWORD B_TRUE___UW 0 0 0.000000 0.000000 /begin IF_DATA ASAP1B_ETK KP_BLOB 0x383BA2 1 2 /end IF_DATA BIT_MASK 0x20 /end MEASUREMENT
/begin MEASUREMENT B_bemd01 "" UWORD B_TRUE___UW 0 0 0.000000 0.000000 /begin IF_DATA ASAP1B_ETK KP_BLOB 0x383BA4 1 2 /end IF_DATA BIT_MASK 0x20 /end MEASUREMENT
/begin MEASUREMENT B_bemd02 "" UWORD B_TRUE___UW 0 0 0.000000 0.000000 /begin IF_DATA ASAP1B_ETK KP_BLOB 0x383BA6 1 2 /end IF_DATA BIT_MASK 0x20 /end MEASUREMENT
/begin MEASUREMENT B_bemd03 "" UWORD B_TRUE___UW 0 0 0.000000 0.000000 /begin IF_DATA ASAP1B_ETK KP_BLOB 0x383BA8 1 2 /end IF_DATA BIT_MASK 0x20 /end MEASUREMENT
/begin MEASUREMENT B_bemd04 "" UWORD B_TRUE___UW 0 0 0.000000 0.000000 /begin IF_DATA ASAP1B_ETK KP_BLOB 0x383BAA 1 2 /end IF_DATA BIT_MASK 0x20 /end MEASUREMENT
/begin MEASUREMENT B_bemdb "" UWORD B_TRUE___UW 0 0 0.000000 0.000000 /begin IF_DATA ASAP1B_ETK KP_BLOB 0x383BAC 1 2 /end IF_DATA BIT_MASK 0x20 /end MEASUREMENT
/begin MEASUREMENT B_bemdk "" UWORD B_TRUE___UW 0 0 0.000000 0.000000 /begin IF_DATA ASAP1B_ETK KP_BLOB 0x383BAE 1 2 /end IF_DATA BIT_MASK 0x20 /end MEASUREMENT
/begin MEASUREMENT B_bemdk01 "" UWORD B_TRUE___UW 0 0 0.000000 0.000000 /begin IF_DATA ASAP1B_ETK KP_BLOB 0x383BB0 1 2 /end IF_DATA BIT_MASK 0x20 /end MEASUREMENT
/begin MEASUREMENT B_bemdk02 "" UWORD B_TRUE___UW 0 0 0.000000 0.000000 /begin IF_DATA ASAP1B_ETK KP_BLOB 0x383BB2 1 2 /end IF_DATA BIT_MASK 0x20 /end MEASUREMENT
/begin MEASUREMENT B_bemdk03 "" UWORD B_TRUE___UW 0 0 0.000000 0.000000 /begin IF_DATA ASAP1B_ETK KP_BLOB 0x383BB4 1 2 /end IF_DATA BIT_MASK 0x20 /end MEASUREMENT
/begin MEASUREMENT B_bemdk04 "" UWORD B_TRUE___UW 0 0 0.000000 0.000000 /begin IF_DATA ASAP1B_ETK KP_BLOB 0x383BB6 1 2 /end IF_DATA BIT_MASK 0x20 /end MEASUREMENT
/begin MEASUREMENT B_benwkw "" UWORD B_TRUE___UW 0 0 0.000000 0.000000 /begin IF_DATA ASAP1B_ETK KP_BLOB 0x383BBC 1 2 /end IF_DATA BIT_MASK 0x20 /end MEASUREMENT
/begin MEASUREMENT B_benwkw2 "" UWORD B_TRUE___UW 0 0 0.000000 0.000000 /begin IF_DATA ASAP1B_ETK KP_BLOB 0x383BBE 1 2 /end IF_DATA BIT_MASK 0x20 /end MEASUREMENT
/begin MEASUREMENT B_benws "" UWORD B_TRUE___UW 0 0 0.000000 0.000000 /begin IF_DATA ASAP1B_ETK KP_BLOB 0x383BC0 1 2 /end IF_DATA BIT_MASK 0x20 /end MEASUREMENT
/begin MEASUREMENT B_benws2 "" UWORD B_TRUE___UW 0 0 0.000000 0.000000 /begin IF_DATA ASAP1B_ETK KP_BLOB 0x383BC2 1 2 /end IF_DATA BIT_MASK 0x20 /end MEASUREMENT
/begin MEASUREMENT B_benx "" UWORD B_TRUE___UW 0 0 0.000000 0.000000 /begin IF_DATA ASAP1B_ETK KP_BLOB 0x383BC6 1 2 /end IF_DATA BIT_MASK 0x20 /end MEASUREMENT
/begin MEASUREMENT B_beph "Bedingung: Bandendefunktionanford. fÅr Phasengeber" UWORD B_TRUE___UW 0 0 0.000000 0.000000 /begin IF_DATA ASAP1B_ETK KP_BLOB 0x383BC8 1 2 /end IF_DATA BIT_MASK 0x20 /end MEASUREMENT
/begin MEASUREMENT B_bepwm "" UWORD B_TRUE___UW 0 0 0.000000 0.000000 /begin IF_DATA ASAP1B_ETK KP_BLOB 0x383BCA 1 2 /end IF_DATA BIT_MASK 0x20 /end MEASUREMENT
/begin MEASUREMENT B_besgeew "" UWORD B_TRUE___UW 0 0 0.000000 0.000000 /begin IF_DATA ASAP1B_ETK KP_BLOB 0x383BD0 1 2 /end IF_DATA BIT_MASK 0x20 /end MEASUREMENT
/begin MEASUREMENT B_besls "Bedingung Bandende-Funktionsanforderung SekundÑrluftsystem" UWORD B_TRUE___UW 0 0 0.000000 0.000000 /begin IF_DATA ASAP1B_ETK KP_BLOB 0x383BD4 1 2 /end IF_DATA BIT_MASK 0x20 /end MEASUREMENT
/begin MEASUREMENT B_beslv "" UWORD B_TRUE___UW 0 0 0.000000 0.000000 /begin IF_DATA ASAP1B_ETK KP_BLOB 0x383BD6 1 2 /end IF_DATA BIT_MASK 0x20 /end MEASUREMENT
/begin MEASUREMENT B_beslwg "" UWORD B_TRUE___UW 0 0 0.000000 0.000000 /begin IF_DATA ASAP1B_ETK KP_BLOB 0x383BDA 1 2 /end IF_DATA BIT_MASK 0x20 /end MEASUREMENT
/begin MEASUREMENT B_beswe "" UWORD B_TRUE___UW 0 0 0.000000 0.000000 /begin IF_DATA ASAP1B_ETK KP_BLOB 0x383BDE 1 2 /end IF_DATA BIT_MASK 0x20 /end MEASUREMENT
/begin MEASUREMENT B_beta "" UWORD B_TRUE___UW 0 0 0.000000 0.000000 /begin IF_DATA ASAP1B_ETK KP_BLOB 0x383BE0 1 2 /end IF_DATA BIT_MASK 0x20 /end MEASUREMENT
/begin MEASUREMENT B_betes "Bedingung Bandende-Funktionsanforderung TankentlÅftungssystem" UWORD B_TRUE___UW 0 0 0.000000 0.000000 /begin IF_DATA ASAP1B_ETK KP_BLOB 0x383BE4 1 2 /end IF_DATA BIT_MASK 0x20 /end MEASUREMENT
/begin MEASUREMENT B_betm "" UWORD B_TRUE___UW 0 0 0.000000 0.000000 /begin IF_DATA ASAP1B_ETK KP_BLOB 0x383BEE 1 2 /end IF_DATA BIT_MASK 0x20 /end MEASUREMENT
/begin MEASUREMENT B_betun "" UWORD B_TRUE___UW 0 0 0.000000 0.000000 /begin IF_DATA ASAP1B_ETK KP_BLOB 0x383BF4 1 2 /end IF_DATA BIT_MASK 0x20 /end MEASUREMENT
/begin MEASUREMENT B_beub "Bedingung: Bandendefunktionanford. fÅr Batteriespannung (Bordnetz)" UWORD B_TRUE___UW 0 0 0.000000 0.000000 /begin IF_DATA ASAP1B_ETK KP_BLOB 0x383BF6 1 2 /end IF_DATA BIT_MASK 0x20 /end MEASUREMENT
/begin MEASUREMENT B_beufmv "" UWORD B_TRUE___UW 0 0 0.000000 0.000000 /begin IF_DATA ASAP1B_ETK KP_BLOB 0x383BF8 1 2 /end IF_DATA BIT_MASK 0x20 /end MEASUREMENT
/begin MEASUREMENT B_beufska "" UWORD B_TRUE___UW 0 0 0.000000 0.000000 /begin IF_DATA ASAP1B_ETK KP_BLOB 0x383BFA 1 2 /end IF_DATA BIT_MASK 0x20 /end MEASUREMENT
/begin MEASUREMENT B_beurram "" UWORD B_TRUE___UW 0 0 0.000000 0.000000 /begin IF_DATA ASAP1B_ETK KP_BLOB 0x383BFC 1 2 /end IF_DATA BIT_MASK 0x20 /end MEASUREMENT
/begin MEASUREMENT B_beurrom "" UWORD B_TRUE___UW 0 0 0.000000 0.000000 /begin IF_DATA ASAP1B_ETK KP_BLOB 0x383BFE 1 2 /end IF_DATA BIT_MASK 0x20 /end MEASUREMENT
/begin MEASUREMENT B_beurrst "" UWORD B_TRUE___UW 0 0 0.000000 0.000000 /begin IF_DATA ASAP1B_ETK KP_BLOB 0x383C00 1 2 /end IF_DATA BIT_MASK 0x20 /end MEASUREMENT
/begin MEASUREMENT B_bevfz "" UWORD B_TRUE___UW 0 0 0.000000 0.000000 /begin IF_DATA ASAP1B_ETK KP_BLOB 0x383C04 1 2 /end IF_DATA BIT_MASK 0x20 /end MEASUREMENT
/begin MEASUREMENT B_bewfs "" UWORD B_TRUE___UW 0 0 0.000000 0.000000 /begin IF_DATA ASAP1B_ETK KP_BLOB 0x383C06 1 2 /end IF_DATA BIT_MASK 0x20 /end MEASUREMENT
/begin MEASUREMENT B_bewfsrc "" UWORD B_TRUE___UW 0 0 0.000000 0.000000 /begin IF_DATA ASAP1B_ETK KP_BLOB 0x383C08 1 2 /end IF_DATA BIT_MASK 0x20 /end MEASUREMENT
/begin MEASUREMENT B_bkbrems "Bedingung Ersatzwert aktiv: BREMS (Bremsschalter)" UWORD B_TRUE___UW 0 0 0.000000 0.000000 /begin IF_DATA ASAP1B_ETK KP_BLOB 0x383AF8 1 2 /end IF_DATA BIT_MASK 0x40 /end MEASUREMENT
/begin MEASUREMENT B_bkbwf "Flag fÅr Ersatzwert: PWG Bewegung" UWORD B_TRUE___UW 0 0 0.000000 0.000000 /begin IF_DATA ASAP1B_ETK KP_BLOB 0x383AFA 1 2 /end IF_DATA BIT_MASK 0x40 /end MEASUREMENT
/begin MEASUREMENT B_bkdpl "Bedingung: Dauerplus" UWORD B_TRUE___UW 0 0 0.000000 0.000000 /begin IF_DATA ASAP1B_ETK KP_BLOB 0x383B10 1 2 /end IF_DATA BIT_MASK 0x40 /end MEASUREMENT
/begin MEASUREMENT B_bkdsl "" UWORD B_TRUE___UW 0 0 0.000000 0.000000 /begin IF_DATA ASAP1B_ETK KP_BLOB 0x383B12 1 2 /end IF_DATA BIT_MASK 0x40 /end MEASUREMENT
/begin MEASUREMENT B_bkdsu "Bedingung: Umgebungsdrucksensor" UWORD B_TRUE___UW 0 0 0.000000 0.000000 /begin IF_DATA ASAP1B_ETK KP_BLOB 0x383B16 1 2 /end IF_DATA BIT_MASK 0x40 /end MEASUREMENT
/begin MEASUREMENT B_bkdsvlu "Bedingung: Drucksensorsingnalvergleich (DS-L DS-U)" UWORD B_TRUE___UW 0 0 0.000000 0.000000 /begin IF_DATA ASAP1B_ETK KP_BLOB 0x383B18 1 2 /end IF_DATA BIT_MASK 0x40 /end MEASUREMENT
/begin MEASUREMENT B_bkegfe "" UWORD B_TRUE___UW 0 0 0.000000 0.000000 /begin IF_DATA ASAP1B_ETK KP_BLOB 0x383B30 1 2 /end IF_DATA BIT_MASK 0x40 /end MEASUREMENT
/begin MEASUREMENT B_bkfp1p "Bedingung: Fahrpedal 1.Potentiometer aktiv" UWORD B_TRUE___UW 0 0 0.000000 0.000000 /begin IF_DATA ASAP1B_ETK KP_BLOB 0x383B46 1 2 /end IF_DATA BIT_MASK 0x40 /end MEASUREMENT
/begin MEASUREMENT B_bkfp2p "Bedingung: Fahrpedal 2.Potentiometer aktiv" UWORD B_TRUE___UW 0 0 0.000000 0.000000 /begin IF_DATA ASAP1B_ETK KP_BLOB 0x383B48 1 2 /end IF_DATA BIT_MASK 0x40 /end MEASUREMENT
/begin MEASUREMENT B_bkfpp "Bedingung: Fahrpedal Potentiometer aktiv" UWORD B_TRUE___UW 0 0 0.000000 0.000000 /begin IF_DATA ASAP1B_ETK KP_BLOB 0x383B4A 1 2 /end IF_DATA BIT_MASK 0x40 /end MEASUREMENT
/begin MEASUREMENT B_bkgecod "" UWORD B_TRUE___UW 0 0 0.000000 0.000000 /begin IF_DATA ASAP1B_ETK KP_BLOB 0x383B52 1 2 /end IF_DATA BIT_MASK 0x40 /end MEASUREMENT
/begin MEASUREMENT B_bkgrbh "" UWORD B_TRUE___UW 0 0 0.000000 0.000000 /begin IF_DATA ASAP1B_ETK KP_BLOB 0x383B54 1 2 /end IF_DATA BIT_MASK 0x40 /end MEASUREMENT
/begin MEASUREMENT B_bkldpe "Bedingung: Leckdiagnosemodul Endstufe aktiv" UWORD B_TRUE___UW 0 0 0.000000 0.000000 /begin IF_DATA ASAP1B_ETK KP_BLOB 0x383B96 1 2 /end IF_DATA BIT_MASK 0x40 /end MEASUREMENT
/begin MEASUREMENT B_bkmd "Flag fÅr Ersatzwert: Aussetzer, Summenfehler (multiple)" UWORD B_TRUE___UW 0 0 0.000000 0.000000 /begin IF_DATA ASAP1B_ETK KP_BLOB 0x383BA2 1 2 /end IF_DATA BIT_MASK 0x40 /end MEASUREMENT
/begin MEASUREMENT B_bkmd01 "Flag fÅr Ersatzwert: Aussetzer ZÅndung 1" UWORD B_TRUE___UW 0 0 0.000000 0.000000 /begin IF_DATA ASAP1B_ETK KP_BLOB 0x383BA4 1 2 /end IF_DATA BIT_MASK 0x40 /end MEASUREMENT
/begin MEASUREMENT B_bkmd02 "Flag fÅr Ersatzwert: Aussetzer ZÅndung 2" UWORD B_TRUE___UW 0 0 0.000000 0.000000 /begin IF_DATA ASAP1B_ETK KP_BLOB 0x383BA6 1 2 /end IF_DATA BIT_MASK 0x40 /end MEASUREMENT
/begin MEASUREMENT B_bkmd03 "Flag fÅr Ersatzwert: Aussetzer ZÅndung 3" UWORD B_TRUE___UW 0 0 0.000000 0.000000 /begin IF_DATA ASAP1B_ETK KP_BLOB 0x383BA8 1 2 /end IF_DATA BIT_MASK 0x40 /end MEASUREMENT
/begin MEASUREMENT B_bkmd04 "Flag fÅr Ersatzwert: Aussetzer ZÅndung 4" UWORD B_TRUE___UW 0 0 0.000000 0.000000 /begin IF_DATA ASAP1B_ETK KP_BLOB 0x383BAA 1 2 /end IF_DATA BIT_MASK 0x40 /end MEASUREMENT
/begin MEASUREMENT B_bkmdb "Bedingung: MomentanÅberwachung (bergrenzt dauerhaft) aktiv" UWORD B_TRUE___UW 0 0 0.000000 0.000000 /begin IF_DATA ASAP1B_ETK KP_BLOB 0x383BAC 1 2 /end IF_DATA BIT_MASK 0x40 /end MEASUREMENT
/begin MEASUREMENT B_bkmdk "Flag fÅr Ersatzwert: Aussetzer, Summenfehler - multiple, kundendienstrelevant" UWORD B_TRUE___UW 0 0 0.000000 0.000000 /begin IF_DATA ASAP1B_ETK KP_BLOB 0x383BAE 1 2 /end IF_DATA BIT_MASK 0x40 /end MEASUREMENT
/begin MEASUREMENT B_bkmdk01 "Flag fÅr Ersatzwert: Aussetzer, ZÅndung 1, kundendienstrelevant" UWORD B_TRUE___UW 0 0 0.000000 0.000000 /begin IF_DATA ASAP1B_ETK KP_BLOB 0x383BB0 1 2 /end IF_DATA BIT_MASK 0x40 /end MEASUREMENT
/begin MEASUREMENT B_bkmdk02 "Flag fÅr Ersatzwert: Aussetzer, ZÅndung 2,  kundendiesntrelevant" UWORD B_TRUE___UW 0 0 0.000000 0.000000 /begin IF_DATA ASAP1B_ETK KP_BLOB 0x383BB2 1 2 /end IF_DATA BIT_MASK 0x40 /end MEASUREMENT
/begin MEASUREMENT B_bkmdk03 "Flag fÅr Ersatzwert: Aussetzer, ZÅndung 3, kundendienstrelevant" UWORD B_TRUE___UW 0 0 0.000000 0.000000 /begin IF_DATA ASAP1B_ETK KP_BLOB 0x383BB4 1 2 /end IF_DATA BIT_MASK 0x40 /end MEASUREMENT
/begin MEASUREMENT B_bkmdk04 "Flag fÅr Ersatzwert: Aussetzer, ZÅndung 4, kundendiesntrelevant" UWORD B_TRUE___UW 0 0 0.000000 0.000000 /begin IF_DATA ASAP1B_ETK KP_BLOB 0x383BB6 1 2 /end IF_DATA BIT_MASK 0x40 /end MEASUREMENT
/begin MEASUREMENT B_bknwkw "Bedingung: Zuordnung Nockenwelle zu Kurbelwelle aktiv" UWORD B_TRUE___UW 0 0 0.000000 0.000000 /begin IF_DATA ASAP1B_ETK KP_BLOB 0x383BBC 1 2 /end IF_DATA BIT_MASK 0x40 /end MEASUREMENT
/begin MEASUREMENT B_bknwkw2 "Bedingung: Zuordnung Nockenwelle 2 zu Kurbelwelle aktiv" UWORD B_TRUE___UW 0 0 0.000000 0.000000 /begin IF_DATA ASAP1B_ETK KP_BLOB 0x383BBE 1 2 /end IF_DATA BIT_MASK 0x40 /end MEASUREMENT
/begin MEASUREMENT B_bknws "Bedingung: Nockenwellensteuerung aktiv" UWORD B_TRUE___UW 0 0 0.000000 0.000000 /begin IF_DATA ASAP1B_ETK KP_BLOB 0x383BC0 1 2 /end IF_DATA BIT_MASK 0x40 /end MEASUREMENT
/begin MEASUREMENT B_bknws2 "Bedingung: Nockenwellensteuerung Bank 2 aktiv" UWORD B_TRUE___UW 0 0 0.000000 0.000000 /begin IF_DATA ASAP1B_ETK KP_BLOB 0x383BC2 1 2 /end IF_DATA BIT_MASK 0x40 /end MEASUREMENT
/begin MEASUREMENT B_bknx "Flag fÅr Ersatzwert: öberdrehzahl" UWORD B_TRUE___UW 0 0 0.000000 0.000000 /begin IF_DATA ASAP1B_ETK KP_BLOB 0x383BC6 1 2 /end IF_DATA BIT_MASK 0x40 /end MEASUREMENT
/begin MEASUREMENT B_bkph "Bedingung: Phasengeber aktiv" UWORD B_TRUE___UW 0 0 0.000000 0.000000 /begin IF_DATA ASAP1B_ETK KP_BLOB 0x383BC8 1 2 /end IF_DATA BIT_MASK 0x40 /end MEASUREMENT
/begin MEASUREMENT B_bkpwm "" UWORD B_TRUE___UW 0 0 0.000000 0.000000 /begin IF_DATA ASAP1B_ETK KP_BLOB 0x383BCA 1 2 /end IF_DATA BIT_MASK 0x40 /end MEASUREMENT
/begin MEASUREMENT B_bksgeew "Bedingung: SteuergerÑt defekt (EEPROM WFS)" UWORD B_TRUE___UW 0 0 0.000000 0.000000 /begin IF_DATA ASAP1B_ETK KP_BLOB 0x383BD0 1 2 /end IF_DATA BIT_MASK 0x40 /end MEASUREMENT
/begin MEASUREMENT B_bksls "Bedingung: SekundÑrluftsystem aktiv" UWORD B_TRUE___UW 0 0 0.000000 0.000000 /begin IF_DATA ASAP1B_ETK KP_BLOB 0x383BD4 1 2 /end IF_DATA BIT_MASK 0x40 /end MEASUREMENT
/begin MEASUREMENT B_bkslv "Bedingung: SekundÑrluftventil aktiv" UWORD B_TRUE___UW 0 0 0.000000 0.000000 /begin IF_DATA ASAP1B_ETK KP_BLOB 0x383BD6 1 2 /end IF_DATA BIT_MASK 0x40 /end MEASUREMENT
/begin MEASUREMENT B_bkslwg "" UWORD B_TRUE___UW 0 0 0.000000 0.000000 /begin IF_DATA ASAP1B_ETK KP_BLOB 0x383BDA 1 2 /end IF_DATA BIT_MASK 0x40 /end MEASUREMENT
/begin MEASUREMENT B_bkswe "" UWORD B_TRUE___UW 0 0 0.000000 0.000000 /begin IF_DATA ASAP1B_ETK KP_BLOB 0x383BDE 1 2 /end IF_DATA BIT_MASK 0x40 /end MEASUREMENT
/begin MEASUREMENT B_bkta "Bedingung Ersatzwert fÅr Ansauglufttemperatur (/Ladelufttemp.)" UWORD B_TRUE___UW 0 0 0.000000 0.000000 /begin IF_DATA ASAP1B_ETK KP_BLOB 0x383BE0 1 2 /end IF_DATA BIT_MASK 0x40 /end MEASUREMENT
/begin MEASUREMENT B_bktes "Bedingung Ersatzwert aktiv Tankdiagnose TankentlÅftungsventil offen" UWORD B_TRUE___UW 0 0 0.000000 0.000000 /begin IF_DATA ASAP1B_ETK KP_BLOB 0x383BE4 1 2 /end IF_DATA BIT_MASK 0x40 /end MEASUREMENT
/begin MEASUREMENT B_bktm "Bedingung Ersatzwert fÅr Motortemperatur" UWORD B_TRUE___UW 0 0 0.000000 0.000000 /begin IF_DATA ASAP1B_ETK KP_BLOB 0x383BEE 1 2 /end IF_DATA BIT_MASK 0x40 /end MEASUREMENT
/begin MEASUREMENT B_bktun "Bedingung Ersatzwert fÅr Tuningschutz" UWORD B_TRUE___UW 0 0 0.000000 0.000000 /begin IF_DATA ASAP1B_ETK KP_BLOB 0x383BF4 1 2 /end IF_DATA BIT_MASK 0x40 /end MEASUREMENT
/begin MEASUREMENT B_bkub "Bedingung Ersatzwert fÅr Batteriespannung (Bordnetz)" UWORD B_TRUE___UW 0 0 0.000000 0.000000 /begin IF_DATA ASAP1B_ETK KP_BLOB 0x383BF6 1 2 /end IF_DATA BIT_MASK 0x40 /end MEASUREMENT
/begin MEASUREMENT B_bkufmv "Bedingung: FunktiosÅberwachung Momentanvergleich aktiv" UWORD B_TRUE___UW 0 0 0.000000 0.000000 /begin IF_DATA ASAP1B_ETK KP_BLOB 0x383BF8 1 2 /end IF_DATA BIT_MASK 0x40 /end MEASUREMENT
/begin MEASUREMENT B_bkufska "Bedingung: FunktionsÅberwachung: Sicherheits-Kraftstoff-Abschaltung aktiv" UWORD B_TRUE___UW 0 0 0.000000 0.000000 /begin IF_DATA ASAP1B_ETK KP_BLOB 0x383BFA 1 2 /end IF_DATA BIT_MASK 0x40 /end MEASUREMENT
/begin MEASUREMENT B_bkurram "Bedingung: RechnerÅberwachung: RAM" UWORD B_TRUE___UW 0 0 0.000000 0.000000 /begin IF_DATA ASAP1B_ETK KP_BLOB 0x383BFC 1 2 /end IF_DATA BIT_MASK 0x40 /end MEASUREMENT
/begin MEASUREMENT B_bkurrom "Bedingung: RechnerÅberwachung: ROM" UWORD B_TRUE___UW 0 0 0.000000 0.000000 /begin IF_DATA ASAP1B_ETK KP_BLOB 0x383BFE 1 2 /end IF_DATA BIT_MASK 0x40 /end MEASUREMENT
/begin MEASUREMENT B_bkurrst "Bedingung: RechnerÅberwachung: RESET" UWORD B_TRUE___UW 0 0 0.000000 0.000000 /begin IF_DATA ASAP1B_ETK KP_BLOB 0x383C00 1 2 /end IF_DATA BIT_MASK 0x40 /end MEASUREMENT
/begin MEASUREMENT B_bkvfz "Bedingung Ersatzwert aktiv: Fahrzeuggeschwindigkeitssignal" UWORD B_TRUE___UW 0 0 0.000000 0.000000 /begin IF_DATA ASAP1B_ETK KP_BLOB 0x383C04 1 2 /end IF_DATA BIT_MASK 0x40 /end MEASUREMENT
/begin MEASUREMENT B_bkwfs "Bedingung: Wegfahrsperre" UWORD B_TRUE___UW 0 0 0.000000 0.000000 /begin IF_DATA ASAP1B_ETK KP_BLOB 0x383C06 1 2 /end IF_DATA BIT_MASK 0x40 /end MEASUREMENT
/begin MEASUREMENT B_bkwfsrc "" UWORD B_TRUE___UW 0 0 0.000000 0.000000 /begin IF_DATA ASAP1B_ETK KP_BLOB 0x383C08 1 2 /end IF_DATA BIT_MASK 0x40 /end MEASUREMENT
/begin MEASUREMENT B_brems "Bedingung Bremse betÑtigt" UWORD B_TRUE___UW 0 0 0.000000 0.000000 /begin IF_DATA ASAP1B_ETK KP_BLOB 0xFD48 0 2 /end IF_DATA BIT_MASK 0x8 /end MEASUREMENT
/begin MEASUREMENT B_cdagr "Funktion Åber Codewort CDAGR freigegeben" UWORD B_TRUE___UW 0 0 0.000000 0.000000 /begin IF_DATA ASAP1B_ETK KP_BLOB 0x380D30 1 2 /end IF_DATA BIT_MASK 0x8000 /end MEASUREMENT
/begin MEASUREMENT B_cdhsh "Funktion Åber Codewort CDHSH freigegeben" UWORD B_TRUE___UW 0 0 0.000000 0.000000 /begin IF_DATA ASAP1B_ETK KP_BLOB 0x380D30 1 2 /end IF_DATA BIT_MASK 0x80 /end MEASUREMENT
/begin MEASUREMENT B_cdhshe "Funktion Åber Codewort CDHSHE freigegeben" UWORD B_TRUE___UW 0 0 0.000000 0.000000 /begin IF_DATA ASAP1B_ETK KP_BLOB 0x380D32 1 2 /end IF_DATA BIT_MASK 0x80 /end MEASUREMENT
/begin MEASUREMENT B_cdhsv "Funktion Åber Codewort CDHSV freigegeben" UWORD B_TRUE___UW 0 0 0.000000 0.000000 /begin IF_DATA ASAP1B_ETK KP_BLOB 0x380D30 1 2 /end IF_DATA BIT_MASK 0x40 /end MEASUREMENT
/begin MEASUREMENT B_cdkat "Funktion Åber Codewort CDKAT freigegeben" UWORD B_TRUE___UW 0 0 0.000000 0.000000 /begin IF_DATA ASAP1B_ETK KP_BLOB 0x380D30 1 2 /end IF_DATA BIT_MASK 0x100 /end MEASUREMENT
/begin MEASUREMENT B_cdldp "Funktion Åber Codewort CDLDP freigegeben" UWORD B_TRUE___UW 0 0 0.000000 0.000000 /begin IF_DATA ASAP1B_ETK KP_BLOB 0x380D30 1 2 /end IF_DATA BIT_MASK 0x4000 /end MEASUREMENT
/begin MEASUREMENT B_cdlsv "Funktion Åber Codewort CDLSV freigegeben" UWORD B_TRUE___UW 0 0 0.000000 0.000000 /begin IF_DATA ASAP1B_ETK KP_BLOB 0x380D30 1 2 /end IF_DATA BIT_MASK 0x8 /end MEASUREMENT
/begin MEASUREMENT B_cdsls "Funktion Åber Codewort CDSLS freigegeben" UWORD B_TRUE___UW 0 0 0.000000 0.000000 /begin IF_DATA ASAP1B_ETK KP_BLOB 0x380D32 1 2 /end IF_DATA BIT_MASK 0x1 /end MEASUREMENT
/begin MEASUREMENT B_cdtes "Funktion Åber Codewort CDTES freigegeben" UWORD B_TRUE___UW 0 0 0.000000 0.000000 /begin IF_DATA ASAP1B_ETK KP_BLOB 0x380D30 1 2 /end IF_DATA BIT_MASK 0x2000 /end MEASUREMENT
/begin MEASUREMENT B_clbrems "Bedingung Fehlerpfad BREMS (Bremsschalter) lîschen" UWORD B_TRUE___UW 0 0 0.000000 0.000000 /begin IF_DATA ASAP1B_ETK KP_BLOB 0x383AF8 1 2 /end IF_DATA BIT_MASK 0x80 /end MEASUREMENT
/begin MEASUREMENT B_clbwf "Flag fÅr Lîschung: PWG Bewegung" UWORD B_TRUE___UW 0 0 0.000000 0.000000 /begin IF_DATA ASAP1B_ETK KP_BLOB 0x383AFA 1 2 /end IF_DATA BIT_MASK 0x80 /end MEASUREMENT
/begin MEASUREMENT B_cldpl "Bedingung Fehler Dauerplus lîschen" UWORD B_TRUE___UW 0 0 0.000000 0.000000 /begin IF_DATA ASAP1B_ETK KP_BLOB 0x383B10 1 2 /end IF_DATA BIT_MASK 0x80 /end MEASUREMENT
/begin MEASUREMENT B_cldsl "Bedingung: Fehlerpfad Ladedrucksensor lîschen" UWORD B_TRUE___UW 0 0 0.000000 0.000000 /begin IF_DATA ASAP1B_ETK KP_BLOB 0x383B12 1 2 /end IF_DATA BIT_MASK 0x80 /end MEASUREMENT
/begin MEASUREMENT B_cldsu "Bedingung: Fehlerpfad Umgebungsdrucksensor lîschen" UWORD B_TRUE___UW 0 0 0.000000 0.000000 /begin IF_DATA ASAP1B_ETK KP_BLOB 0x383B16 1 2 /end IF_DATA BIT_MASK 0x80 /end MEASUREMENT
/begin MEASUREMENT B_cldsvlu "Bedingung: Fehlerpfad Drucksensorvergleich DS-L DS-U" UWORD B_TRUE___UW 0 0 0.000000 0.000000 /begin IF_DATA ASAP1B_ETK KP_BLOB 0x383B18 1 2 /end IF_DATA BIT_MASK 0x80 /end MEASUREMENT
/begin MEASUREMENT B_clegfe "Bedingung Fehlerpfad EGFE lîschen" UWORD B_TRUE___UW 0 0 0.000000 0.000000 /begin IF_DATA ASAP1B_ETK KP_BLOB 0x383B30 1 2 /end IF_DATA BIT_MASK 0x80 /end MEASUREMENT
/begin MEASUREMENT B_clfp1p "Flag fÅr Lîschma·nahmen: Fahrpedal 1. Poti" UWORD B_TRUE___UW 0 0 0.000000 0.000000 /begin IF_DATA ASAP1B_ETK KP_BLOB 0x383B46 1 2 /end IF_DATA BIT_MASK 0x80 /end MEASUREMENT
/begin MEASUREMENT B_clfp2p "Flag fÅr Lîschma·nahmen: Fahrpedal 2. Poti" UWORD B_TRUE___UW 0 0 0.000000 0.000000 /begin IF_DATA ASAP1B_ETK KP_BLOB 0x383B48 1 2 /end IF_DATA BIT_MASK 0x80 /end MEASUREMENT
/begin MEASUREMENT B_clfpp "Bedingung Fehlerpfad FPP (Fahrpedal-Poti) lîschen" UWORD B_TRUE___UW 0 0 0.000000 0.000000 /begin IF_DATA ASAP1B_ETK KP_BLOB 0x383B4A 1 2 /end IF_DATA BIT_MASK 0x80 /end MEASUREMENT
/begin MEASUREMENT B_clgecod "" UWORD B_TRUE___UW 0 0 0.000000 0.000000 /begin IF_DATA ASAP1B_ETK KP_BLOB 0x383B52 1 2 /end IF_DATA BIT_MASK 0x80 /end MEASUREMENT
/begin MEASUREMENT B_clgrbh "Flag fÅr Lîschma·nahmen: GRA-Bedienhebel" UWORD B_TRUE___UW 0 0 0.000000 0.000000 /begin IF_DATA ASAP1B_ETK KP_BLOB 0x383B54 1 2 /end IF_DATA BIT_MASK 0x80 /end MEASUREMENT
/begin MEASUREMENT B_clldpe "Bedingung: Fehlerpfad Endstufe LDP lîschen" UWORD B_TRUE___UW 0 0 0.000000 0.000000 /begin IF_DATA ASAP1B_ETK KP_BLOB 0x383B96 1 2 /end IF_DATA BIT_MASK 0x80 /end MEASUREMENT
/begin MEASUREMENT B_clmd "Flag fÅr Lîschung: Aussetzer, Summenfehler (multiple)" UWORD B_TRUE___UW 0 0 0.000000 0.000000 /begin IF_DATA ASAP1B_ETK KP_BLOB 0x383BA2 1 2 /end IF_DATA BIT_MASK 0x80 /end MEASUREMENT
/begin MEASUREMENT B_clmd01 "Flag fÅr Lîschung: Aussetzer ZÅndung 1" UWORD B_TRUE___UW 0 0 0.000000 0.000000 /begin IF_DATA ASAP1B_ETK KP_BLOB 0x383BA4 1 2 /end IF_DATA BIT_MASK 0x80 /end MEASUREMENT
/begin MEASUREMENT B_clmd02 "Flag fÅr Lîschung: Aussetzer ZÅndung 2" UWORD B_TRUE___UW 0 0 0.000000 0.000000 /begin IF_DATA ASAP1B_ETK KP_BLOB 0x383BA6 1 2 /end IF_DATA BIT_MASK 0x80 /end MEASUREMENT
/begin MEASUREMENT B_clmd03 "Flag fÅr Lîschung: Aussetzer ZÅndung 3" UWORD B_TRUE___UW 0 0 0.000000 0.000000 /begin IF_DATA ASAP1B_ETK KP_BLOB 0x383BA8 1 2 /end IF_DATA BIT_MASK 0x80 /end MEASUREMENT
/begin MEASUREMENT B_clmd04 "Flag fÅr Lîschung: Aussetzer ZÅndung 4" UWORD B_TRUE___UW 0 0 0.000000 0.000000 /begin IF_DATA ASAP1B_ETK KP_BLOB 0x383BAA 1 2 /end IF_DATA BIT_MASK 0x80 /end MEASUREMENT
/begin MEASUREMENT B_clmdb "Flag fÅr Lîschung: Momentenbegrenzung begrenzt dauerhaft" UWORD B_TRUE___UW 0 0 0.000000 0.000000 /begin IF_DATA ASAP1B_ETK KP_BLOB 0x383BAC 1 2 /end IF_DATA BIT_MASK 0x80 /end MEASUREMENT
/begin MEASUREMENT B_clmdk "Flag fÅr Lîschung: Aussetzer, Summenfehler - multiple, kundendienstrelevant" UWORD B_TRUE___UW 0 0 0.000000 0.000000 /begin IF_DATA ASAP1B_ETK KP_BLOB 0x383BAE 1 2 /end IF_DATA BIT_MASK 0x80 /end MEASUREMENT
/begin MEASUREMENT B_clmdk01 "Flag fÅr Lîschung: Aussetzer, ZÅndung 1, kundendienstrelevant" UWORD B_TRUE___UW 0 0 0.000000 0.000000 /begin IF_DATA ASAP1B_ETK KP_BLOB 0x383BB0 1 2 /end IF_DATA BIT_MASK 0x80 /end MEASUREMENT
/begin MEASUREMENT B_clmdk02 "Flag fÅr Lîschung: Aussetzer, ZÅndung 2, kundendienstrelevant" UWORD B_TRUE___UW 0 0 0.000000 0.000000 /begin IF_DATA ASAP1B_ETK KP_BLOB 0x383BB2 1 2 /end IF_DATA BIT_MASK 0x80 /end MEASUREMENT
/begin MEASUREMENT B_clmdk03 "Flag fÅr Lîschung: Aussetzer, ZÅndung 3, kundendienstrelevant" UWORD B_TRUE___UW 0 0 0.000000 0.000000 /begin IF_DATA ASAP1B_ETK KP_BLOB 0x383BB4 1 2 /end IF_DATA BIT_MASK 0x80 /end MEASUREMENT
/begin MEASUREMENT B_clmdk04 "Flag fÅr Lîschung: Aussetzer, ZÅndung 4, kundendienstrelevant" UWORD B_TRUE___UW 0 0 0.000000 0.000000 /begin IF_DATA ASAP1B_ETK KP_BLOB 0x383BB6 1 2 /end IF_DATA BIT_MASK 0x80 /end MEASUREMENT
/begin MEASUREMENT B_clnwkw "Bedingung Fehlerpfad Zuordnung Nockenwelle zu Kurbelwelle lîschen" UWORD B_TRUE___UW 0 0 0.000000 0.000000 /begin IF_DATA ASAP1B_ETK KP_BLOB 0x383BBC 1 2 /end IF_DATA BIT_MASK 0x80 /end MEASUREMENT
/begin MEASUREMENT B_clnwkw2 "Bedingung Fehlerpfad Zuordnung Nockenwelle 2 zu Kurbelwelle lîschen" UWORD B_TRUE___UW 0 0 0.000000 0.000000 /begin IF_DATA ASAP1B_ETK KP_BLOB 0x383BBE 1 2 /end IF_DATA BIT_MASK 0x80 /end MEASUREMENT
/begin MEASUREMENT B_clnws "Bedingung Fehlerpfad Nockenwellensteuerung lîschen" UWORD B_TRUE___UW 0 0 0.000000 0.000000 /begin IF_DATA ASAP1B_ETK KP_BLOB 0x383BC0 1 2 /end IF_DATA BIT_MASK 0x80 /end MEASUREMENT
/begin MEASUREMENT B_clnws2 "Bedingung Fehlerphad Nockenwellensteuerung 2 lîschen" UWORD B_TRUE___UW 0 0 0.000000 0.000000 /begin IF_DATA ASAP1B_ETK KP_BLOB 0x383BC2 1 2 /end IF_DATA BIT_MASK 0x80 /end MEASUREMENT
/begin MEASUREMENT B_clnx "Flag fÅr Lîschung: öberdrehzahl" UWORD B_TRUE___UW 0 0 0.000000 0.000000 /begin IF_DATA ASAP1B_ETK KP_BLOB 0x383BC6 1 2 /end IF_DATA BIT_MASK 0x80 /end MEASUREMENT
/begin MEASUREMENT B_clph "Bedingung Fehlerpfad PH lîschen" UWORD B_TRUE___UW 0 0 0.000000 0.000000 /begin IF_DATA ASAP1B_ETK KP_BLOB 0x383BC8 1 2 /end IF_DATA BIT_MASK 0x80 /end MEASUREMENT
/begin MEASUREMENT B_clpwm "Bedingung Fehlerpfad PWM- Signal lîschen" UWORD B_TRUE___UW 0 0 0.000000 0.000000 /begin IF_DATA ASAP1B_ETK KP_BLOB 0x383BCA 1 2 /end IF_DATA BIT_MASK 0x80 /end MEASUREMENT
/begin MEASUREMENT B_clsgeew "Bedingung SteuergerÑt defekt  (EEPROM-WFS) lîschen" UWORD B_TRUE___UW 0 0 0.000000 0.000000 /begin IF_DATA ASAP1B_ETK KP_BLOB 0x383BD0 1 2 /end IF_DATA BIT_MASK 0x80 /end MEASUREMENT
/begin MEASUREMENT B_clsls "Bedingung: Fehler SekundÑrluftsystem lîschen" UWORD B_TRUE___UW 0 0 0.000000 0.000000 /begin IF_DATA ASAP1B_ETK KP_BLOB 0x383BD4 1 2 /end IF_DATA BIT_MASK 0x80 /end MEASUREMENT
/begin MEASUREMENT B_clslv "Bedingung: Fehler SekundÑrluftventil lîschen" UWORD B_TRUE___UW 0 0 0.000000 0.000000 /begin IF_DATA ASAP1B_ETK KP_BLOB 0x383BD6 1 2 /end IF_DATA BIT_MASK 0x80 /end MEASUREMENT
/begin MEASUREMENT B_clslwg "" UWORD B_TRUE___UW 0 0 0.000000 0.000000 /begin IF_DATA ASAP1B_ETK KP_BLOB 0x383BDA 1 2 /end IF_DATA BIT_MASK 0x80 /end MEASUREMENT
/begin MEASUREMENT B_clswe "Flag : Fehlerpfad Diagnose Beschleunigungssensor lîschen" UWORD B_TRUE___UW 0 0 0.000000 0.000000 /begin IF_DATA ASAP1B_ETK KP_BLOB 0x383BDE 1 2 /end IF_DATA BIT_MASK 0x80 /end MEASUREMENT
/begin MEASUREMENT B_clta "Bedingung Fehlerpfad Ansauglufttemperatur (/Ladeluft-) TANS lîschen" UWORD B_TRUE___UW 0 0 0.000000 0.000000 /begin IF_DATA ASAP1B_ETK KP_BLOB 0x383BE0 1 2 /end IF_DATA BIT_MASK 0x80 /end MEASUREMENT
/begin MEASUREMENT B_cltes "Bedingung Fehlerflag 'TankentlÅftungssystem offen' lîschen" UWORD B_TRUE___UW 0 0 0.000000 0.000000 /begin IF_DATA ASAP1B_ETK KP_BLOB 0x383BE4 1 2 /end IF_DATA BIT_MASK 0x80 /end MEASUREMENT
/begin MEASUREMENT B_cltm "Bedingung Fehlerpfad Motortemperatur TMOT lîschen" UWORD B_TRUE___UW 0 0 0.000000 0.000000 /begin IF_DATA ASAP1B_ETK KP_BLOB 0x383BEE 1 2 /end IF_DATA BIT_MASK 0x80 /end MEASUREMENT
/begin MEASUREMENT B_cltun "Bedingung: Fehler Tuningschutz lîschen" UWORD B_TRUE___UW 0 0 0.000000 0.000000 /begin IF_DATA ASAP1B_ETK KP_BLOB 0x383BF4 1 2 /end IF_DATA BIT_MASK 0x80 /end MEASUREMENT
/begin MEASUREMENT B_club "Bedingung Fehlerpfad Batteriespannung (Bordnetz) lîschen" UWORD B_TRUE___UW 0 0 0.000000 0.000000 /begin IF_DATA ASAP1B_ETK KP_BLOB 0x383BF6 1 2 /end IF_DATA BIT_MASK 0x80 /end MEASUREMENT
/begin MEASUREMENT B_clufmv "Flag fÅr Lîschung: FunktionsÅberwachung: Momentenvergleich" UWORD B_TRUE___UW 0 0 0.000000 0.000000 /begin IF_DATA ASAP1B_ETK KP_BLOB 0x383BF8 1 2 /end IF_DATA BIT_MASK 0x80 /end MEASUREMENT
/begin MEASUREMENT B_clufska "Flag fÅr Lîschung: FunktionsÅberwachung: Sicherheits-Kraftstoff-Abschaltung" UWORD B_TRUE___UW 0 0 0.000000 0.000000 /begin IF_DATA ASAP1B_ETK KP_BLOB 0x383BFA 1 2 /end IF_DATA BIT_MASK 0x80 /end MEASUREMENT
/begin MEASUREMENT B_clurram "Flag fÅr Lîschung: RechnerÅberwachung: RAM" UWORD B_TRUE___UW 0 0 0.000000 0.000000 /begin IF_DATA ASAP1B_ETK KP_BLOB 0x383BFC 1 2 /end IF_DATA BIT_MASK 0x80 /end MEASUREMENT
/begin MEASUREMENT B_clurrom "Flag fÅr Lîschung: RechnerÅberwachung: ROM" UWORD B_TRUE___UW 0 0 0.000000 0.000000 /begin IF_DATA ASAP1B_ETK KP_BLOB 0x383BFE 1 2 /end IF_DATA BIT_MASK 0x80 /end MEASUREMENT
/begin MEASUREMENT B_clurrst "Flag fÅr Lîschung: RechnerÅberwachung: Reset" UWORD B_TRUE___UW 0 0 0.000000 0.000000 /begin IF_DATA ASAP1B_ETK KP_BLOB 0x383C00 1 2 /end IF_DATA BIT_MASK 0x80 /end MEASUREMENT
/begin MEASUREMENT B_clvfz "Bedingung Fehlerpfad VFZ (Fahrzeuggeschwindigkeit) lîschen" UWORD B_TRUE___UW 0 0 0.000000 0.000000 /begin IF_DATA ASAP1B_ETK KP_BLOB 0x383C04 1 2 /end IF_DATA BIT_MASK 0x80 /end MEASUREMENT
/begin MEASUREMENT B_clwfs "Bedingung Wegfahrsperre lîschen" UWORD B_TRUE___UW 0 0 0.000000 0.000000 /begin IF_DATA ASAP1B_ETK KP_BLOB 0x383C06 1 2 /end IF_DATA BIT_MASK 0x80 /end MEASUREMENT
/begin MEASUREMENT B_clwfsrc "" UWORD B_TRUE___UW 0 0 0.000000 0.000000 /begin IF_DATA ASAP1B_ETK KP_BLOB 0x383C08 1 2 /end IF_DATA BIT_MASK 0x80 /end MEASUREMENT
/begin MEASUREMENT B_cwdslt "Bedingung: Freigabe VentildichtheitsprÅfung" UWORD B_TRUE___UW 0 0 0.000000 0.000000 /begin IF_DATA ASAP1B_ETK KP_BLOB 0x380EFC 1 2 /end IF_DATA BIT_MASK 0x1 /end MEASUREMENT
/begin MEASUREMENT B_desee "Diagnose Endstufe: Eingangsbedingungen erfÅllt" UWORD B_TRUE___UW 0 0 0.000000 0.000000 /begin IF_DATA ASAP1B_ETK KP_BLOB 0xFD54 0 2 /end IF_DATA BIT_MASK 0x100 /end MEASUREMENT
/begin MEASUREMENT B_dkini "Bedingung fÅr DKAT-Funktion initialisieren" UWORD B_TRUE___UW 0 0 0.000000 0.000000 /begin IF_DATA ASAP1B_ETK KP_BLOB 0xFD2E 0 2 /end IF_DATA BIT_MASK 0x800 /end MEASUREMENT
/begin MEASUREMENT B_dklpi "interne Umschaltung d. Lambdregelungsparameter angefordert" UWORD B_TRUE___UW 0 0 0.000000 0.000000 /begin IF_DATA ASAP1B_ETK KP_BLOB 0xFD2E 0 2 /end IF_DATA BIT_MASK 0x1000 /end MEASUREMENT
/begin MEASUREMENT B_dktakt "DKAT-Funktion aktiv" UWORD B_TRUE___UW 0 0 0.000000 0.000000 /begin IF_DATA ASAP1B_ETK KP_BLOB 0xFD2E 0 2 /end IF_DATA BIT_MASK 0x2000 /end MEASUREMENT
/begin MEASUREMENT B_dkten "DKAT fÅr diesen Trip nicht mehr aktiv" UWORD B_TRUE___UW 0 0 0.000000 0.000000 /begin IF_DATA ASAP1B_ETK KP_BLOB 0xFD2E 0 2 /end IF_DATA BIT_MASK 0x4000 /end MEASUREMENT
/begin MEASUREMENT B_dktlp "Umschaltung der Lambdaregelungsparameter angefordert" UWORD B_TRUE___UW 0 0 0.000000 0.000000 /begin IF_DATA ASAP1B_ETK KP_BLOB 0xFD2E 0 2 /end IF_DATA BIT_MASK 0x8000 /end MEASUREMENT
/begin MEASUREMENT B_dktnr "DKAT: n/rl-Bereich verlassen" UWORD B_TRUE___UW 0 0 0.000000 0.000000 /begin IF_DATA ASAP1B_ETK KP_BLOB 0xFD30 0 2 /end IF_DATA BIT_MASK 0x1 /end MEASUREMENT
/begin MEASUREMENT B_dktsb "Bankspezifische Stoppbedingung" UWORD B_TRUE___UW 0 0 0.000000 0.000000 /begin IF_DATA ASAP1B_ETK KP_BLOB 0xFD30 0 2 /end IF_DATA BIT_MASK 0x2 /end MEASUREMENT
/begin MEASUREMENT B_dktsp "physikalische Stoppbedingung" UWORD B_TRUE___UW 0 0 0.000000 0.000000 /begin IF_DATA ASAP1B_ETK KP_BLOB 0xFD30 0 2 /end IF_DATA BIT_MASK 0x4 /end MEASUREMENT
/begin MEASUREMENT B_dktst "DKAT-Funktion ist gestoppt (B_dktst=FALSE)" UWORD B_TRUE___UW 0 0 0.000000 0.000000 /begin IF_DATA ASAP1B_ETK KP_BLOB 0xFD30 0 2 /end IF_DATA BIT_MASK 0x8 /end MEASUREMENT
/begin MEASUREMENT B_dktt "DKAT-Aktiv-Zeit abgelaufen" UWORD B_TRUE___UW 0 0 0.000000 0.000000 /begin IF_DATA ASAP1B_ETK KP_BLOB 0xFD30 0 2 /end IF_DATA BIT_MASK 0x10 /end MEASUREMENT
/begin MEASUREMENT B_dkttk "Katdiagnose temperaturbedingt gesperrt (Kat-Temperatur)" UWORD B_TRUE___UW 0 0 0.000000 0.000000 /begin IF_DATA ASAP1B_ETK KP_BLOB 0xFD30 0 2 /end IF_DATA BIT_MASK 0x20 /end MEASUREMENT
/begin MEASUREMENT B_dnt "Aktive Diagnose: Klopfregelung Nulltest" UWORD B_TRUE___UW 0 0 0.000000 0.000000 /begin IF_DATA ASAP1B_ETK KP_BLOB 0xFD6E 0 2 /end IF_DATA BIT_MASK 0x800 /end MEASUREMENT
/begin MEASUREMENT B_ds "KR: Sensordiagnose aktiv" UWORD B_TRUE___UW 0 0 0.000000 0.000000 /begin IF_DATA ASAP1B_ETK KP_BLOB 0xFD74 0 2 /end IF_DATA BIT_MASK 0x10 /end MEASUREMENT
/begin MEASUREMENT B_dsls "Aktive Diagnose: SekundÑrluft-System" UWORD B_TRUE___UW 0 0 0.000000 0.000000 /begin IF_DATA ASAP1B_ETK KP_BLOB 0xFD0C 0 2 /end IF_DATA BIT_MASK 0x2 /end MEASUREMENT
/begin MEASUREMENT B_dtes "Aktive Diagnose: TankentlÅftungssystem" UWORD B_TRUE___UW 0 0 0.000000 0.000000 /begin IF_DATA ASAP1B_ETK KP_BLOB 0xFD8C 0 2 /end IF_DATA BIT_MASK 0x800 /end MEASUREMENT
/begin MEASUREMENT B_dtp "Aktive Diagnose: Klopfregelung Testimpuls" UWORD B_TRUE___UW 0 0 0.000000 0.000000 /begin IF_DATA ASAP1B_ETK KP_BLOB 0xFD6E 0 2 /end IF_DATA BIT_MASK 0x2000 /end MEASUREMENT
/begin MEASUREMENT B_edkvs "Bedingung Adaptionsfehlerschwellen aktuell Åberschritten" UWORD B_TRUE___UW 0 0 0.000000 0.000000 /begin IF_DATA ASAP1B_ETK KP_BLOB 0xFD64 0 2 /end IF_DATA BIT_MASK 0x4000 /end MEASUREMENT
/begin MEASUREMENT B_ehfs "Bedingung Ersatzwert HauptfÅllungssensor" UWORD B_TRUE___UW 0 0 0.000000 0.000000 /begin IF_DATA ASAP1B_ETK KP_BLOB 0xFD56 0 2 /end IF_DATA BIT_MASK 0x20 /end MEASUREMENT
/begin MEASUREMENT B_ehsh "Bedingung Error HSH" UWORD B_TRUE___UW 0 0 0.000000 0.000000 /begin IF_DATA ASAP1B_ETK KP_BLOB 0xFD22 0 2 /end IF_DATA BIT_MASK 0x8 /end MEASUREMENT
/begin MEASUREMENT B_ekats "Summenfehler fÅr MODE 6" UWORD B_TRUE___UW 0 0 0.000000 0.000000 /begin IF_DATA ASAP1B_ETK KP_BLOB 0xFD30 0 2 /end IF_DATA BIT_MASK 0x40 /end MEASUREMENT
/begin MEASUREMENT B_erdkt "Interner Fehler Kat-öberwachung" UWORD B_TRUE___UW 0 0 0.000000 0.000000 /begin IF_DATA ASAP1B_ETK KP_BLOB 0xFD30 0 2 /end IF_DATA BIT_MASK 0x80 /end MEASUREMENT
/begin MEASUREMENT B_fa "Bedingung Funktionsanforderung allgemein" UWORD B_TRUE___UW 0 0 0.000000 0.000000 /begin IF_DATA ASAP1B_ETK KP_BLOB 0xFD74 0 2 /end IF_DATA BIT_MASK 0x100 /end MEASUREMENT
/begin MEASUREMENT B_fakat "Bedingung Funktionsanforderung KatalysatorÅberwachung" UWORD B_TRUE___UW 0 0 0.000000 0.000000 /begin IF_DATA ASAP1B_ETK KP_BLOB 0xFD74 0 2 /end IF_DATA BIT_MASK 0x2000 /end MEASUREMENT
/begin MEASUREMENT B_frmax "Lambda-Regelung setzt Bit sobald FR am Anschlag FRMAX" UWORD B_TRUE___UW 0 0 0.000000 0.000000 /begin IF_DATA ASAP1B_ETK KP_BLOB 0xFD9A 0 2 /end IF_DATA BIT_MASK 0x100 /end MEASUREMENT
/begin MEASUREMENT B_frmin "Lambda-Regelung setzt Bit sobald FR am Anschlag FRMIN" UWORD B_TRUE___UW 0 0 0.000000 0.000000 /begin IF_DATA ASAP1B_ETK KP_BLOB 0xFD9A 0 2 /end IF_DATA BIT_MASK 0x400 /end MEASUREMENT
/begin MEASUREMENT B_ftbrems "" UWORD B_TRUE___UW 0 0 0.000000 0.000000 /begin IF_DATA ASAP1B_ETK KP_BLOB 0x383AF8 1 2 /end IF_DATA BIT_MASK 0x10 /end MEASUREMENT
/begin MEASUREMENT B_ftbwf "" UWORD B_TRUE___UW 0 0 0.000000 0.000000 /begin IF_DATA ASAP1B_ETK KP_BLOB 0x383AFA 1 2 /end IF_DATA BIT_MASK 0x10 /end MEASUREMENT
/begin MEASUREMENT B_ftdpl "" UWORD B_TRUE___UW 0 0 0.000000 0.000000 /begin IF_DATA ASAP1B_ETK KP_BLOB 0x383B10 1 2 /end IF_DATA BIT_MASK 0x10 /end MEASUREMENT
/begin MEASUREMENT B_ftdsl "" UWORD B_TRUE___UW 0 0 0.000000 0.000000 /begin IF_DATA ASAP1B_ETK KP_BLOB 0x383B12 1 2 /end IF_DATA BIT_MASK 0x10 /end MEASUREMENT
/begin MEASUREMENT B_ftdsu "" UWORD B_TRUE___UW 0 0 0.000000 0.000000 /begin IF_DATA ASAP1B_ETK KP_BLOB 0x383B16 1 2 /end IF_DATA BIT_MASK 0x10 /end MEASUREMENT
/begin MEASUREMENT B_ftdsvlu "" UWORD B_TRUE___UW 0 0 0.000000 0.000000 /begin IF_DATA ASAP1B_ETK KP_BLOB 0x383B18 1 2 /end IF_DATA BIT_MASK 0x10 /end MEASUREMENT
/begin MEASUREMENT B_ftegfe "" UWORD B_TRUE___UW 0 0 0.000000 0.000000 /begin IF_DATA ASAP1B_ETK KP_BLOB 0x383B30 1 2 /end IF_DATA BIT_MASK 0x10 /end MEASUREMENT
/begin MEASUREMENT B_ftfp1p "" UWORD B_TRUE___UW 0 0 0.000000 0.000000 /begin IF_DATA ASAP1B_ETK KP_BLOB 0x383B46 1 2 /end IF_DATA BIT_MASK 0x10 /end MEASUREMENT
/begin MEASUREMENT B_ftfp2p "" UWORD B_TRUE___UW 0 0 0.000000 0.000000 /begin IF_DATA ASAP1B_ETK KP_BLOB 0x383B48 1 2 /end IF_DATA BIT_MASK 0x10 /end MEASUREMENT
/begin MEASUREMENT B_ftfpp "" UWORD B_TRUE___UW 0 0 0.000000 0.000000 /begin IF_DATA ASAP1B_ETK KP_BLOB 0x383B4A 1 2 /end IF_DATA BIT_MASK 0x10 /end MEASUREMENT
/begin MEASUREMENT B_ftgecod "" UWORD B_TRUE___UW 0 0 0.000000 0.000000 /begin IF_DATA ASAP1B_ETK KP_BLOB 0x383B52 1 2 /end IF_DATA BIT_MASK 0x10 /end MEASUREMENT
/begin MEASUREMENT B_ftgrbh "" UWORD B_TRUE___UW 0 0 0.000000 0.000000 /begin IF_DATA ASAP1B_ETK KP_BLOB 0x383B54 1 2 /end IF_DATA BIT_MASK 0x10 /end MEASUREMENT
/begin MEASUREMENT B_ftldpe "" UWORD B_TRUE___UW 0 0 0.000000 0.000000 /begin IF_DATA ASAP1B_ETK KP_BLOB 0x383B96 1 2 /end IF_DATA BIT_MASK 0x10 /end MEASUREMENT
/begin MEASUREMENT B_ftmd "" UWORD B_TRUE___UW 0 0 0.000000 0.000000 /begin IF_DATA ASAP1B_ETK KP_BLOB 0x383BA2 1 2 /end IF_DATA BIT_MASK 0x10 /end MEASUREMENT
/begin MEASUREMENT B_ftmd01 "" UWORD B_TRUE___UW 0 0 0.000000 0.000000 /begin IF_DATA ASAP1B_ETK KP_BLOB 0x383BA4 1 2 /end IF_DATA BIT_MASK 0x10 /end MEASUREMENT
/begin MEASUREMENT B_ftmd02 "" UWORD B_TRUE___UW 0 0 0.000000 0.000000 /begin IF_DATA ASAP1B_ETK KP_BLOB 0x383BA6 1 2 /end IF_DATA BIT_MASK 0x10 /end MEASUREMENT
/begin MEASUREMENT B_ftmd03 "" UWORD B_TRUE___UW 0 0 0.000000 0.000000 /begin IF_DATA ASAP1B_ETK KP_BLOB 0x383BA8 1 2 /end IF_DATA BIT_MASK 0x10 /end MEASUREMENT
/begin MEASUREMENT B_ftmd04 "" UWORD B_TRUE___UW 0 0 0.000000 0.000000 /begin IF_DATA ASAP1B_ETK KP_BLOB 0x383BAA 1 2 /end IF_DATA BIT_MASK 0x10 /end MEASUREMENT
/begin MEASUREMENT B_ftmdb "" UWORD B_TRUE___UW 0 0 0.000000 0.000000 /begin IF_DATA ASAP1B_ETK KP_BLOB 0x383BAC 1 2 /end IF_DATA BIT_MASK 0x10 /end MEASUREMENT
/begin MEASUREMENT B_ftmdk "" UWORD B_TRUE___UW 0 0 0.000000 0.000000 /begin IF_DATA ASAP1B_ETK KP_BLOB 0x383BAE 1 2 /end IF_DATA BIT_MASK 0x10 /end MEASUREMENT
/begin MEASUREMENT B_ftmdk01 "" UWORD B_TRUE___UW 0 0 0.000000 0.000000 /begin IF_DATA ASAP1B_ETK KP_BLOB 0x383BB0 1 2 /end IF_DATA BIT_MASK 0x10 /end MEASUREMENT
/begin MEASUREMENT B_ftmdk02 "" UWORD B_TRUE___UW 0 0 0.000000 0.000000 /begin IF_DATA ASAP1B_ETK KP_BLOB 0x383BB2 1 2 /end IF_DATA BIT_MASK 0x10 /end MEASUREMENT
/begin MEASUREMENT B_ftmdk03 "" UWORD B_TRUE___UW 0 0 0.000000 0.000000 /begin IF_DATA ASAP1B_ETK KP_BLOB 0x383BB4 1 2 /end IF_DATA BIT_MASK 0x10 /end MEASUREMENT
/begin MEASUREMENT B_ftmdk04 "" UWORD B_TRUE___UW 0 0 0.000000 0.000000 /begin IF_DATA ASAP1B_ETK KP_BLOB 0x383BB6 1 2 /end IF_DATA BIT_MASK 0x10 /end MEASUREMENT
/begin MEASUREMENT B_ftnwkw "" UWORD B_TRUE___UW 0 0 0.000000 0.000000 /begin IF_DATA ASAP1B_ETK KP_BLOB 0x383BBC 1 2 /end IF_DATA BIT_MASK 0x10 /end MEASUREMENT
/begin MEASUREMENT B_ftnwkw2 "" UWORD B_TRUE___UW 0 0 0.000000 0.000000 /begin IF_DATA ASAP1B_ETK KP_BLOB 0x383BBE 1 2 /end IF_DATA BIT_MASK 0x10 /end MEASUREMENT
/begin MEASUREMENT B_ftnws "" UWORD B_TRUE___UW 0 0 0.000000 0.000000 /begin IF_DATA ASAP1B_ETK KP_BLOB 0x383BC0 1 2 /end IF_DATA BIT_MASK 0x10 /end MEASUREMENT
/begin MEASUREMENT B_ftnws2 "" UWORD B_TRUE___UW 0 0 0.000000 0.000000 /begin IF_DATA ASAP1B_ETK KP_BLOB 0x383BC2 1 2 /end IF_DATA BIT_MASK 0x10 /end MEASUREMENT
/begin MEASUREMENT B_ftnx "" UWORD B_TRUE___UW 0 0 0.000000 0.000000 /begin IF_DATA ASAP1B_ETK KP_BLOB 0x383BC6 1 2 /end IF_DATA BIT_MASK 0x10 /end MEASUREMENT
/begin MEASUREMENT B_ftph "Bedingung Fehlereintrag durch Tester fÅr Phasensensor" UWORD B_TRUE___UW 0 0 0.000000 0.000000 /begin IF_DATA ASAP1B_ETK KP_BLOB 0x383BC8 1 2 /end IF_DATA BIT_MASK 0x10 /end MEASUREMENT
/begin MEASUREMENT B_ftpwm "" UWORD B_TRUE___UW 0 0 0.000000 0.000000 /begin IF_DATA ASAP1B_ETK KP_BLOB 0x383BCA 1 2 /end IF_DATA BIT_MASK 0x10 /end MEASUREMENT
/begin MEASUREMENT B_ftsgeew "" UWORD B_TRUE___UW 0 0 0.000000 0.000000 /begin IF_DATA ASAP1B_ETK KP_BLOB 0x383BD0 1 2 /end IF_DATA BIT_MASK 0x10 /end MEASUREMENT
/begin MEASUREMENT B_ftsls "" UWORD B_TRUE___UW 0 0 0.000000 0.000000 /begin IF_DATA ASAP1B_ETK KP_BLOB 0x383BD4 1 2 /end IF_DATA BIT_MASK 0x10 /end MEASUREMENT
/begin MEASUREMENT B_ftslv "" UWORD B_TRUE___UW 0 0 0.000000 0.000000 /begin IF_DATA ASAP1B_ETK KP_BLOB 0x383BD6 1 2 /end IF_DATA BIT_MASK 0x10 /end MEASUREMENT
/begin MEASUREMENT B_ftslwg "" UWORD B_TRUE___UW 0 0 0.000000 0.000000 /begin IF_DATA ASAP1B_ETK KP_BLOB 0x383BDA 1 2 /end IF_DATA BIT_MASK 0x10 /end MEASUREMENT
/begin MEASUREMENT B_ftswe "" UWORD B_TRUE___UW 0 0 0.000000 0.000000 /begin IF_DATA ASAP1B_ETK KP_BLOB 0x383BDE 1 2 /end IF_DATA BIT_MASK 0x10 /end MEASUREMENT
/begin MEASUREMENT B_ftta "" UWORD B_TRUE___UW 0 0 0.000000 0.000000 /begin IF_DATA ASAP1B_ETK KP_BLOB 0x383BE0 1 2 /end IF_DATA BIT_MASK 0x10 /end MEASUREMENT
/begin MEASUREMENT B_fttes "Bedingung Fehlereintrag durch Tester fÅr TEV" UWORD B_TRUE___UW 0 0 0.000000 0.000000 /begin IF_DATA ASAP1B_ETK KP_BLOB 0x383BE4 1 2 /end IF_DATA BIT_MASK 0x10 /end MEASUREMENT
/begin MEASUREMENT B_fttm "" UWORD B_TRUE___UW 0 0 0.000000 0.000000 /begin IF_DATA ASAP1B_ETK KP_BLOB 0x383BEE 1 2 /end IF_DATA BIT_MASK 0x10 /end MEASUREMENT
/begin MEASUREMENT B_fttun "" UWORD B_TRUE___UW 0 0 0.000000 0.000000 /begin IF_DATA ASAP1B_ETK KP_BLOB 0x383BF4 1 2 /end IF_DATA BIT_MASK 0x10 /end MEASUREMENT
/begin MEASUREMENT B_ftub "Bedingung Fehlereintrag durch Tester fÅr Batteriespannung (Bordnetz)" UWORD B_TRUE___UW 0 0 0.000000 0.000000 /begin IF_DATA ASAP1B_ETK KP_BLOB 0x383BF6 1 2 /end IF_DATA BIT_MASK 0x10 /end MEASUREMENT
/begin MEASUREMENT B_ftufmv "" UWORD B_TRUE___UW 0 0 0.000000 0.000000 /begin IF_DATA ASAP1B_ETK KP_BLOB 0x383BF8 1 2 /end IF_DATA BIT_MASK 0x10 /end MEASUREMENT
/begin MEASUREMENT B_ftufska "" UWORD B_TRUE___UW 0 0 0.000000 0.000000 /begin IF_DATA ASAP1B_ETK KP_BLOB 0x383BFA 1 2 /end IF_DATA BIT_MASK 0x10 /end MEASUREMENT
/begin MEASUREMENT B_fturram "" UWORD B_TRUE___UW 0 0 0.000000 0.000000 /begin IF_DATA ASAP1B_ETK KP_BLOB 0x383BFC 1 2 /end IF_DATA BIT_MASK 0x10 /end MEASUREMENT
/begin MEASUREMENT B_fturrom "" UWORD B_TRUE___UW 0 0 0.000000 0.000000 /begin IF_DATA ASAP1B_ETK KP_BLOB 0x383BFE 1 2 /end IF_DATA BIT_MASK 0x10 /end MEASUREMENT
/begin MEASUREMENT B_fturrst "" UWORD B_TRUE___UW 0 0 0.000000 0.000000 /begin IF_DATA ASAP1B_ETK KP_BLOB 0x383C00 1 2 /end IF_DATA BIT_MASK 0x10 /end MEASUREMENT
/begin MEASUREMENT B_ftvfz "" UWORD B_TRUE___UW 0 0 0.000000 0.000000 /begin IF_DATA ASAP1B_ETK KP_BLOB 0x383C04 1 2 /end IF_DATA BIT_MASK 0x10 /end MEASUREMENT
/begin MEASUREMENT B_ftwfs "" UWORD B_TRUE___UW 0 0 0.000000 0.000000 /begin IF_DATA ASAP1B_ETK KP_BLOB 0x383C06 1 2 /end IF_DATA BIT_MASK 0x10 /end MEASUREMENT
/begin MEASUREMENT B_ftwfsrc "" UWORD B_TRUE___UW 0 0 0.000000 0.000000 /begin IF_DATA ASAP1B_ETK KP_BLOB 0x383C08 1 2 /end IF_DATA BIT_MASK 0x10 /end MEASUREMENT
/begin MEASUREMENT B_gangok "Bedingung Gangwechselerkennung prinziell erlaubt" UWORD B_TRUE___UW 0 0 0.000000 0.000000 /begin IF_DATA ASAP1B_ETK KP_BLOB 0xFD3A 0 2 /end IF_DATA BIT_MASK 0x40 /end MEASUREMENT
/begin MEASUREMENT B_hfm "Bedingung HFM messbereit" UWORD B_TRUE___UW 0 0 0.000000 0.000000 /begin IF_DATA ASAP1B_ETK KP_BLOB 0xFD56 0 2 /end IF_DATA BIT_MASK 0x40 /end MEASUREMENT
/begin MEASUREMENT B_hshe "Bedingung Endstufe Sondenheizung hinter Kat angesteuert" UWORD B_TRUE___UW 0 0 0.000000 0.000000 /begin IF_DATA ASAP1B_ETK KP_BLOB 0xFD32 0 2 /end IF_DATA BIT_MASK 0x1000 /end MEASUREMENT
/begin MEASUREMENT B_hsokh "Bedingung Sondenheizung OK hinter Kat" UWORD B_TRUE___UW 0 0 0.000000 0.000000 /begin IF_DATA ASAP1B_ETK KP_BLOB 0xFD22 0 2 /end IF_DATA BIT_MASK 0x10 /end MEASUREMENT
/begin MEASUREMENT B_hsrdy "Bedingung Sondenheizung geprÅft fÅr 'ready-Byte'" UBYTE B_TRUE 0 0 0.000000 0.000000 /begin IF_DATA ASAP1B_ETK KP_BLOB 0x383312 1 1 /end IF_DATA BIT_MASK 0x40 /end MEASUREMENT
/begin MEASUREMENT B_hsve "Bedingung Endstufe Sondenheizung vor Kat angesteuert" UWORD B_TRUE___UW 0 0 0.000000 0.000000 /begin IF_DATA ASAP1B_ETK KP_BLOB 0xFD34 0 2 /end IF_DATA BIT_MASK 0x4 /end MEASUREMENT
/begin MEASUREMENT B_katfz "Bedingung Kat in Fahrzeug eingebaut" UWORD B_TRUE___UW 0 0 0.000000 0.000000 /begin IF_DATA ASAP1B_ETK KP_BLOB 0xFD00 0 2 /end IF_DATA BIT_MASK 0x4000 /end MEASUREMENT
/begin MEASUREMENT B_kath "Bedingung Kat Heizung in Fahrzeug eingebaut" UWORD B_TRUE___UW 0 0 0.000000 0.000000 /begin IF_DATA ASAP1B_ETK KP_BLOB 0xFD00 0 2 /end IF_DATA BIT_MASK 0x8000 /end MEASUREMENT
/begin MEASUREMENT B_kathrdy "" UBYTE B_TRUE 0 0 0.000000 0.000000 /begin IF_DATA ASAP1B_ETK KP_BLOB 0x383312 1 1 /end IF_DATA BIT_MASK 0x2 /end MEASUREMENT
/begin MEASUREMENT B_katrdy "Bedingung Katalysatoren geprÅft fÅr 'ready-Byte'" UBYTE B_TRUE 0 0 0.000000 0.000000 /begin IF_DATA ASAP1B_ETK KP_BLOB 0x383312 1 1 /end IF_DATA BIT_MASK 0x1 /end MEASUREMENT
/begin MEASUREMENT B_kkrdy "" UBYTE B_TRUE 0 0 0.000000 0.000000 /begin IF_DATA ASAP1B_ETK KP_BLOB 0x383312 1 1 /end IF_DATA BIT_MASK 0x10 /end MEASUREMENT
/begin MEASUREMENT B_kl "Bedingung fÅr erkannte Klopfer" UWORD B_TRUE___UW 0 0 0.000000 0.000000 /begin IF_DATA ASAP1B_ETK KP_BLOB 0xFD70 0 2 /end IF_DATA BIT_MASK 0x20 /end MEASUREMENT
/begin MEASUREMENT B_kr "Bedingung Klopfregelung aktiv" UWORD B_TRUE___UW 0 0 0.000000 0.000000 /begin IF_DATA ASAP1B_ETK KP_BLOB 0xFD70 0 2 /end IF_DATA BIT_MASK 0x40 /end MEASUREMENT
/begin MEASUREMENT B_krfdks "Bedingung Freigabe Diagnose KS" UWORD B_TRUE___UW 0 0 0.000000 0.000000 /begin IF_DATA ASAP1B_ETK KP_BLOB 0xFD70 0 2 /end IF_DATA BIT_MASK 0x400 /end MEASUREMENT
/begin MEASUREMENT B_krldy "Bedingung Lastdynamik fÅr Klopferkennung aktiv" UWORD B_TRUE___UW 0 0 0.000000 0.000000 /begin IF_DATA ASAP1B_ETK KP_BLOB 0xFD72 0 2 /end IF_DATA BIT_MASK 0x200 /end MEASUREMENT
/begin MEASUREMENT B_krndy "Bedingung Drehzahldynamik fÅr Klopferkennung aktiv" UWORD B_TRUE___UW 0 0 0.000000 0.000000 /begin IF_DATA ASAP1B_ETK KP_BLOB 0xFD72 0 2 /end IF_DATA BIT_MASK 0x4000 /end MEASUREMENT
/begin MEASUREMENT B_krwa "Klopfregelung am Anschlag" UWORD B_TRUE___UW 0 0 0.000000 0.000000 /begin IF_DATA ASAP1B_ETK KP_BLOB 0xFD70 0 2 /end IF_DATA BIT_MASK 0x8000 /end MEASUREMENT
/begin MEASUREMENT B_ll "Bedingung Leerlauf" UWORD B_TRUE___UW 0 0 0.000000 0.000000 /begin IF_DATA ASAP1B_ETK KP_BLOB 0xFD7E 0 2 /end IF_DATA BIT_MASK 0x2000 /end MEASUREMENT
/begin MEASUREMENT B_lr "LREB: Bedingung Lambdaregelung (vor Kat); (Bank 1)" UWORD B_TRUE___UW 0 0 0.000000 0.000000 /begin IF_DATA ASAP1B_ETK KP_BLOB 0xFD94 0 2 /end IF_DATA BIT_MASK 0x2 /end MEASUREMENT
/begin MEASUREMENT B_lrka "Bedingung Katalysator-AusrÑumen" UWORD B_TRUE___UW 0 0 0.000000 0.000000 /begin IF_DATA ASAP1B_ETK KP_BLOB 0xFD98 0 2 /end IF_DATA BIT_MASK 0x200 /end MEASUREMENT
/begin MEASUREMENT B_lsd "Bedingung: Pos. LastschlagdÑmpfung aktiv" UWORD B_TRUE___UW 0 0 0.000000 0.000000 /begin IF_DATA ASAP1B_ETK KP_BLOB 0xFD7E 0 2 /end IF_DATA BIT_MASK 0x8000 /end MEASUREMENT
/begin MEASUREMENT B_lsrdy "Bedingung Lambda-Sonden geprÅft fÅr 'ready-Byte'" UBYTE B_TRUE 0 0 0.000000 0.000000 /begin IF_DATA ASAP1B_ETK KP_BLOB 0x383312 1 1 /end IF_DATA BIT_MASK 0x20 /end MEASUREMENT
/begin MEASUREMENT B_mdarv "kritische Aussetzerrate vorhanden" UWORD B_TRUE___UW 0 0 0.000000 0.000000 /begin IF_DATA ASAP1B_ETK KP_BLOB 0xFD1A 0 2 /end IF_DATA BIT_MASK 0x4 /end MEASUREMENT
/begin MEASUREMENT B_mdkat "KatschÑdigende Aussetzerrate Åberschritten (zur Ausblendung anderer Funktionen)" UWORD B_TRUE___UW 0 0 0.000000 0.000000 /begin IF_DATA ASAP1B_ETK KP_BLOB 0xFD1A 0 2 /end IF_DATA BIT_MASK 0x8 /end MEASUREMENT
/begin MEASUREMENT B_mnbrems "Fehlertyp BREMS (Bremssschalter): Minimalwert unterschritten" UWORD B_TRUE___UW 0 0 0.000000 0.000000 /begin IF_DATA ASAP1B_ETK KP_BLOB 0x383AF8 1 2 /end IF_DATA BIT_MASK 0x200 /end MEASUREMENT
/begin MEASUREMENT B_mnbwf "Fehlertyp min.: PWG Bewegung" UWORD B_TRUE___UW 0 0 0.000000 0.000000 /begin IF_DATA ASAP1B_ETK KP_BLOB 0x383AFA 1 2 /end IF_DATA BIT_MASK 0x200 /end MEASUREMENT
/begin MEASUREMENT B_mndpl "Fehlertyp 'Dauerplus' erkannt" UWORD B_TRUE___UW 0 0 0.000000 0.000000 /begin IF_DATA ASAP1B_ETK KP_BLOB 0x383B10 1 2 /end IF_DATA BIT_MASK 0x200 /end MEASUREMENT
/begin MEASUREMENT B_mndsl "Bedingung min. Fehler Ladedrucksensor" UWORD B_TRUE___UW 0 0 0.000000 0.000000 /begin IF_DATA ASAP1B_ETK KP_BLOB 0x383B12 1 2 /end IF_DATA BIT_MASK 0x200 /end MEASUREMENT
/begin MEASUREMENT B_mndsu "Bedingung: min-Fehler Umgebungsdrucksensor" UWORD B_TRUE___UW 0 0 0.000000 0.000000 /begin IF_DATA ASAP1B_ETK KP_BLOB 0x383B16 1 2 /end IF_DATA BIT_MASK 0x200 /end MEASUREMENT
/begin MEASUREMENT B_mndsvlu "Bedingung: min. Fehler Drucksensorsignalvergleich (DS-L DS-U)" UWORD B_TRUE___UW 0 0 0.000000 0.000000 /begin IF_DATA ASAP1B_ETK KP_BLOB 0x383B18 1 2 /end IF_DATA BIT_MASK 0x200 /end MEASUREMENT
/begin MEASUREMENT B_mnegfe "Bedingung: MIN-Fehler Eingangsgrî·en FÅllungserfassung" UWORD B_TRUE___UW 0 0 0.000000 0.000000 /begin IF_DATA ASAP1B_ETK KP_BLOB 0x383B30 1 2 /end IF_DATA BIT_MASK 0x200 /end MEASUREMENT
/begin MEASUREMENT B_mnfp1p "Fehlertyp min.: Fahrpedal 1. Poti" UWORD B_TRUE___UW 0 0 0.000000 0.000000 /begin IF_DATA ASAP1B_ETK KP_BLOB 0x383B46 1 2 /end IF_DATA BIT_MASK 0x200 /end MEASUREMENT
/begin MEASUREMENT B_mnfp2p "Fehlertyp min.: Fahrpedal 2. Poti" UWORD B_TRUE___UW 0 0 0.000000 0.000000 /begin IF_DATA ASAP1B_ETK KP_BLOB 0x383B48 1 2 /end IF_DATA BIT_MASK 0x200 /end MEASUREMENT
/begin MEASUREMENT B_mnfpp "Fehlertyp min.: Fahrpedal Potentiometer" UWORD B_TRUE___UW 0 0 0.000000 0.000000 /begin IF_DATA ASAP1B_ETK KP_BLOB 0x383B4A 1 2 /end IF_DATA BIT_MASK 0x200 /end MEASUREMENT
/begin MEASUREMENT B_mngecod "Fehlertyp: CVT-Getriebe falsch codiert" UWORD B_TRUE___UW 0 0 0.000000 0.000000 /begin IF_DATA ASAP1B_ETK KP_BLOB 0x383B52 1 2 /end IF_DATA BIT_MASK 0x200 /end MEASUREMENT
/begin MEASUREMENT B_mngrbh "Fehlertyp min.: GRA-Bedienhebel" UWORD B_TRUE___UW 0 0 0.000000 0.000000 /begin IF_DATA ASAP1B_ETK KP_BLOB 0x383B54 1 2 /end IF_DATA BIT_MASK 0x200 /end MEASUREMENT
/begin MEASUREMENT B_mnldpe "Fehlertype: Kurzschlu· nach Masse LDP-Endstufe" UWORD B_TRUE___UW 0 0 0.000000 0.000000 /begin IF_DATA ASAP1B_ETK KP_BLOB 0x383B96 1 2 /end IF_DATA BIT_MASK 0x200 /end MEASUREMENT
/begin MEASUREMENT B_mnmd "Fehlertyp min.: Aussetzer, Summenfehler (multiple)" UWORD B_TRUE___UW 0 0 0.000000 0.000000 /begin IF_DATA ASAP1B_ETK KP_BLOB 0x383BA2 1 2 /end IF_DATA BIT_MASK 0x200 /end MEASUREMENT
/begin MEASUREMENT B_mnmd01 "Fehlertyp min.: Aussetzer ZÅndung 1" UWORD B_TRUE___UW 0 0 0.000000 0.000000 /begin IF_DATA ASAP1B_ETK KP_BLOB 0x383BA4 1 2 /end IF_DATA BIT_MASK 0x200 /end MEASUREMENT
/begin MEASUREMENT B_mnmd02 "Fehlertyp min.: Aussetzer ZÅndung 2" UWORD B_TRUE___UW 0 0 0.000000 0.000000 /begin IF_DATA ASAP1B_ETK KP_BLOB 0x383BA6 1 2 /end IF_DATA BIT_MASK 0x200 /end MEASUREMENT
/begin MEASUREMENT B_mnmd03 "Fehlertyp min.: Aussetzer ZÅndung 3" UWORD B_TRUE___UW 0 0 0.000000 0.000000 /begin IF_DATA ASAP1B_ETK KP_BLOB 0x383BA8 1 2 /end IF_DATA BIT_MASK 0x200 /end MEASUREMENT
/begin MEASUREMENT B_mnmd04 "Fehlertyp min.: Aussetzer ZÅndung 4" UWORD B_TRUE___UW 0 0 0.000000 0.000000 /begin IF_DATA ASAP1B_ETK KP_BLOB 0x383BAA 1 2 /end IF_DATA BIT_MASK 0x200 /end MEASUREMENT
/begin MEASUREMENT B_mnmdb "Fehlertyp min.: MomentanÅberwachung begrenzt dauerhaft" UWORD B_TRUE___UW 0 0 0.000000 0.000000 /begin IF_DATA ASAP1B_ETK KP_BLOB 0x383BAC 1 2 /end IF_DATA BIT_MASK 0x200 /end MEASUREMENT
/begin MEASUREMENT B_mnmdk "Fehlertyp min.: Aussetzer, Summenfehler - multiple, kundendienstrelevant" UWORD B_TRUE___UW 0 0 0.000000 0.000000 /begin IF_DATA ASAP1B_ETK KP_BLOB 0x383BAE 1 2 /end IF_DATA BIT_MASK 0x200 /end MEASUREMENT
/begin MEASUREMENT B_mnmdk01 "Fehlertyp min.: Aussetzer, ZÅndung 1, kundendienstrelevant" UWORD B_TRUE___UW 0 0 0.000000 0.000000 /begin IF_DATA ASAP1B_ETK KP_BLOB 0x383BB0 1 2 /end IF_DATA BIT_MASK 0x200 /end MEASUREMENT
/begin MEASUREMENT B_mnmdk02 "Fehlertyp min.: Aussetzer, ZÅndung 2, kundendienstrelevant" UWORD B_TRUE___UW 0 0 0.000000 0.000000 /begin IF_DATA ASAP1B_ETK KP_BLOB 0x383BB2 1 2 /end IF_DATA BIT_MASK 0x200 /end MEASUREMENT
/begin MEASUREMENT B_mnmdk03 "Fehlertyp min.: Aussetzer, ZÅndung 3, kundendienstrelevant" UWORD B_TRUE___UW 0 0 0.000000 0.000000 /begin IF_DATA ASAP1B_ETK KP_BLOB 0x383BB4 1 2 /end IF_DATA BIT_MASK 0x200 /end MEASUREMENT
/begin MEASUREMENT B_mnmdk04 "Fehlertyp min.: Aussetzer, ZÅndung 4, kundendienstrelevant" UWORD B_TRUE___UW 0 0 0.000000 0.000000 /begin IF_DATA ASAP1B_ETK KP_BLOB 0x383BB6 1 2 /end IF_DATA BIT_MASK 0x200 /end MEASUREMENT
/begin MEASUREMENT B_mnnwkw "Fehlerart: Nockenwelle spÑtverstellt" UWORD B_TRUE___UW 0 0 0.000000 0.000000 /begin IF_DATA ASAP1B_ETK KP_BLOB 0x383BBC 1 2 /end IF_DATA BIT_MASK 0x200 /end MEASUREMENT
/begin MEASUREMENT B_mnnwkw2 "Fehlerart: Nockenwelle 2 spÑtverstellt" UWORD B_TRUE___UW 0 0 0.000000 0.000000 /begin IF_DATA ASAP1B_ETK KP_BLOB 0x383BBE 1 2 /end IF_DATA BIT_MASK 0x200 /end MEASUREMENT
/begin MEASUREMENT B_mnnws "Fehlerart: Nockenwellenverstellung FrÅhposition nicht erreicht" UWORD B_TRUE___UW 0 0 0.000000 0.000000 /begin IF_DATA ASAP1B_ETK KP_BLOB 0x383BC0 1 2 /end IF_DATA BIT_MASK 0x200 /end MEASUREMENT
/begin MEASUREMENT B_mnnws2 "Fehlerart: Nockenwellenverstellung 2 FrÅhposition nicht erreicht" UWORD B_TRUE___UW 0 0 0.000000 0.000000 /begin IF_DATA ASAP1B_ETK KP_BLOB 0x383BC2 1 2 /end IF_DATA BIT_MASK 0x200 /end MEASUREMENT
/begin MEASUREMENT B_mnnx "Fehlertyp min.: öberdrehzahl" UWORD B_TRUE___UW 0 0 0.000000 0.000000 /begin IF_DATA ASAP1B_ETK KP_BLOB 0x383BC6 1 2 /end IF_DATA BIT_MASK 0x200 /end MEASUREMENT
/begin MEASUREMENT B_mnph "Fehlerart: Kurzschlu· Masse Phasengeber" UWORD B_TRUE___UW 0 0 0.000000 0.000000 /begin IF_DATA ASAP1B_ETK KP_BLOB 0x383BC8 1 2 /end IF_DATA BIT_MASK 0x200 /end MEASUREMENT
/begin MEASUREMENT B_mnpwm "PWM-Signal kleiner als PlausibilitÑtsschwelle" UWORD B_TRUE___UW 0 0 0.000000 0.000000 /begin IF_DATA ASAP1B_ETK KP_BLOB 0x383BCA 1 2 /end IF_DATA BIT_MASK 0x200 /end MEASUREMENT
/begin MEASUREMENT B_mnsgeew "Fehlertyp min.:SteuergerÑt defekt (EEPROM-WFS)" UWORD B_TRUE___UW 0 0 0.000000 0.000000 /begin IF_DATA ASAP1B_ETK KP_BLOB 0x383BD0 1 2 /end IF_DATA BIT_MASK 0x200 /end MEASUREMENT
/begin MEASUREMENT B_mnsls "Fehlerart: SekundÑrluftmasse zu gering" UWORD B_TRUE___UW 0 0 0.000000 0.000000 /begin IF_DATA ASAP1B_ETK KP_BLOB 0x383BD4 1 2 /end IF_DATA BIT_MASK 0x200 /end MEASUREMENT
/begin MEASUREMENT B_mnslv "Fehlerart:" UWORD B_TRUE___UW 0 0 0.000000 0.000000 /begin IF_DATA ASAP1B_ETK KP_BLOB 0x383BD6 1 2 /end IF_DATA BIT_MASK 0x200 /end MEASUREMENT
/begin MEASUREMENT B_mnslwg "" UWORD B_TRUE___UW 0 0 0.000000 0.000000 /begin IF_DATA ASAP1B_ETK KP_BLOB 0x383BDA 1 2 /end IF_DATA BIT_MASK 0x200 /end MEASUREMENT
/begin MEASUREMENT B_mnswe "Beschleunigungssensorsignal kleiner als PlausibilitÑtsschwelle" UWORD B_TRUE___UW 0 0 0.000000 0.000000 /begin IF_DATA ASAP1B_ETK KP_BLOB 0x383BDE 1 2 /end IF_DATA BIT_MASK 0x200 /end MEASUREMENT
/begin MEASUREMENT B_mnta "Fehlertyp: Minimalwertunterschreitung Ansauglufttemperatur TANS" UWORD B_TRUE___UW 0 0 0.000000 0.000000 /begin IF_DATA ASAP1B_ETK KP_BLOB 0x383BE0 1 2 /end IF_DATA BIT_MASK 0x200 /end MEASUREMENT
/begin MEASUREMENT B_mntes "Fehlertyp 'Minimalwert' erkannt" UWORD B_TRUE___UW 0 0 0.000000 0.000000 /begin IF_DATA ASAP1B_ETK KP_BLOB 0x383BE4 1 2 /end IF_DATA BIT_MASK 0x200 /end MEASUREMENT
/begin MEASUREMENT B_mntm "Fehlertyp: Minimalwertunterschreitung Motortemperatur" UWORD B_TRUE___UW 0 0 0.000000 0.000000 /begin IF_DATA ASAP1B_ETK KP_BLOB 0x383BEE 1 2 /end IF_DATA BIT_MASK 0x200 /end MEASUREMENT
/begin MEASUREMENT B_mntun "Bedingung: Min-Fehler Tuningschutz" UWORD B_TRUE___UW 0 0 0.000000 0.000000 /begin IF_DATA ASAP1B_ETK KP_BLOB 0x383BF4 1 2 /end IF_DATA BIT_MASK 0x200 /end MEASUREMENT
/begin MEASUREMENT B_mnub "Fehlertyp: Minimalwertunterschreitung Batteriespannung (Bordnetz)" UWORD B_TRUE___UW 0 0 0.000000 0.000000 /begin IF_DATA ASAP1B_ETK KP_BLOB 0x383BF6 1 2 /end IF_DATA BIT_MASK 0x200 /end MEASUREMENT
/begin MEASUREMENT B_mnufmv "Fehlertyp min.: FunktionsÅberwachung: Momentenvergleich" UWORD B_TRUE___UW 0 0 0.000000 0.000000 /begin IF_DATA ASAP1B_ETK KP_BLOB 0x383BF8 1 2 /end IF_DATA BIT_MASK 0x200 /end MEASUREMENT
/begin MEASUREMENT B_mnufska "Fehlertyp min.: FunktionsÅberwachung: Sicherheits-Kraftstoff-Abschaltung" UWORD B_TRUE___UW 0 0 0.000000 0.000000 /begin IF_DATA ASAP1B_ETK KP_BLOB 0x383BFA 1 2 /end IF_DATA BIT_MASK 0x200 /end MEASUREMENT
/begin MEASUREMENT B_mnurram "Fehlertyp min.: RechnerÅberwachung: RAM" UWORD B_TRUE___UW 0 0 0.000000 0.000000 /begin IF_DATA ASAP1B_ETK KP_BLOB 0x383BFC 1 2 /end IF_DATA BIT_MASK 0x200 /end MEASUREMENT
/begin MEASUREMENT B_mnurrom "Fehlertyp min.: RechnerÅberwachung: ROM" UWORD B_TRUE___UW 0 0 0.000000 0.000000 /begin IF_DATA ASAP1B_ETK KP_BLOB 0x383BFE 1 2 /end IF_DATA BIT_MASK 0x200 /end MEASUREMENT
/begin MEASUREMENT B_mnurrst "Fehlertyp min.: RechnerÅberwachung: Reset" UWORD B_TRUE___UW 0 0 0.000000 0.000000 /begin IF_DATA ASAP1B_ETK KP_BLOB 0x383C00 1 2 /end IF_DATA BIT_MASK 0x200 /end MEASUREMENT
/begin MEASUREMENT B_mnvfz "Fehlertyp min,: Fahrzeuggeschwindigkeit" UWORD B_TRUE___UW 0 0 0.000000 0.000000 /begin IF_DATA ASAP1B_ETK KP_BLOB 0x383C04 1 2 /end IF_DATA BIT_MASK 0x200 /end MEASUREMENT
/begin MEASUREMENT B_mnwfs "Fehlertyp min.: Wegfahrsperre" UWORD B_TRUE___UW 0 0 0.000000 0.000000 /begin IF_DATA ASAP1B_ETK KP_BLOB 0x383C06 1 2 /end IF_DATA BIT_MASK 0x200 /end MEASUREMENT
/begin MEASUREMENT B_mnwfsrc "" UWORD B_TRUE___UW 0 0 0.000000 0.000000 /begin IF_DATA ASAP1B_ETK KP_BLOB 0x383C08 1 2 /end IF_DATA BIT_MASK 0x200 /end MEASUREMENT
/begin MEASUREMENT B_mslmin "Bedingung sehr geringe SekundÑrluftmasse aus Me·phase" UWORD B_TRUE___UW 0 0 0.000000 0.000000 /begin IF_DATA ASAP1B_ETK KP_BLOB 0x380EFC 1 2 /end IF_DATA BIT_MASK 0x2 /end MEASUREMENT
/begin MEASUREMENT B_mslmin2 "Bedingung sehr geringe SekundÑrluftmasse aus Me·phase (Bank 2)" UWORD B_TRUE___UW 0 0 0.000000 0.000000 /begin IF_DATA ASAP1B_ETK KP_BLOB 0x380EFC 1 2 /end IF_DATA BIT_MASK 0x4 /end MEASUREMENT
/begin MEASUREMENT B_mxbrems "Fehlertyp BREMS (Bremsschalter): Maximalwert Åberschritten" UWORD B_TRUE___UW 0 0 0.000000 0.000000 /begin IF_DATA ASAP1B_ETK KP_BLOB 0x383AF8 1 2 /end IF_DATA BIT_MASK 0x100 /end MEASUREMENT
/begin MEASUREMENT B_mxbwf "Fehlertyp max.: PWG Bewegung" UWORD B_TRUE___UW 0 0 0.000000 0.000000 /begin IF_DATA ASAP1B_ETK KP_BLOB 0x383AFA 1 2 /end IF_DATA BIT_MASK 0x100 /end MEASUREMENT
/begin MEASUREMENT B_mxdpl "Fehlertyp 'Dauerplus' erkannt" UWORD B_TRUE___UW 0 0 0.000000 0.000000 /begin IF_DATA ASAP1B_ETK KP_BLOB 0x383B10 1 2 /end IF_DATA BIT_MASK 0x100 /end MEASUREMENT
/begin MEASUREMENT B_mxdsl "Bedingung max. Fehler Ladedrucksensor" UWORD B_TRUE___UW 0 0 0.000000 0.000000 /begin IF_DATA ASAP1B_ETK KP_BLOB 0x383B12 1 2 /end IF_DATA BIT_MASK 0x100 /end MEASUREMENT
/begin MEASUREMENT B_mxdsu "Bedingung: max-Fehler Umgebungsdrucksensor" UWORD B_TRUE___UW 0 0 0.000000 0.000000 /begin IF_DATA ASAP1B_ETK KP_BLOB 0x383B16 1 2 /end IF_DATA BIT_MASK 0x100 /end MEASUREMENT
/begin MEASUREMENT B_mxdsvlu "Fehlertyp 'Maximalwert' erkannt: Drucksensorsignalvergleich (DS-L DS-U)" UWORD B_TRUE___UW 0 0 0.000000 0.000000 /begin IF_DATA ASAP1B_ETK KP_BLOB 0x383B18 1 2 /end IF_DATA BIT_MASK 0x100 /end MEASUREMENT
/begin MEASUREMENT B_mxegfe "Bedingung: MAX-Fehler Eingangsgrî·en FÅllungserfassung" UWORD B_TRUE___UW 0 0 0.000000 0.000000 /begin IF_DATA ASAP1B_ETK KP_BLOB 0x383B30 1 2 /end IF_DATA BIT_MASK 0x100 /end MEASUREMENT
/begin MEASUREMENT B_mxfp1p "Fehlertyp max.: Fahrpedal 1. Poti" UWORD B_TRUE___UW 0 0 0.000000 0.000000 /begin IF_DATA ASAP1B_ETK KP_BLOB 0x383B46 1 2 /end IF_DATA BIT_MASK 0x100 /end MEASUREMENT
/begin MEASUREMENT B_mxfp2p "Fehlertyp max.: Fahrpedal 2. Poti" UWORD B_TRUE___UW 0 0 0.000000 0.000000 /begin IF_DATA ASAP1B_ETK KP_BLOB 0x383B48 1 2 /end IF_DATA BIT_MASK 0x100 /end MEASUREMENT
/begin MEASUREMENT B_mxfpp "Fehlertyp max.: Fahrpedal Potentiometer" UWORD B_TRUE___UW 0 0 0.000000 0.000000 /begin IF_DATA ASAP1B_ETK KP_BLOB 0x383B4A 1 2 /end IF_DATA BIT_MASK 0x100 /end MEASUREMENT
/begin MEASUREMENT B_mxgecod "Fehlertyp: AT-Getriebe falsch codiert" UWORD B_TRUE___UW 0 0 0.000000 0.000000 /begin IF_DATA ASAP1B_ETK KP_BLOB 0x383B52 1 2 /end IF_DATA BIT_MASK 0x100 /end MEASUREMENT
/begin MEASUREMENT B_mxgrbh "Fehlertyp max.: GRA-Bedienhebel" UWORD B_TRUE___UW 0 0 0.000000 0.000000 /begin IF_DATA ASAP1B_ETK KP_BLOB 0x383B54 1 2 /end IF_DATA BIT_MASK 0x100 /end MEASUREMENT
/begin MEASUREMENT B_mxldpe "Fehlertype: Kurzschlu· nach Ubatt Endstufe LDP" UWORD B_TRUE___UW 0 0 0.000000 0.000000 /begin IF_DATA ASAP1B_ETK KP_BLOB 0x383B96 1 2 /end IF_DATA BIT_MASK 0x100 /end MEASUREMENT
/begin MEASUREMENT B_mxmd "Fehlertyp max.: Aussetzer, Summenfehler (multiple)" UWORD B_TRUE___UW 0 0 0.000000 0.000000 /begin IF_DATA ASAP1B_ETK KP_BLOB 0x383BA2 1 2 /end IF_DATA BIT_MASK 0x100 /end MEASUREMENT
/begin MEASUREMENT B_mxmd01 "Fehlertyp max.: Aussetzer ZÅndung 1" UWORD B_TRUE___UW 0 0 0.000000 0.000000 /begin IF_DATA ASAP1B_ETK KP_BLOB 0x383BA4 1 2 /end IF_DATA BIT_MASK 0x100 /end MEASUREMENT
/begin MEASUREMENT B_mxmd02 "Fehlertyp max.: Aussetzer ZÅndung 2" UWORD B_TRUE___UW 0 0 0.000000 0.000000 /begin IF_DATA ASAP1B_ETK KP_BLOB 0x383BA6 1 2 /end IF_DATA BIT_MASK 0x100 /end MEASUREMENT
/begin MEASUREMENT B_mxmd03 "Fehlertyp max.: Aussetzer ZÅndung 3" UWORD B_TRUE___UW 0 0 0.000000 0.000000 /begin IF_DATA ASAP1B_ETK KP_BLOB 0x383BA8 1 2 /end IF_DATA BIT_MASK 0x100 /end MEASUREMENT
/begin MEASUREMENT B_mxmd04 "Fehlertyp max.: Aussetzer ZÅndung 4" UWORD B_TRUE___UW 0 0 0.000000 0.000000 /begin IF_DATA ASAP1B_ETK KP_BLOB 0x383BAA 1 2 /end IF_DATA BIT_MASK 0x100 /end MEASUREMENT
/begin MEASUREMENT B_mxmdb "Fehlerart: Maximal zulÑssiges Sollmoment wird dauerhaft Åberschritten" UWORD B_TRUE___UW 0 0 0.000000 0.000000 /begin IF_DATA ASAP1B_ETK KP_BLOB 0x383BAC 1 2 /end IF_DATA BIT_MASK 0x100 /end MEASUREMENT
/begin MEASUREMENT B_mxmdk "Fehlertyp max.: Aussetzer, Summenfehler - multiple, kundendienstrelevant" UWORD B_TRUE___UW 0 0 0.000000 0.000000 /begin IF_DATA ASAP1B_ETK KP_BLOB 0x383BAE 1 2 /end IF_DATA BIT_MASK 0x100 /end MEASUREMENT
/begin MEASUREMENT B_mxmdk01 "Fehlertyp max.: Aussetzer, ZÅndung 1, kundendiesntrelevant" UWORD B_TRUE___UW 0 0 0.000000 0.000000 /begin IF_DATA ASAP1B_ETK KP_BLOB 0x383BB0 1 2 /end IF_DATA BIT_MASK 0x100 /end MEASUREMENT
/begin MEASUREMENT B_mxmdk02 "Fehlertyp max.: Aussetzer, ZÅndung 2, kundendienstrelevant" UWORD B_TRUE___UW 0 0 0.000000 0.000000 /begin IF_DATA ASAP1B_ETK KP_BLOB 0x383BB2 1 2 /end IF_DATA BIT_MASK 0x100 /end MEASUREMENT
/begin MEASUREMENT B_mxmdk03 "Fehlertyp max.: Aussetzer, ZÅndung 3, kundendienstrelevant" UWORD B_TRUE___UW 0 0 0.000000 0.000000 /begin IF_DATA ASAP1B_ETK KP_BLOB 0x383BB4 1 2 /end IF_DATA BIT_MASK 0x100 /end MEASUREMENT
/begin MEASUREMENT B_mxmdk04 "Fehlertyp max.: Aussetzer, ZÅndung 4, kundendienstrelevant" UWORD B_TRUE___UW 0 0 0.000000 0.000000 /begin IF_DATA ASAP1B_ETK KP_BLOB 0x383BB6 1 2 /end IF_DATA BIT_MASK 0x100 /end MEASUREMENT
/begin MEASUREMENT B_mxnwkw "Fehlerart: Nockenwelle frÅhverstellt" UWORD B_TRUE___UW 0 0 0.000000 0.000000 /begin IF_DATA ASAP1B_ETK KP_BLOB 0x383BBC 1 2 /end IF_DATA BIT_MASK 0x100 /end MEASUREMENT
/begin MEASUREMENT B_mxnwkw2 "Fehlerart: Nockenwelle 2 frÅhverstellt" UWORD B_TRUE___UW 0 0 0.000000 0.000000 /begin IF_DATA ASAP1B_ETK KP_BLOB 0x383BBE 1 2 /end IF_DATA BIT_MASK 0x100 /end MEASUREMENT
/begin MEASUREMENT B_mxnws "Fehlerart: Nockenwellenverstellung SpÑtposition nicht erreicht" UWORD B_TRUE___UW 0 0 0.000000 0.000000 /begin IF_DATA ASAP1B_ETK KP_BLOB 0x383BC0 1 2 /end IF_DATA BIT_MASK 0x100 /end MEASUREMENT
/begin MEASUREMENT B_mxnws2 "Fehlerart: Nockenwellenverstellung 2 SpÑtposition nicht erreicht" UWORD B_TRUE___UW 0 0 0.000000 0.000000 /begin IF_DATA ASAP1B_ETK KP_BLOB 0x383BC2 1 2 /end IF_DATA BIT_MASK 0x100 /end MEASUREMENT
/begin MEASUREMENT B_mxnx "Fehlertyp max.: öberdrehzahl" UWORD B_TRUE___UW 0 0 0.000000 0.000000 /begin IF_DATA ASAP1B_ETK KP_BLOB 0x383BC6 1 2 /end IF_DATA BIT_MASK 0x100 /end MEASUREMENT
/begin MEASUREMENT B_mxph "Fehlerart: Kurzschlu· Ubat Phasengeber" UWORD B_TRUE___UW 0 0 0.000000 0.000000 /begin IF_DATA ASAP1B_ETK KP_BLOB 0x383BC8 1 2 /end IF_DATA BIT_MASK 0x100 /end MEASUREMENT
/begin MEASUREMENT B_mxpwm "PWM-Signal grî·er als PlausibilitÑtsschwelle" UWORD B_TRUE___UW 0 0 0.000000 0.000000 /begin IF_DATA ASAP1B_ETK KP_BLOB 0x383BCA 1 2 /end IF_DATA BIT_MASK 0x100 /end MEASUREMENT
/begin MEASUREMENT B_mxsgeew "Fehlertyp max.: SteuergerÑt defekt (EEPROM-WFS)" UWORD B_TRUE___UW 0 0 0.000000 0.000000 /begin IF_DATA ASAP1B_ETK KP_BLOB 0x383BD0 1 2 /end IF_DATA BIT_MASK 0x100 /end MEASUREMENT
/begin MEASUREMENT B_mxsls "Fehlerart:SekundÑrluftsystem" UWORD B_TRUE___UW 0 0 0.000000 0.000000 /begin IF_DATA ASAP1B_ETK KP_BLOB 0x383BD4 1 2 /end IF_DATA BIT_MASK 0x100 /end MEASUREMENT
/begin MEASUREMENT B_mxslv "Fehlerart: SekundÑrluftmasse bei VentildichtheitsprÅfung zu gro·" UWORD B_TRUE___UW 0 0 0.000000 0.000000 /begin IF_DATA ASAP1B_ETK KP_BLOB 0x383BD6 1 2 /end IF_DATA BIT_MASK 0x100 /end MEASUREMENT
/begin MEASUREMENT B_mxslwg "" UWORD B_TRUE___UW 0 0 0.000000 0.000000 /begin IF_DATA ASAP1B_ETK KP_BLOB 0x383BDA 1 2 /end IF_DATA BIT_MASK 0x100 /end MEASUREMENT
/begin MEASUREMENT B_mxswe "Beschleunigungssensorsignal grî·er als PlausibilitÑtsschwelle" UWORD B_TRUE___UW 0 0 0.000000 0.000000 /begin IF_DATA ASAP1B_ETK KP_BLOB 0x383BDE 1 2 /end IF_DATA BIT_MASK 0x100 /end MEASUREMENT
/begin MEASUREMENT B_mxta "Fehlertyp: MaximalwertÅberschreitung Ansauglufttemperatur TANS" UWORD B_TRUE___UW 0 0 0.000000 0.000000 /begin IF_DATA ASAP1B_ETK KP_BLOB 0x383BE0 1 2 /end IF_DATA BIT_MASK 0x100 /end MEASUREMENT
/begin MEASUREMENT B_mxtes "Fehlertyp 'Maximalwert' erkannt (TankentlÅftungsventil)" UWORD B_TRUE___UW 0 0 0.000000 0.000000 /begin IF_DATA ASAP1B_ETK KP_BLOB 0x383BE4 1 2 /end IF_DATA BIT_MASK 0x100 /end MEASUREMENT
/begin MEASUREMENT B_mxtm "Fehlertyp: MaximalwertÅberschreitung Motortemperatur" UWORD B_TRUE___UW 0 0 0.000000 0.000000 /begin IF_DATA ASAP1B_ETK KP_BLOB 0x383BEE 1 2 /end IF_DATA BIT_MASK 0x100 /end MEASUREMENT
/begin MEASUREMENT B_mxtun "Bedingung: Max-Fehler Tuningschutz" UWORD B_TRUE___UW 0 0 0.000000 0.000000 /begin IF_DATA ASAP1B_ETK KP_BLOB 0x383BF4 1 2 /end IF_DATA BIT_MASK 0x100 /end MEASUREMENT
/begin MEASUREMENT B_mxub "Fehlertyp: MaximalwertÅberschreitung Batteriespannung (Bordnetz)" UWORD B_TRUE___UW 0 0 0.000000 0.000000 /begin IF_DATA ASAP1B_ETK KP_BLOB 0x383BF6 1 2 /end IF_DATA BIT_MASK 0x100 /end MEASUREMENT
/begin MEASUREMENT B_mxufmv "Fehlertyp max.: FunktionsÅberwachung: Momentenvergleich" UWORD B_TRUE___UW 0 0 0.000000 0.000000 /begin IF_DATA ASAP1B_ETK KP_BLOB 0x383BF8 1 2 /end IF_DATA BIT_MASK 0x100 /end MEASUREMENT
/begin MEASUREMENT B_mxufska "Fehlertyp max.: FunktionsÅberwachung: Sicherheits-Kraftstoff-Abschaltung" UWORD B_TRUE___UW 0 0 0.000000 0.000000 /begin IF_DATA ASAP1B_ETK KP_BLOB 0x383BFA 1 2 /end IF_DATA BIT_MASK 0x100 /end MEASUREMENT
/begin MEASUREMENT B_mxurram "Fehlertyp max.: RechnerÅberwachung: RAM" UWORD B_TRUE___UW 0 0 0.000000 0.000000 /begin IF_DATA ASAP1B_ETK KP_BLOB 0x383BFC 1 2 /end IF_DATA BIT_MASK 0x100 /end MEASUREMENT
/begin MEASUREMENT B_mxurrom "Fehlertyp max.: RechnerÅberwachung: ROM" UWORD B_TRUE___UW 0 0 0.000000 0.000000 /begin IF_DATA ASAP1B_ETK KP_BLOB 0x383BFE 1 2 /end IF_DATA BIT_MASK 0x100 /end MEASUREMENT
/begin MEASUREMENT B_mxurrst "Fehlertyp max.: RechnerÅberwachung: Reset" UWORD B_TRUE___UW 0 0 0.000000 0.000000 /begin IF_DATA ASAP1B_ETK KP_BLOB 0x383C00 1 2 /end IF_DATA BIT_MASK 0x100 /end MEASUREMENT
/begin MEASUREMENT B_mxvfz "Fehlertyp max.: Fahrzeuggeschwindigkeit" UWORD B_TRUE___UW 0 0 0.000000 0.000000 /begin IF_DATA ASAP1B_ETK KP_BLOB 0x383C04 1 2 /end IF_DATA BIT_MASK 0x100 /end MEASUREMENT
/begin MEASUREMENT B_mxwfs "Fehlertyp max.: Wegfahrsperre" UWORD B_TRUE___UW 0 0 0.000000 0.000000 /begin IF_DATA ASAP1B_ETK KP_BLOB 0x383C06 1 2 /end IF_DATA BIT_MASK 0x100 /end MEASUREMENT
/begin MEASUREMENT B_mxwfsrc "" UWORD B_TRUE___UW 0 0 0.000000 0.000000 /begin IF_DATA ASAP1B_ETK KP_BLOB 0x383C08 1 2 /end IF_DATA BIT_MASK 0x100 /end MEASUREMENT
/begin MEASUREMENT B_nachl "Steuerung SG-Nachlauf" UWORD B_TRUE___UW 0 0 0.000000 0.000000 /begin IF_DATA ASAP1B_ETK KP_BLOB 0x383CCE 1 2 /end IF_DATA BIT_MASK 0x8000 /end MEASUREMENT
/begin MEASUREMENT B_nmot "Bedingung Motordrehzahl: n > NMIN" UWORD B_TRUE___UW 0 0 0.000000 0.000000 /begin IF_DATA ASAP1B_ETK KP_BLOB 0xFD1E 0 2 /end IF_DATA BIT_MASK 0x800 /end MEASUREMENT
/begin MEASUREMENT B_npbrems "Fehlertyp BREMS (Bremsschalter): PrÅfresultat nicht plausibel" UWORD B_TRUE___UW 0 0 0.000000 0.000000 /begin IF_DATA ASAP1B_ETK KP_BLOB 0x383AF8 1 2 /end IF_DATA BIT_MASK 0x800 /end MEASUREMENT
/begin MEASUREMENT B_npbwf "Fehlertyp unplaus.: PWG Bewegung" UWORD B_TRUE___UW 0 0 0.000000 0.000000 /begin IF_DATA ASAP1B_ETK KP_BLOB 0x383AFA 1 2 /end IF_DATA BIT_MASK 0x800 /end MEASUREMENT
/begin MEASUREMENT B_npddpl "" UWORD B_TRUE___UW 0 0 0.000000 0.000000 /begin IF_DATA ASAP1B_ETK KP_BLOB 0x383B10 1 2 /end IF_DATA BIT_MASK 0x800 /end MEASUREMENT
/begin MEASUREMENT B_npdsl "Bedingung: Ladedrucksensor nicht plausibel" UWORD B_TRUE___UW 0 0 0.000000 0.000000 /begin IF_DATA ASAP1B_ETK KP_BLOB 0x383B12 1 2 /end IF_DATA BIT_MASK 0x800 /end MEASUREMENT
/begin MEASUREMENT B_npdsu "Bedingung: Umgebungsdrucksensor nicht plausibel" UWORD B_TRUE___UW 0 0 0.000000 0.000000 /begin IF_DATA ASAP1B_ETK KP_BLOB 0x383B16 1 2 /end IF_DATA BIT_MASK 0x800 /end MEASUREMENT
/begin MEASUREMENT B_npdsvlu "Bedingung: Drucksensorsignalvergleich nicht plausibel (DS-L DS-U)" UWORD B_TRUE___UW 0 0 0.000000 0.000000 /begin IF_DATA ASAP1B_ETK KP_BLOB 0x383B18 1 2 /end IF_DATA BIT_MASK 0x800 /end MEASUREMENT
/begin MEASUREMENT B_npegfe "" UWORD B_TRUE___UW 0 0 0.000000 0.000000 /begin IF_DATA ASAP1B_ETK KP_BLOB 0x383B30 1 2 /end IF_DATA BIT_MASK 0x800 /end MEASUREMENT
/begin MEASUREMENT B_npfp1p "Fehlertyp unplaus.: Fahrpedal 1. Poti" UWORD B_TRUE___UW 0 0 0.000000 0.000000 /begin IF_DATA ASAP1B_ETK KP_BLOB 0x383B46 1 2 /end IF_DATA BIT_MASK 0x800 /end MEASUREMENT
/begin MEASUREMENT B_npfp2p "Fehlertyp unplaus.: Fahrpedal 2. Poti" UWORD B_TRUE___UW 0 0 0.000000 0.000000 /begin IF_DATA ASAP1B_ETK KP_BLOB 0x383B48 1 2 /end IF_DATA BIT_MASK 0x800 /end MEASUREMENT
/begin MEASUREMENT B_npfpp "Bedingung unplausible Potisignale vom Fahrpedal" UWORD B_TRUE___UW 0 0 0.000000 0.000000 /begin IF_DATA ASAP1B_ETK KP_BLOB 0x383B4A 1 2 /end IF_DATA BIT_MASK 0x800 /end MEASUREMENT
/begin MEASUREMENT B_npgecod "Fehlertyp: unplausible Getriebecodierung" UWORD B_TRUE___UW 0 0 0.000000 0.000000 /begin IF_DATA ASAP1B_ETK KP_BLOB 0x383B52 1 2 /end IF_DATA BIT_MASK 0x800 /end MEASUREMENT
/begin MEASUREMENT B_npgrbh "Fehlertyp unplaus.: GRA-Bedienhebel" UWORD B_TRUE___UW 0 0 0.000000 0.000000 /begin IF_DATA ASAP1B_ETK KP_BLOB 0x383B54 1 2 /end IF_DATA BIT_MASK 0x800 /end MEASUREMENT
/begin MEASUREMENT B_npldpe "Nicht plausibler Fehler: Leckdiagnosemodul Endstufe" UWORD B_TRUE___UW 0 0 0.000000 0.000000 /begin IF_DATA ASAP1B_ETK KP_BLOB 0x383B96 1 2 /end IF_DATA BIT_MASK 0x800 /end MEASUREMENT
/begin MEASUREMENT B_npmd "Fehlertyp unplaus.: Aussetzer, Summenfehler (multiple)" UWORD B_TRUE___UW 0 0 0.000000 0.000000 /begin IF_DATA ASAP1B_ETK KP_BLOB 0x383BA2 1 2 /end IF_DATA BIT_MASK 0x800 /end MEASUREMENT
/begin MEASUREMENT B_npmd01 "Fehlertyp unplaus.: Aussetzer ZÅndung 1" UWORD B_TRUE___UW 0 0 0.000000 0.000000 /begin IF_DATA ASAP1B_ETK KP_BLOB 0x383BA4 1 2 /end IF_DATA BIT_MASK 0x800 /end MEASUREMENT
/begin MEASUREMENT B_npmd02 "Fehlertyp unplaus.: Aussetzer ZÅndung 2" UWORD B_TRUE___UW 0 0 0.000000 0.000000 /begin IF_DATA ASAP1B_ETK KP_BLOB 0x383BA6 1 2 /end IF_DATA BIT_MASK 0x800 /end MEASUREMENT
/begin MEASUREMENT B_npmd03 "Fehlertyp unplaus.: Aussetzer ZÅndung 3" UWORD B_TRUE___UW 0 0 0.000000 0.000000 /begin IF_DATA ASAP1B_ETK KP_BLOB 0x383BA8 1 2 /end IF_DATA BIT_MASK 0x800 /end MEASUREMENT
/begin MEASUREMENT B_npmd04 "Fehlertyp unplaus.: Aussetzer ZÅndung 4" UWORD B_TRUE___UW 0 0 0.000000 0.000000 /begin IF_DATA ASAP1B_ETK KP_BLOB 0x383BAA 1 2 /end IF_DATA BIT_MASK 0x800 /end MEASUREMENT
/begin MEASUREMENT B_npmdb "Nicht plausibler Fehler: MomentanÅberwachung begrenzt dauerhaft" UWORD B_TRUE___UW 0 0 0.000000 0.000000 /begin IF_DATA ASAP1B_ETK KP_BLOB 0x383BAC 1 2 /end IF_DATA BIT_MASK 0x800 /end MEASUREMENT
/begin MEASUREMENT B_npmdk "Fehlertyp unplaus.: Aussetzer, Summenfehler - multiple, kundendienstrelevant" UWORD B_TRUE___UW 0 0 0.000000 0.000000 /begin IF_DATA ASAP1B_ETK KP_BLOB 0x383BAE 1 2 /end IF_DATA BIT_MASK 0x800 /end MEASUREMENT
/begin MEASUREMENT B_npmdk01 "Fehlertyp unplaus.: Aussetzer, ZÅndung 1, kundendienstrelevant" UWORD B_TRUE___UW 0 0 0.000000 0.000000 /begin IF_DATA ASAP1B_ETK KP_BLOB 0x383BB0 1 2 /end IF_DATA BIT_MASK 0x800 /end MEASUREMENT
/begin MEASUREMENT B_npmdk02 "Fehlertyp unplaus.: Aussetzer, ZÅndung 2, kundendienstrelevant" UWORD B_TRUE___UW 0 0 0.000000 0.000000 /begin IF_DATA ASAP1B_ETK KP_BLOB 0x383BB2 1 2 /end IF_DATA BIT_MASK 0x800 /end MEASUREMENT
/begin MEASUREMENT B_npmdk03 "Fehlertyp unplaus.: Aussetzer, ZÅndung 3, kundendienstrelevant" UWORD B_TRUE___UW 0 0 0.000000 0.000000 /begin IF_DATA ASAP1B_ETK KP_BLOB 0x383BB4 1 2 /end IF_DATA BIT_MASK 0x800 /end MEASUREMENT
/begin MEASUREMENT B_npmdk04 "Fehlertyp unplaus.: Aussetzer, ZÅndung 4, kundendienstrelevant" UWORD B_TRUE___UW 0 0 0.000000 0.000000 /begin IF_DATA ASAP1B_ETK KP_BLOB 0x383BB6 1 2 /end IF_DATA BIT_MASK 0x800 /end MEASUREMENT
/begin MEASUREMENT B_npnwkw "Nicht plausibler Fehler: Zuordnung Nockenwelle zu Kurbelwelle" UWORD B_TRUE___UW 0 0 0.000000 0.000000 /begin IF_DATA ASAP1B_ETK KP_BLOB 0x383BBC 1 2 /end IF_DATA BIT_MASK 0x800 /end MEASUREMENT
/begin MEASUREMENT B_npnwkw2 "Nicht plausibler Fehler: Zuordnung Nockenwelle 2 zu Kurbelwelle" UWORD B_TRUE___UW 0 0 0.000000 0.000000 /begin IF_DATA ASAP1B_ETK KP_BLOB 0x383BBE 1 2 /end IF_DATA BIT_MASK 0x800 /end MEASUREMENT
/begin MEASUREMENT B_npnws "Fehlerart Nockenwellenverstellung unplausible Position" UWORD B_TRUE___UW 0 0 0.000000 0.000000 /begin IF_DATA ASAP1B_ETK KP_BLOB 0x383BC0 1 2 /end IF_DATA BIT_MASK 0x800 /end MEASUREMENT
/begin MEASUREMENT B_npnws2 "Fehlerart Nockenwellenverstellung 2 unplausible Position" UWORD B_TRUE___UW 0 0 0.000000 0.000000 /begin IF_DATA ASAP1B_ETK KP_BLOB 0x383BC2 1 2 /end IF_DATA BIT_MASK 0x800 /end MEASUREMENT
/begin MEASUREMENT B_npnx "Fehlertyp unplaus.: öberdrehzahl" UWORD B_TRUE___UW 0 0 0.000000 0.000000 /begin IF_DATA ASAP1B_ETK KP_BLOB 0x383BC6 1 2 /end IF_DATA BIT_MASK 0x800 /end MEASUREMENT
/begin MEASUREMENT B_npph "Bedingung Phasengebersignal ist unplausibel (ph)" UWORD B_TRUE___UW 0 0 0.000000 0.000000 /begin IF_DATA ASAP1B_ETK KP_BLOB 0x383BC8 1 2 /end IF_DATA BIT_MASK 0x800 /end MEASUREMENT
/begin MEASUREMENT B_nppwm "PWM-Signal ist nicht plausibel" UWORD B_TRUE___UW 0 0 0.000000 0.000000 /begin IF_DATA ASAP1B_ETK KP_BLOB 0x383BCA 1 2 /end IF_DATA BIT_MASK 0x800 /end MEASUREMENT
/begin MEASUREMENT B_npsgeew "Fehlerart: SteuergerÑt defekt (EEPROM-WFS)" UWORD B_TRUE___UW 0 0 0.000000 0.000000 /begin IF_DATA ASAP1B_ETK KP_BLOB 0x383BD0 1 2 /end IF_DATA BIT_MASK 0x800 /end MEASUREMENT
/begin MEASUREMENT B_npsls "Fehlerart: Offsetwert SekundÑrluftmasse zu gro·" UWORD B_TRUE___UW 0 0 0.000000 0.000000 /begin IF_DATA ASAP1B_ETK KP_BLOB 0x383BD4 1 2 /end IF_DATA BIT_MASK 0x800 /end MEASUREMENT
/begin MEASUREMENT B_npslv "Fehlerart: Offsetwert SekundÑrluftmasse zu gro·" UWORD B_TRUE___UW 0 0 0.000000 0.000000 /begin IF_DATA ASAP1B_ETK KP_BLOB 0x383BD6 1 2 /end IF_DATA BIT_MASK 0x800 /end MEASUREMENT
/begin MEASUREMENT B_npslwg "Fehlertyp: Signal Waste Gate Diagnose unplausibel" UWORD B_TRUE___UW 0 0 0.000000 0.000000 /begin IF_DATA ASAP1B_ETK KP_BLOB 0x383BDA 1 2 /end IF_DATA BIT_MASK 0x800 /end MEASUREMENT
/begin MEASUREMENT B_npswe "Beschleunigungssensorsignal ist nicht plausibel" UWORD B_TRUE___UW 0 0 0.000000 0.000000 /begin IF_DATA ASAP1B_ETK KP_BLOB 0x383BDE 1 2 /end IF_DATA BIT_MASK 0x800 /end MEASUREMENT
/begin MEASUREMENT B_npta "Fehlertyp unplaus.: Ansauglufttemperatur TANS (-Ladeluft)" UWORD B_TRUE___UW 0 0 0.000000 0.000000 /begin IF_DATA ASAP1B_ETK KP_BLOB 0x383BE0 1 2 /end IF_DATA BIT_MASK 0x800 /end MEASUREMENT
/begin MEASUREMENT B_nptes "Fehlertyp 'unplausibles PrÅfresultat' erkannt (TEV offen)" UWORD B_TRUE___UW 0 0 0.000000 0.000000 /begin IF_DATA ASAP1B_ETK KP_BLOB 0x383BE4 1 2 /end IF_DATA BIT_MASK 0x800 /end MEASUREMENT
/begin MEASUREMENT B_nptm "Fehlerart: Motortemperatursignal nicht plausibel ggÅ. Modell" UWORD B_TRUE___UW 0 0 0.000000 0.000000 /begin IF_DATA ASAP1B_ETK KP_BLOB 0x383BEE 1 2 /end IF_DATA BIT_MASK 0x800 /end MEASUREMENT
/begin MEASUREMENT B_nptun "Bedingung: Tuningschutz unplausibel" UWORD B_TRUE___UW 0 0 0.000000 0.000000 /begin IF_DATA ASAP1B_ETK KP_BLOB 0x383BF4 1 2 /end IF_DATA BIT_MASK 0x800 /end MEASUREMENT
/begin MEASUREMENT B_npub "Fehlerart: Batteriespannungssignal nicht plausibel" UWORD B_TRUE___UW 0 0 0.000000 0.000000 /begin IF_DATA ASAP1B_ETK KP_BLOB 0x383BF6 1 2 /end IF_DATA BIT_MASK 0x800 /end MEASUREMENT
/begin MEASUREMENT B_npufmv "Fehlertyp unplaus.: FunktionsÅberwachung: Momentenvergleich" UWORD B_TRUE___UW 0 0 0.000000 0.000000 /begin IF_DATA ASAP1B_ETK KP_BLOB 0x383BF8 1 2 /end IF_DATA BIT_MASK 0x800 /end MEASUREMENT
/begin MEASUREMENT B_npufska "Fehlertyp unplaus.: FunktionsÅberwachung: Sicherheits-Kraftstoff-Abschaltung" UWORD B_TRUE___UW 0 0 0.000000 0.000000 /begin IF_DATA ASAP1B_ETK KP_BLOB 0x383BFA 1 2 /end IF_DATA BIT_MASK 0x800 /end MEASUREMENT
/begin MEASUREMENT B_npurram "Fehlertyp unplaus: RechnerÅberwachung: RAM" UWORD B_TRUE___UW 0 0 0.000000 0.000000 /begin IF_DATA ASAP1B_ETK KP_BLOB 0x383BFC 1 2 /end IF_DATA BIT_MASK 0x800 /end MEASUREMENT
/begin MEASUREMENT B_npurrom "Fehlertyp unplaus.: RechnerÅberwachung: ROM" UWORD B_TRUE___UW 0 0 0.000000 0.000000 /begin IF_DATA ASAP1B_ETK KP_BLOB 0x383BFE 1 2 /end IF_DATA BIT_MASK 0x800 /end MEASUREMENT
/begin MEASUREMENT B_npurrst "Fehlertyp unplaus: RechnerÅberwachung: Reset" UWORD B_TRUE___UW 0 0 0.000000 0.000000 /begin IF_DATA ASAP1B_ETK KP_BLOB 0x383C00 1 2 /end IF_DATA BIT_MASK 0x800 /end MEASUREMENT
/begin MEASUREMENT B_npvfz "Fehlerart: Fahrzeuggeschwindigkeit nicht plausibel" UWORD B_TRUE___UW 0 0 0.000000 0.000000 /begin IF_DATA ASAP1B_ETK KP_BLOB 0x383C04 1 2 /end IF_DATA BIT_MASK 0x800 /end MEASUREMENT
/begin MEASUREMENT B_npwfs "Fehlerart: Wegfahrsperre" UWORD B_TRUE___UW 0 0 0.000000 0.000000 /begin IF_DATA ASAP1B_ETK KP_BLOB 0x383C06 1 2 /end IF_DATA BIT_MASK 0x800 /end MEASUREMENT
/begin MEASUREMENT B_npwfsrc "" UWORD B_TRUE___UW 0 0 0.000000 0.000000 /begin IF_DATA ASAP1B_ETK KP_BLOB 0x383C08 1 2 /end IF_DATA BIT_MASK 0x800 /end MEASUREMENT
/begin MEASUREMENT B_pwf "Bedingung Powerfail" UWORD B_TRUE___UW 0 0 0.000000 0.000000 /begin IF_DATA ASAP1B_ETK KP_BLOB 0xFD88 0 2 /end IF_DATA BIT_MASK 0x10 /end MEASUREMENT
/begin MEASUREMENT B_pygecod "" UWORD B_TRUE___UW 0 0 0.000000 0.000000 /begin IF_DATA ASAP1B_ETK KP_BLOB 0x383B52 1 2 /end IF_DATA BIT_MASK 0x2000 /end MEASUREMENT
/begin MEASUREMENT B_pytes "Leckdiagnose ist physikalisch freigegeben" UWORD B_TRUE___UW 0 0 0.000000 0.000000 /begin IF_DATA ASAP1B_ETK KP_BLOB 0x383BE4 1 2 /end IF_DATA BIT_MASK 0x2000 /end MEASUREMENT
/begin MEASUREMENT B_rinh "Bedingung Innenwiderstand Ri-Messung der Nernstsonde aktiv hinter Kat" UWORD B_TRUE___UW 0 0 0.000000 0.000000 /begin IF_DATA ASAP1B_ETK KP_BLOB 0xFD24 0 2 /end IF_DATA BIT_MASK 0x100 /end MEASUREMENT
/begin MEASUREMENT B_rinv "Bedingung Innenwiderstand Ri-Messung der Nernstsonde aktiv vor Kat" UWORD B_TRUE___UW 0 0 0.000000 0.000000 /begin IF_DATA ASAP1B_ETK KP_BLOB 0xFD2C 0 2 /end IF_DATA BIT_MASK 0x8000 /end MEASUREMENT
/begin MEASUREMENT B_sbbhk "Bedingung Sonde betriebsbereit hinter Kat" UWORD B_TRUE___UW 0 0 0.000000 0.000000 /begin IF_DATA ASAP1B_ETK KP_BLOB 0xFD22 0 2 /end IF_DATA BIT_MASK 0x2000 /end MEASUREMENT
/begin MEASUREMENT B_scgecod "" UWORD B_TRUE___UW 0 0 0.000000 0.000000 /begin IF_DATA ASAP1B_ETK KP_BLOB 0x383B52 1 2 /end IF_DATA BIT_MASK 0x4000 /end MEASUREMENT
/begin MEASUREMENT B_sctes "Leckdiagnose ist vom Scheduler freigegeben" UWORD B_TRUE___UW 0 0 0.000000 0.000000 /begin IF_DATA ASAP1B_ETK KP_BLOB 0x383BE4 1 2 /end IF_DATA BIT_MASK 0x4000 /end MEASUREMENT
/begin MEASUREMENT B_sibrems "Fehlertyp BREMS (Bremsschalter): Signal inaktiv" UWORD B_TRUE___UW 0 0 0.000000 0.000000 /begin IF_DATA ASAP1B_ETK KP_BLOB 0x383AF8 1 2 /end IF_DATA BIT_MASK 0x400 /end MEASUREMENT
/begin MEASUREMENT B_sibwf "Fehlertyp sig.: PWG Bewegung" UWORD B_TRUE___UW 0 0 0.000000 0.000000 /begin IF_DATA ASAP1B_ETK KP_BLOB 0x383AFA 1 2 /end IF_DATA BIT_MASK 0x400 /end MEASUREMENT
/begin MEASUREMENT B_siddpl "" UWORD B_TRUE___UW 0 0 0.000000 0.000000 /begin IF_DATA ASAP1B_ETK KP_BLOB 0x383B10 1 2 /end IF_DATA BIT_MASK 0x400 /end MEASUREMENT
/begin MEASUREMENT B_sidsl "Bedingung Signalfehler Ladedrucksensor" UWORD B_TRUE___UW 0 0 0.000000 0.000000 /begin IF_DATA ASAP1B_ETK KP_BLOB 0x383B12 1 2 /end IF_DATA BIT_MASK 0x400 /end MEASUREMENT
/begin MEASUREMENT B_sidsu "Fehlerart: Umgebungsdrucksensor" UWORD B_TRUE___UW 0 0 0.000000 0.000000 /begin IF_DATA ASAP1B_ETK KP_BLOB 0x383B16 1 2 /end IF_DATA BIT_MASK 0x400 /end MEASUREMENT
/begin MEASUREMENT B_sidsvlu "Fehlerart: Drucksensorsingalvergleich (DS-L DS-U)" UWORD B_TRUE___UW 0 0 0.000000 0.000000 /begin IF_DATA ASAP1B_ETK KP_BLOB 0x383B18 1 2 /end IF_DATA BIT_MASK 0x400 /end MEASUREMENT
/begin MEASUREMENT B_siegfe "" UWORD B_TRUE___UW 0 0 0.000000 0.000000 /begin IF_DATA ASAP1B_ETK KP_BLOB 0x383B30 1 2 /end IF_DATA BIT_MASK 0x400 /end MEASUREMENT
/begin MEASUREMENT B_sifp1p "Fehlerart: Fahrpedal 1.Potentiometer" UWORD B_TRUE___UW 0 0 0.000000 0.000000 /begin IF_DATA ASAP1B_ETK KP_BLOB 0x383B46 1 2 /end IF_DATA BIT_MASK 0x400 /end MEASUREMENT
/begin MEASUREMENT B_sifp2p "Fehlerart: Fahrpedal 2.Potentiometer" UWORD B_TRUE___UW 0 0 0.000000 0.000000 /begin IF_DATA ASAP1B_ETK KP_BLOB 0x383B48 1 2 /end IF_DATA BIT_MASK 0x400 /end MEASUREMENT
/begin MEASUREMENT B_sifpp "Fehlerart: Fahrpedal Potentiometer" UWORD B_TRUE___UW 0 0 0.000000 0.000000 /begin IF_DATA ASAP1B_ETK KP_BLOB 0x383B4A 1 2 /end IF_DATA BIT_MASK 0x400 /end MEASUREMENT
/begin MEASUREMENT B_sigecod "" UWORD B_TRUE___UW 0 0 0.000000 0.000000 /begin IF_DATA ASAP1B_ETK KP_BLOB 0x383B52 1 2 /end IF_DATA BIT_MASK 0x400 /end MEASUREMENT
/begin MEASUREMENT B_sigrbh "Fehlerart: GRA-Bedienhebel" UWORD B_TRUE___UW 0 0 0.000000 0.000000 /begin IF_DATA ASAP1B_ETK KP_BLOB 0x383B54 1 2 /end IF_DATA BIT_MASK 0x400 /end MEASUREMENT
/begin MEASUREMENT B_sildpe "Fehlertype: Leitungsabfall Endstufe Leckage Pumpe" UWORD B_TRUE___UW 0 0 0.000000 0.000000 /begin IF_DATA ASAP1B_ETK KP_BLOB 0x383B96 1 2 /end IF_DATA BIT_MASK 0x400 /end MEASUREMENT
/begin MEASUREMENT B_simd "Fehlertyp sig.: Aussetzer, Summenfehler (multiple)" UWORD B_TRUE___UW 0 0 0.000000 0.000000 /begin IF_DATA ASAP1B_ETK KP_BLOB 0x383BA2 1 2 /end IF_DATA BIT_MASK 0x400 /end MEASUREMENT
/begin MEASUREMENT B_simd01 "Fehlertyp sig.: Aussetzer ZÅndung 1" UWORD B_TRUE___UW 0 0 0.000000 0.000000 /begin IF_DATA ASAP1B_ETK KP_BLOB 0x383BA4 1 2 /end IF_DATA BIT_MASK 0x400 /end MEASUREMENT
/begin MEASUREMENT B_simd02 "Fehlertyp sig.: Aussetzer ZÅndung 2" UWORD B_TRUE___UW 0 0 0.000000 0.000000 /begin IF_DATA ASAP1B_ETK KP_BLOB 0x383BA6 1 2 /end IF_DATA BIT_MASK 0x400 /end MEASUREMENT
/begin MEASUREMENT B_simd03 "Fehlertyp sig.: Aussetzer ZÅndung 3" UWORD B_TRUE___UW 0 0 0.000000 0.000000 /begin IF_DATA ASAP1B_ETK KP_BLOB 0x383BA8 1 2 /end IF_DATA BIT_MASK 0x400 /end MEASUREMENT
/begin MEASUREMENT B_simd04 "Fehlertyp sig.: Aussetzer ZÅndung 4" UWORD B_TRUE___UW 0 0 0.000000 0.000000 /begin IF_DATA ASAP1B_ETK KP_BLOB 0x383BAA 1 2 /end IF_DATA BIT_MASK 0x400 /end MEASUREMENT
/begin MEASUREMENT B_simdb "Fehlertyp: MomentanÅberwachung begrenzt dauerhaft" UWORD B_TRUE___UW 0 0 0.000000 0.000000 /begin IF_DATA ASAP1B_ETK KP_BLOB 0x383BAC 1 2 /end IF_DATA BIT_MASK 0x400 /end MEASUREMENT
/begin MEASUREMENT B_simdk "Fehlertyp sig.: Aussetzer, Summenfehler - multiple, kundendienstrelevant" UWORD B_TRUE___UW 0 0 0.000000 0.000000 /begin IF_DATA ASAP1B_ETK KP_BLOB 0x383BAE 1 2 /end IF_DATA BIT_MASK 0x400 /end MEASUREMENT
/begin MEASUREMENT B_simdk01 "Fehlertyp sig.: Aussetzer, ZÅndung 1, kundendienstrelevant" UWORD B_TRUE___UW 0 0 0.000000 0.000000 /begin IF_DATA ASAP1B_ETK KP_BLOB 0x383BB0 1 2 /end IF_DATA BIT_MASK 0x400 /end MEASUREMENT
/begin MEASUREMENT B_simdk02 "Fehlertyp sig.: Aussetzer, ZÅndung 2, kundendienstrelevant" UWORD B_TRUE___UW 0 0 0.000000 0.000000 /begin IF_DATA ASAP1B_ETK KP_BLOB 0x383BB2 1 2 /end IF_DATA BIT_MASK 0x400 /end MEASUREMENT
/begin MEASUREMENT B_simdk03 "Fehlertyp sig.: Aussetzer, ZÅndung 3, kundendienstrelevant" UWORD B_TRUE___UW 0 0 0.000000 0.000000 /begin IF_DATA ASAP1B_ETK KP_BLOB 0x383BB4 1 2 /end IF_DATA BIT_MASK 0x400 /end MEASUREMENT
/begin MEASUREMENT B_simdk04 "Fehlertyp sig.: Aussetzer, ZÅndung 4, kundendienstrelevant" UWORD B_TRUE___UW 0 0 0.000000 0.000000 /begin IF_DATA ASAP1B_ETK KP_BLOB 0x383BB6 1 2 /end IF_DATA BIT_MASK 0x400 /end MEASUREMENT
/begin MEASUREMENT B_sinwkw "Fehlertyp: Zuordnung Nockenwelle zu Kurbelwelle" UWORD B_TRUE___UW 0 0 0.000000 0.000000 /begin IF_DATA ASAP1B_ETK KP_BLOB 0x383BBC 1 2 /end IF_DATA BIT_MASK 0x400 /end MEASUREMENT
/begin MEASUREMENT B_sinwkw2 "Fehlertyp: Zuordnung Nockenwelle 2 zu Kurbelwelle" UWORD B_TRUE___UW 0 0 0.000000 0.000000 /begin IF_DATA ASAP1B_ETK KP_BLOB 0x383BBE 1 2 /end IF_DATA BIT_MASK 0x400 /end MEASUREMENT
/begin MEASUREMENT B_sinws "Fehlerart : Signalfehler Nockenwellengeber" UWORD B_TRUE___UW 0 0 0.000000 0.000000 /begin IF_DATA ASAP1B_ETK KP_BLOB 0x383BC0 1 2 /end IF_DATA BIT_MASK 0x400 /end MEASUREMENT
/begin MEASUREMENT B_sinws2 "Fehlerart : Sinalfehler Nockenwellengeber Bank2" UWORD B_TRUE___UW 0 0 0.000000 0.000000 /begin IF_DATA ASAP1B_ETK KP_BLOB 0x383BC2 1 2 /end IF_DATA BIT_MASK 0x400 /end MEASUREMENT
/begin MEASUREMENT B_sinx "Fehlertyp sig.: öberdrehzahl" UWORD B_TRUE___UW 0 0 0.000000 0.000000 /begin IF_DATA ASAP1B_ETK KP_BLOB 0x383BC6 1 2 /end IF_DATA BIT_MASK 0x400 /end MEASUREMENT
/begin MEASUREMENT B_siph "Bedingung keine alternierende Phasenpegel PG in den Bezugsmarken" UWORD B_TRUE___UW 0 0 0.000000 0.000000 /begin IF_DATA ASAP1B_ETK KP_BLOB 0x383BC8 1 2 /end IF_DATA BIT_MASK 0x400 /end MEASUREMENT
/begin MEASUREMENT B_sipwm "" UWORD B_TRUE___UW 0 0 0.000000 0.000000 /begin IF_DATA ASAP1B_ETK KP_BLOB 0x383BCA 1 2 /end IF_DATA BIT_MASK 0x400 /end MEASUREMENT
/begin MEASUREMENT B_sisgeew "Fehlerart: SteuergerÑt defekt (EEPROM-WFS)" UWORD B_TRUE___UW 0 0 0.000000 0.000000 /begin IF_DATA ASAP1B_ETK KP_BLOB 0x383BD0 1 2 /end IF_DATA BIT_MASK 0x400 /end MEASUREMENT
/begin MEASUREMENT B_sisls "Fehlertype: SekundÑrluftsystem" UWORD B_TRUE___UW 0 0 0.000000 0.000000 /begin IF_DATA ASAP1B_ETK KP_BLOB 0x383BD4 1 2 /end IF_DATA BIT_MASK 0x400 /end MEASUREMENT
/begin MEASUREMENT B_sislv "Fehlertyp: SekundÑrluftventil" UWORD B_TRUE___UW 0 0 0.000000 0.000000 /begin IF_DATA ASAP1B_ETK KP_BLOB 0x383BD6 1 2 /end IF_DATA BIT_MASK 0x400 /end MEASUREMENT
/begin MEASUREMENT B_sislwg "" UWORD B_TRUE___UW 0 0 0.000000 0.000000 /begin IF_DATA ASAP1B_ETK KP_BLOB 0x383BDA 1 2 /end IF_DATA BIT_MASK 0x400 /end MEASUREMENT
/begin MEASUREMENT B_siswe "Fehlertyp: Geschwindigkeitssignal nicht vorhanden" UWORD B_TRUE___UW 0 0 0.000000 0.000000 /begin IF_DATA ASAP1B_ETK KP_BLOB 0x383BDE 1 2 /end IF_DATA BIT_MASK 0x400 /end MEASUREMENT
/begin MEASUREMENT B_sita "Fehlertyp: Ansauglufttemperatur TANS (-Ladeluft)" UWORD B_TRUE___UW 0 0 0.000000 0.000000 /begin IF_DATA ASAP1B_ETK KP_BLOB 0x383BE0 1 2 /end IF_DATA BIT_MASK 0x400 /end MEASUREMENT
/begin MEASUREMENT B_sites "Fehlerart: TEV offen" UWORD B_TRUE___UW 0 0 0.000000 0.000000 /begin IF_DATA ASAP1B_ETK KP_BLOB 0x383BE4 1 2 /end IF_DATA BIT_MASK 0x400 /end MEASUREMENT
/begin MEASUREMENT B_sitm "Fehlerart: Motortemperaturschwelle fÅr Lambdaregelungsfreigabe nicht erreicht" UWORD B_TRUE___UW 0 0 0.000000 0.000000 /begin IF_DATA ASAP1B_ETK KP_BLOB 0x383BEE 1 2 /end IF_DATA BIT_MASK 0x400 /end MEASUREMENT
/begin MEASUREMENT B_situn "Signalfehler Tuningschutz" UWORD B_TRUE___UW 0 0 0.000000 0.000000 /begin IF_DATA ASAP1B_ETK KP_BLOB 0x383BF4 1 2 /end IF_DATA BIT_MASK 0x400 /end MEASUREMENT
/begin MEASUREMENT B_siub "Fehlertyp: Umweltbedingungen" UWORD B_TRUE___UW 0 0 0.000000 0.000000 /begin IF_DATA ASAP1B_ETK KP_BLOB 0x383BF6 1 2 /end IF_DATA BIT_MASK 0x400 /end MEASUREMENT
/begin MEASUREMENT B_siufmv "Fehlertyp sig.: FunktionsÅberwachung: Momentenvergleich" UWORD B_TRUE___UW 0 0 0.000000 0.000000 /begin IF_DATA ASAP1B_ETK KP_BLOB 0x383BF8 1 2 /end IF_DATA BIT_MASK 0x400 /end MEASUREMENT
/begin MEASUREMENT B_siufska "Fehlertyp sig.: FunktionsÅberwachung: Sicherheits-Kraftstoff-Abschaltung" UWORD B_TRUE___UW 0 0 0.000000 0.000000 /begin IF_DATA ASAP1B_ETK KP_BLOB 0x383BFA 1 2 /end IF_DATA BIT_MASK 0x400 /end MEASUREMENT
/begin MEASUREMENT B_siurram "Fehlertyp sig.: RechnerÅberwachung: RAM" UWORD B_TRUE___UW 0 0 0.000000 0.000000 /begin IF_DATA ASAP1B_ETK KP_BLOB 0x383BFC 1 2 /end IF_DATA BIT_MASK 0x400 /end MEASUREMENT
/begin MEASUREMENT B_siurrom "Fehlertyp sig.: RechnerÅberwachung: ROM" UWORD B_TRUE___UW 0 0 0.000000 0.000000 /begin IF_DATA ASAP1B_ETK KP_BLOB 0x383BFE 1 2 /end IF_DATA BIT_MASK 0x400 /end MEASUREMENT
/begin MEASUREMENT B_siurrst "Fehlertyp sig.: RechnerÅberwachung: Reset" UWORD B_TRUE___UW 0 0 0.000000 0.000000 /begin IF_DATA ASAP1B_ETK KP_BLOB 0x383C00 1 2 /end IF_DATA BIT_MASK 0x400 /end MEASUREMENT
/begin MEASUREMENT B_sivfz "Bedingung fehlendes Signal Fahrzeuggeschwindigkeit" UWORD B_TRUE___UW 0 0 0.000000 0.000000 /begin IF_DATA ASAP1B_ETK KP_BLOB 0x383C04 1 2 /end IF_DATA BIT_MASK 0x400 /end MEASUREMENT
/begin MEASUREMENT B_siwfs "Fehlerart: Wegfahrsperre" UWORD B_TRUE___UW 0 0 0.000000 0.000000 /begin IF_DATA ASAP1B_ETK KP_BLOB 0x383C06 1 2 /end IF_DATA BIT_MASK 0x400 /end MEASUREMENT
/begin MEASUREMENT B_siwfsrc "" UWORD B_TRUE___UW 0 0 0.000000 0.000000 /begin IF_DATA ASAP1B_ETK KP_BLOB 0x383C08 1 2 /end IF_DATA BIT_MASK 0x400 /end MEASUREMENT
/begin MEASUREMENT B_sls "Bedingung SekundÑrluft aktiv" UWORD B_TRUE___UW 0 0 0.000000 0.000000 /begin IF_DATA ASAP1B_ETK KP_BLOB 0xFD0A 0 2 /end IF_DATA BIT_MASK 0x800 /end MEASUREMENT
/begin MEASUREMENT B_slsrdy "Bedingung SLS geprÅft fÅr 'ready-Byte'" UBYTE B_TRUE 0 0 0.000000 0.000000 /begin IF_DATA ASAP1B_ETK KP_BLOB 0x383312 1 1 /end IF_DATA BIT_MASK 0x8 /end MEASUREMENT
/begin MEASUREMENT B_stend "1 = Startende erkannt" UWORD B_TRUE___UW 0 0 0.000000 0.000000 /begin IF_DATA ASAP1B_ETK KP_BLOB 0xFD88 0 2 /end IF_DATA BIT_MASK 0x40 /end MEASUREMENT
/begin MEASUREMENT B_szkat "Zykluszeit und Fehler in einer Bank abgelaufen" UWORD B_TRUE___UW 0 0 0.000000 0.000000 /begin IF_DATA ASAP1B_ETK KP_BLOB 0xFD30 0 2 /end IF_DATA BIT_MASK 0x100 /end MEASUREMENT
/begin MEASUREMENT B_tehb "Bedingung TankentlÅftung mit hoher Beladung" UWORD B_TRUE___UW 0 0 0.000000 0.000000 /begin IF_DATA ASAP1B_ETK KP_BLOB 0xFD8A 0 2 /end IF_DATA BIT_MASK 0x1 /end MEASUREMENT
/begin MEASUREMENT B_tesrdy "Bedingung TES geprÅft fÅr 'ready-Byte'" UBYTE B_TRUE 0 0 0.000000 0.000000 /begin IF_DATA ASAP1B_ETK KP_BLOB 0x383312 1 1 /end IF_DATA BIT_MASK 0x4 /end MEASUREMENT
/begin MEASUREMENT B_tmkr "Bedingung Temperatur (tmot) fuer KR aktiv erreicht" UWORD B_TRUE___UW 0 0 0.000000 0.000000 /begin IF_DATA ASAP1B_ETK KP_BLOB 0xFD72 0 2 /end IF_DATA BIT_MASK 0x4 /end MEASUREMENT
/begin MEASUREMENT B_trig "Bedingung fÅr Umschaltung der VerstÑrkerstufen und Skalierung des Referenzpegels" UWORD B_TRUE___UW 0 0 0.000000 0.000000 /begin IF_DATA ASAP1B_ETK KP_BLOB 0xFD30 0 2 /end IF_DATA BIT_MASK 0x200 /end MEASUREMENT
/begin MEASUREMENT B_ukg "Bedingung ök wirkt stark" UWORD B_TRUE___UW 0 0 0.000000 0.000000 /begin IF_DATA ASAP1B_ETK KP_BLOB 0xFD64 0 2 /end IF_DATA BIT_MASK 0x1 /end MEASUREMENT
/begin MEASUREMENT B_zkatb "Bankspezifische Zykluszeit fÅr MODE 6" UWORD B_TRUE___UW 0 0 0.000000 0.000000 /begin IF_DATA ASAP1B_ETK KP_BLOB 0xFD30 0 2 /end IF_DATA BIT_MASK 0x400 /end MEASUREMENT
/begin MEASUREMENT B_zkats "Zykluszeit fÅr eine Bank abgelaufen" UWORD B_TRUE___UW 0 0 0.000000 0.000000 /begin IF_DATA ASAP1B_ETK KP_BLOB 0xFD30 0 2 /end IF_DATA BIT_MASK 0x800 /end MEASUREMENT
/begin MEASUREMENT B_zkatz "Bedinging fÅr Summenfehler im MODE 6" UWORD B_TRUE___UW 0 0 0.000000 0.000000 /begin IF_DATA ASAP1B_ETK KP_BLOB 0xFD30 0 2 /end IF_DATA BIT_MASK 0x1000 /end MEASUREMENT
/begin MEASUREMENT B_ztes "DTEV einmal abgelaufen" UBYTE B_TRUE 0 0 0.000000 0.000000 /begin IF_DATA ASAP1B_ETK KP_BLOB 0x383311 1 1 /end IF_DATA BIT_MASK 0x1 /end MEASUREMENT
/begin MEASUREMENT B_ztesf "Leckdiagnose einmal" UBYTE B_TRUE 0 0 0.000000 0.000000 /begin IF_DATA ASAP1B_ETK KP_BLOB 0x383311 1 1 /end IF_DATA BIT_MASK 0x2 /end MEASUREMENT
/begin MEASUREMENT cd_bits1_w "" UWORD dez___UW 0 0 0.000000 65535.000000 /begin IF_DATA ASAP1B_ETK KP_BLOB 0x380D30 1 2 /end IF_DATA BIT_MASK 0xFFFF /end MEASUREMENT
/begin MEASUREMENT cd_bits2_w "" UWORD dez___UW 0 0 0.000000 65535.000000 /begin IF_DATA ASAP1B_ETK KP_BLOB 0x380D32 1 2 /end IF_DATA BIT_MASK 0xFFFF /end MEASUREMENT
/begin MEASUREMENT cryhs "Counter fÅr Readinessbildung Sondenheizungs-Diagnose" UBYTE dez 0 0 0.000000 255.000000 /begin IF_DATA ASAP1B_ETK KP_BLOB 0x38330B 1 1 /end IF_DATA BIT_MASK 0xFF /end MEASUREMENT
/begin MEASUREMENT crykat "Counter fÅr Readinessbildung Katalysator-Diagnose" UBYTE dez 0 0 0.000000 255.000000 /begin IF_DATA ASAP1B_ETK KP_BLOB 0x38330C 1 1 /end IF_DATA BIT_MASK 0xFF /end MEASUREMENT
/begin MEASUREMENT cryls "Counter fÅr Readinessbildung Lambdasonden-Diagnose" UBYTE dez 0 0 0.000000 255.000000 /begin IF_DATA ASAP1B_ETK KP_BLOB 0x38330D 1 1 /end IF_DATA BIT_MASK 0xFF /end MEASUREMENT
/begin MEASUREMENT crysls "Counter fÅr Readinessbildung SekundÑrluft-Diagnose" UBYTE dez 0 0 0.000000 255.000000 /begin IF_DATA ASAP1B_ETK KP_BLOB 0x38330E 1 1 /end IF_DATA BIT_MASK 0xFF /end MEASUREMENT
/begin MEASUREMENT crytes "Counter fÅr Readinessbildung TankentlÅftungs-Diagnose" UBYTE dez 0 0 0.000000 255.000000 /begin IF_DATA ASAP1B_ETK KP_BLOB 0x38330F 1 1 /end IF_DATA BIT_MASK 0xFF /end MEASUREMENT
/begin MEASUREMENT dkatakt_w "aktive öberwachungszeit fÅr DKAT" UWORD t50msxs_uw_b3276p75 0 0 0.000000 3276.750000 /begin IF_DATA ASAP1B_ETK KP_BLOB 0x381C0A 1 2 /end IF_DATA BIT_MASK 0xFFFF /end MEASUREMENT
/begin MEASUREMENT dkractr "ZÅndungszÑhler fÅr Diagnose Klopfregelanschlag" UWORD dez___UW 0 0 0.000000 65535.000000 /begin IF_DATA ASAP1B_ETK KP_BLOB 0x382186 1 2 /end IF_DATA BIT_MASK 0xFFFF /end MEASUREMENT
/begin MEASUREMENT dmrdkt_w "Momenten-Reserve fÅr Katalysatordiagnose" UWORD rel_uw_b100 0 0 0.000000 99.998474 /begin IF_DATA ASAP1B_ETK KP_BLOB 0x381C06 1 2 /end IF_DATA BIT_MASK 0xFFFF /end MEASUREMENT
/begin MEASUREMENT eevx "EV Fehlerbyte" UBYTE dez 0 0 0.000000 255.000000 /begin IF_DATA ASAP1B_ETK KP_BLOB 0x380B19 1 1 /end IF_DATA BIT_MASK 0xFF /end MEASUREMENT
/begin MEASUREMENT esst_sdk08feuw "" UWORD dez___UW 0 0 0.000000 65535.000000 /begin IF_DATA ASAP1B_ETK KP_BLOB 0x381E1C 1 2 /end IF_DATA BIT_MASK 0xFFFF /end MEASUREMENT
/begin MEASUREMENT esst_sml05dkub "" UWORD dez___UW 0 0 0.000000 65535.000000 /begin IF_DATA ASAP1B_ETK KP_BLOB 0x380E12 1 2 /end IF_DATA BIT_MASK 0xFFFF /end MEASUREMENT
/begin MEASUREMENT esst_snm05dkub "" UWORD dez___UW 0 0 0.000000 65535.000000 /begin IF_DATA ASAP1B_ETK KP_BLOB 0x380E1E 1 2 /end IF_DATA BIT_MASK 0xFFFF /end MEASUREMENT
/begin MEASUREMENT esst_snm08feuw "" UWORD dez___UW 0 0 0.000000 65535.000000 /begin IF_DATA ASAP1B_ETK KP_BLOB 0x381E1E 1 2 /end IF_DATA BIT_MASK 0xFFFF /end MEASUREMENT
/begin MEASUREMENT esst_snm16krub "" UWORD dez___UW 0 0 0.000000 65535.000000 /begin IF_DATA ASAP1B_ETK KP_BLOB 0x380E36 1 2 /end IF_DATA BIT_MASK 0xFFFF /end MEASUREMENT
/begin MEASUREMENT evsup1 "Funktionskennungsbyte fÅr Ausgabe SAE J1979 Mode2" UBYTE dez 0 0 0.000000 255.000000 /begin IF_DATA ASAP1B_ETK KP_BLOB 0x383310 1 1 /end IF_DATA BIT_MASK 0xFF /end MEASUREMENT
/begin MEASUREMENT E_agrf "Errorflag: öberwachung AGR-FLOW" UWORD B_TRUE___UW 0 0 0.000000 0.000000 /begin IF_DATA ASAP1B_ETK KP_BLOB 0x383AF4 1 2 /end IF_DATA BIT_MASK 0x1 /end MEASUREMENT
/begin MEASUREMENT E_brems "Fehlerflag: BREMS (Bremsschalter)" UWORD B_TRUE___UW 0 0 0.000000 0.000000 /begin IF_DATA ASAP1B_ETK KP_BLOB 0x383AF8 1 2 /end IF_DATA BIT_MASK 0x1 /end MEASUREMENT
/begin MEASUREMENT E_bwf "Errorflag: PWG Bewegung" UWORD B_TRUE___UW 0 0 0.000000 0.000000 /begin IF_DATA ASAP1B_ETK KP_BLOB 0x383AFA 1 2 /end IF_DATA BIT_MASK 0x1 /end MEASUREMENT
/begin MEASUREMENT E_dpl "Errorflag: Dauerplus" UWORD B_TRUE___UW 0 0 0.000000 0.000000 /begin IF_DATA ASAP1B_ETK KP_BLOB 0x383B10 1 2 /end IF_DATA BIT_MASK 0x1 /end MEASUREMENT
/begin MEASUREMENT E_dsl "Errorflag: Drucksensor Ladedruck" UWORD B_TRUE___UW 0 0 0.000000 0.000000 /begin IF_DATA ASAP1B_ETK KP_BLOB 0x383B12 1 2 /end IF_DATA BIT_MASK 0x1 /end MEASUREMENT
/begin MEASUREMENT E_dss "Errorflag: Saugrohr-Drucksensor" UWORD B_TRUE___UW 0 0 0.000000 0.000000 /begin IF_DATA ASAP1B_ETK KP_BLOB 0x383B14 1 2 /end IF_DATA BIT_MASK 0x1 /end MEASUREMENT
/begin MEASUREMENT E_dsu "Errorflag: Umgebungsdrucksensor" UWORD B_TRUE___UW 0 0 0.000000 0.000000 /begin IF_DATA ASAP1B_ETK KP_BLOB 0x383B16 1 2 /end IF_DATA BIT_MASK 0x1 /end MEASUREMENT
/begin MEASUREMENT E_dsvlu "Errorflag: Drucksensorsignalvergleich (DS-L DS-U)" UWORD B_TRUE___UW 0 0 0.000000 0.000000 /begin IF_DATA ASAP1B_ETK KP_BLOB 0x383B18 1 2 /end IF_DATA BIT_MASK 0x1 /end MEASUREMENT
/begin MEASUREMENT E_egfe "Errorflag: Eingangsgrî·en FÅllungserfassung" UWORD B_TRUE___UW 0 0 0.000000 0.000000 /begin IF_DATA ASAP1B_ETK KP_BLOB 0x383B30 1 2 /end IF_DATA BIT_MASK 0x1 /end MEASUREMENT
/begin MEASUREMENT E_fp1p "Errorflag: Fahrpedal 1. Poti" UWORD B_TRUE___UW 0 0 0.000000 0.000000 /begin IF_DATA ASAP1B_ETK KP_BLOB 0x383B46 1 2 /end IF_DATA BIT_MASK 0x1 /end MEASUREMENT
/begin MEASUREMENT E_fp2p "Errorflag: Fahrpedal 2. Poti" UWORD B_TRUE___UW 0 0 0.000000 0.000000 /begin IF_DATA ASAP1B_ETK KP_BLOB 0x383B48 1 2 /end IF_DATA BIT_MASK 0x1 /end MEASUREMENT
/begin MEASUREMENT E_fpp "Errorflag Fahrpedal-Poti" UWORD B_TRUE___UW 0 0 0.000000 0.000000 /begin IF_DATA ASAP1B_ETK KP_BLOB 0x383B4A 1 2 /end IF_DATA BIT_MASK 0x1 /end MEASUREMENT
/begin MEASUREMENT E_gecod "Errorflag: Getriebe-Codierung" UWORD B_TRUE___UW 0 0 0.000000 0.000000 /begin IF_DATA ASAP1B_ETK KP_BLOB 0x383B52 1 2 /end IF_DATA BIT_MASK 0x1 /end MEASUREMENT
/begin MEASUREMENT E_grbh "Errorflag: GRA Bedienhebel" UWORD B_TRUE___UW 0 0 0.000000 0.000000 /begin IF_DATA ASAP1B_ETK KP_BLOB 0x383B54 1 2 /end IF_DATA BIT_MASK 0x1 /end MEASUREMENT
/begin MEASUREMENT E_ldpe "Errorflag: Leckdiagnosepumpe Endstufe" UWORD B_TRUE___UW 0 0 0.000000 0.000000 /begin IF_DATA ASAP1B_ETK KP_BLOB 0x383B96 1 2 /end IF_DATA BIT_MASK 0x1 /end MEASUREMENT
/begin MEASUREMENT E_md "Errorflag: Aussetzer, Summenfehler (multiple)" UWORD B_TRUE___UW 0 0 0.000000 0.000000 /begin IF_DATA ASAP1B_ETK KP_BLOB 0x383BA2 1 2 /end IF_DATA BIT_MASK 0x1 /end MEASUREMENT
/begin MEASUREMENT E_md01 "Errorflag: Aussetzer ZÅndung 1" UWORD B_TRUE___UW 0 0 0.000000 0.000000 /begin IF_DATA ASAP1B_ETK KP_BLOB 0x383BA4 1 2 /end IF_DATA BIT_MASK 0x1 /end MEASUREMENT
/begin MEASUREMENT E_md02 "Errorflag: Aussetzer ZÅndung 2" UWORD B_TRUE___UW 0 0 0.000000 0.000000 /begin IF_DATA ASAP1B_ETK KP_BLOB 0x383BA6 1 2 /end IF_DATA BIT_MASK 0x1 /end MEASUREMENT
/begin MEASUREMENT E_md03 "Errorflag: Aussetzer ZÅndung 3" UWORD B_TRUE___UW 0 0 0.000000 0.000000 /begin IF_DATA ASAP1B_ETK KP_BLOB 0x383BA8 1 2 /end IF_DATA BIT_MASK 0x1 /end MEASUREMENT
/begin MEASUREMENT E_md04 "Errorflag: Aussetzer ZÅndung 4" UWORD B_TRUE___UW 0 0 0.000000 0.000000 /begin IF_DATA ASAP1B_ETK KP_BLOB 0x383BAA 1 2 /end IF_DATA BIT_MASK 0x1 /end MEASUREMENT
/begin MEASUREMENT E_mdb "Errorflag: MomentenÅberwachung begrenzt dauerhaft" UWORD B_TRUE___UW 0 0 0.000000 0.000000 /begin IF_DATA ASAP1B_ETK KP_BLOB 0x383BAC 1 2 /end IF_DATA BIT_MASK 0x1 /end MEASUREMENT
/begin MEASUREMENT E_mdk "Errorflag: Aussetzer, Summenfehler - multiple, kundendienstrelevant" UWORD B_TRUE___UW 0 0 0.000000 0.000000 /begin IF_DATA ASAP1B_ETK KP_BLOB 0x383BAE 1 2 /end IF_DATA BIT_MASK 0x1 /end MEASUREMENT
/begin MEASUREMENT E_mdk01 "Errorflag: Aussetzer, ZÅndung 1, kundendienstrelevant" UWORD B_TRUE___UW 0 0 0.000000 0.000000 /begin IF_DATA ASAP1B_ETK KP_BLOB 0x383BB0 1 2 /end IF_DATA BIT_MASK 0x1 /end MEASUREMENT
/begin MEASUREMENT E_mdk02 "Errorflag: Aussetzer, ZÅndung 2, kundendienstrelevant" UWORD B_TRUE___UW 0 0 0.000000 0.000000 /begin IF_DATA ASAP1B_ETK KP_BLOB 0x383BB2 1 2 /end IF_DATA BIT_MASK 0x1 /end MEASUREMENT
/begin MEASUREMENT E_mdk03 "Errorflag: Aussetzer, ZÅndung 3, kundendienstrelevant" UWORD B_TRUE___UW 0 0 0.000000 0.000000 /begin IF_DATA ASAP1B_ETK KP_BLOB 0x383BB4 1 2 /end IF_DATA BIT_MASK 0x1 /end MEASUREMENT
/begin MEASUREMENT E_mdk04 "Errorflag: Aussetzer, ZÅndung 4,  kundendienstrelevant" UWORD B_TRUE___UW 0 0 0.000000 0.000000 /begin IF_DATA ASAP1B_ETK KP_BLOB 0x383BB6 1 2 /end IF_DATA BIT_MASK 0x1 /end MEASUREMENT
/begin MEASUREMENT E_nwkw "Errorflag: Zuordnung Nockenwelle zu Kurbelwelle" UWORD B_TRUE___UW 0 0 0.000000 0.000000 /begin IF_DATA ASAP1B_ETK KP_BLOB 0x383BBC 1 2 /end IF_DATA BIT_MASK 0x1 /end MEASUREMENT
/begin MEASUREMENT E_nwkw2 "Errorflag: Zuordnung Nockenwelle 2 zu Kurbelwelle" UWORD B_TRUE___UW 0 0 0.000000 0.000000 /begin IF_DATA ASAP1B_ETK KP_BLOB 0x383BBE 1 2 /end IF_DATA BIT_MASK 0x1 /end MEASUREMENT
/begin MEASUREMENT E_nws "Errorflag: Nockenwellensteuerung" UWORD B_TRUE___UW 0 0 0.000000 0.000000 /begin IF_DATA ASAP1B_ETK KP_BLOB 0x383BC0 1 2 /end IF_DATA BIT_MASK 0x1 /end MEASUREMENT
/begin MEASUREMENT E_nws2 "Errorflag: Nockenwellensteuerung (Bank 2)" UWORD B_TRUE___UW 0 0 0.000000 0.000000 /begin IF_DATA ASAP1B_ETK KP_BLOB 0x383BC2 1 2 /end IF_DATA BIT_MASK 0x1 /end MEASUREMENT
/begin MEASUREMENT E_nx "Errorflag: NMAX - öberschreitung" UWORD B_TRUE___UW 0 0 0.000000 0.000000 /begin IF_DATA ASAP1B_ETK KP_BLOB 0x383BC6 1 2 /end IF_DATA BIT_MASK 0x1 /end MEASUREMENT
/begin MEASUREMENT E_ph "Errorflag: Phasensensor" UWORD B_TRUE___UW 0 0 0.000000 0.000000 /begin IF_DATA ASAP1B_ETK KP_BLOB 0x383BC8 1 2 /end IF_DATA BIT_MASK 0x1 /end MEASUREMENT
/begin MEASUREMENT E_pwm "Fehler PWM-Signal" UWORD B_TRUE___UW 0 0 0.000000 0.000000 /begin IF_DATA ASAP1B_ETK KP_BLOB 0x383BCA 1 2 /end IF_DATA BIT_MASK 0x1 /end MEASUREMENT
/begin MEASUREMENT E_sgeew "Errorflag: SteuergerÑt defekt (EEPROM - WFS)" UWORD B_TRUE___UW 0 0 0.000000 0.000000 /begin IF_DATA ASAP1B_ETK KP_BLOB 0x383BD0 1 2 /end IF_DATA BIT_MASK 0x1 /end MEASUREMENT
/begin MEASUREMENT E_sls "Errorflag: SekundÑrluft-System" UWORD B_TRUE___UW 0 0 0.000000 0.000000 /begin IF_DATA ASAP1B_ETK KP_BLOB 0x383BD4 1 2 /end IF_DATA BIT_MASK 0x1 /end MEASUREMENT
/begin MEASUREMENT E_slv "Errorflag: SekundÑrluftventil" UWORD B_TRUE___UW 0 0 0.000000 0.000000 /begin IF_DATA ASAP1B_ETK KP_BLOB 0x383BD6 1 2 /end IF_DATA BIT_MASK 0x1 /end MEASUREMENT
/begin MEASUREMENT E_slwg "Errorflag: Waste- Gate- Ansteuerung" UWORD B_TRUE___UW 0 0 0.000000 0.000000 /begin IF_DATA ASAP1B_ETK KP_BLOB 0x383BDA 1 2 /end IF_DATA BIT_MASK 0x1 /end MEASUREMENT
/begin MEASUREMENT E_swe "Errorflag: Beschleunigungssensor der Schlechtwegeerkennung" UWORD B_TRUE___UW 0 0 0.000000 0.000000 /begin IF_DATA ASAP1B_ETK KP_BLOB 0x383BDE 1 2 /end IF_DATA BIT_MASK 0x1 /end MEASUREMENT
/begin MEASUREMENT E_ta "Errorflag: TANS" UWORD B_TRUE___UW 0 0 0.000000 0.000000 /begin IF_DATA ASAP1B_ETK KP_BLOB 0x383BE0 1 2 /end IF_DATA BIT_MASK 0x1 /end MEASUREMENT
/begin MEASUREMENT E_tankl "Errorflag: OBDII-Fehler auf Grund eines leeren Tanks" UWORD B_TRUE___UW 0 0 0.000000 0.000000 /begin IF_DATA ASAP1B_ETK KP_BLOB 0x383BE2 1 2 /end IF_DATA BIT_MASK 0x1 /end MEASUREMENT
/begin MEASUREMENT E_tes "Errorflag: TankentlÅftungssystem" UWORD B_TRUE___UW 0 0 0.000000 0.000000 /begin IF_DATA ASAP1B_ETK KP_BLOB 0x383BE4 1 2 /end IF_DATA BIT_MASK 0x1 /end MEASUREMENT
/begin MEASUREMENT E_teve2 "Errorflag: TankentlÅftungsventil Endstufe, Bank 2" UWORD B_TRUE___UW 0 0 0.000000 0.000000 /begin IF_DATA ASAP1B_ETK KP_BLOB 0x383BEC 1 2 /end IF_DATA BIT_MASK 0x1 /end MEASUREMENT
/begin MEASUREMENT E_tm "Errorflag: TMOT" UWORD B_TRUE___UW 0 0 0.000000 0.000000 /begin IF_DATA ASAP1B_ETK KP_BLOB 0x383BEE 1 2 /end IF_DATA BIT_MASK 0x1 /end MEASUREMENT
/begin MEASUREMENT E_tol "Errorflag: ôltemperatur" UWORD B_TRUE___UW 0 0 0.000000 0.000000 /begin IF_DATA ASAP1B_ETK KP_BLOB 0x383BF0 1 2 /end IF_DATA BIT_MASK 0x1 /end MEASUREMENT
/begin MEASUREMENT E_tum "Errorflag:  Umgebungstemperatur tumg" UWORD B_TRUE___UW 0 0 0.000000 0.000000 /begin IF_DATA ASAP1B_ETK KP_BLOB 0x383BF2 1 2 /end IF_DATA BIT_MASK 0x1 /end MEASUREMENT
/begin MEASUREMENT E_tun "Errorflag: Tuningschutz" UWORD B_TRUE___UW 0 0 0.000000 0.000000 /begin IF_DATA ASAP1B_ETK KP_BLOB 0x383BF4 1 2 /end IF_DATA BIT_MASK 0x1 /end MEASUREMENT
/begin MEASUREMENT E_ub "Errorflag: UB" UWORD B_TRUE___UW 0 0 0.000000 0.000000 /begin IF_DATA ASAP1B_ETK KP_BLOB 0x383BF6 1 2 /end IF_DATA BIT_MASK 0x1 /end MEASUREMENT
/begin MEASUREMENT E_ufmv "Errorflag: FunktionsÅberwachung: Momentenvergleich" UWORD B_TRUE___UW 0 0 0.000000 0.000000 /begin IF_DATA ASAP1B_ETK KP_BLOB 0x383BF8 1 2 /end IF_DATA BIT_MASK 0x1 /end MEASUREMENT
/begin MEASUREMENT E_ufska "Errorflag: FunktionsÅberwachung: Sicherheits-Kraftstoff-Abschaltung" UWORD B_TRUE___UW 0 0 0.000000 0.000000 /begin IF_DATA ASAP1B_ETK KP_BLOB 0x383BFA 1 2 /end IF_DATA BIT_MASK 0x1 /end MEASUREMENT
/begin MEASUREMENT E_urram "Errorflag: RechnerÅberwachung: RAM" UWORD B_TRUE___UW 0 0 0.000000 0.000000 /begin IF_DATA ASAP1B_ETK KP_BLOB 0x383BFC 1 2 /end IF_DATA BIT_MASK 0x1 /end MEASUREMENT
/begin MEASUREMENT E_urrom "Errorflag: RechnerÅberwachung: ROM" UWORD B_TRUE___UW 0 0 0.000000 0.000000 /begin IF_DATA ASAP1B_ETK KP_BLOB 0x383BFE 1 2 /end IF_DATA BIT_MASK 0x1 /end MEASUREMENT
/begin MEASUREMENT E_urrst "Errorflag: RechnerÅberwachung: Reset" UWORD B_TRUE___UW 0 0 0.000000 0.000000 /begin IF_DATA ASAP1B_ETK KP_BLOB 0x383C00 1 2 /end IF_DATA BIT_MASK 0x1 /end MEASUREMENT
/begin MEASUREMENT E_vfz "Errorflag: Fahrzeug-Geschwindigkeit" UWORD B_TRUE___UW 0 0 0.000000 0.000000 /begin IF_DATA ASAP1B_ETK KP_BLOB 0x383C04 1 2 /end IF_DATA BIT_MASK 0x1 /end MEASUREMENT
/begin MEASUREMENT E_wfs "Errorflag: Wegfahrsperre" UWORD B_TRUE___UW 0 0 0.000000 0.000000 /begin IF_DATA ASAP1B_ETK KP_BLOB 0x383C06 1 2 /end IF_DATA BIT_MASK 0x1 /end MEASUREMENT
/begin MEASUREMENT E_wfsrc "" UWORD B_TRUE___UW 0 0 0.000000 0.000000 /begin IF_DATA ASAP1B_ETK KP_BLOB 0x383C08 1 2 /end IF_DATA BIT_MASK 0x1 /end MEASUREMENT
/begin MEASUREMENT falrdkt "Anforderung Katdiagnose: Modifikation der Lambdregelungsamplitude" UBYTE fak_ub_b8 0 0 0.000000 7.968750 /begin IF_DATA ASAP1B_ETK KP_BLOB 0x380A8B 1 1 /end IF_DATA BIT_MASK 0xFF /end MEASUREMENT
/begin MEASUREMENT flgdimc "" UBYTE dez 0 0 0.000000 255.000000 /begin IF_DATA ASAP1B_ETK KP_BLOB 0x383311 1 1 /end IF_DATA BIT_MASK 0xFF /end MEASUREMENT
/begin MEASUREMENT flmxctr_0_A "" UWORD dez___UW 0 0 0.000000 65535.000000 /begin IF_DATA ASAP1B_ETK KP_BLOB 0x382188 1 2 /end IF_DATA BIT_MASK 0xFFFF /end MEASUREMENT
/begin MEASUREMENT flmxctr_1_A "" UWORD dez___UW 0 0 0.000000 65535.000000 /begin IF_DATA ASAP1B_ETK KP_BLOB 0x38218A 1 2 /end IF_DATA BIT_MASK 0xFFFF /end MEASUREMENT
/begin MEASUREMENT flmxctr_2_A "" UWORD dez___UW 0 0 0.000000 65535.000000 /begin IF_DATA ASAP1B_ETK KP_BLOB 0x38218C 1 2 /end IF_DATA BIT_MASK 0xFFFF /end MEASUREMENT
/begin MEASUREMENT flmxctr_3_A "" UWORD dez___UW 0 0 0.000000 65535.000000 /begin IF_DATA ASAP1B_ETK KP_BLOB 0x38218E 1 2 /end IF_DATA BIT_MASK 0xFFFF /end MEASUREMENT
/begin MEASUREMENT flmxctr_4_A "" UWORD dez___UW 0 0 0.000000 65535.000000 /begin IF_DATA ASAP1B_ETK KP_BLOB 0x382190 1 2 /end IF_DATA BIT_MASK 0xFFFF /end MEASUREMENT
/begin MEASUREMENT flmxctr_5_A "" UWORD dez___UW 0 0 0.000000 65535.000000 /begin IF_DATA ASAP1B_ETK KP_BLOB 0x382192 1 2 /end IF_DATA BIT_MASK 0xFFFF /end MEASUREMENT
/begin MEASUREMENT flmxctr_6_A "" UWORD dez___UW 0 0 0.000000 65535.000000 /begin IF_DATA ASAP1B_ETK KP_BLOB 0x382194 1 2 /end IF_DATA BIT_MASK 0xFFFF /end MEASUREMENT
/begin MEASUREMENT flmxctr_7_A "" UWORD dez___UW 0 0 0.000000 65535.000000 /begin IF_DATA ASAP1B_ETK KP_BLOB 0x382196 1 2 /end IF_DATA BIT_MASK 0xFFFF /end MEASUREMENT
/begin MEASUREMENT fr_w "Lambda-Regler-Ausgang (Word)" UWORD fak_uw_b2 0 0 0.000000 1.999969 /begin IF_DATA ASAP1B_ETK KP_BLOB 0x3828A8 1 2 /end IF_DATA BIT_MASK 0xFFFF /end MEASUREMENT
/begin MEASUREMENT igokr_w "Integratorgradient fÅr Offsetkorrektur Klopfregelung (Word)" SWORD spgg_sw_b3052 0 0 -3051.759206 3051.666074 /begin IF_DATA ASAP1B_ETK KP_BLOB 0x38215C 1 2 /end IF_DATA BIT_MASK 0xFFFF /end MEASUREMENT
/begin MEASUREMENT ikrma "Integratorwert Klopfregelung Me·fensteranfang" UBYTE spg_ub_b5 0 0 0.000000 4.980469 /begin IF_DATA ASAP1B_ETK KP_BLOB 0x380B70 1 1 /end IF_DATA BIT_MASK 0xFF /end MEASUREMENT
/begin MEASUREMENT ikrmet "Integratorwert Klopfregelung Me·fensterende Testimpuls" UBYTE spg_ub_b5 0 0 0.000000 4.980469 /begin IF_DATA ASAP1B_ETK KP_BLOB 0x380B72 1 1 /end IF_DATA BIT_MASK 0xFF /end MEASUREMENT
/begin MEASUREMENT katbf "Signal nach Speicher normiert vergleichbar mit ushk" UBYTE spg_ub_q0p0052_o0p2 0 0 -0.200000 1.130000 /begin IF_DATA ASAP1B_ETK KP_BLOB 0x380A8C 1 1 /end IF_DATA BIT_MASK 0xFF /end MEASUREMENT
/begin MEASUREMENT katbfi_w "Sauerstoff-Anteil vor dem Speicher (Kat-Modell)" SWORD freq_sw_b512 0 0 -512.000000 511.984375 /begin IF_DATA ASAP1B_ETK KP_BLOB 0x381C0C 1 2 /end IF_DATA BIT_MASK 0xFFFF /end MEASUREMENT
/begin MEASUREMENT katbfs "Signal nach Speicher (Kat-Modell)" SBYTE fak_sb_b1 0 0 -1.000000 0.992188 /begin IF_DATA ASAP1B_ETK KP_BLOB 0x380A8D 1 1 /end IF_DATA BIT_MASK 0xFF /end MEASUREMENT
/begin MEASUREMENT katbftp "Signal nach Speicher normiert, tiefpa·gefiltert" UBYTE spg_ub_q0p0052 0 0 0.000000 1.330000 /begin IF_DATA ASAP1B_ETK KP_BLOB 0x380A8E 1 1 /end IF_DATA BIT_MASK 0xFF /end MEASUREMENT
/begin MEASUREMENT katbshd_w "Signal fÅr Fett-Verschiebung des Modells" SWORD mgrad_sw_b28p44 0 0 -28.444444 28.443576 /begin IF_DATA ASAP1B_ETK KP_BLOB 0x381C0E 1 2 /end IF_DATA BIT_MASK 0xFFFF /end MEASUREMENT
/begin MEASUREMENT kbdkt_w "Katbelastungssignal" SWORD mgrad_sw_b28p44 0 0 -28.444444 28.443576 /begin IF_DATA ASAP1B_ETK KP_BLOB 0x381C10 1 2 /end IF_DATA BIT_MASK 0xFFFF /end MEASUREMENT
/begin MEASUREMENT ks_sym_0__A "Eingang des Klopfauswerte-IC" UBYTE dez 0 0 0.000000 255.000000 /begin IF_DATA ASAP1B_ETK KP_BLOB 0xE3F1 0 1 /end IF_DATA BIT_MASK 0xFF /end MEASUREMENT
/begin MEASUREMENT ks_sym_1__A "Eingang des Klopfauswerte-IC" UBYTE dez 0 0 0.000000 255.000000 /begin IF_DATA ASAP1B_ETK KP_BLOB 0xE3F2 0 1 /end IF_DATA BIT_MASK 0xFF /end MEASUREMENT
/begin MEASUREMENT ks_sym_2__A "Eingang des Klopfauswerte-IC" UBYTE dez 0 0 0.000000 255.000000 /begin IF_DATA ASAP1B_ETK KP_BLOB 0xE3F3 0 1 /end IF_DATA BIT_MASK 0xFF /end MEASUREMENT
/begin MEASUREMENT ks_sym_3__A "Eingang des Klopfauswerte-IC" UBYTE dez 0 0 0.000000 255.000000 /begin IF_DATA ASAP1B_ETK KP_BLOB 0xE3F4 0 1 /end IF_DATA BIT_MASK 0xFF /end MEASUREMENT
/begin MEASUREMENT mldmn_w "minimale Luftmasse aus Kennfeld KFMLDMN" SWORD m_q0p1___SW 0 0 -3276.800000 3276.700000 /begin IF_DATA ASAP1B_ETK KP_BLOB 0x381E20 1 2 /end IF_DATA BIT_MASK 0xFFFF /end MEASUREMENT
/begin MEASUREMENT mldmx_w "maximale Luftmasse aus Kennfeld KFMLDMX" UWORD m_q0p1___UW 0 0 0.000000 6553.500000 /begin IF_DATA ASAP1B_ETK KP_BLOB 0x381E22 1 2 /end IF_DATA BIT_MASK 0xFFFF /end MEASUREMENT
/begin MEASUREMENT mlhfmf_w "gefilterter Luftmassen HFM-Mittelwert 16Bit-Wert" UWORD m_q0p1___UW 0 0 0.000000 6553.500000 /begin IF_DATA ASAP1B_ETK KP_BLOB 0x381E24 1 2 /end IF_DATA BIT_MASK 0xFFFF /end MEASUREMENT
/begin MEASUREMENT mlhfmm_w "Luftmassen HFM-Mittelwert 16Bit-Wert" UWORD m_uw_b6553p5 0 0 0.000000 6553.500000 /begin IF_DATA ASAP1B_ETK KP_BLOB 0xF986 0 2 /end IF_DATA BIT_MASK 0xFFFF /end MEASUREMENT
/begin MEASUREMENT phlsnh "normierte Heizleistung der Lambdasonde hinter Kat" UBYTE fak_ub_q0p01 0 0 0.000000 2.550000 /begin IF_DATA ASAP1B_ETK KP_BLOB 0x380A96 1 1 /end IF_DATA BIT_MASK 0xFF /end MEASUREMENT
/begin MEASUREMENT phlsnv "normierte Heizleistung der Lambdasonde vor Kat" UBYTE fak_ub_q0p01 0 0 0.000000 2.550000 /begin IF_DATA ASAP1B_ETK KP_BLOB 0x380A98 1 1 /end IF_DATA BIT_MASK 0xFF /end MEASUREMENT
/begin MEASUREMENT ready "readiness-Byte fÅr Ausgabe SAE J1979 Mode2" UBYTE dez 0 0 0.000000 255.000000 /begin IF_DATA ASAP1B_ETK KP_BLOB 0x383312 1 1 /end IF_DATA BIT_MASK 0xFF /end MEASUREMENT
/begin MEASUREMENT rinh_w "Istwert (word) Innenwiderstand Ri-Nernstzelle der Lambdasonde hinter KAT" UWORD r_uw_q2 0 0 0.000000 131070.000000 /begin IF_DATA ASAP1B_ETK KP_BLOB 0x381B42 1 2 /end IF_DATA BIT_MASK 0xFFFF /end MEASUREMENT
/begin MEASUREMENT rinkfh "Innenwiderstand Nernstzelle der Lambdasonde aus Kennfeld vor Kat" UBYTE r_q8 0 0 0.000000 2040.000000 /begin IF_DATA ASAP1B_ETK KP_BLOB 0x380A64 1 1 /end IF_DATA BIT_MASK 0xFF /end MEASUREMENT
/begin MEASUREMENT rinkfv "Innenwiderstand Nernstzelle der Lambdasonde aus Kennfeld vor Kat" UBYTE r_q8 0 0 0.000000 2040.000000 /begin IF_DATA ASAP1B_ETK KP_BLOB 0x380AAB 1 1 /end IF_DATA BIT_MASK 0xFF /end MEASUREMENT
/begin MEASUREMENT rinsh_w "Grenzwert Innenwiderstand Nernstzelle der Lambdasonde hinter Kat" UWORD r_uw_q2 0 0 0.000000 131070.000000 /begin IF_DATA ASAP1B_ETK KP_BLOB 0x381AF8 1 2 /end IF_DATA BIT_MASK 0xFFFF /end MEASUREMENT
/begin MEASUREMENT rinsv_w "Grenzwert Innenwiderstand Nernstzelle der Lambdasonde vor Kat" UWORD r_uw_q2 0 0 0.000000 131070.000000 /begin IF_DATA ASAP1B_ETK KP_BLOB 0x381C78 1 2 /end IF_DATA BIT_MASK 0xFFFF /end MEASUREMENT
/begin MEASUREMENT rinv_w "Istwert (word) Innenwiderstand Ri-Nernstzelle der Lambdasonde vor KAT" UWORD r_uw_q2 0 0 0.000000 131070.000000 /begin IF_DATA ASAP1B_ETK KP_BLOB 0x381BB6 1 2 /end IF_DATA BIT_MASK 0xFFFF /end MEASUREMENT
/begin MEASUREMENT rkrn_w_0__A "normierter Referenzpegel Klopfregelung" UWORD spg_uw_b1280 0 0 0.000000 1279.983745 /begin IF_DATA ASAP1B_ETK KP_BLOB 0x3821CC 1 2 /end IF_DATA BIT_MASK 0xFFFF /end MEASUREMENT
/begin MEASUREMENT rkrn_w_1__A "normierter Referenzpegel Klopfregelung" UWORD spg_uw_b1280 0 0 0.000000 1279.983745 /begin IF_DATA ASAP1B_ETK KP_BLOB 0x3821CE 1 2 /end IF_DATA BIT_MASK 0xFFFF /end MEASUREMENT
/begin MEASUREMENT rkrn_w_2__A "normierter Referenzpegel Klopfregelung" UWORD spg_uw_b1280 0 0 0.000000 1279.983745 /begin IF_DATA ASAP1B_ETK KP_BLOB 0x3821D0 1 2 /end IF_DATA BIT_MASK 0xFFFF /end MEASUREMENT
/begin MEASUREMENT rkrn_w_3__A "normierter Referenzpegel Klopfregelung" UWORD spg_uw_b1280 0 0 0.000000 1279.983745 /begin IF_DATA ASAP1B_ETK KP_BLOB 0x3821D2 1 2 /end IF_DATA BIT_MASK 0xFFFF /end MEASUREMENT
/begin MEASUREMENT rkrn_w_4__A "normierter Referenzpegel Klopfregelung" UWORD spg_uw_b1280 0 0 0.000000 1279.983745 /begin IF_DATA ASAP1B_ETK KP_BLOB 0x3821D4 1 2 /end IF_DATA BIT_MASK 0xFFFF /end MEASUREMENT
/begin MEASUREMENT rkrn_w_5__A "normierter Referenzpegel Klopfregelung" UWORD spg_uw_b1280 0 0 0.000000 1279.983745 /begin IF_DATA ASAP1B_ETK KP_BLOB 0x3821D6 1 2 /end IF_DATA BIT_MASK 0xFFFF /end MEASUREMENT
/begin MEASUREMENT rkrn_w_6__A "normierter Referenzpegel Klopfregelung" UWORD spg_uw_b1280 0 0 0.000000 1279.983745 /begin IF_DATA ASAP1B_ETK KP_BLOB 0x3821D8 1 2 /end IF_DATA BIT_MASK 0xFFFF /end MEASUREMENT
/begin MEASUREMENT rkrn_w_7__A "normierter Referenzpegel Klopfregelung" UWORD spg_uw_b1280 0 0 0.000000 1279.983745 /begin IF_DATA ASAP1B_ETK KP_BLOB 0x3821DA 1 2 /end IF_DATA BIT_MASK 0xFFFF /end MEASUREMENT
/begin MEASUREMENT rkr_0_A "Referenzpegel Klopfregelung" UBYTE spg_ub_b5 0 0 0.000000 4.980469 /begin IF_DATA ASAP1B_ETK KP_BLOB 0x380B96 1 1 /end IF_DATA BIT_MASK 0xFF /end MEASUREMENT
/begin MEASUREMENT rkr_1_A "Referenzpegel Klopfregelung" UBYTE spg_ub_b5 0 0 0.000000 4.980469 /begin IF_DATA ASAP1B_ETK KP_BLOB 0x380B97 1 1 /end IF_DATA BIT_MASK 0xFF /end MEASUREMENT
/begin MEASUREMENT rkr_2_A "Referenzpegel Klopfregelung" UBYTE spg_ub_b5 0 0 0.000000 4.980469 /begin IF_DATA ASAP1B_ETK KP_BLOB 0x380B98 1 1 /end IF_DATA BIT_MASK 0xFF /end MEASUREMENT
/begin MEASUREMENT rkr_3_A "Referenzpegel Klopfregelung" UBYTE spg_ub_b5 0 0 0.000000 4.980469 /begin IF_DATA ASAP1B_ETK KP_BLOB 0x380B99 1 1 /end IF_DATA BIT_MASK 0xFF /end MEASUREMENT
/begin MEASUREMENT rkr_4_A "Referenzpegel Klopfregelung" UBYTE spg_ub_b5 0 0 0.000000 4.980469 /begin IF_DATA ASAP1B_ETK KP_BLOB 0x380B9A 1 1 /end IF_DATA BIT_MASK 0xFF /end MEASUREMENT
/begin MEASUREMENT rkr_5_A "Referenzpegel Klopfregelung" UBYTE spg_ub_b5 0 0 0.000000 4.980469 /begin IF_DATA ASAP1B_ETK KP_BLOB 0x380B9B 1 1 /end IF_DATA BIT_MASK 0xFF /end MEASUREMENT
/begin MEASUREMENT rkr_6_A "Referenzpegel Klopfregelung" UBYTE spg_ub_b5 0 0 0.000000 4.980469 /begin IF_DATA ASAP1B_ETK KP_BLOB 0x380B9C 1 1 /end IF_DATA BIT_MASK 0xFF /end MEASUREMENT
/begin MEASUREMENT rkr_7_A "Referenzpegel Klopfregelung" UBYTE spg_ub_b5 0 0 0.000000 4.980469 /begin IF_DATA ASAP1B_ETK KP_BLOB 0x380B9D 1 1 /end IF_DATA BIT_MASK 0xFF /end MEASUREMENT
/begin MEASUREMENT rldkthp "Hochpa·gefiltertes rl-Signal" SBYTE rel_sb_q0p75 0 0 -96.000000 95.250000 /begin IF_DATA ASAP1B_ETK KP_BLOB 0x380A8F 1 1 /end IF_DATA BIT_MASK 0xFF /end MEASUREMENT
/begin MEASUREMENT sen_c95_0__A "Klopfsensoreingang am Klopfauswerte-IC" UBYTE dezsub1 0 0 1.000000 256.000000 /begin IF_DATA ASAP1B_ETK KP_BLOB 0x380B75 1 1 /end IF_DATA BIT_MASK 0xFF /end MEASUREMENT
/begin MEASUREMENT sen_c95_1__A "Klopfsensoreingang am Klopfauswerte-IC" UBYTE dezsub1 0 0 1.000000 256.000000 /begin IF_DATA ASAP1B_ETK KP_BLOB 0x380B76 1 1 /end IF_DATA BIT_MASK 0xFF /end MEASUREMENT
/begin MEASUREMENT sen_c95_2__A "Klopfsensoreingang am Klopfauswerte-IC" UBYTE dezsub1 0 0 1.000000 256.000000 /begin IF_DATA ASAP1B_ETK KP_BLOB 0x380B77 1 1 /end IF_DATA BIT_MASK 0xFF /end MEASUREMENT
/begin MEASUREMENT sen_c95_3__A "Klopfsensoreingang am Klopfauswerte-IC" UBYTE dezsub1 0 0 1.000000 256.000000 /begin IF_DATA ASAP1B_ETK KP_BLOB 0x380B78 1 1 /end IF_DATA BIT_MASK 0xFF /end MEASUREMENT
/begin MEASUREMENT sen_c95_4__A "Klopfsensoreingang am Klopfauswerte-IC" UBYTE dezsub1 0 0 1.000000 256.000000 /begin IF_DATA ASAP1B_ETK KP_BLOB 0x380B79 1 1 /end IF_DATA BIT_MASK 0xFF /end MEASUREMENT
/begin MEASUREMENT sen_c95_5__A "Klopfsensoreingang am Klopfauswerte-IC" UBYTE dezsub1 0 0 1.000000 256.000000 /begin IF_DATA ASAP1B_ETK KP_BLOB 0x380B7A 1 1 /end IF_DATA BIT_MASK 0xFF /end MEASUREMENT
/begin MEASUREMENT sen_c95_6__A "Klopfsensoreingang am Klopfauswerte-IC" UBYTE dezsub1 0 0 1.000000 256.000000 /begin IF_DATA ASAP1B_ETK KP_BLOB 0x380B7B 1 1 /end IF_DATA BIT_MASK 0xFF /end MEASUREMENT
/begin MEASUREMENT sen_c95_7__A "Klopfsensoreingang am Klopfauswerte-IC" UBYTE dezsub1 0 0 1.000000 256.000000 /begin IF_DATA ASAP1B_ETK KP_BLOB 0x380B7C 1 1 /end IF_DATA BIT_MASK 0xFF /end MEASUREMENT
/begin MEASUREMENT sfpagrf "Status Fehlerpfad: öberwachung AGR-Flow" UWORD dez___UW 0 0 0.000000 65535.000000 /begin IF_DATA ASAP1B_ETK KP_BLOB 0x383AF4 1 2 /end IF_DATA BIT_MASK 0xFFFF /end MEASUREMENT
/begin MEASUREMENT sfpbrems "Status Fehlerpfad BREMS: Bremsschalter" UWORD dez___UW 0 0 0.000000 65535.000000 /begin IF_DATA ASAP1B_ETK KP_BLOB 0x383AF8 1 2 /end IF_DATA BIT_MASK 0xFFFF /end MEASUREMENT
/begin MEASUREMENT sfpbwf "Statuswort:  PWG Bewegung" UWORD dez___UW 0 0 0.000000 65535.000000 /begin IF_DATA ASAP1B_ETK KP_BLOB 0x383AFA 1 2 /end IF_DATA BIT_MASK 0xFFFF /end MEASUREMENT
/begin MEASUREMENT sfpdpl "Status Fehlerpfad: Dauerplus" UWORD dez___UW 0 0 0.000000 65535.000000 /begin IF_DATA ASAP1B_ETK KP_BLOB 0x383B10 1 2 /end IF_DATA BIT_MASK 0xFFFF /end MEASUREMENT
/begin MEASUREMENT sfpdsl "Status Fehlerpfad: Drucksensor Ladedruck" UWORD dez___UW 0 0 0.000000 65535.000000 /begin IF_DATA ASAP1B_ETK KP_BLOB 0x383B12 1 2 /end IF_DATA BIT_MASK 0xFFFF /end MEASUREMENT
/begin MEASUREMENT sfpdss "" UWORD dez___UW 0 0 0.000000 65535.000000 /begin IF_DATA ASAP1B_ETK KP_BLOB 0x383B14 1 2 /end IF_DATA BIT_MASK 0xFFFF /end MEASUREMENT
/begin MEASUREMENT sfpdsu "Status Fehlerpfad: Umgebungsdrucksensor" UWORD dez___UW 0 0 0.000000 65535.000000 /begin IF_DATA ASAP1B_ETK KP_BLOB 0x383B16 1 2 /end IF_DATA BIT_MASK 0xFFFF /end MEASUREMENT
/begin MEASUREMENT sfpdsvlu "Status Fehlerpfad:Drucksensorsignalvergleich (DS-L DS-U)" UWORD dez___UW 0 0 0.000000 65535.000000 /begin IF_DATA ASAP1B_ETK KP_BLOB 0x383B18 1 2 /end IF_DATA BIT_MASK 0xFFFF /end MEASUREMENT
/begin MEASUREMENT sfpegfe "" UWORD dez___UW 0 0 0.000000 65535.000000 /begin IF_DATA ASAP1B_ETK KP_BLOB 0x383B30 1 2 /end IF_DATA BIT_MASK 0xFFFF /end MEASUREMENT
/begin MEASUREMENT sfpfp1p "Status Fehlerpfad: Fahrpedal 1.Potentiometer" UWORD dez___UW 0 0 0.000000 65535.000000 /begin IF_DATA ASAP1B_ETK KP_BLOB 0x383B46 1 2 /end IF_DATA BIT_MASK 0xFFFF /end MEASUREMENT
/begin MEASUREMENT sfpfp2p "Status Fehlerpfad: Fahrpedal 2.Potentiometer" UWORD dez___UW 0 0 0.000000 65535.000000 /begin IF_DATA ASAP1B_ETK KP_BLOB 0x383B48 1 2 /end IF_DATA BIT_MASK 0xFFFF /end MEASUREMENT
/begin MEASUREMENT sfpfpp "Status Fehlerpfad: Fahrpedal Potentiometer" UWORD dez___UW 0 0 0.000000 65535.000000 /begin IF_DATA ASAP1B_ETK KP_BLOB 0x383B4A 1 2 /end IF_DATA BIT_MASK 0xFFFF /end MEASUREMENT
/begin MEASUREMENT sfpgecod "" UWORD dez___UW 0 0 0.000000 65535.000000 /begin IF_DATA ASAP1B_ETK KP_BLOB 0x383B52 1 2 /end IF_DATA BIT_MASK 0xFFFF /end MEASUREMENT
/begin MEASUREMENT sfpgrbh "Status Fehlerpfad: GRA-Bedienhebel" UWORD default 0 0 0.000000 65535.000000 /begin IF_DATA ASAP1B_ETK KP_BLOB 0x383B54 1 2 /end IF_DATA BIT_MASK 0xFFFF /end MEASUREMENT
/begin MEASUREMENT sfpldpe "Status Fehlerpfad: Leckdiagnosepumpe - Endstufe" UWORD dez___UW 0 0 0.000000 65535.000000 /begin IF_DATA ASAP1B_ETK KP_BLOB 0x383B96 1 2 /end IF_DATA BIT_MASK 0xFFFF /end MEASUREMENT
/begin MEASUREMENT sfpmd "Statuswort:  Aussetzer, Summenfehler (multiple)" UWORD dez___UW 0 0 0.000000 65535.000000 /begin IF_DATA ASAP1B_ETK KP_BLOB 0x383BA2 1 2 /end IF_DATA BIT_MASK 0xFFFF /end MEASUREMENT
/begin MEASUREMENT sfpmd01 "Statuswort:  Aussetzer ZÅndung 1" UWORD dez___UW 0 0 0.000000 65535.000000 /begin IF_DATA ASAP1B_ETK KP_BLOB 0x383BA4 1 2 /end IF_DATA BIT_MASK 0xFFFF /end MEASUREMENT
/begin MEASUREMENT sfpmd02 "Statuswort:  Aussetzer ZÅndung 2" UWORD dez___UW 0 0 0.000000 65535.000000 /begin IF_DATA ASAP1B_ETK KP_BLOB 0x383BA6 1 2 /end IF_DATA BIT_MASK 0xFFFF /end MEASUREMENT
/begin MEASUREMENT sfpmd03 "Statuswort:  Aussetzer ZÅndung 3" UWORD dez___UW 0 0 0.000000 65535.000000 /begin IF_DATA ASAP1B_ETK KP_BLOB 0x383BA8 1 2 /end IF_DATA BIT_MASK 0xFFFF /end MEASUREMENT
/begin MEASUREMENT sfpmd04 "Statuswort:  Aussetzer ZÅndung 4" UWORD dez___UW 0 0 0.000000 65535.000000 /begin IF_DATA ASAP1B_ETK KP_BLOB 0x383BAA 1 2 /end IF_DATA BIT_MASK 0xFFFF /end MEASUREMENT
/begin MEASUREMENT sfpmdb "Status Fehlerpfad: MomentanÅberwachung begrenzt dauerhaft" UWORD dez___UW 0 0 0.000000 65535.000000 /begin IF_DATA ASAP1B_ETK KP_BLOB 0x383BAC 1 2 /end IF_DATA BIT_MASK 0xFFFF /end MEASUREMENT
/begin MEASUREMENT sfpmdk "Statuswort:  Aussetzer, Summenfehler - multiple, > 4500 U/min" UWORD dez___UW 0 0 0.000000 65535.000000 /begin IF_DATA ASAP1B_ETK KP_BLOB 0x383BAE 1 2 /end IF_DATA BIT_MASK 0xFFFF /end MEASUREMENT
/begin MEASUREMENT sfpmdk01 "Statuswort:  Aussetzer, ZÅndung 1, > 4500 U/min" UWORD dez___UW 0 0 0.000000 65535.000000 /begin IF_DATA ASAP1B_ETK KP_BLOB 0x383BB0 1 2 /end IF_DATA BIT_MASK 0xFFFF /end MEASUREMENT
/begin MEASUREMENT sfpmdk02 "Statuswort:  Aussetzer, ZÅndung 2, > 4500 U/min" UWORD dez___UW 0 0 0.000000 65535.000000 /begin IF_DATA ASAP1B_ETK KP_BLOB 0x383BB2 1 2 /end IF_DATA BIT_MASK 0xFFFF /end MEASUREMENT
/begin MEASUREMENT sfpmdk03 "Statuswort:  Aussetzer, ZÅndung 3, > 4500 U/min" UWORD dez___UW 0 0 0.000000 65535.000000 /begin IF_DATA ASAP1B_ETK KP_BLOB 0x383BB4 1 2 /end IF_DATA BIT_MASK 0xFFFF /end MEASUREMENT
/begin MEASUREMENT sfpmdk04 "Statuswort:  Aussetzer, ZÅndung 4, > 4500 U/min" UWORD dez___UW 0 0 0.000000 65535.000000 /begin IF_DATA ASAP1B_ETK KP_BLOB 0x383BB6 1 2 /end IF_DATA BIT_MASK 0xFFFF /end MEASUREMENT
/begin MEASUREMENT sfpnwkw "Status Fehlerpfad: Zuordnung Nockenwelle zu Kurbelwelle" UWORD default 0 0 0.000000 65535.000000 /begin IF_DATA ASAP1B_ETK KP_BLOB 0x383BBC 1 2 /end IF_DATA BIT_MASK 0xFFFF /end MEASUREMENT
/begin MEASUREMENT sfpnwkw2 "Status Fehlerpfad: Zuordnung Nockenwelle 2 zu Kurbelwelle" UWORD default 0 0 0.000000 65535.000000 /begin IF_DATA ASAP1B_ETK KP_BLOB 0x383BBE 1 2 /end IF_DATA BIT_MASK 0xFFFF /end MEASUREMENT
/begin MEASUREMENT sfpnws "Status Fehlerpfad: Nockenwellensteuerung" UWORD dez___UW 0 0 0.000000 65535.000000 /begin IF_DATA ASAP1B_ETK KP_BLOB 0x383BC0 1 2 /end IF_DATA BIT_MASK 0xFFFF /end MEASUREMENT
/begin MEASUREMENT sfpnws2 "Status Fehlerpfad: Nockenwellensteuerung Bank 2" UWORD dez___UW 0 0 0.000000 65535.000000 /begin IF_DATA ASAP1B_ETK KP_BLOB 0x383BC2 1 2 /end IF_DATA BIT_MASK 0xFFFF /end MEASUREMENT
/begin MEASUREMENT sfpnx "Statuswort: öberdrehzahl" UWORD dez___UW 0 0 0.000000 65535.000000 /begin IF_DATA ASAP1B_ETK KP_BLOB 0x383BC6 1 2 /end IF_DATA BIT_MASK 0xFFFF /end MEASUREMENT
/begin MEASUREMENT sfpph "Status Fehlerpfad: Phasengeber" UWORD dez___UW 0 0 0.000000 65535.000000 /begin IF_DATA ASAP1B_ETK KP_BLOB 0x383BC8 1 2 /end IF_DATA BIT_MASK 0xFFFF /end MEASUREMENT
/begin MEASUREMENT sfppwm "" UWORD dez___UW 0 0 0.000000 65535.000000 /begin IF_DATA ASAP1B_ETK KP_BLOB 0x383BCA 1 2 /end IF_DATA BIT_MASK 0xFFFF /end MEASUREMENT
/begin MEASUREMENT sfpsgeew "Status Fehlerpfad: SteuergerÑt defekt (EEPROM WFS)" UWORD dez___UW 0 0 0.000000 65535.000000 /begin IF_DATA ASAP1B_ETK KP_BLOB 0x383BD0 1 2 /end IF_DATA BIT_MASK 0xFFFF /end MEASUREMENT
/begin MEASUREMENT sfpsls "Status Fehlerpfad: Diagnose SekundÑrluftsystem" UWORD dez___UW 0 0 0.000000 65535.000000 /begin IF_DATA ASAP1B_ETK KP_BLOB 0x383BD4 1 2 /end IF_DATA BIT_MASK 0xFFFF /end MEASUREMENT
/begin MEASUREMENT sfpslv "Status Fehlerpfad: Diagnose SekundÑrluftventil" UWORD dez___UW 0 0 0.000000 65535.000000 /begin IF_DATA ASAP1B_ETK KP_BLOB 0x383BD6 1 2 /end IF_DATA BIT_MASK 0xFFFF /end MEASUREMENT
/begin MEASUREMENT sfpslwg "" UWORD default 0 0 0.000000 65535.000000 /begin IF_DATA ASAP1B_ETK KP_BLOB 0x383BDA 1 2 /end IF_DATA BIT_MASK 0xFFFF /end MEASUREMENT
/begin MEASUREMENT sfpswe "Status Fehlerpfad Schlechtwegfunktion" UWORD dez___UW 0 0 0.000000 65535.000000 /begin IF_DATA ASAP1B_ETK KP_BLOB 0x383BDE 1 2 /end IF_DATA BIT_MASK 0xFFFF /end MEASUREMENT
/begin MEASUREMENT sfpta "Status Fehlerpfad: Ansauglufttemperatur (Ladeluft-) TANS" UWORD dez___UW 0 0 0.000000 65535.000000 /begin IF_DATA ASAP1B_ETK KP_BLOB 0x383BE0 1 2 /end IF_DATA BIT_MASK 0xFFFF /end MEASUREMENT
/begin MEASUREMENT sfptankl "Statuswort : tankl <Tank leer>" UWORD dez___UW 0 0 0.000000 65535.000000 /begin IF_DATA ASAP1B_ETK KP_BLOB 0x383BE2 1 2 /end IF_DATA BIT_MASK 0xFFFF /end MEASUREMENT
/begin MEASUREMENT sfptes "Status Fehlerpfad: Tankdiagnose, TEV defekt offen" UWORD default 0 0 0.000000 65535.000000 /begin IF_DATA ASAP1B_ETK KP_BLOB 0x383BE4 1 2 /end IF_DATA BIT_MASK 0xFFFF /end MEASUREMENT
/begin MEASUREMENT sfpteve2 "Status Fehlerpfad: TanklÅftungsventil Endstufe Bank 2" UWORD dez___UW 0 0 0.000000 65535.000000 /begin IF_DATA ASAP1B_ETK KP_BLOB 0x383BEC 1 2 /end IF_DATA BIT_MASK 0xFFFF /end MEASUREMENT
/begin MEASUREMENT sfptm "Status Fehlerpfad: Motortemperatur TMOT" UWORD dez___UW 0 0 0.000000 65535.000000 /begin IF_DATA ASAP1B_ETK KP_BLOB 0x383BEE 1 2 /end IF_DATA BIT_MASK 0xFFFF /end MEASUREMENT
/begin MEASUREMENT sfptol "Status Fehlerpfad: (Motor-) Oeltemperatur TOL" UWORD dez___UW 0 0 0.000000 65535.000000 /begin IF_DATA ASAP1B_ETK KP_BLOB 0x383BF0 1 2 /end IF_DATA BIT_MASK 0xFFFF /end MEASUREMENT
/begin MEASUREMENT sfptum "Status Fehlerpfad: Umgebungstemperatur TUM" UWORD dez___UW 0 0 0.000000 65535.000000 /begin IF_DATA ASAP1B_ETK KP_BLOB 0x383BF2 1 2 /end IF_DATA BIT_MASK 0xFFFF /end MEASUREMENT
/begin MEASUREMENT sfptun "Status Fehlerpfad: Tuningschutz" UWORD default 0 0 0.000000 65535.000000 /begin IF_DATA ASAP1B_ETK KP_BLOB 0x383BF4 1 2 /end IF_DATA BIT_MASK 0xFFFF /end MEASUREMENT
/begin MEASUREMENT sfpub "Status Fehlerpfad: Batteriespannung UB (Bordnetz)" UWORD dez___UW 0 0 0.000000 65535.000000 /begin IF_DATA ASAP1B_ETK KP_BLOB 0x383BF6 1 2 /end IF_DATA BIT_MASK 0xFFFF /end MEASUREMENT
/begin MEASUREMENT sfpufmv "Statuswort: FunktionsÅberwachung: Momentenvergleich" UWORD dez___UW 0 0 0.000000 65535.000000 /begin IF_DATA ASAP1B_ETK KP_BLOB 0x383BF8 1 2 /end IF_DATA BIT_MASK 0xFFFF /end MEASUREMENT
/begin MEASUREMENT sfpufska "Statuswort: FunktionsÅberwachung: Sicherheits-Kraftstoff-Abschaltung" UWORD dez___UW 0 0 0.000000 65535.000000 /begin IF_DATA ASAP1B_ETK KP_BLOB 0x383BFA 1 2 /end IF_DATA BIT_MASK 0xFFFF /end MEASUREMENT
/begin MEASUREMENT sfpurram "Statuswort: RechnerÅberwachung: RAM" UWORD dez___UW 0 0 0.000000 65535.000000 /begin IF_DATA ASAP1B_ETK KP_BLOB 0x383BFC 1 2 /end IF_DATA BIT_MASK 0xFFFF /end MEASUREMENT
/begin MEASUREMENT sfpurrom "Statuswort: RechnerÅberwachung: ROM" UWORD dez___UW 0 0 0.000000 65535.000000 /begin IF_DATA ASAP1B_ETK KP_BLOB 0x383BFE 1 2 /end IF_DATA BIT_MASK 0xFFFF /end MEASUREMENT
/begin MEASUREMENT sfpurrst "Statuswort: RechnerÅberwachung: Reset" UWORD dez___UW 0 0 0.000000 65535.000000 /begin IF_DATA ASAP1B_ETK KP_BLOB 0x383C00 1 2 /end IF_DATA BIT_MASK 0xFFFF /end MEASUREMENT
/begin MEASUREMENT sfpvfz "Status Fehlerpfad: Fahrzeuggeschwindigkeit" UWORD dez___UW 0 0 0.000000 65535.000000 /begin IF_DATA ASAP1B_ETK KP_BLOB 0x383C04 1 2 /end IF_DATA BIT_MASK 0xFFFF /end MEASUREMENT
/begin MEASUREMENT sfpwfs "Status Fehlerpfad: Wegfahrsperre" UWORD dez___UW 0 0 0.000000 65535.000000 /begin IF_DATA ASAP1B_ETK KP_BLOB 0x383C06 1 2 /end IF_DATA BIT_MASK 0xFFFF /end MEASUREMENT
/begin MEASUREMENT sfpwfsrc "" UWORD dez___UW 0 0 0.000000 65535.000000 /begin IF_DATA ASAP1B_ETK KP_BLOB 0x383C08 1 2 /end IF_DATA BIT_MASK 0xFFFF /end MEASUREMENT
/begin MEASUREMENT S_kupp "Schalter Kupplung" UWORD B_TRUE___UW 0 0 0.000000 0.000000 /begin IF_DATA ASAP1B_ETK KP_BLOB 0xFD6C 0 2 /end IF_DATA BIT_MASK 0x200 /end MEASUREMENT
/begin MEASUREMENT tc6kata "Anzahl der Ausgabe-Codes SCAN-Tool Mode6 aus Kat-Diagnose" UBYTE dez 0 0 0.000000 255.000000 /begin IF_DATA ASAP1B_ETK KP_BLOB 0x38333B 1 1 /end IF_DATA BIT_MASK 0xFF /end MEASUREMENT
/begin MEASUREMENT tc6katc "Ausgabe-Code SCAN-Tool Mode 6 aus KAT-Diagnose" UBYTE dez 0 0 0.000000 255.000000 /begin IF_DATA ASAP1B_ETK KP_BLOB 0x38333C 1 1 /end IF_DATA BIT_MASK 0xFF /end MEASUREMENT
/begin MEASUREMENT tc6kats "Ausgabe Schwellwert SCAN-Tool Mode 6 aus KAT-Diagnose" UBYTE dez 0 0 0.000000 255.000000 /begin IF_DATA ASAP1B_ETK KP_BLOB 0x38333D 1 1 /end IF_DATA BIT_MASK 0xFF /end MEASUREMENT
/begin MEASUREMENT tc6katw "Ausgabe PrÅfwert SCAN-Tool Mode 6 aus KAT-Diagnose" UBYTE dez 0 0 0.000000 255.000000 /begin IF_DATA ASAP1B_ETK KP_BLOB 0x38333E 1 1 /end IF_DATA BIT_MASK 0xFF /end MEASUREMENT
/begin MEASUREMENT tkdkthp "hochpa·gefilterte Katalysator-Temperatur" UBYTE temp_ub_q5 0 0 0.000000 1275.000000 /begin IF_DATA ASAP1B_ETK KP_BLOB 0x380A85 1 1 /end IF_DATA BIT_MASK 0xFF /end MEASUREMENT
/begin MEASUREMENT tpnt_aktiv "Aktivierung von KR-Funktionen" UBYTE dez 0 0 0.000000 255.000000 /begin IF_DATA ASAP1B_ETK KP_BLOB 0x380B7D 1 1 /end IF_DATA BIT_MASK 0xFF /end MEASUREMENT
/begin MEASUREMENT tvdkttk "TemperaturabhÑngige Verzîgerungszeit" UBYTE t50msxs_q2 0 0 0.000000 510.000000 /begin IF_DATA ASAP1B_ETK KP_BLOB 0x380A91 1 1 /end IF_DATA BIT_MASK 0xFF /end MEASUREMENT
/begin MEASUREMENT TYP_brems "Fehlertyp: Gebergrî·e Bremsschalter" UWORD B_TRUE___UW 0 0 0.000000 0.000000 /begin IF_DATA ASAP1B_ETK KP_BLOB 0x383AF8 1 2 /end IF_DATA BIT_MASK 0xF00 /end MEASUREMENT
/begin MEASUREMENT TYP_bwf "Fehlertyp:  PWG Bewegung" UWORD B_TRUE___UW 0 0 0.000000 0.000000 /begin IF_DATA ASAP1B_ETK KP_BLOB 0x383AFA 1 2 /end IF_DATA BIT_MASK 0xF00 /end MEASUREMENT
/begin MEASUREMENT TYP_dpl "" UWORD B_TRUE___UW 0 0 0.000000 0.000000 /begin IF_DATA ASAP1B_ETK KP_BLOB 0x383B10 1 2 /end IF_DATA BIT_MASK 0xF00 /end MEASUREMENT
/begin MEASUREMENT TYP_dsl "" UWORD B_TRUE___UW 0 0 0.000000 0.000000 /begin IF_DATA ASAP1B_ETK KP_BLOB 0x383B12 1 2 /end IF_DATA BIT_MASK 0xF00 /end MEASUREMENT
/begin MEASUREMENT TYP_dsu "" UWORD B_TRUE___UW 0 0 0.000000 0.000000 /begin IF_DATA ASAP1B_ETK KP_BLOB 0x383B16 1 2 /end IF_DATA BIT_MASK 0xF00 /end MEASUREMENT
/begin MEASUREMENT TYP_dsvlu "" UWORD B_TRUE___UW 0 0 0.000000 0.000000 /begin IF_DATA ASAP1B_ETK KP_BLOB 0x383B18 1 2 /end IF_DATA BIT_MASK 0xF00 /end MEASUREMENT
/begin MEASUREMENT TYP_egfe "" UWORD B_TRUE___UW 0 0 0.000000 0.000000 /begin IF_DATA ASAP1B_ETK KP_BLOB 0x383B30 1 2 /end IF_DATA BIT_MASK 0xF00 /end MEASUREMENT
/begin MEASUREMENT TYP_fp1p "" UWORD B_TRUE___UW 0 0 0.000000 0.000000 /begin IF_DATA ASAP1B_ETK KP_BLOB 0x383B46 1 2 /end IF_DATA BIT_MASK 0xF00 /end MEASUREMENT
/begin MEASUREMENT TYP_fp2p "" UWORD B_TRUE___UW 0 0 0.000000 0.000000 /begin IF_DATA ASAP1B_ETK KP_BLOB 0x383B48 1 2 /end IF_DATA BIT_MASK 0xF00 /end MEASUREMENT
/begin MEASUREMENT TYP_fpp "" UWORD B_TRUE___UW 0 0 0.000000 0.000000 /begin IF_DATA ASAP1B_ETK KP_BLOB 0x383B4A 1 2 /end IF_DATA BIT_MASK 0xF00 /end MEASUREMENT
/begin MEASUREMENT TYP_gecod "" UWORD B_TRUE___UW 0 0 0.000000 0.000000 /begin IF_DATA ASAP1B_ETK KP_BLOB 0x383B52 1 2 /end IF_DATA BIT_MASK 0xF00 /end MEASUREMENT
/begin MEASUREMENT TYP_grbh "" UWORD B_TRUE___UW 0 0 0.000000 0.000000 /begin IF_DATA ASAP1B_ETK KP_BLOB 0x383B54 1 2 /end IF_DATA BIT_MASK 0xF00 /end MEASUREMENT
/begin MEASUREMENT TYP_ldpe "" UWORD B_TRUE___UW 0 0 0.000000 0.000000 /begin IF_DATA ASAP1B_ETK KP_BLOB 0x383B96 1 2 /end IF_DATA BIT_MASK 0xF00 /end MEASUREMENT
/begin MEASUREMENT TYP_md "Fehlertyp:  Aussetzer, Summenfehler (multiple)" UWORD B_TRUE___UW 0 0 0.000000 0.000000 /begin IF_DATA ASAP1B_ETK KP_BLOB 0x383BA2 1 2 /end IF_DATA BIT_MASK 0xF00 /end MEASUREMENT
/begin MEASUREMENT TYP_md01 "Fehlertyp:  Aussetzer ZÅndung 1" UWORD B_TRUE___UW 0 0 0.000000 0.000000 /begin IF_DATA ASAP1B_ETK KP_BLOB 0x383BA4 1 2 /end IF_DATA BIT_MASK 0xF00 /end MEASUREMENT
/begin MEASUREMENT TYP_md02 "Fehlertyp:  Aussetzer ZÅndung 2" UWORD B_TRUE___UW 0 0 0.000000 0.000000 /begin IF_DATA ASAP1B_ETK KP_BLOB 0x383BA6 1 2 /end IF_DATA BIT_MASK 0xF00 /end MEASUREMENT
/begin MEASUREMENT TYP_md03 "Fehlertyp:  Aussetzer ZÅndung 3" UWORD B_TRUE___UW 0 0 0.000000 0.000000 /begin IF_DATA ASAP1B_ETK KP_BLOB 0x383BA8 1 2 /end IF_DATA BIT_MASK 0xF00 /end MEASUREMENT
/begin MEASUREMENT TYP_md04 "Fehlertyp:  Aussetzer ZÅndung 4" UWORD B_TRUE___UW 0 0 0.000000 0.000000 /begin IF_DATA ASAP1B_ETK KP_BLOB 0x383BAA 1 2 /end IF_DATA BIT_MASK 0xF00 /end MEASUREMENT
/begin MEASUREMENT TYP_mdb "Fehlertyp: Momentenbegrenzung (begrenzt dauerhaft) aktiv" UWORD B_TRUE___UW 0 0 0.000000 0.000000 /begin IF_DATA ASAP1B_ETK KP_BLOB 0x383BAC 1 2 /end IF_DATA BIT_MASK 0xF00 /end MEASUREMENT
/begin MEASUREMENT TYP_mdk "Fehlertyp:  Aussetzer, Summenfehler - multiple, > 4500 U/min" UWORD B_TRUE___UW 0 0 0.000000 0.000000 /begin IF_DATA ASAP1B_ETK KP_BLOB 0x383BAE 1 2 /end IF_DATA BIT_MASK 0xF00 /end MEASUREMENT
/begin MEASUREMENT TYP_mdk01 "Fehlertyp:  Aussetzer, ZÅndung 1, > 4500 U/min" UWORD B_TRUE___UW 0 0 0.000000 0.000000 /begin IF_DATA ASAP1B_ETK KP_BLOB 0x383BB0 1 2 /end IF_DATA BIT_MASK 0xF00 /end MEASUREMENT
/begin MEASUREMENT TYP_mdk02 "Fehlertyp:  Aussetzer, ZÅndung 2, > 4500 U/min" UWORD B_TRUE___UW 0 0 0.000000 0.000000 /begin IF_DATA ASAP1B_ETK KP_BLOB 0x383BB2 1 2 /end IF_DATA BIT_MASK 0xF00 /end MEASUREMENT
/begin MEASUREMENT TYP_mdk03 "Fehlertyp:  Aussetzer, ZÅndung 3, > 4500 U/min" UWORD B_TRUE___UW 0 0 0.000000 0.000000 /begin IF_DATA ASAP1B_ETK KP_BLOB 0x383BB4 1 2 /end IF_DATA BIT_MASK 0xF00 /end MEASUREMENT
/begin MEASUREMENT TYP_mdk04 "Fehlertyp:  Aussetzer, ZÅndung 4, > 4500 U/min" UWORD B_TRUE___UW 0 0 0.000000 0.000000 /begin IF_DATA ASAP1B_ETK KP_BLOB 0x383BB6 1 2 /end IF_DATA BIT_MASK 0xF00 /end MEASUREMENT
/begin MEASUREMENT TYP_nwkw "" UWORD B_TRUE___UW 0 0 0.000000 0.000000 /begin IF_DATA ASAP1B_ETK KP_BLOB 0x383BBC 1 2 /end IF_DATA BIT_MASK 0xF00 /end MEASUREMENT
/begin MEASUREMENT TYP_nwkw2 "" UWORD B_TRUE___UW 0 0 0.000000 0.000000 /begin IF_DATA ASAP1B_ETK KP_BLOB 0x383BBE 1 2 /end IF_DATA BIT_MASK 0xF00 /end MEASUREMENT
/begin MEASUREMENT TYP_nws "" UWORD B_TRUE___UW 0 0 0.000000 0.000000 /begin IF_DATA ASAP1B_ETK KP_BLOB 0x383BC0 1 2 /end IF_DATA BIT_MASK 0xF00 /end MEASUREMENT
/begin MEASUREMENT TYP_nws2 "" UWORD B_TRUE___UW 0 0 0.000000 0.000000 /begin IF_DATA ASAP1B_ETK KP_BLOB 0x383BC2 1 2 /end IF_DATA BIT_MASK 0xF00 /end MEASUREMENT
/begin MEASUREMENT TYP_nx "Fehlertyp: öberdrehzahl" UWORD B_TRUE___UW 0 0 0.000000 0.000000 /begin IF_DATA ASAP1B_ETK KP_BLOB 0x383BC6 1 2 /end IF_DATA BIT_MASK 0xF00 /end MEASUREMENT
/begin MEASUREMENT TYP_ph "" UWORD B_TRUE___UW 0 0 0.000000 0.000000 /begin IF_DATA ASAP1B_ETK KP_BLOB 0x383BC8 1 2 /end IF_DATA BIT_MASK 0xF00 /end MEASUREMENT
/begin MEASUREMENT TYP_pwm "" UWORD B_TRUE___UW 0 0 0.000000 0.000000 /begin IF_DATA ASAP1B_ETK KP_BLOB 0x383BCA 1 2 /end IF_DATA BIT_MASK 0xF00 /end MEASUREMENT
/begin MEASUREMENT TYP_sgeew "" UWORD B_TRUE___UW 0 0 0.000000 0.000000 /begin IF_DATA ASAP1B_ETK KP_BLOB 0x383BD0 1 2 /end IF_DATA BIT_MASK 0xF00 /end MEASUREMENT
/begin MEASUREMENT TYP_sls "Fehlertyp: SekundÑrluftsystem" UWORD B_TRUE___UW 0 0 0.000000 0.000000 /begin IF_DATA ASAP1B_ETK KP_BLOB 0x383BD4 1 2 /end IF_DATA BIT_MASK 0xF00 /end MEASUREMENT
/begin MEASUREMENT TYP_slv "Fehlertyp: Dichtheit SekundÑrluftventil" UWORD B_TRUE___UW 0 0 0.000000 0.000000 /begin IF_DATA ASAP1B_ETK KP_BLOB 0x383BD6 1 2 /end IF_DATA BIT_MASK 0xF00 /end MEASUREMENT
/begin MEASUREMENT TYP_slwg "" UWORD B_TRUE___UW 0 0 0.000000 0.000000 /begin IF_DATA ASAP1B_ETK KP_BLOB 0x383BDA 1 2 /end IF_DATA BIT_MASK 0xF00 /end MEASUREMENT
/begin MEASUREMENT TYP_swe "" UWORD B_TRUE___UW 0 0 0.000000 0.000000 /begin IF_DATA ASAP1B_ETK KP_BLOB 0x383BDE 1 2 /end IF_DATA BIT_MASK 0xF00 /end MEASUREMENT
/begin MEASUREMENT TYP_ta "" UWORD B_TRUE___UW 0 0 0.000000 0.000000 /begin IF_DATA ASAP1B_ETK KP_BLOB 0x383BE0 1 2 /end IF_DATA BIT_MASK 0xF00 /end MEASUREMENT
/begin MEASUREMENT TYP_tes "Fehlertyp: Tankdiagnose, TEV offen" UWORD B_TRUE___UW 0 0 0.000000 0.000000 /begin IF_DATA ASAP1B_ETK KP_BLOB 0x383BE4 1 2 /end IF_DATA BIT_MASK 0xF00 /end MEASUREMENT
/begin MEASUREMENT TYP_tm "" UWORD B_TRUE___UW 0 0 0.000000 0.000000 /begin IF_DATA ASAP1B_ETK KP_BLOB 0x383BEE 1 2 /end IF_DATA BIT_MASK 0xF00 /end MEASUREMENT
/begin MEASUREMENT TYP_TUN "" UWORD B_TRUE___UW 0 0 0.000000 0.000000 /begin IF_DATA ASAP1B_ETK KP_BLOB 0x383BF4 1 2 /end IF_DATA BIT_MASK 0xF00 /end MEASUREMENT
/begin MEASUREMENT TYP_ub "" UWORD B_TRUE___UW 0 0 0.000000 0.000000 /begin IF_DATA ASAP1B_ETK KP_BLOB 0x383BF6 1 2 /end IF_DATA BIT_MASK 0xF00 /end MEASUREMENT
/begin MEASUREMENT TYP_ufmv "Fehlertyp: FunktionsÅberwachung: Momentenvergleich" UWORD B_TRUE___UW 0 0 0.000000 0.000000 /begin IF_DATA ASAP1B_ETK KP_BLOB 0x383BF8 1 2 /end IF_DATA BIT_MASK 0xF00 /end MEASUREMENT
/begin MEASUREMENT TYP_ufska "Fehlertyp: FunktionsÅberwachung: Sicherheits-Kraftstoff-Abschaltung" UWORD B_TRUE___UW 0 0 0.000000 0.000000 /begin IF_DATA ASAP1B_ETK KP_BLOB 0x383BFA 1 2 /end IF_DATA BIT_MASK 0xF00 /end MEASUREMENT
/begin MEASUREMENT TYP_urram "Fehlertyp: RechnerÅberwachung: RAM" UWORD B_TRUE___UW 0 0 0.000000 0.000000 /begin IF_DATA ASAP1B_ETK KP_BLOB 0x383BFC 1 2 /end IF_DATA BIT_MASK 0xF00 /end MEASUREMENT
/begin MEASUREMENT TYP_urrom "Fehlertyp: RechnerÅberwachung: ROM" UWORD B_TRUE___UW 0 0 0.000000 0.000000 /begin IF_DATA ASAP1B_ETK KP_BLOB 0x383BFE 1 2 /end IF_DATA BIT_MASK 0xF00 /end MEASUREMENT
/begin MEASUREMENT TYP_urrst "Fehlertyp: RechnerÅberwachung: Reset" UWORD B_TRUE___UW 0 0 0.000000 0.000000 /begin IF_DATA ASAP1B_ETK KP_BLOB 0x383C00 1 2 /end IF_DATA BIT_MASK 0xF00 /end MEASUREMENT
/begin MEASUREMENT TYP_vfz "" UWORD B_TRUE___UW 0 0 0.000000 0.000000 /begin IF_DATA ASAP1B_ETK KP_BLOB 0x383C04 1 2 /end IF_DATA BIT_MASK 0xF00 /end MEASUREMENT
/begin MEASUREMENT TYP_wfs "" UWORD B_TRUE___UW 0 0 0.000000 0.000000 /begin IF_DATA ASAP1B_ETK KP_BLOB 0x383C06 1 2 /end IF_DATA BIT_MASK 0xF00 /end MEASUREMENT
/begin MEASUREMENT TYP_wfsrc "" UWORD B_TRUE___UW 0 0 0.000000 0.000000 /begin IF_DATA ASAP1B_ETK KP_BLOB 0x383C08 1 2 /end IF_DATA BIT_MASK 0xF00 /end MEASUREMENT
/begin MEASUREMENT udksnoa_w "KS-Diagnose: Aktueller Wert obere Schwelle (UDKSNO)" UWORD spg_uw_b1280 0 0 0.000000 1279.983745 /begin IF_DATA ASAP1B_ETK KP_BLOB 0x3821DC 1 2 /end IF_DATA BIT_MASK 0xFFFF /end MEASUREMENT
/begin MEASUREMENT udksnua_w "KS-Diagnose: Aktueller Wert untere Schwelle (UDKSNU)" UWORD spg_uw_b1280 0 0 0.000000 1279.983745 /begin IF_DATA ASAP1B_ETK KP_BLOB 0x3821DE 1 2 /end IF_DATA BIT_MASK 0xFFFF /end MEASUREMENT
/begin MEASUREMENT uhsv "Spannung an der Heizerendstufe vor Kat" UBYTE spg_ub_b5 0 0 0.000000 4.980469 /begin IF_DATA ASAP1B_ETK KP_BLOB 0x3809B7 1 1 /end IF_DATA BIT_MASK 0xFF /end MEASUREMENT
/begin MEASUREMENT urddktp "Regelspannungsdifferenz, tiefpa·gefiltert" SBYTE spg_sb_q0p01043 0 0 -1.335216 1.324784 /begin IF_DATA ASAP1B_ETK KP_BLOB 0x380A92 1 1 /end IF_DATA BIT_MASK 0xFF /end MEASUREMENT
/begin MEASUREMENT ushdktp "Spannung Lambdsonde hinter KAt, tiefpassgefiltert" UBYTE spg_ub_q0p0052 0 0 0.000000 1.330000 /begin IF_DATA ASAP1B_ETK KP_BLOB 0x380A93 1 1 /end IF_DATA BIT_MASK 0xFF /end MEASUREMENT
/begin MEASUREMENT ushk "Spannung Lambdasonde hinter Katalysator" UBYTE spg_ub_q0p0052_o0p2 0 0 -0.200000 1.130000 /begin IF_DATA ASAP1B_ETK KP_BLOB 0x380A71 1 1 /end IF_DATA BIT_MASK 0xFF /end MEASUREMENT
/begin MEASUREMENT vkr_0_A "VerstÑrkungsstufe fÅr EingangsverstÑrkung Klopf-IC" UBYTE dez 0 0 0.000000 255.000000 /begin IF_DATA ASAP1B_ETK KP_BLOB 0x380BA0 1 1 /end IF_DATA BIT_MASK 0xFF /end MEASUREMENT
/begin MEASUREMENT vkr_1_A "VerstÑrkungsstufe fÅr EingangsverstÑrkung Klopf-IC" UBYTE dez 0 0 0.000000 255.000000 /begin IF_DATA ASAP1B_ETK KP_BLOB 0x380BA1 1 1 /end IF_DATA BIT_MASK 0xFF /end MEASUREMENT
/begin MEASUREMENT vkr_2_A "VerstÑrkungsstufe fÅr EingangsverstÑrkung Klopf-IC" UBYTE dez 0 0 0.000000 255.000000 /begin IF_DATA ASAP1B_ETK KP_BLOB 0x380BA2 1 1 /end IF_DATA BIT_MASK 0xFF /end MEASUREMENT
/begin MEASUREMENT vkr_3_A "VerstÑrkungsstufe fÅr EingangsverstÑrkung Klopf-IC" UBYTE dez 0 0 0.000000 255.000000 /begin IF_DATA ASAP1B_ETK KP_BLOB 0x380BA3 1 1 /end IF_DATA BIT_MASK 0xFF /end MEASUREMENT
/begin MEASUREMENT vkr_4_A "VerstÑrkungsstufe fÅr EingangsverstÑrkung Klopf-IC" UBYTE dez 0 0 0.000000 255.000000 /begin IF_DATA ASAP1B_ETK KP_BLOB 0x380BA4 1 1 /end IF_DATA BIT_MASK 0xFF /end MEASUREMENT
/begin MEASUREMENT vkr_5_A "VerstÑrkungsstufe fÅr EingangsverstÑrkung Klopf-IC" UBYTE dez 0 0 0.000000 255.000000 /begin IF_DATA ASAP1B_ETK KP_BLOB 0x380BA5 1 1 /end IF_DATA BIT_MASK 0xFF /end MEASUREMENT
/begin MEASUREMENT vkr_6_A "VerstÑrkungsstufe fÅr EingangsverstÑrkung Klopf-IC" UBYTE dez 0 0 0.000000 255.000000 /begin IF_DATA ASAP1B_ETK KP_BLOB 0x380BA6 1 1 /end IF_DATA BIT_MASK 0xFF /end MEASUREMENT
/begin MEASUREMENT vkr_7_A "VerstÑrkungsstufe fÅr EingangsverstÑrkung Klopf-IC" UBYTE dez 0 0 0.000000 255.000000 /begin IF_DATA ASAP1B_ETK KP_BLOB 0x380BA7 1 1 /end IF_DATA BIT_MASK 0xFF /end MEASUREMENT
/begin MEASUREMENT wdkba_w "Drosselklappenwinkel bezogen auf unteren Anschlag" SWORD relDK_q0p02441 0 0 -800.000000 799.975586 /begin IF_DATA ASAP1B_ETK KP_BLOB 0xF8F2 0 2 /end IF_DATA BIT_MASK 0xFFFF /end MEASUREMENT
/begin MEASUREMENT xzkrznt "ZÑhler Klopfregelung Zyklusflag Z_krnt" UBYTE dez 0 0 0.000000 255.000000 /begin IF_DATA ASAP1B_ETK KP_BLOB 0x380BE0 1 1 /end IF_DATA BIT_MASK 0xFF /end MEASUREMENT
/begin MEASUREMENT xzkrzof "ZÑhler Klopfregelung Zyklusflag Z_krof" UBYTE dez 0 0 0.000000 255.000000 /begin IF_DATA ASAP1B_ETK KP_BLOB 0x380BE1 1 1 /end IF_DATA BIT_MASK 0xFF /end MEASUREMENT
/begin MEASUREMENT xzkrzs_0_A "" UBYTE dez 0 0 0.000000 255.000000 /begin IF_DATA ASAP1B_ETK KP_BLOB 0x380BE4 1 1 /end IF_DATA BIT_MASK 0xFF /end MEASUREMENT
/begin MEASUREMENT xzkrzs_1_A "" UBYTE dez 0 0 0.000000 255.000000 /begin IF_DATA ASAP1B_ETK KP_BLOB 0x380BE5 1 1 /end IF_DATA BIT_MASK 0xFF /end MEASUREMENT
/begin MEASUREMENT xzkrzs_2_A "" UBYTE dez 0 0 0.000000 255.000000 /begin IF_DATA ASAP1B_ETK KP_BLOB 0x380BE6 1 1 /end IF_DATA BIT_MASK 0xFF /end MEASUREMENT
/begin MEASUREMENT xzkrzs_3_A "" UBYTE dez 0 0 0.000000 255.000000 /begin IF_DATA ASAP1B_ETK KP_BLOB 0x380BE7 1 1 /end IF_DATA BIT_MASK 0xFF /end MEASUREMENT
/begin MEASUREMENT xzkrztp "ZÑhler Klopfregelung Zyklusflag Z_krt" UBYTE dez 0 0 0.000000 255.000000 /begin IF_DATA ASAP1B_ETK KP_BLOB 0x380BEC 1 1 /end IF_DATA BIT_MASK 0xFF /end MEASUREMENT
/begin MEASUREMENT xzsen_0_A "" UBYTE dez 0 0 0.000000 255.000000 /begin IF_DATA ASAP1B_ETK KP_BLOB 0x380BE8 1 1 /end IF_DATA BIT_MASK 0xFF /end MEASUREMENT
/begin MEASUREMENT xzsen_1_A "" UBYTE dez 0 0 0.000000 255.000000 /begin IF_DATA ASAP1B_ETK KP_BLOB 0x380BE9 1 1 /end IF_DATA BIT_MASK 0xFF /end MEASUREMENT
/begin MEASUREMENT xzsen_2_A "" UBYTE dez 0 0 0.000000 255.000000 /begin IF_DATA ASAP1B_ETK KP_BLOB 0x380BEA 1 1 /end IF_DATA BIT_MASK 0xFF /end MEASUREMENT
/begin MEASUREMENT xzsen_3_A "" UBYTE dez 0 0 0.000000 255.000000 /begin IF_DATA ASAP1B_ETK KP_BLOB 0x380BEB 1 1 /end IF_DATA BIT_MASK 0xFF /end MEASUREMENT
/begin MEASUREMENT xzskrnt "SicherheitszÑhler Klopfregelung Nulltest" UBYTE dez 0 0 0.000000 255.000000 /begin IF_DATA ASAP1B_ETK KP_BLOB 0x380BE2 1 1 /end IF_DATA BIT_MASK 0xFF /end MEASUREMENT
/begin MEASUREMENT xzskrof "SicherheitszÑhler Klopfregelung Offset" UBYTE dez 0 0 0.000000 255.000000 /begin IF_DATA ASAP1B_ETK KP_BLOB 0x380BE3 1 1 /end IF_DATA BIT_MASK 0xFF /end MEASUREMENT
/begin MEASUREMENT xzskrtp "ZÑhler Klopfregelung Errorflag E_krtp" UBYTE dez 0 0 0.000000 255.000000 /begin IF_DATA ASAP1B_ETK KP_BLOB 0x380BED 1 1 /end IF_DATA BIT_MASK 0xFF /end MEASUREMENT
/begin MEASUREMENT zzylkr "ZylinderzÑhler fÅr die KR" UBYTE dez 0 0 0.000000 255.000000 /begin IF_DATA ASAP1B_ETK KP_BLOB 0xF9B4 0 1 /end IF_DATA BIT_MASK 0xFF /end MEASUREMENT
/begin MEASUREMENT Z_agrf "Zyklusflag: öberwachung AGR-FLOW" UWORD B_TRUE___UW 0 0 0.000000 0.000000 /begin IF_DATA ASAP1B_ETK KP_BLOB 0x383AF4 1 2 /end IF_DATA BIT_MASK 0x2 /end MEASUREMENT
/begin MEASUREMENT Z_brems "Zyklusflag: BREMS (Bremsschalter)" UWORD B_TRUE___UW 0 0 0.000000 0.000000 /begin IF_DATA ASAP1B_ETK KP_BLOB 0x383AF8 1 2 /end IF_DATA BIT_MASK 0x2 /end MEASUREMENT
/begin MEASUREMENT Z_bwf "Zyklusflag: PWG Bewegung" UWORD B_TRUE___UW 0 0 0.000000 0.000000 /begin IF_DATA ASAP1B_ETK KP_BLOB 0x383AFA 1 2 /end IF_DATA BIT_MASK 0x2 /end MEASUREMENT
/begin MEASUREMENT Z_dpl "Zyklusflag:	Dauerplus" UWORD B_TRUE___UW 0 0 0.000000 0.000000 /begin IF_DATA ASAP1B_ETK KP_BLOB 0x383B10 1 2 /end IF_DATA BIT_MASK 0x2 /end MEASUREMENT
/begin MEASUREMENT Z_dsl "Zyklusflag: Drucksensor Ladedruck" UWORD B_TRUE___UW 0 0 0.000000 0.000000 /begin IF_DATA ASAP1B_ETK KP_BLOB 0x383B12 1 2 /end IF_DATA BIT_MASK 0x2 /end MEASUREMENT
/begin MEASUREMENT Z_dss "Zyklusflag: Saugrohr-Drucksensor" UWORD B_TRUE___UW 0 0 0.000000 0.000000 /begin IF_DATA ASAP1B_ETK KP_BLOB 0x383B14 1 2 /end IF_DATA BIT_MASK 0x2 /end MEASUREMENT
/begin MEASUREMENT Z_dsu "Zyklusflag: Umgebungsdrucksensor" UWORD B_TRUE___UW 0 0 0.000000 0.000000 /begin IF_DATA ASAP1B_ETK KP_BLOB 0x383B16 1 2 /end IF_DATA BIT_MASK 0x2 /end MEASUREMENT
/begin MEASUREMENT Z_dsvlu "Zyklusflag: Drucksensorsignalvergleich (DS-L DS-U)" UWORD B_TRUE___UW 0 0 0.000000 0.000000 /begin IF_DATA ASAP1B_ETK KP_BLOB 0x383B18 1 2 /end IF_DATA BIT_MASK 0x2 /end MEASUREMENT
/begin MEASUREMENT Z_egfe "Zyklusflag: Eingangsgrî·en FÅllungserfassung" UWORD B_TRUE___UW 0 0 0.000000 0.000000 /begin IF_DATA ASAP1B_ETK KP_BLOB 0x383B30 1 2 /end IF_DATA BIT_MASK 0x2 /end MEASUREMENT
/begin MEASUREMENT Z_fp1p "Zyklusflag: Fahrpedal 1. Poti" UWORD B_TRUE___UW 0 0 0.000000 0.000000 /begin IF_DATA ASAP1B_ETK KP_BLOB 0x383B46 1 2 /end IF_DATA BIT_MASK 0x2 /end MEASUREMENT
/begin MEASUREMENT Z_fp2p "Zyklusflag: Fahrpedal 2. Poti" UWORD B_TRUE___UW 0 0 0.000000 0.000000 /begin IF_DATA ASAP1B_ETK KP_BLOB 0x383B48 1 2 /end IF_DATA BIT_MASK 0x2 /end MEASUREMENT
/begin MEASUREMENT Z_fpp "Zyklusflag Fahrpedal-Poti" UWORD B_TRUE___UW 0 0 0.000000 0.000000 /begin IF_DATA ASAP1B_ETK KP_BLOB 0x383B4A 1 2 /end IF_DATA BIT_MASK 0x2 /end MEASUREMENT
/begin MEASUREMENT Z_gecod "Zyklusflag Getriebe-Codierung" UWORD B_TRUE___UW 0 0 0.000000 0.000000 /begin IF_DATA ASAP1B_ETK KP_BLOB 0x383B52 1 2 /end IF_DATA BIT_MASK 0x2 /end MEASUREMENT
/begin MEASUREMENT Z_grbh "Zyklusflag: GRA Bedienhebel" UWORD B_TRUE___UW 0 0 0.000000 0.000000 /begin IF_DATA ASAP1B_ETK KP_BLOB 0x383B54 1 2 /end IF_DATA BIT_MASK 0x2 /end MEASUREMENT
/begin MEASUREMENT Z_ldpe "Zyklusflag: Leckdiagnosepumpe Endstufe" UWORD B_TRUE___UW 0 0 0.000000 0.000000 /begin IF_DATA ASAP1B_ETK KP_BLOB 0x383B96 1 2 /end IF_DATA BIT_MASK 0x2 /end MEASUREMENT
/begin MEASUREMENT Z_md "Zyklusflag: Aussetzer, Summenfehler (multiple)" UWORD B_TRUE___UW 0 0 0.000000 0.000000 /begin IF_DATA ASAP1B_ETK KP_BLOB 0x383BA2 1 2 /end IF_DATA BIT_MASK 0x2 /end MEASUREMENT
/begin MEASUREMENT Z_md01 "Zyklusflag: Aussetzer ZÅndung 1" UWORD B_TRUE___UW 0 0 0.000000 0.000000 /begin IF_DATA ASAP1B_ETK KP_BLOB 0x383BA4 1 2 /end IF_DATA BIT_MASK 0x2 /end MEASUREMENT
/begin MEASUREMENT Z_md02 "Zyklusflag: Aussetzer ZÅndung 2" UWORD B_TRUE___UW 0 0 0.000000 0.000000 /begin IF_DATA ASAP1B_ETK KP_BLOB 0x383BA6 1 2 /end IF_DATA BIT_MASK 0x2 /end MEASUREMENT
/begin MEASUREMENT Z_md03 "Zyklusflag: Aussetzer ZÅndung 3" UWORD B_TRUE___UW 0 0 0.000000 0.000000 /begin IF_DATA ASAP1B_ETK KP_BLOB 0x383BA8 1 2 /end IF_DATA BIT_MASK 0x2 /end MEASUREMENT
/begin MEASUREMENT Z_md04 "Zyklusflag: Aussetzer ZÅndung 4" UWORD B_TRUE___UW 0 0 0.000000 0.000000 /begin IF_DATA ASAP1B_ETK KP_BLOB 0x383BAA 1 2 /end IF_DATA BIT_MASK 0x2 /end MEASUREMENT
/begin MEASUREMENT Z_mdb "Zyklusflag: Momentenbegrenzung begrenzt dauerhaft" UWORD B_TRUE___UW 0 0 0.000000 0.000000 /begin IF_DATA ASAP1B_ETK KP_BLOB 0x383BAC 1 2 /end IF_DATA BIT_MASK 0x2 /end MEASUREMENT
/begin MEASUREMENT Z_mdk "Zyklusflag: Aussetzer, Summenfehler - multiple, > 4500 U/min" UWORD B_TRUE___UW 0 0 0.000000 0.000000 /begin IF_DATA ASAP1B_ETK KP_BLOB 0x383BAE 1 2 /end IF_DATA BIT_MASK 0x2 /end MEASUREMENT
/begin MEASUREMENT Z_mdk01 "Zyklusflag: Aussetzer, ZÅndung 1, > 4500 U/min" UWORD B_TRUE___UW 0 0 0.000000 0.000000 /begin IF_DATA ASAP1B_ETK KP_BLOB 0x383BB0 1 2 /end IF_DATA BIT_MASK 0x2 /end MEASUREMENT
/begin MEASUREMENT Z_mdk02 "Zyklusflag: Aussetzer, ZÅndung 2, > 4500 U/min" UWORD B_TRUE___UW 0 0 0.000000 0.000000 /begin IF_DATA ASAP1B_ETK KP_BLOB 0x383BB2 1 2 /end IF_DATA BIT_MASK 0x2 /end MEASUREMENT
/begin MEASUREMENT Z_mdk03 "Zyklusflag: Aussetzer, ZÅndung 3, > 4500 U/min" UWORD B_TRUE___UW 0 0 0.000000 0.000000 /begin IF_DATA ASAP1B_ETK KP_BLOB 0x383BB4 1 2 /end IF_DATA BIT_MASK 0x2 /end MEASUREMENT
/begin MEASUREMENT Z_mdk04 "Zyklusflag: Aussetzer, ZÅndung 4, > 4500 U/min" UWORD B_TRUE___UW 0 0 0.000000 0.000000 /begin IF_DATA ASAP1B_ETK KP_BLOB 0x383BB6 1 2 /end IF_DATA BIT_MASK 0x2 /end MEASUREMENT
/begin MEASUREMENT Z_nwkw "Zykluslag: Zuordnung Nockenwelle zu Kurbelwelle" UWORD B_TRUE___UW 0 0 0.000000 0.000000 /begin IF_DATA ASAP1B_ETK KP_BLOB 0x383BBC 1 2 /end IF_DATA BIT_MASK 0x2 /end MEASUREMENT
/begin MEASUREMENT Z_nwkw2 "Zykluslag: Zuordnung Nockenwelle 2 zu Kurbelwelle" UWORD B_TRUE___UW 0 0 0.000000 0.000000 /begin IF_DATA ASAP1B_ETK KP_BLOB 0x383BBE 1 2 /end IF_DATA BIT_MASK 0x2 /end MEASUREMENT
/begin MEASUREMENT Z_nws "Zyklusflag: Nockenwellensteuerung" UWORD B_TRUE___UW 0 0 0.000000 0.000000 /begin IF_DATA ASAP1B_ETK KP_BLOB 0x383BC0 1 2 /end IF_DATA BIT_MASK 0x2 /end MEASUREMENT
/begin MEASUREMENT Z_nws2 "Zyklusflag: Nockenwellensteuerung (Bank 2)" UWORD B_TRUE___UW 0 0 0.000000 0.000000 /begin IF_DATA ASAP1B_ETK KP_BLOB 0x383BC2 1 2 /end IF_DATA BIT_MASK 0x2 /end MEASUREMENT
/begin MEASUREMENT Z_nx "Zyklusflag: NMAX - öberschreitung" UWORD B_TRUE___UW 0 0 0.000000 0.000000 /begin IF_DATA ASAP1B_ETK KP_BLOB 0x383BC6 1 2 /end IF_DATA BIT_MASK 0x2 /end MEASUREMENT
/begin MEASUREMENT Z_ph "Zyklusflag: Phasensensor" UWORD B_TRUE___UW 0 0 0.000000 0.000000 /begin IF_DATA ASAP1B_ETK KP_BLOB 0x383BC8 1 2 /end IF_DATA BIT_MASK 0x2 /end MEASUREMENT
/begin MEASUREMENT Z_pwm "Zyklusflag: PWM-Signal" UWORD B_TRUE___UW 0 0 0.000000 0.000000 /begin IF_DATA ASAP1B_ETK KP_BLOB 0x383BCA 1 2 /end IF_DATA BIT_MASK 0x2 /end MEASUREMENT
/begin MEASUREMENT Z_sgeew "Zyklusflag: SteuergerÑt defekt (EEPROM-WFS)" UWORD B_TRUE___UW 0 0 0.000000 0.000000 /begin IF_DATA ASAP1B_ETK KP_BLOB 0x383BD0 1 2 /end IF_DATA BIT_MASK 0x2 /end MEASUREMENT
/begin MEASUREMENT Z_sls "Zyklusflag: SekundÑrluft-System" UWORD B_TRUE___UW 0 0 0.000000 0.000000 /begin IF_DATA ASAP1B_ETK KP_BLOB 0x383BD4 1 2 /end IF_DATA BIT_MASK 0x2 /end MEASUREMENT
/begin MEASUREMENT Z_slv "Zyklusflag: SekundÑrluftventil" UWORD B_TRUE___UW 0 0 0.000000 0.000000 /begin IF_DATA ASAP1B_ETK KP_BLOB 0x383BD6 1 2 /end IF_DATA BIT_MASK 0x2 /end MEASUREMENT
/begin MEASUREMENT Z_slwg "Zyklusflag: Waste- Gate- Ansteuerung" UWORD B_TRUE___UW 0 0 0.000000 0.000000 /begin IF_DATA ASAP1B_ETK KP_BLOB 0x383BDA 1 2 /end IF_DATA BIT_MASK 0x2 /end MEASUREMENT
/begin MEASUREMENT Z_swe "Zyklusflag:	Beschleunigungssensor der Schlechtwegeerkennung" UWORD B_TRUE___UW 0 0 0.000000 0.000000 /begin IF_DATA ASAP1B_ETK KP_BLOB 0x383BDE 1 2 /end IF_DATA BIT_MASK 0x2 /end MEASUREMENT
/begin MEASUREMENT Z_ta "Zyklusflag:	TANS" UWORD B_TRUE___UW 0 0 0.000000 0.000000 /begin IF_DATA ASAP1B_ETK KP_BLOB 0x383BE0 1 2 /end IF_DATA BIT_MASK 0x2 /end MEASUREMENT
/begin MEASUREMENT Z_tankl "Zyklusflag: OBDII Fehler auf Grund eines leeren Tanks" UWORD B_TRUE___UW 0 0 0.000000 0.000000 /begin IF_DATA ASAP1B_ETK KP_BLOB 0x383BE2 1 2 /end IF_DATA BIT_MASK 0x2 /end MEASUREMENT
/begin MEASUREMENT Z_tes "Zyklusflag: TankentlÅftungssystem" UWORD B_TRUE___UW 0 0 0.000000 0.000000 /begin IF_DATA ASAP1B_ETK KP_BLOB 0x383BE4 1 2 /end IF_DATA BIT_MASK 0x2 /end MEASUREMENT
/begin MEASUREMENT Z_teve2 "Zyklusflag: TankentlÅftungsventil Endstufe 2" UWORD B_TRUE___UW 0 0 0.000000 0.000000 /begin IF_DATA ASAP1B_ETK KP_BLOB 0x383BEC 1 2 /end IF_DATA BIT_MASK 0x2 /end MEASUREMENT
/begin MEASUREMENT Z_tm "Zyklusflag:	TMOT" UWORD B_TRUE___UW 0 0 0.000000 0.000000 /begin IF_DATA ASAP1B_ETK KP_BLOB 0x383BEE 1 2 /end IF_DATA BIT_MASK 0x2 /end MEASUREMENT
/begin MEASUREMENT Z_tol "Zyklusflag:	ôltemperatur" UWORD B_TRUE___UW 0 0 0.000000 0.000000 /begin IF_DATA ASAP1B_ETK KP_BLOB 0x383BF0 1 2 /end IF_DATA BIT_MASK 0x2 /end MEASUREMENT
/begin MEASUREMENT Z_tum "Zyklusflag: Umgebungstemperatur TUM" UWORD B_TRUE___UW 0 0 0.000000 0.000000 /begin IF_DATA ASAP1B_ETK KP_BLOB 0x383BF2 1 2 /end IF_DATA BIT_MASK 0x2 /end MEASUREMENT
/begin MEASUREMENT Z_tun "Zyklusflag: Tuningschutz" UWORD B_TRUE___UW 0 0 0.000000 0.000000 /begin IF_DATA ASAP1B_ETK KP_BLOB 0x383BF4 1 2 /end IF_DATA BIT_MASK 0x2 /end MEASUREMENT
/begin MEASUREMENT Z_ub "Zyklusflag:	UB" UWORD B_TRUE___UW 0 0 0.000000 0.000000 /begin IF_DATA ASAP1B_ETK KP_BLOB 0x383BF6 1 2 /end IF_DATA BIT_MASK 0x2 /end MEASUREMENT
/begin MEASUREMENT Z_ufmv "Zyklusflag: FunktionsÅberwachung: Momentenvergleich" UWORD B_TRUE___UW 0 0 0.000000 0.000000 /begin IF_DATA ASAP1B_ETK KP_BLOB 0x383BF8 1 2 /end IF_DATA BIT_MASK 0x2 /end MEASUREMENT
/begin MEASUREMENT Z_ufska "Zyklusflag: FunktionsÅberwachung: Sicherheits-Kraftstoff-Abschaltung" UWORD B_TRUE___UW 0 0 0.000000 0.000000 /begin IF_DATA ASAP1B_ETK KP_BLOB 0x383BFA 1 2 /end IF_DATA BIT_MASK 0x2 /end MEASUREMENT
/begin MEASUREMENT Z_urram "Zyklusflag: RechnerÅberwachung: RAM" UWORD B_TRUE___UW 0 0 0.000000 0.000000 /begin IF_DATA ASAP1B_ETK KP_BLOB 0x383BFC 1 2 /end IF_DATA BIT_MASK 0x2 /end MEASUREMENT
/begin MEASUREMENT Z_urrom "Zyklusflag: RechnerÅberwachung: ROM" UWORD B_TRUE___UW 0 0 0.000000 0.000000 /begin IF_DATA ASAP1B_ETK KP_BLOB 0x383BFE 1 2 /end IF_DATA BIT_MASK 0x2 /end MEASUREMENT
/begin MEASUREMENT Z_urrst "Zyklusflag: RechnerÅberwachung: Reset" UWORD B_TRUE___UW 0 0 0.000000 0.000000 /begin IF_DATA ASAP1B_ETK KP_BLOB 0x383C00 1 2 /end IF_DATA BIT_MASK 0x2 /end MEASUREMENT
/begin MEASUREMENT Z_vfz "Zyklusflag: Fahrzeug-Geschwindigkeit" UWORD B_TRUE___UW 0 0 0.000000 0.000000 /begin IF_DATA ASAP1B_ETK KP_BLOB 0x383C04 1 2 /end IF_DATA BIT_MASK 0x2 /end MEASUREMENT
/begin MEASUREMENT Z_wfs "Zyklusflag: Wegfahrsperre" UWORD B_TRUE___UW 0 0 0.000000 0.000000 /begin IF_DATA ASAP1B_ETK KP_BLOB 0x383C06 1 2 /end IF_DATA BIT_MASK 0x2 /end MEASUREMENT
/begin MEASUREMENT Z_wfsrc "" UWORD B_TRUE___UW 0 0 0.000000 0.000000 /begin IF_DATA ASAP1B_ETK KP_BLOB 0x383C08 1 2 /end IF_DATA BIT_MASK 0x2 /end MEASUREMENT
/begin FUNCTION DFPM_DMDMIL ""
 /begin REF_CHARACTERISTIC TSFMDK04 TSFMDK03 TSFMDK02 TSFMDK01 TSFMDK TSFMD04 TSFMD03 TSFMD02 TSFMD01 TSFMD FFTMDK04 FFTMDK03 FFTMDK02 FFTMDK01 FFTMDK FFTMD04 FFTMD03 FFTMD02 FFTMD01 FFTMD CLAMDK04 CLAMDK03 CLAMDK02 CLAMDK01 CLAMDK CLAMD04 CLAMD03 CLAMD02 CLAMD01 CLAMD CDTMDK04 CDTMDK03 CDTMDK02 CDTMDK01 CDTMDK CDTMD04 CDTMD03 CDTMD02 CDTMD01 CDTMD CDKMDK04 CDKMDK03 CDKMDK02 CDKMDK01 CDKMDK CDKMD04 CDKMD03 CDKMD02 CDKMD01 CDKMD CDCMDK04 CDCMDK03 CDCMDK02 CDCMDK01 CDCMDK CDCMD04 CDCMD03 CDCMD02 CDCMD01 CDCMD /end REF_CHARACTERISTIC
 /begin LOC_MEASUREMENT Z_mdk04 Z_mdk03 Z_mdk02 Z_mdk01 Z_mdk Z_md04 Z_md03 Z_md02 Z_md01 Z_md TYP_mdk04 TYP_mdk03 TYP_mdk02 TYP_mdk01 TYP_mdk TYP_md04 TYP_md03 TYP_md02 TYP_md01 TYP_md sfpmdk04 sfpmdk03 sfpmdk02 sfpmdk01 sfpmdk sfpmd04 sfpmd03 sfpmd02 sfpmd01 sfpmd E_mdk04 E_mdk03 E_mdk02 E_mdk01 E_mdk E_md04 E_md03 E_md02 E_md01 E_md B_simdk04 B_simdk03 B_simdk02 B_simdk01 B_simdk B_simd04 B_simd03 B_simd02 B_simd01 B_simd B_npmdk04 B_npmdk03 B_npmdk02 B_npmdk01 B_npmdk B_npmd04 B_npmd03 B_npmd02 B_npmd01 B_npmd B_mxmdk04 B_mxmdk03 B_mxmdk02 B_mxmdk01 B_mxmdk B_mxmd04 B_mxmd03 B_mxmd02 B_mxmd01 B_mxmd B_mnmdk04 B_mnmdk03 B_mnmdk02 B_mnmdk01 B_mnmdk B_mnmd04 B_mnmd03 B_mnmd02 B_mnmd01 B_mnmd B_ftmdk04 B_ftmdk03 B_ftmdk02 B_ftmdk01 B_ftmdk B_ftmd04 B_ftmd03 B_ftmd02 B_ftmd01 B_ftmd B_clmdk04 B_clmdk03 B_clmdk02 B_clmdk01 B_clmdk B_clmd04 B_clmd03 B_clmd02 B_clmd01 B_clmd B_bkmdk04 B_bkmdk03 B_bkmdk02 B_bkmdk01 B_bkmdk B_bkmd04 B_bkmd03 B_bkmd02 B_bkmd01 B_bkmd B_bemdk04 B_bemdk03 B_bemdk02 B_bemdk01 B_bemdk B_bemd04 B_bemd03 B_bemd02 B_bemd01 B_bemd /end LOC_MEASUREMENT
/end FUNCTION
/begin FUNCTION DFPM_DNMAX "" /begin REF_CHARACTERISTIC TSFNX FFTNX CLANX CDTNX CDKNX CDCNX /end REF_CHARACTERISTIC
 /begin LOC_MEASUREMENT Z_nx TYP_nx sfpnx E_nx B_sinx B_npnx B_mxnx B_mnnx B_ftnx B_clnx B_bknx B_benx /end LOC_MEASUREMENT
/end FUNCTION
/begin FUNCTION DFPM_DNWKW ""
 /begin REF_CHARACTERISTIC TSFNWKW2 TSFNWKW FFTNWKW2 FFTNWKW CLANWKW2 CLANWKW CDTNWKW2 CDTNWKW CDKNWKW2 CDKNWKW CDCNWKW2 CDCNWKW /end REF_CHARACTERISTIC
 /begin LOC_MEASUREMENT Z_nwkw2 Z_nwkw TYP_nwkw2 TYP_nwkw sfpnwkw2 sfpnwkw E_nwkw2 E_nwkw B_sinwkw2 B_sinwkw B_npnwkw2 B_npnwkw B_mxnwkw2 B_mxnwkw B_mnnwkw2 B_mnnwkw B_ftnwkw2 B_ftnwkw B_clnwkw2 B_clnwkw B_bknwkw2 B_bknwkw B_benwkw2 B_benwkw /end LOC_MEASUREMENT
/end FUNCTION
/begin FUNCTION DFPM_DNWS ""
 /begin REF_CHARACTERISTIC TSFNWS2 TSFNWS FFTNWS2 FFTNWS CLANWS2 CLANWS CDTNWS2 CDTNWS CDKNWS2 CDKNWS CDCNWS2 CDCNWS /end REF_CHARACTERISTIC
 /begin LOC_MEASUREMENT Z_nws2 Z_nws TYP_nws2 TYP_nws sfpnws2 sfpnws E_nws2 E_nws B_sinws2 B_sinws B_npnws2 B_npnws B_mxnws2 B_mxnws B_mnnws2 B_mnnws B_ftnws2 B_ftnws B_clnws2 B_clnws B_bknws2 B_bknws B_benws2 B_benws /end LOC_MEASUREMENT
/end FUNCTION
/begin FUNCTION DFPM_DPH "" /begin REF_CHARACTERISTIC TSFPH FFTPH CLAPH CDTPH CDKPH CDCPH /end REF_CHARACTERISTIC
 /begin LOC_MEASUREMENT Z_ph TYP_ph sfpph E_ph B_siph B_npph B_mxph B_mnph B_ftph B_clph B_bkph B_beph /end LOC_MEASUREMENT
/end FUNCTION
/begin FUNCTION DFPM_DPL "" /begin REF_CHARACTERISTIC TSFDPL FFTDPL CLADPL CDTDPL CDKDPL CDCDPL /end REF_CHARACTERISTIC
 /begin LOC_MEASUREMENT Z_dpl TYP_dpl sfpdpl E_dpl B_siddpl B_npddpl B_mxdpl B_mndpl B_ftdpl B_cldpl B_bkdpl B_bedpl /end LOC_MEASUREMENT
/end FUNCTION
/begin FUNCTION DFPM_DSLSLR ""
 /begin REF_CHARACTERISTIC TSFSLV TSFSLS FFTSLV FFTSLS CLASLV CLASLS CDTSLV CDTSLS CDKSLV CDKSLS CDCSLV CDCSLS /end REF_CHARACTERISTIC
 /begin LOC_MEASUREMENT Z_slv Z_sls TYP_slv TYP_sls sfpslv sfpsls E_slv E_sls B_sislv B_sisls B_npslv B_npsls B_mxslv B_mxsls B_mnslv B_mnsls B_ftslv B_ftsls B_clslv B_clsls B_bkslv B_bksls B_beslv B_besls /end LOC_MEASUREMENT
/end FUNCTION
/begin FUNCTION DFPM_DSWEA ""
 /begin REF_CHARACTERISTIC TSFSWE TSFPWM FFTSWE FFTPWM CLASWE CLAPWM CDTSWE CDTPWM CDKSWE CDKPWM CDCSWE CDCPWM /end REF_CHARACTERISTIC
 /begin LOC_MEASUREMENT Z_swe Z_pwm TYP_swe TYP_pwm sfpswe sfppwm E_swe E_pwm B_siswe B_sipwm B_npswe B_nppwm B_mxswe B_mxpwm B_mnswe B_mnpwm B_ftswe B_ftpwm B_clswe B_clpwm B_bkswe B_bkpwm B_beswe B_bepwm /end LOC_MEASUREMENT
/end FUNCTION
/begin FUNCTION DFPM_DTEV "" /begin REF_CHARACTERISTIC TSFTES FFTTES CLATES CDTTES CDKTES CDCTES /end REF_CHARACTERISTIC
 /begin LOC_MEASUREMENT Z_tes TYP_tes sfptes E_tes B_sites B_sctes B_pytes B_nptes B_mxtes B_mntes B_fttes B_cltes B_bktes B_betes B_avtes /end LOC_MEASUREMENT
/end FUNCTION
/begin FUNCTION DFPM_DUF ""
 /begin REF_CHARACTERISTIC TSFUFSKA TSFUFMV FFTUFSKA FFTUFMV CLAUFSKA CLAUFMV CDTUFSKA CDTUFMV CDKUFSKA CDKUFMV CDCUFSKA CDCUFMV /end REF_CHARACTERISTIC
 /begin LOC_MEASUREMENT Z_ufska Z_ufmv TYP_ufska TYP_ufmv sfpufska sfpufmv E_ufska E_ufmv B_siufska B_siufmv B_npufska B_npufmv B_mxufska B_mxufmv B_mnufska B_mnufmv B_ftufska B_ftufmv B_clufska B_clufmv B_bkufska B_bkufmv B_beufska B_beufmv /end LOC_MEASUREMENT
/end FUNCTION
/begin FUNCTION DFPM_DUMMY_D ""
 /begin REF_CHARACTERISTIC TSFTOL TSFTEVE2 TSFTANKL TSFDSS TSFAGRF FFTTOL FFTTEVE2 FFTTANKL FFTDSS FFTAGRF CLATOL CLATEVE2 CLATANKL CLADSS CLAAGRF CDTTOL CDTTEVE2 CDTTANKL CDTDSS CDTAGRF CDKTOL CDKTEVE2 CDKTANKL CDKDSS CDKAGRF CDCTOL CDCTEVE2 CDCTANKL CDCDSS CDCAGRF /end REF_CHARACTERISTIC
 /begin LOC_MEASUREMENT Z_tol Z_teve2 Z_tankl Z_dss Z_agrf sfptol sfpteve2 sfptankl sfpdss sfpagrf E_tol E_teve2 E_tankl E_dss E_agrf /end LOC_MEASUREMENT
/end FUNCTION
/begin FUNCTION DFPM_DUR ""
 /begin REF_CHARACTERISTIC TSFURRST TSFURROM TSFURRAM FFTURRST FFTURROM FFTURRAM CLAURRST CLAURROM CLAURRAM CDTURRST CDTURROM CDTURRAM CDKURRST CDKURROM CDKURRAM CDCURRST CDCURROM CDCURRAM /end REF_CHARACTERISTIC
 /begin LOC_MEASUREMENT Z_urrst Z_urrom Z_urram TYP_urrst TYP_urrom TYP_urram sfpurrst sfpurrom sfpurram E_urrst E_urrom E_urram B_siurrst B_siurrom B_siurram B_npurrst B_npurrom B_npurram B_mxurrst B_mxurrom B_mxurram B_mnurrst B_mnurrom B_mnurram B_fturrst B_fturrom B_fturram B_clurrst B_clurrom B_clurram B_bkurrst B_bkurrom B_bkurram B_beurrst B_beurrom B_beurram /end LOC_MEASUREMENT
/end FUNCTION
/begin FUNCTION DFPM_DVFZ "" /begin REF_CHARACTERISTIC TSFVFZ FFTVFZ CLAVFZ CDTVFZ CDKVFZ CDCVFZ /end REF_CHARACTERISTIC
 /begin LOC_MEASUREMENT Z_vfz TYP_vfz sfpvfz E_vfz B_sivfz B_npvfz B_mxvfz B_mnvfz B_ftvfz B_clvfz B_bkvfz B_bevfz /end LOC_MEASUREMENT
/end FUNCTION
/begin FUNCTION DFPM_DWGASLV "" /begin REF_CHARACTERISTIC TSFSLWG FFTSLWG CLASLWG CDTSLWG CDKSLWG CDCSLWG /end REF_CHARACTERISTIC
 /begin LOC_MEASUREMENT Z_slwg TYP_slwg sfpslwg E_slwg B_sislwg B_npslwg B_mxslwg B_mnslwg B_ftslwg B_clslwg B_bkslwg B_beslwg /end LOC_MEASUREMENT
/end FUNCTION
/begin FUNCTION DFPM_EGFE "" /begin REF_CHARACTERISTIC TSFEGFE FFTEGFE CLAEGFE CDTEGFE CDKEGFE CDCEGFE /end REF_CHARACTERISTIC
 /begin LOC_MEASUREMENT Z_egfe TYP_egfe sfpegfe E_egfe B_siegfe B_npegfe B_mxegfe B_mnegfe B_ftegfe B_clegfe B_bkegfe B_beegfe /end LOC_MEASUREMENT
/end FUNCTION
/begin FUNCTION DFPM_GECOD "" /begin REF_CHARACTERISTIC TSFGECOD FFTGECOD CLAGECOD CDTGECOD CDKGECOD CDCGECOD /end REF_CHARACTERISTIC
 /begin LOC_MEASUREMENT Z_gecod TYP_gecod sfpgecod E_gecod B_sigecod B_scgecod B_pygecod B_npgecod B_mxgecod B_mngecod B_ftgecod B_clgecod B_bkgecod B_begecod B_avgecod /end LOC_MEASUREMENT
/end FUNCTION
/begin FUNCTION DFPM_GGDSAS ""
 /begin REF_CHARACTERISTIC TSFDSVLU TSFDSU TSFDSL FFTDSVLU FFTDSU FFTDSL CLADSVLU CLADSU CLADSL CDTDSVLU CDTDSU CDTDSL CDKDSVLU CDKDSU CDKDSL CDCDSVLU CDCDSU CDCDSL /end REF_CHARACTERISTIC
 /begin LOC_MEASUREMENT Z_dsvlu Z_dsu Z_dsl TYP_dsvlu TYP_dsu TYP_dsl sfpdsvlu sfpdsu sfpdsl E_dsvlu E_dsu E_dsl B_sidsvlu B_sidsu B_sidsl B_npdsvlu B_npdsu B_npdsl B_mxdsvlu B_mxdsu B_mxdsl B_mndsvlu B_mndsu B_mndsl B_ftdsvlu B_ftdsu B_ftdsl B_cldsvlu B_cldsu B_cldsl B_bkdsvlu B_bkdsu B_bkdsl B_bedsvlu B_bedsu B_bedsl /end LOC_MEASUREMENT
/end FUNCTION
/begin FUNCTION DFPM_GGEGAS "" /begin REF_CHARACTERISTIC TSFBREMS FFTBREMS CLABREMS CDTBREMS CDKBREMS CDCBREMS /end REF_CHARACTERISTIC
 /begin LOC_MEASUREMENT Z_brems TYP_brems sfpbrems E_brems B_sibrems B_npbrems B_mxbrems B_mnbrems B_ftbrems B_clbrems B_bkbrems B_bebrems /end LOC_MEASUREMENT
/end FUNCTION
/begin FUNCTION DFPM_GGFGRH "" /begin REF_CHARACTERISTIC TSFGRBH FFTGRBH CLAGRBH CDTGRBH CDKGRBH CDCGRBH /end REF_CHARACTERISTIC
 /begin LOC_MEASUREMENT Z_grbh TYP_grbh sfpgrbh E_grbh B_sigrbh B_npgrbh B_mxgrbh B_mngrbh B_ftgrbh B_clgrbh B_bkgrbh B_begrbh /end LOC_MEASUREMENT
/end FUNCTION
/begin FUNCTION DFPM_GGPED ""
 /begin REF_CHARACTERISTIC TSFFPP TSFFP2P TSFFP1P TSFBWF FFTFPP FFTFP2P FFTFP1P FFTBWF CLAFPP CLAFP2P CLAFP1P CLABWF CDTFPP CDTFP2P CDTFP1P CDTBWF CDKFPP CDKFP2P CDKFP1P CDKBWF CDCFPP CDCFP2P CDCFP1P CDCBWF /end REF_CHARACTERISTIC
 /begin LOC_MEASUREMENT Z_fpp Z_fp2p Z_fp1p Z_bwf TYP_fpp TYP_fp2p TYP_fp1p TYP_bwf sfpfpp sfpfp2p sfpfp1p sfpbwf E_fpp E_fp2p E_fp1p E_bwf B_sifpp B_sifp2p B_sifp1p B_sibwf B_npfpp B_npfp2p B_npfp1p B_npbwf B_mxfpp B_mxfp2p B_mxfp1p B_mxbwf B_mnfpp B_mnfp2p B_mnfp1p B_mnbwf B_ftfpp B_ftfp2p B_ftfp1p B_ftbwf B_clfpp B_clfp2p B_clfp1p B_clbwf B_bkfpp B_bkfp2p B_bkfp1p B_bkbwf B_befpp B_befp2p B_befp1p B_bebwf /end LOC_MEASUREMENT
/end FUNCTION
/begin FUNCTION DFPM_GGTFA "" /begin REF_CHARACTERISTIC TSFTA FFTTA CLATA CDTTA CDKTA CDCTA /end REF_CHARACTERISTIC
 /begin LOC_MEASUREMENT Z_ta TYP_ta sfpta E_ta B_sita B_npta B_mxta B_mnta B_ftta B_clta B_bkta B_beta /end LOC_MEASUREMENT
/end FUNCTION
/begin FUNCTION DFPM_GGTFM "" /begin REF_CHARACTERISTIC TSFTM FFTTM CLATM CDTTM CDKTM CDCTM /end REF_CHARACTERISTIC
 /begin LOC_MEASUREMENT Z_tm TYP_tm sfptm E_tm B_sitm B_nptm B_mxtm B_mntm B_fttm B_cltm B_bktm B_betm /end LOC_MEASUREMENT
/end FUNCTION
/begin FUNCTION DFPM_GGUB "" /begin REF_CHARACTERISTIC TSFUB FFTUB CLAUB CDTUB CDKUB CDCUB /end REF_CHARACTERISTIC
 /begin LOC_MEASUREMENT Z_ub TYP_ub sfpub E_ub B_siub B_npub B_mxub B_mnub B_ftub B_club B_bkub B_beub /end LOC_MEASUREMENT
/end FUNCTION
/begin FUNCTION DFPM_IMS ""
 /begin REF_CHARACTERISTIC TSFWFSRC TSFWFS TSFSGEEW FFTWFSRC FFTWFS FFTSGEEW CLAWFSRC CLAWFS CLASGEEW CDTWFSRC CDTWFS CDTSGEEW CDKWFSRC CDKWFS CDKSGEEW CDCWFSRC CDCWFS CDCSGEEW /end REF_CHARACTERISTIC
 /begin LOC_MEASUREMENT Z_wfsrc Z_wfs Z_sgeew TYP_wfsrc TYP_wfs TYP_sgeew sfpwfsrc sfpwfs sfpsgeew E_wfsrc E_wfs E_sgeew B_siwfsrc B_siwfs B_sisgeew B_npwfsrc B_npwfs B_npsgeew B_mxwfsrc B_mxwfs B_mxsgeew B_mnwfsrc B_mnwfs B_mnsgeew B_ftwfsrc B_ftwfs B_ftsgeew B_clwfsrc B_clwfs B_clsgeew B_bkwfsrc B_bkwfs B_bksgeew B_bewfsrc B_bewfs B_besgeew /end LOC_MEASUREMENT
/end FUNCTION
/begin FUNCTION DFPM_LDPE "" /begin REF_CHARACTERISTIC TSFLDPE FFTLDPE CLALDPE CDTLDPE CDKLDPE CDCLDPE /end REF_CHARACTERISTIC
 /begin LOC_MEASUREMENT Z_ldpe TYP_ldpe sfpldpe E_ldpe B_sildpe B_npldpe B_mxldpe B_mnldpe B_ftldpe B_clldpe B_bkldpe B_beldpe /end LOC_MEASUREMENT
/end FUNCTION
/begin FUNCTION DFPM_MDKOG "" /begin REF_CHARACTERISTIC TSFMDB FFTMDB CLAMDB CDTMDB CDKMDB CDCMDB /end REF_CHARACTERISTIC
 /begin LOC_MEASUREMENT Z_mdb TYP_mdb sfpmdb E_mdb B_simdb B_npmdb B_mxmdb B_mnmdb B_ftmdb B_clmdb B_bkmdb B_bemdb /end LOC_MEASUREMENT
/end FUNCTION
/begin FUNCTION DFPM_TUM "" /begin REF_CHARACTERISTIC TSFTUM FFTTUM CLATUM CDTTUM CDKTUM CDCTUM /end REF_CHARACTERISTIC /begin LOC_MEASUREMENT Z_tum sfptum E_tum /end LOC_MEASUREMENT /end FUNCTION
/begin FUNCTION DFPM_TUNING "" /begin REF_CHARACTERISTIC TSFTUN FFTTUN CLATUN CDTTUN CDKTUN CDCTUN /end REF_CHARACTERISTIC
 /begin LOC_MEASUREMENT Z_tun TYP_TUN sfptun E_tun B_situn B_nptun B_mxtun B_mntun B_fttun B_cltun B_bktun B_betun /end LOC_MEASUREMENT
/end FUNCTION
/begin FUNCTION DFRZ "20.20     OBDII; Beschreibung 'freeze frame'" /end FUNCTION
/begin FUNCTION DHFM "63.30     Diagnose; PlausibilitÑtsprÅfung HFM"
 /begin REF_CHARACTERISTIC ZMLRO UBHFM TDUBHFM TDMLST TDMLNF TDMLMX TDMLMN TDMLHFM SNM08FEUW SDK08FEUW MLOFS KFMLDMX KFMLDMN /end REF_CHARACTERISTIC
 /begin LOC_MEASUREMENT wdkba_w wdkbad_w ub nmot_w mlhfmm_w mlhfmf_w mldmx_w mldmn_w esst_snm08feuw esst_sdk08feuw B_stend B_hfm B_ehfs /end LOC_MEASUREMENT
/end FUNCTION
/begin FUNCTION DHLSHK "4.40      Diagnose Sondenheizung hinter Kat"
 /begin REF_CHARACTERISTIC ZKPRIH ZKARIH UBDLSMX UBDLS TVRIF TADHMX TADHMN KFRINH FRINH1 /end REF_CHARACTERISTIC
 /begin LOC_MEASUREMENT ub tkatmf tkatm rinsh_w rinkfh rinh_w phlsnhf phlsnh cd_bits1_w B_stend B_rinh B_nmot B_hsokh B_ehsh B_cdhsh B_atmtpk /end LOC_MEASUREMENT
/end FUNCTION
/begin FUNCTION DHLSHKE "1.10      Diagnose Endstufe Sondenheizung hinter Kat" /begin LOC_MEASUREMENT cd_bits2_w B_hshe B_desee B_cdhshe /end LOC_MEASUREMENT /end FUNCTION
/begin FUNCTION DHLSVK "2.60      Diagnose Sondenheizung vor Kat"
 /begin REF_CHARACTERISTIC ZKPRIV ZKARIV UHEMX UHEMN UBDLSMX UBDLS TVRIF TVHSEE TDFHS TADHMX TADHMN KFRINV FRINV1 /end REF_CHARACTERISTIC
 /begin LOC_MEASUREMENT uhsv ub tabgmf tabgm rinv_w rinsv_w rinkfv phlsnvf phlsnv cd_bits1_w B_stend B_rinv B_pwf B_nachl B_hsve B_cdhsv B_atmtpa /end LOC_MEASUREMENT
/end FUNCTION
/begin FUNCTION DIAVALVE "" /begin LOC_MEASUREMENT eevx /end LOC_MEASUREMENT /end FUNCTION
/begin FUNCTION DIMC "27.50     OBDII; inspection/maintenance-ready" /begin REF_CHARACTERISTIC SRYTES SRYSLS SRYLS SRYKAT SRYHS SRYAGR /end REF_CHARACTERISTIC
 /begin LOC_MEASUREMENT ready flgdimc evsup1 crytes crysls cryls crykat cryhs cd_bits2_w cd_bits1_w B_ztesf B_ztes B_tesrdy B_slsrdy B_pwf B_mslmin2 B_mslmin B_lsrdy B_kkrdy B_katrdy B_kathrdy B_kath B_katfz B_hsrdy B_cwdslt B_cdtes B_cdsls B_cdlsv B_cdldp B_cdhsv B_cdagr B_agrrdy /end LOC_MEASUREMENT
/end FUNCTION
/begin FUNCTION DKAT "58.50     Eigendiagnose; Katalysatorkonvertierung"
 /begin REF_CHARACTERISTIC ZKTDTKM ZKTDRL ZDKTBF ZDKTBD ZDKATSH ZDKATAF ZDKATAD TWKTDLP TWDKATST TVKTDTK TMSUKTD TMNKATT TMINKAT TMAXKAT TDKATATT TDKATAKT SNM05DKUB SML05DKUB RLDKTUT RLDKTSU RLDKTSO RLDKTOT NKTDX NDKTSUT NDKTSU NDKTSOT NDKTSO KATBSHG KATBSHF KATBSH KATBSG KATBFXM KATBFSX KATBFNP KATBFNM KATBFN KATBFMNT KATBFMN KATBFML FALRKTT FALRKTD DRLKTDPT DRLKTDP DMRKTD DKATCW CDKATLK AVKATFS APEKTDX AHKTTSW AHKTMXT AHKATSB AHKATS AHKATMX AHKATMN ADKATNF /end REF_CHARACTERISTIC
 /begin LOC_MEASUREMENT ushk ushdktp urddktp tvdkttk tmst tkdkthp tkdkth tkatm tc6katw tc6kats tc6katc tc6kata rldkthp rl nmot ml_w ml kbdkt_w katbshd_w katbftp katbfs katbfi_w katbf fr_w falrdkt esst_snm05dkub esst_sml05dkub dmrdkt_w dkatakt_w cd_bits1_w B_zkatz B_zkats B_zkatb B_ukg B_trig B_tehb B_szkat B_sls B_sbbhk B_pwf B_mdkat B_mdarv B_lrka B_lr B_ll B_frmin B_frmax B_fakat B_fa B_erdkt B_ekats B_edkvs B_dtes B_dsls B_dkttk B_dktt B_dktst B_dktsp B_dktsb B_dktnr B_dktlp B_dkten B_dktakt B_dklpi B_dkini B_cdkat avkatf apedkt akatbn ahktnk ahktki_w ahkatn ahkat /end LOC_MEASUREMENT
/end FUNCTION
/begin FUNCTION DKRA "6.20      Diagnose; Klopfregelanschlag" /begin REF_CHARACTERISTIC NDKRA DKRAZ DKRAMX /end REF_CHARACTERISTIC
 /begin LOC_MEASUREMENT zzylkr tpnt_aktiv nmot flmxctr_7_A flmxctr_6_A flmxctr_5_A flmxctr_4_A flmxctr_3_A flmxctr_2_A flmxctr_1_A flmxctr_0_A dkractr B_pwf B_krwa B_kr B_kl /end LOC_MEASUREMENT
/end FUNCTION
/begin FUNCTION DKRNT "4.30      Diagnose; Klopfregelung, Nulltest (OBDII)" /begin REF_CHARACTERISTIC UDKRGOFS KRFHT DKROKU DKROKO DKRISNT CDKROF CDKRNT /end REF_CHARACTERISTIC
 /begin LOC_MEASUREMENT xzskrof xzskrnt xzkrzof xzkrznt tpnt_aktiv nmot ikrma igokr_w B_stend B_pwf B_dnt /end LOC_MEASUREMENT
/end FUNCTION
/begin FUNCTION DKRS "30.10     Diagnose; Klopfsensor (OBDII)"
 /begin REF_CHARACTERISTIC UDKSNU UDKSNO SNM16KRUB NDKS KRFHKS CWDKS4 CWDKS3 CWDKS2 CWDKS1 /end REF_CHARACTERISTIC
 /begin LOC_MEASUREMENT xzsen_3_A xzsen_2_A xzsen_1_A xzsen_0_A xzkrzs_3_A xzkrzs_2_A xzkrzs_1_A xzkrzs_0_A vkr_7_A vkr_6_A vkr_5_A vkr_4_A vkr_3_A vkr_2_A vkr_1_A vkr_0_A udksnua_w udksnoa_w sen_c95_7__A sen_c95_6__A sen_c95_5__A sen_c95_4__A sen_c95_3__A sen_c95_2__A sen_c95_1__A sen_c95_0__A rkr_7_A rkr_6_A rkr_5_A rkr_4_A rkr_3_A rkr_2_A rkr_1_A rkr_0_A rkrn_w_7__A rkrn_w_6__A rkrn_w_5__A rkrn_w_4__A rkrn_w_3__A rkrn_w_2__A rkrn_w_1__A rkrn_w_0__A nmot ks_sym_3__A ks_sym_2__A ks_sym_1__A ks_sym_0__A esst_snm16krub B_tmkr B_pwf B_krndy B_krldy B_krfdks B_kr B_ds /end LOC_MEASUREMENT
/end FUNCTION
/begin FUNCTION DKRTP "6.30      Diagnose; Klopfregelung, Testimpuls (OBDII)" /begin REF_CHARACTERISTIC UDKRTP KRFHT CDKRTP /end REF_CHARACTERISTIC /begin LOC_MEASUREMENT xzskrtp xzkrztp tpnt_aktiv ikrmet ikrma B_pwf B_dtp /end LOC_MEASUREMENT /end FUNCTION
/begin FUNCTION DKUPPL "1.40      Diagnose Kupplungsschalter" /begin REF_CHARACTERISTIC VDKUPPLMN TDKUPNOG AKUPPLB AGANGW /end REF_CHARACTERISTIC
 /begin LOC_MEASUREMENT vfzg S_kupp gangi B_lsd B_gangok B_brems B_autget anzkupplb anzgangw /end LOC_MEASUREMENT
/end FUNCTION
/end MODULE
/end PROJECT
