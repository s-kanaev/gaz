ASAP2_VERSION 1 21
/begin PROJECT Pro4017 "R4 1.8l 5V T lÑngs FR5ROM F5051"
/begin HEADER "" PROJECT_NO Pro4017 VERSION "PrV = F21dc mit 00" /end HEADER
/begin MODULE DIM " "
/begin MOD_COMMON " " S_REC_LAYOUT ME7 BYTE_ORDER MSB_LAST /end MOD_COMMON
/begin COMPU_METHOD B_TRUE "boolsche ZustÑnde, positive Logik" TAB_VERB "%6.3" "" COMPU_TAB_REF B_TRUE /end COMPU_METHOD
/begin COMPU_METHOD B_TRUE___UW "boolsche ZustÑnde, positive Logik" TAB_VERB "%6.3" "" COMPU_TAB_REF B_TRUE /end COMPU_METHOD
/begin COMPU_METHOD default "" RAT_FUNC "%6.2" "" COEFFS 0 1.000000 0.000000 0 0.000000 1.000000 /end COMPU_METHOD
/begin COMPU_METHOD dez___UW "1 : 1 Umrechnug (dez/hex)" RAT_FUNC "%6.2" "" COEFFS 0 1.000000 0.000000 0 0.000000 1.000000 /end COMPU_METHOD
/begin COMPU_VTAB B_TRUE "" TAB_VERB 2 0 "----" 1 "TRUE" /end COMPU_VTAB
/begin MEASUREMENT B_beaave "" UWORD B_TRUE___UW 0 0 0.000000 0.000000 /begin IF_DATA ASAP1B_ETK KP_BLOB 0x383AF0 1 2 /end IF_DATA BIT_MASK 0x20 /end MEASUREMENT
/begin MEASUREMENT B_beagre "" UWORD B_TRUE___UW 0 0 0.000000 0.000000 /begin IF_DATA ASAP1B_ETK KP_BLOB 0x383AF2 1 2 /end IF_DATA BIT_MASK 0x20 /end MEASUREMENT
/begin MEASUREMENT B_beepcle "" UWORD B_TRUE___UW 0 0 0.000000 0.000000 /begin IF_DATA ASAP1B_ETK KP_BLOB 0x383B32 1 2 /end IF_DATA BIT_MASK 0x20 /end MEASUREMENT
/begin MEASUREMENT B_beetse "" UWORD B_TRUE___UW 0 0 0.000000 0.000000 /begin IF_DATA ASAP1B_ETK KP_BLOB 0x383B34 1 2 /end IF_DATA BIT_MASK 0x20 /end MEASUREMENT
/begin MEASUREMENT B_beev1 "" UWORD B_TRUE___UW 0 0 0.000000 0.000000 /begin IF_DATA ASAP1B_ETK KP_BLOB 0x383B36 1 2 /end IF_DATA BIT_MASK 0x20 /end MEASUREMENT
/begin MEASUREMENT B_beev2 "" UWORD B_TRUE___UW 0 0 0.000000 0.000000 /begin IF_DATA ASAP1B_ETK KP_BLOB 0x383B38 1 2 /end IF_DATA BIT_MASK 0x20 /end MEASUREMENT
/begin MEASUREMENT B_beev3 "" UWORD B_TRUE___UW 0 0 0.000000 0.000000 /begin IF_DATA ASAP1B_ETK KP_BLOB 0x383B3A 1 2 /end IF_DATA BIT_MASK 0x20 /end MEASUREMENT
/begin MEASUREMENT B_beev4 "" UWORD B_TRUE___UW 0 0 0.000000 0.000000 /begin IF_DATA ASAP1B_ETK KP_BLOB 0x383B3C 1 2 /end IF_DATA BIT_MASK 0x20 /end MEASUREMENT
/begin MEASUREMENT B_beev5 "" UWORD B_TRUE___UW 0 0 0.000000 0.000000 /begin IF_DATA ASAP1B_ETK KP_BLOB 0x383B3E 1 2 /end IF_DATA BIT_MASK 0x20 /end MEASUREMENT
/begin MEASUREMENT B_beev6 "" UWORD B_TRUE___UW 0 0 0.000000 0.000000 /begin IF_DATA ASAP1B_ETK KP_BLOB 0x383B40 1 2 /end IF_DATA BIT_MASK 0x20 /end MEASUREMENT
/begin MEASUREMENT B_beev7 "" UWORD B_TRUE___UW 0 0 0.000000 0.000000 /begin IF_DATA ASAP1B_ETK KP_BLOB 0x383B42 1 2 /end IF_DATA BIT_MASK 0x20 /end MEASUREMENT
/begin MEASUREMENT B_beev8 "" UWORD B_TRUE___UW 0 0 0.000000 0.000000 /begin IF_DATA ASAP1B_ETK KP_BLOB 0x383B44 1 2 /end IF_DATA BIT_MASK 0x20 /end MEASUREMENT
/begin MEASUREMENT B_befrao "" UWORD B_TRUE___UW 0 0 0.000000 0.000000 /begin IF_DATA ASAP1B_ETK KP_BLOB 0x383B4C 1 2 /end IF_DATA BIT_MASK 0x20 /end MEASUREMENT
/begin MEASUREMENT B_befrau "" UWORD B_TRUE___UW 0 0 0.000000 0.000000 /begin IF_DATA ASAP1B_ETK KP_BLOB 0x383B4E 1 2 /end IF_DATA BIT_MASK 0x20 /end MEASUREMENT
/begin MEASUREMENT B_befrst "Bedingung: Bandendefunktionanford. fÅr LR- Kurztest" UWORD B_TRUE___UW 0 0 0.000000 0.000000 /begin IF_DATA ASAP1B_ETK KP_BLOB 0x383B50 1 2 /end IF_DATA BIT_MASK 0x20 /end MEASUREMENT
/begin MEASUREMENT B_behsh "" UWORD B_TRUE___UW 0 0 0.000000 0.000000 /begin IF_DATA ASAP1B_ETK KP_BLOB 0x383B56 1 2 /end IF_DATA BIT_MASK 0x20 /end MEASUREMENT
/begin MEASUREMENT B_behshe "" UWORD B_TRUE___UW 0 0 0.000000 0.000000 /begin IF_DATA ASAP1B_ETK KP_BLOB 0x383B58 1 2 /end IF_DATA BIT_MASK 0x20 /end MEASUREMENT
/begin MEASUREMENT B_behshe2 "" UWORD B_TRUE___UW 0 0 0.000000 0.000000 /begin IF_DATA ASAP1B_ETK KP_BLOB 0x383B5A 1 2 /end IF_DATA BIT_MASK 0x20 /end MEASUREMENT
/begin MEASUREMENT B_behsv "" UWORD B_TRUE___UW 0 0 0.000000 0.000000 /begin IF_DATA ASAP1B_ETK KP_BLOB 0x383B5C 1 2 /end IF_DATA BIT_MASK 0x20 /end MEASUREMENT
/begin MEASUREMENT B_behsv2 "" UWORD B_TRUE___UW 0 0 0.000000 0.000000 /begin IF_DATA ASAP1B_ETK KP_BLOB 0x383B5E 1 2 /end IF_DATA BIT_MASK 0x20 /end MEASUREMENT
/begin MEASUREMENT B_bekat "" UWORD B_TRUE___UW 0 0 0.000000 0.000000 /begin IF_DATA ASAP1B_ETK KP_BLOB 0x383B60 1 2 /end IF_DATA BIT_MASK 0x20 /end MEASUREMENT
/begin MEASUREMENT B_bekpe "" UWORD B_TRUE___UW 0 0 0.000000 0.000000 /begin IF_DATA ASAP1B_ETK KP_BLOB 0x383B62 1 2 /end IF_DATA BIT_MASK 0x20 /end MEASUREMENT
/begin MEASUREMENT B_bekrnt "" UWORD B_TRUE___UW 0 0 0.000000 0.000000 /begin IF_DATA ASAP1B_ETK KP_BLOB 0x383B74 1 2 /end IF_DATA BIT_MASK 0x20 /end MEASUREMENT
/begin MEASUREMENT B_bekrof "" UWORD B_TRUE___UW 0 0 0.000000 0.000000 /begin IF_DATA ASAP1B_ETK KP_BLOB 0x383B76 1 2 /end IF_DATA BIT_MASK 0x20 /end MEASUREMENT
/begin MEASUREMENT B_bekrtp "" UWORD B_TRUE___UW 0 0 0.000000 0.000000 /begin IF_DATA ASAP1B_ETK KP_BLOB 0x383B78 1 2 /end IF_DATA BIT_MASK 0x20 /end MEASUREMENT
/begin MEASUREMENT B_beks1 "" UWORD B_TRUE___UW 0 0 0.000000 0.000000 /begin IF_DATA ASAP1B_ETK KP_BLOB 0x383B7A 1 2 /end IF_DATA BIT_MASK 0x20 /end MEASUREMENT
/begin MEASUREMENT B_beks2 "" UWORD B_TRUE___UW 0 0 0.000000 0.000000 /begin IF_DATA ASAP1B_ETK KP_BLOB 0x383B7C 1 2 /end IF_DATA BIT_MASK 0x20 /end MEASUREMENT
/begin MEASUREMENT B_beks3 "" UWORD B_TRUE___UW 0 0 0.000000 0.000000 /begin IF_DATA ASAP1B_ETK KP_BLOB 0x383B7E 1 2 /end IF_DATA BIT_MASK 0x20 /end MEASUREMENT
/begin MEASUREMENT B_beks4 "" UWORD B_TRUE___UW 0 0 0.000000 0.000000 /begin IF_DATA ASAP1B_ETK KP_BLOB 0x383B80 1 2 /end IF_DATA BIT_MASK 0x20 /end MEASUREMENT
/begin MEASUREMENT B_bekuppl "" UWORD B_TRUE___UW 0 0 0.000000 0.000000 /begin IF_DATA ASAP1B_ETK KP_BLOB 0x383B82 1 2 /end IF_DATA BIT_MASK 0x20 /end MEASUREMENT
/begin MEASUREMENT B_belash "" UWORD B_TRUE___UW 0 0 0.000000 0.000000 /begin IF_DATA ASAP1B_ETK KP_BLOB 0x383B84 1 2 /end IF_DATA BIT_MASK 0x20 /end MEASUREMENT
/begin MEASUREMENT B_belash2 "" UWORD B_TRUE___UW 0 0 0.000000 0.000000 /begin IF_DATA ASAP1B_ETK KP_BLOB 0x383B86 1 2 /end IF_DATA BIT_MASK 0x20 /end MEASUREMENT
/begin MEASUREMENT B_belatp "" UWORD B_TRUE___UW 0 0 0.000000 0.000000 /begin IF_DATA ASAP1B_ETK KP_BLOB 0x383B88 1 2 /end IF_DATA BIT_MASK 0x20 /end MEASUREMENT
/begin MEASUREMENT B_belatp2 "" UWORD B_TRUE___UW 0 0 0.000000 0.000000 /begin IF_DATA ASAP1B_ETK KP_BLOB 0x383B8A 1 2 /end IF_DATA BIT_MASK 0x20 /end MEASUREMENT
/begin MEASUREMENT B_belatv "" UWORD B_TRUE___UW 0 0 0.000000 0.000000 /begin IF_DATA ASAP1B_ETK KP_BLOB 0x383B8C 1 2 /end IF_DATA BIT_MASK 0x20 /end MEASUREMENT
/begin MEASUREMENT B_belatv2 "" UWORD B_TRUE___UW 0 0 0.000000 0.000000 /begin IF_DATA ASAP1B_ETK KP_BLOB 0x383B8E 1 2 /end IF_DATA BIT_MASK 0x20 /end MEASUREMENT
/begin MEASUREMENT B_belde "" UWORD B_TRUE___UW 0 0 0.000000 0.000000 /begin IF_DATA ASAP1B_ETK KP_BLOB 0x383B90 1 2 /end IF_DATA BIT_MASK 0x20 /end MEASUREMENT
/begin MEASUREMENT B_beldo "" UWORD B_TRUE___UW 0 0 0.000000 0.000000 /begin IF_DATA ASAP1B_ETK KP_BLOB 0x383B92 1 2 /end IF_DATA BIT_MASK 0x20 /end MEASUREMENT
/begin MEASUREMENT B_beldp "" UWORD B_TRUE___UW 0 0 0.000000 0.000000 /begin IF_DATA ASAP1B_ETK KP_BLOB 0x383B94 1 2 /end IF_DATA BIT_MASK 0x20 /end MEASUREMENT
/begin MEASUREMENT B_beldra "" UWORD B_TRUE___UW 0 0 0.000000 0.000000 /begin IF_DATA ASAP1B_ETK KP_BLOB 0x383B98 1 2 /end IF_DATA BIT_MASK 0x20 /end MEASUREMENT
/begin MEASUREMENT B_bellr "" UWORD B_TRUE___UW 0 0 0.000000 0.000000 /begin IF_DATA ASAP1B_ETK KP_BLOB 0x383B9A 1 2 /end IF_DATA BIT_MASK 0x20 /end MEASUREMENT
/begin MEASUREMENT B_belm "Bedingung Bandende-Funktionsanforderung Luftmassensensor (HFM/DSS)" UWORD B_TRUE___UW 0 0 0.000000 0.000000 /begin IF_DATA ASAP1B_ETK KP_BLOB 0x383B9C 1 2 /end IF_DATA BIT_MASK 0x20 /end MEASUREMENT
/begin MEASUREMENT B_belsh "Bedingung Bandende-Funktionsanforderung elktr. Diag. Lambda-Sonde hinter KAT" UWORD B_TRUE___UW 0 0 0.000000 0.000000 /begin IF_DATA ASAP1B_ETK KP_BLOB 0x383B9E 1 2 /end IF_DATA BIT_MASK 0x20 /end MEASUREMENT
/begin MEASUREMENT B_belsv "Bedingung Bandende-Funktionsanforderung elktr. Diag. Lambda-Sonde vor KAT" UWORD B_TRUE___UW 0 0 0.000000 0.000000 /begin IF_DATA ASAP1B_ETK KP_BLOB 0x383BA0 1 2 /end IF_DATA BIT_MASK 0x20 /end MEASUREMENT
/begin MEASUREMENT B_bemile "" UWORD B_TRUE___UW 0 0 0.000000 0.000000 /begin IF_DATA ASAP1B_ETK KP_BLOB 0x383BB8 1 2 /end IF_DATA BIT_MASK 0x20 /end MEASUREMENT
/begin MEASUREMENT B_benwse "" UWORD B_TRUE___UW 0 0 0.000000 0.000000 /begin IF_DATA ASAP1B_ETK KP_BLOB 0x383BC4 1 2 /end IF_DATA BIT_MASK 0x20 /end MEASUREMENT
/begin MEASUREMENT B_berkat "" UWORD B_TRUE___UW 0 0 0.000000 0.000000 /begin IF_DATA ASAP1B_ETK KP_BLOB 0x383BCC 1 2 /end IF_DATA BIT_MASK 0x20 /end MEASUREMENT
/begin MEASUREMENT B_berkaz "" UWORD B_TRUE___UW 0 0 0.000000 0.000000 /begin IF_DATA ASAP1B_ETK KP_BLOB 0x383BCE 1 2 /end IF_DATA BIT_MASK 0x20 /end MEASUREMENT
/begin MEASUREMENT B_beslpe "" UWORD B_TRUE___UW 0 0 0.000000 0.000000 /begin IF_DATA ASAP1B_ETK KP_BLOB 0x383BD2 1 2 /end IF_DATA BIT_MASK 0x20 /end MEASUREMENT
/begin MEASUREMENT B_beslve "" UWORD B_TRUE___UW 0 0 0.000000 0.000000 /begin IF_DATA ASAP1B_ETK KP_BLOB 0x383BD8 1 2 /end IF_DATA BIT_MASK 0x20 /end MEASUREMENT
/begin MEASUREMENT B_besue "" UWORD B_TRUE___UW 0 0 0.000000 0.000000 /begin IF_DATA ASAP1B_ETK KP_BLOB 0x383BDC 1 2 /end IF_DATA BIT_MASK 0x20 /end MEASUREMENT
/begin MEASUREMENT B_betesf "" UWORD B_TRUE___UW 0 0 0.000000 0.000000 /begin IF_DATA ASAP1B_ETK KP_BLOB 0x383BE6 1 2 /end IF_DATA BIT_MASK 0x20 /end MEASUREMENT
/begin MEASUREMENT B_betesg "" UWORD B_TRUE___UW 0 0 0.000000 0.000000 /begin IF_DATA ASAP1B_ETK KP_BLOB 0x383BE8 1 2 /end IF_DATA BIT_MASK 0x20 /end MEASUREMENT
/begin MEASUREMENT B_beteve "" UWORD B_TRUE___UW 0 0 0.000000 0.000000 /begin IF_DATA ASAP1B_ETK KP_BLOB 0x383BEA 1 2 /end IF_DATA BIT_MASK 0x20 /end MEASUREMENT
/begin MEASUREMENT B_beuvse "" UWORD B_TRUE___UW 0 0 0.000000 0.000000 /begin IF_DATA ASAP1B_ETK KP_BLOB 0x383C02 1 2 /end IF_DATA BIT_MASK 0x20 /end MEASUREMENT
/begin MEASUREMENT B_bezet1 "" UWORD B_TRUE___UW 0 0 0.000000 0.000000 /begin IF_DATA ASAP1B_ETK KP_BLOB 0x383C0A 1 2 /end IF_DATA BIT_MASK 0x20 /end MEASUREMENT
/begin MEASUREMENT B_bezet2 "" UWORD B_TRUE___UW 0 0 0.000000 0.000000 /begin IF_DATA ASAP1B_ETK KP_BLOB 0x383C0C 1 2 /end IF_DATA BIT_MASK 0x20 /end MEASUREMENT
/begin MEASUREMENT B_bezet3 "" UWORD B_TRUE___UW 0 0 0.000000 0.000000 /begin IF_DATA ASAP1B_ETK KP_BLOB 0x383C0E 1 2 /end IF_DATA BIT_MASK 0x20 /end MEASUREMENT
/begin MEASUREMENT B_bezet4 "" UWORD B_TRUE___UW 0 0 0.000000 0.000000 /begin IF_DATA ASAP1B_ETK KP_BLOB 0x383C10 1 2 /end IF_DATA BIT_MASK 0x20 /end MEASUREMENT
/begin MEASUREMENT B_bezet5 "" UWORD B_TRUE___UW 0 0 0.000000 0.000000 /begin IF_DATA ASAP1B_ETK KP_BLOB 0x383C12 1 2 /end IF_DATA BIT_MASK 0x20 /end MEASUREMENT
/begin MEASUREMENT B_bezet6 "" UWORD B_TRUE___UW 0 0 0.000000 0.000000 /begin IF_DATA ASAP1B_ETK KP_BLOB 0x383C14 1 2 /end IF_DATA BIT_MASK 0x20 /end MEASUREMENT
/begin MEASUREMENT B_bezet7 "" UWORD B_TRUE___UW 0 0 0.000000 0.000000 /begin IF_DATA ASAP1B_ETK KP_BLOB 0x383C16 1 2 /end IF_DATA BIT_MASK 0x20 /end MEASUREMENT
/begin MEASUREMENT B_bezet8 "" UWORD B_TRUE___UW 0 0 0.000000 0.000000 /begin IF_DATA ASAP1B_ETK KP_BLOB 0x383C18 1 2 /end IF_DATA BIT_MASK 0x20 /end MEASUREMENT
/begin MEASUREMENT B_bkaave "Bedingung Ersatzwert aktiv Tankdiagnose, AAVE-Ventil Endstufe" UWORD B_TRUE___UW 0 0 0.000000 0.000000 /begin IF_DATA ASAP1B_ETK KP_BLOB 0x383AF0 1 2 /end IF_DATA BIT_MASK 0x40 /end MEASUREMENT
/begin MEASUREMENT B_bkagre "Bedingung: AbgasrÅckfÅhrungsventil Endstufe" UWORD B_TRUE___UW 0 0 0.000000 0.000000 /begin IF_DATA ASAP1B_ETK KP_BLOB 0x383AF2 1 2 /end IF_DATA BIT_MASK 0x40 /end MEASUREMENT
/begin MEASUREMENT B_bkepcle "Bedingung: Fahrverhaltens-Fehllampe Endstufe" UWORD B_TRUE___UW 0 0 0.000000 0.000000 /begin IF_DATA ASAP1B_ETK KP_BLOB 0x383B32 1 2 /end IF_DATA BIT_MASK 0x40 /end MEASUREMENT
/begin MEASUREMENT B_bketse "Bedingung Ersatzwert aktiv: elektrisches Thermostat Endstufe" UWORD B_TRUE___UW 0 0 0.000000 0.000000 /begin IF_DATA ASAP1B_ETK KP_BLOB 0x383B34 1 2 /end IF_DATA BIT_MASK 0x40 /end MEASUREMENT
/begin MEASUREMENT B_bkev1 "Bedingung: Einspritzventil 1 aktiv" UWORD B_TRUE___UW 0 0 0.000000 0.000000 /begin IF_DATA ASAP1B_ETK KP_BLOB 0x383B36 1 2 /end IF_DATA BIT_MASK 0x40 /end MEASUREMENT
/begin MEASUREMENT B_bkev2 "Bedingung: Einspritzventil 2 aktiv" UWORD B_TRUE___UW 0 0 0.000000 0.000000 /begin IF_DATA ASAP1B_ETK KP_BLOB 0x383B38 1 2 /end IF_DATA BIT_MASK 0x40 /end MEASUREMENT
/begin MEASUREMENT B_bkev3 "Bedingung: Einspritzventil 3 aktiv" UWORD B_TRUE___UW 0 0 0.000000 0.000000 /begin IF_DATA ASAP1B_ETK KP_BLOB 0x383B3A 1 2 /end IF_DATA BIT_MASK 0x40 /end MEASUREMENT
/begin MEASUREMENT B_bkev4 "Bedingung: Einspritzventil 4 aktiv" UWORD B_TRUE___UW 0 0 0.000000 0.000000 /begin IF_DATA ASAP1B_ETK KP_BLOB 0x383B3C 1 2 /end IF_DATA BIT_MASK 0x40 /end MEASUREMENT
/begin MEASUREMENT B_bkev5 "Bedingung: Einspritzventil 5 aktiv" UWORD B_TRUE___UW 0 0 0.000000 0.000000 /begin IF_DATA ASAP1B_ETK KP_BLOB 0x383B3E 1 2 /end IF_DATA BIT_MASK 0x40 /end MEASUREMENT
/begin MEASUREMENT B_bkev6 "Bedingung: Einspritzventil 6 aktiv" UWORD B_TRUE___UW 0 0 0.000000 0.000000 /begin IF_DATA ASAP1B_ETK KP_BLOB 0x383B40 1 2 /end IF_DATA BIT_MASK 0x40 /end MEASUREMENT
/begin MEASUREMENT B_bkev7 "Bedingung: Einspritzventil 7 aktiv" UWORD B_TRUE___UW 0 0 0.000000 0.000000 /begin IF_DATA ASAP1B_ETK KP_BLOB 0x383B42 1 2 /end IF_DATA BIT_MASK 0x40 /end MEASUREMENT
/begin MEASUREMENT B_bkev8 "Bedingung: Einspritzventil 8 aktiv" UWORD B_TRUE___UW 0 0 0.000000 0.000000 /begin IF_DATA ASAP1B_ETK KP_BLOB 0x383B44 1 2 /end IF_DATA BIT_MASK 0x40 /end MEASUREMENT
/begin MEASUREMENT B_bkfrao "Ersatzwert fÅr FRAO aktiv" UWORD B_TRUE___UW 0 0 0.000000 0.000000 /begin IF_DATA ASAP1B_ETK KP_BLOB 0x383B4C 1 2 /end IF_DATA BIT_MASK 0x40 /end MEASUREMENT
/begin MEASUREMENT B_bkfrau "Ersatzwert fÅr FRAU aktiv" UWORD B_TRUE___UW 0 0 0.000000 0.000000 /begin IF_DATA ASAP1B_ETK KP_BLOB 0x383B4E 1 2 /end IF_DATA BIT_MASK 0x40 /end MEASUREMENT
/begin MEASUREMENT B_bkfrst "Bedingung: LR-Abweichung" UWORD B_TRUE___UW 0 0 0.000000 0.000000 /begin IF_DATA ASAP1B_ETK KP_BLOB 0x383B50 1 2 /end IF_DATA BIT_MASK 0x40 /end MEASUREMENT
/begin MEASUREMENT B_bkhsh "Bedingung: Lambdasondenheizung hinter Kat. aktiv" UWORD B_TRUE___UW 0 0 0.000000 0.000000 /begin IF_DATA ASAP1B_ETK KP_BLOB 0x383B56 1 2 /end IF_DATA BIT_MASK 0x40 /end MEASUREMENT
/begin MEASUREMENT B_bkhshe "Bedingung: Lambdasondenheizung hinter Kat. Endstufe" UWORD B_TRUE___UW 0 0 0.000000 0.000000 /begin IF_DATA ASAP1B_ETK KP_BLOB 0x383B58 1 2 /end IF_DATA BIT_MASK 0x40 /end MEASUREMENT
/begin MEASUREMENT B_bkhshe2 "Bedingung: Lambdasondenheizung hinter Kat. Bank 2 Endstufe" UWORD B_TRUE___UW 0 0 0.000000 0.000000 /begin IF_DATA ASAP1B_ETK KP_BLOB 0x383B5A 1 2 /end IF_DATA BIT_MASK 0x40 /end MEASUREMENT
/begin MEASUREMENT B_bkhsv "Bedingung:Lambdasondenheizung vor Kat. aktiv" UWORD B_TRUE___UW 0 0 0.000000 0.000000 /begin IF_DATA ASAP1B_ETK KP_BLOB 0x383B5C 1 2 /end IF_DATA BIT_MASK 0x40 /end MEASUREMENT
/begin MEASUREMENT B_bkhsv2 "" UWORD B_TRUE___UW 0 0 0.000000 0.000000 /begin IF_DATA ASAP1B_ETK KP_BLOB 0x383B5E 1 2 /end IF_DATA BIT_MASK 0x40 /end MEASUREMENT
/begin MEASUREMENT B_bkkat "Bedingung Ersatzwert fÅr Katalysator" UWORD B_TRUE___UW 0 0 0.000000 0.000000 /begin IF_DATA ASAP1B_ETK KP_BLOB 0x383B60 1 2 /end IF_DATA BIT_MASK 0x40 /end MEASUREMENT
/begin MEASUREMENT B_bkkpe "Bedingung Ersatzwert fÅr EKP-Relais Endstufe" UWORD B_TRUE___UW 0 0 0.000000 0.000000 /begin IF_DATA ASAP1B_ETK KP_BLOB 0x383B62 1 2 /end IF_DATA BIT_MASK 0x40 /end MEASUREMENT
/begin MEASUREMENT B_bkkrnt "Bedingung: Klopfregelung Nulltest aktiv" UWORD B_TRUE___UW 0 0 0.000000 0.000000 /begin IF_DATA ASAP1B_ETK KP_BLOB 0x383B74 1 2 /end IF_DATA BIT_MASK 0x40 /end MEASUREMENT
/begin MEASUREMENT B_bkkrof "Bedingung: Klopfregelung Offset aktiv" UWORD B_TRUE___UW 0 0 0.000000 0.000000 /begin IF_DATA ASAP1B_ETK KP_BLOB 0x383B76 1 2 /end IF_DATA BIT_MASK 0x40 /end MEASUREMENT
/begin MEASUREMENT B_bkkrtp "" UWORD B_TRUE___UW 0 0 0.000000 0.000000 /begin IF_DATA ASAP1B_ETK KP_BLOB 0x383B78 1 2 /end IF_DATA BIT_MASK 0x40 /end MEASUREMENT
/begin MEASUREMENT B_bkks1 "Bedingung: Klopfsensor 1 aktiv" UWORD B_TRUE___UW 0 0 0.000000 0.000000 /begin IF_DATA ASAP1B_ETK KP_BLOB 0x383B7A 1 2 /end IF_DATA BIT_MASK 0x40 /end MEASUREMENT
/begin MEASUREMENT B_bkks2 "Bedingung: Klopfsensor 2 aktiv" UWORD B_TRUE___UW 0 0 0.000000 0.000000 /begin IF_DATA ASAP1B_ETK KP_BLOB 0x383B7C 1 2 /end IF_DATA BIT_MASK 0x40 /end MEASUREMENT
/begin MEASUREMENT B_bkks3 "Bedingung: Klopfsensor 3 aktiv" UWORD B_TRUE___UW 0 0 0.000000 0.000000 /begin IF_DATA ASAP1B_ETK KP_BLOB 0x383B7E 1 2 /end IF_DATA BIT_MASK 0x40 /end MEASUREMENT
/begin MEASUREMENT B_bkks4 "Bedingung: Klopfsensor 4 aktiv" UWORD B_TRUE___UW 0 0 0.000000 0.000000 /begin IF_DATA ASAP1B_ETK KP_BLOB 0x383B80 1 2 /end IF_DATA BIT_MASK 0x40 /end MEASUREMENT
/begin MEASUREMENT B_bkkuppl "Ersatzwert aktiv" UWORD B_TRUE___UW 0 0 0.000000 0.000000 /begin IF_DATA ASAP1B_ETK KP_BLOB 0x383B82 1 2 /end IF_DATA BIT_MASK 0x40 /end MEASUREMENT
/begin MEASUREMENT B_bklash "Bedingung: Lambdasondenalterung hinter Kat." UWORD B_TRUE___UW 0 0 0.000000 0.000000 /begin IF_DATA ASAP1B_ETK KP_BLOB 0x383B84 1 2 /end IF_DATA BIT_MASK 0x40 /end MEASUREMENT
/begin MEASUREMENT B_bklash2 "Bedingung: Lambdasondenalterung hinter Kat. Bank2" UWORD B_TRUE___UW 0 0 0.000000 0.000000 /begin IF_DATA ASAP1B_ETK KP_BLOB 0x383B86 1 2 /end IF_DATA BIT_MASK 0x40 /end MEASUREMENT
/begin MEASUREMENT B_bklatp "" UWORD B_TRUE___UW 0 0 0.000000 0.000000 /begin IF_DATA ASAP1B_ETK KP_BLOB 0x383B88 1 2 /end IF_DATA BIT_MASK 0x40 /end MEASUREMENT
/begin MEASUREMENT B_bklatp2 "" UWORD B_TRUE___UW 0 0 0.000000 0.000000 /begin IF_DATA ASAP1B_ETK KP_BLOB 0x383B8A 1 2 /end IF_DATA BIT_MASK 0x40 /end MEASUREMENT
/begin MEASUREMENT B_bklatv "" UWORD B_TRUE___UW 0 0 0.000000 0.000000 /begin IF_DATA ASAP1B_ETK KP_BLOB 0x383B8C 1 2 /end IF_DATA BIT_MASK 0x40 /end MEASUREMENT
/begin MEASUREMENT B_bklatv2 "" UWORD B_TRUE___UW 0 0 0.000000 0.000000 /begin IF_DATA ASAP1B_ETK KP_BLOB 0x383B8E 1 2 /end IF_DATA BIT_MASK 0x40 /end MEASUREMENT
/begin MEASUREMENT B_bklde "Bedingung: Ladedrucksteuerventil Endstufe aktiv" UWORD B_TRUE___UW 0 0 0.000000 0.000000 /begin IF_DATA ASAP1B_ETK KP_BLOB 0x383B90 1 2 /end IF_DATA BIT_MASK 0x40 /end MEASUREMENT
/begin MEASUREMENT B_bkldo "" UWORD B_TRUE___UW 0 0 0.000000 0.000000 /begin IF_DATA ASAP1B_ETK KP_BLOB 0x383B92 1 2 /end IF_DATA BIT_MASK 0x40 /end MEASUREMENT
/begin MEASUREMENT B_bkldp "Bedingung: Leckdiagnosemodul aktiv" UWORD B_TRUE___UW 0 0 0.000000 0.000000 /begin IF_DATA ASAP1B_ETK KP_BLOB 0x383B94 1 2 /end IF_DATA BIT_MASK 0x40 /end MEASUREMENT
/begin MEASUREMENT B_bkldra "" UWORD B_TRUE___UW 0 0 0.000000 0.000000 /begin IF_DATA ASAP1B_ETK KP_BLOB 0x383B98 1 2 /end IF_DATA BIT_MASK 0x40 /end MEASUREMENT
/begin MEASUREMENT B_bkllr "Bedingung: Leerlaufregelung aktiv" UWORD B_TRUE___UW 0 0 0.000000 0.000000 /begin IF_DATA ASAP1B_ETK KP_BLOB 0x383B9A 1 2 /end IF_DATA BIT_MASK 0x40 /end MEASUREMENT
/begin MEASUREMENT B_bklm "Bedingung: Hauptlastsensor aktiv" UWORD B_TRUE___UW 0 0 0.000000 0.000000 /begin IF_DATA ASAP1B_ETK KP_BLOB 0x383B9C 1 2 /end IF_DATA BIT_MASK 0x40 /end MEASUREMENT
/begin MEASUREMENT B_bklsh "Bedingung: Lambdasonde hinter Kat. aktiv" UWORD B_TRUE___UW 0 0 0.000000 0.000000 /begin IF_DATA ASAP1B_ETK KP_BLOB 0x383B9E 1 2 /end IF_DATA BIT_MASK 0x40 /end MEASUREMENT
/begin MEASUREMENT B_bklsv "Bedingung: Lambdasonde vor Kat. aktiv" UWORD B_TRUE___UW 0 0 0.000000 0.000000 /begin IF_DATA ASAP1B_ETK KP_BLOB 0x383BA0 1 2 /end IF_DATA BIT_MASK 0x40 /end MEASUREMENT
/begin MEASUREMENT B_bkmile "Bedingung: MIL-Endstufe aktiv" UWORD B_TRUE___UW 0 0 0.000000 0.000000 /begin IF_DATA ASAP1B_ETK KP_BLOB 0x383BB8 1 2 /end IF_DATA BIT_MASK 0x40 /end MEASUREMENT
/begin MEASUREMENT B_bknwse "Bedingung: Nockenwellensteuerung Endstufe aktiv" UWORD B_TRUE___UW 0 0 0.000000 0.000000 /begin IF_DATA ASAP1B_ETK KP_BLOB 0x383BC4 1 2 /end IF_DATA BIT_MASK 0x40 /end MEASUREMENT
/begin MEASUREMENT B_bkrkat "Ersatzwert fÅr RKAT aktiv" UWORD B_TRUE___UW 0 0 0.000000 0.000000 /begin IF_DATA ASAP1B_ETK KP_BLOB 0x383BCC 1 2 /end IF_DATA BIT_MASK 0x40 /end MEASUREMENT
/begin MEASUREMENT B_bkrkaz "Ersatzwert fÅr RKAZ aktiv" UWORD B_TRUE___UW 0 0 0.000000 0.000000 /begin IF_DATA ASAP1B_ETK KP_BLOB 0x383BCE 1 2 /end IF_DATA BIT_MASK 0x40 /end MEASUREMENT
/begin MEASUREMENT B_bkslpe "Bedingung: SekundÑrluftpumpe ( Endstufe) aktiv" UWORD B_TRUE___UW 0 0 0.000000 0.000000 /begin IF_DATA ASAP1B_ETK KP_BLOB 0x383BD2 1 2 /end IF_DATA BIT_MASK 0x40 /end MEASUREMENT
/begin MEASUREMENT B_bkslve "Bedingung: SekundÑrluftventil Endstufe" UWORD B_TRUE___UW 0 0 0.000000 0.000000 /begin IF_DATA ASAP1B_ETK KP_BLOB 0x383BD8 1 2 /end IF_DATA BIT_MASK 0x40 /end MEASUREMENT
/begin MEASUREMENT B_bksue "Bedingung: Saugrohrumschaltung Endstufe aktiv" UWORD B_TRUE___UW 0 0 0.000000 0.000000 /begin IF_DATA ASAP1B_ETK KP_BLOB 0x383BDC 1 2 /end IF_DATA BIT_MASK 0x40 /end MEASUREMENT
/begin MEASUREMENT B_bktesf "Bedingung Ersatzwert aktiv Tankdiagnose Feinleck" UWORD B_TRUE___UW 0 0 0.000000 0.000000 /begin IF_DATA ASAP1B_ETK KP_BLOB 0x383BE6 1 2 /end IF_DATA BIT_MASK 0x40 /end MEASUREMENT
/begin MEASUREMENT B_bktesg "Bedingung Ersatzwert aktiv Tankdiagnose Grobleck" UWORD B_TRUE___UW 0 0 0.000000 0.000000 /begin IF_DATA ASAP1B_ETK KP_BLOB 0x383BE8 1 2 /end IF_DATA BIT_MASK 0x40 /end MEASUREMENT
/begin MEASUREMENT B_bkteve "Bedingung: TankentlÅftungsventil Endstufe aktiv" UWORD B_TRUE___UW 0 0 0.000000 0.000000 /begin IF_DATA ASAP1B_ETK KP_BLOB 0x383BEA 1 2 /end IF_DATA BIT_MASK 0x40 /end MEASUREMENT
/begin MEASUREMENT B_bkuvse "Bedingung: Endstufe Umluftventil Turbo aktiv" UWORD B_TRUE___UW 0 0 0.000000 0.000000 /begin IF_DATA ASAP1B_ETK KP_BLOB 0x383C02 1 2 /end IF_DATA BIT_MASK 0x40 /end MEASUREMENT
/begin MEASUREMENT B_bkzet1 "" UWORD B_TRUE___UW 0 0 0.000000 0.000000 /begin IF_DATA ASAP1B_ETK KP_BLOB 0x383C0A 1 2 /end IF_DATA BIT_MASK 0x40 /end MEASUREMENT
/begin MEASUREMENT B_bkzet2 "" UWORD B_TRUE___UW 0 0 0.000000 0.000000 /begin IF_DATA ASAP1B_ETK KP_BLOB 0x383C0C 1 2 /end IF_DATA BIT_MASK 0x40 /end MEASUREMENT
/begin MEASUREMENT B_bkzet3 "" UWORD B_TRUE___UW 0 0 0.000000 0.000000 /begin IF_DATA ASAP1B_ETK KP_BLOB 0x383C0E 1 2 /end IF_DATA BIT_MASK 0x40 /end MEASUREMENT
/begin MEASUREMENT B_bkzet4 "" UWORD B_TRUE___UW 0 0 0.000000 0.000000 /begin IF_DATA ASAP1B_ETK KP_BLOB 0x383C10 1 2 /end IF_DATA BIT_MASK 0x40 /end MEASUREMENT
/begin MEASUREMENT B_bkzet5 "" UWORD B_TRUE___UW 0 0 0.000000 0.000000 /begin IF_DATA ASAP1B_ETK KP_BLOB 0x383C12 1 2 /end IF_DATA BIT_MASK 0x40 /end MEASUREMENT
/begin MEASUREMENT B_bkzet6 "" UWORD B_TRUE___UW 0 0 0.000000 0.000000 /begin IF_DATA ASAP1B_ETK KP_BLOB 0x383C14 1 2 /end IF_DATA BIT_MASK 0x40 /end MEASUREMENT
/begin MEASUREMENT B_bkzet7 "" UWORD B_TRUE___UW 0 0 0.000000 0.000000 /begin IF_DATA ASAP1B_ETK KP_BLOB 0x383C16 1 2 /end IF_DATA BIT_MASK 0x40 /end MEASUREMENT
/begin MEASUREMENT B_bkzet8 "" UWORD B_TRUE___UW 0 0 0.000000 0.000000 /begin IF_DATA ASAP1B_ETK KP_BLOB 0x383C18 1 2 /end IF_DATA BIT_MASK 0x40 /end MEASUREMENT
/begin MEASUREMENT B_claave "Bedingung Fehlerpfad AAVE lîschen" UWORD B_TRUE___UW 0 0 0.000000 0.000000 /begin IF_DATA ASAP1B_ETK KP_BLOB 0x383AF0 1 2 /end IF_DATA BIT_MASK 0x80 /end MEASUREMENT
/begin MEASUREMENT B_clagre "Bedingung Fehlerpfad AGR-Endstufe lîschen" UWORD B_TRUE___UW 0 0 0.000000 0.000000 /begin IF_DATA ASAP1B_ETK KP_BLOB 0x383AF2 1 2 /end IF_DATA BIT_MASK 0x80 /end MEASUREMENT
/begin MEASUREMENT B_clepcle "Bedingung Fehlerpfad EPCL-Endstufe lîschen" UWORD B_TRUE___UW 0 0 0.000000 0.000000 /begin IF_DATA ASAP1B_ETK KP_BLOB 0x383B32 1 2 /end IF_DATA BIT_MASK 0x80 /end MEASUREMENT
/begin MEASUREMENT B_cletse "Bedingung Fehlerpfad elektrisches Thermostat Endstufe lîschen" UWORD B_TRUE___UW 0 0 0.000000 0.000000 /begin IF_DATA ASAP1B_ETK KP_BLOB 0x383B34 1 2 /end IF_DATA BIT_MASK 0x80 /end MEASUREMENT
/begin MEASUREMENT B_clev1 "Bedingung Fehlerpfad EV 1 lîschen" UWORD B_TRUE___UW 0 0 0.000000 0.000000 /begin IF_DATA ASAP1B_ETK KP_BLOB 0x383B36 1 2 /end IF_DATA BIT_MASK 0x80 /end MEASUREMENT
/begin MEASUREMENT B_clev2 "Bedingung Fehlerpfad EV 2 lîschen" UWORD B_TRUE___UW 0 0 0.000000 0.000000 /begin IF_DATA ASAP1B_ETK KP_BLOB 0x383B38 1 2 /end IF_DATA BIT_MASK 0x80 /end MEASUREMENT
/begin MEASUREMENT B_clev3 "Bedingung Fehlerpfad EV 3 lîschen" UWORD B_TRUE___UW 0 0 0.000000 0.000000 /begin IF_DATA ASAP1B_ETK KP_BLOB 0x383B3A 1 2 /end IF_DATA BIT_MASK 0x80 /end MEASUREMENT
/begin MEASUREMENT B_clev4 "Bedingung Fehlerpfad EV 4 lîschen" UWORD B_TRUE___UW 0 0 0.000000 0.000000 /begin IF_DATA ASAP1B_ETK KP_BLOB 0x383B3C 1 2 /end IF_DATA BIT_MASK 0x80 /end MEASUREMENT
/begin MEASUREMENT B_clev5 "Bedingung Fehlerpfad EV 5 lîschen" UWORD B_TRUE___UW 0 0 0.000000 0.000000 /begin IF_DATA ASAP1B_ETK KP_BLOB 0x383B3E 1 2 /end IF_DATA BIT_MASK 0x80 /end MEASUREMENT
/begin MEASUREMENT B_clev6 "Bedingung Fehlerpfad EV 6 lîschen" UWORD B_TRUE___UW 0 0 0.000000 0.000000 /begin IF_DATA ASAP1B_ETK KP_BLOB 0x383B40 1 2 /end IF_DATA BIT_MASK 0x80 /end MEASUREMENT
/begin MEASUREMENT B_clev7 "Bedingung Fehlerpfad EV 7 lîschen" UWORD B_TRUE___UW 0 0 0.000000 0.000000 /begin IF_DATA ASAP1B_ETK KP_BLOB 0x383B42 1 2 /end IF_DATA BIT_MASK 0x80 /end MEASUREMENT
/begin MEASUREMENT B_clev8 "Bedingung Fehlerpfad EV 8 lîschen" UWORD B_TRUE___UW 0 0 0.000000 0.000000 /begin IF_DATA ASAP1B_ETK KP_BLOB 0x383B44 1 2 /end IF_DATA BIT_MASK 0x80 /end MEASUREMENT
/begin MEASUREMENT B_clfrao "Bedingung Fehlerpfad FRAO lîschen (obere Multipl. Bereich)" UWORD B_TRUE___UW 0 0 0.000000 0.000000 /begin IF_DATA ASAP1B_ETK KP_BLOB 0x383B4C 1 2 /end IF_DATA BIT_MASK 0x80 /end MEASUREMENT
/begin MEASUREMENT B_clfrau "Bedingung Fehlerpfad FRAU lîschen (untere Multipl. Bereich)" UWORD B_TRUE___UW 0 0 0.000000 0.000000 /begin IF_DATA ASAP1B_ETK KP_BLOB 0x383B4E 1 2 /end IF_DATA BIT_MASK 0x80 /end MEASUREMENT
/begin MEASUREMENT B_clfrst "Bedingung Fehlerpfad FRST lîschen (Kurztest)" UWORD B_TRUE___UW 0 0 0.000000 0.000000 /begin IF_DATA ASAP1B_ETK KP_BLOB 0x383B50 1 2 /end IF_DATA BIT_MASK 0x80 /end MEASUREMENT
/begin MEASUREMENT B_clhsh "Bedingung Fehlerpfad DHLSHK lîschen" UWORD B_TRUE___UW 0 0 0.000000 0.000000 /begin IF_DATA ASAP1B_ETK KP_BLOB 0x383B56 1 2 /end IF_DATA BIT_MASK 0x80 /end MEASUREMENT
/begin MEASUREMENT B_clhshe "Bedingung Fehlerpfad DHLSHK lîschen (Endstufe)" UWORD B_TRUE___UW 0 0 0.000000 0.000000 /begin IF_DATA ASAP1B_ETK KP_BLOB 0x383B58 1 2 /end IF_DATA BIT_MASK 0x80 /end MEASUREMENT
/begin MEASUREMENT B_clhshe2 "Bedingung Fehlerpfad DHLSHK2 lîschen (Endstufe)" UWORD B_TRUE___UW 0 0 0.000000 0.000000 /begin IF_DATA ASAP1B_ETK KP_BLOB 0x383B5A 1 2 /end IF_DATA BIT_MASK 0x80 /end MEASUREMENT
/begin MEASUREMENT B_clhsv "Bedingung Fehlerpfad DHLSVK lîschen" UWORD B_TRUE___UW 0 0 0.000000 0.000000 /begin IF_DATA ASAP1B_ETK KP_BLOB 0x383B5C 1 2 /end IF_DATA BIT_MASK 0x80 /end MEASUREMENT
/begin MEASUREMENT B_clhsv2 "Bedingung Fehlerpfad DHLSVK2 lîschen" UWORD B_TRUE___UW 0 0 0.000000 0.000000 /begin IF_DATA ASAP1B_ETK KP_BLOB 0x383B5E 1 2 /end IF_DATA BIT_MASK 0x80 /end MEASUREMENT
/begin MEASUREMENT B_clkat "Bedingung Fehlerpfad DKAT lîschen" UWORD B_TRUE___UW 0 0 0.000000 0.000000 /begin IF_DATA ASAP1B_ETK KP_BLOB 0x383B60 1 2 /end IF_DATA BIT_MASK 0x80 /end MEASUREMENT
/begin MEASUREMENT B_clkpe "Bedingung Fehlerpfad EKP-Relais Endstufe lîschen" UWORD B_TRUE___UW 0 0 0.000000 0.000000 /begin IF_DATA ASAP1B_ETK KP_BLOB 0x383B62 1 2 /end IF_DATA BIT_MASK 0x80 /end MEASUREMENT
/begin MEASUREMENT B_clkra01 "Bedingung Fehlerpfad Klopfregelanschlag Zylinder 1 lîschen" UWORD B_TRUE___UW 0 0 0.000000 0.000000 /begin IF_DATA ASAP1B_ETK KP_BLOB 0x383B64 1 2 /end IF_DATA BIT_MASK 0x80 /end MEASUREMENT
/begin MEASUREMENT B_clkra02 "Bedingung Fehlerpfad Klopfregelanschlag Zylinder 2 lîschen" UWORD B_TRUE___UW 0 0 0.000000 0.000000 /begin IF_DATA ASAP1B_ETK KP_BLOB 0x383B66 1 2 /end IF_DATA BIT_MASK 0x80 /end MEASUREMENT
/begin MEASUREMENT B_clkra03 "Bedingung Fehlerpfad Klopfregelanschlag Zylinder 3 lîschen" UWORD B_TRUE___UW 0 0 0.000000 0.000000 /begin IF_DATA ASAP1B_ETK KP_BLOB 0x383B68 1 2 /end IF_DATA BIT_MASK 0x80 /end MEASUREMENT
/begin MEASUREMENT B_clkra04 "Bedingung Fehlerpfad Klopfregelanschlag Zylinder 4 lîschen" UWORD B_TRUE___UW 0 0 0.000000 0.000000 /begin IF_DATA ASAP1B_ETK KP_BLOB 0x383B6A 1 2 /end IF_DATA BIT_MASK 0x80 /end MEASUREMENT
/begin MEASUREMENT B_clkra05 "Bedingung Fehlerpfad Klopfregelanschlag Zylinder 5 lîschen" UWORD B_TRUE___UW 0 0 0.000000 0.000000 /begin IF_DATA ASAP1B_ETK KP_BLOB 0x383B6C 1 2 /end IF_DATA BIT_MASK 0x80 /end MEASUREMENT
/begin MEASUREMENT B_clkra06 "Bedingung Fehlerpfad Klopfregelanschlag Zylinder 6 lîschen" UWORD B_TRUE___UW 0 0 0.000000 0.000000 /begin IF_DATA ASAP1B_ETK KP_BLOB 0x383B6E 1 2 /end IF_DATA BIT_MASK 0x80 /end MEASUREMENT
/begin MEASUREMENT B_clkra07 "Bedingung Fehlerpfad Klopfregelanschlag Zylinder 7 lîschen" UWORD B_TRUE___UW 0 0 0.000000 0.000000 /begin IF_DATA ASAP1B_ETK KP_BLOB 0x383B70 1 2 /end IF_DATA BIT_MASK 0x80 /end MEASUREMENT
/begin MEASUREMENT B_clkra08 "Bedingung Fehlerpfad Klopfregelanschlag Zylinder 8 lîschen" UWORD B_TRUE___UW 0 0 0.000000 0.000000 /begin IF_DATA ASAP1B_ETK KP_BLOB 0x383B72 1 2 /end IF_DATA BIT_MASK 0x80 /end MEASUREMENT
/begin MEASUREMENT B_clkrnt "Bedingung Fehlerpfad KR-Diagnose Integratorsteigung lîschen" UWORD B_TRUE___UW 0 0 0.000000 0.000000 /begin IF_DATA ASAP1B_ETK KP_BLOB 0x383B74 1 2 /end IF_DATA BIT_MASK 0x80 /end MEASUREMENT
/begin MEASUREMENT B_clkrof "Bedingung Fehlerpfad KR-Diagnose Resetwert lîschen" UWORD B_TRUE___UW 0 0 0.000000 0.000000 /begin IF_DATA ASAP1B_ETK KP_BLOB 0x383B76 1 2 /end IF_DATA BIT_MASK 0x80 /end MEASUREMENT
/begin MEASUREMENT B_clkrtp "Bedingung Fehlerpfad KR-Diagnose Testimpuls lîschen" UWORD B_TRUE___UW 0 0 0.000000 0.000000 /begin IF_DATA ASAP1B_ETK KP_BLOB 0x383B78 1 2 /end IF_DATA BIT_MASK 0x80 /end MEASUREMENT
/begin MEASUREMENT B_clks1 "Bedingung Fehlerpfad Klopfsensor 1 lîschen" UWORD B_TRUE___UW 0 0 0.000000 0.000000 /begin IF_DATA ASAP1B_ETK KP_BLOB 0x383B7A 1 2 /end IF_DATA BIT_MASK 0x80 /end MEASUREMENT
/begin MEASUREMENT B_clks2 "Bedingung Fehlerpfad Klopfsensor 2 lîschen" UWORD B_TRUE___UW 0 0 0.000000 0.000000 /begin IF_DATA ASAP1B_ETK KP_BLOB 0x383B7C 1 2 /end IF_DATA BIT_MASK 0x80 /end MEASUREMENT
/begin MEASUREMENT B_clks3 "Bedingung Fehlerpfad Klopfsensor 3 lîschen" UWORD B_TRUE___UW 0 0 0.000000 0.000000 /begin IF_DATA ASAP1B_ETK KP_BLOB 0x383B7E 1 2 /end IF_DATA BIT_MASK 0x80 /end MEASUREMENT
/begin MEASUREMENT B_clks4 "Bedingung Fehlerpfad Klopfsensor 4 lîschen" UWORD B_TRUE___UW 0 0 0.000000 0.000000 /begin IF_DATA ASAP1B_ETK KP_BLOB 0x383B80 1 2 /end IF_DATA BIT_MASK 0x80 /end MEASUREMENT
/begin MEASUREMENT B_clkuppl "Bedingung: Fehlerpfad KUPPL (Gebergrî·e Kupplung) lîschen" UWORD B_TRUE___UW 0 0 0.000000 0.000000 /begin IF_DATA ASAP1B_ETK KP_BLOB 0x383B82 1 2 /end IF_DATA BIT_MASK 0x80 /end MEASUREMENT
/begin MEASUREMENT B_cllash "Fehlerpfad in DLSAHK lîschen." UWORD B_TRUE___UW 0 0 0.000000 0.000000 /begin IF_DATA ASAP1B_ETK KP_BLOB 0x383B84 1 2 /end IF_DATA BIT_MASK 0x80 /end MEASUREMENT
/begin MEASUREMENT B_cllash2 "Fehlerpfad in DLSAHK lîschen Bank2" UWORD B_TRUE___UW 0 0 0.000000 0.000000 /begin IF_DATA ASAP1B_ETK KP_BLOB 0x383B86 1 2 /end IF_DATA BIT_MASK 0x80 /end MEASUREMENT
/begin MEASUREMENT B_cllatp "Fehlerpfad in DLSA lîschen." UWORD B_TRUE___UW 0 0 0.000000 0.000000 /begin IF_DATA ASAP1B_ETK KP_BLOB 0x383B88 1 2 /end IF_DATA BIT_MASK 0x80 /end MEASUREMENT
/begin MEASUREMENT B_cllatp2 "Fehlerpfad in DLSA lîschen. Bank2" UWORD B_TRUE___UW 0 0 0.000000 0.000000 /begin IF_DATA ASAP1B_ETK KP_BLOB 0x383B8A 1 2 /end IF_DATA BIT_MASK 0x80 /end MEASUREMENT
/begin MEASUREMENT B_cllatv "Fehlerpfad in DLSA lîschen." UWORD B_TRUE___UW 0 0 0.000000 0.000000 /begin IF_DATA ASAP1B_ETK KP_BLOB 0x383B8C 1 2 /end IF_DATA BIT_MASK 0x80 /end MEASUREMENT
/begin MEASUREMENT B_cllatv2 "Fehlerpfad in DLSA lîschen. Bank2" UWORD B_TRUE___UW 0 0 0.000000 0.000000 /begin IF_DATA ASAP1B_ETK KP_BLOB 0x383B8E 1 2 /end IF_DATA BIT_MASK 0x80 /end MEASUREMENT
/begin MEASUREMENT B_cllde "Bedingung Fehlerpfad LDE lîschen" UWORD B_TRUE___UW 0 0 0.000000 0.000000 /begin IF_DATA ASAP1B_ETK KP_BLOB 0x383B90 1 2 /end IF_DATA BIT_MASK 0x80 /end MEASUREMENT
/begin MEASUREMENT B_clldo "Bedingung: Fehlereintrag öberladefehler lîschen" UWORD B_TRUE___UW 0 0 0.000000 0.000000 /begin IF_DATA ASAP1B_ETK KP_BLOB 0x383B92 1 2 /end IF_DATA BIT_MASK 0x80 /end MEASUREMENT
/begin MEASUREMENT B_clldp "Bedingung: Fehlerpfad LDP lîschen" UWORD B_TRUE___UW 0 0 0.000000 0.000000 /begin IF_DATA ASAP1B_ETK KP_BLOB 0x383B94 1 2 /end IF_DATA BIT_MASK 0x80 /end MEASUREMENT
/begin MEASUREMENT B_clldra "Bedingung: Fehlereintrag LDR Regelabweichungsfehler lîschen" UWORD B_TRUE___UW 0 0 0.000000 0.000000 /begin IF_DATA ASAP1B_ETK KP_BLOB 0x383B98 1 2 /end IF_DATA BIT_MASK 0x80 /end MEASUREMENT
/begin MEASUREMENT B_clllr "Bedingung Fehlerpfad DLLR lîschen" UWORD B_TRUE___UW 0 0 0.000000 0.000000 /begin IF_DATA ASAP1B_ETK KP_BLOB 0x383B9A 1 2 /end IF_DATA BIT_MASK 0x80 /end MEASUREMENT
/begin MEASUREMENT B_cllm "Bedingung: Fehlerpfad HauptfÅllungssensor lîschen" UWORD B_TRUE___UW 0 0 0.000000 0.000000 /begin IF_DATA ASAP1B_ETK KP_BLOB 0x383B9C 1 2 /end IF_DATA BIT_MASK 0x80 /end MEASUREMENT
/begin MEASUREMENT B_cllsh "Fehlerpfad in DLSH lîschen" UWORD B_TRUE___UW 0 0 0.000000 0.000000 /begin IF_DATA ASAP1B_ETK KP_BLOB 0x383B9E 1 2 /end IF_DATA BIT_MASK 0x80 /end MEASUREMENT
/begin MEASUREMENT B_cllsv "Fehlerpfad in DLSV lîschen." UWORD B_TRUE___UW 0 0 0.000000 0.000000 /begin IF_DATA ASAP1B_ETK KP_BLOB 0x383BA0 1 2 /end IF_DATA BIT_MASK 0x80 /end MEASUREMENT
/begin MEASUREMENT B_clmile "Bedingung Fehlerpfad MIL-Endstufe lîschen" UWORD B_TRUE___UW 0 0 0.000000 0.000000 /begin IF_DATA ASAP1B_ETK KP_BLOB 0x383BB8 1 2 /end IF_DATA BIT_MASK 0x80 /end MEASUREMENT
/begin MEASUREMENT B_clnwse "Bedingung Fehlerpfad Nockenwellensteuerung Endstufe lîschen" UWORD B_TRUE___UW 0 0 0.000000 0.000000 /begin IF_DATA ASAP1B_ETK KP_BLOB 0x383BC4 1 2 /end IF_DATA BIT_MASK 0x80 /end MEASUREMENT
/begin MEASUREMENT B_clrkat "Bedingung Fehlerpfad RKAT lîschen (add. pro Zeit)" UWORD B_TRUE___UW 0 0 0.000000 0.000000 /begin IF_DATA ASAP1B_ETK KP_BLOB 0x383BCC 1 2 /end IF_DATA BIT_MASK 0x80 /end MEASUREMENT
/begin MEASUREMENT B_clrkaz "Bedingung Fehlerpfad RKAZ lîschen (add. pro ZÅndung)" UWORD B_TRUE___UW 0 0 0.000000 0.000000 /begin IF_DATA ASAP1B_ETK KP_BLOB 0x383BCE 1 2 /end IF_DATA BIT_MASK 0x80 /end MEASUREMENT
/begin MEASUREMENT B_clslpe "Bedingung: Fehlerpfad Endstufe SekundÑrluftpumpe lîschen" UWORD B_TRUE___UW 0 0 0.000000 0.000000 /begin IF_DATA ASAP1B_ETK KP_BLOB 0x383BD2 1 2 /end IF_DATA BIT_MASK 0x80 /end MEASUREMENT
/begin MEASUREMENT B_clslve "Bedingung: Fehlerpfad Endstufe SekundÑrluftventil lîschen" UWORD B_TRUE___UW 0 0 0.000000 0.000000 /begin IF_DATA ASAP1B_ETK KP_BLOB 0x383BD8 1 2 /end IF_DATA BIT_MASK 0x80 /end MEASUREMENT
/begin MEASUREMENT B_clsue "Bedingung Fehlerpfad Saugrohrumschaltung-Endstufe lîschen" UWORD B_TRUE___UW 0 0 0.000000 0.000000 /begin IF_DATA ASAP1B_ETK KP_BLOB 0x383BDC 1 2 /end IF_DATA BIT_MASK 0x80 /end MEASUREMENT
/begin MEASUREMENT B_cltesf "Bedingung Fehlerflag 'Feinleck' lîschen" UWORD B_TRUE___UW 0 0 0.000000 0.000000 /begin IF_DATA ASAP1B_ETK KP_BLOB 0x383BE6 1 2 /end IF_DATA BIT_MASK 0x80 /end MEASUREMENT
/begin MEASUREMENT B_cltesg "Bedingung Fehlerflag 'Grobleckfehler' lîschen" UWORD B_TRUE___UW 0 0 0.000000 0.000000 /begin IF_DATA ASAP1B_ETK KP_BLOB 0x383BE8 1 2 /end IF_DATA BIT_MASK 0x80 /end MEASUREMENT
/begin MEASUREMENT B_clteve "Bedingung Fehlerphad TEVE lîschen" UWORD B_TRUE___UW 0 0 0.000000 0.000000 /begin IF_DATA ASAP1B_ETK KP_BLOB 0x383BEA 1 2 /end IF_DATA BIT_MASK 0x80 /end MEASUREMENT
/begin MEASUREMENT B_cluvse "Bedingung Fehlerpfad UVSE lîschen" UWORD B_TRUE___UW 0 0 0.000000 0.000000 /begin IF_DATA ASAP1B_ETK KP_BLOB 0x383C02 1 2 /end IF_DATA BIT_MASK 0x80 /end MEASUREMENT
/begin MEASUREMENT B_clzet1 "" UWORD B_TRUE___UW 0 0 0.000000 0.000000 /begin IF_DATA ASAP1B_ETK KP_BLOB 0x383C0A 1 2 /end IF_DATA BIT_MASK 0x80 /end MEASUREMENT
/begin MEASUREMENT B_clzet2 "" UWORD B_TRUE___UW 0 0 0.000000 0.000000 /begin IF_DATA ASAP1B_ETK KP_BLOB 0x383C0C 1 2 /end IF_DATA BIT_MASK 0x80 /end MEASUREMENT
/begin MEASUREMENT B_clzet3 "" UWORD B_TRUE___UW 0 0 0.000000 0.000000 /begin IF_DATA ASAP1B_ETK KP_BLOB 0x383C0E 1 2 /end IF_DATA BIT_MASK 0x80 /end MEASUREMENT
/begin MEASUREMENT B_clzet4 "" UWORD B_TRUE___UW 0 0 0.000000 0.000000 /begin IF_DATA ASAP1B_ETK KP_BLOB 0x383C10 1 2 /end IF_DATA BIT_MASK 0x80 /end MEASUREMENT
/begin MEASUREMENT B_clzet5 "" UWORD B_TRUE___UW 0 0 0.000000 0.000000 /begin IF_DATA ASAP1B_ETK KP_BLOB 0x383C12 1 2 /end IF_DATA BIT_MASK 0x80 /end MEASUREMENT
/begin MEASUREMENT B_clzet6 "" UWORD B_TRUE___UW 0 0 0.000000 0.000000 /begin IF_DATA ASAP1B_ETK KP_BLOB 0x383C14 1 2 /end IF_DATA BIT_MASK 0x80 /end MEASUREMENT
/begin MEASUREMENT B_clzet7 "" UWORD B_TRUE___UW 0 0 0.000000 0.000000 /begin IF_DATA ASAP1B_ETK KP_BLOB 0x383C16 1 2 /end IF_DATA BIT_MASK 0x80 /end MEASUREMENT
/begin MEASUREMENT B_clzet8 "" UWORD B_TRUE___UW 0 0 0.000000 0.000000 /begin IF_DATA ASAP1B_ETK KP_BLOB 0x383C18 1 2 /end IF_DATA BIT_MASK 0x80 /end MEASUREMENT
/begin MEASUREMENT B_fahsv "" UWORD B_TRUE___UW 0 0 0.000000 0.000000 /begin IF_DATA ASAP1B_ETK KP_BLOB 0x383B5C 1 2 /end IF_DATA BIT_MASK 0x10 /end MEASUREMENT
/begin MEASUREMENT B_fahsv2 "" UWORD B_TRUE___UW 0 0 0.000000 0.000000 /begin IF_DATA ASAP1B_ETK KP_BLOB 0x383B5E 1 2 /end IF_DATA BIT_MASK 0x10 /end MEASUREMENT
/begin MEASUREMENT B_falash "" UWORD B_TRUE___UW 0 0 0.000000 0.000000 /begin IF_DATA ASAP1B_ETK KP_BLOB 0x383B84 1 2 /end IF_DATA BIT_MASK 0x10 /end MEASUREMENT
/begin MEASUREMENT B_falash2 "" UWORD B_TRUE___UW 0 0 0.000000 0.000000 /begin IF_DATA ASAP1B_ETK KP_BLOB 0x383B86 1 2 /end IF_DATA BIT_MASK 0x10 /end MEASUREMENT
/begin MEASUREMENT B_ftaave "" UWORD B_TRUE___UW 0 0 0.000000 0.000000 /begin IF_DATA ASAP1B_ETK KP_BLOB 0x383AF0 1 2 /end IF_DATA BIT_MASK 0x10 /end MEASUREMENT
/begin MEASUREMENT B_ftagre "" UWORD B_TRUE___UW 0 0 0.000000 0.000000 /begin IF_DATA ASAP1B_ETK KP_BLOB 0x383AF2 1 2 /end IF_DATA BIT_MASK 0x10 /end MEASUREMENT
/begin MEASUREMENT B_ftepcle "" UWORD B_TRUE___UW 0 0 0.000000 0.000000 /begin IF_DATA ASAP1B_ETK KP_BLOB 0x383B32 1 2 /end IF_DATA BIT_MASK 0x10 /end MEASUREMENT
/begin MEASUREMENT B_ftetse "" UWORD B_TRUE___UW 0 0 0.000000 0.000000 /begin IF_DATA ASAP1B_ETK KP_BLOB 0x383B34 1 2 /end IF_DATA BIT_MASK 0x10 /end MEASUREMENT
/begin MEASUREMENT B_ftev1 "" UWORD B_TRUE___UW 0 0 0.000000 0.000000 /begin IF_DATA ASAP1B_ETK KP_BLOB 0x383B36 1 2 /end IF_DATA BIT_MASK 0x10 /end MEASUREMENT
/begin MEASUREMENT B_ftev2 "" UWORD B_TRUE___UW 0 0 0.000000 0.000000 /begin IF_DATA ASAP1B_ETK KP_BLOB 0x383B38 1 2 /end IF_DATA BIT_MASK 0x10 /end MEASUREMENT
/begin MEASUREMENT B_ftev3 "" UWORD B_TRUE___UW 0 0 0.000000 0.000000 /begin IF_DATA ASAP1B_ETK KP_BLOB 0x383B3A 1 2 /end IF_DATA BIT_MASK 0x10 /end MEASUREMENT
/begin MEASUREMENT B_ftev4 "" UWORD B_TRUE___UW 0 0 0.000000 0.000000 /begin IF_DATA ASAP1B_ETK KP_BLOB 0x383B3C 1 2 /end IF_DATA BIT_MASK 0x10 /end MEASUREMENT
/begin MEASUREMENT B_ftev5 "" UWORD B_TRUE___UW 0 0 0.000000 0.000000 /begin IF_DATA ASAP1B_ETK KP_BLOB 0x383B3E 1 2 /end IF_DATA BIT_MASK 0x10 /end MEASUREMENT
/begin MEASUREMENT B_ftev6 "" UWORD B_TRUE___UW 0 0 0.000000 0.000000 /begin IF_DATA ASAP1B_ETK KP_BLOB 0x383B40 1 2 /end IF_DATA BIT_MASK 0x10 /end MEASUREMENT
/begin MEASUREMENT B_ftev7 "" UWORD B_TRUE___UW 0 0 0.000000 0.000000 /begin IF_DATA ASAP1B_ETK KP_BLOB 0x383B42 1 2 /end IF_DATA BIT_MASK 0x10 /end MEASUREMENT
/begin MEASUREMENT B_ftev8 "" UWORD B_TRUE___UW 0 0 0.000000 0.000000 /begin IF_DATA ASAP1B_ETK KP_BLOB 0x383B44 1 2 /end IF_DATA BIT_MASK 0x10 /end MEASUREMENT
/begin MEASUREMENT B_ftfrao "" UWORD B_TRUE___UW 0 0 0.000000 0.000000 /begin IF_DATA ASAP1B_ETK KP_BLOB 0x383B4C 1 2 /end IF_DATA BIT_MASK 0x10 /end MEASUREMENT
/begin MEASUREMENT B_ftfrau "" UWORD B_TRUE___UW 0 0 0.000000 0.000000 /begin IF_DATA ASAP1B_ETK KP_BLOB 0x383B4E 1 2 /end IF_DATA BIT_MASK 0x10 /end MEASUREMENT
/begin MEASUREMENT B_ftfrst "Bedingung Fehlereintrag durch Tester fÅr FRST (FR-Kurztest)" UWORD B_TRUE___UW 0 0 0.000000 0.000000 /begin IF_DATA ASAP1B_ETK KP_BLOB 0x383B50 1 2 /end IF_DATA BIT_MASK 0x10 /end MEASUREMENT
/begin MEASUREMENT B_fthsh "" UWORD B_TRUE___UW 0 0 0.000000 0.000000 /begin IF_DATA ASAP1B_ETK KP_BLOB 0x383B56 1 2 /end IF_DATA BIT_MASK 0x10 /end MEASUREMENT
/begin MEASUREMENT B_fthshe "" UWORD B_TRUE___UW 0 0 0.000000 0.000000 /begin IF_DATA ASAP1B_ETK KP_BLOB 0x383B58 1 2 /end IF_DATA BIT_MASK 0x10 /end MEASUREMENT
/begin MEASUREMENT B_fthshe2 "" UWORD B_TRUE___UW 0 0 0.000000 0.000000 /begin IF_DATA ASAP1B_ETK KP_BLOB 0x383B5A 1 2 /end IF_DATA BIT_MASK 0x10 /end MEASUREMENT
/begin MEASUREMENT B_ftkat "" UWORD B_TRUE___UW 0 0 0.000000 0.000000 /begin IF_DATA ASAP1B_ETK KP_BLOB 0x383B60 1 2 /end IF_DATA BIT_MASK 0x10 /end MEASUREMENT
/begin MEASUREMENT B_ftkpe "" UWORD B_TRUE___UW 0 0 0.000000 0.000000 /begin IF_DATA ASAP1B_ETK KP_BLOB 0x383B62 1 2 /end IF_DATA BIT_MASK 0x10 /end MEASUREMENT
/begin MEASUREMENT B_ftkrnt "" UWORD B_TRUE___UW 0 0 0.000000 0.000000 /begin IF_DATA ASAP1B_ETK KP_BLOB 0x383B74 1 2 /end IF_DATA BIT_MASK 0x10 /end MEASUREMENT
/begin MEASUREMENT B_ftkrof "" UWORD B_TRUE___UW 0 0 0.000000 0.000000 /begin IF_DATA ASAP1B_ETK KP_BLOB 0x383B76 1 2 /end IF_DATA BIT_MASK 0x10 /end MEASUREMENT
/begin MEASUREMENT B_ftkrtp "" UWORD B_TRUE___UW 0 0 0.000000 0.000000 /begin IF_DATA ASAP1B_ETK KP_BLOB 0x383B78 1 2 /end IF_DATA BIT_MASK 0x10 /end MEASUREMENT
/begin MEASUREMENT B_ftks1 "" UWORD B_TRUE___UW 0 0 0.000000 0.000000 /begin IF_DATA ASAP1B_ETK KP_BLOB 0x383B7A 1 2 /end IF_DATA BIT_MASK 0x10 /end MEASUREMENT
/begin MEASUREMENT B_ftks2 "" UWORD B_TRUE___UW 0 0 0.000000 0.000000 /begin IF_DATA ASAP1B_ETK KP_BLOB 0x383B7C 1 2 /end IF_DATA BIT_MASK 0x10 /end MEASUREMENT
/begin MEASUREMENT B_ftks3 "" UWORD B_TRUE___UW 0 0 0.000000 0.000000 /begin IF_DATA ASAP1B_ETK KP_BLOB 0x383B7E 1 2 /end IF_DATA BIT_MASK 0x10 /end MEASUREMENT
/begin MEASUREMENT B_ftks4 "" UWORD B_TRUE___UW 0 0 0.000000 0.000000 /begin IF_DATA ASAP1B_ETK KP_BLOB 0x383B80 1 2 /end IF_DATA BIT_MASK 0x10 /end MEASUREMENT
/begin MEASUREMENT B_ftkuppl "" UWORD B_TRUE___UW 0 0 0.000000 0.000000 /begin IF_DATA ASAP1B_ETK KP_BLOB 0x383B82 1 2 /end IF_DATA BIT_MASK 0x10 /end MEASUREMENT
/begin MEASUREMENT B_ftlatp "" UWORD B_TRUE___UW 0 0 0.000000 0.000000 /begin IF_DATA ASAP1B_ETK KP_BLOB 0x383B88 1 2 /end IF_DATA BIT_MASK 0x10 /end MEASUREMENT
/begin MEASUREMENT B_ftlatp2 "" UWORD B_TRUE___UW 0 0 0.000000 0.000000 /begin IF_DATA ASAP1B_ETK KP_BLOB 0x383B8A 1 2 /end IF_DATA BIT_MASK 0x10 /end MEASUREMENT
/begin MEASUREMENT B_ftlatv "" UWORD B_TRUE___UW 0 0 0.000000 0.000000 /begin IF_DATA ASAP1B_ETK KP_BLOB 0x383B8C 1 2 /end IF_DATA BIT_MASK 0x10 /end MEASUREMENT
/begin MEASUREMENT B_ftlatv2 "" UWORD B_TRUE___UW 0 0 0.000000 0.000000 /begin IF_DATA ASAP1B_ETK KP_BLOB 0x383B8E 1 2 /end IF_DATA BIT_MASK 0x10 /end MEASUREMENT
/begin MEASUREMENT B_ftlde "" UWORD B_TRUE___UW 0 0 0.000000 0.000000 /begin IF_DATA ASAP1B_ETK KP_BLOB 0x383B90 1 2 /end IF_DATA BIT_MASK 0x10 /end MEASUREMENT
/begin MEASUREMENT B_ftldo "" UWORD B_TRUE___UW 0 0 0.000000 0.000000 /begin IF_DATA ASAP1B_ETK KP_BLOB 0x383B92 1 2 /end IF_DATA BIT_MASK 0x10 /end MEASUREMENT
/begin MEASUREMENT B_ftldp "" UWORD B_TRUE___UW 0 0 0.000000 0.000000 /begin IF_DATA ASAP1B_ETK KP_BLOB 0x383B94 1 2 /end IF_DATA BIT_MASK 0x10 /end MEASUREMENT
/begin MEASUREMENT B_ftldra "" UWORD B_TRUE___UW 0 0 0.000000 0.000000 /begin IF_DATA ASAP1B_ETK KP_BLOB 0x383B98 1 2 /end IF_DATA BIT_MASK 0x10 /end MEASUREMENT
/begin MEASUREMENT B_ftllr "" UWORD B_TRUE___UW 0 0 0.000000 0.000000 /begin IF_DATA ASAP1B_ETK KP_BLOB 0x383B9A 1 2 /end IF_DATA BIT_MASK 0x10 /end MEASUREMENT
/begin MEASUREMENT B_ftlm "Bedingung: Fehlereintrag durch Tester fÅr Luftmassensensor (HFM/DSS/DK)" UWORD B_TRUE___UW 0 0 0.000000 0.000000 /begin IF_DATA ASAP1B_ETK KP_BLOB 0x383B9C 1 2 /end IF_DATA BIT_MASK 0x10 /end MEASUREMENT
/begin MEASUREMENT B_ftlsh "Bedingung Fehlereintrag durch Tester Lambda Sonde hinter KAT" UWORD B_TRUE___UW 0 0 0.000000 0.000000 /begin IF_DATA ASAP1B_ETK KP_BLOB 0x383B9E 1 2 /end IF_DATA BIT_MASK 0x10 /end MEASUREMENT
/begin MEASUREMENT B_ftlsv "Bedingung Fehlereintrag durch Tester Lambda Sonde vor KAT" UWORD B_TRUE___UW 0 0 0.000000 0.000000 /begin IF_DATA ASAP1B_ETK KP_BLOB 0x383BA0 1 2 /end IF_DATA BIT_MASK 0x10 /end MEASUREMENT
/begin MEASUREMENT B_ftmile "" UWORD B_TRUE___UW 0 0 0.000000 0.000000 /begin IF_DATA ASAP1B_ETK KP_BLOB 0x383BB8 1 2 /end IF_DATA BIT_MASK 0x10 /end MEASUREMENT
/begin MEASUREMENT B_ftnwse "" UWORD B_TRUE___UW 0 0 0.000000 0.000000 /begin IF_DATA ASAP1B_ETK KP_BLOB 0x383BC4 1 2 /end IF_DATA BIT_MASK 0x10 /end MEASUREMENT
/begin MEASUREMENT B_ftrkat "" UWORD B_TRUE___UW 0 0 0.000000 0.000000 /begin IF_DATA ASAP1B_ETK KP_BLOB 0x383BCC 1 2 /end IF_DATA BIT_MASK 0x10 /end MEASUREMENT
/begin MEASUREMENT B_ftrkaz "" UWORD B_TRUE___UW 0 0 0.000000 0.000000 /begin IF_DATA ASAP1B_ETK KP_BLOB 0x383BCE 1 2 /end IF_DATA BIT_MASK 0x10 /end MEASUREMENT
/begin MEASUREMENT B_ftslpe "" UWORD B_TRUE___UW 0 0 0.000000 0.000000 /begin IF_DATA ASAP1B_ETK KP_BLOB 0x383BD2 1 2 /end IF_DATA BIT_MASK 0x10 /end MEASUREMENT
/begin MEASUREMENT B_ftslve "" UWORD B_TRUE___UW 0 0 0.000000 0.000000 /begin IF_DATA ASAP1B_ETK KP_BLOB 0x383BD8 1 2 /end IF_DATA BIT_MASK 0x10 /end MEASUREMENT
/begin MEASUREMENT B_ftsue "" UWORD B_TRUE___UW 0 0 0.000000 0.000000 /begin IF_DATA ASAP1B_ETK KP_BLOB 0x383BDC 1 2 /end IF_DATA BIT_MASK 0x10 /end MEASUREMENT
/begin MEASUREMENT B_fttesf "" UWORD B_TRUE___UW 0 0 0.000000 0.000000 /begin IF_DATA ASAP1B_ETK KP_BLOB 0x383BE6 1 2 /end IF_DATA BIT_MASK 0x10 /end MEASUREMENT
/begin MEASUREMENT B_fttesg "" UWORD B_TRUE___UW 0 0 0.000000 0.000000 /begin IF_DATA ASAP1B_ETK KP_BLOB 0x383BE8 1 2 /end IF_DATA BIT_MASK 0x10 /end MEASUREMENT
/begin MEASUREMENT B_ftteve "" UWORD B_TRUE___UW 0 0 0.000000 0.000000 /begin IF_DATA ASAP1B_ETK KP_BLOB 0x383BEA 1 2 /end IF_DATA BIT_MASK 0x10 /end MEASUREMENT
/begin MEASUREMENT B_ftuvse "" UWORD B_TRUE___UW 0 0 0.000000 0.000000 /begin IF_DATA ASAP1B_ETK KP_BLOB 0x383C02 1 2 /end IF_DATA BIT_MASK 0x10 /end MEASUREMENT
/begin MEASUREMENT B_ftzet1 "" UWORD B_TRUE___UW 0 0 0.000000 0.000000 /begin IF_DATA ASAP1B_ETK KP_BLOB 0x383C0A 1 2 /end IF_DATA BIT_MASK 0x10 /end MEASUREMENT
/begin MEASUREMENT B_ftzet2 "" UWORD B_TRUE___UW 0 0 0.000000 0.000000 /begin IF_DATA ASAP1B_ETK KP_BLOB 0x383C0C 1 2 /end IF_DATA BIT_MASK 0x10 /end MEASUREMENT
/begin MEASUREMENT B_ftzet3 "" UWORD B_TRUE___UW 0 0 0.000000 0.000000 /begin IF_DATA ASAP1B_ETK KP_BLOB 0x383C0E 1 2 /end IF_DATA BIT_MASK 0x10 /end MEASUREMENT
/begin MEASUREMENT B_ftzet4 "" UWORD B_TRUE___UW 0 0 0.000000 0.000000 /begin IF_DATA ASAP1B_ETK KP_BLOB 0x383C10 1 2 /end IF_DATA BIT_MASK 0x10 /end MEASUREMENT
/begin MEASUREMENT B_ftzet5 "" UWORD B_TRUE___UW 0 0 0.000000 0.000000 /begin IF_DATA ASAP1B_ETK KP_BLOB 0x383C12 1 2 /end IF_DATA BIT_MASK 0x10 /end MEASUREMENT
/begin MEASUREMENT B_ftzet6 "" UWORD B_TRUE___UW 0 0 0.000000 0.000000 /begin IF_DATA ASAP1B_ETK KP_BLOB 0x383C14 1 2 /end IF_DATA BIT_MASK 0x10 /end MEASUREMENT
/begin MEASUREMENT B_ftzet7 "" UWORD B_TRUE___UW 0 0 0.000000 0.000000 /begin IF_DATA ASAP1B_ETK KP_BLOB 0x383C16 1 2 /end IF_DATA BIT_MASK 0x10 /end MEASUREMENT
/begin MEASUREMENT B_ftzet8 "" UWORD B_TRUE___UW 0 0 0.000000 0.000000 /begin IF_DATA ASAP1B_ETK KP_BLOB 0x383C18 1 2 /end IF_DATA BIT_MASK 0x10 /end MEASUREMENT
/begin MEASUREMENT B_mnaave "Fehlerart: Kurzschlu· Masse Absperrventil Aktivkohlefilter (Endstufe)" UWORD B_TRUE___UW 0 0 0.000000 0.000000 /begin IF_DATA ASAP1B_ETK KP_BLOB 0x383AF0 1 2 /end IF_DATA BIT_MASK 0x200 /end MEASUREMENT
/begin MEASUREMENT B_mnagre "Fehlertype: Kurzschlu· nach Masse Endstufe AGR-Ventil" UWORD B_TRUE___UW 0 0 0.000000 0.000000 /begin IF_DATA ASAP1B_ETK KP_BLOB 0x383AF2 1 2 /end IF_DATA BIT_MASK 0x200 /end MEASUREMENT
/begin MEASUREMENT B_mnepcle "Fehlerart: Kurzschlu· Masse an EPCL-Endstufe" UWORD B_TRUE___UW 0 0 0.000000 0.000000 /begin IF_DATA ASAP1B_ETK KP_BLOB 0x383B32 1 2 /end IF_DATA BIT_MASK 0x200 /end MEASUREMENT
/begin MEASUREMENT B_mnetse "Fehlerart min.: elektrisches Thermostat Endstufe" UWORD B_TRUE___UW 0 0 0.000000 0.000000 /begin IF_DATA ASAP1B_ETK KP_BLOB 0x383B34 1 2 /end IF_DATA BIT_MASK 0x200 /end MEASUREMENT
/begin MEASUREMENT B_mnev1 "Fehlerart: Kurzschlu· Masse an Endstufe EV1" UWORD B_TRUE___UW 0 0 0.000000 0.000000 /begin IF_DATA ASAP1B_ETK KP_BLOB 0x383B36 1 2 /end IF_DATA BIT_MASK 0x200 /end MEASUREMENT
/begin MEASUREMENT B_mnev2 "Fehlerart: Kurzschlu· Masse an Endstufe EV2" UWORD B_TRUE___UW 0 0 0.000000 0.000000 /begin IF_DATA ASAP1B_ETK KP_BLOB 0x383B38 1 2 /end IF_DATA BIT_MASK 0x200 /end MEASUREMENT
/begin MEASUREMENT B_mnev3 "Fehlerart: Kurzschlu· Masse an Endstufe EV3" UWORD B_TRUE___UW 0 0 0.000000 0.000000 /begin IF_DATA ASAP1B_ETK KP_BLOB 0x383B3A 1 2 /end IF_DATA BIT_MASK 0x200 /end MEASUREMENT
/begin MEASUREMENT B_mnev4 "Fehlerart: Kurzschlu· Masse an Endstufe EV4" UWORD B_TRUE___UW 0 0 0.000000 0.000000 /begin IF_DATA ASAP1B_ETK KP_BLOB 0x383B3C 1 2 /end IF_DATA BIT_MASK 0x200 /end MEASUREMENT
/begin MEASUREMENT B_mnev5 "Fehlerart: Kurzschlu· Masse an Endstufe EV5" UWORD B_TRUE___UW 0 0 0.000000 0.000000 /begin IF_DATA ASAP1B_ETK KP_BLOB 0x383B3E 1 2 /end IF_DATA BIT_MASK 0x200 /end MEASUREMENT
/begin MEASUREMENT B_mnev6 "Fehlerart: Kurzschlu· Masse an Endstufe EV6" UWORD B_TRUE___UW 0 0 0.000000 0.000000 /begin IF_DATA ASAP1B_ETK KP_BLOB 0x383B40 1 2 /end IF_DATA BIT_MASK 0x200 /end MEASUREMENT
/begin MEASUREMENT B_mnev7 "Fehlerart: Kurzschlu· Masse an Endstufe EV7" UWORD B_TRUE___UW 0 0 0.000000 0.000000 /begin IF_DATA ASAP1B_ETK KP_BLOB 0x383B42 1 2 /end IF_DATA BIT_MASK 0x200 /end MEASUREMENT
/begin MEASUREMENT B_mnev8 "Fehlerart: Kurzschlu· Masse an Endstufe EV8" UWORD B_TRUE___UW 0 0 0.000000 0.000000 /begin IF_DATA ASAP1B_ETK KP_BLOB 0x383B44 1 2 /end IF_DATA BIT_MASK 0x200 /end MEASUREMENT
/begin MEASUREMENT B_mnfrao "Bedingung untere PlausibilitÑtsschwelle unterschritten (obere Multipl.)" UWORD B_TRUE___UW 0 0 0.000000 0.000000 /begin IF_DATA ASAP1B_ETK KP_BLOB 0x383B4C 1 2 /end IF_DATA BIT_MASK 0x200 /end MEASUREMENT
/begin MEASUREMENT B_mnfrau "Bedingung untere PlausibilitÑtsschwelle unterschritten (untere Multipl.)" UWORD B_TRUE___UW 0 0 0.000000 0.000000 /begin IF_DATA ASAP1B_ETK KP_BLOB 0x383B4E 1 2 /end IF_DATA BIT_MASK 0x200 /end MEASUREMENT
/begin MEASUREMENT B_mnfrst "Bedingung untere PlausibilitÑtsschwelle unterschritten(short test)" UWORD B_TRUE___UW 0 0 0.000000 0.000000 /begin IF_DATA ASAP1B_ETK KP_BLOB 0x383B50 1 2 /end IF_DATA BIT_MASK 0x200 /end MEASUREMENT
/begin MEASUREMENT B_mnhsh "Kurzschlu· Heizung Lambdasonde hinter Kat nach Masse" UWORD B_TRUE___UW 0 0 0.000000 0.000000 /begin IF_DATA ASAP1B_ETK KP_BLOB 0x383B56 1 2 /end IF_DATA BIT_MASK 0x200 /end MEASUREMENT
/begin MEASUREMENT B_mnhshe "Kurzschlu· Heizung Lambdasonde hinter Kat nach Masse" UWORD B_TRUE___UW 0 0 0.000000 0.000000 /begin IF_DATA ASAP1B_ETK KP_BLOB 0x383B58 1 2 /end IF_DATA BIT_MASK 0x200 /end MEASUREMENT
/begin MEASUREMENT B_mnhshe2 "Kurzschlu· Heizung Lambdasonde2 hinter Kat nach Masse" UWORD B_TRUE___UW 0 0 0.000000 0.000000 /begin IF_DATA ASAP1B_ETK KP_BLOB 0x383B5A 1 2 /end IF_DATA BIT_MASK 0x200 /end MEASUREMENT
/begin MEASUREMENT B_mnhsv "Kurzschlu· Heizung Lambdasonde vor Kat nach Masse" UWORD B_TRUE___UW 0 0 0.000000 0.000000 /begin IF_DATA ASAP1B_ETK KP_BLOB 0x383B5C 1 2 /end IF_DATA BIT_MASK 0x200 /end MEASUREMENT
/begin MEASUREMENT B_mnhsv2 "Kurzschlu· Heizung Lambdasonde2 vor Kat nach Masse" UWORD B_TRUE___UW 0 0 0.000000 0.000000 /begin IF_DATA ASAP1B_ETK KP_BLOB 0x383B5E 1 2 /end IF_DATA BIT_MASK 0x200 /end MEASUREMENT
/begin MEASUREMENT B_mnkat "Fehlertyp 'Minimalwert' erkannt (Katalysator defekt)" UWORD B_TRUE___UW 0 0 0.000000 0.000000 /begin IF_DATA ASAP1B_ETK KP_BLOB 0x383B60 1 2 /end IF_DATA BIT_MASK 0x200 /end MEASUREMENT
/begin MEASUREMENT B_mnkpe "Bedingung fÅr Fehlertyp 'Minimalwert' fÅr EKP-Relais Endstufe erkannt" UWORD B_TRUE___UW 0 0 0.000000 0.000000 /begin IF_DATA ASAP1B_ETK KP_BLOB 0x383B62 1 2 /end IF_DATA BIT_MASK 0x200 /end MEASUREMENT
/begin MEASUREMENT B_mnkrnt "Fehlertyp min.: Klopfregelung Nulltest" UWORD B_TRUE___UW 0 0 0.000000 0.000000 /begin IF_DATA ASAP1B_ETK KP_BLOB 0x383B74 1 2 /end IF_DATA BIT_MASK 0x200 /end MEASUREMENT
/begin MEASUREMENT B_mnkrof "Fehlertyp min.: Klopfregelung Offset" UWORD B_TRUE___UW 0 0 0.000000 0.000000 /begin IF_DATA ASAP1B_ETK KP_BLOB 0x383B76 1 2 /end IF_DATA BIT_MASK 0x200 /end MEASUREMENT
/begin MEASUREMENT B_mnkrtp "Fehlertyp min.: Klopfregelung Testimpuls" UWORD B_TRUE___UW 0 0 0.000000 0.000000 /begin IF_DATA ASAP1B_ETK KP_BLOB 0x383B78 1 2 /end IF_DATA BIT_MASK 0x200 /end MEASUREMENT
/begin MEASUREMENT B_mnks1 "Bedingung: Min-Fehler Klopfsensor 1" UWORD B_TRUE___UW 0 0 0.000000 0.000000 /begin IF_DATA ASAP1B_ETK KP_BLOB 0x383B7A 1 2 /end IF_DATA BIT_MASK 0x200 /end MEASUREMENT
/begin MEASUREMENT B_mnks2 "Bedingung: Min-Fehler Klopfsensor 2" UWORD B_TRUE___UW 0 0 0.000000 0.000000 /begin IF_DATA ASAP1B_ETK KP_BLOB 0x383B7C 1 2 /end IF_DATA BIT_MASK 0x200 /end MEASUREMENT
/begin MEASUREMENT B_mnks3 "Bedingung: Min-Fehler Klopfsensor 3" UWORD B_TRUE___UW 0 0 0.000000 0.000000 /begin IF_DATA ASAP1B_ETK KP_BLOB 0x383B7E 1 2 /end IF_DATA BIT_MASK 0x200 /end MEASUREMENT
/begin MEASUREMENT B_mnks4 "Bedingung: Min-fehler Klopfsensor 4" UWORD B_TRUE___UW 0 0 0.000000 0.000000 /begin IF_DATA ASAP1B_ETK KP_BLOB 0x383B80 1 2 /end IF_DATA BIT_MASK 0x200 /end MEASUREMENT
/begin MEASUREMENT B_mnkuppl "Fehlertyp KUPPL: Minimalwert unterschritten" UWORD B_TRUE___UW 0 0 0.000000 0.000000 /begin IF_DATA ASAP1B_ETK KP_BLOB 0x383B82 1 2 /end IF_DATA BIT_MASK 0x200 /end MEASUREMENT
/begin MEASUREMENT B_mnlash "Fehlertyp 'Minimalwert' fÅr SchwingungsprÅfung hinter KAT erkannt" UWORD B_TRUE___UW 0 0 0.000000 0.000000 /begin IF_DATA ASAP1B_ETK KP_BLOB 0x383B84 1 2 /end IF_DATA BIT_MASK 0x200 /end MEASUREMENT
/begin MEASUREMENT B_mnlash2 "Fehlertyp 'Minimalwert' fÅr SchwingungsprÅfung hinter KAT erkannt Bank2" UWORD B_TRUE___UW 0 0 0.000000 0.000000 /begin IF_DATA ASAP1B_ETK KP_BLOB 0x383B86 1 2 /end IF_DATA BIT_MASK 0x200 /end MEASUREMENT
/begin MEASUREMENT B_mnlatp "Fehlertyp 'Minimalwert' fÅr Perioden-Dauer vor KAT erkannt" UWORD B_TRUE___UW 0 0 0.000000 0.000000 /begin IF_DATA ASAP1B_ETK KP_BLOB 0x383B88 1 2 /end IF_DATA BIT_MASK 0x200 /end MEASUREMENT
/begin MEASUREMENT B_mnlatp2 "Fehlertyp 'Minimalwert' fÅr Perioden-Dauer vor KAT erkannt Bank2" UWORD B_TRUE___UW 0 0 0.000000 0.000000 /begin IF_DATA ASAP1B_ETK KP_BLOB 0x383B8A 1 2 /end IF_DATA BIT_MASK 0x200 /end MEASUREMENT
/begin MEASUREMENT B_mnlatv "Fehlertyp 'Minimalwert' fÅr ATV-PrÅfung vor KAT erkannt" UWORD B_TRUE___UW 0 0 0.000000 0.000000 /begin IF_DATA ASAP1B_ETK KP_BLOB 0x383B8C 1 2 /end IF_DATA BIT_MASK 0x200 /end MEASUREMENT
/begin MEASUREMENT B_mnlatv2 "Fehlertyp 'Minimalwert' fÅr ATV-PrÅfung vor KAT erkannt Bank2" UWORD B_TRUE___UW 0 0 0.000000 0.000000 /begin IF_DATA ASAP1B_ETK KP_BLOB 0x383B8E 1 2 /end IF_DATA BIT_MASK 0x200 /end MEASUREMENT
/begin MEASUREMENT B_mnlde "Fehlertyp: Kurzschlu· Masse LDR-Taktventil" UWORD B_TRUE___UW 0 0 0.000000 0.000000 /begin IF_DATA ASAP1B_ETK KP_BLOB 0x383B90 1 2 /end IF_DATA BIT_MASK 0x200 /end MEASUREMENT
/begin MEASUREMENT B_mnldo "" UWORD B_TRUE___UW 0 0 0.000000 0.000000 /begin IF_DATA ASAP1B_ETK KP_BLOB 0x383B92 1 2 /end IF_DATA BIT_MASK 0x200 /end MEASUREMENT
/begin MEASUREMENT B_mnldp "Fehlertyp 'Minimalwert' erkannt (Reed-Switch îffnet nicht)" UWORD B_TRUE___UW 0 0 0.000000 0.000000 /begin IF_DATA ASAP1B_ETK KP_BLOB 0x383B94 1 2 /end IF_DATA BIT_MASK 0x200 /end MEASUREMENT
/begin MEASUREMENT B_mnldra "Bedingung MIN-Fehler Fehlerpfad ldra" UWORD B_TRUE___UW 0 0 0.000000 0.000000 /begin IF_DATA ASAP1B_ETK KP_BLOB 0x383B98 1 2 /end IF_DATA BIT_MASK 0x200 /end MEASUREMENT
/begin MEASUREMENT B_mnllr "Fehler 'Leerlaufdrehzahl zu klein'" UWORD B_TRUE___UW 0 0 0.000000 0.000000 /begin IF_DATA ASAP1B_ETK KP_BLOB 0x383B9A 1 2 /end IF_DATA BIT_MASK 0x200 /end MEASUREMENT
/begin MEASUREMENT B_mnlm "Bedingung: min-Fehler HauptfÅllungssensor" UWORD B_TRUE___UW 0 0 0.000000 0.000000 /begin IF_DATA ASAP1B_ETK KP_BLOB 0x383B9C 1 2 /end IF_DATA BIT_MASK 0x200 /end MEASUREMENT
/begin MEASUREMENT B_mnlsh "Fehlertyp 'Minimalwert' hinter KAT erkannt" UWORD B_TRUE___UW 0 0 0.000000 0.000000 /begin IF_DATA ASAP1B_ETK KP_BLOB 0x383B9E 1 2 /end IF_DATA BIT_MASK 0x200 /end MEASUREMENT
/begin MEASUREMENT B_mnlsv "Fehlertyp 'Minimalwert' vor KAT erkannt" UWORD B_TRUE___UW 0 0 0.000000 0.000000 /begin IF_DATA ASAP1B_ETK KP_BLOB 0x383BA0 1 2 /end IF_DATA BIT_MASK 0x200 /end MEASUREMENT
/begin MEASUREMENT B_mnmile "Fehlerart: Kurzschlu· Masse an MIL-Endstufe" UWORD B_TRUE___UW 0 0 0.000000 0.000000 /begin IF_DATA ASAP1B_ETK KP_BLOB 0x383BB8 1 2 /end IF_DATA BIT_MASK 0x200 /end MEASUREMENT
/begin MEASUREMENT B_mnnwse "Fehlerart: Kurzschlu· Masse Nockenwellensteuerungsventil Endstufe" UWORD B_TRUE___UW 0 0 0.000000 0.000000 /begin IF_DATA ASAP1B_ETK KP_BLOB 0x383BC4 1 2 /end IF_DATA BIT_MASK 0x200 /end MEASUREMENT
/begin MEASUREMENT B_mnrkat "Bedingung untere PlausibilitÑtsschwelle unterschritten (add. pro Zeit)" UWORD B_TRUE___UW 0 0 0.000000 0.000000 /begin IF_DATA ASAP1B_ETK KP_BLOB 0x383BCC 1 2 /end IF_DATA BIT_MASK 0x200 /end MEASUREMENT
/begin MEASUREMENT B_mnrkaz "Bedingung untere PlausibilitÑtsschwelle unterschritten (add. pro ZÅndung)" UWORD B_TRUE___UW 0 0 0.000000 0.000000 /begin IF_DATA ASAP1B_ETK KP_BLOB 0x383BCE 1 2 /end IF_DATA BIT_MASK 0x200 /end MEASUREMENT
/begin MEASUREMENT B_mnslpe "Fehlertype: Kurzschlu· nach Masse Endstufe SekundÑrluftpumpe" UWORD B_TRUE___UW 0 0 0.000000 0.000000 /begin IF_DATA ASAP1B_ETK KP_BLOB 0x383BD2 1 2 /end IF_DATA BIT_MASK 0x200 /end MEASUREMENT
/begin MEASUREMENT B_mnslve "Fehlertype: Kurzschlu· nach Masse Endstufe SekundÑrluftventil" UWORD B_TRUE___UW 0 0 0.000000 0.000000 /begin IF_DATA ASAP1B_ETK KP_BLOB 0x383BD8 1 2 /end IF_DATA BIT_MASK 0x200 /end MEASUREMENT
/begin MEASUREMENT B_mnsue "Fehlerart: Kurzschlu· Masse an Endstufe fÅr Saugrohrumschaltung" UWORD B_TRUE___UW 0 0 0.000000 0.000000 /begin IF_DATA ASAP1B_ETK KP_BLOB 0x383BDC 1 2 /end IF_DATA BIT_MASK 0x200 /end MEASUREMENT
/begin MEASUREMENT B_mntesf "Fehlertyp 'Minimalwert' erkannt (Feinleck)" UWORD B_TRUE___UW 0 0 0.000000 0.000000 /begin IF_DATA ASAP1B_ETK KP_BLOB 0x383BE6 1 2 /end IF_DATA BIT_MASK 0x200 /end MEASUREMENT
/begin MEASUREMENT B_mntesg "Fehlertyp 'Minimalwert' erkannt (Grobleck)" UWORD B_TRUE___UW 0 0 0.000000 0.000000 /begin IF_DATA ASAP1B_ETK KP_BLOB 0x383BE8 1 2 /end IF_DATA BIT_MASK 0x200 /end MEASUREMENT
/begin MEASUREMENT B_mnteve "Fehlertyp: Kurzschlu· Masse TankentlÅftungsventil Endstufe" UWORD B_TRUE___UW 0 0 0.000000 0.000000 /begin IF_DATA ASAP1B_ETK KP_BLOB 0x383BEA 1 2 /end IF_DATA BIT_MASK 0x200 /end MEASUREMENT
/begin MEASUREMENT B_mnuvse "Fehlertyp: Kurzschlu· Masse Umluftventil Turbo" UWORD B_TRUE___UW 0 0 0.000000 0.000000 /begin IF_DATA ASAP1B_ETK KP_BLOB 0x383C02 1 2 /end IF_DATA BIT_MASK 0x200 /end MEASUREMENT
/begin MEASUREMENT B_mnzet1 "" UWORD B_TRUE___UW 0 0 0.000000 0.000000 /begin IF_DATA ASAP1B_ETK KP_BLOB 0x383C0A 1 2 /end IF_DATA BIT_MASK 0x200 /end MEASUREMENT
/begin MEASUREMENT B_mnzet2 "" UWORD B_TRUE___UW 0 0 0.000000 0.000000 /begin IF_DATA ASAP1B_ETK KP_BLOB 0x383C0C 1 2 /end IF_DATA BIT_MASK 0x200 /end MEASUREMENT
/begin MEASUREMENT B_mnzet3 "" UWORD B_TRUE___UW 0 0 0.000000 0.000000 /begin IF_DATA ASAP1B_ETK KP_BLOB 0x383C0E 1 2 /end IF_DATA BIT_MASK 0x200 /end MEASUREMENT
/begin MEASUREMENT B_mnzet4 "" UWORD B_TRUE___UW 0 0 0.000000 0.000000 /begin IF_DATA ASAP1B_ETK KP_BLOB 0x383C10 1 2 /end IF_DATA BIT_MASK 0x200 /end MEASUREMENT
/begin MEASUREMENT B_mnzet5 "" UWORD B_TRUE___UW 0 0 0.000000 0.000000 /begin IF_DATA ASAP1B_ETK KP_BLOB 0x383C12 1 2 /end IF_DATA BIT_MASK 0x200 /end MEASUREMENT
/begin MEASUREMENT B_mnzet6 "" UWORD B_TRUE___UW 0 0 0.000000 0.000000 /begin IF_DATA ASAP1B_ETK KP_BLOB 0x383C14 1 2 /end IF_DATA BIT_MASK 0x200 /end MEASUREMENT
/begin MEASUREMENT B_mnzet7 "" UWORD B_TRUE___UW 0 0 0.000000 0.000000 /begin IF_DATA ASAP1B_ETK KP_BLOB 0x383C16 1 2 /end IF_DATA BIT_MASK 0x200 /end MEASUREMENT
/begin MEASUREMENT B_mnzet8 "" UWORD B_TRUE___UW 0 0 0.000000 0.000000 /begin IF_DATA ASAP1B_ETK KP_BLOB 0x383C18 1 2 /end IF_DATA BIT_MASK 0x200 /end MEASUREMENT
/begin MEASUREMENT B_mxaave "Fehlerart: Kurzschlu· Ubat Absperrventil Aktivkohlefilter (Endstufe)" UWORD B_TRUE___UW 0 0 0.000000 0.000000 /begin IF_DATA ASAP1B_ETK KP_BLOB 0x383AF0 1 2 /end IF_DATA BIT_MASK 0x100 /end MEASUREMENT
/begin MEASUREMENT B_mxagre "Fehlertype: Kurzschlu· nach Ubat Endstufe AGR-Ventil" UWORD B_TRUE___UW 0 0 0.000000 0.000000 /begin IF_DATA ASAP1B_ETK KP_BLOB 0x383AF2 1 2 /end IF_DATA BIT_MASK 0x100 /end MEASUREMENT
/begin MEASUREMENT B_mxepcle "Fehlerart: Kurzschlu· Ubat an EPCL-Endstufe" UWORD B_TRUE___UW 0 0 0.000000 0.000000 /begin IF_DATA ASAP1B_ETK KP_BLOB 0x383B32 1 2 /end IF_DATA BIT_MASK 0x100 /end MEASUREMENT
/begin MEASUREMENT B_mxetse "Fehlertyp max.: elektrisches Thermostat Endstufe" UWORD B_TRUE___UW 0 0 0.000000 0.000000 /begin IF_DATA ASAP1B_ETK KP_BLOB 0x383B34 1 2 /end IF_DATA BIT_MASK 0x100 /end MEASUREMENT
/begin MEASUREMENT B_mxev1 "Fehlerart: Kurzschlu· UBat an Endstufe EV1" UWORD B_TRUE___UW 0 0 0.000000 0.000000 /begin IF_DATA ASAP1B_ETK KP_BLOB 0x383B36 1 2 /end IF_DATA BIT_MASK 0x100 /end MEASUREMENT
/begin MEASUREMENT B_mxev2 "Fehlerart: Kurzschlu· UBat an Endstufe EV2" UWORD B_TRUE___UW 0 0 0.000000 0.000000 /begin IF_DATA ASAP1B_ETK KP_BLOB 0x383B38 1 2 /end IF_DATA BIT_MASK 0x100 /end MEASUREMENT
/begin MEASUREMENT B_mxev3 "Fehlerart: Kurzschlu· UBat an Endstufe EV3" UWORD B_TRUE___UW 0 0 0.000000 0.000000 /begin IF_DATA ASAP1B_ETK KP_BLOB 0x383B3A 1 2 /end IF_DATA BIT_MASK 0x100 /end MEASUREMENT
/begin MEASUREMENT B_mxev4 "Fehlerart: Kurzschlu· UBat an Endstufe EV4" UWORD B_TRUE___UW 0 0 0.000000 0.000000 /begin IF_DATA ASAP1B_ETK KP_BLOB 0x383B3C 1 2 /end IF_DATA BIT_MASK 0x100 /end MEASUREMENT
/begin MEASUREMENT B_mxev5 "Fehlerart: Kurzschlu· UBat an Endstufe EV5" UWORD B_TRUE___UW 0 0 0.000000 0.000000 /begin IF_DATA ASAP1B_ETK KP_BLOB 0x383B3E 1 2 /end IF_DATA BIT_MASK 0x100 /end MEASUREMENT
/begin MEASUREMENT B_mxev6 "Fehlerart: Kurzschlu· UBat an Endstufe EV6" UWORD B_TRUE___UW 0 0 0.000000 0.000000 /begin IF_DATA ASAP1B_ETK KP_BLOB 0x383B40 1 2 /end IF_DATA BIT_MASK 0x100 /end MEASUREMENT
/begin MEASUREMENT B_mxev7 "Fehlerart: Kurzschlu· UBat an Endstufe EV7" UWORD B_TRUE___UW 0 0 0.000000 0.000000 /begin IF_DATA ASAP1B_ETK KP_BLOB 0x383B42 1 2 /end IF_DATA BIT_MASK 0x100 /end MEASUREMENT
/begin MEASUREMENT B_mxev8 "Fehlerart: Kurzschlu· UBat an Endstufe EV8" UWORD B_TRUE___UW 0 0 0.000000 0.000000 /begin IF_DATA ASAP1B_ETK KP_BLOB 0x383B44 1 2 /end IF_DATA BIT_MASK 0x100 /end MEASUREMENT
/begin MEASUREMENT B_mxfrao "Bedingung obere PlausibilitÑtsschwelle Åberschritten (obere Multipl.)" UWORD B_TRUE___UW 0 0 0.000000 0.000000 /begin IF_DATA ASAP1B_ETK KP_BLOB 0x383B4C 1 2 /end IF_DATA BIT_MASK 0x100 /end MEASUREMENT
/begin MEASUREMENT B_mxfrau "Bedingung obere PlausiblitÑtsschwelle Åberschritten (untere Multipl.)" UWORD B_TRUE___UW 0 0 0.000000 0.000000 /begin IF_DATA ASAP1B_ETK KP_BLOB 0x383B4E 1 2 /end IF_DATA BIT_MASK 0x100 /end MEASUREMENT
/begin MEASUREMENT B_mxfrst "Bedingung obere PlausiblitÑtsschwelle Åberschritten (short test" UWORD B_TRUE___UW 0 0 0.000000 0.000000 /begin IF_DATA ASAP1B_ETK KP_BLOB 0x383B50 1 2 /end IF_DATA BIT_MASK 0x100 /end MEASUREMENT
/begin MEASUREMENT B_mxhsh "Kurzschlu· Heizung Lambdasonde hinter Kat nach UB" UWORD B_TRUE___UW 0 0 0.000000 0.000000 /begin IF_DATA ASAP1B_ETK KP_BLOB 0x383B56 1 2 /end IF_DATA BIT_MASK 0x100 /end MEASUREMENT
/begin MEASUREMENT B_mxhshe "Kurzschlu· Heizung Lambdasonde hinter Kat nach UB" UWORD B_TRUE___UW 0 0 0.000000 0.000000 /begin IF_DATA ASAP1B_ETK KP_BLOB 0x383B58 1 2 /end IF_DATA BIT_MASK 0x100 /end MEASUREMENT
/begin MEASUREMENT B_mxhshe2 "Kurzschlu· Heizung Lambdasonde2 hinter Kat nach UB" UWORD B_TRUE___UW 0 0 0.000000 0.000000 /begin IF_DATA ASAP1B_ETK KP_BLOB 0x383B5A 1 2 /end IF_DATA BIT_MASK 0x100 /end MEASUREMENT
/begin MEASUREMENT B_mxhsv "Kurzschlu· Heizung Lambdasonde vor Kat nach UB" UWORD B_TRUE___UW 0 0 0.000000 0.000000 /begin IF_DATA ASAP1B_ETK KP_BLOB 0x383B5C 1 2 /end IF_DATA BIT_MASK 0x100 /end MEASUREMENT
/begin MEASUREMENT B_mxhsv2 "Kurzschlu· Heizung Lambdasonde2 vor Kat nach UB" UWORD B_TRUE___UW 0 0 0.000000 0.000000 /begin IF_DATA ASAP1B_ETK KP_BLOB 0x383B5E 1 2 /end IF_DATA BIT_MASK 0x100 /end MEASUREMENT
/begin MEASUREMENT B_mxkat "Bedingung obere PlausibilitÑtsschwelle Åberschritten" UWORD B_TRUE___UW 0 0 0.000000 0.000000 /begin IF_DATA ASAP1B_ETK KP_BLOB 0x383B60 1 2 /end IF_DATA BIT_MASK 0x100 /end MEASUREMENT
/begin MEASUREMENT B_mxkpe "Bedingung fÅr Fehlertyp 'Maximalwert' fÅr EKP-Relais Endstufe erkannt" UWORD B_TRUE___UW 0 0 0.000000 0.000000 /begin IF_DATA ASAP1B_ETK KP_BLOB 0x383B62 1 2 /end IF_DATA BIT_MASK 0x100 /end MEASUREMENT
/begin MEASUREMENT B_mxkra01 "Fehlertyp max.: Klopfregelanschlag Zylinder 1" UWORD B_TRUE___UW 0 0 0.000000 0.000000 /begin IF_DATA ASAP1B_ETK KP_BLOB 0x383B64 1 2 /end IF_DATA BIT_MASK 0x100 /end MEASUREMENT
/begin MEASUREMENT B_mxkra02 "Fehlertyp max.: Klopfregelanschlag Zylinder 2" UWORD B_TRUE___UW 0 0 0.000000 0.000000 /begin IF_DATA ASAP1B_ETK KP_BLOB 0x383B66 1 2 /end IF_DATA BIT_MASK 0x100 /end MEASUREMENT
/begin MEASUREMENT B_mxkra03 "Fehlertyp max.: Klopfregelanschlag Zylinder 3" UWORD B_TRUE___UW 0 0 0.000000 0.000000 /begin IF_DATA ASAP1B_ETK KP_BLOB 0x383B68 1 2 /end IF_DATA BIT_MASK 0x100 /end MEASUREMENT
/begin MEASUREMENT B_mxkra04 "Fehlertyp max.: Klopfregelanschlag Zylinder 4" UWORD B_TRUE___UW 0 0 0.000000 0.000000 /begin IF_DATA ASAP1B_ETK KP_BLOB 0x383B6A 1 2 /end IF_DATA BIT_MASK 0x100 /end MEASUREMENT
/begin MEASUREMENT B_mxkra05 "Fehlertyp max.: Klopfregelanschlag Zylinder 5" UWORD B_TRUE___UW 0 0 0.000000 0.000000 /begin IF_DATA ASAP1B_ETK KP_BLOB 0x383B6C 1 2 /end IF_DATA BIT_MASK 0x100 /end MEASUREMENT
/begin MEASUREMENT B_mxkra06 "Fehlertyp max.: Klopfregelanschlag Zylinder 6" UWORD B_TRUE___UW 0 0 0.000000 0.000000 /begin IF_DATA ASAP1B_ETK KP_BLOB 0x383B6E 1 2 /end IF_DATA BIT_MASK 0x100 /end MEASUREMENT
/begin MEASUREMENT B_mxkra07 "Fehlertyp max.: Klopfregelanschlag Zylinder 7" UWORD B_TRUE___UW 0 0 0.000000 0.000000 /begin IF_DATA ASAP1B_ETK KP_BLOB 0x383B70 1 2 /end IF_DATA BIT_MASK 0x100 /end MEASUREMENT
/begin MEASUREMENT B_mxkra08 "Fehlertyp max.: Klopfregelanschlag Zylinder 8" UWORD B_TRUE___UW 0 0 0.000000 0.000000 /begin IF_DATA ASAP1B_ETK KP_BLOB 0x383B72 1 2 /end IF_DATA BIT_MASK 0x100 /end MEASUREMENT
/begin MEASUREMENT B_mxkrnt "Fehlertyp max.: Klopfregelung Nulltest" UWORD B_TRUE___UW 0 0 0.000000 0.000000 /begin IF_DATA ASAP1B_ETK KP_BLOB 0x383B74 1 2 /end IF_DATA BIT_MASK 0x100 /end MEASUREMENT
/begin MEASUREMENT B_mxkrof "Fehlertyp max.: Klopfregelung Offset" UWORD B_TRUE___UW 0 0 0.000000 0.000000 /begin IF_DATA ASAP1B_ETK KP_BLOB 0x383B76 1 2 /end IF_DATA BIT_MASK 0x100 /end MEASUREMENT
/begin MEASUREMENT B_mxkrtp "Fehlertyp max.: Klopfregelung Testimpuls" UWORD B_TRUE___UW 0 0 0.000000 0.000000 /begin IF_DATA ASAP1B_ETK KP_BLOB 0x383B78 1 2 /end IF_DATA BIT_MASK 0x100 /end MEASUREMENT
/begin MEASUREMENT B_mxks1 "Bedingung: Max-Fehler Klopfsensor 1" UWORD B_TRUE___UW 0 0 0.000000 0.000000 /begin IF_DATA ASAP1B_ETK KP_BLOB 0x383B7A 1 2 /end IF_DATA BIT_MASK 0x100 /end MEASUREMENT
/begin MEASUREMENT B_mxks2 "Bedingung: Max-Fehler Klopfsensor 2" UWORD B_TRUE___UW 0 0 0.000000 0.000000 /begin IF_DATA ASAP1B_ETK KP_BLOB 0x383B7C 1 2 /end IF_DATA BIT_MASK 0x100 /end MEASUREMENT
/begin MEASUREMENT B_mxks3 "Bedingung: Max-Fehler Klopfsensor 3" UWORD B_TRUE___UW 0 0 0.000000 0.000000 /begin IF_DATA ASAP1B_ETK KP_BLOB 0x383B7E 1 2 /end IF_DATA BIT_MASK 0x100 /end MEASUREMENT
/begin MEASUREMENT B_mxks4 "Bedingung: Max-Fehler Klopfsensor 4" UWORD B_TRUE___UW 0 0 0.000000 0.000000 /begin IF_DATA ASAP1B_ETK KP_BLOB 0x383B80 1 2 /end IF_DATA BIT_MASK 0x100 /end MEASUREMENT
/begin MEASUREMENT B_mxkuppl "Fehlertyp KUPPL: Maximalwert Åberschritten" UWORD B_TRUE___UW 0 0 0.000000 0.000000 /begin IF_DATA ASAP1B_ETK KP_BLOB 0x383B82 1 2 /end IF_DATA BIT_MASK 0x100 /end MEASUREMENT
/begin MEASUREMENT B_mxlash "Fehlertyp 'Maximalwert' fÅr Schwingungs-PrÅfung hinter KAT erkannt" UWORD B_TRUE___UW 0 0 0.000000 0.000000 /begin IF_DATA ASAP1B_ETK KP_BLOB 0x383B84 1 2 /end IF_DATA BIT_MASK 0x100 /end MEASUREMENT
/begin MEASUREMENT B_mxlash2 "Fehlertyp 'Maximalwert' fÅr Schwingungs-PrÅfung hinter KAT erkannt Bank2" UWORD B_TRUE___UW 0 0 0.000000 0.000000 /begin IF_DATA ASAP1B_ETK KP_BLOB 0x383B86 1 2 /end IF_DATA BIT_MASK 0x100 /end MEASUREMENT
/begin MEASUREMENT B_mxlatp "Fehlertyp 'Maximalwert' fÅr Periodendauer-PrÅfung vor KAT erkannt" UWORD B_TRUE___UW 0 0 0.000000 0.000000 /begin IF_DATA ASAP1B_ETK KP_BLOB 0x383B88 1 2 /end IF_DATA BIT_MASK 0x100 /end MEASUREMENT
/begin MEASUREMENT B_mxlatp2 "Fehlertyp 'Maximalwert' fÅr Periodendauer-PrÅfung vor KAT erkannt Bank2" UWORD B_TRUE___UW 0 0 0.000000 0.000000 /begin IF_DATA ASAP1B_ETK KP_BLOB 0x383B8A 1 2 /end IF_DATA BIT_MASK 0x100 /end MEASUREMENT
/begin MEASUREMENT B_mxlatv "Fehlertyp 'Maximalwert' fÅr ATV-PrÅfung vor KAT erkannt" UWORD B_TRUE___UW 0 0 0.000000 0.000000 /begin IF_DATA ASAP1B_ETK KP_BLOB 0x383B8C 1 2 /end IF_DATA BIT_MASK 0x100 /end MEASUREMENT
/begin MEASUREMENT B_mxlatv2 "Fehlertyp 'Maximalwert' fÅr ATV-PrÅfung vor KAT erkannt Bank2" UWORD B_TRUE___UW 0 0 0.000000 0.000000 /begin IF_DATA ASAP1B_ETK KP_BLOB 0x383B8E 1 2 /end IF_DATA BIT_MASK 0x100 /end MEASUREMENT
/begin MEASUREMENT B_mxlde "Fehlertyp: Kurzschlu· Ubat LDR-Taktventil" UWORD B_TRUE___UW 0 0 0.000000 0.000000 /begin IF_DATA ASAP1B_ETK KP_BLOB 0x383B90 1 2 /end IF_DATA BIT_MASK 0x100 /end MEASUREMENT
/begin MEASUREMENT B_mxldo "Bedingung MAX-Fehler Fehlerpfad ldo" UWORD B_TRUE___UW 0 0 0.000000 0.000000 /begin IF_DATA ASAP1B_ETK KP_BLOB 0x383B92 1 2 /end IF_DATA BIT_MASK 0x100 /end MEASUREMENT
/begin MEASUREMENT B_mxldp "Fehlertyp 'Maximalwert' erkannt (Reed-Switch nicht geschlossen)" UWORD B_TRUE___UW 0 0 0.000000 0.000000 /begin IF_DATA ASAP1B_ETK KP_BLOB 0x383B94 1 2 /end IF_DATA BIT_MASK 0x100 /end MEASUREMENT
/begin MEASUREMENT B_mxldra "Bedingung Max-Fehler Fehlerpfad ldra" UWORD B_TRUE___UW 0 0 0.000000 0.000000 /begin IF_DATA ASAP1B_ETK KP_BLOB 0x383B98 1 2 /end IF_DATA BIT_MASK 0x100 /end MEASUREMENT
/begin MEASUREMENT B_mxllr "Fehler 'Leerlaufdrehzahl zu gro·'" UWORD B_TRUE___UW 0 0 0.000000 0.000000 /begin IF_DATA ASAP1B_ETK KP_BLOB 0x383B9A 1 2 /end IF_DATA BIT_MASK 0x100 /end MEASUREMENT
/begin MEASUREMENT B_mxlm "Bedingung: max-Fehler HauptfÅllungssensor" UWORD B_TRUE___UW 0 0 0.000000 0.000000 /begin IF_DATA ASAP1B_ETK KP_BLOB 0x383B9C 1 2 /end IF_DATA BIT_MASK 0x100 /end MEASUREMENT
/begin MEASUREMENT B_mxlsh "Fehlertyp 'Maximalwert' hinter KAT erkannt" UWORD B_TRUE___UW 0 0 0.000000 0.000000 /begin IF_DATA ASAP1B_ETK KP_BLOB 0x383B9E 1 2 /end IF_DATA BIT_MASK 0x100 /end MEASUREMENT
/begin MEASUREMENT B_mxlsv "Fehlertyp 'Maximalwert' vor KAT erkannt" UWORD B_TRUE___UW 0 0 0.000000 0.000000 /begin IF_DATA ASAP1B_ETK KP_BLOB 0x383BA0 1 2 /end IF_DATA BIT_MASK 0x100 /end MEASUREMENT
/begin MEASUREMENT B_mxmile "Fehlerart: Kurzschlu· Ubat an MIL-Endstufe" UWORD B_TRUE___UW 0 0 0.000000 0.000000 /begin IF_DATA ASAP1B_ETK KP_BLOB 0x383BB8 1 2 /end IF_DATA BIT_MASK 0x100 /end MEASUREMENT
/begin MEASUREMENT B_mxnwse "Fehlerart: Kurzschlu· Ubat Nockenwellensteuerungsventil Endstufe" UWORD B_TRUE___UW 0 0 0.000000 0.000000 /begin IF_DATA ASAP1B_ETK KP_BLOB 0x383BC4 1 2 /end IF_DATA BIT_MASK 0x100 /end MEASUREMENT
/begin MEASUREMENT B_mxrkat "Bedingung obere PlausibilitÑtsschwelle Åberschritten (add. pro Zeit)" UWORD B_TRUE___UW 0 0 0.000000 0.000000 /begin IF_DATA ASAP1B_ETK KP_BLOB 0x383BCC 1 2 /end IF_DATA BIT_MASK 0x100 /end MEASUREMENT
/begin MEASUREMENT B_mxrkaz "Bedingung obere PlausibilitÑtsschwelle Åberschritten (add. pro ZÅndung)" UWORD B_TRUE___UW 0 0 0.000000 0.000000 /begin IF_DATA ASAP1B_ETK KP_BLOB 0x383BCE 1 2 /end IF_DATA BIT_MASK 0x100 /end MEASUREMENT
/begin MEASUREMENT B_mxslpe "Fehlertype: Kurzschlu· nach Ubatt Endstufe SekundÑrluftpumpe" UWORD B_TRUE___UW 0 0 0.000000 0.000000 /begin IF_DATA ASAP1B_ETK KP_BLOB 0x383BD2 1 2 /end IF_DATA BIT_MASK 0x100 /end MEASUREMENT
/begin MEASUREMENT B_mxslve "Fehlertype: Kurzschlu· nach Masse Endstufe SekundÑrluftventil" UWORD B_TRUE___UW 0 0 0.000000 0.000000 /begin IF_DATA ASAP1B_ETK KP_BLOB 0x383BD8 1 2 /end IF_DATA BIT_MASK 0x100 /end MEASUREMENT
/begin MEASUREMENT B_mxsue "Fehlerart: Kurzschlu· Ubat an Endstufe fÅr Saugrohrumschaltung" UWORD B_TRUE___UW 0 0 0.000000 0.000000 /begin IF_DATA ASAP1B_ETK KP_BLOB 0x383BDC 1 2 /end IF_DATA BIT_MASK 0x100 /end MEASUREMENT
/begin MEASUREMENT B_mxtesf "Fehlertyp 'Maximalwert' erkannt (Feinleck)" UWORD B_TRUE___UW 0 0 0.000000 0.000000 /begin IF_DATA ASAP1B_ETK KP_BLOB 0x383BE6 1 2 /end IF_DATA BIT_MASK 0x100 /end MEASUREMENT
/begin MEASUREMENT B_mxtesg "Fehlertyp 'Maximalwert' erkannt (Grobleck)" UWORD B_TRUE___UW 0 0 0.000000 0.000000 /begin IF_DATA ASAP1B_ETK KP_BLOB 0x383BE8 1 2 /end IF_DATA BIT_MASK 0x100 /end MEASUREMENT
/begin MEASUREMENT B_mxteve "Fehlertyp: Kurzschlu· Ubat TankentlÅftungsventil Endstufe" UWORD B_TRUE___UW 0 0 0.000000 0.000000 /begin IF_DATA ASAP1B_ETK KP_BLOB 0x383BEA 1 2 /end IF_DATA BIT_MASK 0x100 /end MEASUREMENT
/begin MEASUREMENT B_mxuvse "Fehlertyp: Kurzschlu· Ubat Umluftventil Turbo" UWORD B_TRUE___UW 0 0 0.000000 0.000000 /begin IF_DATA ASAP1B_ETK KP_BLOB 0x383C02 1 2 /end IF_DATA BIT_MASK 0x100 /end MEASUREMENT
/begin MEASUREMENT B_mxzet1 "" UWORD B_TRUE___UW 0 0 0.000000 0.000000 /begin IF_DATA ASAP1B_ETK KP_BLOB 0x383C0A 1 2 /end IF_DATA BIT_MASK 0x100 /end MEASUREMENT
/begin MEASUREMENT B_mxzet2 "" UWORD B_TRUE___UW 0 0 0.000000 0.000000 /begin IF_DATA ASAP1B_ETK KP_BLOB 0x383C0C 1 2 /end IF_DATA BIT_MASK 0x100 /end MEASUREMENT
/begin MEASUREMENT B_mxzet3 "" UWORD B_TRUE___UW 0 0 0.000000 0.000000 /begin IF_DATA ASAP1B_ETK KP_BLOB 0x383C0E 1 2 /end IF_DATA BIT_MASK 0x100 /end MEASUREMENT
/begin MEASUREMENT B_mxzet4 "" UWORD B_TRUE___UW 0 0 0.000000 0.000000 /begin IF_DATA ASAP1B_ETK KP_BLOB 0x383C10 1 2 /end IF_DATA BIT_MASK 0x100 /end MEASUREMENT
/begin MEASUREMENT B_mxzet5 "" UWORD B_TRUE___UW 0 0 0.000000 0.000000 /begin IF_DATA ASAP1B_ETK KP_BLOB 0x383C12 1 2 /end IF_DATA BIT_MASK 0x100 /end MEASUREMENT
/begin MEASUREMENT B_mxzet6 "" UWORD B_TRUE___UW 0 0 0.000000 0.000000 /begin IF_DATA ASAP1B_ETK KP_BLOB 0x383C14 1 2 /end IF_DATA BIT_MASK 0x100 /end MEASUREMENT
/begin MEASUREMENT B_mxzet7 "" UWORD B_TRUE___UW 0 0 0.000000 0.000000 /begin IF_DATA ASAP1B_ETK KP_BLOB 0x383C16 1 2 /end IF_DATA BIT_MASK 0x100 /end MEASUREMENT
/begin MEASUREMENT B_mxzet8 "" UWORD B_TRUE___UW 0 0 0.000000 0.000000 /begin IF_DATA ASAP1B_ETK KP_BLOB 0x383C18 1 2 /end IF_DATA BIT_MASK 0x100 /end MEASUREMENT
/begin MEASUREMENT B_npaave "Fehlertyp 'unplausibles PrÅfresultat' erkannt (Endstufe AAV)" UWORD B_TRUE___UW 0 0 0.000000 0.000000 /begin IF_DATA ASAP1B_ETK KP_BLOB 0x383AF0 1 2 /end IF_DATA BIT_MASK 0x800 /end MEASUREMENT
/begin MEASUREMENT B_npagre "Fehlerart: AbgasrÅckfÅhrungsventil Endstufe" UWORD B_TRUE___UW 0 0 0.000000 0.000000 /begin IF_DATA ASAP1B_ETK KP_BLOB 0x383AF2 1 2 /end IF_DATA BIT_MASK 0x800 /end MEASUREMENT
/begin MEASUREMENT B_npepcle "" UWORD B_TRUE___UW 0 0 0.000000 0.000000 /begin IF_DATA ASAP1B_ETK KP_BLOB 0x383B32 1 2 /end IF_DATA BIT_MASK 0x800 /end MEASUREMENT
/begin MEASUREMENT B_npetse "Fehlertyp unplaus.: elektrisches Thermostat Endstufe" UWORD B_TRUE___UW 0 0 0.000000 0.000000 /begin IF_DATA ASAP1B_ETK KP_BLOB 0x383B34 1 2 /end IF_DATA BIT_MASK 0x800 /end MEASUREMENT
/begin MEASUREMENT B_npev1 "Fehlerart: Zustand nicht plausibel EV1" UWORD B_TRUE___UW 0 0 0.000000 0.000000 /begin IF_DATA ASAP1B_ETK KP_BLOB 0x383B36 1 2 /end IF_DATA BIT_MASK 0x800 /end MEASUREMENT
/begin MEASUREMENT B_npev2 "Fehlerart: Zustand nicht plausibel EV2" UWORD B_TRUE___UW 0 0 0.000000 0.000000 /begin IF_DATA ASAP1B_ETK KP_BLOB 0x383B38 1 2 /end IF_DATA BIT_MASK 0x800 /end MEASUREMENT
/begin MEASUREMENT B_npev3 "Fehlerart: Zustand nicht plausibel EV3" UWORD B_TRUE___UW 0 0 0.000000 0.000000 /begin IF_DATA ASAP1B_ETK KP_BLOB 0x383B3A 1 2 /end IF_DATA BIT_MASK 0x800 /end MEASUREMENT
/begin MEASUREMENT B_npev4 "Fehlerart: Zustand nicht plausibel EV4" UWORD B_TRUE___UW 0 0 0.000000 0.000000 /begin IF_DATA ASAP1B_ETK KP_BLOB 0x383B3C 1 2 /end IF_DATA BIT_MASK 0x800 /end MEASUREMENT
/begin MEASUREMENT B_npev5 "Fehlerart: Zustand nicht plausibel EV5" UWORD B_TRUE___UW 0 0 0.000000 0.000000 /begin IF_DATA ASAP1B_ETK KP_BLOB 0x383B3E 1 2 /end IF_DATA BIT_MASK 0x800 /end MEASUREMENT
/begin MEASUREMENT B_npev6 "Fehlerart: Zustand nicht plausibel EV6" UWORD B_TRUE___UW 0 0 0.000000 0.000000 /begin IF_DATA ASAP1B_ETK KP_BLOB 0x383B40 1 2 /end IF_DATA BIT_MASK 0x800 /end MEASUREMENT
/begin MEASUREMENT B_npev7 "Fehlerart: Zustand nicht plausibel EV7" UWORD B_TRUE___UW 0 0 0.000000 0.000000 /begin IF_DATA ASAP1B_ETK KP_BLOB 0x383B42 1 2 /end IF_DATA BIT_MASK 0x800 /end MEASUREMENT
/begin MEASUREMENT B_npev8 "Fehlerart: Zustand nicht plausibel EV8" UWORD B_TRUE___UW 0 0 0.000000 0.000000 /begin IF_DATA ASAP1B_ETK KP_BLOB 0x383B44 1 2 /end IF_DATA BIT_MASK 0x800 /end MEASUREMENT
/begin MEASUREMENT B_npfrao "Bedingung FRAO ist unplausibel" UWORD B_TRUE___UW 0 0 0.000000 0.000000 /begin IF_DATA ASAP1B_ETK KP_BLOB 0x383B4C 1 2 /end IF_DATA BIT_MASK 0x800 /end MEASUREMENT
/begin MEASUREMENT B_npfrau "Bedingung FRAU ist unplausibel" UWORD B_TRUE___UW 0 0 0.000000 0.000000 /begin IF_DATA ASAP1B_ETK KP_BLOB 0x383B4E 1 2 /end IF_DATA BIT_MASK 0x800 /end MEASUREMENT
/begin MEASUREMENT B_npfrst "Fehlertyp 'unplausibles PrÅfresultat' erkannt (DKVS Kurztest)" UWORD B_TRUE___UW 0 0 0.000000 0.000000 /begin IF_DATA ASAP1B_ETK KP_BLOB 0x383B50 1 2 /end IF_DATA BIT_MASK 0x800 /end MEASUREMENT
/begin MEASUREMENT B_nphsh "Nernstwiderstand Sonde hinter Kat zu gro·" UWORD B_TRUE___UW 0 0 0.000000 0.000000 /begin IF_DATA ASAP1B_ETK KP_BLOB 0x383B56 1 2 /end IF_DATA BIT_MASK 0x800 /end MEASUREMENT
/begin MEASUREMENT B_nphshe "Nicht plausibler Fehler: Lambda-Sonden Heizung hinter Kat. Endstufe" UWORD B_TRUE___UW 0 0 0.000000 0.000000 /begin IF_DATA ASAP1B_ETK KP_BLOB 0x383B58 1 2 /end IF_DATA BIT_MASK 0x800 /end MEASUREMENT
/begin MEASUREMENT B_nphshe2 "Nicht plausibler Fehler: Lambda-Sonden Heizung 2 hinter Kat. Endstufe" UWORD B_TRUE___UW 0 0 0.000000 0.000000 /begin IF_DATA ASAP1B_ETK KP_BLOB 0x383B5A 1 2 /end IF_DATA BIT_MASK 0x800 /end MEASUREMENT
/begin MEASUREMENT B_nphsv "Nernstwiderstand Sonde vor Kat zu gro·" UWORD B_TRUE___UW 0 0 0.000000 0.000000 /begin IF_DATA ASAP1B_ETK KP_BLOB 0x383B5C 1 2 /end IF_DATA BIT_MASK 0x800 /end MEASUREMENT
/begin MEASUREMENT B_nphsv2 "Nernstwiderstand Sonde 2 vor Kat zu gro·" UWORD B_TRUE___UW 0 0 0.000000 0.000000 /begin IF_DATA ASAP1B_ETK KP_BLOB 0x383B5E 1 2 /end IF_DATA BIT_MASK 0x800 /end MEASUREMENT
/begin MEASUREMENT B_npkat "Fehlertyp 'unplausibles PrÅfresultat' erkannt (Katalysator)" UWORD B_TRUE___UW 0 0 0.000000 0.000000 /begin IF_DATA ASAP1B_ETK KP_BLOB 0x383B60 1 2 /end IF_DATA BIT_MASK 0x800 /end MEASUREMENT
/begin MEASUREMENT B_npkpe "Bedingung fÅr Fehlertyp 'Wert unplausibel' fÅr EKP-Relais Endstufe erkannt" UWORD B_TRUE___UW 0 0 0.000000 0.000000 /begin IF_DATA ASAP1B_ETK KP_BLOB 0x383B62 1 2 /end IF_DATA BIT_MASK 0x800 /end MEASUREMENT
/begin MEASUREMENT B_npkrnt "Bedingung PlausibilitÑtsfehler der KR-Diagnose Integratorsteigung" UWORD B_TRUE___UW 0 0 0.000000 0.000000 /begin IF_DATA ASAP1B_ETK KP_BLOB 0x383B74 1 2 /end IF_DATA BIT_MASK 0x800 /end MEASUREMENT
/begin MEASUREMENT B_npkrof "Bedingung PlausibilitÑtsfehler der KR-Diagnose Resetwert" UWORD B_TRUE___UW 0 0 0.000000 0.000000 /begin IF_DATA ASAP1B_ETK KP_BLOB 0x383B76 1 2 /end IF_DATA BIT_MASK 0x800 /end MEASUREMENT
/begin MEASUREMENT B_npkrtp "Bedingung PlausibilitÑtsfehler der KR-Diagnose Testimpuls" UWORD B_TRUE___UW 0 0 0.000000 0.000000 /begin IF_DATA ASAP1B_ETK KP_BLOB 0x383B78 1 2 /end IF_DATA BIT_MASK 0x800 /end MEASUREMENT
/begin MEASUREMENT B_npks1 "Nicht plausibler Fehler: Klopfsensor 1" UWORD B_TRUE___UW 0 0 0.000000 0.000000 /begin IF_DATA ASAP1B_ETK KP_BLOB 0x383B7A 1 2 /end IF_DATA BIT_MASK 0x800 /end MEASUREMENT
/begin MEASUREMENT B_npks2 "Nicht plausibler Fehler: Klopfsensor 2" UWORD B_TRUE___UW 0 0 0.000000 0.000000 /begin IF_DATA ASAP1B_ETK KP_BLOB 0x383B7C 1 2 /end IF_DATA BIT_MASK 0x800 /end MEASUREMENT
/begin MEASUREMENT B_npks3 "Nicht plausibler Fehler: Klopfsensor 3" UWORD B_TRUE___UW 0 0 0.000000 0.000000 /begin IF_DATA ASAP1B_ETK KP_BLOB 0x383B7E 1 2 /end IF_DATA BIT_MASK 0x800 /end MEASUREMENT
/begin MEASUREMENT B_npks4 "Nicht plausibler Fehler: Klopfsensor 4" UWORD B_TRUE___UW 0 0 0.000000 0.000000 /begin IF_DATA ASAP1B_ETK KP_BLOB 0x383B80 1 2 /end IF_DATA BIT_MASK 0x800 /end MEASUREMENT
/begin MEASUREMENT B_npkuppl "Fehlertyp KUPPL: PrÅfresultat nicht plausibel" UWORD B_TRUE___UW 0 0 0.000000 0.000000 /begin IF_DATA ASAP1B_ETK KP_BLOB 0x383B82 1 2 /end IF_DATA BIT_MASK 0x800 /end MEASUREMENT
/begin MEASUREMENT B_nplash "Fehlertyp 'Wert unplausibel' fÅr Schwingungs-PrÅfung hinter KAT erkannt" UWORD B_TRUE___UW 0 0 0.000000 0.000000 /begin IF_DATA ASAP1B_ETK KP_BLOB 0x383B84 1 2 /end IF_DATA BIT_MASK 0x800 /end MEASUREMENT
/begin MEASUREMENT B_nplash2 "Fehlertyp 'Wert unplausibel' fÅr Schwingungs-PrÅfung hinter KAT erkannt Bank2" UWORD B_TRUE___UW 0 0 0.000000 0.000000 /begin IF_DATA ASAP1B_ETK KP_BLOB 0x383B86 1 2 /end IF_DATA BIT_MASK 0x800 /end MEASUREMENT
/begin MEASUREMENT B_nplatp "" UWORD B_TRUE___UW 0 0 0.000000 0.000000 /begin IF_DATA ASAP1B_ETK KP_BLOB 0x383B88 1 2 /end IF_DATA BIT_MASK 0x800 /end MEASUREMENT
/begin MEASUREMENT B_nplatp2 "" UWORD B_TRUE___UW 0 0 0.000000 0.000000 /begin IF_DATA ASAP1B_ETK KP_BLOB 0x383B8A 1 2 /end IF_DATA BIT_MASK 0x800 /end MEASUREMENT
/begin MEASUREMENT B_nplatv "" UWORD B_TRUE___UW 0 0 0.000000 0.000000 /begin IF_DATA ASAP1B_ETK KP_BLOB 0x383B8C 1 2 /end IF_DATA BIT_MASK 0x800 /end MEASUREMENT
/begin MEASUREMENT B_nplatv2 "" UWORD B_TRUE___UW 0 0 0.000000 0.000000 /begin IF_DATA ASAP1B_ETK KP_BLOB 0x383B8E 1 2 /end IF_DATA BIT_MASK 0x800 /end MEASUREMENT
/begin MEASUREMENT B_nplde "Nicht plausibler Fehler: Ladedrucksteuerventil Endstufe" UWORD B_TRUE___UW 0 0 0.000000 0.000000 /begin IF_DATA ASAP1B_ETK KP_BLOB 0x383B90 1 2 /end IF_DATA BIT_MASK 0x800 /end MEASUREMENT
/begin MEASUREMENT B_npldo "" UWORD B_TRUE___UW 0 0 0.000000 0.000000 /begin IF_DATA ASAP1B_ETK KP_BLOB 0x383B92 1 2 /end IF_DATA BIT_MASK 0x800 /end MEASUREMENT
/begin MEASUREMENT B_npldp "Fehlertyp 'unplausibles PrÅfresultat' Reed Switch schliesst nicht" UWORD B_TRUE___UW 0 0 0.000000 0.000000 /begin IF_DATA ASAP1B_ETK KP_BLOB 0x383B94 1 2 /end IF_DATA BIT_MASK 0x800 /end MEASUREMENT
/begin MEASUREMENT B_npldra "" UWORD B_TRUE___UW 0 0 0.000000 0.000000 /begin IF_DATA ASAP1B_ETK KP_BLOB 0x383B98 1 2 /end IF_DATA BIT_MASK 0x800 /end MEASUREMENT
/begin MEASUREMENT B_npllr "Nicht plausibler Fehler: Leerlaufregelung" UWORD B_TRUE___UW 0 0 0.000000 0.000000 /begin IF_DATA ASAP1B_ETK KP_BLOB 0x383B9A 1 2 /end IF_DATA BIT_MASK 0x800 /end MEASUREMENT
/begin MEASUREMENT B_nplm "Bedingung Plausfehler HauptfÅllungssensor" UWORD B_TRUE___UW 0 0 0.000000 0.000000 /begin IF_DATA ASAP1B_ETK KP_BLOB 0x383B9C 1 2 /end IF_DATA BIT_MASK 0x800 /end MEASUREMENT
/begin MEASUREMENT B_nplsh "Fehlertyp 'Wert unplausibel' hinter KAT erkannt" UWORD B_TRUE___UW 0 0 0.000000 0.000000 /begin IF_DATA ASAP1B_ETK KP_BLOB 0x383B9E 1 2 /end IF_DATA BIT_MASK 0x800 /end MEASUREMENT
/begin MEASUREMENT B_nplsv "Fehlertyp 'Wert unplausibel' erkannt" UWORD B_TRUE___UW 0 0 0.000000 0.000000 /begin IF_DATA ASAP1B_ETK KP_BLOB 0x383BA0 1 2 /end IF_DATA BIT_MASK 0x800 /end MEASUREMENT
/begin MEASUREMENT B_npmile "Fehlerart: Zustand nicht plausibel an MIL-Endstufe" UWORD B_TRUE___UW 0 0 0.000000 0.000000 /begin IF_DATA ASAP1B_ETK KP_BLOB 0x383BB8 1 2 /end IF_DATA BIT_MASK 0x800 /end MEASUREMENT
/begin MEASUREMENT B_npnwse "Nicht plausibler Fehler: Nockenwellenverstellung Endstufe" UWORD B_TRUE___UW 0 0 0.000000 0.000000 /begin IF_DATA ASAP1B_ETK KP_BLOB 0x383BC4 1 2 /end IF_DATA BIT_MASK 0x800 /end MEASUREMENT
/begin MEASUREMENT B_nprkat "Bedingung RKAT ist unplausibel" UWORD B_TRUE___UW 0 0 0.000000 0.000000 /begin IF_DATA ASAP1B_ETK KP_BLOB 0x383BCC 1 2 /end IF_DATA BIT_MASK 0x800 /end MEASUREMENT
/begin MEASUREMENT B_nprkaz "Bedingung RKAZ ist unplausibel" UWORD B_TRUE___UW 0 0 0.000000 0.000000 /begin IF_DATA ASAP1B_ETK KP_BLOB 0x383BCE 1 2 /end IF_DATA BIT_MASK 0x800 /end MEASUREMENT
/begin MEASUREMENT B_npslpe "Nicht plausibler Fehler: SekundÑrluftpumpe Endstufe" UWORD B_TRUE___UW 0 0 0.000000 0.000000 /begin IF_DATA ASAP1B_ETK KP_BLOB 0x383BD2 1 2 /end IF_DATA BIT_MASK 0x800 /end MEASUREMENT
/begin MEASUREMENT B_npslve "Fehlerart: Offsetwert SekundÑrluftmasse Endstufe" UWORD B_TRUE___UW 0 0 0.000000 0.000000 /begin IF_DATA ASAP1B_ETK KP_BLOB 0x383BD8 1 2 /end IF_DATA BIT_MASK 0x800 /end MEASUREMENT
/begin MEASUREMENT B_npsue "Nicht plausibler Fehler: Saugrohrumschaltung Endstufe" UWORD B_TRUE___UW 0 0 0.000000 0.000000 /begin IF_DATA ASAP1B_ETK KP_BLOB 0x383BDC 1 2 /end IF_DATA BIT_MASK 0x800 /end MEASUREMENT
/begin MEASUREMENT B_nptesf "Fehlertyp 'unplausibles PrÅfresultat' erkannt (Feinleck)" UWORD B_TRUE___UW 0 0 0.000000 0.000000 /begin IF_DATA ASAP1B_ETK KP_BLOB 0x383BE6 1 2 /end IF_DATA BIT_MASK 0x800 /end MEASUREMENT
/begin MEASUREMENT B_nptesg "Fehlertyp 'unplausibles PrÅfresultat' erkannt (Grobleck)" UWORD B_TRUE___UW 0 0 0.000000 0.000000 /begin IF_DATA ASAP1B_ETK KP_BLOB 0x383BE8 1 2 /end IF_DATA BIT_MASK 0x800 /end MEASUREMENT
/begin MEASUREMENT B_npteve "Nicht plausibler Fehler: TankentlÅftungsventil Endstufe" UWORD B_TRUE___UW 0 0 0.000000 0.000000 /begin IF_DATA ASAP1B_ETK KP_BLOB 0x383BEA 1 2 /end IF_DATA BIT_MASK 0x800 /end MEASUREMENT
/begin MEASUREMENT B_npuvse "Nicht plausibler  Fehler: Endstufe Umluftventil Turbo" UWORD B_TRUE___UW 0 0 0.000000 0.000000 /begin IF_DATA ASAP1B_ETK KP_BLOB 0x383C02 1 2 /end IF_DATA BIT_MASK 0x800 /end MEASUREMENT
/begin MEASUREMENT B_npzet1 "" UWORD B_TRUE___UW 0 0 0.000000 0.000000 /begin IF_DATA ASAP1B_ETK KP_BLOB 0x383C0A 1 2 /end IF_DATA BIT_MASK 0x800 /end MEASUREMENT
/begin MEASUREMENT B_npzet2 "" UWORD B_TRUE___UW 0 0 0.000000 0.000000 /begin IF_DATA ASAP1B_ETK KP_BLOB 0x383C0C 1 2 /end IF_DATA BIT_MASK 0x800 /end MEASUREMENT
/begin MEASUREMENT B_npzet3 "" UWORD B_TRUE___UW 0 0 0.000000 0.000000 /begin IF_DATA ASAP1B_ETK KP_BLOB 0x383C0E 1 2 /end IF_DATA BIT_MASK 0x800 /end MEASUREMENT
/begin MEASUREMENT B_npzet4 "" UWORD B_TRUE___UW 0 0 0.000000 0.000000 /begin IF_DATA ASAP1B_ETK KP_BLOB 0x383C10 1 2 /end IF_DATA BIT_MASK 0x800 /end MEASUREMENT
/begin MEASUREMENT B_npzet5 "" UWORD B_TRUE___UW 0 0 0.000000 0.000000 /begin IF_DATA ASAP1B_ETK KP_BLOB 0x383C12 1 2 /end IF_DATA BIT_MASK 0x800 /end MEASUREMENT
/begin MEASUREMENT B_npzet6 "" UWORD B_TRUE___UW 0 0 0.000000 0.000000 /begin IF_DATA ASAP1B_ETK KP_BLOB 0x383C14 1 2 /end IF_DATA BIT_MASK 0x800 /end MEASUREMENT
/begin MEASUREMENT B_npzet7 "" UWORD B_TRUE___UW 0 0 0.000000 0.000000 /begin IF_DATA ASAP1B_ETK KP_BLOB 0x383C16 1 2 /end IF_DATA BIT_MASK 0x800 /end MEASUREMENT
/begin MEASUREMENT B_npzet8 "" UWORD B_TRUE___UW 0 0 0.000000 0.000000 /begin IF_DATA ASAP1B_ETK KP_BLOB 0x383C18 1 2 /end IF_DATA BIT_MASK 0x800 /end MEASUREMENT
/begin MEASUREMENT B_siaave "Fehlerart: Leitungsabfall Absperrventil Aktivkohlefilter (Endstufe)" UWORD B_TRUE___UW 0 0 0.000000 0.000000 /begin IF_DATA ASAP1B_ETK KP_BLOB 0x383AF0 1 2 /end IF_DATA BIT_MASK 0x400 /end MEASUREMENT
/begin MEASUREMENT B_siagre "Fehlertype: Leitungsabfall Endstufe AGR-Ventil" UWORD B_TRUE___UW 0 0 0.000000 0.000000 /begin IF_DATA ASAP1B_ETK KP_BLOB 0x383AF2 1 2 /end IF_DATA BIT_MASK 0x400 /end MEASUREMENT
/begin MEASUREMENT B_siepcle "Fehlerart: Unterbrechung an EPCL-Endstufe" UWORD B_TRUE___UW 0 0 0.000000 0.000000 /begin IF_DATA ASAP1B_ETK KP_BLOB 0x383B32 1 2 /end IF_DATA BIT_MASK 0x400 /end MEASUREMENT
/begin MEASUREMENT B_sietse "Fehlertyp: elektrisches Thermostat Endstufe" UWORD B_TRUE___UW 0 0 0.000000 0.000000 /begin IF_DATA ASAP1B_ETK KP_BLOB 0x383B34 1 2 /end IF_DATA BIT_MASK 0x400 /end MEASUREMENT
/begin MEASUREMENT B_siev1 "Fehlerart: Unterbrechung an Endstufe EV1" UWORD B_TRUE___UW 0 0 0.000000 0.000000 /begin IF_DATA ASAP1B_ETK KP_BLOB 0x383B36 1 2 /end IF_DATA BIT_MASK 0x400 /end MEASUREMENT
/begin MEASUREMENT B_siev2 "Fehlerart: Unterbrechung an Endstufe EV2" UWORD B_TRUE___UW 0 0 0.000000 0.000000 /begin IF_DATA ASAP1B_ETK KP_BLOB 0x383B38 1 2 /end IF_DATA BIT_MASK 0x400 /end MEASUREMENT
/begin MEASUREMENT B_siev3 "Fehlerart: Unterbrechung an Endstufe EV3" UWORD B_TRUE___UW 0 0 0.000000 0.000000 /begin IF_DATA ASAP1B_ETK KP_BLOB 0x383B3A 1 2 /end IF_DATA BIT_MASK 0x400 /end MEASUREMENT
/begin MEASUREMENT B_siev4 "Fehlerart: Unterbrechung an Endstufe EV4" UWORD B_TRUE___UW 0 0 0.000000 0.000000 /begin IF_DATA ASAP1B_ETK KP_BLOB 0x383B3C 1 2 /end IF_DATA BIT_MASK 0x400 /end MEASUREMENT
/begin MEASUREMENT B_siev5 "Fehlerart: Unterbrechung an Endstufe EV5" UWORD B_TRUE___UW 0 0 0.000000 0.000000 /begin IF_DATA ASAP1B_ETK KP_BLOB 0x383B3E 1 2 /end IF_DATA BIT_MASK 0x400 /end MEASUREMENT
/begin MEASUREMENT B_siev6 "Fehlerart: Unterbrechung an Endstufe EV6" UWORD B_TRUE___UW 0 0 0.000000 0.000000 /begin IF_DATA ASAP1B_ETK KP_BLOB 0x383B40 1 2 /end IF_DATA BIT_MASK 0x400 /end MEASUREMENT
/begin MEASUREMENT B_siev7 "Fehlerart: Unterbrechung an Endstufe EV7" UWORD B_TRUE___UW 0 0 0.000000 0.000000 /begin IF_DATA ASAP1B_ETK KP_BLOB 0x383B42 1 2 /end IF_DATA BIT_MASK 0x400 /end MEASUREMENT
/begin MEASUREMENT B_siev8 "Fehlerart: Unterbrechung an Endstufe EV8" UWORD B_TRUE___UW 0 0 0.000000 0.000000 /begin IF_DATA ASAP1B_ETK KP_BLOB 0x383B44 1 2 /end IF_DATA BIT_MASK 0x400 /end MEASUREMENT
/begin MEASUREMENT B_sifrao "Fehlertyp 'Signal fehlt' for FRAO erkannt" UWORD B_TRUE___UW 0 0 0.000000 0.000000 /begin IF_DATA ASAP1B_ETK KP_BLOB 0x383B4C 1 2 /end IF_DATA BIT_MASK 0x400 /end MEASUREMENT
/begin MEASUREMENT B_sifrau "Fehlertyp 'Signal fehlt' fÅr FRAU erkannt" UWORD B_TRUE___UW 0 0 0.000000 0.000000 /begin IF_DATA ASAP1B_ETK KP_BLOB 0x383B4E 1 2 /end IF_DATA BIT_MASK 0x400 /end MEASUREMENT
/begin MEASUREMENT B_sifrst "Fehlerart: LR-Abweichung" UWORD B_TRUE___UW 0 0 0.000000 0.000000 /begin IF_DATA ASAP1B_ETK KP_BLOB 0x383B50 1 2 /end IF_DATA BIT_MASK 0x400 /end MEASUREMENT
/begin MEASUREMENT B_sihsh "Lastabfall Sondenheizung hinter Kat" UWORD B_TRUE___UW 0 0 0.000000 0.000000 /begin IF_DATA ASAP1B_ETK KP_BLOB 0x383B56 1 2 /end IF_DATA BIT_MASK 0x400 /end MEASUREMENT
/begin MEASUREMENT B_sihshe "Lastabfall Sondenheizung hinter Kat" UWORD B_TRUE___UW 0 0 0.000000 0.000000 /begin IF_DATA ASAP1B_ETK KP_BLOB 0x383B58 1 2 /end IF_DATA BIT_MASK 0x400 /end MEASUREMENT
/begin MEASUREMENT B_sihshe2 "Lastabfall Sondenheizung2 hinter Kat" UWORD B_TRUE___UW 0 0 0.000000 0.000000 /begin IF_DATA ASAP1B_ETK KP_BLOB 0x383B5A 1 2 /end IF_DATA BIT_MASK 0x400 /end MEASUREMENT
/begin MEASUREMENT B_sihsv "Lastabfall Sondenheizung vor Kat" UWORD B_TRUE___UW 0 0 0.000000 0.000000 /begin IF_DATA ASAP1B_ETK KP_BLOB 0x383B5C 1 2 /end IF_DATA BIT_MASK 0x400 /end MEASUREMENT
/begin MEASUREMENT B_sihsv2 "Lastabfall Sondenheizung2 vor Kat" UWORD B_TRUE___UW 0 0 0.000000 0.000000 /begin IF_DATA ASAP1B_ETK KP_BLOB 0x383B5E 1 2 /end IF_DATA BIT_MASK 0x400 /end MEASUREMENT
/begin MEASUREMENT B_sikat "Fehlertyp 'Signal fehlt' fÅr DKAT erkannt" UWORD B_TRUE___UW 0 0 0.000000 0.000000 /begin IF_DATA ASAP1B_ETK KP_BLOB 0x383B60 1 2 /end IF_DATA BIT_MASK 0x400 /end MEASUREMENT
/begin MEASUREMENT B_sikpe "Bedingung fÅr Fehlertyp 'Signal fehlt' fÅr EKP-Relais Endstufe erkannt" UWORD B_TRUE___UW 0 0 0.000000 0.000000 /begin IF_DATA ASAP1B_ETK KP_BLOB 0x383B62 1 2 /end IF_DATA BIT_MASK 0x400 /end MEASUREMENT
/begin MEASUREMENT B_sikrnt "Fehlertyp: Klopfregelung Nulltest" UWORD B_TRUE___UW 0 0 0.000000 0.000000 /begin IF_DATA ASAP1B_ETK KP_BLOB 0x383B74 1 2 /end IF_DATA BIT_MASK 0x400 /end MEASUREMENT
/begin MEASUREMENT B_sikrof "Fehlertyp: Klopfregelung Offset" UWORD B_TRUE___UW 0 0 0.000000 0.000000 /begin IF_DATA ASAP1B_ETK KP_BLOB 0x383B76 1 2 /end IF_DATA BIT_MASK 0x400 /end MEASUREMENT
/begin MEASUREMENT B_sikrtp "Fehlertyp: Klopfregelung Testimpuls" UWORD B_TRUE___UW 0 0 0.000000 0.000000 /begin IF_DATA ASAP1B_ETK KP_BLOB 0x383B78 1 2 /end IF_DATA BIT_MASK 0x400 /end MEASUREMENT
/begin MEASUREMENT B_siks1 "Fehlertyp: Klopfsensor 1" UWORD B_TRUE___UW 0 0 0.000000 0.000000 /begin IF_DATA ASAP1B_ETK KP_BLOB 0x383B7A 1 2 /end IF_DATA BIT_MASK 0x400 /end MEASUREMENT
/begin MEASUREMENT B_siks2 "Fehlertyp: Klopfsensor 2" UWORD B_TRUE___UW 0 0 0.000000 0.000000 /begin IF_DATA ASAP1B_ETK KP_BLOB 0x383B7C 1 2 /end IF_DATA BIT_MASK 0x400 /end MEASUREMENT
/begin MEASUREMENT B_siks3 "Fehlertyp: Klopfsensor 3" UWORD B_TRUE___UW 0 0 0.000000 0.000000 /begin IF_DATA ASAP1B_ETK KP_BLOB 0x383B7E 1 2 /end IF_DATA BIT_MASK 0x400 /end MEASUREMENT
/begin MEASUREMENT B_siks4 "Fehlertyp: Klopfsensor 4" UWORD B_TRUE___UW 0 0 0.000000 0.000000 /begin IF_DATA ASAP1B_ETK KP_BLOB 0x383B80 1 2 /end IF_DATA BIT_MASK 0x400 /end MEASUREMENT
/begin MEASUREMENT B_sikuppl "Fehlertyp KUPPL: Signal inaktiv" UWORD B_TRUE___UW 0 0 0.000000 0.000000 /begin IF_DATA ASAP1B_ETK KP_BLOB 0x383B82 1 2 /end IF_DATA BIT_MASK 0x400 /end MEASUREMENT
/begin MEASUREMENT B_silash "Fehlertyp: Lambdasondenalterung hinter Kat." UWORD B_TRUE___UW 0 0 0.000000 0.000000 /begin IF_DATA ASAP1B_ETK KP_BLOB 0x383B84 1 2 /end IF_DATA BIT_MASK 0x400 /end MEASUREMENT
/begin MEASUREMENT B_silash2 "Fehlertyp: Lambdasondenalterung hinter Kat. Bank 2" UWORD B_TRUE___UW 0 0 0.000000 0.000000 /begin IF_DATA ASAP1B_ETK KP_BLOB 0x383B86 1 2 /end IF_DATA BIT_MASK 0x400 /end MEASUREMENT
/begin MEASUREMENT B_silatp "" UWORD B_TRUE___UW 0 0 0.000000 0.000000 /begin IF_DATA ASAP1B_ETK KP_BLOB 0x383B88 1 2 /end IF_DATA BIT_MASK 0x400 /end MEASUREMENT
/begin MEASUREMENT B_silatp2 "" UWORD B_TRUE___UW 0 0 0.000000 0.000000 /begin IF_DATA ASAP1B_ETK KP_BLOB 0x383B8A 1 2 /end IF_DATA BIT_MASK 0x400 /end MEASUREMENT
/begin MEASUREMENT B_silatv "" UWORD B_TRUE___UW 0 0 0.000000 0.000000 /begin IF_DATA ASAP1B_ETK KP_BLOB 0x383B8C 1 2 /end IF_DATA BIT_MASK 0x400 /end MEASUREMENT
/begin MEASUREMENT B_silatv2 "" UWORD B_TRUE___UW 0 0 0.000000 0.000000 /begin IF_DATA ASAP1B_ETK KP_BLOB 0x383B8E 1 2 /end IF_DATA BIT_MASK 0x400 /end MEASUREMENT
/begin MEASUREMENT B_silde "Fehlertyp: Leitungsabfall LDR-Taktventil" UWORD B_TRUE___UW 0 0 0.000000 0.000000 /begin IF_DATA ASAP1B_ETK KP_BLOB 0x383B90 1 2 /end IF_DATA BIT_MASK 0x400 /end MEASUREMENT
/begin MEASUREMENT B_sildo "" UWORD B_TRUE___UW 0 0 0.000000 0.000000 /begin IF_DATA ASAP1B_ETK KP_BLOB 0x383B92 1 2 /end IF_DATA BIT_MASK 0x400 /end MEASUREMENT
/begin MEASUREMENT B_sildp "Fehlertyp: Leckdiagnosemodul" UWORD B_TRUE___UW 0 0 0.000000 0.000000 /begin IF_DATA ASAP1B_ETK KP_BLOB 0x383B94 1 2 /end IF_DATA BIT_MASK 0x400 /end MEASUREMENT
/begin MEASUREMENT B_sildra "" UWORD B_TRUE___UW 0 0 0.000000 0.000000 /begin IF_DATA ASAP1B_ETK KP_BLOB 0x383B98 1 2 /end IF_DATA BIT_MASK 0x400 /end MEASUREMENT
/begin MEASUREMENT B_sillr "Fehlertyp: Leerlaufregelung" UWORD B_TRUE___UW 0 0 0.000000 0.000000 /begin IF_DATA ASAP1B_ETK KP_BLOB 0x383B9A 1 2 /end IF_DATA BIT_MASK 0x400 /end MEASUREMENT
/begin MEASUREMENT B_silm "Bedingung Signalfehler HauptfÅllungssensor" UWORD B_TRUE___UW 0 0 0.000000 0.000000 /begin IF_DATA ASAP1B_ETK KP_BLOB 0x383B9C 1 2 /end IF_DATA BIT_MASK 0x400 /end MEASUREMENT
/begin MEASUREMENT B_silsh "Fehlertyp 'Signal fehlt' hinter KAT erkannt" UWORD B_TRUE___UW 0 0 0.000000 0.000000 /begin IF_DATA ASAP1B_ETK KP_BLOB 0x383B9E 1 2 /end IF_DATA BIT_MASK 0x400 /end MEASUREMENT
/begin MEASUREMENT B_silsv "Fehlertyp 'Signal fehlt' vor KAT erkannt" UWORD B_TRUE___UW 0 0 0.000000 0.000000 /begin IF_DATA ASAP1B_ETK KP_BLOB 0x383BA0 1 2 /end IF_DATA BIT_MASK 0x400 /end MEASUREMENT
/begin MEASUREMENT B_simile "Fehlerart: Unterbrechung an MIL-Endstufe" UWORD B_TRUE___UW 0 0 0.000000 0.000000 /begin IF_DATA ASAP1B_ETK KP_BLOB 0x383BB8 1 2 /end IF_DATA BIT_MASK 0x400 /end MEASUREMENT
/begin MEASUREMENT B_sinwse "Fehlerart: Leitungsabfall Nockenwellensteuerungsventil Endstufe" UWORD B_TRUE___UW 0 0 0.000000 0.000000 /begin IF_DATA ASAP1B_ETK KP_BLOB 0x383BC4 1 2 /end IF_DATA BIT_MASK 0x400 /end MEASUREMENT
/begin MEASUREMENT B_sirkat "Fehlertyp 'Signal fehlt' for RKAT erkannt" UWORD B_TRUE___UW 0 0 0.000000 0.000000 /begin IF_DATA ASAP1B_ETK KP_BLOB 0x383BCC 1 2 /end IF_DATA BIT_MASK 0x400 /end MEASUREMENT
/begin MEASUREMENT B_sirkaz "Fehlertyp 'Signal fehlt' for RKAZ erkannt" UWORD B_TRUE___UW 0 0 0.000000 0.000000 /begin IF_DATA ASAP1B_ETK KP_BLOB 0x383BCE 1 2 /end IF_DATA BIT_MASK 0x400 /end MEASUREMENT
/begin MEASUREMENT B_sislpe "Fehlertype: Leitungsabfall Endstufe SekundÑrluftpumpe" UWORD B_TRUE___UW 0 0 0.000000 0.000000 /begin IF_DATA ASAP1B_ETK KP_BLOB 0x383BD2 1 2 /end IF_DATA BIT_MASK 0x400 /end MEASUREMENT
/begin MEASUREMENT B_sislve "Fehlertype: Leitungsabfall Endstufe SekundÑrluftventil" UWORD B_TRUE___UW 0 0 0.000000 0.000000 /begin IF_DATA ASAP1B_ETK KP_BLOB 0x383BD8 1 2 /end IF_DATA BIT_MASK 0x400 /end MEASUREMENT
/begin MEASUREMENT B_sisue "Fehlerart: Leitungsabfall  an Endstufe fÅr Saugrohrumschaltung" UWORD B_TRUE___UW 0 0 0.000000 0.000000 /begin IF_DATA ASAP1B_ETK KP_BLOB 0x383BDC 1 2 /end IF_DATA BIT_MASK 0x400 /end MEASUREMENT
/begin MEASUREMENT B_sitesf "Fehlerart: Feinleck" UWORD B_TRUE___UW 0 0 0.000000 0.000000 /begin IF_DATA ASAP1B_ETK KP_BLOB 0x383BE6 1 2 /end IF_DATA BIT_MASK 0x400 /end MEASUREMENT
/begin MEASUREMENT B_sitesg "Fehlerart: Grobleck" UWORD B_TRUE___UW 0 0 0.000000 0.000000 /begin IF_DATA ASAP1B_ETK KP_BLOB 0x383BE8 1 2 /end IF_DATA BIT_MASK 0x400 /end MEASUREMENT
/begin MEASUREMENT B_siteve "Fehlertyp: Leitungsabfall TankentlÅftungsventil Endstufe" UWORD B_TRUE___UW 0 0 0.000000 0.000000 /begin IF_DATA ASAP1B_ETK KP_BLOB 0x383BEA 1 2 /end IF_DATA BIT_MASK 0x400 /end MEASUREMENT
/begin MEASUREMENT B_siuvse "Fehlertyp: Leitungsabfall Umluftventil turbo" UWORD B_TRUE___UW 0 0 0.000000 0.000000 /begin IF_DATA ASAP1B_ETK KP_BLOB 0x383C02 1 2 /end IF_DATA BIT_MASK 0x400 /end MEASUREMENT
/begin MEASUREMENT B_sizet1 "" UWORD B_TRUE___UW 0 0 0.000000 0.000000 /begin IF_DATA ASAP1B_ETK KP_BLOB 0x383C0A 1 2 /end IF_DATA BIT_MASK 0x400 /end MEASUREMENT
/begin MEASUREMENT B_sizet2 "" UWORD B_TRUE___UW 0 0 0.000000 0.000000 /begin IF_DATA ASAP1B_ETK KP_BLOB 0x383C0C 1 2 /end IF_DATA BIT_MASK 0x400 /end MEASUREMENT
/begin MEASUREMENT B_sizet3 "" UWORD B_TRUE___UW 0 0 0.000000 0.000000 /begin IF_DATA ASAP1B_ETK KP_BLOB 0x383C0E 1 2 /end IF_DATA BIT_MASK 0x400 /end MEASUREMENT
/begin MEASUREMENT B_sizet4 "" UWORD B_TRUE___UW 0 0 0.000000 0.000000 /begin IF_DATA ASAP1B_ETK KP_BLOB 0x383C10 1 2 /end IF_DATA BIT_MASK 0x400 /end MEASUREMENT
/begin MEASUREMENT B_sizet5 "" UWORD B_TRUE___UW 0 0 0.000000 0.000000 /begin IF_DATA ASAP1B_ETK KP_BLOB 0x383C12 1 2 /end IF_DATA BIT_MASK 0x400 /end MEASUREMENT
/begin MEASUREMENT B_sizet6 "" UWORD B_TRUE___UW 0 0 0.000000 0.000000 /begin IF_DATA ASAP1B_ETK KP_BLOB 0x383C14 1 2 /end IF_DATA BIT_MASK 0x400 /end MEASUREMENT
/begin MEASUREMENT B_sizet7 "" UWORD B_TRUE___UW 0 0 0.000000 0.000000 /begin IF_DATA ASAP1B_ETK KP_BLOB 0x383C16 1 2 /end IF_DATA BIT_MASK 0x400 /end MEASUREMENT
/begin MEASUREMENT B_sizet8 "" UWORD B_TRUE___UW 0 0 0.000000 0.000000 /begin IF_DATA ASAP1B_ETK KP_BLOB 0x383C18 1 2 /end IF_DATA BIT_MASK 0x400 /end MEASUREMENT
/begin MEASUREMENT E_aave "Errorflag: Absperrventil Aktivkohlefilter (Endstufe)" UWORD B_TRUE___UW 0 0 0.000000 0.000000 /begin IF_DATA ASAP1B_ETK KP_BLOB 0x383AF0 1 2 /end IF_DATA BIT_MASK 0x1 /end MEASUREMENT
/begin MEASUREMENT E_agre "Errorflag: öberwachung AGR-Endstufe" UWORD B_TRUE___UW 0 0 0.000000 0.000000 /begin IF_DATA ASAP1B_ETK KP_BLOB 0x383AF2 1 2 /end IF_DATA BIT_MASK 0x1 /end MEASUREMENT
/begin MEASUREMENT E_epcle "Fehlerflag: EPCL-Endstufe" UWORD B_TRUE___UW 0 0 0.000000 0.000000 /begin IF_DATA ASAP1B_ETK KP_BLOB 0x383B32 1 2 /end IF_DATA BIT_MASK 0x1 /end MEASUREMENT
/begin MEASUREMENT E_etse "Errorflag: Elektrisches Thermostat Endstufe" UWORD B_TRUE___UW 0 0 0.000000 0.000000 /begin IF_DATA ASAP1B_ETK KP_BLOB 0x383B34 1 2 /end IF_DATA BIT_MASK 0x1 /end MEASUREMENT
/begin MEASUREMENT E_ev1 "Errorflag: EV von Zyl. 1" UWORD B_TRUE___UW 0 0 0.000000 0.000000 /begin IF_DATA ASAP1B_ETK KP_BLOB 0x383B36 1 2 /end IF_DATA BIT_MASK 0x1 /end MEASUREMENT
/begin MEASUREMENT E_ev2 "Errorflag: EV von Zyl. 2" UWORD B_TRUE___UW 0 0 0.000000 0.000000 /begin IF_DATA ASAP1B_ETK KP_BLOB 0x383B38 1 2 /end IF_DATA BIT_MASK 0x1 /end MEASUREMENT
/begin MEASUREMENT E_ev3 "Errorflag: EV von Zyl. 3" UWORD B_TRUE___UW 0 0 0.000000 0.000000 /begin IF_DATA ASAP1B_ETK KP_BLOB 0x383B3A 1 2 /end IF_DATA BIT_MASK 0x1 /end MEASUREMENT
/begin MEASUREMENT E_ev4 "Errorflag: EV von Zyl. 4" UWORD B_TRUE___UW 0 0 0.000000 0.000000 /begin IF_DATA ASAP1B_ETK KP_BLOB 0x383B3C 1 2 /end IF_DATA BIT_MASK 0x1 /end MEASUREMENT
/begin MEASUREMENT E_ev5 "Errorflag: EV von Zyl. 5" UWORD B_TRUE___UW 0 0 0.000000 0.000000 /begin IF_DATA ASAP1B_ETK KP_BLOB 0x383B3E 1 2 /end IF_DATA BIT_MASK 0x1 /end MEASUREMENT
/begin MEASUREMENT E_ev6 "Errorflag: EV von Zyl. 6" UWORD B_TRUE___UW 0 0 0.000000 0.000000 /begin IF_DATA ASAP1B_ETK KP_BLOB 0x383B40 1 2 /end IF_DATA BIT_MASK 0x1 /end MEASUREMENT
/begin MEASUREMENT E_ev7 "Errorflag: EV von Zyl. 7" UWORD B_TRUE___UW 0 0 0.000000 0.000000 /begin IF_DATA ASAP1B_ETK KP_BLOB 0x383B42 1 2 /end IF_DATA BIT_MASK 0x1 /end MEASUREMENT
/begin MEASUREMENT E_ev8 "Errorflag: EV von Zyl. 8" UWORD B_TRUE___UW 0 0 0.000000 0.000000 /begin IF_DATA ASAP1B_ETK KP_BLOB 0x383B44 1 2 /end IF_DATA BIT_MASK 0x1 /end MEASUREMENT
/begin MEASUREMENT E_frao "Errorflag: LR-Adaption oberer multiplikativer Bereich" UWORD B_TRUE___UW 0 0 0.000000 0.000000 /begin IF_DATA ASAP1B_ETK KP_BLOB 0x383B4C 1 2 /end IF_DATA BIT_MASK 0x1 /end MEASUREMENT
/begin MEASUREMENT E_frau "Errorflag: LR-Adaption unterer multiplikativer Bereich" UWORD B_TRUE___UW 0 0 0.000000 0.000000 /begin IF_DATA ASAP1B_ETK KP_BLOB 0x383B4E 1 2 /end IF_DATA BIT_MASK 0x1 /end MEASUREMENT
/begin MEASUREMENT E_frst "Errorflag: Fehler aus Diagnose Kraftstoffversorgungssystem (Kurztest)" UWORD B_TRUE___UW 0 0 0.000000 0.000000 /begin IF_DATA ASAP1B_ETK KP_BLOB 0x383B50 1 2 /end IF_DATA BIT_MASK 0x1 /end MEASUREMENT
/begin MEASUREMENT E_hsh "Errorflag: Lambdasonden-Heizung hinter Katalysator" UWORD B_TRUE___UW 0 0 0.000000 0.000000 /begin IF_DATA ASAP1B_ETK KP_BLOB 0x383B56 1 2 /end IF_DATA BIT_MASK 0x1 /end MEASUREMENT
/begin MEASUREMENT E_hshe "Errorflag: Lambdasonden-Heizung hinter Katalysator (Endstufe)" UWORD B_TRUE___UW 0 0 0.000000 0.000000 /begin IF_DATA ASAP1B_ETK KP_BLOB 0x383B58 1 2 /end IF_DATA BIT_MASK 0x1 /end MEASUREMENT
/begin MEASUREMENT E_hshe2 "Errorflag: Lambdasonden-Heizung hinter Katalysator Bank 2 (Endstufe)" UWORD B_TRUE___UW 0 0 0.000000 0.000000 /begin IF_DATA ASAP1B_ETK KP_BLOB 0x383B5A 1 2 /end IF_DATA BIT_MASK 0x1 /end MEASUREMENT
/begin MEASUREMENT E_hsv "Errorflag: Lambdasonden-Heizung vor Katalysator" UWORD B_TRUE___UW 0 0 0.000000 0.000000 /begin IF_DATA ASAP1B_ETK KP_BLOB 0x383B5C 1 2 /end IF_DATA BIT_MASK 0x1 /end MEASUREMENT
/begin MEASUREMENT E_hsv2 "Errorflag: Lambdasonden-Heizung vor Katalysator Bank 2" UWORD B_TRUE___UW 0 0 0.000000 0.000000 /begin IF_DATA ASAP1B_ETK KP_BLOB 0x383B5E 1 2 /end IF_DATA BIT_MASK 0x1 /end MEASUREMENT
/begin MEASUREMENT E_kat "Errorflag: Katalysator-Konvertierung" UWORD B_TRUE___UW 0 0 0.000000 0.000000 /begin IF_DATA ASAP1B_ETK KP_BLOB 0x383B60 1 2 /end IF_DATA BIT_MASK 0x1 /end MEASUREMENT
/begin MEASUREMENT E_kpe "Errorflag: EKP-Relais Endstufe" UWORD B_TRUE___UW 0 0 0.000000 0.000000 /begin IF_DATA ASAP1B_ETK KP_BLOB 0x383B62 1 2 /end IF_DATA BIT_MASK 0x1 /end MEASUREMENT
/begin MEASUREMENT E_kra01 "Errorflag: Klopfregelanschlag Zyl.1" UWORD B_TRUE___UW 0 0 0.000000 0.000000 /begin IF_DATA ASAP1B_ETK KP_BLOB 0x383B64 1 2 /end IF_DATA BIT_MASK 0x1 /end MEASUREMENT
/begin MEASUREMENT E_kra02 "Errorflag: Klopfregelanschlag Zyl.2" UWORD B_TRUE___UW 0 0 0.000000 0.000000 /begin IF_DATA ASAP1B_ETK KP_BLOB 0x383B66 1 2 /end IF_DATA BIT_MASK 0x1 /end MEASUREMENT
/begin MEASUREMENT E_kra03 "Errorflag: Klopfregelanschlag Zyl.3" UWORD B_TRUE___UW 0 0 0.000000 0.000000 /begin IF_DATA ASAP1B_ETK KP_BLOB 0x383B68 1 2 /end IF_DATA BIT_MASK 0x1 /end MEASUREMENT
/begin MEASUREMENT E_kra04 "Errorflag: Klopfregelanschlag Zyl.4" UWORD B_TRUE___UW 0 0 0.000000 0.000000 /begin IF_DATA ASAP1B_ETK KP_BLOB 0x383B6A 1 2 /end IF_DATA BIT_MASK 0x1 /end MEASUREMENT
/begin MEASUREMENT E_kra05 "Errorflag: Klopfregelanschlag Zyl.5" UWORD B_TRUE___UW 0 0 0.000000 0.000000 /begin IF_DATA ASAP1B_ETK KP_BLOB 0x383B6C 1 2 /end IF_DATA BIT_MASK 0x1 /end MEASUREMENT
/begin MEASUREMENT E_kra06 "Errorflag: Klopfregelanschlag Zyl.6" UWORD B_TRUE___UW 0 0 0.000000 0.000000 /begin IF_DATA ASAP1B_ETK KP_BLOB 0x383B6E 1 2 /end IF_DATA BIT_MASK 0x1 /end MEASUREMENT
/begin MEASUREMENT E_kra07 "Errorflag: Klopfregelanschlag Zyl.7" UWORD B_TRUE___UW 0 0 0.000000 0.000000 /begin IF_DATA ASAP1B_ETK KP_BLOB 0x383B70 1 2 /end IF_DATA BIT_MASK 0x1 /end MEASUREMENT
/begin MEASUREMENT E_kra08 "Errorflag: Klopfregelanschlag Zyl.8" UWORD B_TRUE___UW 0 0 0.000000 0.000000 /begin IF_DATA ASAP1B_ETK KP_BLOB 0x383B72 1 2 /end IF_DATA BIT_MASK 0x1 /end MEASUREMENT
/begin MEASUREMENT E_krnt "Errorflag: Klopfregelung Nulltest" UWORD B_TRUE___UW 0 0 0.000000 0.000000 /begin IF_DATA ASAP1B_ETK KP_BLOB 0x383B74 1 2 /end IF_DATA BIT_MASK 0x1 /end MEASUREMENT
/begin MEASUREMENT E_krof "Errorflag: Klopfregelung Offset" UWORD B_TRUE___UW 0 0 0.000000 0.000000 /begin IF_DATA ASAP1B_ETK KP_BLOB 0x383B76 1 2 /end IF_DATA BIT_MASK 0x1 /end MEASUREMENT
/begin MEASUREMENT E_krtp "Errorflag: Klopfregelung Testimpuls" UWORD B_TRUE___UW 0 0 0.000000 0.000000 /begin IF_DATA ASAP1B_ETK KP_BLOB 0x383B78 1 2 /end IF_DATA BIT_MASK 0x1 /end MEASUREMENT
/begin MEASUREMENT E_ks1 "Errorflag: Klopfsensor 1" UWORD B_TRUE___UW 0 0 0.000000 0.000000 /begin IF_DATA ASAP1B_ETK KP_BLOB 0x383B7A 1 2 /end IF_DATA BIT_MASK 0x1 /end MEASUREMENT
/begin MEASUREMENT E_ks2 "Errorflag: Klopfsensor 2" UWORD B_TRUE___UW 0 0 0.000000 0.000000 /begin IF_DATA ASAP1B_ETK KP_BLOB 0x383B7C 1 2 /end IF_DATA BIT_MASK 0x1 /end MEASUREMENT
/begin MEASUREMENT E_ks3 "Errorflag: Klopfsensor 3" UWORD B_TRUE___UW 0 0 0.000000 0.000000 /begin IF_DATA ASAP1B_ETK KP_BLOB 0x383B7E 1 2 /end IF_DATA BIT_MASK 0x1 /end MEASUREMENT
/begin MEASUREMENT E_ks4 "Errorflag: Klopfsensor 4" UWORD B_TRUE___UW 0 0 0.000000 0.000000 /begin IF_DATA ASAP1B_ETK KP_BLOB 0x383B80 1 2 /end IF_DATA BIT_MASK 0x1 /end MEASUREMENT
/begin MEASUREMENT E_kuppl "Fehlerflag: Gebergrî·e Kupplung" UWORD B_TRUE___UW 0 0 0.000000 0.000000 /begin IF_DATA ASAP1B_ETK KP_BLOB 0x383B82 1 2 /end IF_DATA BIT_MASK 0x1 /end MEASUREMENT
/begin MEASUREMENT E_lash "Errorflag: Lambda-Sondenalterung hinter Kat." UWORD B_TRUE___UW 0 0 0.000000 0.000000 /begin IF_DATA ASAP1B_ETK KP_BLOB 0x383B84 1 2 /end IF_DATA BIT_MASK 0x1 /end MEASUREMENT
/begin MEASUREMENT E_lash2 "Errorflag: Lambda-Sondenalterung hinter Kat. (Bank 2)" UWORD B_TRUE___UW 0 0 0.000000 0.000000 /begin IF_DATA ASAP1B_ETK KP_BLOB 0x383B86 1 2 /end IF_DATA BIT_MASK 0x1 /end MEASUREMENT
/begin MEASUREMENT E_latp "Errorflag: Lambda-Sondenalterung TP" UWORD B_TRUE___UW 0 0 0.000000 0.000000 /begin IF_DATA ASAP1B_ETK KP_BLOB 0x383B88 1 2 /end IF_DATA BIT_MASK 0x1 /end MEASUREMENT
/begin MEASUREMENT E_latp2 "Errorflag: Lambda-Sondenalterung TP (Bank 2)" UWORD B_TRUE___UW 0 0 0.000000 0.000000 /begin IF_DATA ASAP1B_ETK KP_BLOB 0x383B8A 1 2 /end IF_DATA BIT_MASK 0x1 /end MEASUREMENT
/begin MEASUREMENT E_latv "Errorflag: Lambda-Sondenalterung TV" UWORD B_TRUE___UW 0 0 0.000000 0.000000 /begin IF_DATA ASAP1B_ETK KP_BLOB 0x383B8C 1 2 /end IF_DATA BIT_MASK 0x1 /end MEASUREMENT
/begin MEASUREMENT E_latv2 "Errorflag: Lambda-Sondenalterung TV (Bank 2)" UWORD B_TRUE___UW 0 0 0.000000 0.000000 /begin IF_DATA ASAP1B_ETK KP_BLOB 0x383B8E 1 2 /end IF_DATA BIT_MASK 0x1 /end MEASUREMENT
/begin MEASUREMENT E_lde "Errorflag: Ladedrucksteuerventil (Endstufe)" UWORD B_TRUE___UW 0 0 0.000000 0.000000 /begin IF_DATA ASAP1B_ETK KP_BLOB 0x383B90 1 2 /end IF_DATA BIT_MASK 0x1 /end MEASUREMENT
/begin MEASUREMENT E_ldo "Errorflag: Ladedruckkennlinie; oberer Wert Åberschritten" UWORD B_TRUE___UW 0 0 0.000000 0.000000 /begin IF_DATA ASAP1B_ETK KP_BLOB 0x383B92 1 2 /end IF_DATA BIT_MASK 0x1 /end MEASUREMENT
/begin MEASUREMENT E_ldp "Errorflag: Leckdiagnosemodul" UWORD B_TRUE___UW 0 0 0.000000 0.000000 /begin IF_DATA ASAP1B_ETK KP_BLOB 0x383B94 1 2 /end IF_DATA BIT_MASK 0x1 /end MEASUREMENT
/begin MEASUREMENT E_ldra "Errorflag: Ladedruckregelabweichung" UWORD B_TRUE___UW 0 0 0.000000 0.000000 /begin IF_DATA ASAP1B_ETK KP_BLOB 0x383B98 1 2 /end IF_DATA BIT_MASK 0x1 /end MEASUREMENT
/begin MEASUREMENT E_llr "Errorflag: Leerlaufregelung" UWORD B_TRUE___UW 0 0 0.000000 0.000000 /begin IF_DATA ASAP1B_ETK KP_BLOB 0x383B9A 1 2 /end IF_DATA BIT_MASK 0x1 /end MEASUREMENT
/begin MEASUREMENT E_lm "Errorflag: Hauptlastsensor" UWORD B_TRUE___UW 0 0 0.000000 0.000000 /begin IF_DATA ASAP1B_ETK KP_BLOB 0x383B9C 1 2 /end IF_DATA BIT_MASK 0x1 /end MEASUREMENT
/begin MEASUREMENT E_lsh "Errorflag: Lambda-Sonde hinter Kat" UWORD B_TRUE___UW 0 0 0.000000 0.000000 /begin IF_DATA ASAP1B_ETK KP_BLOB 0x383B9E 1 2 /end IF_DATA BIT_MASK 0x1 /end MEASUREMENT
/begin MEASUREMENT E_lsv "Errorflag: Lambda-Sonde vor Kat" UWORD B_TRUE___UW 0 0 0.000000 0.000000 /begin IF_DATA ASAP1B_ETK KP_BLOB 0x383BA0 1 2 /end IF_DATA BIT_MASK 0x1 /end MEASUREMENT
/begin MEASUREMENT E_mile "Fehlerflag: MIL-Endstufe" UWORD B_TRUE___UW 0 0 0.000000 0.000000 /begin IF_DATA ASAP1B_ETK KP_BLOB 0x383BB8 1 2 /end IF_DATA BIT_MASK 0x1 /end MEASUREMENT
/begin MEASUREMENT E_nwse "Errorflag: Nockenwellensteuerungsventil Endstufe" UWORD B_TRUE___UW 0 0 0.000000 0.000000 /begin IF_DATA ASAP1B_ETK KP_BLOB 0x383BC4 1 2 /end IF_DATA BIT_MASK 0x1 /end MEASUREMENT
/begin MEASUREMENT E_rkat "Errorflag DKVS (additive Korrektur pro Zeit)" UWORD B_TRUE___UW 0 0 0.000000 0.000000 /begin IF_DATA ASAP1B_ETK KP_BLOB 0x383BCC 1 2 /end IF_DATA BIT_MASK 0x1 /end MEASUREMENT
/begin MEASUREMENT E_rkaz "Errorflag DKVS (additive Korrektur pro ZÅndung)" UWORD B_TRUE___UW 0 0 0.000000 0.000000 /begin IF_DATA ASAP1B_ETK KP_BLOB 0x383BCE 1 2 /end IF_DATA BIT_MASK 0x1 /end MEASUREMENT
/begin MEASUREMENT E_slpe "Errorflag: SekundÑrluftpumpe (Endstufe)" UWORD B_TRUE___UW 0 0 0.000000 0.000000 /begin IF_DATA ASAP1B_ETK KP_BLOB 0x383BD2 1 2 /end IF_DATA BIT_MASK 0x1 /end MEASUREMENT
/begin MEASUREMENT E_slve "Errorflag: SekundÑrluftventil (Endstufe)" UWORD B_TRUE___UW 0 0 0.000000 0.000000 /begin IF_DATA ASAP1B_ETK KP_BLOB 0x383BD8 1 2 /end IF_DATA BIT_MASK 0x1 /end MEASUREMENT
/begin MEASUREMENT E_sue "Errorflag: Endstufe Saugrohrumschaltung" UWORD B_TRUE___UW 0 0 0.000000 0.000000 /begin IF_DATA ASAP1B_ETK KP_BLOB 0x383BDC 1 2 /end IF_DATA BIT_MASK 0x1 /end MEASUREMENT
/begin MEASUREMENT E_tesf "Errorflag: TankentlÅftungssystem Feinleck" UWORD B_TRUE___UW 0 0 0.000000 0.000000 /begin IF_DATA ASAP1B_ETK KP_BLOB 0x383BE6 1 2 /end IF_DATA BIT_MASK 0x1 /end MEASUREMENT
/begin MEASUREMENT E_tesg "Errorflag: TankentlÅftungssystem Grobleck" UWORD B_TRUE___UW 0 0 0.000000 0.000000 /begin IF_DATA ASAP1B_ETK KP_BLOB 0x383BE8 1 2 /end IF_DATA BIT_MASK 0x1 /end MEASUREMENT
/begin MEASUREMENT E_teve "Errorflag: TankentlÅftungsventil Endstufe" UWORD B_TRUE___UW 0 0 0.000000 0.000000 /begin IF_DATA ASAP1B_ETK KP_BLOB 0x383BEA 1 2 /end IF_DATA BIT_MASK 0x1 /end MEASUREMENT
/begin MEASUREMENT E_uvse "Errorflag: Endstufe Umluftventil Turbo" UWORD B_TRUE___UW 0 0 0.000000 0.000000 /begin IF_DATA ASAP1B_ETK KP_BLOB 0x383C02 1 2 /end IF_DATA BIT_MASK 0x1 /end MEASUREMENT
/begin MEASUREMENT E_zet1 "Errorflag: ZÅndtreiber ZUE1" UWORD B_TRUE___UW 0 0 0.000000 0.000000 /begin IF_DATA ASAP1B_ETK KP_BLOB 0x383C0A 1 2 /end IF_DATA BIT_MASK 0x1 /end MEASUREMENT
/begin MEASUREMENT E_zet2 "Errorflag: ZÅndtreiber ZUE2" UWORD B_TRUE___UW 0 0 0.000000 0.000000 /begin IF_DATA ASAP1B_ETK KP_BLOB 0x383C0C 1 2 /end IF_DATA BIT_MASK 0x1 /end MEASUREMENT
/begin MEASUREMENT E_zet3 "Errorflag: ZÅndtreiber ZUE3" UWORD B_TRUE___UW 0 0 0.000000 0.000000 /begin IF_DATA ASAP1B_ETK KP_BLOB 0x383C0E 1 2 /end IF_DATA BIT_MASK 0x1 /end MEASUREMENT
/begin MEASUREMENT E_zet4 "Errorflag: ZÅndtreiber ZUE4" UWORD B_TRUE___UW 0 0 0.000000 0.000000 /begin IF_DATA ASAP1B_ETK KP_BLOB 0x383C10 1 2 /end IF_DATA BIT_MASK 0x1 /end MEASUREMENT
/begin MEASUREMENT E_zet5 "Errorflag: ZÅndtreiber ZUE5" UWORD B_TRUE___UW 0 0 0.000000 0.000000 /begin IF_DATA ASAP1B_ETK KP_BLOB 0x383C12 1 2 /end IF_DATA BIT_MASK 0x1 /end MEASUREMENT
/begin MEASUREMENT E_zet6 "Errorflag: ZÅndtreiber ZUE6" UWORD B_TRUE___UW 0 0 0.000000 0.000000 /begin IF_DATA ASAP1B_ETK KP_BLOB 0x383C14 1 2 /end IF_DATA BIT_MASK 0x1 /end MEASUREMENT
/begin MEASUREMENT E_zet7 "" UWORD B_TRUE___UW 0 0 0.000000 0.000000 /begin IF_DATA ASAP1B_ETK KP_BLOB 0x383C16 1 2 /end IF_DATA BIT_MASK 0x1 /end MEASUREMENT
/begin MEASUREMENT E_zet8 "" UWORD B_TRUE___UW 0 0 0.000000 0.000000 /begin IF_DATA ASAP1B_ETK KP_BLOB 0x383C18 1 2 /end IF_DATA BIT_MASK 0x1 /end MEASUREMENT
/begin MEASUREMENT sfpaaa "Dummy: Tabellenanfang" UWORD dez___UW 0 0 0.000000 65535.000000 /begin IF_DATA ASAP1B_ETK KP_BLOB 0x383AEE 1 2 /end IF_DATA BIT_MASK 0xFFFF /end MEASUREMENT
/begin MEASUREMENT sfpaave "Status Fehlerpfad: AAV-Ventil Endstufe" UWORD default 0 0 0.000000 65535.000000 /begin IF_DATA ASAP1B_ETK KP_BLOB 0x383AF0 1 2 /end IF_DATA BIT_MASK 0xFFFF /end MEASUREMENT
/begin MEASUREMENT sfpagre "Status Fehlerpfad: AGR-Ventil Endstufe" UWORD default 0 0 0.000000 65535.000000 /begin IF_DATA ASAP1B_ETK KP_BLOB 0x383AF2 1 2 /end IF_DATA BIT_MASK 0xFFFF /end MEASUREMENT
/begin MEASUREMENT sfpepcle "Status Fehlerpfad: Fahrverhaltens-Fehllampe Endstufe" UWORD default 0 0 0.000000 65535.000000 /begin IF_DATA ASAP1B_ETK KP_BLOB 0x383B32 1 2 /end IF_DATA BIT_MASK 0xFFFF /end MEASUREMENT
/begin MEASUREMENT sfpetse "Status Fehlerpfad: elektrisches Thermostat Endstufe" UWORD default 0 0 0.000000 65535.000000 /begin IF_DATA ASAP1B_ETK KP_BLOB 0x383B34 1 2 /end IF_DATA BIT_MASK 0xFFFF /end MEASUREMENT
/begin MEASUREMENT sfpev1 "Status Fehlerpfad: EV1" UWORD default 0 0 0.000000 65535.000000 /begin IF_DATA ASAP1B_ETK KP_BLOB 0x383B36 1 2 /end IF_DATA BIT_MASK 0xFFFF /end MEASUREMENT
/begin MEASUREMENT sfpev2 "Status Fehlerpfad: EV2" UWORD default 0 0 0.000000 65535.000000 /begin IF_DATA ASAP1B_ETK KP_BLOB 0x383B38 1 2 /end IF_DATA BIT_MASK 0xFFFF /end MEASUREMENT
/begin MEASUREMENT sfpev3 "Status Fehlerpfad: EV3" UWORD default 0 0 0.000000 65535.000000 /begin IF_DATA ASAP1B_ETK KP_BLOB 0x383B3A 1 2 /end IF_DATA BIT_MASK 0xFFFF /end MEASUREMENT
/begin MEASUREMENT sfpev4 "Status Fehlerpfad: EV4" UWORD default 0 0 0.000000 65535.000000 /begin IF_DATA ASAP1B_ETK KP_BLOB 0x383B3C 1 2 /end IF_DATA BIT_MASK 0xFFFF /end MEASUREMENT
/begin MEASUREMENT sfpev5 "Status Fehlerpfad: EV5" UWORD default 0 0 0.000000 65535.000000 /begin IF_DATA ASAP1B_ETK KP_BLOB 0x383B3E 1 2 /end IF_DATA BIT_MASK 0xFFFF /end MEASUREMENT
/begin MEASUREMENT sfpev6 "Status Fehlerpfad: EV6" UWORD default 0 0 0.000000 65535.000000 /begin IF_DATA ASAP1B_ETK KP_BLOB 0x383B40 1 2 /end IF_DATA BIT_MASK 0xFFFF /end MEASUREMENT
/begin MEASUREMENT sfpev7 "Status Fehlerpfad: EV7" UWORD default 0 0 0.000000 65535.000000 /begin IF_DATA ASAP1B_ETK KP_BLOB 0x383B42 1 2 /end IF_DATA BIT_MASK 0xFFFF /end MEASUREMENT
/begin MEASUREMENT sfpev8 "Status Fehlerpfad: EV8" UWORD default 0 0 0.000000 65535.000000 /begin IF_DATA ASAP1B_ETK KP_BLOB 0x383B44 1 2 /end IF_DATA BIT_MASK 0xFFFF /end MEASUREMENT
/begin MEASUREMENT sfpfrao "Status Fehlerpfad FRAO" UWORD dez___UW 0 0 0.000000 65535.000000 /begin IF_DATA ASAP1B_ETK KP_BLOB 0x383B4C 1 2 /end IF_DATA BIT_MASK 0xFFFF /end MEASUREMENT
/begin MEASUREMENT sfpfrau "Status Fehlerpfad FRAU" UWORD dez___UW 0 0 0.000000 65535.000000 /begin IF_DATA ASAP1B_ETK KP_BLOB 0x383B4E 1 2 /end IF_DATA BIT_MASK 0xFFFF /end MEASUREMENT
/begin MEASUREMENT sfpfrst "Status Fehlerpfad: LR-Abweichung" UWORD dez___UW 0 0 0.000000 65535.000000 /begin IF_DATA ASAP1B_ETK KP_BLOB 0x383B50 1 2 /end IF_DATA BIT_MASK 0xFFFF /end MEASUREMENT
/begin MEASUREMENT sfphsh "Status Fehlerpfad: Heizung Lambdasonde hinter Kat" UWORD dez___UW 0 0 0.000000 65535.000000 /begin IF_DATA ASAP1B_ETK KP_BLOB 0x383B56 1 2 /end IF_DATA BIT_MASK 0xFFFF /end MEASUREMENT
/begin MEASUREMENT sfphshe "Status Fehlerpfad: Endstufe Heizung Lambdasonde hinter Kat" UWORD default 0 0 0.000000 65535.000000 /begin IF_DATA ASAP1B_ETK KP_BLOB 0x383B58 1 2 /end IF_DATA BIT_MASK 0xFFFF /end MEASUREMENT
/begin MEASUREMENT sfphshe2 "Status Fehlerpfad: Endstufe Heizung Lambdasonde 2 hinter Kat" UWORD default 0 0 0.000000 65535.000000 /begin IF_DATA ASAP1B_ETK KP_BLOB 0x383B5A 1 2 /end IF_DATA BIT_MASK 0xFFFF /end MEASUREMENT
/begin MEASUREMENT sfphsv "Status Fehlerpfad: Heizung Lambdasonde vor Kat" UWORD dez___UW 0 0 0.000000 65535.000000 /begin IF_DATA ASAP1B_ETK KP_BLOB 0x383B5C 1 2 /end IF_DATA BIT_MASK 0xFFFF /end MEASUREMENT
/begin MEASUREMENT sfphsv2 "Status Fehlerpfad: Heizung Lambdasonde 2 vor Kat" UWORD dez___UW 0 0 0.000000 65535.000000 /begin IF_DATA ASAP1B_ETK KP_BLOB 0x383B5E 1 2 /end IF_DATA BIT_MASK 0xFFFF /end MEASUREMENT
/begin MEASUREMENT sfpkat "Status Fehlerpfad: Katalysator-öberwachung" UWORD dez___UW 0 0 0.000000 65535.000000 /begin IF_DATA ASAP1B_ETK KP_BLOB 0x383B60 1 2 /end IF_DATA BIT_MASK 0xFFFF /end MEASUREMENT
/begin MEASUREMENT sfpkpe "Status Fehlerpfad: EKP-Relais Endstufe" UWORD default 0 0 0.000000 65535.000000 /begin IF_DATA ASAP1B_ETK KP_BLOB 0x383B62 1 2 /end IF_DATA BIT_MASK 0xFFFF /end MEASUREMENT
/begin MEASUREMENT sfpkra01 "Status Fehlerpfad: Klopfregelanschlag Zylinder 1" UWORD dez___UW 0 0 0.000000 65535.000000 /begin IF_DATA ASAP1B_ETK KP_BLOB 0x383B64 1 2 /end IF_DATA BIT_MASK 0xFFFF /end MEASUREMENT
/begin MEASUREMENT sfpkra02 "Status Fehlerpfad: Klopfregelanschlag Zylinder 2" UWORD dez___UW 0 0 0.000000 65535.000000 /begin IF_DATA ASAP1B_ETK KP_BLOB 0x383B66 1 2 /end IF_DATA BIT_MASK 0xFFFF /end MEASUREMENT
/begin MEASUREMENT sfpkra03 "Status Fehlerpfad: Klopfregelanschlag Zylinder 3" UWORD dez___UW 0 0 0.000000 65535.000000 /begin IF_DATA ASAP1B_ETK KP_BLOB 0x383B68 1 2 /end IF_DATA BIT_MASK 0xFFFF /end MEASUREMENT
/begin MEASUREMENT sfpkra04 "Status Fehlerpfad: Klopfregelanschlag Zylinder 4" UWORD dez___UW 0 0 0.000000 65535.000000 /begin IF_DATA ASAP1B_ETK KP_BLOB 0x383B6A 1 2 /end IF_DATA BIT_MASK 0xFFFF /end MEASUREMENT
/begin MEASUREMENT sfpkra05 "Status Fehlerpfad: Klopfregelanschlag Zylinder 5" UWORD dez___UW 0 0 0.000000 65535.000000 /begin IF_DATA ASAP1B_ETK KP_BLOB 0x383B6C 1 2 /end IF_DATA BIT_MASK 0xFFFF /end MEASUREMENT
/begin MEASUREMENT sfpkra06 "Status Fehlerpfad: Klopfregelanschlag Zylinder 6" UWORD dez___UW 0 0 0.000000 65535.000000 /begin IF_DATA ASAP1B_ETK KP_BLOB 0x383B6E 1 2 /end IF_DATA BIT_MASK 0xFFFF /end MEASUREMENT
/begin MEASUREMENT sfpkra07 "Status Fehlerpfad: Klopfregelanschlag Zylinder 7" UWORD dez___UW 0 0 0.000000 65535.000000 /begin IF_DATA ASAP1B_ETK KP_BLOB 0x383B70 1 2 /end IF_DATA BIT_MASK 0xFFFF /end MEASUREMENT
/begin MEASUREMENT sfpkra08 "Status Fehlerpfad: Klopfregelanschlag Zylinder 8" UWORD dez___UW 0 0 0.000000 65535.000000 /begin IF_DATA ASAP1B_ETK KP_BLOB 0x383B72 1 2 /end IF_DATA BIT_MASK 0xFFFF /end MEASUREMENT
/begin MEASUREMENT sfpkrnt "Status Fehlerpfad: Klopfregelung Nulltest" UWORD dez___UW 0 0 0.000000 65535.000000 /begin IF_DATA ASAP1B_ETK KP_BLOB 0x383B74 1 2 /end IF_DATA BIT_MASK 0xFFFF /end MEASUREMENT
/begin MEASUREMENT sfpkrof "Status Fehlerpfad: Klopfregelung Offset" UWORD dez___UW 0 0 0.000000 65535.000000 /begin IF_DATA ASAP1B_ETK KP_BLOB 0x383B76 1 2 /end IF_DATA BIT_MASK 0xFFFF /end MEASUREMENT
/begin MEASUREMENT sfpkrtp "Status Fehlerpfad: Klopfregelung Testimpuls" UWORD dez___UW 0 0 0.000000 65535.000000 /begin IF_DATA ASAP1B_ETK KP_BLOB 0x383B78 1 2 /end IF_DATA BIT_MASK 0xFFFF /end MEASUREMENT
/begin MEASUREMENT sfpks1 "Status Fehlerpfad: Klopfsensor 1" UWORD dez___UW 0 0 0.000000 65535.000000 /begin IF_DATA ASAP1B_ETK KP_BLOB 0x383B7A 1 2 /end IF_DATA BIT_MASK 0xFFFF /end MEASUREMENT
/begin MEASUREMENT sfpks2 "Status Fehlerpfad: Klopfsensor 2" UWORD dez___UW 0 0 0.000000 65535.000000 /begin IF_DATA ASAP1B_ETK KP_BLOB 0x383B7C 1 2 /end IF_DATA BIT_MASK 0xFFFF /end MEASUREMENT
/begin MEASUREMENT sfpks3 "Status Fehlerpfad: Klopfsensor 3" UWORD dez___UW 0 0 0.000000 65535.000000 /begin IF_DATA ASAP1B_ETK KP_BLOB 0x383B7E 1 2 /end IF_DATA BIT_MASK 0xFFFF /end MEASUREMENT
/begin MEASUREMENT sfpks4 "Status Fehlerpfad: Klopfsensor 4" UWORD dez___UW 0 0 0.000000 65535.000000 /begin IF_DATA ASAP1B_ETK KP_BLOB 0x383B80 1 2 /end IF_DATA BIT_MASK 0xFFFF /end MEASUREMENT
/begin MEASUREMENT sfpkuppl "Status Fehlerpfad KUPPL: Gebergrî·e Kupplung" UWORD dez___UW 0 0 0.000000 65535.000000 /begin IF_DATA ASAP1B_ETK KP_BLOB 0x383B82 1 2 /end IF_DATA BIT_MASK 0xFFFF /end MEASUREMENT
/begin MEASUREMENT sfplash "Status Fehlerpfad: Lambdasondenalterung hinter Kat" UWORD dez___UW 0 0 0.000000 65535.000000 /begin IF_DATA ASAP1B_ETK KP_BLOB 0x383B84 1 2 /end IF_DATA BIT_MASK 0xFFFF /end MEASUREMENT
/begin MEASUREMENT sfplash2 "Status Fehlerpfad: Lambdasondenalterung hinter Kat Bank2" UWORD dez___UW 0 0 0.000000 65535.000000 /begin IF_DATA ASAP1B_ETK KP_BLOB 0x383B86 1 2 /end IF_DATA BIT_MASK 0xFFFF /end MEASUREMENT
/begin MEASUREMENT sfplatp "Status Fehlerpfad: Diagnose Lambdasondenalterung Tp vor Kat" UWORD dez___UW 0 0 0.000000 65535.000000 /begin IF_DATA ASAP1B_ETK KP_BLOB 0x383B88 1 2 /end IF_DATA BIT_MASK 0xFFFF /end MEASUREMENT
/begin MEASUREMENT sfplatp2 "Status Fehlerpfad: Diagnose Lambdasondenalterung Tp vor Kat Bank2" UWORD dez___UW 0 0 0.000000 65535.000000 /begin IF_DATA ASAP1B_ETK KP_BLOB 0x383B8A 1 2 /end IF_DATA BIT_MASK 0xFFFF /end MEASUREMENT
/begin MEASUREMENT sfplatv "Status Fehlerpfad: Diagnose Lambdasondenalterung Tv vor Kat" UWORD dez___UW 0 0 0.000000 65535.000000 /begin IF_DATA ASAP1B_ETK KP_BLOB 0x383B8C 1 2 /end IF_DATA BIT_MASK 0xFFFF /end MEASUREMENT
/begin MEASUREMENT sfplatv2 "Status Fehlerpfad: Diagnose Lambdasondenalterung Tv vor Kat Bank2" UWORD dez___UW 0 0 0.000000 65535.000000 /begin IF_DATA ASAP1B_ETK KP_BLOB 0x383B8E 1 2 /end IF_DATA BIT_MASK 0xFFFF /end MEASUREMENT
/begin MEASUREMENT sfplde "Status Fehlerpfad: Ladedrucksteuerventil Endstufe" UWORD default 0 0 0.000000 65535.000000 /begin IF_DATA ASAP1B_ETK KP_BLOB 0x383B90 1 2 /end IF_DATA BIT_MASK 0xFFFF /end MEASUREMENT
/begin MEASUREMENT sfpldo "Status Fehlerpfad: öberladefehler LDR" UWORD dez___UW 0 0 0.000000 65535.000000 /begin IF_DATA ASAP1B_ETK KP_BLOB 0x383B92 1 2 /end IF_DATA BIT_MASK 0xFFFF /end MEASUREMENT
/begin MEASUREMENT sfpldp "Status Fehlerpfad:Leckdiagnosemodul" UWORD default 0 0 0.000000 65535.000000 /begin IF_DATA ASAP1B_ETK KP_BLOB 0x383B94 1 2 /end IF_DATA BIT_MASK 0xFFFF /end MEASUREMENT
/begin MEASUREMENT sfpldra "Status Fehlerpfad: Regelabweichung LDR" UWORD dez___UW 0 0 0.000000 65535.000000 /begin IF_DATA ASAP1B_ETK KP_BLOB 0x383B98 1 2 /end IF_DATA BIT_MASK 0xFFFF /end MEASUREMENT
/begin MEASUREMENT sfpllr "Status Fehlerpfad: Leerlaufregelung" UWORD dez___UW 0 0 0.000000 65535.000000 /begin IF_DATA ASAP1B_ETK KP_BLOB 0x383B9A 1 2 /end IF_DATA BIT_MASK 0xFFFF /end MEASUREMENT
/begin MEASUREMENT sfplm "Status Fehlerpfad: HauptfÅllungssensor" UWORD dez___UW 0 0 0.000000 65535.000000 /begin IF_DATA ASAP1B_ETK KP_BLOB 0x383B9C 1 2 /end IF_DATA BIT_MASK 0xFFFF /end MEASUREMENT
/begin MEASUREMENT sfplsh "Status Fehlerpfad: Diagnose Lambdasonde hinter Kat" UWORD dez___UW 0 0 0.000000 65535.000000 /begin IF_DATA ASAP1B_ETK KP_BLOB 0x383B9E 1 2 /end IF_DATA BIT_MASK 0xFFFF /end MEASUREMENT
/begin MEASUREMENT sfplsv "Status Fehlerpfad: Diagnose Lambdasonde vor Kat" UWORD dez___UW 0 0 0.000000 65535.000000 /begin IF_DATA ASAP1B_ETK KP_BLOB 0x383BA0 1 2 /end IF_DATA BIT_MASK 0xFFFF /end MEASUREMENT
/begin MEASUREMENT sfpmile "Status Fehlerpfad: Mil - Endstufe" UWORD default 0 0 0.000000 65535.000000 /begin IF_DATA ASAP1B_ETK KP_BLOB 0x383BB8 1 2 /end IF_DATA BIT_MASK 0xFFFF /end MEASUREMENT
/begin MEASUREMENT sfpnwse "Status Fehlerpfad: Nockenwellensteuerungsventil Endstufe" UWORD default 0 0 0.000000 65535.000000 /begin IF_DATA ASAP1B_ETK KP_BLOB 0x383BC4 1 2 /end IF_DATA BIT_MASK 0xFFFF /end MEASUREMENT
/begin MEASUREMENT sfprkat "Status Fehlerpfad RKAT" UWORD dez___UW 0 0 0.000000 65535.000000 /begin IF_DATA ASAP1B_ETK KP_BLOB 0x383BCC 1 2 /end IF_DATA BIT_MASK 0xFFFF /end MEASUREMENT
/begin MEASUREMENT sfprkaz "Status Fehlerpfad RKAZ" UWORD dez___UW 0 0 0.000000 65535.000000 /begin IF_DATA ASAP1B_ETK KP_BLOB 0x383BCE 1 2 /end IF_DATA BIT_MASK 0xFFFF /end MEASUREMENT
/begin MEASUREMENT sfpslpe "Status Fehlerpfad: SekundÑrluftpumpe Endstufe" UWORD default 0 0 0.000000 65535.000000 /begin IF_DATA ASAP1B_ETK KP_BLOB 0x383BD2 1 2 /end IF_DATA BIT_MASK 0xFFFF /end MEASUREMENT
/begin MEASUREMENT sfpslve "Status Fehlerpfad: SekundÑrluftventil Endstufe" UWORD default 0 0 0.000000 65535.000000 /begin IF_DATA ASAP1B_ETK KP_BLOB 0x383BD8 1 2 /end IF_DATA BIT_MASK 0xFFFF /end MEASUREMENT
/begin MEASUREMENT sfpsue "Status Fehlerpfad: Endstufe Saugrohrumschaltung" UWORD default 0 0 0.000000 65535.000000 /begin IF_DATA ASAP1B_ETK KP_BLOB 0x383BDC 1 2 /end IF_DATA BIT_MASK 0xFFFF /end MEASUREMENT
/begin MEASUREMENT sfptesf "Status Fehlerpfad: Tankdiagnose, Feinleck" UWORD default 0 0 0.000000 65535.000000 /begin IF_DATA ASAP1B_ETK KP_BLOB 0x383BE6 1 2 /end IF_DATA BIT_MASK 0xFFFF /end MEASUREMENT
/begin MEASUREMENT sfptesg "Status Fehlerpfad: Tankdiagnose, Grobleck" UWORD default 0 0 0.000000 65535.000000 /begin IF_DATA ASAP1B_ETK KP_BLOB 0x383BE8 1 2 /end IF_DATA BIT_MASK 0xFFFF /end MEASUREMENT
/begin MEASUREMENT sfpteve "Status Fehlerpfad: TanklÅftungsventil Endstufe" UWORD default 0 0 0.000000 65535.000000 /begin IF_DATA ASAP1B_ETK KP_BLOB 0x383BEA 1 2 /end IF_DATA BIT_MASK 0xFFFF /end MEASUREMENT
/begin MEASUREMENT sfpuvse "Status Fehlerpfad: Endstufe Umluftventil Turbo" UWORD default 0 0 0.000000 65535.000000 /begin IF_DATA ASAP1B_ETK KP_BLOB 0x383C02 1 2 /end IF_DATA BIT_MASK 0xFFFF /end MEASUREMENT
/begin MEASUREMENT sfpzet1 "" UWORD default 0 0 0.000000 65535.000000 /begin IF_DATA ASAP1B_ETK KP_BLOB 0x383C0A 1 2 /end IF_DATA BIT_MASK 0xFFFF /end MEASUREMENT
/begin MEASUREMENT sfpzet2 "" UWORD default 0 0 0.000000 65535.000000 /begin IF_DATA ASAP1B_ETK KP_BLOB 0x383C0C 1 2 /end IF_DATA BIT_MASK 0xFFFF /end MEASUREMENT
/begin MEASUREMENT sfpzet3 "" UWORD default 0 0 0.000000 65535.000000 /begin IF_DATA ASAP1B_ETK KP_BLOB 0x383C0E 1 2 /end IF_DATA BIT_MASK 0xFFFF /end MEASUREMENT
/begin MEASUREMENT sfpzet4 "" UWORD default 0 0 0.000000 65535.000000 /begin IF_DATA ASAP1B_ETK KP_BLOB 0x383C10 1 2 /end IF_DATA BIT_MASK 0xFFFF /end MEASUREMENT
/begin MEASUREMENT sfpzet5 "" UWORD default 0 0 0.000000 65535.000000 /begin IF_DATA ASAP1B_ETK KP_BLOB 0x383C12 1 2 /end IF_DATA BIT_MASK 0xFFFF /end MEASUREMENT
/begin MEASUREMENT sfpzet6 "" UWORD default 0 0 0.000000 65535.000000 /begin IF_DATA ASAP1B_ETK KP_BLOB 0x383C14 1 2 /end IF_DATA BIT_MASK 0xFFFF /end MEASUREMENT
/begin MEASUREMENT sfpzet7 "" UWORD default 0 0 0.000000 65535.000000 /begin IF_DATA ASAP1B_ETK KP_BLOB 0x383C16 1 2 /end IF_DATA BIT_MASK 0xFFFF /end MEASUREMENT
/begin MEASUREMENT sfpzet8 "" UWORD default 0 0 0.000000 65535.000000 /begin IF_DATA ASAP1B_ETK KP_BLOB 0x383C18 1 2 /end IF_DATA BIT_MASK 0xFFFF /end MEASUREMENT
/begin MEASUREMENT sfpzzz "Dummy: Tabellenende" UWORD dez___UW 0 0 0.000000 65535.000000 /begin IF_DATA ASAP1B_ETK KP_BLOB 0x383C1A 1 2 /end IF_DATA BIT_MASK 0xFFFF /end MEASUREMENT
/begin MEASUREMENT TYPkra01 "" UWORD B_TRUE___UW 0 0 0.000000 0.000000 /begin IF_DATA ASAP1B_ETK KP_BLOB 0x383B64 1 2 /end IF_DATA BIT_MASK 0xF00 /end MEASUREMENT
/begin MEASUREMENT TYPkra02 "" UWORD B_TRUE___UW 0 0 0.000000 0.000000 /begin IF_DATA ASAP1B_ETK KP_BLOB 0x383B66 1 2 /end IF_DATA BIT_MASK 0xF00 /end MEASUREMENT
/begin MEASUREMENT TYPkra03 "" UWORD B_TRUE___UW 0 0 0.000000 0.000000 /begin IF_DATA ASAP1B_ETK KP_BLOB 0x383B68 1 2 /end IF_DATA BIT_MASK 0xF00 /end MEASUREMENT
/begin MEASUREMENT TYPkra04 "" UWORD B_TRUE___UW 0 0 0.000000 0.000000 /begin IF_DATA ASAP1B_ETK KP_BLOB 0x383B6A 1 2 /end IF_DATA BIT_MASK 0xF00 /end MEASUREMENT
/begin MEASUREMENT TYPkra05 "" UWORD B_TRUE___UW 0 0 0.000000 0.000000 /begin IF_DATA ASAP1B_ETK KP_BLOB 0x383B6C 1 2 /end IF_DATA BIT_MASK 0xF00 /end MEASUREMENT
/begin MEASUREMENT TYPkra06 "" UWORD B_TRUE___UW 0 0 0.000000 0.000000 /begin IF_DATA ASAP1B_ETK KP_BLOB 0x383B6E 1 2 /end IF_DATA BIT_MASK 0xF00 /end MEASUREMENT
/begin MEASUREMENT TYPkra07 "" UWORD B_TRUE___UW 0 0 0.000000 0.000000 /begin IF_DATA ASAP1B_ETK KP_BLOB 0x383B70 1 2 /end IF_DATA BIT_MASK 0xF00 /end MEASUREMENT
/begin MEASUREMENT TYPkra08 "" UWORD B_TRUE___UW 0 0 0.000000 0.000000 /begin IF_DATA ASAP1B_ETK KP_BLOB 0x383B72 1 2 /end IF_DATA BIT_MASK 0xF00 /end MEASUREMENT
/begin MEASUREMENT TYP_aave "Fehlertyp: Endstufe AKF-Absperrventil (AAV)" UWORD B_TRUE___UW 0 0 0.000000 0.000000 /begin IF_DATA ASAP1B_ETK KP_BLOB 0x383AF0 1 2 /end IF_DATA BIT_MASK 0xF00 /end MEASUREMENT
/begin MEASUREMENT TYP_agre "" UWORD B_TRUE___UW 0 0 0.000000 0.000000 /begin IF_DATA ASAP1B_ETK KP_BLOB 0x383AF2 1 2 /end IF_DATA BIT_MASK 0xF00 /end MEASUREMENT
/begin MEASUREMENT TYP_epcle "" UWORD B_TRUE___UW 0 0 0.000000 0.000000 /begin IF_DATA ASAP1B_ETK KP_BLOB 0x383B32 1 2 /end IF_DATA BIT_MASK 0xF00 /end MEASUREMENT
/begin MEASUREMENT TYP_etse "" UWORD B_TRUE___UW 0 0 0.000000 0.000000 /begin IF_DATA ASAP1B_ETK KP_BLOB 0x383B34 1 2 /end IF_DATA BIT_MASK 0xF00 /end MEASUREMENT
/begin MEASUREMENT TYP_ev1 "" UWORD B_TRUE___UW 0 0 0.000000 0.000000 /begin IF_DATA ASAP1B_ETK KP_BLOB 0x383B36 1 2 /end IF_DATA BIT_MASK 0xF00 /end MEASUREMENT
/begin MEASUREMENT TYP_ev2 "" UWORD B_TRUE___UW 0 0 0.000000 0.000000 /begin IF_DATA ASAP1B_ETK KP_BLOB 0x383B38 1 2 /end IF_DATA BIT_MASK 0xF00 /end MEASUREMENT
/begin MEASUREMENT TYP_ev3 "" UWORD B_TRUE___UW 0 0 0.000000 0.000000 /begin IF_DATA ASAP1B_ETK KP_BLOB 0x383B3A 1 2 /end IF_DATA BIT_MASK 0xF00 /end MEASUREMENT
/begin MEASUREMENT TYP_ev4 "" UWORD B_TRUE___UW 0 0 0.000000 0.000000 /begin IF_DATA ASAP1B_ETK KP_BLOB 0x383B3C 1 2 /end IF_DATA BIT_MASK 0xF00 /end MEASUREMENT
/begin MEASUREMENT TYP_ev5 "" UWORD B_TRUE___UW 0 0 0.000000 0.000000 /begin IF_DATA ASAP1B_ETK KP_BLOB 0x383B3E 1 2 /end IF_DATA BIT_MASK 0xF00 /end MEASUREMENT
/begin MEASUREMENT TYP_ev6 "" UWORD B_TRUE___UW 0 0 0.000000 0.000000 /begin IF_DATA ASAP1B_ETK KP_BLOB 0x383B40 1 2 /end IF_DATA BIT_MASK 0xF00 /end MEASUREMENT
/begin MEASUREMENT TYP_ev7 "" UWORD B_TRUE___UW 0 0 0.000000 0.000000 /begin IF_DATA ASAP1B_ETK KP_BLOB 0x383B42 1 2 /end IF_DATA BIT_MASK 0xF00 /end MEASUREMENT
/begin MEASUREMENT TYP_ev8 "" UWORD B_TRUE___UW 0 0 0.000000 0.000000 /begin IF_DATA ASAP1B_ETK KP_BLOB 0x383B44 1 2 /end IF_DATA BIT_MASK 0xF00 /end MEASUREMENT
/begin MEASUREMENT TYP_frao "" UWORD B_TRUE___UW 0 0 0.000000 0.000000 /begin IF_DATA ASAP1B_ETK KP_BLOB 0x383B4C 1 2 /end IF_DATA BIT_MASK 0xF00 /end MEASUREMENT
/begin MEASUREMENT TYP_frau "" UWORD B_TRUE___UW 0 0 0.000000 0.000000 /begin IF_DATA ASAP1B_ETK KP_BLOB 0x383B4E 1 2 /end IF_DATA BIT_MASK 0xF00 /end MEASUREMENT
/begin MEASUREMENT TYP_frst "" UWORD B_TRUE___UW 0 0 0.000000 0.000000 /begin IF_DATA ASAP1B_ETK KP_BLOB 0x383B50 1 2 /end IF_DATA BIT_MASK 0xF00 /end MEASUREMENT
/begin MEASUREMENT TYP_hsh "Fehlertyp: Heizung Lambdasonde 1 hinter Kat" UWORD B_TRUE___UW 0 0 0.000000 0.000000 /begin IF_DATA ASAP1B_ETK KP_BLOB 0x383B56 1 2 /end IF_DATA BIT_MASK 0xF00 /end MEASUREMENT
/begin MEASUREMENT TYP_hshe "Fehlertyp: Endstufe Heizung Lambdasonde 1 hinter Kat" UWORD B_TRUE___UW 0 0 0.000000 0.000000 /begin IF_DATA ASAP1B_ETK KP_BLOB 0x383B58 1 2 /end IF_DATA BIT_MASK 0xF00 /end MEASUREMENT
/begin MEASUREMENT TYP_hshe2 "Fehlertyp: Endstufe Heizung Lambdasonde 2 hinter Kat" UWORD B_TRUE___UW 0 0 0.000000 0.000000 /begin IF_DATA ASAP1B_ETK KP_BLOB 0x383B5A 1 2 /end IF_DATA BIT_MASK 0xF00 /end MEASUREMENT
/begin MEASUREMENT TYP_hsv "Fehlertyp: Heizung Lambdasonde 1 vor Kat" UWORD B_TRUE___UW 0 0 0.000000 0.000000 /begin IF_DATA ASAP1B_ETK KP_BLOB 0x383B5C 1 2 /end IF_DATA BIT_MASK 0xF00 /end MEASUREMENT
/begin MEASUREMENT TYP_hsv2 "Fehlertyp: Heizung Lambdasonde 2 vor Kat" UWORD B_TRUE___UW 0 0 0.000000 0.000000 /begin IF_DATA ASAP1B_ETK KP_BLOB 0x383B5E 1 2 /end IF_DATA BIT_MASK 0xF00 /end MEASUREMENT
/begin MEASUREMENT TYP_kat "Fehlertyp: Katalysator-Diagnose" UWORD B_TRUE___UW 0 0 0.000000 0.000000 /begin IF_DATA ASAP1B_ETK KP_BLOB 0x383B60 1 2 /end IF_DATA BIT_MASK 0xF00 /end MEASUREMENT
/begin MEASUREMENT TYP_kpe "Fehlertyp: EKP-Relais Endstufe" UWORD B_TRUE___UW 0 0 0.000000 0.000000 /begin IF_DATA ASAP1B_ETK KP_BLOB 0x383B62 1 2 /end IF_DATA BIT_MASK 0xF00 /end MEASUREMENT
/begin MEASUREMENT TYP_krnt "" UWORD B_TRUE___UW 0 0 0.000000 0.000000 /begin IF_DATA ASAP1B_ETK KP_BLOB 0x383B74 1 2 /end IF_DATA BIT_MASK 0xF00 /end MEASUREMENT
/begin MEASUREMENT TYP_krof "" UWORD B_TRUE___UW 0 0 0.000000 0.000000 /begin IF_DATA ASAP1B_ETK KP_BLOB 0x383B76 1 2 /end IF_DATA BIT_MASK 0xF00 /end MEASUREMENT
/begin MEASUREMENT TYP_krtp "" UWORD B_TRUE___UW 0 0 0.000000 0.000000 /begin IF_DATA ASAP1B_ETK KP_BLOB 0x383B78 1 2 /end IF_DATA BIT_MASK 0xF00 /end MEASUREMENT
/begin MEASUREMENT TYP_ks1 "" UWORD B_TRUE___UW 0 0 0.000000 0.000000 /begin IF_DATA ASAP1B_ETK KP_BLOB 0x383B7A 1 2 /end IF_DATA BIT_MASK 0xF00 /end MEASUREMENT
/begin MEASUREMENT TYP_ks2 "" UWORD B_TRUE___UW 0 0 0.000000 0.000000 /begin IF_DATA ASAP1B_ETK KP_BLOB 0x383B7C 1 2 /end IF_DATA BIT_MASK 0xF00 /end MEASUREMENT
/begin MEASUREMENT TYP_ks3 "" UWORD B_TRUE___UW 0 0 0.000000 0.000000 /begin IF_DATA ASAP1B_ETK KP_BLOB 0x383B7E 1 2 /end IF_DATA BIT_MASK 0xF00 /end MEASUREMENT
/begin MEASUREMENT TYP_ks4 "" UWORD B_TRUE___UW 0 0 0.000000 0.000000 /begin IF_DATA ASAP1B_ETK KP_BLOB 0x383B80 1 2 /end IF_DATA BIT_MASK 0xF00 /end MEASUREMENT
/begin MEASUREMENT TYP_kuppl "Fehlertyp: Gebergrî·e Kupplungsschalter" UWORD B_TRUE___UW 0 0 0.000000 0.000000 /begin IF_DATA ASAP1B_ETK KP_BLOB 0x383B82 1 2 /end IF_DATA BIT_MASK 0xF00 /end MEASUREMENT
/begin MEASUREMENT TYP_lash "Fehlertyp: Lambda- Sondenalterung hinter Kat" UWORD B_TRUE___UW 0 0 0.000000 0.000000 /begin IF_DATA ASAP1B_ETK KP_BLOB 0x383B84 1 2 /end IF_DATA BIT_MASK 0xF00 /end MEASUREMENT
/begin MEASUREMENT TYP_lash2 "Fehlertyp: Lambda-Sondenalterung hinter Kat Bank2" UWORD B_TRUE___UW 0 0 0.000000 0.000000 /begin IF_DATA ASAP1B_ETK KP_BLOB 0x383B86 1 2 /end IF_DATA BIT_MASK 0xF00 /end MEASUREMENT
/begin MEASUREMENT TYP_latp "Fehlertyp: Lambda- Sondenalterung Tp vor Kat" UWORD B_TRUE___UW 0 0 0.000000 0.000000 /begin IF_DATA ASAP1B_ETK KP_BLOB 0x383B88 1 2 /end IF_DATA BIT_MASK 0xF00 /end MEASUREMENT
/begin MEASUREMENT TYP_latp2 "Fehlertyp: Lambda- Sondenalterung Tp vor Kat Bank2" UWORD B_TRUE___UW 0 0 0.000000 0.000000 /begin IF_DATA ASAP1B_ETK KP_BLOB 0x383B8A 1 2 /end IF_DATA BIT_MASK 0xF00 /end MEASUREMENT
/begin MEASUREMENT TYP_latv "Fehlertyp: Lambda- Sondenalterung Tv vor Kat" UWORD B_TRUE___UW 0 0 0.000000 0.000000 /begin IF_DATA ASAP1B_ETK KP_BLOB 0x383B8C 1 2 /end IF_DATA BIT_MASK 0xF00 /end MEASUREMENT
/begin MEASUREMENT TYP_latv2 "Fehlertyp: Lambda- Sondenalterung Tv vor Kat Bank2" UWORD B_TRUE___UW 0 0 0.000000 0.000000 /begin IF_DATA ASAP1B_ETK KP_BLOB 0x383B8E 1 2 /end IF_DATA BIT_MASK 0xF00 /end MEASUREMENT
/begin MEASUREMENT TYP_lde "" UWORD B_TRUE___UW 0 0 0.000000 0.000000 /begin IF_DATA ASAP1B_ETK KP_BLOB 0x383B90 1 2 /end IF_DATA BIT_MASK 0xF00 /end MEASUREMENT
/begin MEASUREMENT TYP_ldo "" UWORD B_TRUE___UW 0 0 0.000000 0.000000 /begin IF_DATA ASAP1B_ETK KP_BLOB 0x383B92 1 2 /end IF_DATA BIT_MASK 0xF00 /end MEASUREMENT
/begin MEASUREMENT TYP_ldp "" UWORD B_TRUE___UW 0 0 0.000000 0.000000 /begin IF_DATA ASAP1B_ETK KP_BLOB 0x383B94 1 2 /end IF_DATA BIT_MASK 0xF00 /end MEASUREMENT
/begin MEASUREMENT TYP_ldra "" UWORD B_TRUE___UW 0 0 0.000000 0.000000 /begin IF_DATA ASAP1B_ETK KP_BLOB 0x383B98 1 2 /end IF_DATA BIT_MASK 0xF00 /end MEASUREMENT
/begin MEASUREMENT TYP_LLR "" UWORD B_TRUE___UW 0 0 0.000000 0.000000 /begin IF_DATA ASAP1B_ETK KP_BLOB 0x383B9A 1 2 /end IF_DATA BIT_MASK 0xF00 /end MEASUREMENT
/begin MEASUREMENT TYP_lm "" UWORD B_TRUE___UW 0 0 0.000000 0.000000 /begin IF_DATA ASAP1B_ETK KP_BLOB 0x383B9C 1 2 /end IF_DATA BIT_MASK 0xF00 /end MEASUREMENT
/begin MEASUREMENT TYP_lsh "Fehlertyp: Lambdasonde 1 hinter Kat" UWORD B_TRUE___UW 0 0 0.000000 0.000000 /begin IF_DATA ASAP1B_ETK KP_BLOB 0x383B9E 1 2 /end IF_DATA BIT_MASK 0xF00 /end MEASUREMENT
/begin MEASUREMENT TYP_lsv "Fehlertyp: Lambdasonde 1 vor Kat" UWORD B_TRUE___UW 0 0 0.000000 0.000000 /begin IF_DATA ASAP1B_ETK KP_BLOB 0x383BA0 1 2 /end IF_DATA BIT_MASK 0xF00 /end MEASUREMENT
/begin MEASUREMENT TYP_mile "" UWORD B_TRUE___UW 0 0 0.000000 0.000000 /begin IF_DATA ASAP1B_ETK KP_BLOB 0x383BB8 1 2 /end IF_DATA BIT_MASK 0xF00 /end MEASUREMENT
/begin MEASUREMENT TYP_nwse "" UWORD B_TRUE___UW 0 0 0.000000 0.000000 /begin IF_DATA ASAP1B_ETK KP_BLOB 0x383BC4 1 2 /end IF_DATA BIT_MASK 0xF00 /end MEASUREMENT
/begin MEASUREMENT TYP_rkat "" UWORD B_TRUE___UW 0 0 0.000000 0.000000 /begin IF_DATA ASAP1B_ETK KP_BLOB 0x383BCC 1 2 /end IF_DATA BIT_MASK 0xF00 /end MEASUREMENT
/begin MEASUREMENT TYP_rkaz "" UWORD B_TRUE___UW 0 0 0.000000 0.000000 /begin IF_DATA ASAP1B_ETK KP_BLOB 0x383BCE 1 2 /end IF_DATA BIT_MASK 0xF00 /end MEASUREMENT
/begin MEASUREMENT TYP_slpe "" UWORD B_TRUE___UW 0 0 0.000000 0.000000 /begin IF_DATA ASAP1B_ETK KP_BLOB 0x383BD2 1 2 /end IF_DATA BIT_MASK 0xF00 /end MEASUREMENT
/begin MEASUREMENT TYP_slve "" UWORD B_TRUE___UW 0 0 0.000000 0.000000 /begin IF_DATA ASAP1B_ETK KP_BLOB 0x383BD8 1 2 /end IF_DATA BIT_MASK 0xF00 /end MEASUREMENT
/begin MEASUREMENT TYP_sue "" UWORD B_TRUE___UW 0 0 0.000000 0.000000 /begin IF_DATA ASAP1B_ETK KP_BLOB 0x383BDC 1 2 /end IF_DATA BIT_MASK 0xF00 /end MEASUREMENT
/begin MEASUREMENT TYP_tesf "Fehlertyp: Tankdiagnose, Feinleck" UWORD B_TRUE___UW 0 0 0.000000 0.000000 /begin IF_DATA ASAP1B_ETK KP_BLOB 0x383BE6 1 2 /end IF_DATA BIT_MASK 0xF00 /end MEASUREMENT
/begin MEASUREMENT TYP_tesg "Fehlertyp: Tankdiagnose, Grobleck" UWORD B_TRUE___UW 0 0 0.000000 0.000000 /begin IF_DATA ASAP1B_ETK KP_BLOB 0x383BE8 1 2 /end IF_DATA BIT_MASK 0xF00 /end MEASUREMENT
/begin MEASUREMENT TYP_teve "" UWORD B_TRUE___UW 0 0 0.000000 0.000000 /begin IF_DATA ASAP1B_ETK KP_BLOB 0x383BEA 1 2 /end IF_DATA BIT_MASK 0xF00 /end MEASUREMENT
/begin MEASUREMENT TYP_uvse "" UWORD B_TRUE___UW 0 0 0.000000 0.000000 /begin IF_DATA ASAP1B_ETK KP_BLOB 0x383C02 1 2 /end IF_DATA BIT_MASK 0xF00 /end MEASUREMENT
/begin MEASUREMENT TYP_zet1 "" UWORD B_TRUE___UW 0 0 0.000000 0.000000 /begin IF_DATA ASAP1B_ETK KP_BLOB 0x383C0A 1 2 /end IF_DATA BIT_MASK 0xF00 /end MEASUREMENT
/begin MEASUREMENT TYP_zet2 "" UWORD B_TRUE___UW 0 0 0.000000 0.000000 /begin IF_DATA ASAP1B_ETK KP_BLOB 0x383C0C 1 2 /end IF_DATA BIT_MASK 0xF00 /end MEASUREMENT
/begin MEASUREMENT TYP_zet3 "" UWORD B_TRUE___UW 0 0 0.000000 0.000000 /begin IF_DATA ASAP1B_ETK KP_BLOB 0x383C0E 1 2 /end IF_DATA BIT_MASK 0xF00 /end MEASUREMENT
/begin MEASUREMENT TYP_zet4 "" UWORD B_TRUE___UW 0 0 0.000000 0.000000 /begin IF_DATA ASAP1B_ETK KP_BLOB 0x383C10 1 2 /end IF_DATA BIT_MASK 0xF00 /end MEASUREMENT
/begin MEASUREMENT TYP_zet5 "" UWORD B_TRUE___UW 0 0 0.000000 0.000000 /begin IF_DATA ASAP1B_ETK KP_BLOB 0x383C12 1 2 /end IF_DATA BIT_MASK 0xF00 /end MEASUREMENT
/begin MEASUREMENT TYP_zet6 "" UWORD B_TRUE___UW 0 0 0.000000 0.000000 /begin IF_DATA ASAP1B_ETK KP_BLOB 0x383C14 1 2 /end IF_DATA BIT_MASK 0xF00 /end MEASUREMENT
/begin MEASUREMENT TYP_zet7 "" UWORD B_TRUE___UW 0 0 0.000000 0.000000 /begin IF_DATA ASAP1B_ETK KP_BLOB 0x383C16 1 2 /end IF_DATA BIT_MASK 0xF00 /end MEASUREMENT
/begin MEASUREMENT TYP_zet8 "" UWORD B_TRUE___UW 0 0 0.000000 0.000000 /begin IF_DATA ASAP1B_ETK KP_BLOB 0x383C18 1 2 /end IF_DATA BIT_MASK 0xF00 /end MEASUREMENT
/begin MEASUREMENT Z_aave "Zyklusflag: Absperrventil Aktivkohlefilter (Endstufe)" UWORD B_TRUE___UW 0 0 0.000000 0.000000 /begin IF_DATA ASAP1B_ETK KP_BLOB 0x383AF0 1 2 /end IF_DATA BIT_MASK 0x2 /end MEASUREMENT
/begin MEASUREMENT Z_agre "Zyklusflag: AbgasrÅckfÅhrungsventil Endstufe" UWORD B_TRUE___UW 0 0 0.000000 0.000000 /begin IF_DATA ASAP1B_ETK KP_BLOB 0x383AF2 1 2 /end IF_DATA BIT_MASK 0x2 /end MEASUREMENT
/begin MEASUREMENT Z_epcle "Zyklusflag: EPCL-Endstufe" UWORD B_TRUE___UW 0 0 0.000000 0.000000 /begin IF_DATA ASAP1B_ETK KP_BLOB 0x383B32 1 2 /end IF_DATA BIT_MASK 0x2 /end MEASUREMENT
/begin MEASUREMENT Z_etse "Zyklusflag: Elektrisches Thermostat Endstufe" UWORD B_TRUE___UW 0 0 0.000000 0.000000 /begin IF_DATA ASAP1B_ETK KP_BLOB 0x383B34 1 2 /end IF_DATA BIT_MASK 0x2 /end MEASUREMENT
/begin MEASUREMENT Z_ev1 "Zyklusflag: EV von Zyl. 1" UWORD B_TRUE___UW 0 0 0.000000 0.000000 /begin IF_DATA ASAP1B_ETK KP_BLOB 0x383B36 1 2 /end IF_DATA BIT_MASK 0x2 /end MEASUREMENT
/begin MEASUREMENT Z_ev2 "Zyklusflag:	EV von Zyl. 2" UWORD B_TRUE___UW 0 0 0.000000 0.000000 /begin IF_DATA ASAP1B_ETK KP_BLOB 0x383B38 1 2 /end IF_DATA BIT_MASK 0x2 /end MEASUREMENT
/begin MEASUREMENT Z_ev3 "Zyklusflag:	EV von Zyl. 3" UWORD B_TRUE___UW 0 0 0.000000 0.000000 /begin IF_DATA ASAP1B_ETK KP_BLOB 0x383B3A 1 2 /end IF_DATA BIT_MASK 0x2 /end MEASUREMENT
/begin MEASUREMENT Z_ev4 "Zyklusflag:	EV von Zyl. 4" UWORD B_TRUE___UW 0 0 0.000000 0.000000 /begin IF_DATA ASAP1B_ETK KP_BLOB 0x383B3C 1 2 /end IF_DATA BIT_MASK 0x2 /end MEASUREMENT
/begin MEASUREMENT Z_ev5 "Zyklusflag:	EV von Zyl. 5" UWORD B_TRUE___UW 0 0 0.000000 0.000000 /begin IF_DATA ASAP1B_ETK KP_BLOB 0x383B3E 1 2 /end IF_DATA BIT_MASK 0x2 /end MEASUREMENT
/begin MEASUREMENT Z_ev6 "Zyklusflag:	EV von Zyl. 6" UWORD B_TRUE___UW 0 0 0.000000 0.000000 /begin IF_DATA ASAP1B_ETK KP_BLOB 0x383B40 1 2 /end IF_DATA BIT_MASK 0x2 /end MEASUREMENT
/begin MEASUREMENT Z_ev7 "Zyklusflag:	EV von Zyl. 7" UWORD B_TRUE___UW 0 0 0.000000 0.000000 /begin IF_DATA ASAP1B_ETK KP_BLOB 0x383B42 1 2 /end IF_DATA BIT_MASK 0x2 /end MEASUREMENT
/begin MEASUREMENT Z_ev8 "Zyklusflag:	EV von Zyl. 8" UWORD B_TRUE___UW 0 0 0.000000 0.000000 /begin IF_DATA ASAP1B_ETK KP_BLOB 0x383B44 1 2 /end IF_DATA BIT_MASK 0x2 /end MEASUREMENT
/begin MEASUREMENT Z_frao "Zyklusflag:LR-Adaption oberer multiplikativer Bereich" UWORD B_TRUE___UW 0 0 0.000000 0.000000 /begin IF_DATA ASAP1B_ETK KP_BLOB 0x383B4C 1 2 /end IF_DATA BIT_MASK 0x2 /end MEASUREMENT
/begin MEASUREMENT Z_frau "Zyklusflag:LR-Adaption unterer multiplikativer Bereich" UWORD B_TRUE___UW 0 0 0.000000 0.000000 /begin IF_DATA ASAP1B_ETK KP_BLOB 0x383B4E 1 2 /end IF_DATA BIT_MASK 0x2 /end MEASUREMENT
/begin MEASUREMENT Z_frst "Zyklusmeldung Diagnose Kraftstoffversorgungssystem (Kurztest)" UWORD B_TRUE___UW 0 0 0.000000 0.000000 /begin IF_DATA ASAP1B_ETK KP_BLOB 0x383B50 1 2 /end IF_DATA BIT_MASK 0x2 /end MEASUREMENT
/begin MEASUREMENT Z_hsh "Zyklusflag:Lambdasonden-Heizung hinter Katalysator" UWORD B_TRUE___UW 0 0 0.000000 0.000000 /begin IF_DATA ASAP1B_ETK KP_BLOB 0x383B56 1 2 /end IF_DATA BIT_MASK 0x2 /end MEASUREMENT
/begin MEASUREMENT Z_hshe "Zyklusflag:Lambdasonden-Heizung hinter Katalysator (Endstufe)" UWORD B_TRUE___UW 0 0 0.000000 0.000000 /begin IF_DATA ASAP1B_ETK KP_BLOB 0x383B58 1 2 /end IF_DATA BIT_MASK 0x2 /end MEASUREMENT
/begin MEASUREMENT Z_hshe2 "Zyklusflag:Lambdasonden-Heizung hinter Katalysator, Bank2 (Endstufe)" UWORD B_TRUE___UW 0 0 0.000000 0.000000 /begin IF_DATA ASAP1B_ETK KP_BLOB 0x383B5A 1 2 /end IF_DATA BIT_MASK 0x2 /end MEASUREMENT
/begin MEASUREMENT Z_hsv "Zyklusflag:Lambdasonden-Heizung vor Katalysator" UWORD B_TRUE___UW 0 0 0.000000 0.000000 /begin IF_DATA ASAP1B_ETK KP_BLOB 0x383B5C 1 2 /end IF_DATA BIT_MASK 0x2 /end MEASUREMENT
/begin MEASUREMENT Z_hsv2 "Zyklusflag:Lambdasonden-Heizung vor Katalysator, Bank2" UWORD B_TRUE___UW 0 0 0.000000 0.000000 /begin IF_DATA ASAP1B_ETK KP_BLOB 0x383B5E 1 2 /end IF_DATA BIT_MASK 0x2 /end MEASUREMENT
/begin MEASUREMENT Z_kat "Zyklusflag:	Katalysator-Konvertierung" UWORD B_TRUE___UW 0 0 0.000000 0.000000 /begin IF_DATA ASAP1B_ETK KP_BLOB 0x383B60 1 2 /end IF_DATA BIT_MASK 0x2 /end MEASUREMENT
/begin MEASUREMENT Z_kpe "Zyklusflag: EKP-Relais Endstufe" UWORD B_TRUE___UW 0 0 0.000000 0.000000 /begin IF_DATA ASAP1B_ETK KP_BLOB 0x383B62 1 2 /end IF_DATA BIT_MASK 0x2 /end MEASUREMENT
/begin MEASUREMENT Z_kra01 "Zyklusflag: Klopfregelanschlag Zylinder 1" UWORD B_TRUE___UW 0 0 0.000000 0.000000 /begin IF_DATA ASAP1B_ETK KP_BLOB 0x383B64 1 2 /end IF_DATA BIT_MASK 0x2 /end MEASUREMENT
/begin MEASUREMENT Z_kra02 "Zyklusflag: Klopfregelanschlag Zylinder 2" UWORD B_TRUE___UW 0 0 0.000000 0.000000 /begin IF_DATA ASAP1B_ETK KP_BLOB 0x383B66 1 2 /end IF_DATA BIT_MASK 0x2 /end MEASUREMENT
/begin MEASUREMENT Z_kra03 "Zyklusflag: Klopfregelanschlag Zylinder 3" UWORD B_TRUE___UW 0 0 0.000000 0.000000 /begin IF_DATA ASAP1B_ETK KP_BLOB 0x383B68 1 2 /end IF_DATA BIT_MASK 0x2 /end MEASUREMENT
/begin MEASUREMENT Z_kra04 "Zyklusflag: Klopfregelanschlag Zylinder 4" UWORD B_TRUE___UW 0 0 0.000000 0.000000 /begin IF_DATA ASAP1B_ETK KP_BLOB 0x383B6A 1 2 /end IF_DATA BIT_MASK 0x2 /end MEASUREMENT
/begin MEASUREMENT Z_kra05 "Zyklusflag: Klopfregelanschlag Zylinder 5" UWORD B_TRUE___UW 0 0 0.000000 0.000000 /begin IF_DATA ASAP1B_ETK KP_BLOB 0x383B6C 1 2 /end IF_DATA BIT_MASK 0x2 /end MEASUREMENT
/begin MEASUREMENT Z_kra06 "Zyklusflag: Klopfregelanschlag Zylinder 6" UWORD B_TRUE___UW 0 0 0.000000 0.000000 /begin IF_DATA ASAP1B_ETK KP_BLOB 0x383B6E 1 2 /end IF_DATA BIT_MASK 0x2 /end MEASUREMENT
/begin MEASUREMENT Z_kra07 "Zyklusflag: Klopfregelanschlag Zylinder 7" UWORD B_TRUE___UW 0 0 0.000000 0.000000 /begin IF_DATA ASAP1B_ETK KP_BLOB 0x383B70 1 2 /end IF_DATA BIT_MASK 0x2 /end MEASUREMENT
/begin MEASUREMENT Z_kra08 "Zyklusflag: Klopfregelanschlag Zylinder 8" UWORD B_TRUE___UW 0 0 0.000000 0.000000 /begin IF_DATA ASAP1B_ETK KP_BLOB 0x383B72 1 2 /end IF_DATA BIT_MASK 0x2 /end MEASUREMENT
/begin MEASUREMENT Z_krnt "Zyklusflag:	Klopfregelung Nulltest" UWORD B_TRUE___UW 0 0 0.000000 0.000000 /begin IF_DATA ASAP1B_ETK KP_BLOB 0x383B74 1 2 /end IF_DATA BIT_MASK 0x2 /end MEASUREMENT
/begin MEASUREMENT Z_krof "Zyklusflag:	Klopfregelung Offset" UWORD B_TRUE___UW 0 0 0.000000 0.000000 /begin IF_DATA ASAP1B_ETK KP_BLOB 0x383B76 1 2 /end IF_DATA BIT_MASK 0x2 /end MEASUREMENT
/begin MEASUREMENT Z_krtp "Zyklusflag: Klopfregelung Testimpuls" UWORD B_TRUE___UW 0 0 0.000000 0.000000 /begin IF_DATA ASAP1B_ETK KP_BLOB 0x383B78 1 2 /end IF_DATA BIT_MASK 0x2 /end MEASUREMENT
/begin MEASUREMENT Z_ks1 "Zyklusflag:	Klopfsensor 1" UWORD B_TRUE___UW 0 0 0.000000 0.000000 /begin IF_DATA ASAP1B_ETK KP_BLOB 0x383B7A 1 2 /end IF_DATA BIT_MASK 0x2 /end MEASUREMENT
/begin MEASUREMENT Z_ks2 "Zyklusflag:	Klopfsensor 2" UWORD B_TRUE___UW 0 0 0.000000 0.000000 /begin IF_DATA ASAP1B_ETK KP_BLOB 0x383B7C 1 2 /end IF_DATA BIT_MASK 0x2 /end MEASUREMENT
/begin MEASUREMENT Z_ks3 "Zyklusflag:	Klopfsensor 3" UWORD B_TRUE___UW 0 0 0.000000 0.000000 /begin IF_DATA ASAP1B_ETK KP_BLOB 0x383B7E 1 2 /end IF_DATA BIT_MASK 0x2 /end MEASUREMENT
/begin MEASUREMENT Z_ks4 "Zyklusflag:	Klopfsensor 4" UWORD B_TRUE___UW 0 0 0.000000 0.000000 /begin IF_DATA ASAP1B_ETK KP_BLOB 0x383B80 1 2 /end IF_DATA BIT_MASK 0x2 /end MEASUREMENT
/begin MEASUREMENT Z_kuppl "Zyklusflag: Kupplung betaetigt" UWORD B_TRUE___UW 0 0 0.000000 0.000000 /begin IF_DATA ASAP1B_ETK KP_BLOB 0x383B82 1 2 /end IF_DATA BIT_MASK 0x2 /end MEASUREMENT
/begin MEASUREMENT Z_lash "Zyklusflag:	Lambda-Sondenalterung hinter Kat." UWORD B_TRUE___UW 0 0 0.000000 0.000000 /begin IF_DATA ASAP1B_ETK KP_BLOB 0x383B84 1 2 /end IF_DATA BIT_MASK 0x2 /end MEASUREMENT
/begin MEASUREMENT Z_lash2 "Zyklusflag:	Lambda-Sondenalterung hinter Kat. (Bank 2)" UWORD B_TRUE___UW 0 0 0.000000 0.000000 /begin IF_DATA ASAP1B_ETK KP_BLOB 0x383B86 1 2 /end IF_DATA BIT_MASK 0x2 /end MEASUREMENT
/begin MEASUREMENT Z_latp "Zyklusflag:	Lambda-Sondenalterung TP" UWORD B_TRUE___UW 0 0 0.000000 0.000000 /begin IF_DATA ASAP1B_ETK KP_BLOB 0x383B88 1 2 /end IF_DATA BIT_MASK 0x2 /end MEASUREMENT
/begin MEASUREMENT Z_latp2 "Zyklusflag:	Lambda-Sondenalterung TP (Bank 2)" UWORD B_TRUE___UW 0 0 0.000000 0.000000 /begin IF_DATA ASAP1B_ETK KP_BLOB 0x383B8A 1 2 /end IF_DATA BIT_MASK 0x2 /end MEASUREMENT
/begin MEASUREMENT Z_latv "Zyklusflag:	Lambda-Sondenalterung TV" UWORD B_TRUE___UW 0 0 0.000000 0.000000 /begin IF_DATA ASAP1B_ETK KP_BLOB 0x383B8C 1 2 /end IF_DATA BIT_MASK 0x2 /end MEASUREMENT
/begin MEASUREMENT Z_latv2 "Zyklusflag:	Lambda-Sondenalterung TV (Bank 2)" UWORD B_TRUE___UW 0 0 0.000000 0.000000 /begin IF_DATA ASAP1B_ETK KP_BLOB 0x383B8E 1 2 /end IF_DATA BIT_MASK 0x2 /end MEASUREMENT
/begin MEASUREMENT Z_lde "Zyklusflag: Ladedrucksteuerventil (Endstufe)" UWORD B_TRUE___UW 0 0 0.000000 0.000000 /begin IF_DATA ASAP1B_ETK KP_BLOB 0x383B90 1 2 /end IF_DATA BIT_MASK 0x2 /end MEASUREMENT
/begin MEASUREMENT Z_ldo "Zyklusflag:	Ladedruckkennlinie; oberer Wert Åberschritten" UWORD B_TRUE___UW 0 0 0.000000 0.000000 /begin IF_DATA ASAP1B_ETK KP_BLOB 0x383B92 1 2 /end IF_DATA BIT_MASK 0x2 /end MEASUREMENT
/begin MEASUREMENT Z_ldp "Zyklusflag: Leckdiagnosemodul" UWORD B_TRUE___UW 0 0 0.000000 0.000000 /begin IF_DATA ASAP1B_ETK KP_BLOB 0x383B94 1 2 /end IF_DATA BIT_MASK 0x2 /end MEASUREMENT
/begin MEASUREMENT Z_ldra "Zyklusflag:	Ladedruckregelabweichung" UWORD B_TRUE___UW 0 0 0.000000 0.000000 /begin IF_DATA ASAP1B_ETK KP_BLOB 0x383B98 1 2 /end IF_DATA BIT_MASK 0x2 /end MEASUREMENT
/begin MEASUREMENT Z_llr "Zyklusflag: Diagnose Leerlaufregelung, Steller" UWORD B_TRUE___UW 0 0 0.000000 0.000000 /begin IF_DATA ASAP1B_ETK KP_BLOB 0x383B9A 1 2 /end IF_DATA BIT_MASK 0x2 /end MEASUREMENT
/begin MEASUREMENT Z_lm "Zyklusflag:	LMM/HLM/HFM" UWORD B_TRUE___UW 0 0 0.000000 0.000000 /begin IF_DATA ASAP1B_ETK KP_BLOB 0x383B9C 1 2 /end IF_DATA BIT_MASK 0x2 /end MEASUREMENT
/begin MEASUREMENT Z_lsh "Zyklusflag: Lambda-Sonde hinter Kat" UWORD B_TRUE___UW 0 0 0.000000 0.000000 /begin IF_DATA ASAP1B_ETK KP_BLOB 0x383B9E 1 2 /end IF_DATA BIT_MASK 0x2 /end MEASUREMENT
/begin MEASUREMENT Z_lsv "Zyklusflag: Lambda-Sonde vor Kat" UWORD B_TRUE___UW 0 0 0.000000 0.000000 /begin IF_DATA ASAP1B_ETK KP_BLOB 0x383BA0 1 2 /end IF_DATA BIT_MASK 0x2 /end MEASUREMENT
/begin MEASUREMENT Z_mile "Zyklusflag: MIL-Endstufe" UWORD B_TRUE___UW 0 0 0.000000 0.000000 /begin IF_DATA ASAP1B_ETK KP_BLOB 0x383BB8 1 2 /end IF_DATA BIT_MASK 0x2 /end MEASUREMENT
/begin MEASUREMENT Z_nwse "Zyklusflag: Nockenwellensteuerungsventil Endstufe" UWORD B_TRUE___UW 0 0 0.000000 0.000000 /begin IF_DATA ASAP1B_ETK KP_BLOB 0x383BC4 1 2 /end IF_DATA BIT_MASK 0x2 /end MEASUREMENT
/begin MEASUREMENT Z_rkat "Zyklusflag:LR-Adaption additiv pro Zeit" UWORD B_TRUE___UW 0 0 0.000000 0.000000 /begin IF_DATA ASAP1B_ETK KP_BLOB 0x383BCC 1 2 /end IF_DATA BIT_MASK 0x2 /end MEASUREMENT
/begin MEASUREMENT Z_rkaz "Zyklusflag:LR-Adaption additiv pro Einspritzung" UWORD B_TRUE___UW 0 0 0.000000 0.000000 /begin IF_DATA ASAP1B_ETK KP_BLOB 0x383BCE 1 2 /end IF_DATA BIT_MASK 0x2 /end MEASUREMENT
/begin MEASUREMENT Z_slpe "Zyklusflag: SekundÑrluftpumpe (Endstufe)" UWORD B_TRUE___UW 0 0 0.000000 0.000000 /begin IF_DATA ASAP1B_ETK KP_BLOB 0x383BD2 1 2 /end IF_DATA BIT_MASK 0x2 /end MEASUREMENT
/begin MEASUREMENT Z_slve "Zyklusflag:	SekundÑrluftventil (Endstufe)" UWORD B_TRUE___UW 0 0 0.000000 0.000000 /begin IF_DATA ASAP1B_ETK KP_BLOB 0x383BD8 1 2 /end IF_DATA BIT_MASK 0x2 /end MEASUREMENT
/begin MEASUREMENT Z_sue "Zyklusflag: Endstufe Saugrohrumschaltung" UWORD B_TRUE___UW 0 0 0.000000 0.000000 /begin IF_DATA ASAP1B_ETK KP_BLOB 0x383BDC 1 2 /end IF_DATA BIT_MASK 0x2 /end MEASUREMENT
/begin MEASUREMENT Z_tesf "Zyklusflag: TankentlÅftungssystem Feinleck" UWORD B_TRUE___UW 0 0 0.000000 0.000000 /begin IF_DATA ASAP1B_ETK KP_BLOB 0x383BE6 1 2 /end IF_DATA BIT_MASK 0x2 /end MEASUREMENT
/begin MEASUREMENT Z_tesg "Zyklusflag:	TankentlÅftungssystem Grobleck" UWORD B_TRUE___UW 0 0 0.000000 0.000000 /begin IF_DATA ASAP1B_ETK KP_BLOB 0x383BE8 1 2 /end IF_DATA BIT_MASK 0x2 /end MEASUREMENT
/begin MEASUREMENT Z_teve "Zyklusflag:	TankentlÅftungsventil Endstufe" UWORD B_TRUE___UW 0 0 0.000000 0.000000 /begin IF_DATA ASAP1B_ETK KP_BLOB 0x383BEA 1 2 /end IF_DATA BIT_MASK 0x2 /end MEASUREMENT
/begin MEASUREMENT Z_uvse "Zyklusflag: Endstufe Umluftventil Turbo" UWORD B_TRUE___UW 0 0 0.000000 0.000000 /begin IF_DATA ASAP1B_ETK KP_BLOB 0x383C02 1 2 /end IF_DATA BIT_MASK 0x2 /end MEASUREMENT
/begin MEASUREMENT Z_zet1 "" UWORD B_TRUE___UW 0 0 0.000000 0.000000 /begin IF_DATA ASAP1B_ETK KP_BLOB 0x383C0A 1 2 /end IF_DATA BIT_MASK 0x2 /end MEASUREMENT
/begin MEASUREMENT Z_zet2 "" UWORD B_TRUE___UW 0 0 0.000000 0.000000 /begin IF_DATA ASAP1B_ETK KP_BLOB 0x383C0C 1 2 /end IF_DATA BIT_MASK 0x2 /end MEASUREMENT
/begin MEASUREMENT Z_zet3 "" UWORD B_TRUE___UW 0 0 0.000000 0.000000 /begin IF_DATA ASAP1B_ETK KP_BLOB 0x383C0E 1 2 /end IF_DATA BIT_MASK 0x2 /end MEASUREMENT
/begin MEASUREMENT Z_zet4 "" UWORD B_TRUE___UW 0 0 0.000000 0.000000 /begin IF_DATA ASAP1B_ETK KP_BLOB 0x383C10 1 2 /end IF_DATA BIT_MASK 0x2 /end MEASUREMENT
/begin MEASUREMENT Z_zet5 "" UWORD B_TRUE___UW 0 0 0.000000 0.000000 /begin IF_DATA ASAP1B_ETK KP_BLOB 0x383C12 1 2 /end IF_DATA BIT_MASK 0x2 /end MEASUREMENT
/begin MEASUREMENT Z_zet6 "" UWORD B_TRUE___UW 0 0 0.000000 0.000000 /begin IF_DATA ASAP1B_ETK KP_BLOB 0x383C14 1 2 /end IF_DATA BIT_MASK 0x2 /end MEASUREMENT
/begin MEASUREMENT Z_zet7 "" UWORD B_TRUE___UW 0 0 0.000000 0.000000 /begin IF_DATA ASAP1B_ETK KP_BLOB 0x383C16 1 2 /end IF_DATA BIT_MASK 0x2 /end MEASUREMENT
/begin MEASUREMENT Z_zet8 "" UWORD B_TRUE___UW 0 0 0.000000 0.000000 /begin IF_DATA ASAP1B_ETK KP_BLOB 0x383C18 1 2 /end IF_DATA BIT_MASK 0x2 /end MEASUREMENT
/begin FUNCTION DFPM_DEKON ""
 /begin REF_CHARACTERISTIC TSFZET8 TSFZET7 TSFZET6 TSFZET5 TSFZET4 TSFZET3 TSFZET2 TSFZET1 TSFUVSE TSFTEVE TSFSUE TSFSLVE TSFSLPE TSFNWSE TSFMILE TSFLDE TSFKPE TSFHSHE2 TSFHSHE TSFEV8 TSFEV7 TSFEV6 TSFEV5 TSFEV4 TSFEV3 TSFEV2 TSFEV1 TSFETSE TSFEPCLE TSFAGRE TSFAAVE FFTZET8 FFTZET7 FFTZET6 FFTZET5 FFTZET4 FFTZET3 FFTZET2 FFTZET1 FFTUVSE FFTTEVE FFTSUE FFTSLVE FFTSLPE FFTNWSE FFTMILE FFTLDE FFTKPE FFTHSHE2 FFTHSHE FFTEV8 FFTEV7 FFTEV6 FFTEV5 FFTEV4 FFTEV3 FFTEV2 FFTEV1 FFTETSE FFTEPCLE FFTAGRE FFTAAVE CLAZET8 CLAZET7 CLAZET6 CLAZET5 CLAZET4 CLAZET3 CLAZET2 CLAZET1 CLAUVSE CLATEVE CLASUE CLASLVE CLASLPE CLANWSE CLAMILE CLALDE CLAKPE CLAHSHE2 CLAHSHE CLAEV8 CLAEV7 CLAEV6 CLAEV5 CLAEV4 CLAEV3 CLAEV2 CLAEV1 CLAETSE CLAEPCLE CLAAGRE CLAAAVE CDTZET8 CDTZET7 CDTZET6 CDTZET5 CDTZET4 CDTZET3 CDTZET2 CDTZET1 CDTUVSE CDTTEVE CDTSUE CDTSLVE CDTSLPE CDTNWSE CDTMILE CDTLDE CDTKPE CDTHSHE2 CDTHSHE CDTEV8 CDTEV7 CDTEV6 CDTEV5 CDTEV4 CDTEV3 CDTEV2 CDTEV1 CDTETSE CDTEPCLE CDTAGRE CDTAAVE CDKZET8 CDKZET7 CDKZET6 CDKZET5 CDKZET4 CDKZET3 CDKZET2 CDKZET1 CDKUVSE CDKTEVE CDKSUE CDKSLVE CDKSLPE CDKNWSE CDKMILE CDKLDE CDKKPE CDKHSHE2 CDKHSHE CDKEV8 CDKEV7 CDKEV6 CDKEV5 CDKEV4 CDKEV3 CDKEV2 CDKEV1 CDKETSE CDKEPCLE CDKAGRE CDKAAVE CDCZET8 CDCZET7 CDCZET6 CDCZET5 CDCZET4 CDCZET3 CDCZET2 CDCZET1 CDCUVSE CDCTEVE CDCSUE CDCSLVE CDCSLPE CDCNWSE CDCMILE CDCLDE CDCKPE CDCHSHE2 CDCHSHE CDCEV8 CDCEV7 CDCEV6 CDCEV5 CDCEV4 CDCEV3 CDCEV2 CDCEV1 CDCETSE CDCEPCLE CDCAGRE CDCAAVE /end REF_CHARACTERISTIC
 /begin LOC_MEASUREMENT Z_zet8 Z_zet7 Z_zet6 Z_zet5 Z_zet4 Z_zet3 Z_zet2 Z_zet1 Z_uvse Z_teve Z_sue Z_slve Z_slpe Z_nwse Z_mile Z_lde Z_kpe Z_hshe2 Z_hshe Z_ev8 Z_ev7 Z_ev6 Z_ev5 Z_ev4 Z_ev3 Z_ev2 Z_ev1 Z_etse Z_epcle Z_agre Z_aave TYP_zet8 TYP_zet7 TYP_zet6 TYP_zet5 TYP_zet4 TYP_zet3 TYP_zet2 TYP_zet1 TYP_uvse TYP_teve TYP_sue TYP_slve TYP_slpe TYP_nwse TYP_mile TYP_lde TYP_kpe TYP_hshe2 TYP_hshe TYP_ev8 TYP_ev7 TYP_ev6 TYP_ev5 TYP_ev4 TYP_ev3 TYP_ev2 TYP_ev1 TYP_etse TYP_epcle TYP_agre TYP_aave sfpzet8 sfpzet7 sfpzet6 sfpzet5 sfpzet4 sfpzet3 sfpzet2 sfpzet1 sfpuvse sfpteve sfpsue sfpslve sfpslpe sfpnwse sfpmile sfplde sfpkpe sfphshe2 sfphshe sfpev8 sfpev7 sfpev6 sfpev5 sfpev4 sfpev3 sfpev2 sfpev1 sfpetse sfpepcle sfpagre sfpaave E_zet8 E_zet7 E_zet6 E_zet5 E_zet4 E_zet3 E_zet2 E_zet1 E_uvse E_teve E_sue E_slve E_slpe E_nwse E_mile E_lde E_kpe E_hshe2 E_hshe E_ev8 E_ev7 E_ev6 E_ev5 E_ev4 E_ev3 E_ev2 E_ev1 E_etse E_epcle E_agre E_aave B_sizet8 B_sizet7 B_sizet6 B_sizet5 B_sizet4 B_sizet3 B_sizet2 B_sizet1 B_siuvse B_siteve B_sisue B_sislve B_sislpe B_sinwse B_simile B_silde B_sikpe B_sihshe2 B_sihshe B_siev8 B_siev7 B_siev6 B_siev5 B_siev4 B_siev3 B_siev2 B_siev1 B_sietse B_siepcle B_siagre B_siaave B_npzet8 B_npzet7 B_npzet6 B_npzet5 B_npzet4 B_npzet3 B_npzet2 B_npzet1 B_npuvse B_npteve B_npsue B_npslve B_npslpe B_npnwse B_npmile B_nplde B_npkpe B_nphshe2 B_nphshe B_npev8 B_npev7 B_npev6 B_npev5 B_npev4 B_npev3 B_npev2 B_npev1 B_npetse B_npepcle B_npagre B_npaave B_mxzet8 B_mxzet7 B_mxzet6 B_mxzet5 B_mxzet4 B_mxzet3 B_mxzet2 B_mxzet1 B_mxuvse B_mxteve B_mxsue B_mxslve B_mxslpe B_mxnwse B_mxmile B_mxlde B_mxkpe B_mxhshe2 B_mxhshe B_mxev8 B_mxev7 B_mxev6 B_mxev5 B_mxev4 B_mxev3 B_mxev2 B_mxev1 B_mxetse B_mxepcle B_mxagre B_mxaave B_mnzet8 B_mnzet7 B_mnzet6 B_mnzet5 B_mnzet4 B_mnzet3 B_mnzet2 B_mnzet1 B_mnuvse B_mnteve B_mnsue B_mnslve B_mnslpe B_mnnwse B_mnmile B_mnlde B_mnkpe B_mnhshe2 B_mnhshe B_mnev8 B_mnev7 B_mnev6 B_mnev5 B_mnev4 B_mnev3 B_mnev2 B_mnev1 B_mnetse B_mnepcle B_mnagre B_mnaave B_ftzet8 B_ftzet7 B_ftzet6 B_ftzet5 B_ftzet4 B_ftzet3 B_ftzet2 B_ftzet1 B_ftuvse B_ftteve B_ftsue B_ftslve B_ftslpe B_ftnwse B_ftmile B_ftlde B_ftkpe B_fthshe2 B_fthshe B_ftev8 B_ftev7 B_ftev6 B_ftev5 B_ftev4 B_ftev3 B_ftev2 B_ftev1 B_ftetse B_ftepcle B_ftagre B_ftaave B_clzet8 B_clzet7 B_clzet6 B_clzet5 B_clzet4 B_clzet3 B_clzet2 B_clzet1 B_cluvse B_clteve B_clsue B_clslve B_clslpe B_clnwse B_clmile B_cllde B_clkpe B_clhshe2 B_clhshe B_clev8 B_clev7 B_clev6 B_clev5 B_clev4 B_clev3 B_clev2 B_clev1 B_cletse B_clepcle B_clagre B_claave B_bkzet8 B_bkzet7 B_bkzet6 B_bkzet5 B_bkzet4 B_bkzet3 B_bkzet2 B_bkzet1 B_bkuvse B_bkteve B_bksue B_bkslve B_bkslpe B_bknwse B_bkmile B_bklde B_bkkpe B_bkhshe2 B_bkhshe B_bkev8 B_bkev7 B_bkev6 B_bkev5 B_bkev4 B_bkev3 B_bkev2 B_bkev1 B_bketse B_bkepcle B_bkagre B_bkaave B_bezet8 B_bezet7 B_bezet6 B_bezet5 B_bezet4 B_bezet3 B_bezet2 B_bezet1 B_beuvse B_beteve B_besue B_beslve B_beslpe B_benwse B_bemile B_belde B_bekpe B_behshe2 B_behshe B_beev8 B_beev7 B_beev6 B_beev5 B_beev4 B_beev3 B_beev2 B_beev1 B_beetse B_beepcle B_beagre B_beaave /end LOC_MEASUREMENT
/end FUNCTION
/begin FUNCTION DFPM_DFPM ""
 /begin REF_CHARACTERISTIC TSFZZZ TSFAAA FFTZZZ FFTAAA CLAZZZ CLAAAA CDTZZZ CDTAAA CDKZZZ CDKAAA CDCZZZ CDCAAA /end REF_CHARACTERISTIC
 /begin LOC_MEASUREMENT sfpzzz sfpaaa /end LOC_MEASUREMENT
/end FUNCTION
/begin FUNCTION DFPM_DHFM "" /begin REF_CHARACTERISTIC TSFLM FFTLM CLALM CDTLM CDKLM CDCLM /end REF_CHARACTERISTIC
 /begin LOC_MEASUREMENT Z_lm TYP_lm sfplm E_lm B_silm B_nplm B_mxlm B_mnlm B_ftlm B_cllm B_bklm B_belm /end LOC_MEASUREMENT
/end FUNCTION
/begin FUNCTION DFPM_DHLSHK "" /begin REF_CHARACTERISTIC TSFHSH FFTHSH CLAHSH CDTHSH CDKHSH CDCHSH /end REF_CHARACTERISTIC
 /begin LOC_MEASUREMENT Z_hsh TYP_hsh sfphsh E_hsh B_sihsh B_nphsh B_mxhsh B_mnhsh B_fthsh B_clhsh B_bkhsh B_behsh /end LOC_MEASUREMENT
/end FUNCTION
/begin FUNCTION DFPM_DHLSVK ""
 /begin REF_CHARACTERISTIC TSFHSV2 TSFHSV FFTHSV2 FFTHSV CLAHSV2 CLAHSV CDTHSV2 CDTHSV CDKHSV2 CDKHSV CDCHSV2 CDCHSV /end REF_CHARACTERISTIC
 /begin LOC_MEASUREMENT Z_hsv2 Z_hsv TYP_hsv2 TYP_hsv sfphsv2 sfphsv E_hsv2 E_hsv B_sihsv2 B_sihsv B_nphsv2 B_nphsv B_mxhsv2 B_mxhsv B_mnhsv2 B_mnhsv B_fahsv2 B_fahsv B_clhsv2 B_clhsv B_bkhsv2 B_bkhsv B_behsv2 B_behsv /end LOC_MEASUREMENT
/end FUNCTION
/begin FUNCTION DFPM_DKAT "" /begin REF_CHARACTERISTIC TSFKAT FFTKAT CLAKAT CDTKAT CDKKAT CDCKAT /end REF_CHARACTERISTIC
 /begin LOC_MEASUREMENT Z_kat TYP_kat sfpkat E_kat B_sikat B_npkat B_mxkat B_mnkat B_ftkat B_clkat B_bkkat B_bekat /end LOC_MEASUREMENT
/end FUNCTION
/begin FUNCTION DFPM_DKRA ""
 /begin REF_CHARACTERISTIC TSFKRA08 TSFKRA07 TSFKRA06 TSFKRA05 TSFKRA04 TSFKRA03 TSFKRA02 TSFKRA01 FFTKRA08 FFTKRA07 FFTKRA06 FFTKRA05 FFTKRA04 FFTKRA03 FFTKRA02 FFTKRA01 CLAKRA08 CLAKRA07 CLAKRA06 CLAKRA05 CLAKRA04 CLAKRA03 CLAKRA02 CLAKRA01 CDTKRA08 CDTKRA07 CDTKRA06 CDTKRA05 CDTKRA04 CDTKRA03 CDTKRA02 CDTKRA01 CDKKRA08 CDKKRA07 CDKKRA06 CDKKRA05 CDKKRA04 CDKKRA03 CDKKRA02 CDKKRA01 CDCKRA08 CDCKRA07 CDCKRA06 CDCKRA05 CDCKRA04 CDCKRA03 CDCKRA02 CDCKRA01 /end REF_CHARACTERISTIC
 /begin LOC_MEASUREMENT Z_kra08 Z_kra07 Z_kra06 Z_kra05 Z_kra04 Z_kra03 Z_kra02 Z_kra01 TYPkra08 TYPkra07 TYPkra06 TYPkra05 TYPkra04 TYPkra03 TYPkra02 TYPkra01 sfpkra08 sfpkra07 sfpkra06 sfpkra05 sfpkra04 sfpkra03 sfpkra02 sfpkra01 E_kra08 E_kra07 E_kra06 E_kra05 E_kra04 E_kra03 E_kra02 E_kra01 B_mxkra08 B_mxkra07 B_mxkra06 B_mxkra05 B_mxkra04 B_mxkra03 B_mxkra02 B_mxkra01 B_clkra08 B_clkra07 B_clkra06 B_clkra05 B_clkra04 B_clkra03 B_clkra02 B_clkra01 /end LOC_MEASUREMENT
/end FUNCTION
/begin FUNCTION DFPM_DKRNT ""
 /begin REF_CHARACTERISTIC TSFKROF TSFKRNT FFTKROF FFTKRNT CLAKROF CLAKRNT CDTKROF CDTKRNT CDKKROF CDKKRNT CDCKROF CDCKRNT /end REF_CHARACTERISTIC
 /begin LOC_MEASUREMENT Z_krof Z_krnt TYP_krof TYP_krnt sfpkrof sfpkrnt E_krof E_krnt B_sikrof B_sikrnt B_npkrof B_npkrnt B_mxkrof B_mxkrnt B_mnkrof B_mnkrnt B_ftkrof B_ftkrnt B_clkrof B_clkrnt B_bkkrof B_bkkrnt B_bekrof B_bekrnt /end LOC_MEASUREMENT
/end FUNCTION
/begin FUNCTION DFPM_DKRS ""
 /begin REF_CHARACTERISTIC TSFKS4 TSFKS3 TSFKS2 TSFKS1 FFTKS4 FFTKS3 FFTKS2 FFTKS1 CLAKS4 CLAKS3 CLAKS2 CLAKS1 CDTKS4 CDTKS3 CDTKS2 CDTKS1 CDKKS4 CDKKS3 CDKKS2 CDKKS1 CDCKS4 CDCKS3 CDCKS2 CDCKS1 /end REF_CHARACTERISTIC
 /begin LOC_MEASUREMENT Z_ks4 Z_ks3 Z_ks2 Z_ks1 TYP_ks4 TYP_ks3 TYP_ks2 TYP_ks1 sfpks4 sfpks3 sfpks2 sfpks1 E_ks4 E_ks3 E_ks2 E_ks1 B_siks4 B_siks3 B_siks2 B_siks1 B_npks4 B_npks3 B_npks2 B_npks1 B_mxks4 B_mxks3 B_mxks2 B_mxks1 B_mnks4 B_mnks3 B_mnks2 B_mnks1 B_ftks4 B_ftks3 B_ftks2 B_ftks1 B_clks4 B_clks3 B_clks2 B_clks1 B_bkks4 B_bkks3 B_bkks2 B_bkks1 B_beks4 B_beks3 B_beks2 B_beks1 /end LOC_MEASUREMENT
/end FUNCTION
/begin FUNCTION DFPM_DKRTP "" /begin REF_CHARACTERISTIC TSFKRTP FFTKRTP CLAKRTP CDTKRTP CDKKRTP CDCKRTP /end REF_CHARACTERISTIC
 /begin LOC_MEASUREMENT Z_krtp TYP_krtp sfpkrtp E_krtp B_sikrtp B_npkrtp B_mxkrtp B_mnkrtp B_ftkrtp B_clkrtp B_bkkrtp B_bekrtp /end LOC_MEASUREMENT
/end FUNCTION
/begin FUNCTION DFPM_DKUPPL "" /begin REF_CHARACTERISTIC TSFKUPPL FFTKUPPL CLAKUPPL CDTKUPPL CDKKUPPL CDCKUPPL /end REF_CHARACTERISTIC
 /begin LOC_MEASUREMENT Z_kuppl TYP_kuppl sfpkuppl E_kuppl B_sikuppl B_npkuppl B_mxkuppl B_mnkuppl B_ftkuppl B_clkuppl B_bkkuppl B_bekuppl /end LOC_MEASUREMENT
/end FUNCTION
/begin FUNCTION DFPM_DKVS ""
 /begin REF_CHARACTERISTIC TSFRKAZ TSFRKAT TSFFRST TSFFRAU TSFFRAO FFTRKAZ FFTRKAT FFTFRST FFTFRAU FFTFRAO CLARKAZ CLARKAT CLAFRST CLAFRAU CLAFRAO CDTRKAZ CDTRKAT CDTFRST CDTFRAU CDTFRAO CDKRKAZ CDKRKAT CDKFRST CDKFRAU CDKFRAO CDCRKAZ CDCRKAT CDCFRST CDCFRAU CDCFRAO /end REF_CHARACTERISTIC
 /begin LOC_MEASUREMENT Z_rkaz Z_rkat Z_frst Z_frau Z_frao TYP_rkaz TYP_rkat TYP_frst TYP_frau TYP_frao sfprkaz sfprkat sfpfrst sfpfrau sfpfrao E_rkaz E_rkat E_frst E_frau E_frao B_sirkaz B_sirkat B_sifrst B_sifrau B_sifrao B_nprkaz B_nprkat B_npfrst B_npfrau B_npfrao B_mxrkaz B_mxrkat B_mxfrst B_mxfrau B_mxfrao B_mnrkaz B_mnrkat B_mnfrst B_mnfrau B_mnfrao B_ftrkaz B_ftrkat B_ftfrst B_ftfrau B_ftfrao B_clrkaz B_clrkat B_clfrst B_clfrau B_clfrao B_bkrkaz B_bkrkat B_bkfrst B_bkfrau B_bkfrao B_berkaz B_berkat B_befrst B_befrau B_befrao /end LOC_MEASUREMENT
/end FUNCTION
/begin FUNCTION DFPM_DLDP ""
 /begin REF_CHARACTERISTIC TSFTESG TSFTESF TSFLDP FFTTESG FFTTESF FFTLDP CLATESG CLATESF CLALDP CDTTESG CDTTESF CDTLDP CDKTESG CDKTESF CDKLDP CDCTESG CDCTESF CDCLDP /end REF_CHARACTERISTIC
 /begin LOC_MEASUREMENT Z_tesg Z_tesf Z_ldp TYP_tesg TYP_tesf TYP_ldp sfptesg sfptesf sfpldp E_tesg E_tesf E_ldp B_sitesg B_sitesf B_sildp B_nptesg B_nptesf B_npldp B_mxtesg B_mxtesf B_mxldp B_mntesg B_mntesf B_mnldp B_fttesg B_fttesf B_ftldp B_cltesg B_cltesf B_clldp B_bktesg B_bktesf B_bkldp B_betesg B_betesf B_beldp /end LOC_MEASUREMENT
/end FUNCTION
/begin FUNCTION DFPM_DLDR ""
 /begin REF_CHARACTERISTIC TSFLDRA TSFLDO FFTLDRA FFTLDO CLALDRA CLALDO CDTLDRA CDTLDO CDKLDRA CDKLDO CDCLDRA CDCLDO /end REF_CHARACTERISTIC
 /begin LOC_MEASUREMENT Z_ldra Z_ldo TYP_ldra TYP_ldo sfpldra sfpldo E_ldra E_ldo B_sildra B_sildo B_npldra B_npldo B_mxldra B_mxldo B_mnldra B_mnldo B_ftldra B_ftldo B_clldra B_clldo B_bkldra B_bkldo B_beldra B_beldo /end LOC_MEASUREMENT
/end FUNCTION
/begin FUNCTION DFPM_DLLR "" /begin REF_CHARACTERISTIC TSFLLR FFTLLR CLALLR CDTLLR CDKLLR CDCLLR /end REF_CHARACTERISTIC
 /begin LOC_MEASUREMENT Z_llr TYP_LLR sfpllr E_llr B_sillr B_npllr B_mxllr B_mnllr B_ftllr B_clllr B_bkllr B_bellr /end LOC_MEASUREMENT
/end FUNCTION
/begin FUNCTION DFPM_DLSA ""
 /begin REF_CHARACTERISTIC TSFLATV2 TSFLATV TSFLATP2 TSFLATP FFTLATV2 FFTLATV FFTLATP2 FFTLATP CLALATV2 CLALATV CLALATP2 CLALATP CDTLATV2 CDTLATV CDTLATP2 CDTLATP CDKLATV2 CDKLATV CDKLATP2 CDKLATP CDCLATV2 CDCLATV CDCLATP2 CDCLATP /end REF_CHARACTERISTIC
 /begin LOC_MEASUREMENT Z_latv2 Z_latv Z_latp2 Z_latp TYP_latv2 TYP_latv TYP_latp2 TYP_latp sfplatv2 sfplatv sfplatp2 sfplatp E_latv2 E_latv E_latp2 E_latp B_silatv2 B_silatv B_silatp2 B_silatp B_nplatv2 B_nplatv B_nplatp2 B_nplatp B_mxlatv2 B_mxlatv B_mxlatp2 B_mxlatp B_mnlatv2 B_mnlatv B_mnlatp2 B_mnlatp B_ftlatv2 B_ftlatv B_ftlatp2 B_ftlatp B_cllatv2 B_cllatv B_cllatp2 B_cllatp B_bklatv2 B_bklatv B_bklatp2 B_bklatp B_belatv2 B_belatv B_belatp2 B_belatp /end LOC_MEASUREMENT
/end FUNCTION
/begin FUNCTION DFPM_DLSAHK ""
 /begin REF_CHARACTERISTIC TSFLASH2 TSFLASH FFTLASH2 FFTLASH CLALASH2 CLALASH CDTLASH2 CDTLASH CDKLASH2 CDKLASH CDCLASH2 CDCLASH /end REF_CHARACTERISTIC
 /begin LOC_MEASUREMENT Z_lash2 Z_lash TYP_lash2 TYP_lash sfplash2 sfplash E_lash2 E_lash B_silash2 B_silash B_nplash2 B_nplash B_mxlash2 B_mxlash B_mnlash2 B_mnlash B_falash2 B_falash B_cllash2 B_cllash B_bklash2 B_bklash B_belash2 B_belash /end LOC_MEASUREMENT
/end FUNCTION
/begin FUNCTION DFPM_DLSH "" /begin REF_CHARACTERISTIC TSFLSH FFTLSH CLALSH CDTLSH CDKLSH CDCLSH /end REF_CHARACTERISTIC
 /begin LOC_MEASUREMENT Z_lsh TYP_lsh sfplsh E_lsh B_silsh B_nplsh B_mxlsh B_mnlsh B_ftlsh B_cllsh B_bklsh B_belsh /end LOC_MEASUREMENT
/end FUNCTION
/begin FUNCTION DFPM_DLSV "" /begin REF_CHARACTERISTIC TSFLSV FFTLSV CLALSV CDTLSV CDKLSV CDCLSV /end REF_CHARACTERISTIC
 /begin LOC_MEASUREMENT Z_lsv TYP_lsv sfplsv E_lsv B_silsv B_nplsv B_mxlsv B_mnlsv B_ftlsv B_cllsv B_bklsv B_belsv /end LOC_MEASUREMENT
/end FUNCTION
/end MODULE
/end PROJECT
