ASAP2_VERSION 1 21
/begin PROJECT Pro4017 "R4 1.8l 5V T lÑngs FR5ROM F5051"
/begin HEADER "" PROJECT_NO Pro4017 VERSION "PrV = F21dc mit 00" /end HEADER
/begin MODULE DIM " "
/begin MOD_COMMON " " S_REC_LAYOUT ME7 BYTE_ORDER MSB_LAST /end MOD_COMMON
/begin RECORD_LAYOUT ME7_FW4 FNC_VALUES 1 SWORD COLUMN_DIR DIRECT /end RECORD_LAYOUT
/begin RECORD_LAYOUT ME7_FW1 FNC_VALUES 1 UBYTE COLUMN_DIR DIRECT /end RECORD_LAYOUT
/begin RECORD_LAYOUT ME7_FW3 FNC_VALUES 1 UWORD COLUMN_DIR DIRECT /end RECORD_LAYOUT
/begin RECORD_LAYOUT ME7_GKL1 FNC_VALUES 1 UBYTE COLUMN_DIR DIRECT /end RECORD_LAYOUT
/begin RECORD_LAYOUT ME7_FWB1 FNC_VALUES 1 UBYTE COLUMN_DIR DIRECT /end RECORD_LAYOUT
/begin RECORD_LAYOUT ME7_GKL3 FNC_VALUES 1 UWORD COLUMN_DIR DIRECT /end RECORD_LAYOUT
/begin RECORD_LAYOUT ME7_FW2 FNC_VALUES 1 SBYTE COLUMN_DIR DIRECT /end RECORD_LAYOUT
/begin RECORD_LAYOUT ZF_KL111 NO_AXIS_PTS_X 1 UWORD AXIS_PTS_X 2 UWORD INDEX_INCR DIRECT FNC_VALUES 3 UWORD ROW_DIR DIRECT /end RECORD_LAYOUT
/begin RECORD_LAYOUT ME7_KL97 NO_AXIS_PTS_X 1 UBYTE AXIS_PTS_X 2 UBYTE INDEX_INCR DIRECT FNC_VALUES 3 UBYTE COLUMN_DIR DIRECT /end RECORD_LAYOUT
/begin RECORD_LAYOUT ME7_FWB3 FNC_VALUES 1 UWORD COLUMN_DIR DIRECT /end RECORD_LAYOUT
/begin RECORD_LAYOUT ME7_GKL2 FNC_VALUES 1 SBYTE COLUMN_DIR DIRECT /end RECORD_LAYOUT
/begin RECORD_LAYOUT ME7_KL99 NO_AXIS_PTS_X 1 UBYTE AXIS_PTS_X 2 UBYTE INDEX_INCR DIRECT FNC_VALUES 3 UWORD COLUMN_DIR DIRECT /end RECORD_LAYOUT
/begin RECORD_LAYOUT ZF_KL117 NO_AXIS_PTS_X 1 UWORD AXIS_PTS_X 2 SWORD INDEX_INCR DIRECT FNC_VALUES 3 UWORD ROW_DIR DIRECT /end RECORD_LAYOUT
/begin RECORD_LAYOUT ME7_FKL1 FNC_VALUES 1 UBYTE COLUMN_DIR DIRECT /end RECORD_LAYOUT
/begin RECORD_LAYOUT ME7_SST97 NO_AXIS_PTS_X 1 UBYTE AXIS_PTS_X 2 UBYTE INDEX_INCR DIRECT /end RECORD_LAYOUT
/begin RECORD_LAYOUT ME7_FKL3 FNC_VALUES 1 UWORD COLUMN_DIR DIRECT /end RECORD_LAYOUT
/begin RECORD_LAYOUT ME7_SST109 NO_AXIS_PTS_X 1 UWORD AXIS_PTS_X 2 UWORD INDEX_INCR DIRECT /end RECORD_LAYOUT
/begin AXIS_PTS SML06TEUB "ml abhÑngige StÅtzstellen (Anzahl 6)" 0x8181B5 ml ME7_SST97 0 m_ub_b1020 6 0.000000 1020.000000 DEPOSIT ABSOLUTE EXTENDED_LIMITS 0.000000 65535.000000 /end AXIS_PTS
/begin AXIS_PTS SML07TMUW "" 0x81A0E0 ml_w ME7_SST109 0 m_uw_b6553p5 7 0.000000 6553.500000 DEPOSIT ABSOLUTE EXTENDED_LIMITS 0.000000 65535.000000 /end AXIS_PTS
/begin AXIS_PTS SML08LHUB "" 0x8181C3 ml ME7_SST97 0 m_ub_b1020 8 0.000000 1020.000000 DEPOSIT ABSOLUTE EXTENDED_LIMITS 0.000000 65535.000000 /end AXIS_PTS
/begin AXIS_PTS SNM08GKUB "StÅtzstellenverteilung Gemischkontrolle 8 nmot StÅtzstellen" 0x818A9C nmot ME7_SST97 0 nmot_ub_q40 8 0.000000 10200.000000 DEPOSIT ABSOLUTE EXTENDED_LIMITS 0.000000 182.041667 /end AXIS_PTS
/begin AXIS_PTS SNM08KOUB "StÅtzstellenverteilung fÅr Klimakompressorsteuerung  8  nmot" 0x816491 nmot ME7_SST97 0 nmot_ub_q40 8 0.000000 10200.000000 DEPOSIT ABSOLUTE EXTENDED_LIMITS 0.000000 182.041667 /end AXIS_PTS
/begin AXIS_PTS SNM08LDUW "" 0x81003E nmot_w ME7_SST109 0 nmot_uw_q0p25 8 0.000000 16383.800000 DEPOSIT ABSOLUTE EXTENDED_LIMITS 0.000000 182.041667 /end AXIS_PTS
/begin AXIS_PTS SNM08__UB "StÅtzstellenverteilung Drehzahl, 8 Sst." 0x8181FB nmot ME7_SST97 0 nmot_ub_q40 8 0.000000 10200.000000 DEPOSIT ABSOLUTE EXTENDED_LIMITS 0.000000 182.041667 /end AXIS_PTS
/begin AXIS_PTS SNM12FEUB "StÅtzstellen fÅr WDKSMX, WDKUGDN" 0x8143C3 nmot ME7_SST97 0 nmot_ub_q40 12 0.000000 10200.000000 DEPOSIT ABSOLUTE EXTENDED_LIMITS 0.000000 182.041667 /end AXIS_PTS
/begin AXIS_PTS SNM16KRUB "StÅtzstellenverteilung Drehzahl, 16 Sst." 0x818242 nmot ME7_SST97 0 nmot_ub_q40 16 0.000000 10200.000000 DEPOSIT ABSOLUTE EXTENDED_LIMITS 0.000000 182.041667 /end AXIS_PTS
/begin AXIS_PTS STA12ESUB "" 0x814434 tans ME7_SST97 0 temp_ub_q0p75_o48 12 -48.000000 143.250000 DEPOSIT ABSOLUTE EXTENDED_LIMITS 0.000000 255.000000 /end AXIS_PTS
/begin AXIS_PTS STM05SAUB "" 0x8182A3 tmot ME7_SST97 0 temp_ub_q0p75_o48 5 -48.000000 143.250000 DEPOSIT ABSOLUTE EXTENDED_LIMITS 0.000000 10200.000000 /end AXIS_PTS
/begin AXIS_PTS STM08MDUB "" 0x8182C6 tmot ME7_SST97 0 temp_ub_q0p75_o48 8 -48.000000 143.250000 DEPOSIT ABSOLUTE EXTENDED_LIMITS 0.000000 10200.000000 /end AXIS_PTS
/begin AXIS_PTS STM08OPUB "" 0x814461 tmot ME7_SST97 0 temp_ub_q0p75_o48 8 -48.000000 143.250000 DEPOSIT ABSOLUTE EXTENDED_LIMITS 0.000000 10200.000000 /end AXIS_PTS
/begin AXIS_PTS STM09ESUB "StÅtzstellenverteilung Motortemperatur, 9 Sst." 0x8182CF tmot ME7_SST97 0 temp_ub_q0p75_o48 9 -48.000000 143.250000 DEPOSIT ABSOLUTE EXTENDED_LIMITS 0.000000 10200.000000 /end AXIS_PTS
/begin AXIS_PTS SUE08MFUB "" 0x814493 uevges ME7_SST97 0 fak_q0p1 8 0.000000 25.500000 DEPOSIT ABSOLUTE EXTENDED_LIMITS 0.000000 10200.000000 /end AXIS_PTS
/begin CHARACTERISTIC TQTEAB "Zeit fÅr Absteuerung SpÅlrate TankentlÅftung" VALUE 0x815E36 ME7_FW1 0 t20msxs_ub_q0p32 0.320000 81.600000 EXTENDED_LIMITS 0.000000 81.600000 /end CHARACTERISTIC
/begin CHARACTERISTIC TQTEDAB "Zeit fÅr schnelle Absteuerung SpÅlrate TankentlÅftung" VALUE 0x815E37 ME7_FW1 0 t20msxs_ub_q0p32 0.320000 81.600000 EXTENDED_LIMITS 0.000000 81.600000 /end CHARACTERISTIC
/begin CHARACTERISTIC TRAU "öberwachungszeit fÅr untere Lastschwelle der Lambdaregelung" VALUE 0x819CAF ME7_FW1 0 t100msxs_ub_b25p5 0.000000 25.500000 /end CHARACTERISTIC
/begin CHARACTERISTIC TRD "Zahnperiodenzeit fÅr RÅckdrehen im Auslauf" VALUE 0x814D6A ME7_FW1 0 t1msxms_q1 0.000000 100.000000 EXTENDED_LIMITS 0.000000 255.000000 /end CHARACTERISTIC
/begin CHARACTERISTIC TREHS "Zeit fÅr Restart Sondenheizung" VALUE 0x818523 ME7_FW1 0 t100msxs_ub_b25p5 0.000000 25.500000 /end CHARACTERISTIC
/begin CHARACTERISTIC TRIAKTH "Zeitdauer fÅr Ri-Berechnung aktuell hinter KAT" VALUE 0x810BC0 ME7_FW3 0 t100msxs_uw_b6553p5 0.000000 6553.500000 /end CHARACTERISTIC
/begin CHARACTERISTIC TRIAKTV "Zeitdauer fÅr Ri-Berechnung aktuell vor KAT" VALUE 0x810BD4 ME7_FW3 0 t100msxs_uw_b6553p5 0.000000 6553.500000 /end CHARACTERISTIC
/begin CHARACTERISTIC TRIIMPH "Zeitdauer fÅr Pumpimpuls fÅr beide BÑnke hinter KAT" VALUE 0x810BC2 ME7_FW3 0 t10msxs_uw_b655p35 0.000000 655.350000 /end CHARACTERISTIC
/begin CHARACTERISTIC TRIIMPV "Zeitdauer fÅr Pumpimpuls fÅr beide BÑnke vor KAT" VALUE 0x810BD6 ME7_FW3 0 t10msxs_uw_b655p35 0.000000 655.350000 /end CHARACTERISTIC
/begin CHARACTERISTIC TRIPFASH "Mindest Zeitdauer fÅr aktive Lamda Regelung vor KAT" VALUE 0x81AD5A ME7_FW3 0 t100msxs_uw_b6553p5 0.000000 6553.500000 /end CHARACTERISTIC
/begin CHARACTERISTIC TRKA "Erkennungszeit fÅr eingeschwungene Grundadaption von rkat bzw. rkaz" VALUE 0x818E1E ME7_FW1 0 t200msxs_ub_b51 0.000000 51.000000 /end CHARACTERISTIC
/begin CHARACTERISTIC TRKATZ "Aktivierungszeit von rkat bis Setzen Zyklusflag, wenn B_gae = FALSE" VALUE 0x818E1F ME7_FW1 0 t200msxs_ub_b51 0.000000 51.000000 /end CHARACTERISTIC
/begin CHARACTERISTIC TRKAUF "öberwachungszeit Reedkontakt îffnet wÑhrend Fast Pulse" VALUE 0x8135F2 ME7_FW3 0 t10msxs_uw_b655p35 0.000000 655.350000 /end CHARACTERISTIC
/begin CHARACTERISTIC TRKAZZ "Aktivierungszeit von rkaz bis Setzen Zyklusflag, wenn B_gae = FALSE" VALUE 0x818E20 ME7_FW1 0 t200msxs_ub_b51 0.000000 51.000000 /end CHARACTERISTIC
/begin CHARACTERISTIC TRSA "öberwachungszeit Regelung (vor KAT)-> Sonde Aus" VALUE 0x8184F8 ME7_FW1 0 t100msxs_ub_b25p5 0.000000 25.500000 /end CHARACTERISTIC
/begin CHARACTERISTIC TRSAFA "öberwachungszeit Regelung hinter KAT: Funktions Anforderung fÅr Kurz-Trip-Test" VALUE 0x81AD38 ME7_FW3 0 t100msxs_uw_q100 0.000000 6553.500000 /end CHARACTERISTIC
/begin CHARACTERISTIC TRSAH "öberwachungszeit Regelung (hinter KAT)-> Sonde Aus" VALUE 0x81AD3A ME7_FW3 0 t100msxs_uw_q100 0.000000 6553.500000 /end CHARACTERISTIC
/begin CHARACTERISTIC TRSE "öberwachungszeit -> Regelung ein" VALUE 0x8184AC ME7_FW1 0 t100msxs_ub_b25p5 0.000000 25.500000 /end CHARACTERISTIC
/begin CHARACTERISTIC TSAKAMN "Mindestdauer SA fÅr Funktion Katalysator-AusrÑumen" VALUE 0x815E93 ME7_FW1 0 t20msxs_ub_b5p1 0.000000 5.100000 /end CHARACTERISTIC
/begin CHARACTERISTIC TSALASH "Zeit nach Schub fÅr öberprÅfung Sonde hinter KAT" VALUE 0x8184C0 ME7_FW1 0 t100msxs_ub_b25p5 0.000000 25.500000 /end CHARACTERISTIC
/begin CHARACTERISTIC TSBBVTMS "Verzîgerung Einschalten LR nach Sondenbetriebsbereitschaft" CURVE 0x8136C0 ME7_KL99 0 t100msxs_uw_b6553p5 0.000000 6553.500000
 /begin AXIS_DESCR STD_AXIS tmst temp_ub_q0p75_o48 4 -48.000000 143.250000 DEPOSIT ABSOLUTE /end AXIS_DESCR
/end CHARACTERISTIC
/begin CHARACTERISTIC TSFAAA "Dummy: Tabellenanfang" VALUE 0x814CC0 ME7_FW1 0 dez 0.000000 255.000000 /end CHARACTERISTIC
/begin CHARACTERISTIC TSFAAVE "Fehlersummenzeit: Absperrventil Aktivkohlefilter (Endstufe)" VALUE 0x814CC1 ME7_FW1 0 dez 0.000000 255.000000 /end CHARACTERISTIC
/begin CHARACTERISTIC TSFAGRE "Fehlersummenzeit: öberwachung AGR-Endstufe" VALUE 0x814CC2 ME7_FW1 0 dez 0.000000 255.000000 /end CHARACTERISTIC
/begin CHARACTERISTIC TSFAGRF "Fehlersummenzeit: öberwachung AGR-FLOW" VALUE 0x814CC3 ME7_FW1 0 dez 0.000000 255.000000 /end CHARACTERISTIC
/begin CHARACTERISTIC TSFBM "Fehlersummenzeit: Bezugsmarkengeber" VALUE 0x814CC4 ME7_FW1 0 dez 0.000000 255.000000 /end CHARACTERISTIC
/begin CHARACTERISTIC TSFBREMS "Fehlersummenzeit: BREMS (Bremsschalter)" VALUE 0x814CC5 ME7_FW1 0 dez 0.000000 255.000000 /end CHARACTERISTIC
/begin CHARACTERISTIC TSFBWF "Fehlersummenzeit: PWG Bewegung" VALUE 0x814CC6 ME7_FW1 0 dez 0.000000 255.000000 /end CHARACTERISTIC
/begin CHARACTERISTIC TSFCADR "Fehlersummenzeit: CAN- Timeout ADR" VALUE 0x814CC7 ME7_FW1 0 dez 0.000000 255.000000 /end CHARACTERISTIC
/begin CHARACTERISTIC TSFCAS "Fehlersummenzeit: CAN-Schnittstelle, Timeout ASC" VALUE 0x814CC8 ME7_FW1 0 dez 0.000000 255.000000 /end CHARACTERISTIC
/begin CHARACTERISTIC TSFCAT "Fehlersummenzeit: CAN-Schnittstelle, Timeout ASR" VALUE 0x814CC9 ME7_FW1 0 dez 0.000000 255.000000 /end CHARACTERISTIC
/begin CHARACTERISTIC TSFCGE "Fehlersummenzeit: CAN-Schnittstelle, Timeout EGS" VALUE 0x814CCA ME7_FW1 0 dez 0.000000 255.000000 /end CHARACTERISTIC
/begin CHARACTERISTIC TSFCIF "Fehlersummenzeit: CAN-Schnittstelle, interner Fehler" VALUE 0x814CCB ME7_FW1 0 dez 0.000000 255.000000 /end CHARACTERISTIC
/begin CHARACTERISTIC TSFCINS "Fehlersummenzeit: CAN-Schnittstelle, Timeout Instrument" VALUE 0x814CCC ME7_FW1 0 dez 0.000000 255.000000 /end CHARACTERISTIC
/begin CHARACTERISTIC TSFCLWS "Fehlersummenzeit: CAN-Schnittstelle, Timeout Botschaft Lenkwinkelsensor" VALUE 0x814CCD ME7_FW1 0 dez 0.000000 255.000000 /end CHARACTERISTIC
/begin CHARACTERISTIC TSFDK "Fehlersummenzeit: DK - Potentiometer" VALUE 0x814CCE ME7_FW1 0 dez 0.000000 255.000000 /end CHARACTERISTIC
/begin CHARACTERISTIC TSFDK1P "Fehlersummenzeit: Drosselklappe 1. Poti" VALUE 0x814CCF ME7_FW1 0 dez 0.000000 255.000000 /end CHARACTERISTIC
/begin CHARACTERISTIC TSFDK2P "Fehlersummenzeit: Drosselklappenpotentiometer 2" VALUE 0x814CD0 ME7_FW1 0 dez 0.000000 255.000000 /end CHARACTERISTIC
/begin CHARACTERISTIC TSFDPL "Fehlersummenzeit: Dauerplus" VALUE 0x814CD1 ME7_FW1 0 dez 0.000000 255.000000 /end CHARACTERISTIC
/begin CHARACTERISTIC TSFDSL "Fehlersummenzeit: Drucksensor Ladedruck" VALUE 0x814CD2 ME7_FW1 0 dez 0.000000 255.000000 /end CHARACTERISTIC
/begin CHARACTERISTIC TSFDSS "Fehlersummenzeit: Saugrohr-Drucksensor" VALUE 0x814CD3 ME7_FW1 0 dez 0.000000 255.000000 /end CHARACTERISTIC
/begin CHARACTERISTIC TSFDSU "Fehlersummenzeit: Drucksensor Umgebung" VALUE 0x814CD4 ME7_FW1 0 dez 0.000000 255.000000 /end CHARACTERISTIC
/begin CHARACTERISTIC TSFDSVLU "" VALUE 0x814CD5 ME7_FW1 0 dez 0.000000 255.000000 /end CHARACTERISTIC
/begin CHARACTERISTIC TSFDVEE "Fehlersummenzeit: DV-E Endstufe" VALUE 0x814CD6 ME7_FW1 0 dez 0.000000 255.000000 /end CHARACTERISTIC
/begin CHARACTERISTIC TSFDVEF "Fehlersummenzeit: DV-E Fehler bei FederprÅfung" VALUE 0x814CD7 ME7_FW1 0 dez 0.000000 255.000000 /end CHARACTERISTIC
/begin CHARACTERISTIC TSFDVEFO "" VALUE 0x814CD8 ME7_FW1 0 dez 0.000000 255.000000 /end CHARACTERISTIC
/begin CHARACTERISTIC TSFDVEL "Fehlersummenzeit: DV-E Lageabweichung" VALUE 0x814CD9 ME7_FW1 0 dez 0.000000 255.000000 /end CHARACTERISTIC
/begin CHARACTERISTIC TSFDVEN "Fehlersummenzeit: DV-E Fehler bei PrÅfung Notluftposition" VALUE 0x814CDA ME7_FW1 0 dez 0.000000 255.000000 /end CHARACTERISTIC
/begin CHARACTERISTIC TSFDVER "Fehlersummenzeit: DV-E Regelbereich" VALUE 0x814CDB ME7_FW1 0 dez 0.000000 255.000000 /end CHARACTERISTIC
/begin CHARACTERISTIC TSFDVET "" VALUE 0x814CDC ME7_FW1 0 dez 0.000000 255.000000 /end CHARACTERISTIC
/begin CHARACTERISTIC TSFDVEU "Fehlersummenzeit: DV-E Fehler beim UMA-Lernen" VALUE 0x814CDD ME7_FW1 0 dez 0.000000 255.000000 /end CHARACTERISTIC
/begin CHARACTERISTIC TSFDVEUB "" VALUE 0x814CDE ME7_FW1 0 dez 0.000000 255.000000 /end CHARACTERISTIC
/begin CHARACTERISTIC TSFDVEUW "" VALUE 0x814CDF ME7_FW1 0 dez 0.000000 255.000000 /end CHARACTERISTIC
/begin CHARACTERISTIC TSFDVEV "Fehlersummenzeit: DV-E Fehler bei VerstÑrkerabgleich" VALUE 0x814CE0 ME7_FW1 0 dez 0.000000 255.000000 /end CHARACTERISTIC
/begin CHARACTERISTIC TSFEGFE "" VALUE 0x814CE1 ME7_FW1 0 dez 0.000000 255.000000 /end CHARACTERISTIC
/begin CHARACTERISTIC TSFEPCLE "Fehlersummenzeit: Fahrverhaltens- Fehllampe ( Endstufe )" VALUE 0x814CE2 ME7_FW1 0 dez 0.000000 255.000000 /end CHARACTERISTIC
/begin CHARACTERISTIC TSFETSE "Fehlersummenzeit: Elektrisches Thermosatat Endstufe" VALUE 0x814CE3 ME7_FW1 0 dez 0.000000 255.000000 /end CHARACTERISTIC
/begin CHARACTERISTIC TSFEV1 "Fehlersummenzeit: EV von Zyl. 1" VALUE 0x814CE4 ME7_FW1 0 dez 0.000000 255.000000 /end CHARACTERISTIC
/begin CHARACTERISTIC TSFEV2 "Fehlersummenzeit: EV von Zyl. 2" VALUE 0x814CE5 ME7_FW1 0 dez 0.000000 255.000000 /end CHARACTERISTIC
/begin CHARACTERISTIC TSFEV3 "Fehlersummenzeit: EV von Zyl. 3" VALUE 0x814CE6 ME7_FW1 0 dez 0.000000 255.000000 /end CHARACTERISTIC
/begin CHARACTERISTIC TSFEV4 "Fehlersummenzeit: EV von Zyl. 4" VALUE 0x814CE7 ME7_FW1 0 dez 0.000000 255.000000 /end CHARACTERISTIC
/begin CHARACTERISTIC TSFEV5 "Fehlersummenzeit: EV von Zyl. 5" VALUE 0x814CE8 ME7_FW1 0 dez 0.000000 255.000000 /end CHARACTERISTIC
/begin CHARACTERISTIC TSFEV6 "Fehlersummenzeit: EV von Zyl. 6" VALUE 0x814CE9 ME7_FW1 0 dez 0.000000 255.000000 /end CHARACTERISTIC
/begin CHARACTERISTIC TSFEV7 "Fehlersummenzeit: EV von Zyl. 7" VALUE 0x814CEA ME7_FW1 0 dez 0.000000 255.000000 /end CHARACTERISTIC
/begin CHARACTERISTIC TSFEV8 "Fehlersummenzeit: EV von Zyl. 8" VALUE 0x814CEB ME7_FW1 0 dez 0.000000 255.000000 /end CHARACTERISTIC
/begin CHARACTERISTIC TSFFP1P "Fehlersummenzeit: Poti 1, Fahrpedal" VALUE 0x814CEC ME7_FW1 0 dez 0.000000 255.000000 /end CHARACTERISTIC
/begin CHARACTERISTIC TSFFP2P "Fehlersummenzeit: Poti 2, Fahrpedal" VALUE 0x814CED ME7_FW1 0 dez 0.000000 255.000000 /end CHARACTERISTIC
/begin CHARACTERISTIC TSFFPP "Fehlersummenzeit: Poti Fahrpedal" VALUE 0x814CEE ME7_FW1 0 dez 0.000000 255.000000 /end CHARACTERISTIC
/begin CHARACTERISTIC TSFFRAO "Fehlersummenzeit: LR-Adaption oberer Bereich" VALUE 0x814CEF ME7_FW1 0 dez 0.000000 255.000000 /end CHARACTERISTIC
/begin CHARACTERISTIC TSFFRAU "Fehlersummenzeit: LR-Adaption unterer Bereich" VALUE 0x814CF0 ME7_FW1 0 dez 0.000000 255.000000 /end CHARACTERISTIC
/begin CHARACTERISTIC TSFFRST "Fehlersummenzeit: LR-Abweichung" VALUE 0x814CF1 ME7_FW1 0 dez 0.000000 255.000000 /end CHARACTERISTIC
/begin CHARACTERISTIC TSFGECOD "" VALUE 0x814CF2 ME7_FW1 0 dez 0.000000 255.000000 /end CHARACTERISTIC
/begin CHARACTERISTIC TSFGRBH "Fehlersummenzeit: GRA Bedienhebel" VALUE 0x814CF3 ME7_FW1 0 dez 0.000000 255.000000 /end CHARACTERISTIC
/begin CHARACTERISTIC TSFHSH "Fehlersummenzeit: Lambdasonden-Heizung hinter Katalysator" VALUE 0x814CF4 ME7_FW1 0 dez 0.000000 255.000000 /end CHARACTERISTIC
/begin CHARACTERISTIC TSFHSHE "Fehlersummenzeit: Endstufe Heizung Sonde hinter Kat." VALUE 0x814CF5 ME7_FW1 0 dez 0.000000 255.000000 /end CHARACTERISTIC
/begin CHARACTERISTIC TSFHSHE2 "Fehlersummenzeit: Endstufe Heizung Sonde hinter Kat. Bank 2" VALUE 0x814CF6 ME7_FW1 0 dez 0.000000 255.000000 /end CHARACTERISTIC
/begin CHARACTERISTIC TSFHSV "Fehlersummenzeit: Lambdasonden-Heizung vor Katalysator" VALUE 0x814CF7 ME7_FW1 0 dez 0.000000 255.000000 /end CHARACTERISTIC
/begin CHARACTERISTIC TSFHSV2 "Fehlersummenzeit: Lambdasonden-Heizung vor Katalysator, Bank 2" VALUE 0x814CF8 ME7_FW1 0 dez 0.000000 255.000000 /end CHARACTERISTIC
/begin CHARACTERISTIC TSFKAT "Fehlersummenzeit: Katalysator-Konvertierung" VALUE 0x814CF9 ME7_FW1 0 dez 0.000000 255.000000 /end CHARACTERISTIC
/begin CHARACTERISTIC TSFKPE "Fehlersummenzeit: EKP-Relais Endstufe" VALUE 0x814CFA ME7_FW1 0 dez 0.000000 255.000000 /end CHARACTERISTIC
/begin CHARACTERISTIC TSFKRA01 "Fehlersummenzeit: Klopfregelanschlag Zylinder 1" VALUE 0x814CFB ME7_FW1 0 dez 0.000000 255.000000 /end CHARACTERISTIC
/begin CHARACTERISTIC TSFKRA02 "Fehlersummenzeit: Klopfregelanschlag Zylinder 2" VALUE 0x814CFC ME7_FW1 0 dez 0.000000 255.000000 /end CHARACTERISTIC
/begin CHARACTERISTIC TSFKRA03 "Fehlersummenzeit: Klopfregelanschlag Zylinder 3" VALUE 0x814CFD ME7_FW1 0 dez 0.000000 255.000000 /end CHARACTERISTIC
/begin CHARACTERISTIC TSFKRA04 "Fehlersummenzeit: Klopfregelanschlag Zylinder 4" VALUE 0x814CFE ME7_FW1 0 dez 0.000000 255.000000 /end CHARACTERISTIC
/begin CHARACTERISTIC TSFKRA05 "Fehlersummenzeit: Klopfregelanschlag Zylinder 5" VALUE 0x814CFF ME7_FW1 0 dez 0.000000 255.000000 /end CHARACTERISTIC
/begin CHARACTERISTIC TSFKRA06 "Fehlersummenzeit: Klopfregelanschlag Zylinder 6" VALUE 0x814D00 ME7_FW1 0 dez 0.000000 255.000000 /end CHARACTERISTIC
/begin CHARACTERISTIC TSFKRA07 "Fehlersummenzeit: Klopfregelanschlag Zylinder 7" VALUE 0x814D01 ME7_FW1 0 dez 0.000000 255.000000 /end CHARACTERISTIC
/begin CHARACTERISTIC TSFKRA08 "Fehlersummenzeit: Klopfregelanschlag Zylinder 8" VALUE 0x814D02 ME7_FW1 0 dez 0.000000 255.000000 /end CHARACTERISTIC
/begin CHARACTERISTIC TSFKRNT "Fehlersummenzeit: Klopfregelung Nulltest" VALUE 0x814D03 ME7_FW1 0 dez 0.000000 255.000000 /end CHARACTERISTIC
/begin CHARACTERISTIC TSFKROF "Fehlersummenzeit: Klopfregelung Offset" VALUE 0x814D04 ME7_FW1 0 dez 0.000000 255.000000 /end CHARACTERISTIC
/begin CHARACTERISTIC TSFKRTP "Fehlersummenzeit: Klopfregelung Testimpuls" VALUE 0x814D05 ME7_FW1 0 dez 0.000000 255.000000 /end CHARACTERISTIC
/begin CHARACTERISTIC TSFKS1 "Fehlersummenzeit: Klopfsensor 1" VALUE 0x814D06 ME7_FW1 0 dez 0.000000 255.000000 /end CHARACTERISTIC
/begin CHARACTERISTIC TSFKS2 "Fehlersummenzeit: Klopfsensor 2" VALUE 0x814D07 ME7_FW1 0 dez 0.000000 255.000000 /end CHARACTERISTIC
/begin CHARACTERISTIC TSFKS3 "Fehlersummenzeit: Klopfsensor 3" VALUE 0x814D08 ME7_FW1 0 dez 0.000000 255.000000 /end CHARACTERISTIC
/begin CHARACTERISTIC TSFKS4 "Fehlersummenzeit: Klopfsensor 4" VALUE 0x814D09 ME7_FW1 0 dez 0.000000 255.000000 /end CHARACTERISTIC
/begin CHARACTERISTIC TSFKUPPL "Fehlersummenzeit: Pedalwertgeber Kupplung" VALUE 0x814D0A ME7_FW1 0 dez 0.000000 255.000000 /end CHARACTERISTIC
/begin CHARACTERISTIC TSFLASH "Fehlersummenzeit: Lambda-Sondenalterung hinter Kat." VALUE 0x814D0B ME7_FW1 0 dez 0.000000 255.000000 /end CHARACTERISTIC
/begin CHARACTERISTIC TSFLASH2 "Fehlersummenzeit: Lambda-Sondenalterung hinter Kat. (Bank 2)" VALUE 0x814D0C ME7_FW1 0 dez 0.000000 255.000000 /end CHARACTERISTIC
/begin CHARACTERISTIC TSFLATP "Fehlersummenzeit: Lambda-Sondenalterung TP" VALUE 0x814D0D ME7_FW1 0 dez 0.000000 255.000000 /end CHARACTERISTIC
/begin CHARACTERISTIC TSFLATP2 "Fehlersummenzeit: Lambda-Sondenalterung TP (Bank 2)" VALUE 0x814D0E ME7_FW1 0 dez 0.000000 255.000000 /end CHARACTERISTIC
/begin CHARACTERISTIC TSFLATV "Fehlersummenzeit: Lambda-Sondenalterung TV" VALUE 0x814D0F ME7_FW1 0 dez 0.000000 255.000000 /end CHARACTERISTIC
/begin CHARACTERISTIC TSFLATV2 "Fehlersummenzeit: Lambda-Sondenalterung TV (Bank 2)" VALUE 0x814D10 ME7_FW1 0 dez 0.000000 255.000000 /end CHARACTERISTIC
/begin CHARACTERISTIC TSFLDE "Fehlersummenzeit: Ladedrucksteuerventil (Endstufe)" VALUE 0x814D11 ME7_FW1 0 dez 0.000000 255.000000 /end CHARACTERISTIC
/begin CHARACTERISTIC TSFLDO "Fehlersummenzeit: Ladedruckkennlinie; oberer Wert Åberschritten" VALUE 0x814D12 ME7_FW1 0 dez 0.000000 255.000000 /end CHARACTERISTIC
/begin CHARACTERISTIC TSFLDP "Fehlersummenzeit: Leckdiagnosepumpe" VALUE 0x814D13 ME7_FW1 0 dez 0.000000 255.000000 /end CHARACTERISTIC
/begin CHARACTERISTIC TSFLDPE "Fehlersummenzeit: Leckdiagnosepumpe Endstufe" VALUE 0x814D14 ME7_FW1 0 dez 0.000000 255.000000 /end CHARACTERISTIC
/begin CHARACTERISTIC TSFLDRA "Fehlersummenzeit: Ladedruckregelabweichung" VALUE 0x814D15 ME7_FW1 0 dez 0.000000 255.000000 /end CHARACTERISTIC
/begin CHARACTERISTIC TSFLLR "Fehlersummenzeit: Leerlaufregelung am Anschlag" VALUE 0x814D16 ME7_FW1 0 dez 0.000000 255.000000 /end CHARACTERISTIC
/begin CHARACTERISTIC TSFLM "Fehlersummenzeit: LMM/HLM/HFM" VALUE 0x814D17 ME7_FW1 0 dez 0.000000 255.000000 /end CHARACTERISTIC
/begin CHARACTERISTIC TSFLSH "Fehlersummenzeit: Lambda-Sonde hinter Kat" VALUE 0x814D18 ME7_FW1 0 dez 0.000000 255.000000 /end CHARACTERISTIC
/begin CHARACTERISTIC TSFLSV "Fehlersummenzeit: Lambda-Sonde vor Kat" VALUE 0x814D19 ME7_FW1 0 dez 0.000000 255.000000 /end CHARACTERISTIC
/begin CHARACTERISTIC TSFMD "Fehlersummenzeit: Aussetzer, Summenfehler (multiple)" VALUE 0x814D1A ME7_FW1 0 dez 0.000000 255.000000 /end CHARACTERISTIC
/begin CHARACTERISTIC TSFMD01 "Fehlersummenzeit: Aussetzer Zyl. 1" VALUE 0x814D1B ME7_FW1 0 dez 0.000000 255.000000 /end CHARACTERISTIC
/begin CHARACTERISTIC TSFMD02 "Fehlersummenzeit: Aussetzer Zylinder 2" VALUE 0x814D1C ME7_FW1 0 dez 0.000000 255.000000 /end CHARACTERISTIC
/begin CHARACTERISTIC TSFMD03 "Fehlersummenzeit: Aussetzer Zylinder 3" VALUE 0x814D1D ME7_FW1 0 dez 0.000000 255.000000 /end CHARACTERISTIC
/begin CHARACTERISTIC TSFMD04 "Fehlersummenzeit: Aussetzer Zylinder 4" VALUE 0x814D1E ME7_FW1 0 dez 0.000000 255.000000 /end CHARACTERISTIC
/begin CHARACTERISTIC TSFMDB "Fehlersummenzeit: Momentbegrenzung Sollmoment" VALUE 0x814D1F ME7_FW1 0 dez 0.000000 255.000000 /end CHARACTERISTIC
/begin CHARACTERISTIC TSFMDK "Fehlersummenzeit: Aussetzer, Summenfehler - multiple, kundendienstrelevant" VALUE 0x814D20 ME7_FW1 0 dez 0.000000 255.000000 /end CHARACTERISTIC
/begin CHARACTERISTIC TSFMDK01 "Fehlersummenzeit: Aussetzer, Zylinder 1, kundendienstrelevant" VALUE 0x814D21 ME7_FW1 0 dez 0.000000 255.000000 /end CHARACTERISTIC
/begin CHARACTERISTIC TSFMDK02 "Fehlersummenzeit: Aussetzer, Zylinder 2, kundendienstrelevant" VALUE 0x814D22 ME7_FW1 0 dez 0.000000 255.000000 /end CHARACTERISTIC
/begin CHARACTERISTIC TSFMDK03 "Fehlersummenzeit: Aussetzer, Zylinder 3, kundendienstrelevant" VALUE 0x814D23 ME7_FW1 0 dez 0.000000 255.000000 /end CHARACTERISTIC
/begin CHARACTERISTIC TSFMDK04 "Fehlersummenzeit: Aussetzer, Zylinder 4, kundendienstrelevant" VALUE 0x814D24 ME7_FW1 0 dez 0.000000 255.000000 /end CHARACTERISTIC
/begin CHARACTERISTIC TSFMILE "Fehlersummenzeit: MIL-Endstufe" VALUE 0x814D25 ME7_FW1 0 dez 0.000000 255.000000 /end CHARACTERISTIC
/begin CHARACTERISTIC TSFN "Fehlersummenzeit: Drehzahlgeber" VALUE 0x814D26 ME7_FW1 0 dez 0.000000 255.000000 /end CHARACTERISTIC
/begin CHARACTERISTIC TSFNWKW "Fehlersummenzeit: Zuordnung Nockenwelle zu Kurbelwelle" VALUE 0x814D27 ME7_FW1 0 dez 0.000000 255.000000 /end CHARACTERISTIC
/begin CHARACTERISTIC TSFNWKW2 "Fehlersummenzeit: Zuordnung Nockenwelle 2 zu Kurbelwelle" VALUE 0x814D28 ME7_FW1 0 dez 0.000000 255.000000 /end CHARACTERISTIC
/begin CHARACTERISTIC TSFNWS "Fehlersummenzeit: Nockenwellensteuerung" VALUE 0x814D29 ME7_FW1 0 dez 0.000000 255.000000 /end CHARACTERISTIC
/begin CHARACTERISTIC TSFNWS2 "Fehlersummenzeit: Nockenwellensteuerung Bank2" VALUE 0x814D2A ME7_FW1 0 dez 0.000000 255.000000 /end CHARACTERISTIC
/begin CHARACTERISTIC TSFNWSE "Fehlersummenzeit: Nockenwellensteuerungsventil Endstufe" VALUE 0x814D2B ME7_FW1 0 dez 0.000000 255.000000 /end CHARACTERISTIC
/begin CHARACTERISTIC TSFNX "Fehlersummenzeit: NMAX - öberschreitung" VALUE 0x814D2C ME7_FW1 0 dez 0.000000 255.000000 /end CHARACTERISTIC
/begin CHARACTERISTIC TSFPH "Fehlersummenzeit: Phasensensor" VALUE 0x814D2D ME7_FW1 0 dez 0.000000 255.000000 /end CHARACTERISTIC
/begin CHARACTERISTIC TSFPWM "" VALUE 0x814D2E ME7_FW1 0 dez 0.000000 255.000000 /end CHARACTERISTIC
/begin CHARACTERISTIC TSFRKAT "Fehlersummenzeit: LR-Adaption additiver Bereich pro Zeit" VALUE 0x814D2F ME7_FW1 0 dez 0.000000 255.000000 /end CHARACTERISTIC
/begin CHARACTERISTIC TSFRKAZ "Fehlersummenzeit: LR-Adaption additiver Bereich pro ZÅndung" VALUE 0x814D30 ME7_FW1 0 dez 0.000000 255.000000 /end CHARACTERISTIC
/begin CHARACTERISTIC TSFSGEEW "Fehlersummenzeit: SteuergerÑt defekt (EEPROM WFS-Bereich)" VALUE 0x814D31 ME7_FW1 0 dez 0.000000 255.000000 /end CHARACTERISTIC
/begin CHARACTERISTIC TSFSLPE "Fehlersummenzeit: SekundÑrluftpumpe (Endstufe)" VALUE 0x814D32 ME7_FW1 0 dez 0.000000 255.000000 /end CHARACTERISTIC
/begin CHARACTERISTIC TSFSLS "Fehlersummenzeit: SekundÑrluft-System" VALUE 0x814D33 ME7_FW1 0 dez 0.000000 255.000000 /end CHARACTERISTIC
/begin CHARACTERISTIC TSFSLV "Fehlersummenzeit: SekundÑrluftventil" VALUE 0x814D34 ME7_FW1 0 dez 0.000000 255.000000 /end CHARACTERISTIC
/begin CHARACTERISTIC TSFSLVE "Fehlersummenzeit: SekundÑrluftventil (Endstufe)" VALUE 0x814D35 ME7_FW1 0 dez 0.000000 255.000000 /end CHARACTERISTIC
/begin CHARACTERISTIC TSFSLWG "FEhlersummenzeit: Waste- Gate- Ansteuerung" VALUE 0x814D36 ME7_FW1 0 dez 0.000000 255.000000 /end CHARACTERISTIC
/begin CHARACTERISTIC TSFSUE "Fehlersummenzeit: Endstufe Saugrohrumschaltung" VALUE 0x814D37 ME7_FW1 0 dez 0.000000 255.000000 /end CHARACTERISTIC
/begin CHARACTERISTIC TSFSWE "Fehlersummenzeit: Beschleunigungssensor der Schlechtwegeerkennung" VALUE 0x814D38 ME7_FW1 0 dez 0.000000 255.000000 /end CHARACTERISTIC
/begin CHARACTERISTIC TSFTA "Fehlersummenzeit: Ansauglufttemperatur TANS" VALUE 0x814D39 ME7_FW1 0 dez 0.000000 255.000000 /end CHARACTERISTIC
/begin CHARACTERISTIC TSFTANKL "Fehlersummenzeit: OBDII Fehler auf Grund eines leeren Tanks" VALUE 0x814D3A ME7_FW1 0 dez 0.000000 255.000000 /end CHARACTERISTIC
/begin CHARACTERISTIC TSFTES "Fehlersummenzeit: TankentlÅftungssystem" VALUE 0x814D3B ME7_FW1 0 dez 0.000000 255.000000 /end CHARACTERISTIC
/begin CHARACTERISTIC TSFTESF "Fehlersummenzeit: TankentlÅftungssytem Feinleck" VALUE 0x814D3C ME7_FW1 0 dez 0.000000 255.000000 /end CHARACTERISTIC
/begin CHARACTERISTIC TSFTESG "Fehlersummenzeit: TankentlÅftungssystem Grobleck" VALUE 0x814D3D ME7_FW1 0 dez 0.000000 255.000000 /end CHARACTERISTIC
/begin CHARACTERISTIC TSFTEVE "Fehlersummenzeit: TankentlÅftungsventil Endstufe" VALUE 0x814D3E ME7_FW1 0 dez 0.000000 255.000000 /end CHARACTERISTIC
/begin CHARACTERISTIC TSFTEVE2 "Fehlersummenzeit: TankentlÅftungsventil Endstufe  Bank2" VALUE 0x814D3F ME7_FW1 0 dez 0.000000 255.000000 /end CHARACTERISTIC
/begin CHARACTERISTIC TSFTM "Fehlersummenzeit: Motortemperatur TMOT" VALUE 0x814D40 ME7_FW1 0 dez 0.000000 255.000000 /end CHARACTERISTIC
/begin CHARACTERISTIC TSFTOL "Fehlersummenzeit: ôltemperatur" VALUE 0x814D41 ME7_FW1 0 dez 0.000000 255.000000 /end CHARACTERISTIC
/begin CHARACTERISTIC TSFTUM "Fehlersummenzeit: Umgebungstemperatur TUM" VALUE 0x814D42 ME7_FW1 0 dez 0.000000 255.000000 /end CHARACTERISTIC
/begin CHARACTERISTIC TSFTUN "Fehlersummenzeit: Tuningschutz" VALUE 0x814D43 ME7_FW1 0 dez 0.000000 255.000000 /end CHARACTERISTIC
/begin CHARACTERISTIC TSFUB "Fehlersummenzeit: Batteriespannung UB (Bordnetz)" VALUE 0x814D44 ME7_FW1 0 dez 0.000000 255.000000 /end CHARACTERISTIC
/begin CHARACTERISTIC TSFUFMV "Fehlersummenzeit: FunktionsÅberwachung: Momentenvergleich" VALUE 0x814D45 ME7_FW1 0 dez 0.000000 255.000000 /end CHARACTERISTIC
/begin CHARACTERISTIC TSFUFSKA "Fehlersummenzeit: FunktionsÅberwachung: Sicherheits-Kraftstoff-Abschaltung" VALUE 0x814D46 ME7_FW1 0 dez 0.000000 255.000000 /end CHARACTERISTIC
/begin CHARACTERISTIC TSFURRAM "Fehlersummenzeit: RechnerÅberwachung: RAM" VALUE 0x814D47 ME7_FW1 0 dez 0.000000 255.000000 /end CHARACTERISTIC
/begin CHARACTERISTIC TSFURROM "Fehlersummenzeit: RechnerÅberwachung: ROM" VALUE 0x814D48 ME7_FW1 0 dez 0.000000 255.000000 /end CHARACTERISTIC
/begin CHARACTERISTIC TSFURRST "Fehlersummenzeit: RechnerÅberwachung: Reset" VALUE 0x814D49 ME7_FW1 0 dez 0.000000 255.000000 /end CHARACTERISTIC
/begin CHARACTERISTIC TSFUVSE "Fehlersummenzeit: Endstufe Umluftventil Turbo" VALUE 0x814D4A ME7_FW1 0 dez 0.000000 255.000000 /end CHARACTERISTIC
/begin CHARACTERISTIC TSFVFZ "Fehlersummenzeit: Fahrzeug-Geschwindigkeit" VALUE 0x814D4B ME7_FW1 0 dez 0.000000 255.000000 /end CHARACTERISTIC
/begin CHARACTERISTIC TSFWFS "Fehlersummenzeit: Wegfahrsperre" VALUE 0x814D4C ME7_FW1 0 dez 0.000000 255.000000 /end CHARACTERISTIC
/begin CHARACTERISTIC TSFWFSRC "" VALUE 0x814D4D ME7_FW1 0 dez 0.000000 255.000000 /end CHARACTERISTIC
/begin CHARACTERISTIC TSFZET1 "" VALUE 0x814D4E ME7_FW1 0 dez 0.000000 255.000000 /end CHARACTERISTIC
/begin CHARACTERISTIC TSFZET2 "" VALUE 0x814D4F ME7_FW1 0 dez 0.000000 255.000000 /end CHARACTERISTIC
/begin CHARACTERISTIC TSFZET3 "" VALUE 0x814D50 ME7_FW1 0 dez 0.000000 255.000000 /end CHARACTERISTIC
/begin CHARACTERISTIC TSFZET4 "" VALUE 0x814D51 ME7_FW1 0 dez 0.000000 255.000000 /end CHARACTERISTIC
/begin CHARACTERISTIC TSFZET5 "" VALUE 0x814D52 ME7_FW1 0 dez 0.000000 255.000000 /end CHARACTERISTIC
/begin CHARACTERISTIC TSFZET6 "" VALUE 0x814D53 ME7_FW1 0 dez 0.000000 255.000000 /end CHARACTERISTIC
/begin CHARACTERISTIC TSFZET7 "" VALUE 0x814D54 ME7_FW1 0 dez 0.000000 255.000000 /end CHARACTERISTIC
/begin CHARACTERISTIC TSFZET8 "" VALUE 0x814D55 ME7_FW1 0 dez 0.000000 255.000000 /end CHARACTERISTIC
/begin CHARACTERISTIC TSFZZZ "Dummy: Tabellenende" VALUE 0x814D56 ME7_FW1 0 dez 0.000000 255.000000 /end CHARACTERISTIC
/begin CHARACTERISTIC TSKRLDAB "Zeitkonstante fÅr schnelle LDR-Absenkung" CURVE 0x81CB94 ME7_GKL3 0 zk50msxs_uw_b3276p8 0.050001 64.251000
 /begin AXIS_DESCR COM_AXIS nmot_w nmot_uw_q0p25 0 0.000000 16383.800000 AXIS_PTS_REF SNM08LDUW /end AXIS_DESCR
 EXTENDED_LIMITS 0.050001 3276.800000 /end CHARACTERISTIC
/begin CHARACTERISTIC TSKRLDAU "Zeitkonstante fÅr schnelle LDR-Aufregelung" CURVE 0x81CBA4 ME7_GKL3 0 zk50msxs_uw_b3276p8 0.050001 64.251000
 /begin AXIS_DESCR COM_AXIS nmot_w nmot_uw_q0p25 0 0.000000 16383.800000 AXIS_PTS_REF SNM08LDUW /end AXIS_DESCR
 EXTENDED_LIMITS 0.050001 3276.800000 /end CHARACTERISTIC
/begin CHARACTERISTIC TSLABB "Verweilzeit fÅr SekundÑrluft- Abbruchbedingung" VALUE 0x818360 ME7_FW1 0 t100msxs_ub_b25p5 0.100000 25.500000 EXTENDED_LIMITS 0.000000 25.500000 /end CHARACTERISTIC
/begin CHARACTERISTIC TSLPMN "Mindesteinschaltdauer der SekundÑrluftpumpe" VALUE 0x818361 ME7_FW1 0 t100msxs_ub_b25p5 0.100000 25.500000 EXTENDED_LIMITS 0.000000 25.500000 /end CHARACTERISTIC
/begin CHARACTERISTIC TSLUBST "Entprellzeit fÅr SekundÑrluft ein im Start bei UBSLSTMN" VALUE 0x818362 ME7_FW1 0 t100msxs_ub_b25p5 0.000000 25.500000 /end CHARACTERISTIC
/begin CHARACTERISTIC TSMX "Ladezeitbegrenzung" VALUE 0x816465 ME7_FW1 0 txms_ub_q0p1 0.000000 25.500000 /end CHARACTERISTIC
/begin CHARACTERISTIC TSPERN "Sperrzeit P-Sprung nach Sondensprung" CURVE 0x815EC1 ME7_KL97 0 t10msxs_ub_b2p55 0.000000 2.550000
 /begin AXIS_DESCR STD_AXIS nmot nmot_ub_q40 7 0.000000 10200.000000 DEPOSIT ABSOLUTE /end AXIS_DESCR
/end CHARACTERISTIC
/begin CHARACTERISTIC TSPERN2 "Sperrzeit P-Sprung nach Sondensprung, Bank 2" CURVE 0x815ED0 ME7_KL97 0 t10msxs_ub_b2p55 0.000000 2.550000
 /begin AXIS_DESCR STD_AXIS nmot nmot_ub_q40 7 0.000000 10200.000000 DEPOSIT ABSOLUTE /end AXIS_DESCR
/end CHARACTERISTIC
/begin CHARACTERISTIC TSRFPAB "Mindestschaltzeit Reed-Kontakt fÅr Abbruch Fast Pulse" VALUE 0x8135F4 ME7_FW3 0 t10msxs_uw_b655p35 0.000000 655.350000 /end CHARACTERISTIC
/begin CHARACTERISTIC TSTEAA "Sperrzeit nach B_te (TEA aktiv)" VALUE 0x818579 ME7_FW1 0 t100msxs_ub_b25p5 0.000000 25.500000 /end CHARACTERISTIC
/begin CHARACTERISTIC TSTZUMN "Zeit nach Start fÅr zwangsgeschlossenes TEV" VALUE 0x8135F6 ME7_FW3 0 t1sxs_uw_b65535 0.000000 65535.000000 /end CHARACTERISTIC
/begin CHARACTERISTIC TSVKKTO "obere Periodendauergrenze fÅr SVK, Kurztest" VALUE 0x810BF8 ME7_FW3 0 t10msxs_uw_b655p35 0.000000 655.350000 /end CHARACTERISTIC
/begin CHARACTERISTIC TSVKKTU "untere Periodendauergrenze fÅr SVK, Kurztest" VALUE 0x810BFA ME7_FW3 0 t10msxs_uw_b655p35 0.000000 655.350000 /end CHARACTERISTIC
/begin CHARACTERISTIC TSVKO "obere Periodendauergrenze fÅr die Lambda-Sonde vor Katalysator" VALUE 0x810BFC ME7_FW3 0 t10msxs_uw_b655p35 0.000000 655.350000 /end CHARACTERISTIC
/begin CHARACTERISTIC TSVKU "untere Periodengrenze fÅr Lambda-Sonde vor Katalysator" VALUE 0x810BFE ME7_FW3 0 t10msxs_uw_b655p35 0.000000 655.350000 /end CHARACTERISTIC
/begin CHARACTERISTIC TSWKNBGA_0_A "Zeit bis Setzwertkorrektur nach Ende Beschleunigen" CURVE 0x810E78 ME7_GKL3 0 t20msxs_uw_q0p02 0.000000 1310.700000
 /begin AXIS_DESCR COM_AXIS uevges fak_q0p1 0 0.000000 25.500000 AXIS_PTS_REF SUE08MFUB /end AXIS_DESCR
/end CHARACTERISTIC
/begin CHARACTERISTIC TSWKNBGA_1_A "Zeit bis Setzwertkorrektur nach Ende Beschleunigen" CURVE 0x810E88 ME7_GKL3 0 t20msxs_uw_q0p02 0.000000 1310.700000
 /begin AXIS_DESCR COM_AXIS uevges fak_q0p1 0 0.000000 25.500000 AXIS_PTS_REF SUE08MFUB /end AXIS_DESCR
/end CHARACTERISTIC
/begin CHARACTERISTIC TSWKNVGA_0_A "Zeit bis Setzwertkorrektur nach Ende Verzîgern" CURVE 0x810E98 ME7_GKL3 0 t20msxs_uw_q0p02 0.000000 1310.700000
 /begin AXIS_DESCR COM_AXIS uevges fak_q0p1 0 0.000000 25.500000 AXIS_PTS_REF SUE08MFUB /end AXIS_DESCR
/end CHARACTERISTIC
/begin CHARACTERISTIC TSWKNVGA_1_A "Zeit bis Setzwertkorrektur nach Ende Verzîgern" CURVE 0x810EA8 ME7_GKL3 0 t20msxs_uw_q0p02 0.000000 1310.700000
 /begin AXIS_DESCR COM_AXIS uevges fak_q0p1 0 0.000000 25.500000 AXIS_PTS_REF SUE08MFUB /end AXIS_DESCR
/end CHARACTERISTIC
/begin CHARACTERISTIC TSWKR "Totzeit fÅr Summen-ZW-SpÑtverstellabfrage" VALUE 0x8161ED ME7_FW1 0 t100msxs_ub_b25p5 0.000000 25.500000 /end CHARACTERISTIC
/begin CHARACTERISTIC TTBMH "Zeit fÅr theoretische Sondenbetriebsbereitschaft mit Heizung" VALUE 0x81AD3C ME7_FW3 0 t100msxs_uw_q100 0.000000 6553.500000 /end CHARACTERISTIC
/begin CHARACTERISTIC TTE "Zeit fÅr TankentlÅftungsphase" VALUE 0x81B8EC ME7_FW3 0 t100msxs_uw_b6553p6 0.000000 6553.500000 /end CHARACTERISTIC
/begin CHARACTERISTIC TTEAE "Zeit fÅr TankentlÅftungsphase bei eingeschwungener Gemischadaption" VALUE 0x81B8EE ME7_FW3 0 t100msxs_uw_b6553p6 0.000000 6553.500000 /end CHARACTERISTIC
/begin CHARACTERISTIC TTEAUS "Zeit nach Start bis TEB aktiv wird" VALUE 0x8134EA ME7_FW3 0 t100msxs_uw_q100 5.000000 100.000000 EXTENDED_LIMITS 0.000000 6553.500000 /end CHARACTERISTIC
/begin CHARACTERISTIC TTEBSTP "Maximal Zeit fÅr TE-Stop im Leerlauf bei nicht gesetzten Zyklusflags" VALUE 0x81B8F0 ME7_FW3 0 t100msxs_uw_b6553p6 0.000000 6553.500000 /end CHARACTERISTIC
/begin CHARACTERISTIC TTEGA "Zeit bei der TankentlÅftung fÅr Grundadaption" VALUE 0x81B8F2 ME7_FW3 0 t100msxs_uw_b6553p6 0.000000 6553.500000 /end CHARACTERISTIC
/begin CHARACTERISTIC TTEGAI "Zeitdauer der ersten  Gemischadaptionsphase" VALUE 0x81B8F4 ME7_FW3 0 t100msxs_uw_b6553p6 0.000000 6553.500000 /end CHARACTERISTIC
/begin CHARACTERISTIC TTEGAZO "Zeit fÅr TankentlÅftungsstop wg. Gemischadaption, obere Schwelle" VALUE 0x81B8F6 ME7_FW3 0 t100msxs_uw_b6553p6 0.000000 6553.500000 /end CHARACTERISTIC
/begin CHARACTERISTIC TTEGAZU "Zeit fÅr TankentlÅftungsstop wg. Gemischadaption, untere Schwelle" VALUE 0x81B8F8 ME7_FW3 0 t100msxs_uw_b6553p6 0.000000 6553.500000 /end CHARACTERISTIC
/begin CHARACTERISTIC TTEINI "Zeit fÅr TankentlÅftung in erster TE-Phase nach Initialisierung (B_ini)" VALUE 0x81B8FA ME7_FW3 0 t100msxs_uw_b6553p6 0.000000 6553.500000 /end CHARACTERISTIC
/begin CHARACTERISTIC TTEMN "Zeit fÅr TankentlÅftungsphase minimal" VALUE 0x81B8FC ME7_FW3 0 t100msxs_uw_b6553p6 0.000000 6553.500000 /end CHARACTERISTIC
/begin CHARACTERISTIC TTEPRIO "Zeit ab Start fÅr Umschalten auf DauertankentlÅftung" VALUE 0x81B8FE ME7_FW3 0 t100msxs_uw_b6553p6 0.000000 6553.500000 /end CHARACTERISTIC
/begin CHARACTERISTIC TTEVAZ "Verweilzeit fÅr TEV Aufsteuern bei nicht eingeschwungen frm" VALUE 0x819C37 ME7_FW1 0 t100msxs_ub_b25p5 0.000000 10.000000 EXTENDED_LIMITS 0.000000 25.500000 /end CHARACTERISTIC
/begin CHARACTERISTIC TTEZAO "Zeit fÅr TankentlÅftung Daueraktivierung, obere Schwelle" VALUE 0x81B900 ME7_FW3 0 t100msxs_uw_b6553p6 0.000000 6553.500000 /end CHARACTERISTIC
/begin CHARACTERISTIC TTEZAU "Zeit fÅr TankentlÅftung Daueraktivierung, untere Schwelle" VALUE 0x81B902 ME7_FW3 0 t100msxs_uw_b6553p6 0.000000 6553.500000 /end CHARACTERISTIC
/begin CHARACTERISTIC TTLASH "Zeit fÅr Verweildauer der Sonde hinter KAT unter/oberhalb des Sollwertes" VALUE 0x81AD5C ME7_FW3 0 t100msxs_uw_b6553p5 0.000000 6553.500000 /end CHARACTERISTIC
/begin CHARACTERISTIC TTMUMASTA "Zeitdauer fÅr StationÑrzustand bei temp. UMA-Adaption" VALUE 0x814EC6 ME7_FW1 0 t1sxs_ub_b255 0.000000 255.000000 /end CHARACTERISTIC
/begin CHARACTERISTIC TTOTLDP "Totzeit LDP- Sofortansteuerung wÑhrend Fast Pulse" VALUE 0x8135F8 ME7_FW3 0 t10msxs_uw_b655p35 0.000000 655.350000 /end CHARACTERISTIC
/begin CHARACTERISTIC TUBKL15 "Filterzeit fÅr redundante KL15-Erfassung" VALUE 0x819A26 ME7_FW1 0 t10msxs_ub_b2p55 0.000000 2.550000 /end CHARACTERISTIC
/begin CHARACTERISTIC TULV1 "Verzîgerung öberladeabschneiden, ti-Ausblengung Stufe 1" VALUE 0x81974E ME7_FW1 0 t50msxs_ub_b12p75 0.000000 12.500000 EXTENDED_LIMITS 0.000000 12.750000 /end CHARACTERISTIC
/begin CHARACTERISTIC TULV3 "Verzîgerungszeit fÅr Heilung öberladefehler" VALUE 0x81974F ME7_FW1 0 t50msxs_ub_b12p75 0.000000 12.500000 EXTENDED_LIMITS 0.000000 12.750000 /end CHARACTERISTIC
/begin CHARACTERISTIC TUMDETM "Umgebungslufttemperatur-Ersatzwert fÅr Motortemperatur-Modell" VALUE 0x818FFD ME7_FW1 0 temp_ub_q0p75_o48 -48.000000 143.250000 /end CHARACTERISTIC
/begin CHARACTERISTIC TUMTAI "Initialisierungswert Umgebungstemperatur" VALUE 0x818E13 ME7_FW1 0 temp_ub_q0p75_o48 -48.000000 143.250000 /end CHARACTERISTIC
/begin CHARACTERISTIC TUMTAIT "Initialisierungswert Umgebungstemperatur aus TANS" VALUE 0x8184A8 ME7_FW1 0 temp_ub_q0p75_o48 -48.000000 143.250000 /end CHARACTERISTIC
/begin CHARACTERISTIC TUPWBWF "Fehlerzeit bei Bewegungserkennung" VALUE 0x814DBB ME7_FW1 0 t10msxs_ub_b2p55 0.000000 2.550000 /end CHARACTERISTIC
/begin CHARACTERISTIC TUPWBWV "Zeitverzîgerung zum Einspeichern eines neuen Poti 2 Wertes" VALUE 0x814DBC ME7_FW1 0 t10msxs_ub_b2p55 0.000000 2.550000 /end CHARACTERISTIC
/begin CHARACTERISTIC TUPWG12 "Fehlerzeit bei Vergleich von PWG-Poti 1 und 2" VALUE 0x814DBD ME7_FW1 0 t10msxs_ub_b2p55 0.000000 2.550000 /end CHARACTERISTIC
/begin CHARACTERISTIC TUPWG1O "Fehlerzeit bei Bereichsverletzung von PWG-Poti 1 nach oben" VALUE 0x814DBE ME7_FW1 0 t10msxs_ub_b2p55 0.000000 2.550000 /end CHARACTERISTIC
/begin CHARACTERISTIC TUPWG1U "Fehlerzeit bei Bereichsverletzung von PWG-Poti 1 nach unten" VALUE 0x814DBF ME7_FW1 0 t10msxs_ub_b2p55 0.000000 2.550000 /end CHARACTERISTIC
/begin CHARACTERISTIC TUPWG2O "Fehlerzeit bei Bereichsverletzung von PWG-Poti 2 nach oben" VALUE 0x814DC0 ME7_FW1 0 t10msxs_ub_b2p55 0.000000 2.550000 /end CHARACTERISTIC
/begin CHARACTERISTIC TUPWG2U "Fehlerzeit bei Bereichsverletzung von PWG-Poti 2 nach unten" VALUE 0x814DC1 ME7_FW1 0 t10msxs_ub_b2p55 0.000000 2.550000 /end CHARACTERISTIC
/begin CHARACTERISTIC TUSBELH "Zeit fÅr Festhaltung der Sondenspannung nach Impulsbelastung  hinter KAT" VALUE 0x814D7A ME7_FW1 0 t10msxs_ub_b2p55 0.000000 2.550000 /end CHARACTERISTIC
/begin CHARACTERISTIC TUSBELV "Zeit fÅr Festhaltung der Sondenspannung nach Impulsbelastung  vor KAT" VALUE 0x814D7C ME7_FW1 0 t10msxs_ub_b2p55 0.000000 2.550000 /end CHARACTERISTIC
/begin CHARACTERISTIC TUSCHUB "Verzîgerungszeit fÅr Stîrspitzen bei SchubprÅfung der Sonde hinter KAT" VALUE 0x8184C1 ME7_FW1 0 t100msxs_ub_b25p5 0.000000 25.500000 /end CHARACTERISTIC
/begin CHARACTERISTIC TUSDU "Verzîg.zeit fÅr Erkennung Adernschlu· und Sonde mit begr. Spannungshub v.K." VALUE 0x81AD72 ME7_FW3 0 t100msxs_uw_q100 0.000000 6553.500000 /end CHARACTERISTIC
/begin CHARACTERISTIC TUSDUC "Verzîgerungszeit Code fÅr Erkennung Adernschlu· Sonde vor KAT" VALUE 0x81AD74 ME7_FW3 0 t100msxs_uw_q100 0.000000 6553.500000 /end CHARACTERISTIC
/begin CHARACTERISTIC TUSDUFA "Verzîgerunszeit fÅr Erk. Adernschl. Lamdasonde h.KAT (Funkt. Anford. Kurz-Trip)" VALUE 0x81AD3E ME7_FW3 0 t100msxs_uw_q100 0.000000 6553.500000 /end CHARACTERISTIC
/begin CHARACTERISTIC TUSDUH "Verzîgerungszeit fÅr Erkennung Adernschlu· Lambdasonde hinter KAT" VALUE 0x81AD40 ME7_FW3 0 t100msxs_uw_q100 0.000000 6553.500000 /end CHARACTERISTIC
/begin CHARACTERISTIC TUSEINH "Verzîgerungzeit fÅr Einschalten der Sondenbetriebsbereitschaft hinter KAT" VALUE 0x8184AD ME7_FW1 0 t1sxs_ub_b255 0.000000 255.000000 /end CHARACTERISTIC
/begin CHARACTERISTIC TUSEINV "Verzîgerungzeit fÅr Einschalten der Sondenbetriebsbereitschaft vor KAT" VALUE 0x8184F9 ME7_FW1 0 t1sxs_ub_b255 0.000000 255.000000 /end CHARACTERISTIC
/begin CHARACTERISTIC TUSENLASH "Zeitdauer bis Sonden Mager/Fett Erkennung erlaubt" VALUE 0x81AD5E ME7_FW3 0 t100msxs_uw_b6553p5 0.000000 6553.500000 /end CHARACTERISTIC
/begin CHARACTERISTIC TUSFETT "Verzîg.zeit fÅr Erkennung niederohmiger Nebenschlu· nach Ubatt vor KAT" VALUE 0x81AD76 ME7_FW3 0 t100msxs_uw_q100 0.000000 6553.500000 /end CHARACTERISTIC
/begin CHARACTERISTIC TUSHSMIN "Mindestdauer fÅr Steigungsmessung fÅr enable Filter" VALUE 0x8184C2 ME7_FW1 0 t100msxs_ub_b25p5 0.000000 25.500000 /end CHARACTERISTIC
/begin CHARACTERISTIC TUSKS "Verzîgerungszeit bei Kurzschlu·erkennung der Lambdasonde" VALUE 0x814D76 ME7_FW1 0 t20msxs_ub_b5p1 0.000000 5.100000 /end CHARACTERISTIC
/begin CHARACTERISTIC TUSLASH "Testzeit fÅt Dauer Anfettung/Abmagerung hinter KAT" VALUE 0x81AD60 ME7_FW3 0 t100msxs_uw_b6553p5 0.000000 6553.500000 /end CHARACTERISTIC
/begin CHARACTERISTIC TUSMAX "öberwachungszeit fÅr Usmax" VALUE 0x8184AE ME7_FW1 0 t100msxs_ub_b25p5 0.000000 25.500000 /end CHARACTERISTIC
/begin CHARACTERISTIC TUSPNMN "min. Zeit der Sondenspannung zwischen pos. und neg. Flanke" VALUE 0x8188DE ME7_FW1 0 t40msxs_ub_q0p04 0.000000 10.200000 /end CHARACTERISTIC
/begin CHARACTERISTIC TUSPNMX "max. Zeit der Sondenspannung zwischen pos. und neg. Flanke" VALUE 0x8188DF ME7_FW1 0 t40msxs_ub_q0p04 0.000000 10.200000 /end CHARACTERISTIC
/begin CHARACTERISTIC TUSSA "Verzîgerungszeit nach öber/Unterschreiten der Regelschwelle hinter KAT" VALUE 0x8184C3 ME7_FW1 0 t100msxs_ub_b25p5 0.000000 25.500000 /end CHARACTERISTIC
/begin CHARACTERISTIC TUSTAL "Verzîg.zeit fÅr Erkennung Adernschlu· nach 'Tank leer' fahren fÅr Sonde h. KAT" VALUE 0x81AD42 ME7_FW3 0 t100msxs_uw_q100 0.000000 6553.500000 /end CHARACTERISTIC
/begin CHARACTERISTIC TVCAMSR "Entprellzeit nach Start Startende bei ASR/MSR-Fehler" VALUE 0x81017E ME7_FW3 0 t10msxs_uw_b655p35 0.000000 655.350000 /end CHARACTERISTIC
/begin CHARACTERISTIC TVDK "Verzîgerungszeit nach Schlie·en der Drosselklappe" VALUE 0x8155D6 ME7_FW1 0 t20msxs_ub_b5p1 0.000000 5.100000 /end CHARACTERISTIC
/begin CHARACTERISTIC TVDNWS "Wartezeit ab Startende bis DNWS zugelassen" VALUE 0x81B5C6 ME7_FW3 0 t10msxs_uw_b655p35 0.000000 655.350000 /end CHARACTERISTIC
/begin CHARACTERISTIC TVDSLOFF "Zeitverzîgerung Schlie·en SekundÑrluftventil bei Adaption/Kurztrip" VALUE 0x818363 ME7_FW1 0 t100msxs_ub_b25p5 0.000000 25.500000 /end CHARACTERISTIC
/begin CHARACTERISTIC TVDTEABG "Verzîgerungszeit zwischen Motor und Lambdasonde" VALUE 0x819C38 ME7_FW1 0 t100msxs_ub_b25p5 0.000000 2.000000 EXTENDED_LIMITS 0.000000 25.500000 /end CHARACTERISTIC
/begin CHARACTERISTIC TVDTEB "Verzîgerungszeit ab TEV offen fÅr Aussage TEV i.O./defekt in Diagnose DTEV" VALUE 0x819C39 ME7_FW1 0 t100msxs_ub_b25p5 0.000000 10.000000 EXTENDED_LIMITS 0.000000 25.500000 /end CHARACTERISTIC
/begin CHARACTERISTIC TVDTEE "Zeitdauer ab TEV offen fÅr PrÅfung DTEV" VALUE 0x819C3A ME7_FW1 0 t100msxs_ub_b25p5 3.000000 10.000000 EXTENDED_LIMITS 0.000000 25.500000 /end CHARACTERISTIC
/begin CHARACTERISTIC TVDTELLA "Mindestzzeit fÅr Aktivierungsbedingungen fÅr AufsteuerprÅfung DTEV erfÅllt" VALUE 0x819C3B ME7_FW1 0 t100msxs_ub_b25p5 0.500000 10.000000 EXTENDED_LIMITS 0.000000 25.500000 /end CHARACTERISTIC
/begin CHARACTERISTIC TVDTEVP "Entprellung fÅr Setzen Flip-Flop Passiv-PrÅfung DTEV i.O." VALUE 0x819C3C ME7_FW1 0 t100msxs_ub_b25p5 1.000000 20.000000 EXTENDED_LIMITS 0.000000 25.500000 /end CHARACTERISTIC
/begin CHARACTERISTIC TVDTEVPM "Entprellung fÅr Setzen Flip-Flop 'Diagnose passiv mîglich'" VALUE 0x819C3D ME7_FW1 0 t100msxs_ub_b25p5 1.000000 20.000000 EXTENDED_LIMITS 0.000000 25.500000 /end CHARACTERISTIC
/begin CHARACTERISTIC TVDTEVZ "Verzîgerungszeit fÅr Schlie·en TEV fÅr AufsteuerprÅfung DTEV" VALUE 0x819C3E ME7_FW1 0 t100msxs_ub_b25p5 0.000000 10.000000 EXTENDED_LIMITS 0.000000 25.500000 /end CHARACTERISTIC
/begin CHARACTERISTIC TVERBR "Verzîgerungszeit fÅr Bremsschalter-PlausibilitÑtsprÅfung" VALUE 0x8185A3 ME7_FW1 0 t100msxs_ub_b25p5 0.000000 25.500000 /end CHARACTERISTIC
/begin CHARACTERISTIC TVESWER "Verzîgerungszeit fÅr Erkennung fehlerfreies Schlechtwegsignal" VALUE 0x8183A3 ME7_FW1 0 t100msxs_ub_b25p5 0.000000 25.500000 /end CHARACTERISTIC
/begin CHARACTERISTIC TVESWES "Verzîgerungszeit fÅr Erkennung fehlerhaften Schlechtwegsignal" VALUE 0x8183A4 ME7_FW1 0 t100msxs_ub_b25p5 0.000000 25.500000 /end CHARACTERISTIC
/begin CHARACTERISTIC TVFRG "Verzîgerundszeit nach Satrtende bis zur Freigabe des FÅllungsreglers" VALUE 0x815112 ME7_FW1 0 t50msxs_ub_b12p75 0.000000 12.750000 /end CHARACTERISTIC
/begin CHARACTERISTIC TVFSAM "TemperaturabhÑngige Verzîgerungszeit fÅr Fahrstufe AUS" CURVE 0x81984B ME7_GKL1 0 t20msxs_ub_b5p1 0.000000 5.100000
 /begin AXIS_DESCR COM_AXIS tmot temp_ub_q0p75_o48 0 -48.000000 143.250000 AXIS_PTS_REF STM08MDUB /end AXIS_DESCR
/end CHARACTERISTIC
/begin CHARACTERISTIC TVFSAWE "Verzîgerungszeit fÅr RÅcksetzen von B_fil" VALUE 0x815705 ME7_FW1 0 t10msxs_ub_b2p55 0.010000 2.550000 EXTENDED_LIMITS 0.000000 2.550000 /end CHARACTERISTIC
/begin CHARACTERISTIC TVFSEM "TemperaturabhÑngige Verzîgerungszeit fÅr Fahrstufe EIN" CURVE 0x819853 ME7_GKL1 0 t20msxs_ub_b5p1 0.000000 5.100000
 /begin AXIS_DESCR COM_AXIS tmot temp_ub_q0p75_o48 0 -48.000000 143.250000 AXIS_PTS_REF STM08MDUB /end AXIS_DESCR
/end CHARACTERISTIC
/begin CHARACTERISTIC TVFSRAM "motortemperaturabhÑngige Verzîgerungszeit fÅr Fahrstufe aus (R)" CURVE 0x81985B ME7_GKL1 0 t20msxs_ub_b5p1 0.000000 5.100000
 /begin AXIS_DESCR COM_AXIS tmot temp_ub_q0p75_o48 0 -48.000000 143.250000 AXIS_PTS_REF STM08MDUB /end AXIS_DESCR
/end CHARACTERISTIC
/begin CHARACTERISTIC TVFSREM "motortemperaturabhÑngige Verzîgerungszeit fÅr Fahrstufe ein (R)" CURVE 0x819863 ME7_GKL1 0 t20msxs_ub_b5p1 0.000000 5.100000
 /begin AXIS_DESCR COM_AXIS tmot temp_ub_q0p75_o48 0 -48.000000 143.250000 AXIS_PTS_REF STM08MDUB /end AXIS_DESCR
/end CHARACTERISTIC
/begin CHARACTERISTIC TVFUE "Verzîgerungszeit fÅr den Aufbau der FÅllung" VALUE 0x8155C7 ME7_FW1 0 t20msxs_ub_b5p1 0.000000 5.100000 /end CHARACTERISTIC
/begin CHARACTERISTIC TVFZDIF "Zeitintervall fÅr vfz-Differenzberechnung" VALUE 0x819C6F ME7_FW1 0 t100msxs_ub_b25p5 0.000000 25.500000 /end CHARACTERISTIC
/begin CHARACTERISTIC TVFZNW "Vezîgerungszeit fÅr Aktivierung der CIFI-Faktoren nach NoWe-Umschaltung" VALUE 0x814FE5 ME7_FW1 0 t10msxs_ub_b2p55 0.000000 2.550000 /end CHARACTERISTIC
/begin CHARACTERISTIC TVHSEE "Entprellzeit fÅr Heizerendstufenfehler" VALUE 0x81858A ME7_FW1 0 t50msxs_ub_b12p75 0.000000 12.750000 /end CHARACTERISTIC
/begin CHARACTERISTIC TVHSH "Einschaltverzîgerung der Sondenheizung hinter Kat" VALUE 0x818524 ME7_FW1 0 t100msxs_ub_b25p5 0.000000 25.500000 /end CHARACTERISTIC
/begin CHARACTERISTIC TVHSV "Einschaltverzîgerung der Sondenheizung vor Kat" VALUE 0x818525 ME7_FW1 0 t100msxs_ub_b25p5 0.000000 25.500000 /end CHARACTERISTIC
/begin CHARACTERISTIC TVHSVMX "Einschaltverzîgerung der maximalen Sondenheizung vor Kat" VALUE 0x818526 ME7_FW1 0 t100msxs_ub_b25p5 0.000000 25.500000 /end CHARACTERISTIC
/begin CHARACTERISTIC TVKOE1 "Verzîgerungszeit fÅr Kompressor EIN ( zur Momentreserve)" VALUE 0x8164BD ME7_FW1 0 t20msxs_ub_b5p1 0.000000 5.100000 /end CHARACTERISTIC
/begin CHARACTERISTIC TVKTDTK "TemperaturabhÑngige Verzîgerungszeit fÅr Katdiagnose" CURVE 0x814D8C ME7_KL97 0 t50msxs_q2 0.000000 510.000000
 /begin AXIS_DESCR STD_AXIS tkdkth temp_ub_q5 4 0.000000 1275.000000 DEPOSIT ABSOLUTE /end AXIS_DESCR
/end CHARACTERISTIC
/begin CHARACTERISTIC TVKUP "Verzîgerungszeit fÅr B_kupplv" VALUE 0x814F60 ME7_FW1 0 t20msxs_ub_b5p1 0.000000 5.100000 /end CHARACTERISTIC
/begin CHARACTERISTIC TVKUPHS "Verzîgerungszeit Kupplungsschalter beim Hochschalten" CURVE 0x812A84 ME7_FKL3 0 t10msxs_ub_b2p55___UW 0.000000 655.350000
 /begin AXIS_DESCR FIX_AXIS gangi dez___SL 6 1.000000 6.000000 FIX_AXIS_PAR 1 0 6 /end AXIS_DESCR
/end CHARACTERISTIC
/begin CHARACTERISTIC TVKUPPL "Verzîgerungszeit fÅr die Information des Kupplungsschalter" VALUE 0x8155D7 ME7_FW1 0 t20msxs_ub_b5p1 0.000000 5.100000 /end CHARACTERISTIC
/begin CHARACTERISTIC TVKUPRS "Verzîgerungszeit Kupplungsschalter beim Runterschalten" CURVE 0x812A90 ME7_FKL3 0 t10msxs_ub_b2p55___UW 0.000000 655.350000
 /begin AXIS_DESCR FIX_AXIS gangi dez___SL 6 1.000000 6.000000 FIX_AXIS_PAR 1 0 6 /end AXIS_DESCR
/end CHARACTERISTIC
/begin CHARACTERISTIC TVKUPV "Verzîgerungszeit fÅr RÅcksetzen von B_kupplv" VALUE 0x810CEC ME7_FW3 0 t20msxs_uw_q0p02 0.000000 1310.700000 /end CHARACTERISTIC
/begin CHARACTERISTIC TVLADV_0_A "Zeitkonstante fÅr Integrator bei vlast-Berechnung" CURVE 0x81AF16 ZF_KL117 0 zk20msxs_uw_b1310 0.019989 1310.000000
 /begin AXIS_DESCR STD_AXIS dvzvi_w vfzg_sw_q0p00781 8 -256.000000 255.992000 DEPOSIT ABSOLUTE /end AXIS_DESCR
/end CHARACTERISTIC
/begin CHARACTERISTIC TVLADV_1_A "Zeitkonstante fÅr Integrator bei vlast-Berechnung" CURVE 0x81AF38 ZF_KL117 0 zk20msxs_uw_b1310 0.019989 1310.000000
 /begin AXIS_DESCR STD_AXIS dvzvi_w vfzg_sw_q0p00781 8 -256.000000 255.992000 DEPOSIT ABSOLUTE /end AXIS_DESCR
/end CHARACTERISTIC
/begin CHARACTERISTIC TVLDMN "Untere TastverhÑltnisbegrenzung fÅr LDR" VALUE 0x81552C ME7_FW1 0 tv_ub_b100 0.000000 99.609400 EXTENDED_LIMITS 0.000000 99.609375 /end CHARACTERISTIC
/begin CHARACTERISTIC TVLDMX "Obere TastverhÑltnisbegrenzung fÅr LDR" VALUE 0x81CAEE ME7_FW4 0 tv_sw_q0p005 0.000000 100.000000 EXTENDED_LIMITS -163.840000 163.835000 /end CHARACTERISTIC
/begin CHARACTERISTIC TVLDPMN "Minimales TEV-TastverhÑltnis fÅr Fortsetzung Leckdiagnose" VALUE 0x819C70 ME7_FW1 0 rel_ub_b99p6 0.000000 99.609400 EXTENDED_LIMITS 0.000000 99.609375 /end CHARACTERISTIC
/begin CHARACTERISTIC TVLDPT "TastverhÑltnis fÅr Fast Pulse Leckdiagnosepumpe" CURVE 0x815E76 ME7_KL97 0 rel_ub_b99p6 0.000000 99.609400
 /begin AXIS_DESCR STD_AXIS tfpg t1sxs_ub_b255 6 0.000000 255.000000 DEPOSIT ABSOLUTE /end AXIS_DESCR
 EXTENDED_LIMITS 0.000000 99.609375 /end CHARACTERISTIC
/begin CHARACTERISTIC TVLISTU "Verbotszeit fÅr negativen Integratoranteil nach Start" VALUE 0x8156D8 ME7_FW1 0 t20msxs_ub_b5p1 0.000000 5.100000 /end CHARACTERISTIC
/begin CHARACTERISTIC TVLLRI "Verzîgerungszeit fÅr Freigabe I-Anteil nach Start" CURVE 0x8155D8 ME7_KL97 0 t20msxs_ub_b5p1 0.000000 5.100000
 /begin AXIS_DESCR STD_AXIS tmot temp_ub_q0p75_o48 6 -48.000000 143.250000 DEPOSIT ABSOLUTE /end AXIS_DESCR
/end CHARACTERISTIC
/begin CHARACTERISTIC TVLLRPD "Maximale Verzîgerungszeit for Freigabe PD-Anteil nach Start" CURVE 0x8155E5 ME7_KL97 0 t20msxs_ub_b5p1 0.000000 5.100000
 /begin AXIS_DESCR STD_AXIS tmot temp_ub_q0p75_o48 6 -48.000000 143.250000 DEPOSIT ABSOLUTE /end AXIS_DESCR
/end CHARACTERISTIC
/begin CHARACTERISTIC TVLRA "Verzîgerungszeit fÅr Aktivierung Gemischadaption nach Lambdaregelung aktiv" VALUE 0x8153E9 ME7_FW1 0 t100msxs_ub_b25p5 0.100000 25.500000 EXTENDED_LIMITS 0.000000 25.500000 /end CHARACTERISTIC
/begin CHARACTERISTIC TVLRHMN "untere Grenze fÅr tv-Korrektur" VALUE 0x81857A ME7_FW2 0 t100msxs_sb_q0p01 -1.280000 1.270000 /end CHARACTERISTIC
/begin CHARACTERISTIC TVLRHMN2 "untere Grenze fÅr tv-Korrektur ungleiche Parameter Bank2" VALUE 0x81857B ME7_FW2 0 t100msxs_sb_q0p01 -1.280000 1.270000 /end CHARACTERISTIC
/begin CHARACTERISTIC TVLRHMX "obere Grenze fÅr tv-Korrektur" VALUE 0x81857C ME7_FW2 0 t100msxs_sb_q0p01 -1.280000 1.270000 /end CHARACTERISTIC
/begin CHARACTERISTIC TVLRHMX2 "obere Grenze fÅr tv-Korrektur ungleiche Parameter Bank2" VALUE 0x81857D ME7_FW2 0 t100msxs_sb_q0p01 -1.280000 1.270000 /end CHARACTERISTIC
/begin CHARACTERISTIC TVMXPR "Geschwindigkeit-PrÑdiktionshorizont fÅr VMAX-Regelung" VALUE 0x815A62 ME7_FW1 0 t10msxs_ub_b2p55 0.000000 2.550000 /end CHARACTERISTIC
/begin CHARACTERISTIC TVNWF "Verzugszeit zur NW-Umschaltfreigabe nach frÅh" VALUE 0x8188BC ME7_FW1 0 t50msxs_ub_b12p75 0.000000 12.750000 /end CHARACTERISTIC
/begin CHARACTERISTIC TVNWGE "Verzugszeit zur NW-Umschaltfreigabe nach Getriebeeingriff" VALUE 0x8188BD ME7_FW1 0 t50msxs_ub_b12p75 0.000000 12.750000 /end CHARACTERISTIC
/begin CHARACTERISTIC TVNWNST "Zeitverzîgerung der Nockenwelle nach Start" VALUE 0x8188BE ME7_FW1 0 t1sxs_ub_b255 0.000000 255.000000 /end CHARACTERISTIC
/begin CHARACTERISTIC TVNWS "Verzîgerungszeit fÅr Nockenwellenverstellung" VALUE 0x8188BF ME7_FW1 0 t50msxs_ub_b12p75 0.000000 12.750000 /end CHARACTERISTIC
/begin CHARACTERISTIC TVNWSTTM "Zeitverzîgerung im Start ab der die Nockenwelle angesteuert werden kann" CURVE 0x8188C0 ME7_KL97 0 t1sxs_ub_b255 0.000000 255.000000
 /begin AXIS_DESCR STD_AXIS tmot temp_ub_q0p75_o48 4 -48.000000 143.250000 DEPOSIT ABSOLUTE /end AXIS_DESCR
/end CHARACTERISTIC
/begin CHARACTERISTIC TVNW_S "Verzîgerungszeit nach der das Einla·ventil sicher in SpÑtstellung ist" VALUE 0x8188C9 ME7_FW1 0 t50msxs_ub_b12p75 0.000000 12.750000 /end CHARACTERISTIC
/begin CHARACTERISTIC TVPDKP1 "Fehlertoleranzzeit bei BereichsprÅfung DK-Poti 1" VALUE 0x814E93 ME7_FW1 0 t10msxs_ub_b2p55 0.010000 2.550000 EXTENDED_LIMITS 0.000000 2.550000 /end CHARACTERISTIC
/begin CHARACTERISTIC TVPDKP2 "Fehlertoleranzzeit bei BereichsprÅfung DK-Poti 2" VALUE 0x814E94 ME7_FW1 0 t10msxs_ub_b2p55 0.010000 2.550000 EXTENDED_LIMITS 0.000000 2.550000 /end CHARACTERISTIC
/begin CHARACTERISTIC TVPWDK12 "Fehlertoleranzzeit bei GleichlaufprÅfung der DK-Potis" VALUE 0x814E95 ME7_FW1 0 t10msxs_ub_b2p55 0.010000 2.550000 EXTENDED_LIMITS 0.000000 2.550000 /end CHARACTERISTIC
/begin CHARACTERISTIC TVPWDK13 "Fehlertoleranzzeit bei GleichlaufprÅfung DK-Poti 1 und Ersatzwert aus FÅllung" VALUE 0x814E96 ME7_FW1 0 t10msxs_ub_b2p55 0.010000 2.550000 EXTENDED_LIMITS 0.000000 2.550000 /end CHARACTERISTIC
/begin CHARACTERISTIC TVPWDK23 "Fehlertoleranzzeit bei GleichlaufprÅfung DK-Poti 2 und Ersatzwert aus FÅllung" VALUE 0x814E97 ME7_FW1 0 t10msxs_ub_b2p55 0.010000 2.550000 EXTENDED_LIMITS 0.000000 2.550000 /end CHARACTERISTIC
/begin CHARACTERISTIC TVPWMFR "Verzîgerungszeit fÅr Erkennung fehlerfreiem PWM-Signal" VALUE 0x8183A5 ME7_FW1 0 t100msxs_ub_b25p5 0.000000 25.500000 /end CHARACTERISTIC
/begin CHARACTERISTIC TVPWMFS "Verzîgerungszeit fÅr Erkennung fehlerhaftes PWM-Signal" VALUE 0x8183A6 ME7_FW1 0 t100msxs_ub_b25p5 0.000000 25.500000 /end CHARACTERISTIC
/begin CHARACTERISTIC TVRESLL "Haltezeit fÅr die erhîhte Momentenrerserve nach Drehzahleinbruch" VALUE 0x81986C ME7_FW1 0 t200msxs_ub_b51 0.000000 51.000000 /end CHARACTERISTIC
/begin CHARACTERISTIC TVRIF "Verzîgerungszeit fÅr Ri-Fehler" VALUE 0x8183D4 ME7_FW1 0 t1sxs_ub_b255 0.000000 255.000000 /end CHARACTERISTIC
/begin CHARACTERISTIC TVSATEM "Verzîgerungszeit fÅr TEV zu nach SA-Bereitschaft" CURVE 0x815E38 ME7_KL97 0 t20msxs_ub_b5p1 0.000000 5.100000
 /begin AXIS_DESCR STD_AXIS tmot temp_ub_q0p75_o48 6 -48.000000 143.250000 DEPOSIT ABSOLUTE /end AXIS_DESCR
/end CHARACTERISTIC
/begin CHARACTERISTIC TVSATM "Sperrzeit Schubabschalten nach Startende" CURVE 0x8197AD ME7_GKL1 0 t1sxs_ub_b255 0.000000 255.000000
 /begin AXIS_DESCR COM_AXIS tmot temp_ub_q0p75_o48 0 -48.000000 143.250000 AXIS_PTS_REF STM05SAUB /end AXIS_DESCR
/end CHARACTERISTIC
/begin CHARACTERISTIC TVSLVOFF "Zeitverzîgerung Schlie·en SekundÑrluftventil" VALUE 0x818364 ME7_FW1 0 t100msxs_ub_b25p5 0.000000 25.500000 /end CHARACTERISTIC
/begin CHARACTERISTIC TVSLVON "Zeitverzîgerung ôffnen SekundÑrluftventil" VALUE 0x818365 ME7_FW1 0 t100msxs_ub_b25p5 0.100000 25.500000 EXTENDED_LIMITS 0.000000 25.500000 /end CHARACTERISTIC
/begin CHARACTERISTIC TVTEVMN "minimales TEV- TastverhÑltnis bei DLDP- TEV- Check" VALUE 0x815E83 ME7_FW1 0 rel_ub_b99p6 0.000000 99.609400 EXTENDED_LIMITS 0.000000 99.609375 /end CHARACTERISTIC
/begin CHARACTERISTIC TVTUMTA "Verzugszeit Fahrgeschwindigkeitsbedingung fÅr Bestimmung Umgebungstemperatur" VALUE 0x81B9F0 ME7_FW3 0 t1sxs_uw_b65535 0.000000 65535.000000 /end CHARACTERISTIC
/begin CHARACTERISTIC TVUB "Spannungskorrektur" CURVE 0x811FD2 ME7_KL99 0 tinjection_sy 0.000000 209.712000
 /begin AXIS_DESCR STD_AXIS ub spg_ubatt 5 0.000000 17.952000 DEPOSIT ABSOLUTE /end AXIS_DESCR
/end CHARACTERISTIC
/begin CHARACTERISTIC TVWDKS "Verzîgerungszeit fÅr Drosselklappen-Sollwinkel" VALUE 0x815123 ME7_FW1 0 t10msxs_ub_b2p55 0.000000 2.550000 /end CHARACTERISTIC
/begin CHARACTERISTIC TVZMSE "Zeitgrenze fÅr RÅcksetzen öberwachungszÑhler ZMS- Resonanz" VALUE 0x81EBB4 ME7_FW3 0 t10msxs_uw_b655p35 0.000000 655.350000 /end CHARACTERISTIC
/begin CHARACTERISTIC TVZWMSA "Zeit bis zum öbergehen auf DauerspÑtbegrenzung" VALUE 0x813964 ME7_FW3 0 t10msxs_uw_b655p35 0.000000 655.350000 /end CHARACTERISTIC
/begin CHARACTERISTIC TVZWMSE "Zeit bis zum öbergehen auf DynamikspÑtbegrenzung" VALUE 0x813966 ME7_FW3 0 t10msxs_uw_b655p35 0.000000 655.350000 /end CHARACTERISTIC
/begin CHARACTERISTIC TWBDCY "Wartezeit fÅr Erkennung Bedingung 'driving cycle'" VALUE 0x81AC36 ME7_FW3 0 t200msxs_uw_q0p2 0.000000 13107.000000 /end CHARACTERISTIC
/begin CHARACTERISTIC TWDDTV "Wartezeit fÅr Ready-Flag der Delta-TV Diagnose (DLSA)" VALUE 0x81AD80 ME7_FW3 0 t1sxs_uw_b65535 10.000000 65535.000000 EXTENDED_LIMITS 0.000000 65535.000000 /end CHARACTERISTIC
/begin CHARACTERISTIC TWDKATST "Wartezeit nach Stoppbedingung fÅr Filter und Integrator" VALUE 0x8184EC ME7_FW1 0 t50msxs_ub_b12p75 0.000000 12.750000 /end CHARACTERISTIC
/begin CHARACTERISTIC TWDKSV "Zeitkonstante fÅr Drosselklappensollwinkelfilterung" CURVE 0x811B92 ZF_KL111 0 zk10msxs_uw_b655 0.010000 655.360000
 /begin AXIS_DESCR STD_AXIS pspvmin_w fak_uw_b2 6 0.000000 1.999970 DEPOSIT ABSOLUTE /end AXIS_DESCR
/end CHARACTERISTIC
/begin CHARACTERISTIC TWDLDPE "Wartezeit fÅr Fehlerdiagnose LDP-Endstufe" VALUE 0x8185E1 ME7_FW1 0 t100msxs_ub_b25p5 0.000000 25.500000 /end CHARACTERISTIC
/begin CHARACTERISTIC TWDLSSA "MindestprÅfzeit fÅr DLSSA-Extremwertbestimmung" VALUE 0x81B5CA ME7_FW3 0 t50msxs_uw_b3276p75 0.000000 3276.750000 /end CHARACTERISTIC
/begin CHARACTERISTIC TWDMAD "Wartezeit bis Freigabe der Adaption des Verlustmoments" VALUE 0x81983A ME7_FW1 0 t200msxs_ub_b51 0.000000 51.000000 /end CHARACTERISTIC
/begin CHARACTERISTIC TWHLSLP "Wartezeit fÅr Hochlauf SekundÑrluftpumpe" VALUE 0x81839D ME7_FW1 0 t100msxs_ub_b25p5 0.000000 25.500000 /end CHARACTERISTIC
/begin CHARACTERISTIC TWKTDLP "Wartezeit nach Parameterumschaltung in Lambdaregelung" VALUE 0x8184ED ME7_FW1 0 t50msxs_ub_b12p75 0.000000 12.750000 /end CHARACTERISTIC
/begin CHARACTERISTIC TWLDPE "Entprellzeit fÅr i.O.-PrÅfung LDP-Endstufe" VALUE 0x8185E2 ME7_FW1 0 t100msxs_ub_b25p5 0.000000 25.500000 /end CHARACTERISTIC
/begin CHARACTERISTIC TWLRTMS "Wartezeit fÅr Diagnose TMOT-Einschaltbedingung lambda-Regelung" CURVE 0x818FFE ME7_KL97 0 t100msxs_ub_q20 0.000000 5100.000000
 /begin AXIS_DESCR STD_AXIS tmst temp_ub_q0p75_o48 4 -48.000000 143.250000 DEPOSIT ABSOLUTE /end AXIS_DESCR
/end CHARACTERISTIC
/begin CHARACTERISTIC TWMLFE "Mindestzeit fÅr ml im Diagnosebereich" VALUE 0x81839E ME7_FW1 0 t100msxs_ub_b25p5 0.000000 25.500000 /end CHARACTERISTIC
/begin CHARACTERISTIC TWMSLMIN "Entprellzeit fÅr Fehlermeldung B_mslmin" VALUE 0x81839F ME7_FW1 0 t100msxs_ub_b25p5 0.000000 25.500000 /end CHARACTERISTIC
/begin CHARACTERISTIC TWNSTA "Wartezeit nach Motorstart" VALUE 0x81ADA4 ME7_FW3 0 t10msxs_uw_b655p35 0.000000 655.350000 /end CHARACTERISTIC
/begin CHARACTERISTIC TWNTAL "Wartezeit bis Nicht-Tankleer-Signal gÅltig ist" VALUE 0x81ADA6 ME7_FW3 0 t200msxs_uw_q0p2 0.000000 13107.000000 /end CHARACTERISTIC
/begin CHARACTERISTIC TWPMBBR "Verzîgerungszeit fÅr Pedalwertbegrenzung bei betÑtigter Bremse" VALUE 0x814DC2 ME7_FW1 0 t10msxs_ub_b2p55 0.000000 2.550000 /end CHARACTERISTIC
/begin CHARACTERISTIC TWSTT "Schwelle Abstellzeit fÅr Wiederholstart" CURVE 0x811F5C ZF_KL111 0 t1sxs_uw_q1 0.000000 65535.000000
 /begin AXIS_DESCR STD_AXIS tmotab temp_ub_q0p75_o48___UW 12 -48.000000 49103.300000 DEPOSIT ABSOLUTE /end AXIS_DESCR
/end CHARACTERISTIC
/begin CHARACTERISTIC TZ2FGRGA_0_A "Doppelte ZÑhlerzeitkonstante fÅr FGR-Regler" CURVE 0x810EB8 ME7_GKL3 0 t20msxs_uw_q0p02 0.000000 1310.700000
 /begin AXIS_DESCR COM_AXIS uevges fak_q0p1 0 0.000000 25.500000 AXIS_PTS_REF SUE08MFUB /end AXIS_DESCR
/end CHARACTERISTIC
/begin CHARACTERISTIC TZ2FGRGA_1_A "Doppelte ZÑhlerzeitkonstante fÅr FGR-Regler" CURVE 0x810EC8 ME7_GKL3 0 t20msxs_uw_q0p02 0.000000 1310.700000
 /begin AXIS_DESCR COM_AXIS uevges fak_q0p1 0 0.000000 25.500000 AXIS_PTS_REF SUE08MFUB /end AXIS_DESCR
/end CHARACTERISTIC
/begin CHARACTERISTIC TZMIN "Zeitfenster fÅr Zahnerkennung nach UBatt-Einbruch" VALUE 0x8164CB ME7_FW1 0 t10msxs_ub_b2p55 0.000000 2.550000 /end CHARACTERISTIC
/begin CHARACTERISTIC TZMSAS "Zeitgrenze fÅr ZMS-Resonanz au·erhalb Start" VALUE 0x813A2A ME7_FW3 0 t10msxs_uw_b655p35 0.000000 655.350000 /end CHARACTERISTIC
/begin CHARACTERISTIC TZMSST "Zeitgrenze fÅr ZMS-Resonanz innerhalb Start" VALUE 0x813A2C ME7_FW3 0 t10msxs_uw_b655p35 0.000000 655.350000 /end CHARACTERISTIC
/begin CHARACTERISTIC TZSPINI_0_A "Sperrzeit fuer Filterinitialisierung" VALUE 0x81728C ME7_FW1 0 t10msxs_ub_b2p55 0.000000 2.550000 /end CHARACTERISTIC
/begin CHARACTERISTIC TZSPINI_1_A "Sperrzeit fuer Filterinitialisierung" VALUE 0x81728D ME7_FW1 0 t10msxs_ub_b2p55 0.000000 2.550000 /end CHARACTERISTIC
/begin CHARACTERISTIC TZSPINI_2_A "Sperrzeit fuer Filterinitialisierung" VALUE 0x81728E ME7_FW1 0 t10msxs_ub_b2p55 0.000000 2.550000 /end CHARACTERISTIC
/begin CHARACTERISTIC TZSPINI_3_A "Sperrzeit fuer Filterinitialisierung" VALUE 0x81728F ME7_FW1 0 t10msxs_ub_b2p55 0.000000 2.550000 /end CHARACTERISTIC
/begin CHARACTERISTIC TZSUDYN "Dauer des Dynamikvorhalts" CURVE 0x816466 ME7_KL97 0 t10msxs_ub_b2p55 0.000000 2.550000
 /begin AXIS_DESCR STD_AXIS nmot nmot_ub_q40 6 0.000000 10200.000000 DEPOSIT ABSOLUTE /end AXIS_DESCR
/end CHARACTERISTIC
/begin CHARACTERISTIC TZTOL_UM "Toleranz zwischen Zeit- und ZahnzÑhlererfassung in Timerinkrementen" VALUE 0x814216 ME7_FW3 0 dez___UW 0.000000 65535.000000 /end CHARACTERISTIC
/begin CHARACTERISTIC T_GEUEW "öberwachungszeit fÅr Getriebeeingriff (nur ZW-Eingriff)" VALUE 0x810180 ME7_FW3 0 t10msxs_uw_b655p35 0.000000 655.350000 /end CHARACTERISTIC
/begin CHARACTERISTIC T_NOMALL "Timeoutzeit Allrad-Botschaft" VALUE 0x8144F2 ME7_FW1 0 t100msxs_ub_b25p5 0.000000 25.500000 /end CHARACTERISTIC
/begin CHARACTERISTIC T_NOMASR "DCAN Fehlerzeit ASR Botschaft" VALUE 0x8144F3 ME7_FW1 0 t10msxs_ub_b2p55 0.000000 2.550000 /end CHARACTERISTIC
/begin CHARACTERISTIC T_NOMASRTA "DCAN Timeoutzeit ASR Botschaft" VALUE 0x8144F4 ME7_FW1 0 t100msxs_ub_b25p5 0.000000 25.500000 /end CHARACTERISTIC
/begin CHARACTERISTIC T_NOMBR3 "CAN : Timeoutzeit fÅr Botschaft Bremse 3" VALUE 0x8144F5 ME7_FW1 0 t10msxs_ub_b2p55 0.000000 2.550000 /end CHARACTERISTIC
/begin CHARACTERISTIC T_NOMEGS "DCAN Fehlerzeit EGS Botschaft" VALUE 0x8144F6 ME7_FW1 0 t10msxs_ub_b2p55 0.000000 2.550000 /end CHARACTERISTIC
/begin CHARACTERISTIC T_NOMKBI1 "Timeoutzeit Botschaft Kombi1" VALUE 0x8144F7 ME7_FW1 0 t20msxs_ub_b5p1 0.000000 5.100000 /end CHARACTERISTIC
/begin CHARACTERISTIC T_NOMKBI23 "Timeoutzeit Botschaft Kombi2 und 3" VALUE 0x8183A0 ME7_FW1 0 t100msxs_ub_b25p5 0.000000 25.500000 /end CHARACTERISTIC
/begin CHARACTERISTIC T_NOMLWS "CAN Timeoutzeit Lenkwinkelsensor Botschaft" VALUE 0x8144F8 ME7_FW1 0 t10msxs_ub_b2p55 0.000000 2.550000 /end CHARACTERISTIC
/begin CHARACTERISTIC T_SFSEN "Zeit nach Startende fÅr Auswertung Fahrstufe S_fs" VALUE 0x810182 ME7_FW3 0 t10msxs_uw_b655p35 0.000000 655.350000 /end CHARACTERISTIC
/begin CHARACTERISTIC UADPLMN "min. Spannungswert fÅr Diagnose Drucksensor Ladedruck" VALUE 0x81860F ME7_FW1 0 spg_ub_b5 0.000000 4.980470 EXTENDED_LIMITS 0.000000 4.980469 /end CHARACTERISTIC
/begin CHARACTERISTIC UADPLMX "max. Spannungswert fÅr Diagnose Drucksensor Ladedruck" VALUE 0x818610 ME7_FW1 0 spg_ub_b5 0.000000 4.980470 EXTENDED_LIMITS 0.000000 4.980469 /end CHARACTERISTIC
/begin CHARACTERISTIC UADPUMN "min. Spannungswert fÅr Diagnose Drucksensor" VALUE 0x818611 ME7_FW1 0 spg_ub_q0p019 0.000000 4.980470 EXTENDED_LIMITS 0.000000 4.980469 /end CHARACTERISTIC
/begin CHARACTERISTIC UADPUMX "max. Spannungswert fÅr Diagnose Drucksensor" VALUE 0x818612 ME7_FW1 0 spg_ub_q0p019 0.000000 4.980470 EXTENDED_LIMITS 0.000000 4.980469 /end CHARACTERISTIC
/begin CHARACTERISTIC UANAUFRP "Schrittweite fÅr AUF-Rampe" VALUE 0x810C60 ME7_FW3 0 relDK_uw_b100 0.000000 0.999466 EXTENDED_LIMITS 0.000000 100.000000 /end CHARACTERISTIC
/begin CHARACTERISTIC UANNMAX "Motordrehzahlschwelle fÅr Freigabe UMA-Lernen und VerstÑrkerabgleich" VALUE 0x814EC7 ME7_FW1 0 nmot_ub_q10 0.000000 2550.000000 /end CHARACTERISTIC
/begin CHARACTERISTIC UANPEDMAX "Pedalschwelle fÅr UMA-Lernen erlaubt" VALUE 0x814EC8 ME7_FW1 0 relDK_ub_b100 0.000000 100.000000 /end CHARACTERISTIC
/begin CHARACTERISTIC UANPIDMIN "Abbruchschwelle PID-Summe fÅr ZU-Rampe" VALUE 0x810C62 ME7_FW3 0 rel_uw_b100 0.000000 99.998500 EXTENDED_LIMITS 0.000000 99.998474 /end CHARACTERISTIC
/begin CHARACTERISTIC UANPIDMINA "Abbruchschwelle PID-Summe fÅr AUF-Rampe" VALUE 0x810C64 ME7_FW3 0 rel_uw_b100 0.000000 99.998500 EXTENDED_LIMITS 0.000000 99.998474 /end CHARACTERISTIC
/begin CHARACTERISTIC UANUATS "untere Ansauglufttemperaturschwelle fÅr Lernfreigabe" VALUE 0x814EC9 ME7_FW1 0 temp_ub_q0p75_o48 -48.000000 143.250000 /end CHARACTERISTIC
/begin CHARACTERISTIC UANVFZG "Geschwindigkeitssschelle fÅr DV-E-PrÅfung/Lernroutine" VALUE 0x814ECA ME7_FW1 0 vfzg_ub_q1p25___UB 0.000000 318.750000 /end CHARACTERISTIC
/begin CHARACTERISTIC UANZURP "Schrittweite fÅr ZU-Rampe" VALUE 0x810C66 ME7_FW3 0 spg_uw_q0p001222 0.000000 0.050102 EXTENDED_LIMITS 0.000000 80.083770 /end CHARACTERISTIC
/begin CHARACTERISTIC UAN_O_MT "obere Motortemperaturschwelle fÅr Anschlag" VALUE 0x814ECB ME7_FW1 0 temp_ub_q0p75_o48 -48.000000 143.250000 /end CHARACTERISTIC
/begin CHARACTERISTIC UAN_STORE "Schwelle fÅr Abspeicherung neuer Lernwerte" VALUE 0x810C68 ME7_FW3 0 spg_uw_q0p001222 0.000000 0.050102 EXTENDED_LIMITS 0.000000 80.083770 /end CHARACTERISTIC
/begin CHARACTERISTIC UAN_U_MT "untere Motortemperaturschwelle fÅr Anschlag" VALUE 0x814ECC ME7_FW1 0 temp_ub_q0p75_o48 -48.000000 143.250000 /end CHARACTERISTIC
/begin CHARACTERISTIC UBDABS "Batteriespannungsschwelle fÅr Auswertung Schlechtweginfo" VALUE 0x8183A9 ME7_FW1 0 spg_ubatt 0.000000 17.952000 /end CHARACTERISTIC
/begin CHARACTERISTIC UBDE "Ubatt - Ersatzwert bei defektem AD - Kanal" VALUE 0x814DA6 ME7_FW1 0 spg_ubatt 0.000000 17.952000 /end CHARACTERISTIC
/begin CHARACTERISTIC UBDLS "Batteriespannungsschwelle zur Freigabe der Sonden-Diagnose" VALUE 0x8184AF ME7_FW1 0 spg_ubatt 0.000000 17.952000 /end CHARACTERISTIC
/begin CHARACTERISTIC UBDLSMX "obere Batteriespannungsschwelle fÅr die  Sonden-Diagnose" VALUE 0x8183D5 ME7_FW1 0 spg_ubatt 0.000000 17.952000 /end CHARACTERISTIC
/begin CHARACTERISTIC UBDMN1 "Batteriespannung min. (Netz)" VALUE 0x814DA7 ME7_FW1 0 spg_ubatt 0.000000 17.952000 /end CHARACTERISTIC
/begin CHARACTERISTIC UBDMN2 "Batteriespannung min. (ADC)" VALUE 0x814DA8 ME7_FW1 0 spg_ubatt 0.000000 17.952000 /end CHARACTERISTIC
/begin CHARACTERISTIC UBDMX "Batteriespannung max." VALUE 0x814DA9 ME7_FW1 0 spg_ubatt 0.000000 17.952000 /end CHARACTERISTIC
/begin CHARACTERISTIC UBDOLDPE "obere Spannungschwelle fÅr Freigabe LDP-Endstufendiagnose" VALUE 0x8185E3 ME7_FW1 0 spg_ubatt 0.000000 17.952000 /end CHARACTERISTIC
/begin CHARACTERISTIC UBDULDPE "untere Spannungschwelle fÅr Freigabe LDP-Endstufendiagnose" VALUE 0x8185E4 ME7_FW1 0 spg_ubatt 0.000000 17.952000 /end CHARACTERISTIC
/begin CHARACTERISTIC UBHFM "Batteriespannungsschwelle zur Umschaltung auf tlw" VALUE 0x8185FF ME7_FW1 0 spg_ubatt 0.000000 17.952000 /end CHARACTERISTIC
/begin CHARACTERISTIC UBHS "Batteriespannungsschwelle fÅr Abschalten der Sondenheizung" VALUE 0x818527 ME7_FW1 0 spg_ubatt 0.000000 17.952000 /end CHARACTERISTIC
/begin CHARACTERISTIC UBKL15 "Ub-Schwelle fÅr redundaten KL15-Erfassung" VALUE 0x819A27 ME7_FW1 0 spg_ubatt 0.000000 4.998400 EXTENDED_LIMITS 0.000000 17.952000 /end CHARACTERISTIC
/begin CHARACTERISTIC UBKST "Ubat-Schwelle fÅr ZUBKSTMX" VALUE 0x815214 ME7_FW1 0 spg_ubatt 0.000000 17.952000 /end CHARACTERISTIC
/begin CHARACTERISTIC UBKSTMX "Anzahlschwelle Ubat unter UBKST fÅr Adaptionssperrung" VALUE 0x815215 ME7_FW1 0 dez 0.000000 255.000000 /end CHARACTERISTIC
/begin CHARACTERISTIC UBNACHL "Ub-Ersatzwert im Nachlauf" VALUE 0x818596 ME7_FW1 0 spg_ubatt 0.000000 17.952000 /end CHARACTERISTIC
/begin CHARACTERISTIC UBNLMN "Minimale Batterie-Sollspannung" VALUE 0x819A25 ME7_FW1 0 spg_ubatt 0.000000 17.952000 /end CHARACTERISTIC
/begin CHARACTERISTIC UBSLMN "min. Spannung fÅr SekundÑrluft ein" VALUE 0x818366 ME7_FW1 0 spg_ubatt 0.000000 17.952000 /end CHARACTERISTIC
/begin CHARACTERISTIC UBSLMX "max. Spannung fÅr SekundÑrluft ein" VALUE 0x818367 ME7_FW1 0 spg_ubatt 0.000000 17.952000 /end CHARACTERISTIC
/begin CHARACTERISTIC UBSLSTMN "min.Spannung fÅr SekundÑrluft ein im Start" VALUE 0x818368 ME7_FW1 0 spg_ubatt 0.000000 17.952000 /end CHARACTERISTIC
/begin CHARACTERISTIC UBSOLMN "Minimale Batterie-Sollspannung" VALUE 0x81858F ME7_FW1 0 spg_ubatt 0.000000 17.952000 /end CHARACTERISTIC
/begin CHARACTERISTIC UBSOLMX "Maximale Batterie-Sollspannung" VALUE 0x818590 ME7_FW1 0 spg_ubatt 0.000000 17.952000 /end CHARACTERISTIC
/begin CHARACTERISTIC UBSTS "Schwelle zur Erkennung UBatt-Einbruch im Start" VALUE 0x8164CC ME7_FW1 0 spg_ubatt 0.000000 17.952000 /end CHARACTERISTIC
/begin CHARACTERISTIC UBVDKPO "Batteriespannungsschwelle fÅr Umschaltung auf verstÑrktes Signal von DK-Poti 1" VALUE 0x814E98 ME7_FW1 0 spg_ubatt 0.000000 17.952000 /end CHARACTERISTIC
/begin CHARACTERISTIC UBVDKPU "Batteriespannungsschwelle fÅr Umschaltung auf unverstÑrktes Signal von DK-Poti 1" VALUE 0x814E99 ME7_FW1 0 spg_ubatt 0.000000 17.952000 /end CHARACTERISTIC
/begin CHARACTERISTIC UB_UANL "Batteriespannungsschwelle fÅr Lernfreigabe" VALUE 0x814ECD ME7_FW1 0 spg_ubatt 0.000000 17.952000 /end CHARACTERISTIC
/begin CHARACTERISTIC UDKNLP1N "Nennwert-Spannung DK-Poti 1 in NLP-Stellung" VALUE 0x810C6A ME7_FW3 0 spg_uw_q0p001222 0.000000 5.004090 EXTENDED_LIMITS 0.000000 80.083770 /end CHARACTERISTIC
/begin CHARACTERISTIC UDKNLP2N "Nennwert-Spannung DK-Poti 2 in NLP-Stellung" VALUE 0x810C6C ME7_FW3 0 spg_uw_q0p001222 0.000000 5.004090 EXTENDED_LIMITS 0.000000 80.083770 /end CHARACTERISTIC
/begin CHARACTERISTIC UDKNLPTOL "zulÑssige Potispannungs-Toleranz des NLP" VALUE 0x810CDE ME7_FW3 0 spg_uw_q0p001222 0.000000 80.083800 EXTENDED_LIMITS 0.000000 80.083770 /end CHARACTERISTIC
/begin CHARACTERISTIC UDKP1AMAX "max. Spannung DK-Poti 1 am unteren DK-Anschlag" VALUE 0x810C6E ME7_FW3 0 spg_uw_q0p001222 0.000000 5.004090 EXTENDED_LIMITS 0.000000 80.083770 /end CHARACTERISTIC
/begin CHARACTERISTIC UDKP1AMIN "min. Spannung DK-Poti 1 am unteren DK-Anschlag" VALUE 0x810C70 ME7_FW3 0 spg_uw_q0p001222 0.000000 5.004090 EXTENDED_LIMITS 0.000000 80.083770 /end CHARACTERISTIC
/begin CHARACTERISTIC UDKP1AURI "Spannung DK-Poti 1 am unt. DK-Anschlag, Initial. Wert" VALUE 0x810C72 ME7_FW3 0 spg_uw_q0p001222 0.000000 5.004090 EXTENDED_LIMITS 0.000000 80.083770 /end CHARACTERISTIC
/begin CHARACTERISTIC UDKP1DUS "Nennumschaltschwelle zur DK-Poti-1-Umschaltung" VALUE 0x814ECE ME7_FW1 0 spg_ub_b5 0.000000 4.980470 EXTENDED_LIMITS 0.000000 4.980469 /end CHARACTERISTIC
/begin CHARACTERISTIC UDKP1NHUB "Nennhub der Drosselklappe im DV-E, (Poti 1)" VALUE 0x810C74 ME7_FW3 0 spg_uw_q0p001222 0.000000 5.004090 EXTENDED_LIMITS 0.000000 80.083770 /end CHARACTERISTIC
/begin CHARACTERISTIC UDKP1O "Maximale zulÑssige Spannung von DK-Poti 1" VALUE 0x814E9A ME7_FW1 0 spg_ub_b5 0.000000 4.980470 EXTENDED_LIMITS 0.000000 4.980469 /end CHARACTERISTIC
/begin CHARACTERISTIC UDKP1U "Minimale zulÑssige Spannung von DK-Poti 1" VALUE 0x814E9B ME7_FW1 0 spg_ub_b5 0.000000 4.980470 EXTENDED_LIMITS 0.000000 4.980469 /end CHARACTERISTIC
/begin CHARACTERISTIC UDKP1VID "NennverstÑrkung fÅr DK-Poti 1" VALUE 0x810C76 ME7_FW3 0 fak_q0p0039 0.000000 7.996090 EXTENDED_LIMITS 0.000000 255.996094 /end CHARACTERISTIC
/begin CHARACTERISTIC UDKP1VOMA "max. Offsetfehler fÅr DK-Poti-1-VerstÑrker" VALUE 0x810C78 ME7_FW4 0 spg_sw_q0p001222 0.000000 5.004090 EXTENDED_LIMITS -40.042496 40.041274 /end CHARACTERISTIC
/begin CHARACTERISTIC UDKP1VOMI "min. Offsetfehler fÅr DK-Poti-1-VerstÑrker" VALUE 0x810C7A ME7_FW4 0 spg_sw_q0p001222 -5.004090 0.000000 EXTENDED_LIMITS -40.042496 40.041274 /end CHARACTERISTIC
/begin CHARACTERISTIC UDKP1VOSC "unt. Grenze fÅr ob. Abgleichpkt. DK-Poti 1" VALUE 0x810C7C ME7_FW3 0 spg_uw_q0p00488 0.000000 4.995120 EXTENDED_LIMITS 0.000000 319.995117 /end CHARACTERISTIC
/begin CHARACTERISTIC UDKP1VUSC "ob. Grenze fÅr unt. Abgleichpkt. DK-Poti 1" VALUE 0x810C7E ME7_FW3 0 spg_uw_q0p00488 0.000000 4.995120 EXTENDED_LIMITS 0.000000 319.995117 /end CHARACTERISTIC
/begin CHARACTERISTIC UDKP1VVMA "ob. Wert VerstÑrkungsfehler fÅr VerstÑrker" VALUE 0x810C80 ME7_FW3 0 fak_q0p0039 0.000000 7.996090 EXTENDED_LIMITS 0.000000 255.996094 /end CHARACTERISTIC
/begin CHARACTERISTIC UDKP1VVMI "unt. Wert VerstÑrkungsfehler fÅr VerstÑrker" VALUE 0x810C82 ME7_FW3 0 fak_q0p0039 0.000000 7.996090 EXTENDED_LIMITS 0.000000 255.996094 /end CHARACTERISTIC
/begin CHARACTERISTIC UDKP2AMAX "max. Spannung DK-Poti 2 am unteren DK-Anschlag" VALUE 0x810C84 ME7_FW3 0 spg_uw_q0p001222 0.000000 5.004090 EXTENDED_LIMITS 0.000000 80.083770 /end CHARACTERISTIC
/begin CHARACTERISTIC UDKP2AMIN "min. Spannung DK-Poti 2 am unteren DK-Anschlag" VALUE 0x810C86 ME7_FW3 0 spg_uw_q0p001222 0.000000 5.004090 EXTENDED_LIMITS 0.000000 80.083770 /end CHARACTERISTIC
/begin CHARACTERISTIC UDKP2AURI "Spannung DK-Poti 2 am unt. DK-Anschlag, Initial. Wert" VALUE 0x810C88 ME7_FW3 0 spg_uw_q0p001222 0.000000 5.004090 EXTENDED_LIMITS 0.000000 80.083770 /end CHARACTERISTIC
/begin CHARACTERISTIC UDKP2O "Maximale zulÑssige Spannung von DK-Poti 2" VALUE 0x814E9C ME7_FW1 0 spg_ub_b5 0.000000 4.980470 EXTENDED_LIMITS 0.000000 4.980469 /end CHARACTERISTIC
/begin CHARACTERISTIC UDKP2U "Minimale zulÑssige Spannung von DK-Poti 2" VALUE 0x814E9D ME7_FW1 0 spg_ub_b5 0.000000 4.980470 EXTENDED_LIMITS 0.000000 4.980469 /end CHARACTERISTIC
/begin CHARACTERISTIC UDKPALOS "Spannungsoffset zur Erkennung des Loslîsens" VALUE 0x810C8A ME7_FW3 0 spg_uw_q0p001222 0.000000 0.400816 EXTENDED_LIMITS 0.000000 80.083770 /end CHARACTERISTIC
/begin CHARACTERISTIC UDKPAOFF "Spannungsoffset am unteren Anschlag" VALUE 0x810C8C ME7_FW3 0 spg_uw_q0p001222 0.000000 0.050102 EXTENDED_LIMITS 0.000000 80.083770 /end CHARACTERISTIC
/begin CHARACTERISTIC UDKPATMX "max. mîglicher Offset der temp. UMA-Adaption" VALUE 0x810C8E ME7_FW3 0 spg_uw_q0p001222 0.000000 5.004090 EXTENDED_LIMITS 0.000000 80.083770 /end CHARACTERISTIC
/begin CHARACTERISTIC UDKRGOFS "Spannungsschwelle fÅr DIA/KR Grundoffset VerstÑrker" VALUE 0x815440 ME7_FW1 0 spg_ub_b5 0.000000 4.980470 EXTENDED_LIMITS 0.000000 4.980469 /end CHARACTERISTIC
/begin CHARACTERISTIC UDKRTP "Integratorspannungsschwelle fÅr Dia KS - Auswerteschaltung Testimpuls" VALUE 0x815442 ME7_FW1 0 spg_ub_b5 0.000000 4.980470 EXTENDED_LIMITS 0.000000 4.980469 /end CHARACTERISTIC
/begin CHARACTERISTIC UDKSNO "Obere Referenzspannungsschwelle DIA KS" CURVE 0x81C000 ME7_GKL3 0 spg_uw_b1280 0.000000 319.981000
 /begin AXIS_DESCR COM_AXIS nmot nmot_ub_q40 0 0.000000 10200.000000 AXIS_PTS_REF SNM16KRUB /end AXIS_DESCR
 EXTENDED_LIMITS 0.000000 1279.983745 /end CHARACTERISTIC
/begin CHARACTERISTIC UDKSNU "untere Referenzspannungsschwelle DIA KS" CURVE 0x81C020 ME7_GKL3 0 spg_uw_b1280 0.000000 319.981000
 /begin AXIS_DESCR COM_AXIS nmot nmot_ub_q40 0 0.000000 10200.000000 AXIS_PTS_REF SNM16KRUB /end AXIS_DESCR
 EXTENDED_LIMITS 0.000000 1279.983745 /end CHARACTERISTIC
/begin CHARACTERISTIC UEVERG "öbersetzungsverhÑltnis abh. vom eingelegten Gang" CURVE 0x8155C8 ME7_FKL1 0 fak_ub_b16 0.000000 15.937500
 /begin AXIS_DESCR FIX_AXIS gangi dez___SL 8 0.000000 7.000000 FIX_AXIS_PAR 0 0 8 /end AXIS_DESCR
/end CHARACTERISTIC
/begin CHARACTERISTIC UHEMN "Schwellwert fÅr bestromte Heizerendstufe" VALUE 0x81858B ME7_FW1 0 spg_ub_b5 0.000000 4.980470 EXTENDED_LIMITS 0.000000 4.980469 /end CHARACTERISTIC
/begin CHARACTERISTIC UHEMX "Schwellwert fÅr stromlose Heizerendstufe" VALUE 0x81858C ME7_FW1 0 spg_ub_b5 0.000000 4.980470 EXTENDED_LIMITS 0.000000 4.980469 /end CHARACTERISTIC
/begin CHARACTERISTIC UHSN "Nennspannung fÅr die Sondenheizung" VALUE 0x818528 ME7_FW1 0 spg_ubatt 0.000000 17.952000 /end CHARACTERISTIC
/begin CHARACTERISTIC ULDPEMN "Minimale Spannung fÅr Diagnose LDP-Endstufe i.O." VALUE 0x8185E5 ME7_FW1 0 spg_ub_q0p019 0.000000 4.980470 EXTENDED_LIMITS 0.000000 4.980469 /end CHARACTERISTIC
/begin CHARACTERISTIC ULDPEMX "Maximale Spannung fÅr Diagnose LDP-Endstufe i.O." VALUE 0x8185E6 ME7_FW1 0 spg_ub_q0p019 0.000000 4.980470 EXTENDED_LIMITS 0.000000 4.980469 /end CHARACTERISTIC
/begin CHARACTERISTIC UMDYLDR "Umschaltschwelle Dynamik LDR" VALUE 0x8194BE ME7_FW2 0 p_sb_q10 0.000000 1270.000000 EXTENDED_LIMITS -1280.000000 1270.000000 /end CHARACTERISTIC
/begin CHARACTERISTIC UMRST_TV_UM "" VALUE 0x814001 ME7_FW1 0 dez 0.000000 255.000000 /end CHARACTERISTIC
/begin CHARACTERISTIC UNWDNWS "Umdrehungen Nockenwelle fÅr Fehlerentprellung Diagnose NWS" VALUE 0x8188D4 ME7_FW1 0 nwu_q1 0.000000 255.000000 /end CHARACTERISTIC
/begin CHARACTERISTIC UPVGNENN "Nennwert fÅr DV-E Potiversorgungsspannung" VALUE 0x81ADAC ME7_FW3 0 dez___UW 0.000000 65535.000000 /end CHARACTERISTIC
/begin CHARACTERISTIC UPW1BE "Spannung PWG-Poti 1 fÅr DurchfÅhrung der Bewegungserkennung" VALUE 0x814DC3 ME7_FW1 0 spg_ub_b5 0.000000 4.980470 EXTENDED_LIMITS 0.000000 4.980469 /end CHARACTERISTIC
/begin CHARACTERISTIC UPW1LLMX "Maximale Spannung von Poti 1 im Leergaspunkt" VALUE 0x814DC4 ME7_FW1 0 spg_ub_b5 0.000000 4.980470 EXTENDED_LIMITS 0.000000 4.980469 /end CHARACTERISTIC
/begin CHARACTERISTIC UPWG12U "Untere Begrenzung PWG-Poti-Spannung vor Vergleich Poti 1 und 2" VALUE 0x814DC5 ME7_FW1 0 spg_ub_b5 0.000000 4.980470 EXTENDED_LIMITS 0.000000 4.980469 /end CHARACTERISTIC
/begin CHARACTERISTIC UPWG1O "Obere Schranke fÅr PWG-Poti-1-Spannung" VALUE 0x814DC6 ME7_FW1 0 spg_ub_b5 0.000000 4.980470 EXTENDED_LIMITS 0.000000 4.980469 /end CHARACTERISTIC
/begin CHARACTERISTIC UPWG1U "Untere Schranke fÅr PWG-Poti-1-Spannung" VALUE 0x814DC7 ME7_FW1 0 spg_ub_b5 0.000000 4.980470 EXTENDED_LIMITS 0.000000 4.980469 /end CHARACTERISTIC
/begin CHARACTERISTIC UPWG2O "Obere Schranke fÅr PWG-Poti-2-Spannung" VALUE 0x814DC8 ME7_FW1 0 spg_ub_b5 0.000000 4.980470 EXTENDED_LIMITS 0.000000 4.980469 /end CHARACTERISTIC
/begin CHARACTERISTIC UPWG2U "Untere Schranke fÅr PWG-Poti-2-Spannung" VALUE 0x814DC9 ME7_FW1 0 spg_ub_b5 0.000000 4.980470 EXTENDED_LIMITS 0.000000 4.980469 /end CHARACTERISTIC
/begin CHARACTERISTIC UPWGKDMN "Untere Grenze der PWG-Poti-Spannung fÅr Toleranzbereich der Kick-Down-Position" VALUE 0x810C48 ME7_FW3 0 spg_uw_q0p004888 0.000000 320.335000 EXTENDED_LIMITS 0.000000 320.335080 /end CHARACTERISTIC
/begin CHARACTERISTIC UPWGKDMX "Obere Grenze der PWG-Poti-Spannung fÅr Toleranzbereich der Kick-Down-Position" VALUE 0x810C4A ME7_FW3 0 spg_uw_q0p004888 0.000000 320.335000 EXTENDED_LIMITS 0.000000 320.335080 /end CHARACTERISTIC
/begin CHARACTERISTIC UPWGKDO "Oberer Hysterese-Schaltpunkt zur Kick-Down-Erkennung aus Potispannung" VALUE 0x81ADA8 ME7_FW3 0 spg_uw_q0p004888 0.000000 320.335000 EXTENDED_LIMITS 0.000000 320.335080 /end CHARACTERISTIC
/begin CHARACTERISTIC UPWGKDU "Unterer Hysterese-Schaltpunkt zur Kick-Down-Erkennung aus Potispannung" VALUE 0x81ADAA ME7_FW3 0 spg_uw_q0p004888 0.000000 320.335000 EXTENDED_LIMITS 0.000000 320.335080 /end CHARACTERISTIC
/begin CHARACTERISTIC UPWGO "Oberer PWG-Spannungswert fÅr Umnormierung auf Pedalwert" VALUE 0x814DCA ME7_FW1 0 spg_ub_b5 0.000000 4.980470 EXTENDED_LIMITS 0.000000 4.980469 /end CHARACTERISTIC
/begin CHARACTERISTIC UPWGTG "PWG-Spannungsschwelle fÅr Teilgasbereich" VALUE 0x814DCB ME7_FW1 0 spg_ub_b5 0.000000 4.980470 EXTENDED_LIMITS 0.000000 4.980469 /end CHARACTERISTIC
/begin CHARACTERISTIC UPWGTL "Teillastschwelle der PWG-Spannung in HochohmigkeitsprÅfung" VALUE 0x814DCC ME7_FW1 0 spg_ub_b5 0.000000 4.980470 EXTENDED_LIMITS 0.000000 4.980469 /end CHARACTERISTIC
/begin CHARACTERISTIC UPWGU "Unterer PWG-Spannungswert fÅr Umnormierung auf Pedalwert" VALUE 0x814DCD ME7_FW1 0 spg_ub_b5 0.000000 4.980470 EXTENDED_LIMITS 0.000000 4.980469 /end CHARACTERISTIC
/begin CHARACTERISTIC UPWGUBF "Unterer Spannungswert zur Umnormierung bei erkanntem Bewegungsfehler" VALUE 0x814DCE ME7_FW1 0 spg_ub_b5 0.000000 4.980470 EXTENDED_LIMITS 0.000000 4.980469 /end CHARACTERISTIC
/begin CHARACTERISTIC UPWGUR "Reduzierter unterer PWG-Spannungswert fÅr Umnormierung auf Pedalwert" VALUE 0x814DCF ME7_FW1 0 spg_ub_b5 0.000000 4.980470 EXTENDED_LIMITS 0.000000 4.980469 /end CHARACTERISTIC
/begin CHARACTERISTIC UPWGVG "PWG-Spannungsschwelle fÅr Vollgasbereich" VALUE 0x814DD0 ME7_FW1 0 spg_ub_b5 0.000000 4.980470 EXTENDED_LIMITS 0.000000 4.980469 /end CHARACTERISTIC
/begin CHARACTERISTIC UPWKDDF "Defaultwert PWG-Poti-Spannung fÅr gelernte Kick-Down-Position" VALUE 0x810C4C ME7_FW3 0 spg_uw_q0p004888 0.000000 320.335000 EXTENDED_LIMITS 0.000000 320.335080 /end CHARACTERISTIC
/begin CHARACTERISTIC USDBO "obere Schwelle f. Erk. Adernschlu· und defekte Sonde mit begrenztem Spannungshub" VALUE 0x810BEA ME7_FW3 0 spg_uw_q0p00488_o1 -1.000000 318.995000 EXTENDED_LIMITS -1.000000 318.995117 /end CHARACTERISTIC
/begin CHARACTERISTIC USDBU "untere Schwelle f. Erk. Adernschlu· u. defekte Sonde mit begrenztem Spannungshub" VALUE 0x810BEC ME7_FW3 0 spg_uw_q0p00488_o1 -1.000000 318.995000 EXTENDED_LIMITS -1.000000 318.995117 /end CHARACTERISTIC
/begin CHARACTERISTIC USFHK "Sondenspannungsschwelle fÅr Erkennung fett hinter Kat" VALUE 0x810BEE ME7_FW3 0 spg_uw_q0p00488_o1 -1.000000 318.995000 EXTENDED_LIMITS -1.000000 318.995117 /end CHARACTERISTIC
/begin CHARACTERISTIC USHKAMN "Sondenspannung hinter Kat fÅr Erkennung Kat ist mit O2 gefÅllt" VALUE 0x815E94 ME7_FW1 0 spg_ub_q0p0052_o0p2 -0.200000 1.130000 /end CHARACTERISTIC
/begin CHARACTERISTIC USHKAMX "Sondenspannung hinter Kat fÅr Abbruch Kat-AusrÑumen" VALUE 0x815E95 ME7_FW1 0 spg_ub_q0p0052_o0p2 -0.200000 1.130000 /end CHARACTERISTIC
/begin CHARACTERISTIC USHLEAN "Schwelle fÅr Magerspannung fÅr ungÅltige Dynamikmessung der Sonde hinter KAT" VALUE 0x8184C4 ME7_FW1 0 spg_ub_q0p0052_o0p2 -0.200000 1.130000 /end CHARACTERISTIC
/begin CHARACTERISTIC USHOV "obere Sondenspannungs-Schwelle fÅr maximale Sondenheizung vor Kat" VALUE 0x81AD7C ME7_FW3 0 spg_uw_q0p00488_o1 -1.000000 318.995000 EXTENDED_LIMITS -1.000000 318.995117 /end CHARACTERISTIC
/begin CHARACTERISTIC USHRICH "Schwelle fÅr Fettspannung fÅr gÅltige Dynamikmessung der Sonde hinter KAT" VALUE 0x8184C5 ME7_FW1 0 spg_ub_q0p0052_o0p2 -0.200000 1.130000 /end CHARACTERISTIC
/begin CHARACTERISTIC USHSTGMX "Wert fÅr maximale Steigung fÅr Startwert Filter" VALUE 0x8184C6 ME7_FW1 0 spgg_q0p52 0.000000 132.600000 /end CHARACTERISTIC
/begin CHARACTERISTIC USHSTSOLL "Schwelle fÅr zulÑssige Steigung der Sondenspannung hinter KAT" VALUE 0x8184C7 ME7_FW1 0 spgg_q0p52 0.000000 132.600000 /end CHARACTERISTIC
/begin CHARACTERISTIC USHUV "untere Sondenspannungs-Schwelle fÅr maximale Sondenheizung vor Kat" VALUE 0x81AD7E ME7_FW3 0 spg_uw_q0p00488_o1 -1.000000 318.995000 EXTENDED_LIMITS -1.000000 318.995117 /end CHARACTERISTIC
/begin CHARACTERISTIC USMASO "Sondenspannungsschwelle fÅr gemeinsame Sondenmasse offen" VALUE 0x810BF0 ME7_FW3 0 spg_uw_q0p00488_o1 -1.000000 318.995000 EXTENDED_LIMITS -1.000000 318.995117 /end CHARACTERISTIC
/begin CHARACTERISTIC USMAX "Schwelle fÅr Sondenkurzschlu· nach Ubat" VALUE 0x810BAC ME7_FW3 0 spg_uw_q0p00488_o1 -1.000000 318.995000 EXTENDED_LIMITS -1.000000 318.995117 /end CHARACTERISTIC
/begin CHARACTERISTIC USMHK "Sondenspannungsschwelle fÅr Erkennung mager hinter Kat" VALUE 0x810BF2 ME7_FW3 0 spg_uw_q0p00488_o1 -1.000000 318.995000 EXTENDED_LIMITS -1.000000 318.995117 /end CHARACTERISTIC
/begin CHARACTERISTIC USMIN "Schwelle fÅr Sondenkurzschlu· nach Masse" VALUE 0x810BAE ME7_FW3 0 spg_uw_q0p00488_o1 -1.000000 318.995000 EXTENDED_LIMITS -1.000000 318.995117 /end CHARACTERISTIC
/begin CHARACTERISTIC USMNSAMN "min. erkannte Sondenspannung fÅr Signalausgabe (min. plaus. Wert)" VALUE 0x8188E0 ME7_FW1 0 spg_ub_b1p33 0.000000 1.330000 /end CHARACTERISTIC
/begin CHARACTERISTIC USMNSAMX "min. erkannte Sondenspannung fÅr Signalausgabe (max. plaus. Wert)" VALUE 0x8188E1 ME7_FW1 0 spg_ub_b1p33 0.000000 1.330000 /end CHARACTERISTIC
/begin CHARACTERISTIC USMNSHMN "min. erkannte Sondenspannung hinter Kat fÅr Signalausgabe (min. plaus. Wert)" VALUE 0x8188E2 ME7_FW1 0 spg_ub_b1p33 0.000000 1.330000 /end CHARACTERISTIC
/begin CHARACTERISTIC USMNSHMX "min. erkannte Sondenspannung hinter Kat fÅr Signalausgabe (max. plaus. Wert)" VALUE 0x8188E3 ME7_FW1 0 spg_ub_b1p33 0.000000 1.330000 /end CHARACTERISTIC
/begin CHARACTERISTIC USMXSAMN "max. erkannte Sondenspannung fÅr Signalausgabe (min. plaus. Wert)" VALUE 0x8188E4 ME7_FW1 0 spg_ub_b1p33 0.000000 1.330000 /end CHARACTERISTIC
/begin CHARACTERISTIC USMXSAMX "max. erkannte Sondenspannung fÅr Signalausgabe (max. plaus. Wert)" VALUE 0x8188E5 ME7_FW1 0 spg_ub_b1p33 0.000000 1.330000 /end CHARACTERISTIC
/begin CHARACTERISTIC USMXSHMN "max. erkannte Sondenspannung hinter Kat fÅr Signalausgabe (min. plaus. Wert)" VALUE 0x8188E6 ME7_FW1 0 spg_ub_b1p33 0.000000 1.330000 /end CHARACTERISTIC
/begin CHARACTERISTIC USMXSHMX "max. erkannte Sondenspannung hinter Kat fÅr Signalausgabe (max. plaus. Wert)" VALUE 0x8188E7 ME7_FW1 0 spg_ub_b1p33 0.000000 1.330000 /end CHARACTERISTIC
/begin CHARACTERISTIC USR "Regelschwelle fÅr Regelung vor Kat" VALUE 0x815EDF ME7_FW1 0 spg_ub_q0p0052_o0p2 -0.200000 1.130000 /end CHARACTERISTIC
/begin CHARACTERISTIC USREF "Schwelle fÅr Sondenbetriebsbereitschaft bei fettem Gemisch (vor KAT)" VALUE 0x810BF4 ME7_FW3 0 spg_uw_q0p00488_o1 -1.000000 318.995000 EXTENDED_LIMITS -1.000000 318.995117 /end CHARACTERISTIC
/begin CHARACTERISTIC USREFH "Schwelle fÅr Sondenbetriebsbereitschaft hinter KAT bei fettem Gemisch" VALUE 0x810BB0 ME7_FW3 0 spg_uw_q0p00488_o1 -1.000000 318.995000 EXTENDED_LIMITS -1.000000 318.995117 /end CHARACTERISTIC
/begin CHARACTERISTIC USREM "Schwelle fÅr Sondenbetriebsbereitschaft bei magerem Gemisch (vor KAT)" VALUE 0x810BF6 ME7_FW3 0 spg_uw_q0p00488_o1 -1.000000 318.995000 EXTENDED_LIMITS -1.000000 318.995117 /end CHARACTERISTIC
/begin CHARACTERISTIC USREMH "Schwelle fÅr Sondenbetriebsbereitschaft hinter KAT bei magerem Gemisch" VALUE 0x810BB2 ME7_FW3 0 spg_uw_q0p00488_o1 -1.000000 318.995000 EXTENDED_LIMITS -1.000000 318.995117 /end CHARACTERISTIC
/begin CHARACTERISTIC USRHKSHJ "Regelschwelle fÅr Regelung hinter Kat, DLSSA-Ausgabe umgerechn. Wert" VALUE 0x8188E8 ME7_FW1 0 spg_ub_b1p33 0.000000 1.330000 /end CHARACTERISTIC
/begin CHARACTERISTIC USRIMINH "Mindest Spannungs-Schwelle fÅr Ri-Messung der Sonde hinter KAT" VALUE 0x810BC4 ME7_FW3 0 spg_uw_q0p00488_o1 -1.000000 318.995000 EXTENDED_LIMITS -1.000000 318.995117 /end CHARACTERISTIC
/begin CHARACTERISTIC USRIMINV "Mindest Spannungs-Schwelle fÅr Ri-Messung der Sonde vor KAT" VALUE 0x810BD8 ME7_FW3 0 spg_uw_q0p00488_o1 -1.000000 318.995000 EXTENDED_LIMITS -1.000000 318.995117 /end CHARACTERISTIC
/begin CHARACTERISTIC USRIOH "Obere Spannungs-Schwelle fÅr Ri-Messung der Sonde hinter KAT" VALUE 0x810BC6 ME7_FW3 0 spg_uw_q0p00488_o1 -1.000000 318.995000 EXTENDED_LIMITS -1.000000 318.995117 /end CHARACTERISTIC
/begin CHARACTERISTIC USRIOV "Obere Spannungs-Schwelle fÅr Ri-Messung der Sonde vor KAT" VALUE 0x810BDA ME7_FW3 0 spg_uw_q0p00488_o1 -1.000000 318.995000 EXTENDED_LIMITS -1.000000 318.995117 /end CHARACTERISTIC
/begin CHARACTERISTIC USRIUH "Untere Spannungs-Schwelle fÅr Ri-Messung der Sonde hinter KAT" VALUE 0x810BC8 ME7_FW3 0 spg_uw_q0p00488_o1 -1.000000 318.995000 EXTENDED_LIMITS -1.000000 318.995117 /end CHARACTERISTIC
/begin CHARACTERISTIC USRIUV "Untere Spannungs-Schwelle fÅr Ri-Messung der Sonde vor KAT" VALUE 0x810BDC ME7_FW3 0 spg_uw_q0p00488_o1 -1.000000 318.995000 EXTENDED_LIMITS -1.000000 318.995117 /end CHARACTERISTIC
/begin CHARACTERISTIC USSCHUB "Schwelle fÅr Sondenspannung hinter KAT nach Schub" VALUE 0x8184C8 ME7_FW1 0 spg_ub_q0p0052_o0p2 -0.200000 1.130000 /end CHARACTERISTIC
/begin CHARACTERISTIC USVKAMX "Sondenspannung vor Kat fÅr Erkennung Magerbedingung Kat-AusrÑumen" VALUE 0x815E96 ME7_FW1 0 spg_ub_q0p0052_o0p2 -0.200000 1.130000 /end CHARACTERISTIC
/begin CHARACTERISTIC VABSCH "Vmax-Regler-Abschaltschwelle, variantenkodiert" VALUE 0x813478 ME7_FW3 0 vfzg_uw_q0p00781 0.000000 511.992000 EXTENDED_LIMITS 0.000000 511.992188 /end CHARACTERISTIC
/begin CHARACTERISTIC VALDPMN "minimale Fahrzeuggeschwindigkeit bei Aktivierung DLDP" VALUE 0x815E84 ME7_FW1 0 vfzg_ub_q1p25___UB 0.000000 318.750000 /end CHARACTERISTIC
/begin CHARACTERISTIC VANF "Geschwindigkeitsschwelle fÅr Anfahrhilfe" VALUE 0x815666 ME7_FW1 0 vfzg_ub_q1p25___UB 0.000000 318.750000 /end CHARACTERISTIC
/begin CHARACTERISTIC VARAU_0_A "minimale Fahrzeuggeschwindigkeit fÅr ARA - Funktion" VALUE 0x817290 ME7_FW1 0 fak_ub_b318p75 0.000000 317.505000 EXTENDED_LIMITS 0.000000 317.504883 /end CHARACTERISTIC
/begin CHARACTERISTIC VARAU_1_A "minimale Fahrzeuggeschwindigkeit fÅr ARA - Funktion" VALUE 0x817291 ME7_FW1 0 fak_ub_b318p75 0.000000 317.505000 EXTENDED_LIMITS 0.000000 317.504883 /end CHARACTERISTIC
/begin CHARACTERISTIC VARAU_2_A "minimale Fahrzeuggeschwindigkeit fÅr ARA - Funktion" VALUE 0x817292 ME7_FW1 0 fak_ub_b318p75 0.000000 317.505000 EXTENDED_LIMITS 0.000000 317.504883 /end CHARACTERISTIC
/begin CHARACTERISTIC VARAU_3_A "minimale Fahrzeuggeschwindigkeit fÅr ARA - Funktion" VALUE 0x817293 ME7_FW1 0 fak_ub_b318p75 0.000000 317.505000 EXTENDED_LIMITS 0.000000 317.504883 /end CHARACTERISTIC
/begin CHARACTERISTIC VARDEF "Default Variante fÅr Variantencodierung" VALUE 0x81226A ME7_FW3 0 dez___UW 0.000000 32767.000000 EXTENDED_LIMITS 0.000000 65535.000000 /end CHARACTERISTIC
/begin CHARACTERISTIC VARTAB "Tabelle der zulÑ·igen Varianten" VAL_BLK 0x81D9F2 ME7_FWB3 0 dez___UW 0.000000 32767.000000 NUMBER 416 EXTENDED_LIMITS 0.000000 65535.000000 /end CHARACTERISTIC
/begin CHARACTERISTIC VBGFGRAQ "Geschwindigkeit Bereichsgrenze bei Aquaplaningerkennung" VALUE 0x810D00 ME7_FW3 0 vfzg_uw_b512 0.000000 511.992000 EXTENDED_LIMITS 0.000000 511.992188 /end CHARACTERISTIC
/begin CHARACTERISTIC VDASH "Mindestgeschwindigkeit fÅr Dashpot" VALUE 0x815706 ME7_FW1 0 vfzg_ub_q1p25___UB 0.000000 318.750000 /end CHARACTERISTIC
/begin CHARACTERISTIC VDKUPPLMN "min. vfzg-Schwelle fÅr Diagnose Kupplungsschalter" VALUE 0x81859A ME7_FW1 0 vfzg_ub_q1p25___UB 0.000000 318.750000 /end CHARACTERISTIC
/begin CHARACTERISTIC VDMN "Geschwindigkeitsschwelle; Fehlererkennung Geschwindigkeitssignal" VALUE 0x81ADA2 ME7_FW3 0 vfzg_uw_b512 0.000000 511.992000 EXTENDED_LIMITS 0.000000 511.992188 /end CHARACTERISTIC
/begin CHARACTERISTIC VFGRMAX "Maximal zulÑssige Geschwindigkeit im FGR-Betrieb" VALUE 0x810D02 ME7_FW3 0 vfzg_uw_b512 0.000000 511.992000 EXTENDED_LIMITS 0.000000 511.992188 /end CHARACTERISTIC
/begin CHARACTERISTIC VFGRMIN "Minimal zulÑssige Geschwindigkeit im FGR-Betrieb" VALUE 0x810D04 ME7_FW3 0 vfzg_uw_b512 0.000000 511.992000 EXTENDED_LIMITS 0.000000 511.992188 /end CHARACTERISTIC
/begin CHARACTERISTIC VFZGADMD "Fahrzeuggeschw.schwelle zum Ausblenden DMD bei aktivem Bremseingriff" VALUE 0x8183A1 ME7_FW1 0 vfzg_ub_q1p25___UB 0.000000 318.750000 /end CHARACTERISTIC
/begin CHARACTERISTIC VFZG_DAT_UC "" VAL_BLK 0x813494 ME7_FWB3 0 vfzg_uw_q0p00781 0.000000 511.992000 NUMBER 16 EXTENDED_LIMITS 0.000000 511.992188 /end CHARACTERISTIC
/begin CHARACTERISTIC VFZMN "Erkennen Fahren-Stehen" VALUE 0x810006 ME7_FW3 0 vfzg_uw_b512 0.000000 511.992000 EXTENDED_LIMITS 0.000000 511.992188 /end CHARACTERISTIC
/begin CHARACTERISTIC VHYST "Vmax-Hystereseschwelle, variantenkodiert" VALUE 0x81347A ME7_FW3 0 vfzg_uw_q0p00781 0.000000 511.992000 EXTENDED_LIMITS 0.000000 511.992188 /end CHARACTERISTIC
/begin CHARACTERISTIC VKOAO "Obere Geschwindigkeitsschwelle fÅr Kompressorabschaltung" VALUE 0x8164BE ME7_FW1 0 vfzg_ub_q1p25___UB 0.000000 318.750000 /end CHARACTERISTIC
/begin CHARACTERISTIC VKOB "Geschwindinkeitschwelle fÅr Ko-Steuerung in Beschleunigung" VALUE 0x8164BF ME7_FW1 0 vfzg_ub_q1p25___UB 0.000000 318.750000 /end CHARACTERISTIC
/begin CHARACTERISTIC VLDPMN "Min. Geschwindigkeit fÅr Grobleckverifikation" VALUE 0x815E85 ME7_FW1 0 vfzg_ub_q1p25___UB 0.000000 318.750000 /end CHARACTERISTIC
/begin CHARACTERISTIC VLLR "Fahrzeuggeschwindigkeitsschwelle fÅr Leerlaufregelung" VALUE 0x8155F2 ME7_FW1 0 vfzg_ub_q1p25___UB 0.000000 318.750000 /end CHARACTERISTIC
/begin CHARACTERISTIC VLMXVZ_0_A "Maximalwert fÅr vlast_w" CURVE 0x81AF5A ZF_KL111 0 vfzg_uw_b512 0.007812 511.992000
 /begin AXIS_DESCR STD_AXIS vziel_w vfzg_uw_b512 6 0.000000 511.992000 DEPOSIT ABSOLUTE /end AXIS_DESCR
 EXTENDED_LIMITS 0.000000 511.992188 /end CHARACTERISTIC
/begin CHARACTERISTIC VLMXVZ_1_A "Maximalwert fÅr vlast_w" CURVE 0x81AF74 ZF_KL111 0 vfzg_uw_b512 0.007812 511.992000
 /begin AXIS_DESCR STD_AXIS vziel_w vfzg_uw_b512 6 0.000000 511.992000 DEPOSIT ABSOLUTE /end AXIS_DESCR
 EXTENDED_LIMITS 0.000000 511.992188 /end CHARACTERISTIC
/begin CHARACTERISTIC VLSD "Mindestgeschwindigkeit fÅr LastschlagdÑmpfung" VALUE 0x815707 ME7_FW1 0 vfzg_ub_q1p25___UB 0.000000 318.750000 /end CHARACTERISTIC
/begin CHARACTERISTIC VMAXO "Vmax-Begrenzungswert (Linie mit 16 Varianten)" VALUE 0x81347C ME7_FW3 0 vfzg_uw_q0p00781 0.000000 511.992000 EXTENDED_LIMITS 0.000000 511.992188 /end CHARACTERISTIC
/begin CHARACTERISTIC VMAXP "P-Glied bei VMAX-Regelung" VALUE 0x815A63 ME7_FW1 0 rel_ub_q0p391 0.000000 99.705000 /end CHARACTERISTIC
/begin CHARACTERISTIC VMDUB "Geschwindigkeitsschwelle min. fÅr Batteriespannungs-Diagnose" VALUE 0x814DAA ME7_FW1 0 vfzg_ub_q1p25___UB 0.000000 318.750000 /end CHARACTERISTIC
/begin CHARACTERISTIC VMINAMSR "Geschwindigkeitschwelle fÅr plausiblen MSR-Eingriff" VALUE 0x810184 ME7_FW3 0 vfzg_uw_b325 0.000000 324.995000 EXTENDED_LIMITS 0.000000 324.995041 /end CHARACTERISTIC
/begin CHARACTERISTIC VMIN_UC "" VALUE 0x8134B4 ME7_FW3 0 vfzg_uw_q0p00781 0.000000 511.992000 EXTENDED_LIMITS 0.000000 511.992188 /end CHARACTERISTIC
/begin CHARACTERISTIC VMIN_UM "Minimalgeschwindigkeit fÅr FGR-Betrieb in der FunktionsÅberwachung" VALUE 0x81421A ME7_FW3 0 vfzg_uw_q0p00781 0.000000 511.992000 EXTENDED_LIMITS 0.000000 511.992188 /end CHARACTERISTIC
/begin CHARACTERISTIC VNMX "Geschwindigkeitsschwelle fÅr Aktivierung der erhîhten Drehzahlschwelle" VALUE 0x815982 ME7_FW1 0 vfzg_ub_q1p25___UB 0.000000 318.750000 /end CHARACTERISTIC
/begin CHARACTERISTIC VNVKO "Gangerkennungschwelle fÅr KO-Auschalten bei Vollast" VALUE 0x813A02 ME7_FW3 0 qnv_uw_b512 0.000000 511.992000 EXTENDED_LIMITS 0.000000 511.992188 /end CHARACTERISTIC
/begin CHARACTERISTIC VREGLMAX "Maximal zulÑssige Sollgeschwindigkeit fÅr FGR" VALUE 0x810D06 ME7_FW3 0 vfzg_uw_b512 0.000000 511.992000 EXTENDED_LIMITS 0.000000 511.992188 /end CHARACTERISTIC
/begin CHARACTERISTIC VREGLMIN "Minimal zulÑssige Sollgeschwindigkeit fÅr FGR" VALUE 0x810D08 ME7_FW3 0 vfzg_uw_b512 0.000000 511.992000 EXTENDED_LIMITS 0.000000 511.992188 /end CHARACTERISTIC
/begin CHARACTERISTIC VRFGRMN "Untere Schwelle vroh_w fÅr FGR-Abschaltung Åber vfzg_w = 0" VALUE 0x810008 ME7_FW3 0 vfzg_uw_b512 0.000000 511.992000 EXTENDED_LIMITS 0.000000 511.992188 /end CHARACTERISTIC
/begin CHARACTERISTIC VSAA "Geschwindigkeitsschwelle fÅr SA-Drehzahlanhebung" VALUE 0x815537 ME7_FW1 0 vfzg_ub_q1p25___UB 0.000000 318.750000 /end CHARACTERISTIC
/begin CHARACTERISTIC VSL "Fahrzeuggeschwindigkeitsschwelle fÅr Kompensation Servolenkung" VALUE 0x81982A ME7_FW1 0 vfzg_ub_q1p25___UB 0.000000 318.750000 /end CHARACTERISTIC
/begin CHARACTERISTIC VSLS "Schwelle Fahrzeuggeschwindigkeit fÅr SLS ein" VALUE 0x818369 ME7_FW1 0 vfzg_ub_q1p25___UB 0.000000 318.750000 /end CHARACTERISTIC
/begin CHARACTERISTIC VTUMTA "Schwelle Fahrzeuggeschwindigkeit fÅr Bestimmung Umgebungstemperatur" VALUE 0x818E14 ME7_FW1 0 vfzg_ub_q1p25___UB 0.000000 318.750000 /end CHARACTERISTIC
/begin CHARACTERISTIC VTUMTAT "Schwelle Fahrzeuggeschwindigkeit fÅr TANS -> Umgebungstemperatur" VALUE 0x8184A9 ME7_FW1 0 vfzg_ub_q1p25___UB 0.000000 318.750000 /end CHARACTERISTIC
/begin CHARACTERISTIC VVORH "Vmax-Vorhaltschwelle, variantenkodiert" VALUE 0x81347E ME7_FW3 0 vfzg_uw_q0p00781 0.000000 511.992000 EXTENDED_LIMITS 0.000000 511.992188 /end CHARACTERISTIC
/begin CHARACTERISTIC VVR_AOG "oberer Grenzwert Anpassung V-Verriegelung" VALUE 0x815482 ME7_FW2 0 vfzg_q1p0___SB -128.000000 127.000000 /end CHARACTERISTIC
/begin CHARACTERISTIC VVR_AUG "unterer Grenzwert Anpassung V-Verriegelung" VALUE 0x815483 ME7_FW2 0 vfzg_q1p0___SB -128.000000 127.000000 /end CHARACTERISTIC
/begin CHARACTERISTIC VWPMBBR "Mindestgeschwindigkeit fÅr Pedalwertbegrenzung bei betÑtigter Bremse" VALUE 0x814DD1 ME7_FW1 0 vfzg_ub_q1p25___UB 0.000000 318.750000 /end CHARACTERISTIC
/begin CHARACTERISTIC WAD0T1 "Wichtungsfaktor Adaptionsbereich 0 zu 1" VALUE 0x815216 ME7_FW1 0 fak_ub_b16 0.000000 15.937500 /end CHARACTERISTIC
/begin CHARACTERISTIC WAD0T2 "Wichtungsfaktor Adaptionsbereich 0 zu 2" VALUE 0x815217 ME7_FW1 0 fak_ub_b16 0.000000 15.937500 /end CHARACTERISTIC
/begin CHARACTERISTIC WAD1T0 "Wichtungsfaktor Adaptionsbereich 1 zu 0" VALUE 0x815218 ME7_FW1 0 fak_ub_b16 0.000000 15.937500 /end CHARACTERISTIC
/begin CHARACTERISTIC WAD1T2 "Wichtungsfaktor Adaptionsbereich 1 zu 2" VALUE 0x815219 ME7_FW1 0 fak_ub_b16 0.000000 15.937500 /end CHARACTERISTIC
/begin CHARACTERISTIC WAD2T0 "Wichtungsfaktor Adaptionsbereich 2 zu 0" VALUE 0x81521A ME7_FW1 0 fak_ub_b16 0.000000 15.937500 /end CHARACTERISTIC
/begin CHARACTERISTIC WAD2T1 "Wichtungsfaktor Adaptionsbereich 2 zu 1" VALUE 0x81521B ME7_FW1 0 fak_ub_b16 0.000000 15.937500 /end CHARACTERISTIC
/begin CHARACTERISTIC WAIT_T_UM "Wartezeit fÅr Reset-TastverhÑltnis aus der FunktionsÅberwachung" VALUE 0x814214 ME7_FW3 0 t_wdt_high 0.000000 9999.160000 EXTENDED_LIMITS 0.000000 107372.467035 /end CHARACTERISTIC
/begin CHARACTERISTIC WDKARN "DK-Winkel-Schwelle fÅr Gemischadaption aktiv" CURVE 0x818CCD ME7_KL97 0 rel_ub_b99p6 0.000000 99.609400
 /begin AXIS_DESCR STD_AXIS nmot nmot_ub_q40 10 0.000000 10200.000000 DEPOSIT ABSOLUTE /end AXIS_DESCR
 EXTENDED_LIMITS 0.000000 99.609375 /end CHARACTERISTIC
/begin CHARACTERISTIC WDKBEWS "Schwelle zur DK-Bewegungserkennung (I-Klein)" VALUE 0x810CE0 ME7_FW4 0 relDK_q0p02441 -800.000000 799.976000 EXTENDED_LIMITS -800.000000 799.975586 /end CHARACTERISTIC
/begin CHARACTERISTIC WDKDSVLU "Drosselklappenschwelle fÅr Drucksensorplausibilisierung" CURVE 0x818613 ME7_KL97 0 relDK_ub_b100 0.000000 100.000000
 /begin AXIS_DESCR STD_AXIS nmot nmot_ub_q40 6 0.000000 10200.000000 DEPOSIT ABSOLUTE /end AXIS_DESCR
/end CHARACTERISTIC
/begin CHARACTERISTIC WDKETE "Obere Grenze fÅr DK-Sollwert bei erweiterter Stellertauscherkennung" VALUE 0x810CE2 ME7_FW3 0 relDK_q0p00152___UW 0.000000 99.998500 EXTENDED_LIMITS 0.000000 99.998474 /end CHARACTERISTIC
/begin CHARACTERISTIC WDKFPRO1 "Aschaltschwelle DK-Istwert fÅr îffnende DV-E-FederprÅfung" VALUE 0x810C90 ME7_FW4 0 relDK_q0p02441 -800.000000 799.976000 EXTENDED_LIMITS -800.000000 799.975586 /end CHARACTERISTIC
/begin CHARACTERISTIC WDKFPRO2 "PrÅfschwelle DK-Istwert fÅr îffnende DV-E-FederprÅfung" VALUE 0x810C92 ME7_FW4 0 relDK_q0p02441 -800.000000 799.976000 EXTENDED_LIMITS -800.000000 799.975586 /end CHARACTERISTIC
/begin CHARACTERISTIC WDKFPRZ1 "Abschaltschwelle DK-Istwert fÅr DV-E-RÅckstellfederprÅfung" VALUE 0x810C94 ME7_FW3 0 relDK_uw_b100 0.000000 100.000000 /end CHARACTERISTIC
/begin CHARACTERISTIC WDKFPRZ2 "PrÅfschwelle DK-Istwert fÅr DV-E-RÅckstellfederprÅfung" VALUE 0x810C96 ME7_FW3 0 relDK_uw_b100 0.000000 100.000000 /end CHARACTERISTIC
/begin CHARACTERISTIC WDKNLPMA "oberer erlaubter Istwert fÅr NLP-Stellung" VALUE 0x810C98 ME7_FW3 0 relDK_uw_b100 0.000000 100.000000 /end CHARACTERISTIC
/begin CHARACTERISTIC WDKNLPMI "unterer erlaubter Istwert fÅr NLP-Stellung" VALUE 0x810C9A ME7_FW3 0 relDK_uw_b100 0.000000 100.000000 /end CHARACTERISTIC
/begin CHARACTERISTIC WDKNLPTOL "zulÑssige DK-Winkel-Toleranz des NLP" VALUE 0x810CE4 ME7_FW3 0 relDK_uw_b100 0.000000 100.000000 /end CHARACTERISTIC
/begin CHARACTERISTIC WDKPMXN "Maximaler Drosselklappenwinkel fÅr Plausibilisierung mit FÅllungssignal" CURVE 0x814E9E ME7_KL97 0 relDK_ub_b100 0.000000 100.000000
 /begin AXIS_DESCR STD_AXIS nmot nmot_ub_q40 12 0.000000 10200.000000 DEPOSIT ABSOLUTE /end AXIS_DESCR
/end CHARACTERISTIC
/begin CHARACTERISTIC WDKREIB "Haftreibungsanteil der DK fÅr I-Klein" VALUE 0x814F5C ME7_FW1 0 fak_ub_b1 0.000000 0.996094 /end CHARACTERISTIC
/begin CHARACTERISTIC WDKSAPNOL "DK-Sollwert bei Applikationshilfe DK-Notluftfahren" VALUE 0x810CE6 ME7_FW3 0 relDK_q0p00152___UW 0.000000 99.998500 EXTENDED_LIMITS 0.000000 99.998474 /end CHARACTERISTIC
/begin CHARACTERISTIC WDKSAPP "Drosselklappensollwert fÅr Applikationszwecke" VALUE 0x811BAC ME7_FW3 0 rel_uw_b100 0.000000 99.998500 EXTENDED_LIMITS 0.000000 99.998474 /end CHARACTERISTIC
/begin CHARACTERISTIC WDKSFPR "DK-Sollwert fÅr DV-E-RÅckstellfederprÅfung" VALUE 0x810C9C ME7_FW3 0 relDK_uw_b100 0.000000 100.000000 /end CHARACTERISTIC
/begin CHARACTERISTIC WDKSFPRO "DK-Sollwert fÅr îffnende DV-E-FederprÅfung" VALUE 0x810C9E ME7_FW3 0 relDK_uw_b100 0.000000 100.000000 /end CHARACTERISTIC
/begin CHARACTERISTIC WDKSTFEIN "Schwelle zur StationaritÑtserkennung (verstÑrkter Bereich)" VALUE 0x810CE8 ME7_FW4 0 relDK_q0p02441 -800.000000 799.976000 EXTENDED_LIMITS -800.000000 799.975586 /end CHARACTERISTIC
/begin CHARACTERISTIC WDKSTGROB "Schwelle zur StationaritÑtserkennung (unverstÑrkter Bereich)" VALUE 0x810CEA ME7_FW4 0 relDK_q0p02441 -800.000000 799.976000 EXTENDED_LIMITS -800.000000 799.975586 /end CHARACTERISTIC
/begin CHARACTERISTIC WDKSTMUMA "DK-Winkel-Schwelle fÅr temporÑre UMA-Adaption" VALUE 0x810CA0 ME7_FW3 0 relDK_uw_b100 0.000000 100.000000 /end CHARACTERISTIC
/begin CHARACTERISTIC WDKUGDN "KL Drosselklappenwinkel, ab der keine Drosselung mehr erfolgt" CURVE 0x811800 ME7_GKL3 0 rel_uw_b100 0.000000 99.998500
 /begin AXIS_DESCR COM_AXIS nmot nmot_ub_q40 0 0.000000 10200.000000 AXIS_PTS_REF SNM12FEUB /end AXIS_DESCR
 EXTENDED_LIMITS 0.000000 99.998474 /end CHARACTERISTIC
/begin CHARACTERISTIC WEAN "Winkel Einspritzabbruch" CURVE 0x818AAE ME7_GKL1 0 zw_ub_q6 0.000000 1530.000000
 /begin AXIS_DESCR COM_AXIS nmot nmot_ub_q40 0 0.000000 10200.000000 AXIS_PTS_REF SNM08GKUB /end AXIS_DESCR
/end CHARACTERISTIC
/begin CHARACTERISTIC WEEM "Vorlagerungswinkel - Korrektur" CURVE 0x818AB6 ME7_KL97 0 zw_ub_q6 0.000000 1530.000000
 /begin AXIS_DESCR STD_AXIS tmot temp_ub_q0p75_o48 8 -48.000000 143.250000 DEPOSIT ABSOLUTE /end AXIS_DESCR
/end CHARACTERISTIC
/begin CHARACTERISTIC WEEMRFAN "Winkel Einspritzende bei maximalem Fahrerwunsch" CURVE 0x818AC7 ME7_GKL1 0 zw_ub_q6 0.000000 1530.000000
 /begin AXIS_DESCR COM_AXIS nmot nmot_ub_q40 0 0.000000 10200.000000 AXIS_PTS_REF SNM08GKUB /end AXIS_DESCR
/end CHARACTERISTIC
/begin CHARACTERISTIC WEESTM "Vorlagerunswinkel-Korrektur im Start" CURVE 0x818ACF ME7_KL97 0 zw_ub_q6 0.000000 1530.000000
 /begin AXIS_DESCR STD_AXIS tmot temp_ub_q0p75_o48 8 -48.000000 143.250000 DEPOSIT ABSOLUTE /end AXIS_DESCR
/end CHARACTERISTIC
/begin CHARACTERISTIC WEESTN "Winkel Einspritzende im Start" CURVE 0x818AE0 ME7_KL97 0 zw_ub_q6 0.000000 1530.000000
 /begin AXIS_DESCR STD_AXIS nmot nmot_ub_q40 4 0.000000 10200.000000 DEPOSIT ABSOLUTE /end AXIS_DESCR
/end CHARACTERISTIC
/begin CHARACTERISTIC WEESTS "Winkelgrenze Einspritzende fÅr sim. Startauslîsungen" VALUE 0x814FE6 ME7_FW1 0 kw_q2p8125 0.000000 717.188000 EXTENDED_LIMITS 0.000000 717.187500 /end CHARACTERISTIC
/begin CHARACTERISTIC WESBM "Winkel Einla·-schlie·t vor SW-Bezugsmarke (tR)" VALUE 0x814FE7 ME7_FW1 0 kw_q2p8125 0.000000 717.188000 EXTENDED_LIMITS 0.000000 717.187500 /end CHARACTERISTIC
/begin CHARACTERISTIC WESSTO "Offsetwinkel Einspritzung fÅr Schnellstart" VALUE 0x814FE8 ME7_FW1 0 kw_q2p8125 0.000000 717.188000 EXTENDED_LIMITS 0.000000 717.187500 /end CHARACTERISTIC
/begin CHARACTERISTIC WFRL "Kraftstoffwandfilmkennlinie" CURVE 0x811FEE ME7_FKL3 0 rel_uw_b6144 0.000000 6143.910000
 /begin AXIS_DESCR FIX_AXIS rlp_w rel_uw_q0p0234___SL 26 0.000000 155.977000 FIX_AXIS_PAR 0 8 26 /end AXIS_DESCR
 EXTENDED_LIMITS 0.000000 6143.906250 /end CHARACTERISTIC
/begin CHARACTERISTIC WKRLZOF "Festwerteblock: ZW-Offset fÅr gefÅhrte Zylinder" VAL_BLK 0x81542C ME7_FWB1 0 zw_ub_qn0p75 -191.250000 0.000000 NUMBER 8 /end CHARACTERISTIC
/begin CHARACTERISTIC WMABGKH "Faktor fÅr WÑrmemengenkorrektur bei Katheizen fÅr Taupunktende" VALUE 0x8184AA ME7_FW1 0 fak_ub_b1 0.000000 0.996094 /end CHARACTERISTIC
/begin CHARACTERISTIC WNWA "Grenzwinkel fÅr Nockenwellensteller aktiv" VALUE 0x8188D5 ME7_FW2 0 kw_q1 -128.000000 127.000000 /end CHARACTERISTIC
/begin CHARACTERISTIC WNWAFMX "Begrenzung Adaption SpÑtanschlag nach 'frÅh'" VALUE 0x814D65 ME7_FW2 0 kw_q1 -128.000000 127.000000 /end CHARACTERISTIC
/begin CHARACTERISTIC WNWASA "Winkel Ausla·ventil schlie·t am NW-Anschlag" VALUE 0x8188CA ME7_FW2 0 kw_q1 -128.000000 127.000000 /end CHARACTERISTIC
/begin CHARACTERISTIC WNWASMX "Obere Begrenzung Adaption NW-SpÑtanschlag (Richtung spÑt)" VALUE 0x814D66 ME7_FW2 0 kw_q1 -128.000000 127.000000 /end CHARACTERISTIC
/begin CHARACTERISTIC WNWEOA "Winkel Einla·ventil îffnet am NW-Anschlag" VALUE 0x8188CB ME7_FW2 0 kw_q1 -128.000000 127.000000 /end CHARACTERISTIC
/begin CHARACTERISTIC WNWIMXT "theoretisch maximaler wnwi (Winkel Nockenwelle ist)" VALUE 0x8188CC ME7_FW1 0 kw_ub_q0p5 0.000000 127.500000 /end CHARACTERISTIC
/begin CHARACTERISTIC WNWP "Grenzwinkel fÅr Nockenwellensteller passiv" VALUE 0x8188D6 ME7_FW2 0 kw_q1 -128.000000 127.000000 /end CHARACTERISTIC
/begin CHARACTERISTIC WNWSPMN "Grenzwinkel SpÑtverschiebung fÅr Zuordnung Nockenwelle zu Kurbelwelle" VALUE 0x81AC5A ME7_FW4 0 kw_q0p0156 -512.000000 511.984000 EXTENDED_LIMITS -512.000000 511.984375 /end CHARACTERISTIC
/begin CHARACTERISTIC WNWSPMX "Grenzwinkel FrÅhverschiebung fÅr Zuordnung Nockenwelle zu Kurbelwelle" VALUE 0x81AC5C ME7_FW4 0 kw_q0p0156 -512.000000 511.984000 EXTENDED_LIMITS -512.000000 511.984375 /end CHARACTERISTIC
/begin CHARACTERISTIC WNWSPS2_0 "Sollwinkel der Flanke 0 der Nockenwelle 2 in Position SpÑtanschlag" VALUE 0x810B74 ME7_FW3 0 kw_q0p0156___UW 0.000000 1023.980000 EXTENDED_LIMITS 0.000000 1023.984375 /end CHARACTERISTIC
/begin CHARACTERISTIC WNWSPS2_1 "Sollwinkel der Flanke 1 der Nockenwelle 2 in Position SpÑtanschlag" VALUE 0x810B76 ME7_FW3 0 kw_q0p0156___UW 0.000000 1023.980000 EXTENDED_LIMITS 0.000000 1023.984375 /end CHARACTERISTIC
/begin CHARACTERISTIC WNWSPS2_2 "Sollwinkel der Flanke 2 der Nockenwelle 2 in Position SpÑtanschlag" VALUE 0x810B78 ME7_FW3 0 kw_q0p0156___UW 0.000000 1023.980000 EXTENDED_LIMITS 0.000000 1023.984375 /end CHARACTERISTIC
/begin CHARACTERISTIC WNWSPS2_3 "Sollwinkel der Flanke 3 der Nockenwelle 2 in Position SpÑtanschlag" VALUE 0x810B7A ME7_FW3 0 kw_q0p0156___UW 0.000000 1023.980000 EXTENDED_LIMITS 0.000000 1023.984375 /end CHARACTERISTIC
/begin CHARACTERISTIC WNWSPS_0 "Sollwinkel der Flanke 0 der Nockenwelle in Position SpÑtanschlag" VALUE 0x810B7C ME7_FW3 0 kw_q0p0156___UW 0.000000 1023.980000 EXTENDED_LIMITS 0.000000 1023.984375 /end CHARACTERISTIC
/begin CHARACTERISTIC WNWSPS_1 "Sollwinkel der Flanke 1 der Nockenwelle in Position SpÑtanschlag" VALUE 0x810B7E ME7_FW3 0 kw_q0p0156___UW 0.000000 1023.980000 EXTENDED_LIMITS 0.000000 1023.984375 /end CHARACTERISTIC
/begin CHARACTERISTIC WNWSPS_2 "Sollwinkel der Flanke 2 der Nockenwelle in Position SpÑtanschlag" VALUE 0x810B80 ME7_FW3 0 kw_q0p0156___UW 0.000000 1023.980000 EXTENDED_LIMITS 0.000000 1023.984375 /end CHARACTERISTIC
/begin CHARACTERISTIC WNWSPS_3 "Sollwinkel der Flanke 3 der Nockenwelle in Position SpÑtanschlag" VALUE 0x810B82 ME7_FW3 0 kw_q0p0156___UW 0.000000 1023.980000 EXTENDED_LIMITS 0.000000 1023.984375 /end CHARACTERISTIC
/begin CHARACTERISTIC WNWUEMNT "theoretisch minimaler NockenwellenwinkelÅberschneidungswinkel" VALUE 0x8188CD ME7_FW1 0 kw_ub_q0p5 0.000000 127.500000 /end CHARACTERISTIC
/begin CHARACTERISTIC WNWUEMXT "theoretisch maximaler NockenwellenÅberschneidungswinkel" VALUE 0x8188CE ME7_FW1 0 kw_ub_q0p5 0.000000 127.500000 /end CHARACTERISTIC
/begin CHARACTERISTIC WPEDKO "Pedalwinkelschwelle fÅr KO-Auschaltung" CURVE 0x8164C0 ME7_GKL1 0 rel_ub_b100 0.000000 99.609400
 /begin AXIS_DESCR COM_AXIS nmot nmot_ub_q40 0 0.000000 10200.000000 AXIS_PTS_REF SNM08KOUB /end AXIS_DESCR
 EXTENDED_LIMITS 0.000000 99.609375 /end CHARACTERISTIC
/begin CHARACTERISTIC WPFGRBMR "RÅckgerechneter Pedalwert beim Beschleunigen mit FGR" CURVE 0x81B158 ZF_KL111 0 rel_uw_b100 0.000000 99.998500
 /begin AXIS_DESCR STD_AXIS mrfgr_w rel_uw_b200 16 0.000000 199.997000 DEPOSIT ABSOLUTE /end AXIS_DESCR
 EXTENDED_LIMITS 0.000000 99.998474 /end CHARACTERISTIC
/begin CHARACTERISTIC WPHN "Phasengang" CURVE 0x819E32 ME7_GKL2 0 zw_sb_q0p75 -96.000000 95.250000
 /begin AXIS_DESCR COM_AXIS nmot nmot_ub_q40 0 0.000000 10200.000000 AXIS_PTS_REF SNM08__UB /end AXIS_DESCR
/end CHARACTERISTIC
/begin CHARACTERISTIC WPKDMN "Minimaler Pedalwert fÅr Kick-Down-Erkennung" VALUE 0x810C4E ME7_FW3 0 relPED_uw_b100 0.000000 100.000000 /end CHARACTERISTIC
/begin CHARACTERISTIC WPMXBR "Maximal zulÑssiger Pedalwert bei betÑtigter Bremse (vor Erkennung wped = 0)" VALUE 0x810C3A ME7_FW3 0 relPED_uw_b100 0.000000 100.000000 /end CHARACTERISTIC
/begin CHARACTERISTIC WPMXNOT "Maximal zulÑssiger Fahrpedalwert im PWG-Notfahren" VALUE 0x814DD2 ME7_FW1 0 relPED_ub_b100 0.000000 100.000000 /end CHARACTERISTIC
/begin CHARACTERISTIC WPRMX "maximaler PrÑdiktionswinkel" VALUE 0x8151C3 ME7_FW1 0 kw_q6 0.000000 1530.000000 /end CHARACTERISTIC
/begin CHARACTERISTIC WZLDPMX "Max. Anzahl Wiederholversuche nach Unterbrechung bei erkanntem Leck" VALUE 0x815E86 ME7_FW1 0 dez 0.000000 255.000000 /end CHARACTERISTIC
/begin CHARACTERISTIC WZLDPRO "Max. Anzahl Wiederholversuche Reed-Switch Close to Open Check" VALUE 0x815E87 ME7_FW1 0 dez 0.000000 255.000000 /end CHARACTERISTIC
/begin CHARACTERISTIC ZASMASK "Zylinderabschaltmaske fÅr CIFI aus ZAS" VALUE 0x81454F ME7_FW1 0 dez 0.000000 255.000000 /end CHARACTERISTIC
/begin CHARACTERISTIC ZATMAML "Zeitkonstante fuer Abgastemperaturmodell" CURVE 0x81AD06 ME7_GKL3 0 zk200msxs_uw_b13107 0.200003 13107.200000
 /begin AXIS_DESCR COM_AXIS ml_w m_uw_b6553p5 0 0.000000 6553.500000 AXIS_PTS_REF SML07TMUW /end AXIS_DESCR
/end CHARACTERISTIC
/begin CHARACTERISTIC ZATMKML "Zeitkonstante fuer Katalysatortemperaturmodell - Kat-Temperatur" CURVE 0x81AD14 ME7_GKL3 0 zk200msxs_uw_b13107 0.200003 13107.200000
 /begin AXIS_DESCR COM_AXIS ml_w m_uw_b6553p5 0 0.000000 6553.500000 AXIS_PTS_REF SML07TMUW /end AXIS_DESCR
/end CHARACTERISTIC
/begin CHARACTERISTIC ZATMRML "Zeitkonstante fuer Abgastemperaturmodell - Rohrwandtemperatur" CURVE 0x81AD22 ME7_GKL3 0 zk200msxs_uw_b13107 0.200003 13107.200000
 /begin AXIS_DESCR COM_AXIS ml_w m_uw_b6553p5 0 0.000000 6553.500000 AXIS_PTS_REF SML07TMUW /end AXIS_DESCR
/end CHARACTERISTIC
/begin CHARACTERISTIC ZBALM "Abregelfaktor L-Speicher (tmot) BA" CURVE 0x818DFE ME7_GKL1 0 fak_ub_b0p125 0.000000 0.124512
 /begin AXIS_DESCR COM_AXIS tmot temp_ub_q0p75_o48 0 -48.000000 143.250000 AXIS_PTS_REF STM09ESUB /end AXIS_DESCR
/end CHARACTERISTIC
/begin CHARACTERISTIC ZBFIL "Zeitkonstante fÅr Beschleunigungsfilter" VALUE 0x815A64 ME7_FW1 0 zk10msxs_ub_b2p55 0.010000 2.550000 /end CHARACTERISTIC
/begin CHARACTERISTIC ZBRT "Zeitkonstante fÅr Brennraumtempmodell" VALUE 0x8186CD ME7_FW1 0 zk100msxs_ub_b25p5 0.100392 25.600000 /end CHARACTERISTIC
/begin CHARACTERISTIC ZBTEML "Integrationsgeschwindigkeit Beladungsfaktor" CURVE 0x819B6C ME7_GKL1 0 perio_ub_b6p125 0.000000 6.101070
 /begin AXIS_DESCR COM_AXIS ml m_ub_b1020 0 0.000000 1020.000000 AXIS_PTS_REF SML06TEUB /end AXIS_DESCR
 EXTENDED_LIMITS 0.000000 6.101074 /end CHARACTERISTIC
/begin CHARACTERISTIC ZBURNABR "Verbrennungsanzahl fÅr Entscheidung Adaptionsabbruch" VALUE 0x81521C ME7_FW1 0 dez 0.000000 255.000000 /end CHARACTERISTIC
/begin CHARACTERISTIC ZBURNDEC "Zu Åberschreitende Verbrennungsanzahl fÅr 'Abmagern'" VALUE 0x81521D ME7_FW1 0 dez 0.000000 255.000000 /end CHARACTERISTIC
/begin CHARACTERISTIC ZBURNLIM "Schwelle erkannte Verbrennungen fÅr Wiederholstart" VALUE 0x815305 ME7_FW1 0 dez 0.000000 255.000000 /end CHARACTERISTIC
/begin CHARACTERISTIC ZBURNSOL "Erforderliche Verbrennungsanzahl fÅr 'keine Anreicherung'" VALUE 0x81521E ME7_FW1 0 dez 0.000000 255.000000 /end CHARACTERISTIC
/begin CHARACTERISTIC ZBWF "ZÑhlerstand fÅr Fehlereintrag Bewegungserkennung" VALUE 0x814DD3 ME7_FW1 0 dez 0.000000 255.000000 /end CHARACTERISTIC
/begin CHARACTERISTIC ZDELBMSRCH "ZusÑtzlicher Zahnoffset beim Warten auf BM im Schnellstart" VALUE 0x814D70 ME7_FW1 0 dez 0.000000 6.000000 EXTENDED_LIMITS 0.000000 255.000000 /end CHARACTERISTIC
/begin CHARACTERISTIC ZDFR "Abregelfaktor Tiefpa· fÅr Adaption Regelhub von fr" VALUE 0x813774 ME7_FW3 0 fak_uw_b1 0.000000 0.999985 /end CHARACTERISTIC
/begin CHARACTERISTIC ZDGZA1 "ZÅndungszahl Abregelung Bereich 1" VALUE 0x81517C ME7_FW1 0 dez 0.000000 255.000000 /end CHARACTERISTIC
/begin CHARACTERISTIC ZDGZA2 "ZÅndungszahl Abregelung Bereich 2" VALUE 0x81517D ME7_FW1 0 dez 0.000000 255.000000 /end CHARACTERISTIC
/begin CHARACTERISTIC ZDKATAD "Filterzeitkonstante der Differenzierer fÅr Signalamplitude" VALUE 0x8184EE ME7_FW1 0 zk50msxs_ub_b12p8 0.050196 12.800000 /end CHARACTERISTIC
/begin CHARACTERISTIC ZDKATAF "Zeitkonstante Betrags-Filter fÅr Signalamplitude" VALUE 0x8184EF ME7_FW1 0 zk50msxs_ub_b12p8 0.050196 12.800000 /end CHARACTERISTIC
/begin CHARACTERISTIC ZDKATSH "Zeitkonstante Tiefpa·, Regellagendifferenz" VALUE 0x8184F0 ME7_FW1 0 zk50msxs_ub_b12p8 0.050196 12.800000 /end CHARACTERISTIC
/begin CHARACTERISTIC ZDKTBD "Zeitkonstante der Differenzierer fÅr FR-Wechselanteil" VALUE 0x8184F1 ME7_FW1 0 zk50msxs_ub_b12p8 0.050196 12.800000 /end CHARACTERISTIC
/begin CHARACTERISTIC ZDKTBF "Zeitkonstante fÅr Gasvermischungsvorgang vor Katalysator" VALUE 0x8184F2 ME7_FW1 0 zk50msxs_ub_b12p8 0.050196 12.800000 /end CHARACTERISTIC
/begin CHARACTERISTIC ZDLBTS "Zeitkonstante Delta Lambda Bauteileschutz" VALUE 0x81BA36 ME7_FW3 0 zk100msxs_uw_b6553 0.100002 6553.600000 /end CHARACTERISTIC
/begin CHARACTERISTIC ZDRLKRA "Zeitkonstante fÅr Tiefpass Lastgradient in KR" VALUE 0x812222 ME7_FW3 0 zk10msxs_uw_b655 0.010000 655.360000 /end CHARACTERISTIC
/begin CHARACTERISTIC ZDSU "Zeitkonstante fÅr Filterung von pu und fho in GGDSU" VALUE 0x818620 ME7_FW1 0 zk1sxs_ub_b25p5 1.003920 256.000000 EXTENDED_LIMITS 1.003922 256.000000 /end CHARACTERISTIC
/begin CHARACTERISTIC ZERBR "FehlerzÑhler fÅr Bremsschalter-UnplausibilitÑten" VALUE 0x8185A4 ME7_FW1 0 dez 0.000000 255.000000 /end CHARACTERISTIC
/begin CHARACTERISTIC ZETATE "Rampensteilheit fÅr VerÑnderung Motorwirkungsgrad durch TankentlÅftung" VALUE 0x81D97A ME7_FW3 0 rgrad_uw_b1280 0.390625 1279.980000 EXTENDED_LIMITS 0.000000 1279.980469 /end CHARACTERISTIC
/begin CHARACTERISTIC ZFLASKH "Zeitkonstante fÅr öbergang auf Lambda-Abgas-Vorgabe" VALUE 0x819161 ME7_FW1 0 zk100msxs_ub_b25p5 0.100392 25.600000 /end CHARACTERISTIC
/begin CHARACTERISTIC ZFLMSSL "Zeitkonstante Gemischanteil SekundÑrluft" VALUE 0x81836A ME7_FW1 0 zk100msxs_ub_b25p5 0.100392 25.600000 /end CHARACTERISTIC
/begin CHARACTERISTIC ZFMDVERL "Zeitkonstante fÅr Filterung Verlustmoment" VALUE 0x8156E3 ME7_FW1 0 zk20msxs_ub_b5p1 0.020000 2.550000 EXTENDED_LIMITS 0.020000 5.100000 /end CHARACTERISTIC
/begin CHARACTERISTIC ZFRIH "AbschwÑchungsfaktor fÅr Innenwiderstand Ri-Nernst-Filter hinter KAT" VALUE 0x810BCA ME7_FW3 0 fak_uw_b1 0.000000 0.999985 /end CHARACTERISTIC
/begin CHARACTERISTIC ZFRIV "AbschwÑchungsfaktor fÅr Innenwiderstand Ri-Nernst-Filter vor KAT" VALUE 0x810BDE ME7_FW3 0 fak_uw_b1 0.000000 0.999985 /end CHARACTERISTIC
/begin CHARACTERISTIC ZFRMFIL "Filterzeitkonstante Lambdareglergrî·en" VALUE 0x81D9BC ME7_FW3 0 zk100msxs_uw_b6553 0.100002 6.006970 EXTENDED_LIMITS 0.100002 6553.600000 /end CHARACTERISTIC
/begin CHARACTERISTIC ZFRMST "Zeitkonstante fÅr frm-Filter (short test)" VALUE 0x818E21 ME7_FW1 0 zk200msxs_ub_b51p2 0.200000 51.000000 /end CHARACTERISTIC
/begin CHARACTERISTIC ZFRMXAF "Filterzeitkonstante fÅr frmxa_w Signal" VALUE 0x81D9BE ME7_FW3 0 zk100msxs_uw_b6553 0.100002 6553.600000 /end CHARACTERISTIC
/begin CHARACTERISTIC ZFTANS "Zeitkonstante Tiefpa·filter Ansauglufttemperatur" VALUE 0x81BA38 ME7_FW3 0 zk100msxs_uw_b6553 0.100002 6553.600000 /end CHARACTERISTIC
/begin CHARACTERISTIC ZFTSVK "Zeitkonstante fÅr Filter Periodendauer der Sonde vor Katalysator" VALUE 0x814DA3 ME7_FW1 0 fak_ub_b1 0.000000 0.996094 /end CHARACTERISTIC
/begin CHARACTERISTIC ZFUKA "énderungsrate adaptiver öK-Korrekturfaktor" VALUE 0x8153FE ME7_FW1 0 fak_ub_b2 0.000000 1.992190 EXTENDED_LIMITS 0.000000 1.992188 /end CHARACTERISTIC
/begin CHARACTERISTIC ZFV "Zeitkonstante fÅr Filterung des Geschwindigkeitssignals" VALUE 0x81000A ME7_FW3 0 zk20msxs_uw_b1310 0.019989 1310.000000 /end CHARACTERISTIC
/begin CHARACTERISTIC ZHLLA "ZeitzÑhler-Schwelle fÅr Abbruch erhîhte Solldrehzahl im Hei·-Leerlauf" VALUE 0x815572 ME7_FW1 0 t1sxs_ub_b255 0.000000 255.000000 /end CHARACTERISTIC
/begin CHARACTERISTIC ZHLLE "ZeitzÑhler-Schwelle fÅr erhîhte Solldrehzahl im Hei·-Leerlauf" VALUE 0x815573 ME7_FW1 0 t1sxs_ub_b255 0.000000 255.000000 /end CHARACTERISTIC
/begin CHARACTERISTIC ZIDFBM "ZÑhler-Inkrementierung je LÅckenkorrektur bei BM-öberprÅfung" VALUE 0x810B70 ME7_FW3 0 dez___UW 0.000000 65535.000000 /end CHARACTERISTIC
/begin CHARACTERISTIC ZIDNOBM "ZÑhler-Inkrementierung nach Verlust der Bezugsmarke" VALUE 0x810B72 ME7_FW3 0 dez___UW 0.000000 65535.000000 /end CHARACTERISTIC
/begin CHARACTERISTIC ZIVMAX "I-Steigung fÅr VMAX-Regelung" VALUE 0x815A65 ME7_FW1 0 zk100msxs_ub_b25p5 0.100392 25.600000 /end CHARACTERISTIC
/begin CHARACTERISTIC ZKARIH "Filterzeitkonst.fÅr Nachbildung Dynamik der Keramiktemp. aus Abgastemp. h.Kat" VALUE 0x81AC5E ME7_FW3 0 zk100msxs_uw_b6553 0.100002 6553.600000 /end CHARACTERISTIC
/begin CHARACTERISTIC ZKARIV "Filterzeitkonst.fÅr Nachbildung Dynamik der Keramiktemp. aus Abgastemp. v.Kat" VALUE 0x81AD9C ME7_FW3 0 zk100msxs_uw_b6553 0.100002 6553.600000 /end CHARACTERISTIC
/begin CHARACTERISTIC ZKDMADFK "Zeitkonstante fÅr Adaption des Verlustmoments Fahrstufe und Kompressor ein" VALUE 0x81CBC4 ME7_FW3 0 zk200msxs_uw_b13107 3.200000 819.200000 EXTENDED_LIMITS 0.200003 13107.200000 /end CHARACTERISTIC
/begin CHARACTERISTIC ZKDMADFS "Zeitkonstante fÅr Adaption des Verlustmoments Fahrstufe ein" VALUE 0x81CBC6 ME7_FW3 0 zk200msxs_uw_b13107 3.200000 819.200000 EXTENDED_LIMITS 0.200003 13107.200000 /end CHARACTERISTIC
/begin CHARACTERISTIC ZKDMADKO "Zeitkonstante fÅr Adaption des Verlustmoments Klimakompressor ein" VALUE 0x81CBC8 ME7_FW3 0 zk200msxs_uw_b13107 3.200000 819.200000 EXTENDED_LIMITS 0.200003 13107.200000 /end CHARACTERISTIC
/begin CHARACTERISTIC ZKDMADLL "Zeitkonstante fÅr Adaption des Verlustmoments ohne Last" VALUE 0x81CBCA ME7_FW3 0 zk200msxs_uw_b13107 3.200000 819.200000 EXTENDED_LIMITS 0.200003 13107.200000 /end CHARACTERISTIC
/begin CHARACTERISTIC ZKDMDW "Zeitkonstante fÅr Abregelung D-Anteil Wandlermoment" VALUE 0x8155D0 ME7_FW1 0 zk20msxs_ub_b5p1 0.020000 5.100000 /end CHARACTERISTIC
/begin CHARACTERISTIC ZKDRLSOL "Zeitkonstante fÅr drlsol-Integrator" VALUE 0x811D84 ME7_FW3 0 zk10msxs_uw_b655 0.010000 655.360000 /end CHARACTERISTIC
/begin CHARACTERISTIC ZKDXLDPE "Einschaltzeit(konstante) fÅr Max-Fehler-PrÅfung (KS_UB) LDP-Endst.-Diagnose" VALUE 0x8185E7 ME7_FW1 0 t100msxs_ub_b25p5 0.000000 25.500000 /end CHARACTERISTIC
/begin CHARACTERISTIC ZKFRAO "Zeitkonstante fÅr frao-Integrator" VALUE 0x81B87E ME7_FW3 0 zk200msxs_uw_b5 0.000000 4.999920 EXTENDED_LIMITS 0.000000 4.999924 /end CHARACTERISTIC
/begin CHARACTERISTIC ZKFRAU "Zeitkonstante fÅr frau-Integrator" VALUE 0x81B880 ME7_FW3 0 zk200msxs_uw_b5 0.000000 4.999920 EXTENDED_LIMITS 0.000000 4.999924 /end CHARACTERISTIC
/begin CHARACTERISTIC ZKFTEAD "Zeitkonstante gefilteter Faktor Beladung SpÅlstrom bei TankentlÅftung" VALUE 0x81D97C ME7_FW3 0 zk100msxs_uw_b6553 0.100002 6553.600000 /end CHARACTERISTIC
/begin CHARACTERISTIC ZKFUB "Filterzeitkonstante fÅr Batteriespannung" VALUE 0x818591 ME7_FW1 0 zk200msxs_ub_b51p2 0.200000 51.000000 /end CHARACTERISTIC
/begin CHARACTERISTIC ZKHABB "Zeitkonstante fÅr Abbruch-Tiefpass Katheizen" VALUE 0x81908E ME7_FW1 0 zk100msxs_ub_b25p5 0.100392 25.600000 /end CHARACTERISTIC
/begin CHARACTERISTIC ZKLAMKH "Zeitkonstante Lambda-Motor-Soll bei Katheizen" VALUE 0x81206A ME7_FW3 0 zk10msxs_uw_b655 0.010000 655.360000 /end CHARACTERISTIC
/begin CHARACTERISTIC ZKLAMKR "Zeitkonstante Filterung Anfettungsfaktor bei ZÅndwinkelspÑtverstellung" VALUE 0x818CCC ME7_FW1 0 zk100msxs_ub_b25p5 0.100392 25.600000 /end CHARACTERISTIC
/begin CHARACTERISTIC ZKLANSWL "Zeitkonstante Filterung lamnswl_w" VALUE 0x811FCE ME7_FW3 0 zk10msxs_uw_b655 0.010000 655.360000 /end CHARACTERISTIC
/begin CHARACTERISTIC ZKLAWLRL "Zeitkonstante Wichtung lamwlrl_w" VALUE 0x811FD0 ME7_FW3 0 zk10msxs_uw_b655 0.010000 655.360000 /end CHARACTERISTIC
/begin CHARACTERISTIC ZKLBZ "Zeitkonstante des LBZ-Integrators" VALUE 0x81ADA0 ME7_FW3 0 zk200msxs_uw_b13107 0.200003 13107.200000 /end CHARACTERISTIC
/begin CHARACTERISTIC ZKLLRD "Zeitkonstante fÅr die Abregelung des D-Anteils" VALUE 0x8156D9 ME7_FW1 0 zk20msxs_ub_b5p1 0.020000 5.100000 /end CHARACTERISTIC
/begin CHARACTERISTIC ZKMDKO "Zeitkonstante Klimakompressor-Lastabregelung" VALUE 0x8156E1 ME7_FW1 0 zk20msxs_ub_b5p1 0.020000 5.100000 /end CHARACTERISTIC
/begin CHARACTERISTIC ZKMDSLP "Zeitkonstante zur Abregelung des Einschaltmomentes der Sek-Luftpumpe" VALUE 0x8156E2 ME7_FW1 0 zk20msxs_ub_b5p1 0.020000 5.100000 /end CHARACTERISTIC
/begin CHARACTERISTIC ZKMDWAB "Zeitkonstante fÅr Abregelung der  Drehmomentaufnahme des Wandlers" VALUE 0x8155D1 ME7_FW1 0 zk20msxs_ub_b5p1 0.020000 5.100000 /end CHARACTERISTIC
/begin CHARACTERISTIC ZKMDWAUF "Zeitkonstante fÅr Aufregelung der  Drehmomentaufnahme des Wandlers" VALUE 0x8155D2 ME7_FW1 0 zk20msxs_ub_b5p1 0.020000 5.100000 /end CHARACTERISTIC
/begin CHARACTERISTIC ZKMDWF "Zeitkonstante fÅr Filterung Wandlermoment zur Bildung D-Anteil" VALUE 0x8155D3 ME7_FW1 0 zk20msxs_ub_b5p1 0.020000 5.100000 /end CHARACTERISTIC
/begin CHARACTERISTIC ZKMSDKT "Zeitkonstante schnelle Massenstromadaption" CURVE 0x811818 ZF_KL111 0 zk10msxs_uw_b655 0.010000 655.360000
 /begin AXIS_DESCR STD_AXIS pspvds_w fak_uw_b2 8 0.000000 1.999970 DEPOSIT ABSOLUTE /end AXIS_DESCR
/end CHARACTERISTIC
/begin CHARACTERISTIC ZKNS "Zeitkonstante fÅr Solldrehzahl bei Umschaltung" VALUE 0x81982B ME7_FW1 0 zk200msxs_ub_b51p2 0.200000 51.000000 /end CHARACTERISTIC
/begin CHARACTERISTIC ZKPRIH "Filter fÅr Nachbildung Dynamik der Sondenkeramiktemp.aus el.Heizleistung h.Kat" VALUE 0x81AC60 ME7_FW3 0 zk100msxs_uw_b6553 0.100002 6553.600000 /end CHARACTERISTIC
/begin CHARACTERISTIC ZKPRIV "Filter fÅr Nachbildung Dynamik der Sondenkeramiktemp.aus el.Heizleistung v.Kat" VALUE 0x81AD9E ME7_FW3 0 zk100msxs_uw_b6553 0.100002 6553.600000 /end CHARACTERISTIC
/begin CHARACTERISTIC ZKPVDKT "Zeitkonstante fÅr langsame Massenstromadaption" CURVE 0x81183A ZF_KL111 0 zk1sxs_uw_b65535 1.000000 65535.000000
 /begin AXIS_DESCR STD_AXIS pspvds_w fak_uw_b2 8 0.000000 1.999970 DEPOSIT ABSOLUTE /end AXIS_DESCR
/end CHARACTERISTIC
/begin CHARACTERISTIC ZKRKAT "Integrationsgeschwindigkeit Integrator rkat" VALUE 0x81B882 ME7_FW3 0 zk200msxs_uw_b960 0.000000 959.985000 EXTENDED_LIMITS 0.000000 959.985352 /end CHARACTERISTIC
/begin CHARACTERISTIC ZKRKAZ "Integrationsgeschwindigkeit Integrator rkaz" VALUE 0x81B884 ME7_FW3 0 zk200msxs_uw_b960 0.000000 959.985000 EXTENDED_LIMITS 0.000000 959.985352 /end CHARACTERISTIC
/begin CHARACTERISTIC ZKRMSTEV "Zeitkonstante Tiefpa·filterung fÅr Mode 6 DTEV" VALUE 0x81D9C0 ME7_FW3 0 zk100msxs_uw_b6553 0.100002 60.124800 EXTENDED_LIMITS 0.100002 6553.600000 /end CHARACTERISTIC
/begin CHARACTERISTIC ZKSLPOFF "Zeitkonstante Runterlauf SekundÑrluftgeblÑse" VALUE 0x81836B ME7_FW1 0 zk100msxs_ub_b25p5 0.100392 25.600000 /end CHARACTERISTIC
/begin CHARACTERISTIC ZKSLPON "Zeitkonstante Hochlauf SekundÑrluftgeblÑse" VALUE 0x81836C ME7_FW1 0 zk100msxs_ub_b25p5 0.100392 25.600000 /end CHARACTERISTIC
/begin CHARACTERISTIC ZKSLSOFF "Zeitkonstante AusrÑumen der SekundÑrluft nach Ventil schlie·en" VALUE 0x81836D ME7_FW1 0 zk100msxs_ub_b25p5 0.100392 25.600000 /end CHARACTERISTIC
/begin CHARACTERISTIC ZKSLSON "Zeitkonstante Einbringen der SekundÑrluft nach Ventil îffnen" VALUE 0x81836E ME7_FW1 0 zk100msxs_ub_b25p5 0.100392 25.600000 /end CHARACTERISTIC
/begin CHARACTERISTIC ZKTABTU "Zeitkonstante fÅr MotorabkÅhlung" CURVE 0x81B9F2 ZF_KL111 0 t1sxs_uw_q1 0.000000 65535.000000
 /begin AXIS_DESCR STD_AXIS tum_ein temp_ub_q0p75_o48___UW 4 -48.000000 49103.300000 DEPOSIT ABSOLUTE /end AXIS_DESCR
/end CHARACTERISTIC
/begin CHARACTERISTIC ZKTDRL "Zeitkonstante Tiefpa·, rl-Filterung" VALUE 0x8184F3 ME7_FW1 0 zk50msxs_ub_b12p8 0.050196 12.800000 /end CHARACTERISTIC
/begin CHARACTERISTIC ZKTDTKM "Tiefpa·-Filterzeitkonstante fÅr tkatm-Filterung" VALUE 0x81AD6C ME7_FW3 0 zk50msxs_uw_b3276p8 0.050001 3276.800000 /end CHARACTERISTIC
/begin CHARACTERISTIC ZKUBDLR "DLR, Zeitkonstante fÅr Filterung von Ubatt" VALUE 0x8185A2 ME7_FW1 0 fak_ub_b0p5 0.000000 0.498047 /end CHARACTERISTIC
/begin CHARACTERISTIC ZKWDKSPT1 "Zeitkonstante fÅr PrÑdiktion DK-Winkel aus Sollwert" VALUE 0x814F5D ME7_FW1 0 fak_q0p00273 0.000000 0.697266 /end CHARACTERISTIC
/begin CHARACTERISTIC ZKWNWI "Zeitkonstante fÅr die Filterung von wnwi" VALUE 0x8188CF ME7_FW1 0 zk50msxs_ub_b12p8 0.050196 12.800000 /end CHARACTERISTIC
/begin CHARACTERISTIC ZLASHKAB "Zeitkonstante fÅr Abregelung der dyn. Sollwertanhebung (dlasohkab) rin der LRHK" VALUE 0x813738 ME7_FW3 0 zk10msxs_uw_b655 0.010000 655.360000 /end CHARACTERISTIC
/begin CHARACTERISTIC ZLASOHML "Zeitkonstante fÅr PT1-Filter des Pseudo-Lambda hinter Kat" CURVE 0x81373A ZF_KL111 0 zk10msxs_uw_b655 0.010000 655.360000
 /begin AXIS_DESCR STD_AXIS ml_w m_uw_b6553p5 8 0.000000 6553.500000 DEPOSIT ABSOLUTE /end AXIS_DESCR
/end CHARACTERISTIC
/begin CHARACTERISTIC ZLIBG "Filterzeitkonstante fÅr die NachfÅhrung der Integratorgrenzen" VALUE 0x8156DA ME7_FW1 0 zk20msxs_ub_b5p1 0.020000 5.100000 /end CHARACTERISTIC
/begin CHARACTERISTIC ZLRFRI "Zeitkonstante zum Aufregeln des tmst abhÑngigen Gewichtungsfaktor FFRITMS" VALUE 0x81EB0A ME7_FW3 0 zk100msxs_uw_b655 0.100002 6553.600000 /end CHARACTERISTIC
/begin CHARACTERISTIC ZLRHML "Luftmassendurchsatz abhÑngige Zeitkonstante fÅr Lambdaregler hinter Katalysator" CURVE 0x819D25 ME7_GKL1 0 tgrad_ub_q0p039 0.000000 9.960940
 /begin AXIS_DESCR COM_AXIS ml m_ub_b1020 0 0.000000 1020.000000 AXIS_PTS_REF SML08LHUB /end AXIS_DESCR
 EXTENDED_LIMITS 0.000000 9.960938 /end CHARACTERISTIC
/begin CHARACTERISTIC ZMDNSM "Zeitkonstante zur Abrgelung des Nachstart-Momentenoffset" CURVE 0x8198F5 ME7_KL97 0 zk200msxs_ub_b51p2 0.200000 51.000000
 /begin AXIS_DESCR STD_AXIS tmot temp_ub_q0p75_o48 8 -48.000000 143.250000 DEPOSIT ABSOLUTE /end AXIS_DESCR
/end CHARACTERISTIC
/begin CHARACTERISTIC ZMLETAN "Zeitkonstante fÅr Filterung zur Berechnung des Leerlaufenergiebedarf fÅr DTEV" VALUE 0x81D9C2 ME7_FW3 0 zk100msxs_uw_b6553 0.100002 10.005500 EXTENDED_LIMITS 0.100002 6553.600000 /end CHARACTERISTIC
/begin CHARACTERISTIC ZMLRO "Zeitkonstante mlroh-Tiefpa· bei Diagnose HFM/HLM" VALUE 0x8150DA ME7_FW1 0 zk10msxs_ub_b2p55 0.010000 2.550000 /end CHARACTERISTIC
/begin CHARACTERISTIC ZMLTE "Zeitkonstante fÅr ml-Filter in beladungsabh. TankentlÅftung" VALUE 0x81D97E ME7_FW3 0 zk100msxs_uw_b655 0.100002 6553.600000 /end CHARACTERISTIC
/begin CHARACTERISTIC ZMSSGIN "Filterzeitkonstante fÅr Berechnung der relativen énderung von mssgin_w" VALUE 0x819B72 ME7_FW1 0 zk100msxs_ub_b25p5 0.100392 25.600000 /end CHARACTERISTIC
/begin CHARACTERISTIC ZMSTEDTE "Zeitkonstante fÅr Filterung des berechneten Massenstrom TEV" VALUE 0x81D9C4 ME7_FW3 0 zk100msxs_uw_b6553 0.100002 15.031200 EXTENDED_LIMITS 0.100002 6553.600000 /end CHARACTERISTIC
/begin CHARACTERISTIC ZNFNGLL "Filterzeitkonstante fÅr Drehzahlgradient auf Luftpfad (LLR)" VALUE 0x8156DB ME7_FW1 0 zk20msxs_ub_b5p1 0.020000 5.100000 /end CHARACTERISTIC
/begin CHARACTERISTIC ZNGFIL "Zeitkonstante fÅr Drehzahlgradient-Filter" VALUE 0x810B6A ME7_FW3 0 zk10msxs_uw_b655 0.010000 655.360000 /end CHARACTERISTIC
/begin CHARACTERISTIC ZNGKRA "Zeitkonstante fÅr Tiefpa· Drehzahlgradient" VALUE 0x812224 ME7_FW3 0 zk10msxs_uw_b655 0.010000 655.360000 /end CHARACTERISTIC
/begin CHARACTERISTIC ZNOSTMX "Anzahl ZÅndung=ein ohne Erreichen von Startende fÅr kein EKP-Vorlauf" VALUE 0x8164CD ME7_FW1 0 dez 0.000000 255.000000 /end CHARACTERISTIC
/begin CHARACTERISTIC ZNSLFA "Zeitkonstante Tiefpass Solldrehzahlanhebung Kurztrip" VALUE 0x8156E8 ME7_FW1 0 zk20msxs_ub_b5p1 0.020000 5.100000 /end CHARACTERISTIC
/begin CHARACTERISTIC ZNSUB "Zeitkonstante fÅr Mindestsolldrehzahl bei Unterspannung" VALUE 0x81982C ME7_FW1 0 zk200msxs_ub_b51p2 0.200000 51.000000 /end CHARACTERISTIC
/begin CHARACTERISTIC ZNWSP "Zeitkonstante fÅr Adaption-SpÑtanschlagposition" VALUE 0x814D67 ME7_FW1 0 rel_ub_b99p6 0.000000 99.609400 EXTENDED_LIMITS 0.000000 99.609375 /end CHARACTERISTIC
/begin CHARACTERISTIC ZPVDKR "Zeitkonstante fÅr pvdkr-Filterung" CURVE 0x811BAE ZF_KL111 0 zk10msxs_uw_b655 0.010000 655.360000
 /begin AXIS_DESCR STD_AXIS vpsspu_w fak_uw_b4 6 0.000000 3.999940 DEPOSIT ABSOLUTE /end AXIS_DESCR
/end CHARACTERISTIC
/begin CHARACTERISTIC ZRLBAB "Zeitkonstante RL-Tiefpa· bei Bergaberkennung" VALUE 0x81D9CE ME7_FW3 0 zk100msxs_uw_b6553 0.100002 6553.600000 /end CHARACTERISTIC
/begin CHARACTERISTIC ZRLTEDTE "Zeitkonstante fÅr Filterung der berechneten FÅllung TEV" VALUE 0x81D9C6 ME7_FW3 0 zk100msxs_uw_b6553 0.100002 6553.600000 /end CHARACTERISTIC
/begin CHARACTERISTIC ZSYNABR "ZÅndungsanzahl fÅr Entscheidung Adaptionsabbruch" VALUE 0x81521F ME7_FW1 0 dez 0.000000 255.000000 /end CHARACTERISTIC
/begin CHARACTERISTIC ZSYNAUSW "Anzahl ZÅndungen (Synchros) bis Auswerten" VALUE 0x815220 ME7_FW1 0 dez 0.000000 255.000000 /end CHARACTERISTIC
/begin CHARACTERISTIC ZTAGR "Zeitkonstante fÅr AGR-Temperaturmodell Einleitstelle" VALUE 0x81B566 ME7_FW3 0 zk100msxs_uw_b6553 0.100002 6553.600000 /end CHARACTERISTIC
/begin CHARACTERISTIC ZTAGRV "Zeitkonstante fÅr AGR-Temperaturmodell AGR-Ventil" VALUE 0x81B568 ME7_FW3 0 zk100msxs_uw_b6553 0.100002 6553.600000 /end CHARACTERISTIC
/begin CHARACTERISTIC ZTDAGR "Zeitkonstante Temperaturdynamik bei AGR Auf- Abschaltung" VALUE 0x81B516 ME7_FW3 0 zk100msxs_uw_b6553 0.100002 6553.600000 /end CHARACTERISTIC
/begin CHARACTERISTIC ZTMMBR "Zeitkonstante Motortemperatur fÅr Brennraumtempmodell" VALUE 0x81B518 ME7_FW3 0 zk100msxs_uw_b6553 0.100002 6553.600000 /end CHARACTERISTIC
/begin CHARACTERISTIC ZTPREL "Anzahl ZÑhne wÑhrend der Starterkennung" VALUE 0x814D71 ME7_FW1 0 dez 0.000000 255.000000 /end CHARACTERISTIC
/begin CHARACTERISTIC ZUKE "Zeitkonstante öK-Ersatzwert" VALUE 0x812022 ME7_FW3 0 zk10msxs_uw_b655 0.010000 655.360000 /end CHARACTERISTIC
/begin CHARACTERISTIC ZUKK "Abregelfaktor Kurzzeitanteil" VALUE 0x8153EC ME7_FW1 0 fak_ub_b1 0.000000 0.996094 /end CHARACTERISTIC
/begin CHARACTERISTIC ZUKNST "Abregelzeitkonstante öK-Faktor im Nachstart" VALUE 0x812024 ME7_FW3 0 zk100msxs_uw_b6553 0.100002 6553.600000 /end CHARACTERISTIC
/begin CHARACTERISTIC ZVALM "Abregelfaktor L-Speicher (tmot) VA" CURVE 0x818E07 ME7_GKL1 0 fak_ub_b0p125 0.000000 0.124512
 /begin AXIS_DESCR COM_AXIS tmot temp_ub_q0p75_o48 0 -48.000000 143.250000 AXIS_PTS_REF STM09ESUB /end AXIS_DESCR
/end CHARACTERISTIC
/begin CHARACTERISTIC ZVTPRGSU "Zeitkonstante Tiefpa·filterung bei Saugrohrklappendynamik" VALUE 0x8150DB ME7_FW1 0 zk50msxs_ub_b12p8 0.050196 12.800000 /end CHARACTERISTIC
/begin CHARACTERISTIC ZWAPPL "Applikationsschnittstelle ZÅndwinkelverstellung" VALUE 0x815EE3 ME7_FW2 0 zw_sb_q0p75 -96.000000 95.250000 /end CHARACTERISTIC
/begin CHARACTERISTIC ZWC_T_UM "Fehlertoleranzzeit der ZÅndwinkelÅberwachung in der FunktionsÅberw." VALUE 0x81400C ME7_FW1 0 dez 0.000000 255.000000 /end CHARACTERISTIC
/begin CHARACTERISTIC ZWDKM1 "1. Zeitkonstante Dk-Modell" VALUE 0x811FE2 ME7_FW3 0 zk10msxs_uw_b2p55T 0.000000 2.550000 /end CHARACTERISTIC
/begin CHARACTERISTIC ZWDKM2 "2. Zeitkonstante Dk-Modell" VALUE 0x811FE4 ME7_FW3 0 zk10msxs_uw_b2p55T 0.000000 2.550000 /end CHARACTERISTIC
/begin CHARACTERISTIC ZWOUT_DAT_UC "" VAL_BLK 0x815C6A ME7_FWB1 0 zw_sb_q0p75___UB 0.000000 191.250000 NUMBER 16 /end CHARACTERISTIC
/begin CHARACTERISTIC ZYLANZ_UM "Zylinderzahl fÅr die ZÅndwinkelÅberwachung in der FunktionsÅberw." VALUE 0x81400D ME7_FW1 0 dez 0.000000 255.000000 /end CHARACTERISTIC
/begin CHARACTERISTIC ZYRKR "Zylinderzuordnung fÅr maximale Referenzpegelbegrenzung Klopfregelung" VALUE 0x819360 ME7_FW1 0 dez 0.000000 255.000000 /end CHARACTERISTIC
/begin CHARACTERISTIC ZZWEETM "Umschaltschwelle Vorlagerungswinkel" CURVE 0x818AE9 ME7_KL97 0 dez 0.000000 255.000000
 /begin AXIS_DESCR STD_AXIS tmst temp_ub_q0p75_o48 8 -48.000000 143.250000 DEPOSIT ABSOLUTE /end AXIS_DESCR
/end CHARACTERISTIC
/begin COMPU_METHOD dez "1 : 1 Umrechnug (dez/hex)" RAT_FUNC "%6.2" "" COEFFS 0 1.000000 0.000000 0 0.000000 1.000000 /end COMPU_METHOD
/begin COMPU_METHOD dez___SL "1 : 1 Umrechnug (dez/hex)" RAT_FUNC "%6.2" "" COEFFS 0 1.000000 0.000000 0 0.000000 1.000000 /end COMPU_METHOD
/begin COMPU_METHOD dez___UW "1 : 1 Umrechnug (dez/hex)" RAT_FUNC "%6.2" "" COEFFS 0 1.000000 0.000000 0 0.000000 1.000000 /end COMPU_METHOD
/begin COMPU_METHOD fak_q0p00273 "" RAT_FUNC "%6.4" "-" COEFFS 0 256.000000 0.000000 0 0.000000 7.000000e-01 /end COMPU_METHOD
/begin COMPU_METHOD fak_q0p0039 "" RAT_FUNC "%6.4" "-" COEFFS 0 256.000000 0.000000 0 0.000000 1.000000 /end COMPU_METHOD
/begin COMPU_METHOD fak_q0p1 "" RAT_FUNC "%6.3" "" COEFFS 0 1.000000 0.000000 0 0.000000 1.000000e-01 /end COMPU_METHOD
/begin COMPU_METHOD fak_ub_b0p125 "" RAT_FUNC "%6.5" "-" COEFFS 0 256.000000 0.000000 0 0.000000 1.250000e-01 /end COMPU_METHOD
/begin COMPU_METHOD fak_ub_b0p5 "" RAT_FUNC "%6.4" "-" COEFFS 0 256.000000 0.000000 0 0.000000 5.000000e-01 /end COMPU_METHOD
/begin COMPU_METHOD fak_ub_b1 "" RAT_FUNC "%6.4" "-" COEFFS 0 256.000000 0.000000 0 0.000000 1.000000 /end COMPU_METHOD
/begin COMPU_METHOD fak_ub_b16 "" RAT_FUNC "%6.4" "-" COEFFS 0 256.000000 0.000000 0 0.000000 16.000000 /end COMPU_METHOD
/begin COMPU_METHOD fak_ub_b2 "" RAT_FUNC "%6.4" "-" COEFFS 0 256.000000 0.000000 0 0.000000 2.000000 /end COMPU_METHOD
/begin COMPU_METHOD fak_ub_b318p75 "" RAT_FUNC "%6.2" "-" COEFFS 0 256.000000 0.000000 0 0.000000 318.750000 /end COMPU_METHOD
/begin COMPU_METHOD fak_uw_b1 "" RAT_FUNC "%7.6" "-" COEFFS 0 6.553600e+04 0.000000 0 0.000000 1.000000 /end COMPU_METHOD
/begin COMPU_METHOD fak_uw_b2 "" RAT_FUNC "%7.6" "-" COEFFS 0 6.553600e+04 0.000000 0 0.000000 2.000000 /end COMPU_METHOD
/begin COMPU_METHOD fak_uw_b4 "" RAT_FUNC "%7.6" "-" COEFFS 0 6.553600e+04 0.000000 0 0.000000 4.000000 /end COMPU_METHOD
/begin COMPU_METHOD KennText "" RAT_FUNC "%6.2" "" COEFFS 0 1.000000 0.000000 0 0.000000 1.000000 /end COMPU_METHOD
/begin COMPU_METHOD kw_q0p0156 "" RAT_FUNC "%6.4" "∞KW" COEFFS 0 64.000000 0.000000 0 0.000000 1.000000 /end COMPU_METHOD
/begin COMPU_METHOD kw_q0p0156___UW "" RAT_FUNC "%6.4" "∞KW" COEFFS 0 64.000000 0.000000 0 0.000000 1.000000 /end COMPU_METHOD
/begin COMPU_METHOD kw_q1 "" RAT_FUNC "%6.2" "∞KW" COEFFS 0 1.000000 0.000000 0 0.000000 1.000000 /end COMPU_METHOD
/begin COMPU_METHOD kw_q2p8125 "" RAT_FUNC "%6.2" "∞KW" COEFFS 0 1.000000 0.000000 0 0.000000 2.812500 /end COMPU_METHOD
/begin COMPU_METHOD kw_q6 "" RAT_FUNC "%6.2" "∞KW" COEFFS 0 1.000000 0.000000 0 0.000000 6.000000 /end COMPU_METHOD
/begin COMPU_METHOD kw_ub_q0p5 "" RAT_FUNC "%6.3" "∞KW" COEFFS 0 256.000000 0.000000 0 0.000000 128.000000 /end COMPU_METHOD
/begin COMPU_METHOD m_ub_b1020 "" RAT_FUNC "%6.2" "kg/h" COEFFS 0 1.000000 0.000000 0 0.000000 4.000000 /end COMPU_METHOD
/begin COMPU_METHOD m_uw_b6553p5 "" RAT_FUNC "%6.3" "kg/h" COEFFS 0 1.000000 0.000000 0 0.000000 1.000000e-01 /end COMPU_METHOD
/begin COMPU_METHOD nmot_ub_q10 "" RAT_FUNC "%6.1" "U/min" COEFFS 0 1.000000 0.000000 0 0.000000 10.000000 /end COMPU_METHOD
/begin COMPU_METHOD nmot_ub_q40 "" RAT_FUNC "%6.1" "Upm" COEFFS 0 1.000000 0.000000 0 0.000000 40.000000 /end COMPU_METHOD
/begin COMPU_METHOD nmot_uw_q0p25 "" RAT_FUNC "%6.3" "U/min" COEFFS 0 1.000000 0.000000 0 0.000000 2.500000e-01 /end COMPU_METHOD
/begin COMPU_METHOD nwu_q1 "" RAT_FUNC "%6.2" "" COEFFS 0 1.000000 0.000000 0 0.000000 1.000000 /end COMPU_METHOD
/begin COMPU_METHOD perio_ub_b6p125 "" RAT_FUNC "%6.4" "1/s" COEFFS 0 256.000000 0.000000 0 0.000000 6.125000 /end COMPU_METHOD
/begin COMPU_METHOD p_sb_q10 "" RAT_FUNC "%6.1" "hPa" COEFFS 0 1.000000 0.000000 0 0.000000 10.000000 /end COMPU_METHOD
/begin COMPU_METHOD qnv_uw_b512 "" RAT_FUNC "%6.4" "(U/min)/(km/h)" COEFFS 0 6.553600e+04 0.000000 0 0.000000 512.000000 /end COMPU_METHOD
/begin COMPU_METHOD relDK_q0p00152___UW "" RAT_FUNC "%6.4" "%DK" COEFFS 0 6.553600e+04 0.000000 0 0.000000 100.000000 /end COMPU_METHOD
/begin COMPU_METHOD relDK_q0p02441 "" RAT_FUNC "%6.4" "% DK" COEFFS 0 6.553600e+04 0.000000 0 0.000000 1600.000000 /end COMPU_METHOD
/begin COMPU_METHOD relDK_ub_b100 "" RAT_FUNC "%6.3" "% DK" COEFFS 0 255.000000 0.000000 0 0.000000 100.000000 /end COMPU_METHOD
/begin COMPU_METHOD relDK_uw_b100 "" RAT_FUNC "%6.4" "% DK" COEFFS 0 65535.000000 0.000000 0 0.000000 100.000000 /end COMPU_METHOD
/begin COMPU_METHOD relPED_ub_b100 "" RAT_FUNC "%6.3" "% PED" COEFFS 0 255.000000 0.000000 0 0.000000 100.000000 /end COMPU_METHOD
/begin COMPU_METHOD relPED_uw_b100 "" RAT_FUNC "%6.4" "% PED" COEFFS 0 65535.000000 0.000000 0 0.000000 100.000000 /end COMPU_METHOD
/begin COMPU_METHOD rel_ub_b100 "" RAT_FUNC "%6.3" "%" COEFFS 0 256.000000 0.000000 0 0.000000 100.000000 /end COMPU_METHOD
/begin COMPU_METHOD rel_ub_b99p6 "" RAT_FUNC "%6.3" "%" COEFFS 0 256.000000 0.000000 0 0.000000 100.000000 /end COMPU_METHOD
/begin COMPU_METHOD rel_ub_q0p391 "" RAT_FUNC "%6.3" "%/km/h" COEFFS 0 1.000000 0.000000 0 0.000000 3.910000e-01 /end COMPU_METHOD
/begin COMPU_METHOD rel_uw_b100 "" RAT_FUNC "%6.4" "%" COEFFS 0 6.553600e+04 0.000000 0 0.000000 100.000000 /end COMPU_METHOD
/begin COMPU_METHOD rel_uw_b200 "" RAT_FUNC "%6.4" "%" COEFFS 0 6.553600e+04 0.000000 0 0.000000 200.000000 /end COMPU_METHOD
/begin COMPU_METHOD rel_uw_b6144 "" RAT_FUNC "%6.3" "%" COEFFS 0 6.553600e+04 0.000000 0 0.000000 6144.000000 /end COMPU_METHOD
/begin COMPU_METHOD rel_uw_q0p0234___SL "" RAT_FUNC "%6.4" "%" COEFFS 0 32.000000 0.000000 0 0.000000 7.500000e-01 /end COMPU_METHOD
/begin COMPU_METHOD rgrad_uw_b1280 "" RAT_FUNC "%6.4" "%/s" COEFFS 0 6.553600e+04 0.000000 0 0.000000 1280.000000 /end COMPU_METHOD
/begin COMPU_METHOD spgg_q0p52 "" RAT_FUNC "%6.3" "mV/ms" COEFFS 0 1.000000 0.000000 0 0.000000 5.200000e-01 /end COMPU_METHOD
/begin COMPU_METHOD spg_sw_q0p001222 "" RAT_FUNC "%6.4" "V" COEFFS 0 1.000000 0.000000 0 0.000000 1.222000e-03 /end COMPU_METHOD
/begin COMPU_METHOD spg_ubatt "" RAT_FUNC "%6.4" "V" COEFFS 0 1.000000 0.000000 0 0.000000 7.040000e-02 /end COMPU_METHOD
/begin COMPU_METHOD spg_ub_b1p33 "" RAT_FUNC "%6.4" "V" COEFFS 0 255.000000 0.000000 0 0.000000 1.330000 /end COMPU_METHOD
/begin COMPU_METHOD spg_ub_b5 "" RAT_FUNC "%6.4" "V" COEFFS 0 256.000000 0.000000 0 0.000000 5.000000 /end COMPU_METHOD
/begin COMPU_METHOD spg_ub_q0p0052_o0p2 "" RAT_FUNC "%6.3" "V" COEFFS 0 255.000000 51.000000 0 0.000000 1.330000 /end COMPU_METHOD
/begin COMPU_METHOD spg_ub_q0p019 "" RAT_FUNC "%6.4" "V" COEFFS 0 256.000000 0.000000 0 0.000000 5.000000 /end COMPU_METHOD
/begin COMPU_METHOD spg_uw_b1280 "" RAT_FUNC "%6.4" "V" COEFFS 0 1000.000000 0.000000 0 0.000000 19.531300 /end COMPU_METHOD
/begin COMPU_METHOD spg_uw_q0p001222 "" RAT_FUNC "%6.4" "V" COEFFS 0 1.000000 0.000000 0 0.000000 1.222000e-03 /end COMPU_METHOD
/begin COMPU_METHOD spg_uw_q0p00488 "" RAT_FUNC "%6.4" "V" COEFFS 0 1024.000000 0.000000 0 0.000000 5.000000 /end COMPU_METHOD
/begin COMPU_METHOD spg_uw_q0p004888 "" RAT_FUNC "%6.4" "V" COEFFS 0 1.000000 0.000000 0 0.000000 4.888000e-03 /end COMPU_METHOD
/begin COMPU_METHOD spg_uw_q0p00488_o1 "" RAT_FUNC "%6.3" "V" COEFFS 0 1024.000000 1024.000000 0 0.000000 5.000000 /end COMPU_METHOD
/begin COMPU_METHOD t100msxs_sb_q0p01 "" RAT_FUNC "%6.4" "s" COEFFS 0 1.000000 0.000000 0 0.000000 1.000000e-02 /end COMPU_METHOD
/begin COMPU_METHOD t100msxs_ub_b25p5 "" RAT_FUNC "%6.3" "s" COEFFS 0 1.000000 0.000000 0 0.000000 1.000000e-01 /end COMPU_METHOD
/begin COMPU_METHOD t100msxs_ub_q20 "" RAT_FUNC "%9.3" "s" COEFFS 0 1.000000 0.000000 0 0.000000 20.000000 /end COMPU_METHOD
/begin COMPU_METHOD t100msxs_uw_b6553p5 "" RAT_FUNC "%6.3" "s" COEFFS 0 1.000000 0.000000 0 0.000000 1.000000e-01 /end COMPU_METHOD
/begin COMPU_METHOD t100msxs_uw_b6553p6 "" RAT_FUNC "%6.3" "s" COEFFS 0 10.000000 0.000000 0 0.000000 1.000000 /end COMPU_METHOD
/begin COMPU_METHOD t100msxs_uw_q100 "" RAT_FUNC "%6.3" "s" COEFFS 0 1.000000 0.000000 0 0.000000 1.000000e-01 /end COMPU_METHOD
/begin COMPU_METHOD t10msxs_ub_b2p55 "" RAT_FUNC "%6.4" "s" COEFFS 0 1.000000 0.000000 0 0.000000 1.000000e-02 /end COMPU_METHOD
/begin COMPU_METHOD t10msxs_ub_b2p55___UW "" RAT_FUNC "%6.4" "s" COEFFS 0 1.000000 0.000000 0 0.000000 1.000000e-02 /end COMPU_METHOD
/begin COMPU_METHOD t10msxs_uw_b655p35 "" RAT_FUNC "%6.4" "s" COEFFS 0 1.000000 0.000000 0 0.000000 1.000000e-02 /end COMPU_METHOD
/begin COMPU_METHOD t1msxms_q1 "" RAT_FUNC "%6.2" "ms" COEFFS 0 1.000000 0.000000 0 0.000000 1.000000 /end COMPU_METHOD
/begin COMPU_METHOD t1sxs_ub_b255 "" RAT_FUNC "%6.2" "s" COEFFS 0 1.000000 0.000000 0 0.000000 1.000000 /end COMPU_METHOD
/begin COMPU_METHOD t1sxs_uw_b65535 "" RAT_FUNC "%6.2" "s" COEFFS 0 1.000000 0.000000 0 0.000000 1.000000 /end COMPU_METHOD
/begin COMPU_METHOD t1sxs_uw_q1 "" RAT_FUNC "%6.2" "s" COEFFS 0 1.000000 0.000000 0 0.000000 1.000000 /end COMPU_METHOD
/begin COMPU_METHOD t200msxs_ub_b51 "" RAT_FUNC "%6.3" "s" COEFFS 0 1.000000 0.000000 0 0.000000 2.000000e-01 /end COMPU_METHOD
/begin COMPU_METHOD t200msxs_uw_q0p2 "" RAT_FUNC "%6.3" "s" COEFFS 0 1.000000 0.000000 0 0.000000 2.000000e-01 /end COMPU_METHOD
/begin COMPU_METHOD t20msxs_ub_b5p1 "" RAT_FUNC "%6.4" "s" COEFFS 0 1.000000 0.000000 0 0.000000 2.000000e-02 /end COMPU_METHOD
/begin COMPU_METHOD t20msxs_ub_q0p32 "" RAT_FUNC "%6.3" "s" COEFFS 0 256.000000 0.000000 0 0.000000 81.920000 /end COMPU_METHOD
/begin COMPU_METHOD t20msxs_uw_q0p02 "" RAT_FUNC "%6.4" "s" COEFFS 0 1.000000 0.000000 0 0.000000 2.000000e-02 /end COMPU_METHOD
/begin COMPU_METHOD t40msxs_ub_q0p04 "" RAT_FUNC "%6.4" "s" COEFFS 0 1.000000 0.000000 0 0.000000 4.000000e-02 /end COMPU_METHOD
/begin COMPU_METHOD t50msxs_q2 "" RAT_FUNC "%6.2" "s" COEFFS 0 1.000000 0.000000 0 0.000000 2.000000 /end COMPU_METHOD
/begin COMPU_METHOD t50msxs_ub_b12p75 "" RAT_FUNC "%6.4" "s" COEFFS 0 1.000000 0.000000 0 0.000000 5.000000e-02 /end COMPU_METHOD
/begin COMPU_METHOD t50msxs_uw_b3276p75 "" RAT_FUNC "%6.4" "s" COEFFS 0 1.000000 0.000000 0 0.000000 5.000000e-02 /end COMPU_METHOD
/begin COMPU_METHOD temp_ub_q0p75_o48 "" RAT_FUNC "%6.2" "Grad C" COEFFS 0 1.000000 48.000000 0 0.000000 7.500000e-01 /end COMPU_METHOD
/begin COMPU_METHOD temp_ub_q0p75_o48___UW "" RAT_FUNC "%6.2" "Grad C" COEFFS 0 1.000000 48.000000 0 0.000000 7.500000e-01 /end COMPU_METHOD
/begin COMPU_METHOD temp_ub_q5 "" RAT_FUNC "%6.2" "Grad C" COEFFS 0 1.000000 0.000000 0 0.000000 5.000000 /end COMPU_METHOD
/begin COMPU_METHOD tgrad_ub_q0p039 "" RAT_FUNC "%6.4" "ms/s" COEFFS 0 256.000000 0.000000 0 0.000000 10.000000 /end COMPU_METHOD
/begin COMPU_METHOD tinjection_sy "" RAT_FUNC "%6.4" "ms" COEFFS 0 312.500000 0.000000 0 0.000000 1.000000 /end COMPU_METHOD
/begin COMPU_METHOD tv_sw_q0p005 "" RAT_FUNC "%6.4" "%" COEFFS 0 1.000000 0.000000 0 0.000000 5.000000e-03 /end COMPU_METHOD
/begin COMPU_METHOD tv_ub_b100 "" RAT_FUNC "%6.3" "%" COEFFS 0 256.000000 0.000000 0 0.000000 100.000000 /end COMPU_METHOD
/begin COMPU_METHOD txms_ub_q0p1 "" RAT_FUNC "%6.3" "ms" COEFFS 0 10.000000 0.000000 0 0.000000 1.000000 /end COMPU_METHOD
/begin COMPU_METHOD t_wdt_high "" RAT_FUNC "%6.2" "ms" COEFFS 0 6.103520e-01 0.000000 0 0.000000 1.000000 /end COMPU_METHOD
/begin COMPU_METHOD vfzg_q1p0___SB "" RAT_FUNC "%6.2" "km/h" COEFFS 0 1.000000 0.000000 0 0.000000 1.000000 /end COMPU_METHOD
/begin COMPU_METHOD vfzg_sw_q0p00781 "" RAT_FUNC "%6.4" "km/h" COEFFS 0 1.000000 0.000000 0 0.000000 7.812500e-03 /end COMPU_METHOD
/begin COMPU_METHOD vfzg_ub_q1p25___UB "" RAT_FUNC "%6.2" "km/h" COEFFS 0 1.000000 0.000000 0 0.000000 1.250000 /end COMPU_METHOD
/begin COMPU_METHOD vfzg_uw_b325 "" RAT_FUNC "%6.4" "km/h" COEFFS 0 6.553600e+04 0.000000 0 0.000000 325.000000 /end COMPU_METHOD
/begin COMPU_METHOD vfzg_uw_b512 "" RAT_FUNC "%6.4" "km/h" COEFFS 0 6.553600e+04 0.000000 0 0.000000 512.000000 /end COMPU_METHOD
/begin COMPU_METHOD vfzg_uw_q0p00781 "" RAT_FUNC "%6.4" "km/h" COEFFS 0 1.000000 0.000000 0 0.000000 7.812500e-03 /end COMPU_METHOD
/begin COMPU_METHOD zk100msxs_ub_b25p5 "" RAT_FUNC "%6.3" "s" COEFFS 0 0.000000 256.000000 0 10.000000 0.000000 /end COMPU_METHOD
/begin COMPU_METHOD zk100msxs_uw_b655 "" RAT_FUNC "%6.1" "s" COEFFS 0 0.000000 6.553600e+04 0 10.000000 0.000000 /end COMPU_METHOD
/begin COMPU_METHOD zk100msxs_uw_b6553 "" RAT_FUNC "%6.1" "s" COEFFS 0 0.000000 6.553600e+04 0 10.000000 0.000000 /end COMPU_METHOD
/begin COMPU_METHOD zk10msxs_ub_b2p55 "" RAT_FUNC "%6.4" "s" COEFFS 0 0.000000 255.000000 0 100.000000 0.000000 /end COMPU_METHOD
/begin COMPU_METHOD zk10msxs_uw_b2p55T "" TAB_INTP "%6.3" "s" COMPU_TAB_REF zk10msxs_uw_b2p55T /end COMPU_METHOD
/begin COMPU_METHOD zk10msxs_uw_b655 "" RAT_FUNC "%10.4" "s" COEFFS 0 0.000000 6.553600e+04 0 100.000000 0.000000 /end COMPU_METHOD
/begin COMPU_METHOD zk1sxs_ub_b25p5 "" RAT_FUNC "%6.2" "s" COEFFS 0 0.000000 256.000000 0 1.000000 0.000000 /end COMPU_METHOD
/begin COMPU_METHOD zk1sxs_uw_b65535 "" RAT_FUNC "%6.0" "s" COEFFS 0 0.000000 65535.000000 0 1.000000 0.000000 /end COMPU_METHOD
/begin COMPU_METHOD zk200msxs_ub_b51p2 "" RAT_FUNC "%6.3" "s" COEFFS 0 0.000000 255.000000 0 5.000000 0.000000 /end COMPU_METHOD
/begin COMPU_METHOD zk200msxs_uw_b13107 "" RAT_FUNC "%10.2" "s" COEFFS 0 0.000000 13107.200000 0 1.000000 0.000000 /end COMPU_METHOD
/begin COMPU_METHOD zk200msxs_uw_b5 "" RAT_FUNC "%7.6" "1/s" COEFFS 0 6.553600e+04 0.000000 0 0.000000 5.000000 /end COMPU_METHOD
/begin COMPU_METHOD zk200msxs_uw_b960 "" RAT_FUNC "%6.4" "%/s" COEFFS 0 6.553600e+04 0.000000 0 0.000000 960.000000 /end COMPU_METHOD
/begin COMPU_METHOD zk20msxs_ub_b5p1 "" RAT_FUNC "%6.4" "s" COEFFS 0 0.000000 5.100000 0 1.000000 0.000000 /end COMPU_METHOD
/begin COMPU_METHOD zk20msxs_uw_b1310 "" RAT_FUNC "%10.3" "s" COEFFS 0 0.000000 1310.000000 0 1.000000 0.000000 /end COMPU_METHOD
/begin COMPU_METHOD zk50msxs_ub_b12p8 "" RAT_FUNC "%6.3" "s" COEFFS 0 0.000000 128.000000 0 10.000000 0.000000 /end COMPU_METHOD
/begin COMPU_METHOD zk50msxs_uw_b3276p8 "" RAT_FUNC "%6.1" "s" COEFFS 0 0.000000 6.553600e+04 0 20.000000 0.000000 /end COMPU_METHOD
/begin COMPU_METHOD zw_sb_q0p75 "" RAT_FUNC "%6.3" "grad KW" COEFFS 0 255.000000 0.000000 0 0.000000 191.250000 /end COMPU_METHOD
/begin COMPU_METHOD zw_sb_q0p75___UB "" RAT_FUNC "%6.3" "grad KW" COEFFS 0 255.000000 0.000000 0 0.000000 191.250000 /end COMPU_METHOD
/begin COMPU_METHOD zw_ub_q6 "" RAT_FUNC "%6.2" "Grad KW" COEFFS 0 255.000000 0.000000 0 0.000000 1530.000000 /end COMPU_METHOD
/begin COMPU_METHOD zw_ub_qn0p75 "" RAT_FUNC "%6.4" "grad KW" COEFFS 0 1.000000 0.000000 0 0.000000 -7.500000e-01 /end COMPU_METHOD
/begin COMPU_TAB zk10msxs_uw_b2p55T "" TAB_INTP 35 128 2.550000 145 2.250000 163 2.000000 186 1.750000 217 1.500000 251 1.300000 283 1.150000 326 1.000000 362 0.900000 407 0.800000 465 0.700000 541 0.600000 649 0.500000 720 0.450000 809 0.400000 923 0.350000 1074 0.300000 1285 0.250000 1524 0.210000 1872 0.170000 2259 0.140000 2426 0.130000 2620 0.120000 2847 0.110000 3118 0.100000 3446 0.090000 3850 0.080000 4362 0.070000 5030 0.060000 5939 0.050000 7248 0.040000 9288 0.030000 12893 0.020000 20713 0.010000 32767 0.000000 /end COMPU_TAB
/end MODULE
/end PROJECT
