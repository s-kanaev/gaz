ASAP2_VERSION 1 21
/begin PROJECT Pro4017 "R4 1.8l 5V T lÑngs FR5ROM F5051"
/begin HEADER "" PROJECT_NO Pro4017 VERSION "PrV = F21dc mit 00" /end HEADER
/begin MODULE DIM " "
/begin MOD_COMMON " " S_REC_LAYOUT ME7 BYTE_ORDER MSB_LAST /end MOD_COMMON
/begin RECORD_LAYOUT ME7_FW4 FNC_VALUES 1 SWORD COLUMN_DIR DIRECT /end RECORD_LAYOUT
/begin RECORD_LAYOUT ME7_FW1 FNC_VALUES 1 UBYTE COLUMN_DIR DIRECT /end RECORD_LAYOUT
/begin RECORD_LAYOUT ME7_FW3 FNC_VALUES 1 UWORD COLUMN_DIR DIRECT /end RECORD_LAYOUT
/begin RECORD_LAYOUT ME7_GKL1 FNC_VALUES 1 UBYTE COLUMN_DIR DIRECT /end RECORD_LAYOUT
/begin RECORD_LAYOUT ME7_FWB1 FNC_VALUES 1 UBYTE COLUMN_DIR DIRECT /end RECORD_LAYOUT
/begin RECORD_LAYOUT ME7_GKL3 FNC_VALUES 1 UWORD COLUMN_DIR DIRECT /end RECORD_LAYOUT
/begin RECORD_LAYOUT ME7_KL98 NO_AXIS_PTS_X 1 UBYTE AXIS_PTS_X 2 UBYTE INDEX_INCR DIRECT FNC_VALUES 3 SBYTE COLUMN_DIR DIRECT /end RECORD_LAYOUT
/begin RECORD_LAYOUT ME7_FW2 FNC_VALUES 1 SBYTE COLUMN_DIR DIRECT /end RECORD_LAYOUT
/begin RECORD_LAYOUT ZF_KL111 NO_AXIS_PTS_X 1 UWORD AXIS_PTS_X 2 UWORD INDEX_INCR DIRECT FNC_VALUES 3 UWORD ROW_DIR DIRECT /end RECORD_LAYOUT
/begin RECORD_LAYOUT ME7_KL97 NO_AXIS_PTS_X 1 UBYTE AXIS_PTS_X 2 UBYTE INDEX_INCR DIRECT FNC_VALUES 3 UBYTE COLUMN_DIR DIRECT /end RECORD_LAYOUT
/begin RECORD_LAYOUT ME7_FWB3 FNC_VALUES 1 UWORD COLUMN_DIR DIRECT /end RECORD_LAYOUT
/begin CHARACTERISTIC CDTKRTP "Codewort Tester: Klopfregelung Testimpuls" VALUE 0x810832 ME7_FW3 0 dez___UW 0.000000 65535.000000 /end CHARACTERISTIC
/begin CHARACTERISTIC CDTKS1 "Codewort Tester: Klopfsensor 1" VALUE 0x810834 ME7_FW3 0 dez___UW 0.000000 65535.000000 /end CHARACTERISTIC
/begin CHARACTERISTIC CDTKS2 "Codewort Tester: Klopfsensor 2" VALUE 0x810836 ME7_FW3 0 dez___UW 0.000000 65535.000000 /end CHARACTERISTIC
/begin CHARACTERISTIC CDTKS3 "Codewort Tester: Klopfsensor 3" VALUE 0x810838 ME7_FW3 0 dez___UW 0.000000 65535.000000 /end CHARACTERISTIC
/begin CHARACTERISTIC CDTKS4 "Codewort Tester: Klopfsensor 4" VALUE 0x81083A ME7_FW3 0 dez___UW 0.000000 65535.000000 /end CHARACTERISTIC
/begin CHARACTERISTIC CDTKUPPL "Fehlerpfadcode: Pedalwertgeber Kupplung" VALUE 0x81083C ME7_FW3 0 dez___UW 0.000000 65535.000000 /end CHARACTERISTIC
/begin CHARACTERISTIC CDTLASH "Codewort Tester: Lambda-Sondenalterung hinter Kat" VALUE 0x81083E ME7_FW3 0 dez___UW 0.000000 65535.000000 /end CHARACTERISTIC
/begin CHARACTERISTIC CDTLASH2 "Codewort Tester: Lambda-Sondenalterung hinter Kat. Bank2" VALUE 0x810840 ME7_FW3 0 dez___UW 0.000000 65535.000000 /end CHARACTERISTIC
/begin CHARACTERISTIC CDTLATP "Codewort Tester: Lambda-Sondenalterung TP" VALUE 0x810842 ME7_FW3 0 dez___UW 0.000000 65535.000000 /end CHARACTERISTIC
/begin CHARACTERISTIC CDTLATP2 "Codewort Tester: Lambda-Sondenalterung TP (Bank 2)" VALUE 0x810844 ME7_FW3 0 dez___UW 0.000000 65535.000000 /end CHARACTERISTIC
/begin CHARACTERISTIC CDTLATV "Codewort Tester: Lambda-Sondenalterung TV" VALUE 0x810846 ME7_FW3 0 dez___UW 0.000000 65535.000000 /end CHARACTERISTIC
/begin CHARACTERISTIC CDTLATV2 "Codewort Tester: Lambda-Sondenalterung TV (Bank 2)" VALUE 0x810848 ME7_FW3 0 dez___UW 0.000000 65535.000000 /end CHARACTERISTIC
/begin CHARACTERISTIC CDTLDE "Codewort Tester: Ladedrucksteuerventil (Endstufe)" VALUE 0x81084A ME7_FW3 0 dez___UW 0.000000 65535.000000 /end CHARACTERISTIC
/begin CHARACTERISTIC CDTLDO "Codewort Tester: Ladedruck; oberer Wert Åberschritten" VALUE 0x81084C ME7_FW3 0 dez___UW 0.000000 65535.000000 /end CHARACTERISTIC
/begin CHARACTERISTIC CDTLDP "Codewort Tester: TankentlÅftung; Leckdiagnosepumpe" VALUE 0x81084E ME7_FW3 0 dez___UW 0.000000 65535.000000 /end CHARACTERISTIC
/begin CHARACTERISTIC CDTLDPE "Codewort Tester: Leckdiagnosepumpe Endstufe" VALUE 0x810850 ME7_FW3 0 dez___UW 0.000000 65535.000000 /end CHARACTERISTIC
/begin CHARACTERISTIC CDTLDRA "Codewort Tester: Ladedruckregelabweichung" VALUE 0x810852 ME7_FW3 0 dez___UW 0.000000 65535.000000 /end CHARACTERISTIC
/begin CHARACTERISTIC CDTLLR "Codewort Tester: Leerlaufregelung am Anschlag" VALUE 0x810854 ME7_FW3 0 dez___UW 0.000000 65535.000000 /end CHARACTERISTIC
/begin CHARACTERISTIC CDTLM "Codewort Tester: LMM/HLM/HFM" VALUE 0x810856 ME7_FW3 0 dez___UW 0.000000 65535.000000 /end CHARACTERISTIC
/begin CHARACTERISTIC CDTLSH "Codewort Tester: Lambda-Sonde hinter Kat" VALUE 0x810858 ME7_FW3 0 dez___UW 0.000000 65535.000000 /end CHARACTERISTIC
/begin CHARACTERISTIC CDTLSV "Codewort Tester: Lambda-Sonde vor Kat" VALUE 0x81085A ME7_FW3 0 dez___UW 0.000000 65535.000000 /end CHARACTERISTIC
/begin CHARACTERISTIC CDTMD "Codewort Tester: Aussetzer, Summenfehler (multiple)" VALUE 0x81085C ME7_FW3 0 dez___UW 0.000000 65535.000000 /end CHARACTERISTIC
/begin CHARACTERISTIC CDTMD01 "Codewort Tester: Aussetzer Zyl. 1" VALUE 0x81085E ME7_FW3 0 dez___UW 0.000000 65535.000000 /end CHARACTERISTIC
/begin CHARACTERISTIC CDTMD02 "Codewort Tester: Aussetzer Zylinder 2" VALUE 0x810860 ME7_FW3 0 dez___UW 0.000000 65535.000000 /end CHARACTERISTIC
/begin CHARACTERISTIC CDTMD03 "Codewort Tester: Aussetzer Zylinder 3" VALUE 0x810862 ME7_FW3 0 dez___UW 0.000000 65535.000000 /end CHARACTERISTIC
/begin CHARACTERISTIC CDTMD04 "Codewort Tester: Aussetzer Zylinder 4" VALUE 0x810864 ME7_FW3 0 dez___UW 0.000000 65535.000000 /end CHARACTERISTIC
/begin CHARACTERISTIC CDTMDB "Codewort Tester: Momentbegrenzung Sollmoment" VALUE 0x810866 ME7_FW3 0 dez___UW 0.000000 65535.000000 /end CHARACTERISTIC
/begin CHARACTERISTIC CDTMDK "Codewort Tester: Aussetzer, Summenfehler - multiple, kundendienstrelevant" VALUE 0x810868 ME7_FW3 0 dez___UW 0.000000 65535.000000 /end CHARACTERISTIC
/begin CHARACTERISTIC CDTMDK01 "Codewort Tester: Aussetzer, Zylinder 1, kundendienstrelevant" VALUE 0x81086A ME7_FW3 0 dez___UW 0.000000 65535.000000 /end CHARACTERISTIC
/begin CHARACTERISTIC CDTMDK02 "Codewort Tester: Aussetzer, Zylinder 2, kundendienstrelevant" VALUE 0x81086C ME7_FW3 0 dez___UW 0.000000 65535.000000 /end CHARACTERISTIC
/begin CHARACTERISTIC CDTMDK03 "Codewort Tester: Aussetzer, Zylinder 3, kundendienstrelevant" VALUE 0x81086E ME7_FW3 0 dez___UW 0.000000 65535.000000 /end CHARACTERISTIC
/begin CHARACTERISTIC CDTMDK04 "Codewort Tester: Aussetzer, Zylinder 4, kundendienstrelevant" VALUE 0x810870 ME7_FW3 0 dez___UW 0.000000 65535.000000 /end CHARACTERISTIC
/begin CHARACTERISTIC CDTMILE "Codewort Tester: MIL-Endstufe" VALUE 0x810872 ME7_FW3 0 dez___UW 0.000000 65535.000000 /end CHARACTERISTIC
/begin CHARACTERISTIC CDTN "Codewort Tester: Drehzahlsignalgeber" VALUE 0x810874 ME7_FW3 0 dez___UW 0.000000 65535.000000 /end CHARACTERISTIC
/begin CHARACTERISTIC CDTNWKW "Codewort Tester: Zuordnung Nockenwelle zu Kurbelwelle" VALUE 0x810876 ME7_FW3 0 dez___UW 0.000000 65535.000000 /end CHARACTERISTIC
/begin CHARACTERISTIC CDTNWKW2 "Codewort Tester: Zuordnung Nockenwelle 2 zu Kurbelwelle" VALUE 0x810878 ME7_FW3 0 dez___UW 0.000000 65535.000000 /end CHARACTERISTIC
/begin CHARACTERISTIC CDTNWS "Codewort Tester: Nockenwellensteuerung" VALUE 0x81087A ME7_FW3 0 dez___UW 0.000000 65535.000000 /end CHARACTERISTIC
/begin CHARACTERISTIC CDTNWS2 "Codewort Tester: Nockenwellensteuerung (Bank 2)" VALUE 0x81087C ME7_FW3 0 dez___UW 0.000000 65535.000000 /end CHARACTERISTIC
/begin CHARACTERISTIC CDTNWSE "Codewort Tester: Nockenwellensteuerungsventil Endstufe" VALUE 0x81087E ME7_FW3 0 dez___UW 0.000000 65535.000000 /end CHARACTERISTIC
/begin CHARACTERISTIC CDTNX "Codewort Tester: NMAX - öberschreitung" VALUE 0x810880 ME7_FW3 0 dez___UW 0.000000 65535.000000 /end CHARACTERISTIC
/begin CHARACTERISTIC CDTPH "Codewort Tester: Phasensensor" VALUE 0x810882 ME7_FW3 0 dez___UW 0.000000 65535.000000 /end CHARACTERISTIC
/begin CHARACTERISTIC CDTPWM "" VALUE 0x810884 ME7_FW3 0 dez___UW 0.000000 65535.000000 /end CHARACTERISTIC
/begin CHARACTERISTIC CDTRKAT "Codewort Tester: LR-Adaption additiv pro Zeit" VALUE 0x810886 ME7_FW3 0 dez___UW 0.000000 65535.000000 /end CHARACTERISTIC
/begin CHARACTERISTIC CDTRKAZ "Codewort Tester: LR-Adaption additiv pro ZÅndung" VALUE 0x810888 ME7_FW3 0 dez___UW 0.000000 65535.000000 /end CHARACTERISTIC
/begin CHARACTERISTIC CDTSGEEW "Codewort Tester: SteuergerÑt defekt (EEPROM WFS-Bereich)" VALUE 0x81088A ME7_FW3 0 dez___UW 0.000000 65535.000000 /end CHARACTERISTIC
/begin CHARACTERISTIC CDTSLPE "Codewort Tester: SekundÑrluftpumpe (Endstufe)" VALUE 0x81088C ME7_FW3 0 dez___UW 0.000000 65535.000000 /end CHARACTERISTIC
/begin CHARACTERISTIC CDTSLS "Codewort Tester: SekundÑrluft-System" VALUE 0x81088E ME7_FW3 0 dez___UW 0.000000 65535.000000 /end CHARACTERISTIC
/begin CHARACTERISTIC CDTSLV "Codewort Tester: SekundÑrluftventil" VALUE 0x810890 ME7_FW3 0 dez___UW 0.000000 65535.000000 /end CHARACTERISTIC
/begin CHARACTERISTIC CDTSLVE "Codewort Tester: SekundÑrluftventil (Endstufe)" VALUE 0x810892 ME7_FW3 0 dez___UW 0.000000 65535.000000 /end CHARACTERISTIC
/begin CHARACTERISTIC CDTSLWG "Codewort Tester: Wast- Gate- Ansteuerung" VALUE 0x810894 ME7_FW3 0 dez___UW 0.000000 65535.000000 /end CHARACTERISTIC
/begin CHARACTERISTIC CDTSUE "Codewort Tester: Endstufe Saugrohrumschaltung" VALUE 0x810896 ME7_FW3 0 dez___UW 0.000000 65535.000000 /end CHARACTERISTIC
/begin CHARACTERISTIC CDTSWE "Codewort Tester: Beschleunigungssensor Schlechtwegeerk." VALUE 0x810898 ME7_FW3 0 dez___UW 0.000000 65535.000000 /end CHARACTERISTIC
/begin CHARACTERISTIC CDTTA "Codewort Tester: TANS" VALUE 0x81089A ME7_FW3 0 dez___UW 0.000000 65535.000000 /end CHARACTERISTIC
/begin CHARACTERISTIC CDTTANKL "Codewort Tester: OBDII Fehler auf Grund eines leeren Tanks" VALUE 0x81089C ME7_FW3 0 dez___UW 0.000000 65535.000000 /end CHARACTERISTIC
/begin CHARACTERISTIC CDTTES "Codewort Tester: TankentlÅftungssystem" VALUE 0x81089E ME7_FW3 0 dez___UW 0.000000 65535.000000 /end CHARACTERISTIC
/begin CHARACTERISTIC CDTTESF "Codewort Tester: TankentlÅftungssystem Feinleck" VALUE 0x8108A0 ME7_FW3 0 dez___UW 0.000000 65535.000000 /end CHARACTERISTIC
/begin CHARACTERISTIC CDTTESG "Codewort Tester: TankentlÅftungssystem Grobleck" VALUE 0x8108A2 ME7_FW3 0 dez___UW 0.000000 65535.000000 /end CHARACTERISTIC
/begin CHARACTERISTIC CDTTEVE "Codewort Tester: TankentlÅftungsventil Endstufe" VALUE 0x8108A4 ME7_FW3 0 dez___UW 0.000000 65535.000000 /end CHARACTERISTIC
/begin CHARACTERISTIC CDTTEVE2 "Codewort Tester: TankentlÅftungsventil Endstufe Bank 2" VALUE 0x8108A6 ME7_FW3 0 dez___UW 0.000000 65535.000000 /end CHARACTERISTIC
/begin CHARACTERISTIC CDTTM "Codewort Tester: TMOT" VALUE 0x8108A8 ME7_FW3 0 dez___UW 0.000000 65535.000000 /end CHARACTERISTIC
/begin CHARACTERISTIC CDTTOL "Codewort Tester: ôltemperatur" VALUE 0x8108AA ME7_FW3 0 dez___UW 0.000000 65535.000000 /end CHARACTERISTIC
/begin CHARACTERISTIC CDTTUM "Codewort Tester: Umgebungstemperatur TUM" VALUE 0x8108AC ME7_FW3 0 dez___UW 0.000000 65535.000000 /end CHARACTERISTIC
/begin CHARACTERISTIC CDTTUN "Codewort Tester: Tuningschutz" VALUE 0x8108AE ME7_FW3 0 dez___UW 0.000000 65535.000000 /end CHARACTERISTIC
/begin CHARACTERISTIC CDTUB "Codewort Tester: UB" VALUE 0x8108B0 ME7_FW3 0 dez___UW 0.000000 65535.000000 /end CHARACTERISTIC
/begin CHARACTERISTIC CDTUFMV "Codewort Tester: FunktionsÅberwachung: Momentenvergleich" VALUE 0x8108B2 ME7_FW3 0 dez___UW 0.000000 65535.000000 /end CHARACTERISTIC
/begin CHARACTERISTIC CDTUFSKA "Codewort Tester: FunktionsÅberwachung: Sicherheits-Kraftstoff-Abschaltung" VALUE 0x8108B4 ME7_FW3 0 dez___UW 0.000000 65535.000000 /end CHARACTERISTIC
/begin CHARACTERISTIC CDTURRAM "Codewort Tester: RechnerÅberwachung: RAM" VALUE 0x8108B6 ME7_FW3 0 dez___UW 0.000000 65535.000000 /end CHARACTERISTIC
/begin CHARACTERISTIC CDTURROM "Codewort Tester: RechnerÅberwachung: ROM" VALUE 0x8108B8 ME7_FW3 0 dez___UW 0.000000 65535.000000 /end CHARACTERISTIC
/begin CHARACTERISTIC CDTURRST "Codewort Tester: RechnerÅberwachung: Reset" VALUE 0x8108BA ME7_FW3 0 dez___UW 0.000000 65535.000000 /end CHARACTERISTIC
/begin CHARACTERISTIC CDTUVSE "Codewort Tester: Endstufe Umluftventil Turbo" VALUE 0x8108BC ME7_FW3 0 dez___UW 0.000000 65535.000000 /end CHARACTERISTIC
/begin CHARACTERISTIC CDTVFZ "Codewort Tester: Fahrzeug-Geschwindigkeit" VALUE 0x8108BE ME7_FW3 0 dez___UW 0.000000 65535.000000 /end CHARACTERISTIC
/begin CHARACTERISTIC CDTWFS "Codewort Tester: Wegfahrsperre" VALUE 0x8108C0 ME7_FW3 0 dez___UW 0.000000 65535.000000 /end CHARACTERISTIC
/begin CHARACTERISTIC CDTWFSRC "" VALUE 0x8108C2 ME7_FW3 0 dez___UW 0.000000 65535.000000 /end CHARACTERISTIC
/begin CHARACTERISTIC CDTZET1 "" VALUE 0x8108C4 ME7_FW3 0 dez___UW 0.000000 65535.000000 /end CHARACTERISTIC
/begin CHARACTERISTIC CDTZET2 "" VALUE 0x8108C6 ME7_FW3 0 dez___UW 0.000000 65535.000000 /end CHARACTERISTIC
/begin CHARACTERISTIC CDTZET3 "" VALUE 0x8108C8 ME7_FW3 0 dez___UW 0.000000 65535.000000 /end CHARACTERISTIC
/begin CHARACTERISTIC CDTZET4 "" VALUE 0x8108CA ME7_FW3 0 dez___UW 0.000000 65535.000000 /end CHARACTERISTIC
/begin CHARACTERISTIC CDTZET5 "" VALUE 0x8108CC ME7_FW3 0 dez___UW 0.000000 65535.000000 /end CHARACTERISTIC
/begin CHARACTERISTIC CDTZET6 "" VALUE 0x8108CE ME7_FW3 0 dez___UW 0.000000 65535.000000 /end CHARACTERISTIC
/begin CHARACTERISTIC CDTZET7 "" VALUE 0x8108D0 ME7_FW3 0 dez___UW 0.000000 65535.000000 /end CHARACTERISTIC
/begin CHARACTERISTIC CDTZET8 "" VALUE 0x8108D2 ME7_FW3 0 dez___UW 0.000000 65535.000000 /end CHARACTERISTIC
/begin CHARACTERISTIC CDTZZZ "" VALUE 0x8108D4 ME7_FW3 0 dez___UW 0.000000 65535.000000 /end CHARACTERISTIC
/begin CHARACTERISTIC CDWGANG "Gangerkennung fÅr Kompressorabschalten bei Vollgas" VALUE 0x816473 ME7_FW1 0 dez 0.000000 255.000000 /end CHARACTERISTIC
/begin CHARACTERISTIC CDWGANGB "Gangerkennung bei Beschleunigung" VALUE 0x816474 ME7_FW1 0 dez 0.000000 255.000000 /end CHARACTERISTIC
/begin CHARACTERISTIC CDWKOB "Codewort : Auswahl zur Gangerkennung fÅr KO-Auschalten ( gangi oder nmot/vfzw)" VALUE 0x816475 ME7_FW1 0 dez 0.000000 255.000000 /end CHARACTERISTIC
/begin CHARACTERISTIC CDWVERAD "Codewort : Sperrung Bedarfsadaption dmvadll fÅr AG" VALUE 0x814319 ME7_FW1 0 dez 0.000000 255.000000 /end CHARACTERISTIC
/begin CHARACTERISTIC CFRA "Codewort Adaption Regelhub in LR" VALUE 0x815EB3 ME7_FW1 0 dez 0.000000 255.000000 /end CHARACTERISTIC
/begin CHARACTERISTIC CIDATV "Component ID fÅr ATV-EinmalprÅfung" VALUE 0x81852B ME7_FW1 0 dez 0.000000 127.000000 EXTENDED_LIMITS 0.000000 255.000000 /end CHARACTERISTIC
/begin CHARACTERISTIC CIDATV2 "Component ID fÅr ATV-EinmalprÅfung Bank2" VALUE 0x81852C ME7_FW1 0 dez 0.000000 127.000000 EXTENDED_LIMITS 0.000000 255.000000 /end CHARACTERISTIC
/begin CHARACTERISTIC CIDLSCH "Component ID fÅr EinmalprÅfung Messung im Schub fÅr Sonde hinter KAT" VALUE 0x8184B4 ME7_FW1 0 dez 0.000000 127.000000 EXTENDED_LIMITS 0.000000 255.000000 /end CHARACTERISTIC
/begin CHARACTERISTIC CIDLSCH2 "Component ID fÅr EinmalprÅfung Messung im Schub fÅr Sonde hinter KAT Bank2" VALUE 0x8184B5 ME7_FW1 0 dez 0.000000 127.000000 EXTENDED_LIMITS 0.000000 255.000000 /end CHARACTERISTIC
/begin CHARACTERISTIC CIDLSDY "Component ID fÅr EinmalprÅfung Dynamik-Messung im Schub fÅr Sonde hinter KAT" VALUE 0x8184B6 ME7_FW1 0 dez 0.000000 127.000000 EXTENDED_LIMITS 0.000000 255.000000 /end CHARACTERISTIC
/begin CHARACTERISTIC CIDLSDY2 "Component ID fÅr EinmalprÅfung Dyn.-Messung im Schub fÅr Sonde hinte KAT Bank2" VALUE 0x8184B7 ME7_FW1 0 dez 0.000000 127.000000 EXTENDED_LIMITS 0.000000 255.000000 /end CHARACTERISTIC
/begin CHARACTERISTIC CIDSHKF "Component ID fÅr EinmalprÅfung Fettspannung hinter KAT" VALUE 0x8184B8 ME7_FW1 0 dez 0.000000 127.000000 EXTENDED_LIMITS 0.000000 255.000000 /end CHARACTERISTIC
/begin CHARACTERISTIC CIDSHKF2 "Component ID fÅr EinmalprÅfung Fettspannung hinter KAT Bank2" VALUE 0x8184B9 ME7_FW1 0 dez 0.000000 127.000000 EXTENDED_LIMITS 0.000000 255.000000 /end CHARACTERISTIC
/begin CHARACTERISTIC CIDSHKM "Component ID fÅr EinmalprÅfung Magerspannung hinter KAT" VALUE 0x8184BA ME7_FW1 0 dez 0.000000 127.000000 EXTENDED_LIMITS 0.000000 255.000000 /end CHARACTERISTIC
/begin CHARACTERISTIC CIDSHKM2 "Component ID fÅr EinmalprÅfung Magerspannung hinter KAT Bank2" VALUE 0x8184BB ME7_FW1 0 dez 0.000000 127.000000 EXTENDED_LIMITS 0.000000 255.000000 /end CHARACTERISTIC
/begin CHARACTERISTIC CIDTP "Component ID fÅr Periodendauer TP-EinmalprÅfung" VALUE 0x81852D ME7_FW1 0 dez 0.000000 127.000000 EXTENDED_LIMITS 0.000000 255.000000 /end CHARACTERISTIC
/begin CHARACTERISTIC CIDTP2 "Component ID fÅr Periodendauer TP-EinmalprÅfung Bank2" VALUE 0x81852E ME7_FW1 0 dez 0.000000 127.000000 EXTENDED_LIMITS 0.000000 255.000000 /end CHARACTERISTIC
/begin CHARACTERISTIC CL30LINE "30. Linie der Klassentabelle" VAL_BLK 0x810ADE ME7_FWB1 0 dez 0.000000 255.000000 NUMBER 13 /end CHARACTERISTIC
/begin CHARACTERISTIC CL31LINE "31. Linie der Klassentabelle" VAL_BLK 0x810AEC ME7_FWB1 0 dez 0.000000 255.000000 NUMBER 13 /end CHARACTERISTIC
/begin CHARACTERISTIC CL32LINE "32. Linie der Klassentabelle" VAL_BLK 0x810AFA ME7_FWB1 0 dez 0.000000 255.000000 NUMBER 13 /end CHARACTERISTIC
/begin CHARACTERISTIC CL33LINE "33. Linie der Klassentabelle" VAL_BLK 0x810B08 ME7_FWB1 0 dez 0.000000 255.000000 NUMBER 13 /end CHARACTERISTIC
/begin CHARACTERISTIC CL34LINE "34. Linie der Klassentabelle" VAL_BLK 0x810B16 ME7_FWB1 0 dez 0.000000 255.000000 NUMBER 13 /end CHARACTERISTIC
/begin CHARACTERISTIC CL35LINE "35. Linie der Klassentabelle" VAL_BLK 0x810B24 ME7_FWB1 0 dez 0.000000 255.000000 NUMBER 13 /end CHARACTERISTIC
/begin CHARACTERISTIC CL36LINE "36. Linie der Klassentabelle" VAL_BLK 0x810B32 ME7_FWB1 0 dez 0.000000 255.000000 NUMBER 13 /end CHARACTERISTIC
/begin CHARACTERISTIC CL37LINE "37. Linie der Klassentabelle" VAL_BLK 0x810B40 ME7_FWB1 0 dez 0.000000 255.000000 NUMBER 13 /end CHARACTERISTIC
/begin CHARACTERISTIC CL38LINE "38. Linie der Klassentabelle" VAL_BLK 0x810B4E ME7_FWB1 0 dez 0.000000 255.000000 NUMBER 13 /end CHARACTERISTIC
/begin CHARACTERISTIC CL39LINE "39. Linie der Klassentabelle" VAL_BLK 0x810B5C ME7_FWB1 0 dez 0.000000 255.000000 NUMBER 13 /end CHARACTERISTIC
/begin CHARACTERISTIC CLAAAA "Dummy: Tabellenanfang" VALUE 0x814AFB ME7_FW1 0 dez 0.000000 255.000000 /end CHARACTERISTIC
/begin CHARACTERISTIC CLAAAVE "Fehlerklasse: Absperrventil Aktivkohlefilter (Endstufe)" VALUE 0x814AFC ME7_FW1 0 dez 0.000000 255.000000 /end CHARACTERISTIC
/begin CHARACTERISTIC CLAAGRE "Fehlerklasse: AGR-Ventil Endstufe" VALUE 0x814AFD ME7_FW1 0 dez 0.000000 255.000000 /end CHARACTERISTIC
/begin CHARACTERISTIC CLAAGRF "Fehlerklasse: öberwachung AGR-Flow" VALUE 0x814AFE ME7_FW1 0 dez 0.000000 255.000000 /end CHARACTERISTIC
/begin CHARACTERISTIC CLABM "Fehlerklasse: Bezugsmarkengeber" VALUE 0x814AFF ME7_FW1 0 dez 0.000000 255.000000 /end CHARACTERISTIC
/begin CHARACTERISTIC CLABREMS "Fehlerklasse: BREMS (Bremsschalter)" VALUE 0x814B00 ME7_FW1 0 dez 0.000000 255.000000 /end CHARACTERISTIC
/begin CHARACTERISTIC CLABWF "Fehlerklasse:  PWG Bewegung" VALUE 0x814B01 ME7_FW1 0 dez 0.000000 255.000000 /end CHARACTERISTIC
/begin CHARACTERISTIC CLACADR "Fehlerklasse: CAN- Timeout ADR" VALUE 0x814B02 ME7_FW1 0 dez 0.000000 255.000000 /end CHARACTERISTIC
/begin CHARACTERISTIC CLACAS "Fehlerklasse: CAN-Timeout ASC-Botschaft" VALUE 0x814B03 ME7_FW1 0 dez 0.000000 255.000000 /end CHARACTERISTIC
/begin CHARACTERISTIC CLACAT "Fehlerklasse: CAN-Schnittstelle, Timeout ASR" VALUE 0x814B04 ME7_FW1 0 dez 0.000000 255.000000 /end CHARACTERISTIC
/begin CHARACTERISTIC CLACGE "Fehlerklasse: CAN-Timeout EGS-Botschaft" VALUE 0x814B05 ME7_FW1 0 dez 0.000000 255.000000 /end CHARACTERISTIC
/begin CHARACTERISTIC CLACIF "Fehlerklasse: CAN-Schnittstelle, interner Fehler" VALUE 0x814B06 ME7_FW1 0 dez 0.000000 255.000000 /end CHARACTERISTIC
/begin CHARACTERISTIC CLACINS "Fehlerklasse: CAN-Timeout Botschaft Kombiinstrument" VALUE 0x814B07 ME7_FW1 0 dez 0.000000 255.000000 /end CHARACTERISTIC
/begin CHARACTERISTIC CLACLWS "Fehlerklasse: CAN-Schnittstelle, Timeout Botschaft Lenkwinkelsensor" VALUE 0x814B08 ME7_FW1 0 dez 0.000000 255.000000 /end CHARACTERISTIC
/begin CHARACTERISTIC CLADK "Fehlerklasse: DK- Potentiometer" VALUE 0x814B09 ME7_FW1 0 dez 0.000000 255.000000 /end CHARACTERISTIC
/begin CHARACTERISTIC CLADK1P "Fehlerklassse: Drosselklappe 1. Poti" VALUE 0x814B0A ME7_FW1 0 dez 0.000000 255.000000 /end CHARACTERISTIC
/begin CHARACTERISTIC CLADK2P "Fehlerklasse: Drosselklappenpotentiometer 2" VALUE 0x814B0B ME7_FW1 0 dez 0.000000 255.000000 /end CHARACTERISTIC
/begin CHARACTERISTIC CLADPL "Fehlerklasse: Dauerplus" VALUE 0x814B0C ME7_FW1 0 dez 0.000000 255.000000 /end CHARACTERISTIC
/begin CHARACTERISTIC CLADSL "Fehlerklasse: Druchsensor Ladedruck" VALUE 0x814B0D ME7_FW1 0 dez 0.000000 255.000000 /end CHARACTERISTIC
/begin CHARACTERISTIC CLADSS "Fehlerklasse: Saugrohrdrucksensor" VALUE 0x814B0E ME7_FW1 0 dez 0.000000 255.000000 /end CHARACTERISTIC
/begin CHARACTERISTIC CLADSU "Fehlerklasse: Umgebungsdrucksensor" VALUE 0x814B0F ME7_FW1 0 dez 0.000000 255.000000 /end CHARACTERISTIC
/begin CHARACTERISTIC CLADSVLU "" VALUE 0x814B10 ME7_FW1 0 dez 0.000000 255.000000 /end CHARACTERISTIC
/begin CHARACTERISTIC CLADVEE "Fehlerklasse: DV-E Endstufe" VALUE 0x814B11 ME7_FW1 0 dez 0.000000 255.000000 /end CHARACTERISTIC
/begin CHARACTERISTIC CLADVEF "Fehlerklasse: DV-E Fehler bei FederprÅfung" VALUE 0x814B12 ME7_FW1 0 dez 0.000000 255.000000 /end CHARACTERISTIC
/begin CHARACTERISTIC CLADVEFO "" VALUE 0x814B13 ME7_FW1 0 dez 0.000000 255.000000 /end CHARACTERISTIC
/begin CHARACTERISTIC CLADVEL "Fehlerklasse: DV-E Lageabweichung" VALUE 0x814B14 ME7_FW1 0 dez 0.000000 255.000000 /end CHARACTERISTIC
/begin CHARACTERISTIC CLADVEN "Fehlerklasse: DV-E Fehler bei PrÅfung Notluftposition" VALUE 0x814B15 ME7_FW1 0 dez 0.000000 255.000000 /end CHARACTERISTIC
/begin CHARACTERISTIC CLADVER "Fehlerklasse: DV-E Regelbereich" VALUE 0x814B16 ME7_FW1 0 dez 0.000000 255.000000 /end CHARACTERISTIC
/begin CHARACTERISTIC CLADVET "" VALUE 0x814B17 ME7_FW1 0 dez 0.000000 255.000000 /end CHARACTERISTIC
/begin CHARACTERISTIC CLADVEU "Fehlerklasse: DV-E Fehler beim UMA-Lernen" VALUE 0x814B18 ME7_FW1 0 dez 0.000000 255.000000 /end CHARACTERISTIC
/begin CHARACTERISTIC CLADVEUB "" VALUE 0x814B19 ME7_FW1 0 dez 0.000000 255.000000 /end CHARACTERISTIC
/begin CHARACTERISTIC CLADVEUW "" VALUE 0x814B1A ME7_FW1 0 dez 0.000000 255.000000 /end CHARACTERISTIC
/begin CHARACTERISTIC CLADVEV "Fehlerklasse: DV-E Fehler bei VerstÑrkerabgleich" VALUE 0x814B1B ME7_FW1 0 dez 0.000000 255.000000 /end CHARACTERISTIC
/begin CHARACTERISTIC CLAEGFE "" VALUE 0x814B1C ME7_FW1 0 dez 0.000000 255.000000 /end CHARACTERISTIC
/begin CHARACTERISTIC CLAEPCLE "Fehlerklasse: Fahrverhaltens- Fehllampe ( Endstufe )" VALUE 0x814B1D ME7_FW1 0 dez 0.000000 255.000000 /end CHARACTERISTIC
/begin CHARACTERISTIC CLAETSE "Fehlerklasse: Elektrisches Thermostat Endstufe" VALUE 0x814B1E ME7_FW1 0 dez 0.000000 255.000000 /end CHARACTERISTIC
/begin CHARACTERISTIC CLAEV1 "Fehlerklasse: EV Endtsufe 1" VALUE 0x814B1F ME7_FW1 0 dez 0.000000 255.000000 /end CHARACTERISTIC
/begin CHARACTERISTIC CLAEV2 "Fehlerklasse: EV Endstufe 2" VALUE 0x814B20 ME7_FW1 0 dez 0.000000 255.000000 /end CHARACTERISTIC
/begin CHARACTERISTIC CLAEV3 "Fehlerklasse: EV Endstufe 3" VALUE 0x814B21 ME7_FW1 0 dez 0.000000 255.000000 /end CHARACTERISTIC
/begin CHARACTERISTIC CLAEV4 "Fehlerklasse: EV Endstufe 4" VALUE 0x814B22 ME7_FW1 0 dez 0.000000 255.000000 /end CHARACTERISTIC
/begin CHARACTERISTIC CLAEV5 "Fehlerklasse: EV Endstufe 5" VALUE 0x814B23 ME7_FW1 0 dez 0.000000 255.000000 /end CHARACTERISTIC
/begin CHARACTERISTIC CLAEV6 "Fehlerklasse: EV Endstufe 6" VALUE 0x814B24 ME7_FW1 0 dez 0.000000 255.000000 /end CHARACTERISTIC
/begin CHARACTERISTIC CLAEV7 "Fehlerklasse: EV Endstufe 7" VALUE 0x814B25 ME7_FW1 0 dez 0.000000 255.000000 /end CHARACTERISTIC
/begin CHARACTERISTIC CLAEV8 "Fehlerklasse: EV Endstufe 8" VALUE 0x814B26 ME7_FW1 0 dez 0.000000 255.000000 /end CHARACTERISTIC
/begin CHARACTERISTIC CLAFP1P "Fehlerklasse: Poti 1, Fahrpedal" VALUE 0x814B27 ME7_FW1 0 dez 0.000000 255.000000 /end CHARACTERISTIC
/begin CHARACTERISTIC CLAFP2P "Fehlerklasse: Poti 2, Fahrpedal" VALUE 0x814B28 ME7_FW1 0 dez 0.000000 255.000000 /end CHARACTERISTIC
/begin CHARACTERISTIC CLAFPP "Fehlerklasse: Poti Fahrpedal" VALUE 0x814B29 ME7_FW1 0 dez 0.000000 255.000000 /end CHARACTERISTIC
/begin CHARACTERISTIC CLAFRAO "Fehlerklasse: LR-Adaption oberer Bereich" VALUE 0x814B2A ME7_FW1 0 dez 0.000000 255.000000 /end CHARACTERISTIC
/begin CHARACTERISTIC CLAFRAU "Fehlerklasse: LR-Adaption unterer Bereich" VALUE 0x814B2B ME7_FW1 0 dez 0.000000 255.000000 /end CHARACTERISTIC
/begin CHARACTERISTIC CLAFRST "Fehlerklasse: LR-Abweichung" VALUE 0x814B2C ME7_FW1 0 dez 0.000000 255.000000 /end CHARACTERISTIC
/begin CHARACTERISTIC CLAGECOD "" VALUE 0x814B2D ME7_FW1 0 dez 0.000000 255.000000 /end CHARACTERISTIC
/begin CHARACTERISTIC CLAGRBH "Fehlerklasse: GRA- Bedienhebel" VALUE 0x814B2E ME7_FW1 0 dez 0.000000 255.000000 /end CHARACTERISTIC
/begin CHARACTERISTIC CLAHSH "Fehlerklasse: Heizung Lambdasonde hinter Kat" VALUE 0x814B2F ME7_FW1 0 dez 0.000000 255.000000 /end CHARACTERISTIC
/begin CHARACTERISTIC CLAHSHE "Fehlerklasse: Endstufe Heizung Lambdasonde hinter Kat" VALUE 0x814B30 ME7_FW1 0 dez 0.000000 255.000000 /end CHARACTERISTIC
/begin CHARACTERISTIC CLAHSHE2 "Fehlerklasse: Endstufe Heizung Lambdasonde 2 hinter Kat" VALUE 0x814B31 ME7_FW1 0 dez 0.000000 255.000000 /end CHARACTERISTIC
/begin CHARACTERISTIC CLAHSV "Fehlerklasse: Heizung Lambdasonde vor Kat" VALUE 0x814B32 ME7_FW1 0 dez 0.000000 255.000000 /end CHARACTERISTIC
/begin CHARACTERISTIC CLAHSV2 "Fehlerklasse: Heizung Lambdasonde 2 vor Kat" VALUE 0x814B33 ME7_FW1 0 dez 0.000000 255.000000 /end CHARACTERISTIC
/begin CHARACTERISTIC CLAKAT "Fehlerklasse: Katalysator" VALUE 0x814B34 ME7_FW1 0 dez 0.000000 255.000000 /end CHARACTERISTIC
/begin CHARACTERISTIC CLAKPE "Fehlerklasse: EKP-Relais Endstufe" VALUE 0x814B35 ME7_FW1 0 dez 0.000000 255.000000 /end CHARACTERISTIC
/begin CHARACTERISTIC CLAKRA01 "Fehlerklasse: Klopfregelanschlag Zylinder 1" VALUE 0x814B36 ME7_FW1 0 dez 0.000000 255.000000 /end CHARACTERISTIC
/begin CHARACTERISTIC CLAKRA02 "Fehlerklasse: Klopfregelanschlag Zylinder 2" VALUE 0x814B37 ME7_FW1 0 dez 0.000000 255.000000 /end CHARACTERISTIC
/begin CHARACTERISTIC CLAKRA03 "Fehlerklasse: Klopfregelanschlag Zylinder 3" VALUE 0x814B38 ME7_FW1 0 dez 0.000000 255.000000 /end CHARACTERISTIC
/begin CHARACTERISTIC CLAKRA04 "Fehlerklasse: Klopfregelanschlag Zylinder 4" VALUE 0x814B39 ME7_FW1 0 dez 0.000000 255.000000 /end CHARACTERISTIC
/begin CHARACTERISTIC CLAKRA05 "Fehlerklasse: Klopfregelanschlag Zylinder 5" VALUE 0x814B3A ME7_FW1 0 dez 0.000000 255.000000 /end CHARACTERISTIC
/begin CHARACTERISTIC CLAKRA06 "Fehlerklasse: Klopfregelanschlag Zylinder 6" VALUE 0x814B3B ME7_FW1 0 dez 0.000000 255.000000 /end CHARACTERISTIC
/begin CHARACTERISTIC CLAKRA07 "Fehlerklasse: Klopfregelanschlag Zylinder 7" VALUE 0x814B3C ME7_FW1 0 dez 0.000000 255.000000 /end CHARACTERISTIC
/begin CHARACTERISTIC CLAKRA08 "Fehlerklasse: Klopfregelanschlag Zylinder 8" VALUE 0x814B3D ME7_FW1 0 dez 0.000000 255.000000 /end CHARACTERISTIC
/begin CHARACTERISTIC CLAKRNT "Fehlerklasse: Klopfregelung Nulltest" VALUE 0x814B3E ME7_FW1 0 dez 0.000000 255.000000 /end CHARACTERISTIC
/begin CHARACTERISTIC CLAKROF "Fehlerklasse: Klopfreglung Offset" VALUE 0x814B3F ME7_FW1 0 dez 0.000000 255.000000 /end CHARACTERISTIC
/begin CHARACTERISTIC CLAKRTP "Fehlerklasse: Klopfregelung Testimpuls" VALUE 0x814B40 ME7_FW1 0 dez 0.000000 255.000000 /end CHARACTERISTIC
/begin CHARACTERISTIC CLAKS1 "Fehlerklasse: Klopfsensor 1" VALUE 0x814B41 ME7_FW1 0 dez 0.000000 255.000000 /end CHARACTERISTIC
/begin CHARACTERISTIC CLAKS2 "Fehlerklasse: Klopfsensor 2" VALUE 0x814B42 ME7_FW1 0 dez 0.000000 255.000000 /end CHARACTERISTIC
/begin CHARACTERISTIC CLAKS3 "Fehlerklasse: Klopfsensor 3" VALUE 0x814B43 ME7_FW1 0 dez 0.000000 255.000000 /end CHARACTERISTIC
/begin CHARACTERISTIC CLAKS4 "Fehlerklasse: Klopfsensor 4" VALUE 0x814B44 ME7_FW1 0 dez 0.000000 255.000000 /end CHARACTERISTIC
/begin CHARACTERISTIC CLAKUPPL "Fehlerklasse: Pedalwertgeber Kupplung" VALUE 0x814B45 ME7_FW1 0 dez 0.000000 255.000000 /end CHARACTERISTIC
/begin CHARACTERISTIC CLALASH "Fehlerklasse: Lambdasondenalterung hinter Kat" VALUE 0x814B46 ME7_FW1 0 dez 0.000000 255.000000 /end CHARACTERISTIC
/begin CHARACTERISTIC CLALASH2 "Fehlerklasse: Lambdasondenalterung hinter Kat Bank2" VALUE 0x814B47 ME7_FW1 0 dez 0.000000 255.000000 /end CHARACTERISTIC
/begin CHARACTERISTIC CLALATP "Fehlerklasse: Lambda Sondenalterung vor Kat Tp" VALUE 0x814B48 ME7_FW1 0 dez 0.000000 255.000000 /end CHARACTERISTIC
/begin CHARACTERISTIC CLALATP2 "Fehlerklasse: Lambda Sondenalterung vor Kat Tp Bank2" VALUE 0x814B49 ME7_FW1 0 dez 0.000000 255.000000 /end CHARACTERISTIC
/begin CHARACTERISTIC CLALATV "Fehlerklasse: Lambda Sondenalterung vor Kat Tv" VALUE 0x814B4A ME7_FW1 0 dez 0.000000 255.000000 /end CHARACTERISTIC
/begin CHARACTERISTIC CLALATV2 "Fehlerklasse: Lambda Sondenalterung vor Kat Tv Bank2" VALUE 0x814B4B ME7_FW1 0 dez 0.000000 255.000000 /end CHARACTERISTIC
/begin CHARACTERISTIC CLALDE "Fehlerklasse: LDR-Taktventil Endstufe" VALUE 0x814B4C ME7_FW1 0 dez 0.000000 255.000000 /end CHARACTERISTIC
/begin CHARACTERISTIC CLALDO "Fehlerklasse: LDR öberladefehler" VALUE 0x814B4D ME7_FW1 0 dez 0.000000 255.000000 /end CHARACTERISTIC
/begin CHARACTERISTIC CLALDP "Fehlerklasse: Leckdiagnosepumpe" VALUE 0x814B4E ME7_FW1 0 dez 0.000000 255.000000 /end CHARACTERISTIC
/begin CHARACTERISTIC CLALDPE "Fehlerklasse: LDP  Endstufe" VALUE 0x814B4F ME7_FW1 0 dez 0.000000 255.000000 /end CHARACTERISTIC
/begin CHARACTERISTIC CLALDRA "Fehlerklasse: LDR Regelabweichungsfehler" VALUE 0x814B50 ME7_FW1 0 dez 0.000000 255.000000 /end CHARACTERISTIC
/begin CHARACTERISTIC CLALLR "Fehlerklasse: Leerlaufregelung" VALUE 0x814B51 ME7_FW1 0 dez 0.000000 255.000000 /end CHARACTERISTIC
/begin CHARACTERISTIC CLALM "Fehlerklasse: HauptfÅllungssignal" VALUE 0x814B52 ME7_FW1 0 dez 0.000000 255.000000 /end CHARACTERISTIC
/begin CHARACTERISTIC CLALSH "Fehlerklasse: Lambdasonde hinter Kat" VALUE 0x814B53 ME7_FW1 0 dez 0.000000 255.000000 /end CHARACTERISTIC
/begin CHARACTERISTIC CLALSV "Fehlerklasse: Lambdasonde vor Kat" VALUE 0x814B54 ME7_FW1 0 dez 0.000000 255.000000 /end CHARACTERISTIC
/begin CHARACTERISTIC CLAMD "Fehlerklasse:  Aussetzer, Summenfehler (multiple)" VALUE 0x814B55 ME7_FW1 0 dez 0.000000 255.000000 /end CHARACTERISTIC
/begin CHARACTERISTIC CLAMD01 "Fehlerklasse:  Aussetzer Zyl. 1" VALUE 0x814B56 ME7_FW1 0 dez 0.000000 255.000000 /end CHARACTERISTIC
/begin CHARACTERISTIC CLAMD02 "Fehlerklasse:  Aussetzer Zylinder 2" VALUE 0x814B57 ME7_FW1 0 dez 0.000000 255.000000 /end CHARACTERISTIC
/begin CHARACTERISTIC CLAMD03 "Fehlerklasse:  Aussetzer Zylinder 3" VALUE 0x814B58 ME7_FW1 0 dez 0.000000 255.000000 /end CHARACTERISTIC
/begin CHARACTERISTIC CLAMD04 "Fehlerklasse:  Aussetzer Zylinder 4" VALUE 0x814B59 ME7_FW1 0 dez 0.000000 255.000000 /end CHARACTERISTIC
/begin CHARACTERISTIC CLAMDB "Fehlerklasse: Momentbgrenzung Sollmoment" VALUE 0x814B5A ME7_FW1 0 dez 0.000000 255.000000 /end CHARACTERISTIC
/begin CHARACTERISTIC CLAMDK "Fehlerklasse:  Aussetzer, Summenfehler - multiple, kundendienstrelevant" VALUE 0x814B5B ME7_FW1 0 dez 0.000000 255.000000 /end CHARACTERISTIC
/begin CHARACTERISTIC CLAMDK01 "Fehlerklasse:  Aussetzer, Zylinder 1, kundendienstrelevant" VALUE 0x814B5C ME7_FW1 0 dez 0.000000 255.000000 /end CHARACTERISTIC
/begin CHARACTERISTIC CLAMDK02 "Fehlerklasse:  Aussetzer, Zylinder 2, kundendienstrelevant" VALUE 0x814B5D ME7_FW1 0 dez 0.000000 255.000000 /end CHARACTERISTIC
/begin CHARACTERISTIC CLAMDK03 "Fehlerklasse:  Aussetzer, Zylinder 3, kundendienstrelevant" VALUE 0x814B5E ME7_FW1 0 dez 0.000000 255.000000 /end CHARACTERISTIC
/begin CHARACTERISTIC CLAMDK04 "Fehlerklasse:  Aussetzer, Zylinder 4, kundendienstrelevant" VALUE 0x814B5F ME7_FW1 0 dez 0.000000 255.000000 /end CHARACTERISTIC
/begin CHARACTERISTIC CLAMILE "Fehlerklasse: MIL-Endstufe" VALUE 0x814B60 ME7_FW1 0 dez 0.000000 255.000000 /end CHARACTERISTIC
/begin CHARACTERISTIC CLAN "Fehlerklasse: Drehzahlgeber" VALUE 0x814B61 ME7_FW1 0 dez 0.000000 255.000000 /end CHARACTERISTIC
/begin CHARACTERISTIC CLANWKW "Fehlerklasse: Zuordnung Nockenwelle zu Kurbelwelle" VALUE 0x814B62 ME7_FW1 0 dez 0.000000 255.000000 /end CHARACTERISTIC
/begin CHARACTERISTIC CLANWKW2 "Fehlerklasse: Zuordnung Nockenwelle 2 zu Kurbelwelle" VALUE 0x814B63 ME7_FW1 0 dez 0.000000 255.000000 /end CHARACTERISTIC
/begin CHARACTERISTIC CLANWS "Fehlerklasse: Nockenwellensteuerung" VALUE 0x814B64 ME7_FW1 0 dez 0.000000 255.000000 /end CHARACTERISTIC
/begin CHARACTERISTIC CLANWS2 "Fehlerklasse: Nockenwellensteuerung Bank 2" VALUE 0x814B65 ME7_FW1 0 dez 0.000000 255.000000 /end CHARACTERISTIC
/begin CHARACTERISTIC CLANWSE "Fehlerklasse: Nockenwellensteuerungsventil Endstufe" VALUE 0x814B66 ME7_FW1 0 dez 0.000000 255.000000 /end CHARACTERISTIC
/begin CHARACTERISTIC CLANX "Fehlerklasse: ^NMAX- öberschreitung" VALUE 0x814B67 ME7_FW1 0 dez 0.000000 255.000000 /end CHARACTERISTIC
/begin CHARACTERISTIC CLAPH "Fehlerklasse: Phasengeber" VALUE 0x814B68 ME7_FW1 0 dez 0.000000 255.000000 /end CHARACTERISTIC
/begin CHARACTERISTIC CLAPWM "" VALUE 0x814B69 ME7_FW1 0 dez 0.000000 255.000000 /end CHARACTERISTIC
/begin CHARACTERISTIC CLARKAT "Fehlerklasse: LR-Adaption additiver Bereich pro Zeit" VALUE 0x814B6A ME7_FW1 0 dez 0.000000 255.000000 /end CHARACTERISTIC
/begin CHARACTERISTIC CLARKAZ "Fehlerklasse: LR-Adaption additiver Bereich pro ZÅndung" VALUE 0x814B6B ME7_FW1 0 dez 0.000000 255.000000 /end CHARACTERISTIC
/begin CHARACTERISTIC CLASGEEW "Fehlerklasse: SG defekt (EEPROM WFS- Bereich)" VALUE 0x814B6C ME7_FW1 0 dez 0.000000 255.000000 /end CHARACTERISTIC
/begin CHARACTERISTIC CLASLPE "Fehlerklasse: SekundÑrluftpumpe Endstufe" VALUE 0x814B6D ME7_FW1 0 dez 0.000000 255.000000 /end CHARACTERISTIC
/begin CHARACTERISTIC CLASLS "Fehlerklasse: SekundÑrluftsystem" VALUE 0x814B6E ME7_FW1 0 dez 0.000000 255.000000 /end CHARACTERISTIC
/begin CHARACTERISTIC CLASLV "Fehlerklasse: Dichtheit SekundÑrluftventil" VALUE 0x814B6F ME7_FW1 0 dez 0.000000 255.000000 /end CHARACTERISTIC
/begin CHARACTERISTIC CLASLVE "Fehlerklasse: SekundÑrluftventil Endstufe" VALUE 0x814B70 ME7_FW1 0 dez 0.000000 255.000000 /end CHARACTERISTIC
/begin CHARACTERISTIC CLASLWG "FEhlerklasse: Waste- Gate- Ansteuerung" VALUE 0x814B71 ME7_FW1 0 dez 0.000000 255.000000 /end CHARACTERISTIC
/begin CHARACTERISTIC CLASUE "Fehlerklasse: Saugrohrumschaltung Endstufe" VALUE 0x814B72 ME7_FW1 0 dez 0.000000 255.000000 /end CHARACTERISTIC
/begin CHARACTERISTIC CLASWE "Fehlerklasse: Beschleunigungssensor der Schlechtwegerkennung" VALUE 0x814B73 ME7_FW1 0 dez 0.000000 255.000000 /end CHARACTERISTIC
/begin CHARACTERISTIC CLATA "Fehlerklasse: Ansauglufttemperatur TANS (/Ladeluft-)" VALUE 0x814B74 ME7_FW1 0 dez 0.000000 255.000000 /end CHARACTERISTIC
/begin CHARACTERISTIC CLATANKL "Fehlerklasse : tankl (Tank leer)" VALUE 0x814B75 ME7_FW1 0 dez 0.000000 255.000000 /end CHARACTERISTIC
/begin CHARACTERISTIC CLATES "Fehlerklasse: Tankdiagnose, TEV offen" VALUE 0x814B76 ME7_FW1 0 dez 0.000000 255.000000 /end CHARACTERISTIC
/begin CHARACTERISTIC CLATESF "Fehlerklasse: Tankdiagnose, Feinleck" VALUE 0x814B77 ME7_FW1 0 dez 0.000000 255.000000 /end CHARACTERISTIC
/begin CHARACTERISTIC CLATESG "Fehlerklasse: Tankdiagnose, Grobleck" VALUE 0x814B78 ME7_FW1 0 dez 0.000000 255.000000 /end CHARACTERISTIC
/begin CHARACTERISTIC CLATEVE "Fehlerklasse: TankentlÅftungsventil Endstufe" VALUE 0x814B79 ME7_FW1 0 dez 0.000000 255.000000 /end CHARACTERISTIC
/begin CHARACTERISTIC CLATEVE2 "Fehlerklasse: TankentlÅftungsventil Endstufe Bank 2" VALUE 0x814B7A ME7_FW1 0 dez 0.000000 255.000000 /end CHARACTERISTIC
/begin CHARACTERISTIC CLATM "Fehlerklasse: Motortemperatur TMOT" VALUE 0x814B7B ME7_FW1 0 dez 0.000000 255.000000 /end CHARACTERISTIC
/begin CHARACTERISTIC CLATOL "Fehlerklasse: (Motor-) Oeltemperatur TOL" VALUE 0x814B7C ME7_FW1 0 dez 0.000000 255.000000 /end CHARACTERISTIC
/begin CHARACTERISTIC CLATUM "Fehlerklasse: Umgebungstemperatur TUM" VALUE 0x814B7D ME7_FW1 0 dez 0.000000 255.000000 /end CHARACTERISTIC
/begin CHARACTERISTIC CLATUN "Fehlerklasse: Tuningschutz" VALUE 0x814B7E ME7_FW1 0 dez 0.000000 255.000000 /end CHARACTERISTIC
/begin CHARACTERISTIC CLAUB "Fehlerklasse: Batteriespannung UB (Bordnetz)" VALUE 0x814B7F ME7_FW1 0 dez 0.000000 255.000000 /end CHARACTERISTIC
/begin CHARACTERISTIC CLAUFMV "Fehlerklasse: FunktionsÅberwachung: Momentenvergleich" VALUE 0x814B80 ME7_FW1 0 dez 0.000000 255.000000 /end CHARACTERISTIC
/begin CHARACTERISTIC CLAUFSKA "Fehlerklasse: FunktionsÅberwachung: Sicherheits-Kraftstoff-Abschaltung" VALUE 0x814B81 ME7_FW1 0 dez 0.000000 255.000000 /end CHARACTERISTIC
/begin CHARACTERISTIC CLAURRAM "Fehlerklasse: RechnerÅberwachung: RAM" VALUE 0x814B82 ME7_FW1 0 dez 0.000000 255.000000 /end CHARACTERISTIC
/begin CHARACTERISTIC CLAURROM "Fehlerklasse: RechnerÅberwachung: ROM" VALUE 0x814B83 ME7_FW1 0 dez 0.000000 255.000000 /end CHARACTERISTIC
/begin CHARACTERISTIC CLAURRST "Fehlerklasse: RechnerÅberwachung: Reset" VALUE 0x814B84 ME7_FW1 0 dez 0.000000 255.000000 /end CHARACTERISTIC
/begin CHARACTERISTIC CLAUVSE "Fehlerklasse: Endstufe Umluftventil Turbo" VALUE 0x814B85 ME7_FW1 0 dez 0.000000 255.000000 /end CHARACTERISTIC
/begin CHARACTERISTIC CLAVFZ "Fehlerklasse: Geschwindigkeitssignal" VALUE 0x814B86 ME7_FW1 0 dez 0.000000 255.000000 /end CHARACTERISTIC
/begin CHARACTERISTIC CLAWFS "Fehlerklasse: Wegfahrsperre" VALUE 0x814B87 ME7_FW1 0 dez 0.000000 255.000000 /end CHARACTERISTIC
/begin CHARACTERISTIC CLAWFSRC "" VALUE 0x814B88 ME7_FW1 0 dez 0.000000 255.000000 /end CHARACTERISTIC
/begin CHARACTERISTIC CLAZET1 "" VALUE 0x814B89 ME7_FW1 0 dez 0.000000 255.000000 /end CHARACTERISTIC
/begin CHARACTERISTIC CLAZET2 "" VALUE 0x814B8A ME7_FW1 0 dez 0.000000 255.000000 /end CHARACTERISTIC
/begin CHARACTERISTIC CLAZET3 "" VALUE 0x814B8B ME7_FW1 0 dez 0.000000 255.000000 /end CHARACTERISTIC
/begin CHARACTERISTIC CLAZET4 "" VALUE 0x814B8C ME7_FW1 0 dez 0.000000 255.000000 /end CHARACTERISTIC
/begin CHARACTERISTIC CLAZET5 "" VALUE 0x814B8D ME7_FW1 0 dez 0.000000 255.000000 /end CHARACTERISTIC
/begin CHARACTERISTIC CLAZET6 "" VALUE 0x814B8E ME7_FW1 0 dez 0.000000 255.000000 /end CHARACTERISTIC
/begin CHARACTERISTIC CLAZET7 "" VALUE 0x814B8F ME7_FW1 0 dez 0.000000 255.000000 /end CHARACTERISTIC
/begin CHARACTERISTIC CLAZET8 "" VALUE 0x814B90 ME7_FW1 0 dez 0.000000 255.000000 /end CHARACTERISTIC
/begin CHARACTERISTIC CLAZZZ "Dummy: Tabellenende" VALUE 0x814B91 ME7_FW1 0 dez 0.000000 255.000000 /end CHARACTERISTIC
/begin CHARACTERISTIC CLDPAAV "Codewort Elektrisches AAV vorhanden" VALUE 0x815E48 ME7_FW1 0 dez 0.000000 255.000000 /end CHARACTERISTIC
/begin CHARACTERISTIC CLDPTVC "Codewort DLDP-TEV- Check" VALUE 0x819C3F ME7_FW1 0 dez 0.000000 255.000000 /end CHARACTERISTIC
/begin CHARACTERISTIC CLRHK "Codewort fÅr Lambda - Regelung hinter Kat ein/aus" VALUE 0x815E9B ME7_FW1 0 dez 0.000000 255.000000 /end CHARACTERISTIC
/begin CHARACTERISTIC CLRKA "Codewort fÅr Funktion O2-Kat-AusrÑumen" VALUE 0x815E8D ME7_FW1 0 dez 0.000000 255.000000 /end CHARACTERISTIC
/begin CHARACTERISTIC CLRMSFS "Codewort fÅr Lambda - Regelung Mager-/Fettschutz ein/aus" VALUE 0x815E8A ME7_FW1 0 dez 0.000000 255.000000 /end CHARACTERISTIC
/begin CHARACTERISTIC CLRZWTMS "Codewort Zwangseinschaltung LR gemÑ· CARB-Forderung" VALUE 0x819C72 ME7_FW1 0 dez 0.000000 255.000000 /end CHARACTERISTIC
/begin CHARACTERISTIC CLSDKH "Codewort fÅr LSD-Abschaltung bei Kat. heizen" VALUE 0x815EE0 ME7_FW1 0 dez 0.000000 255.000000 /end CHARACTERISTIC
/begin CHARACTERISTIC CMSR_DAT_UC "" VAL_BLK 0x815ADA ME7_FWB1 0 rel_ub_q0p3906___UB 0.000000 99.609400 NUMBER 16 EXTENDED_LIMITS 0.000000 99.609375 /end CHARACTERISTIC
/begin CHARACTERISTIC CNFKUPPL "Konfigurationsflag fÅr die Auswertung des Kuplg.schalters in der LLR" VALUE 0x8155D4 ME7_FW1 0 dez 0.000000 255.000000 /end CHARACTERISTIC
/begin CHARACTERISTIC CNFLLRNS "Configurationsbyte fÅr die LL-Solldrehzahlfreigabe" VALUE 0x8197B2 ME7_FW1 0 dez 0.000000 255.000000 /end CHARACTERISTIC
/begin CHARACTERISTIC CNFMDVER "Codewort zur Konfiguration von MDVER" VALUE 0x8198E3 ME7_FW1 0 dez 0.000000 255.000000 /end CHARACTERISTIC
/begin CHARACTERISTIC CNFMDWAN "Codewort fÅr die Einberechnung von MDWAN in der LLR" VALUE 0x815574 ME7_FW1 0 dez 0.000000 255.000000 /end CHARACTERISTIC
/begin CHARACTERISTIC CNFSL "Codewort fÅr Einberechnung der Servolenkung in der LLR" VALUE 0x8156DC ME7_FW1 0 dez 0.000000 255.000000 /end CHARACTERISTIC
/begin CHARACTERISTIC CNOKT "Codewort Niederoktan-Kraftstoff" VALUE 0x819E40 ME7_FW1 0 dez 0.000000 255.000000 /end CHARACTERISTIC
/begin CHARACTERISTIC CNSDEF "Codewort fÅr Solldrehzahlumschaltung (Defaultwert)" VALUE 0x815445 ME7_FW1 0 dez 0.000000 255.000000 /end CHARACTERISTIC
/begin CHARACTERISTIC CNS_AOG "oberer Grenzwert Anpassung Codewort LL-Solldrehzahl-Umsch." VALUE 0x815446 ME7_FW1 0 dez 0.000000 255.000000 /end CHARACTERISTIC
/begin CHARACTERISTIC CNS_AUG "unterer Grenzwert Anpassung Codewort LL-Solldrehzahl-Umsch." VALUE 0x815447 ME7_FW1 0 dez 0.000000 255.000000 /end CHARACTERISTIC
/begin CHARACTERISTIC CPLRA "Codewort fÅr Umschaltung DKVS von HFM- auf P-System" VALUE 0x818E15 ME7_FW1 0 dez 0.000000 255.000000 /end CHARACTERISTIC
/begin CHARACTERISTIC CREDSTU "Codewort fÅr Reduzierstufe ein/aus" VALUE 0x815983 ME7_FW1 0 dez 0.000000 255.000000 /end CHARACTERISTIC
/begin CHARACTERISTIC CSCATT "Eurobyte fÅr SCAN-Tool" VALUE 0x81431A ME7_FW1 0 dez 0.000000 255.000000 /end CHARACTERISTIC
/begin CHARACTERISTIC CSGRA "Checksumme fÅr GRA-Can-Botschaft" VALUE 0x8144D8 ME7_FW1 0 DEZ 0.000000 255.000000 /end CHARACTERISTIC
/begin CHARACTERISTIC CUKA "Codewort öK-Adaption" VALUE 0x8153F1 ME7_FW1 0 dez 0.000000 255.000000 /end CHARACTERISTIC
/begin CHARACTERISTIC CWAGRT "Codewort fÅr Abgastemperaturmodell in BGAGR einrechnen ein/aus" VALUE 0x8186CE ME7_FW1 0 dez 0.000000 255.000000 /end CHARACTERISTIC
/begin CHARACTERISTIC CWARMD "Codewort Antiruckelfunktion" VALUE 0x8156E9 ME7_FW1 0 dez 0.000000 255.000000 /end CHARACTERISTIC
/begin CHARACTERISTIC CWBAESEL "Codewort fÅr Umschaltung Bergaberkennung usw." VALUE 0x815E49 ME7_FW1 0 dez 0.000000 255.000000 /end CHARACTERISTIC
/begin CHARACTERISTIC CWBBFGR "Codewort fÅr BBFGR" VALUE 0x814FEB ME7_FW1 0 dez 0.000000 255.000000 /end CHARACTERISTIC
/begin CHARACTERISTIC CWBBKD "Codewort fÅr %BBKD" VALUE 0x814DD4 ME7_FW1 0 dez 0.000000 255.000000 /end CHARACTERISTIC
/begin CHARACTERISTIC CWBGWPFGR "Codewort fÅr %BGWPFGR" VALUE 0x8185DF ME7_FW1 0 dez 0.000000 255.000000 /end CHARACTERISTIC
/begin CHARACTERISTIC CWBWEEN "Codewort zur Deaktivierung der Bewegungserkennung" VALUE 0x814DB4 ME7_FW1 0 dez 0.000000 255.000000 /end CHARACTERISTIC
/begin CHARACTERISTIC CWCKBI "Codewort zum Empfang der CAN-Botschaft Kombi1" VALUE 0x819FC1 ME7_FW1 0 dez 0.000000 255.000000 /end CHARACTERISTIC
/begin CHARACTERISTIC CWDEGFE "Codewort fÅr Abschaltung der Funktion %DEGFE" VALUE 0x81874F ME7_FW1 0 dez 0.000000 255.000000 /end CHARACTERISTIC
/begin CHARACTERISTIC CWDKNOLU "" VALUE 0x81859D ME7_FW1 0 dez 0.000000 255.000000 /end CHARACTERISTIC
/begin CHARACTERISTIC CWDKS1 "Codewort: Klopfsensordiagnose Sensor1" VALUE 0x819453 ME7_FW1 0 dez 0.000000 255.000000 /end CHARACTERISTIC
/begin CHARACTERISTIC CWDKS2 "Codewort: Klopfsensordiagnose Sensor 2" VALUE 0x819454 ME7_FW1 0 dez 0.000000 255.000000 /end CHARACTERISTIC
/begin CHARACTERISTIC CWDKS3 "Codewort: Klopfsensordiagnose Sensor 3" VALUE 0x819455 ME7_FW1 0 dez 0.000000 255.000000 /end CHARACTERISTIC
/begin CHARACTERISTIC CWDKS4 "Codewort: Klopfsensordiagnose Sensor 4" VALUE 0x819456 ME7_FW1 0 dez 0.000000 255.000000 /end CHARACTERISTIC
/begin CHARACTERISTIC CWDLRIKL "" VALUE 0x814ECF ME7_FW1 0 dez 0.000000 255.000000 /end CHARACTERISTIC
/begin CHARACTERISTIC CWDLSA "Codewort fÅr EinmalprÅfung Alterung Sonde vor KAT fÅr Applikationszwecke" VALUE 0x81852F ME7_FW1 0 dez 0.000000 255.000000 /end CHARACTERISTIC
/begin CHARACTERISTIC CWDLSAHK "Codewort fÅr EinmalprÅfung Alterung Sonde hinter KAT fÅr Applikationszwecke" VALUE 0x8184BC ME7_FW1 0 dez 0.000000 255.000000 /end CHARACTERISTIC
/begin CHARACTERISTIC CWDMFAB "Codewort Sw-Schalter fÅr énderungsbegrenzung" VALUE 0x815703 ME7_FW1 0 DEZ 0.000000 255.000000 /end CHARACTERISTIC
/begin CHARACTERISTIC CWDNMAX "Codeword: Abschaltung Diagnose öberdrehzahl" VALUE 0x814D72 ME7_FW1 0 dez 0.000000 255.000000 /end CHARACTERISTIC
/begin CHARACTERISTIC CWDSLSY "Codewort in der Diagnose SekundÑrluftsystem" VALUE 0x81836F ME7_FW1 0 dez 0.000000 255.000000 /end CHARACTERISTIC
/begin CHARACTERISTIC CWDTEAPP "Applikationscodeword fÅr DTEV immer aktiv und Umschaltung von HFM auf P-System" VALUE 0x819BD0 ME7_FW1 0 dez 0.000000 255.000000 /end CHARACTERISTIC
/begin CHARACTERISTIC CWDVMX "Codewort SW-Schalter fÅr Integratorinit. bei VMAX-Regelung" VALUE 0x815A57 ME7_FW1 0 dez 0.000000 255.000000 /end CHARACTERISTIC
/begin CHARACTERISTIC CWERFIL "Codewort zur Auswahl Filtervar. fÅr die Ausgabe von AS.-Fehler an das Scan Tool" VALUE 0x81431B ME7_FW1 0 dez 0.000000 255.000000 /end CHARACTERISTIC
/begin CHARACTERISTIC CWESWEZ "Codewort Freigabe Kraftstoffmehrmenge bei Wiedereinsetzen" VALUE 0x8185A6 ME7_FW1 0 dez 0.000000 255.000000 /end CHARACTERISTIC
/begin CHARACTERISTIC CWFA190 "Codewort Kurztripanforderungen Anzeigegruppe 190" VALUE 0x81C040 ME7_FW3 0 dez___UW 0.000000 65535.000000 /end CHARACTERISTIC
/begin CHARACTERISTIC CWFA191 "Codewort Kurztripanforderungen Anzeigegruppe 191" VALUE 0x81C042 ME7_FW3 0 dez___UW 0.000000 65535.000000 /end CHARACTERISTIC
/begin CHARACTERISTIC CWFA192 "Codewort Kurztripanforderungen Anzeigegruppe 192" VALUE 0x81C044 ME7_FW3 0 dez___UW 0.000000 65535.000000 /end CHARACTERISTIC
/begin CHARACTERISTIC CWFA193 "Codewort Kurztripanforderungen Anzeigegruppe 193" VALUE 0x81C046 ME7_FW3 0 dez___UW 0.000000 65535.000000 /end CHARACTERISTIC
/begin CHARACTERISTIC CWFA194 "Codewort Kurztripanforderungen Anzeigegruppe 194" VALUE 0x81C048 ME7_FW3 0 dez___UW 0.000000 65535.000000 /end CHARACTERISTIC
/begin CHARACTERISTIC CWFA195 "Codewort Kurztripanforderungen Anzeigegruppe 195" VALUE 0x81C04A ME7_FW3 0 dez___UW 0.000000 65535.000000 /end CHARACTERISTIC
/begin CHARACTERISTIC CWFA196 "Codewort Kurztripanforderungen Anzeigegruppe 196" VALUE 0x81C04C ME7_FW3 0 dez___UW 0.000000 65535.000000 /end CHARACTERISTIC
/begin CHARACTERISTIC CWFA197 "Codewort Kurztripanforderungen Anzeigegruppe 197" VALUE 0x81C04E ME7_FW3 0 dez___UW 0.000000 65535.000000 /end CHARACTERISTIC
/begin CHARACTERISTIC CWFA198 "Codewort Kurztripanforderungen Anzeigegruppe 198" VALUE 0x81C050 ME7_FW3 0 dez___UW 0.000000 65535.000000 /end CHARACTERISTIC
/begin CHARACTERISTIC CWFA199 "Codewort Kurztripanforderungen Anzeigegruppe 199" VALUE 0x81C052 ME7_FW3 0 dez___UW 0.000000 65535.000000 /end CHARACTERISTIC
/begin CHARACTERISTIC CWFA201 "Codewort Kurztripanforderung Anzeigegruppe 201" VALUE 0x81C054 ME7_FW3 0 dez___UW 0.000000 65535.000000 /end CHARACTERISTIC
/begin CHARACTERISTIC CWFA202 "Codewort Kurztripanforderung Anzeigegruppe 202" VALUE 0x81C056 ME7_FW3 0 dez___UW 0.000000 65535.000000 /end CHARACTERISTIC
/begin CHARACTERISTIC CWFA203 "Codewort Kurztripanforderung Anzeigegruppe 203" VALUE 0x81C058 ME7_FW3 0 dez___UW 0.000000 65535.000000 /end CHARACTERISTIC
/begin CHARACTERISTIC CWFA204 "Codewort Kurztripanforderung Anzeigegruppe 204" VALUE 0x81C05A ME7_FW3 0 dez___UW 0.000000 65535.000000 /end CHARACTERISTIC
/begin CHARACTERISTIC CWFA205 "Codewort Kurztripanforderung Anzeigegruppe 205" VALUE 0x81C05C ME7_FW3 0 dez___UW 0.000000 65535.000000 /end CHARACTERISTIC
/begin CHARACTERISTIC CWFA206 "Codewort Kurztripanforderung Anzeigegruppe 206" VALUE 0x81C05E ME7_FW3 0 dez___UW 0.000000 65535.000000 /end CHARACTERISTIC
/begin CHARACTERISTIC CWFA207 "Codewort Kurztripanforderung Anzeigegruppe 207" VALUE 0x81C060 ME7_FW3 0 dez___UW 0.000000 65535.000000 /end CHARACTERISTIC
/begin CHARACTERISTIC CWFA208 "Codewort Kurztripanforderung Anzeigegruppe 208" VALUE 0x81C062 ME7_FW3 0 dez___UW 0.000000 65535.000000 /end CHARACTERISTIC
/begin CHARACTERISTIC CWFA209 "Codewort Kurztripanforderung Anzeigegruppe 209" VALUE 0x81C064 ME7_FW3 0 dez___UW 0.000000 65535.000000 /end CHARACTERISTIC
/begin CHARACTERISTIC CWFA210 "Codewort Kurztripanforderung Anzeigegruppe 210" VALUE 0x81C066 ME7_FW3 0 dez___UW 0.000000 65535.000000 /end CHARACTERISTIC
/begin CHARACTERISTIC CWFA211 "Codewort Kurztripanforderung Anzeigegruppe 211" VALUE 0x81C068 ME7_FW3 0 dez___UW 0.000000 65535.000000 /end CHARACTERISTIC
/begin CHARACTERISTIC CWFA212 "Codewort Kurztripanforderung Anzeigegruppe 212" VALUE 0x81C06A ME7_FW3 0 dez___UW 0.000000 65535.000000 /end CHARACTERISTIC
/begin CHARACTERISTIC CWFA213 "Codewort Kurtripanforderung Anzeigegruppe 213" VALUE 0x81C06C ME7_FW3 0 dez___UW 0.000000 65535.000000 /end CHARACTERISTIC
/begin CHARACTERISTIC CWFA214 "Codewort Kurztripanforderung Anzeigegruppe 214" VALUE 0x81C06E ME7_FW3 0 dez___UW 0.000000 65535.000000 /end CHARACTERISTIC
/begin CHARACTERISTIC CWFA215 "Codewort Kurztripanforderung Anzeigegruppe 215" VALUE 0x81C070 ME7_FW3 0 dez___UW 0.000000 65535.000000 /end CHARACTERISTIC
/begin CHARACTERISTIC CWFA216 "Codewort Kurztripanforderung Anzeigegruppe 216" VALUE 0x81C072 ME7_FW3 0 dez___UW 0.000000 65535.000000 /end CHARACTERISTIC
/begin CHARACTERISTIC CWFA217 "Codewort Kurztripanforderung Anzeigegruppe 217" VALUE 0x81C074 ME7_FW3 0 dez___UW 0.000000 65535.000000 /end CHARACTERISTIC
/begin CHARACTERISTIC CWFA218 "Codewort Kurztripanforderung Anzeigegruppe 218" VALUE 0x81C076 ME7_FW3 0 dez___UW 0.000000 65535.000000 /end CHARACTERISTIC
/begin CHARACTERISTIC CWFA219 "Codewort Kurztripanforderung Anzeigegruppe 219" VALUE 0x81C078 ME7_FW3 0 dez___UW 0.000000 65535.000000 /end CHARACTERISTIC
/begin CHARACTERISTIC CWFASL "Codewort: Testereingriff SekundÑrluftdiagnose" VALUE 0x8182D9 ME7_FW1 0 dez 0.000000 255.000000 /end CHARACTERISTIC
/begin CHARACTERISTIC CWFGRMD "Codewort fÅr FGRMD" VALUE 0x8185BB ME7_FW1 0 dez 0.000000 255.000000 /end CHARACTERISTIC
/begin CHARACTERISTIC CWFKMSDKA "Codewort fÅr Massenstromadaption aktiv" VALUE 0x8150DC ME7_FW1 0 dez 0.000000 255.000000 /end CHARACTERISTIC
/begin CHARACTERISTIC CWFUEREG "Codewort FÅllungsregler au·erhalb Leerlauf aktiv" VALUE 0x815103 ME7_FW1 0 dez 0.000000 255.000000 /end CHARACTERISTIC
/begin CHARACTERISTIC CWGC_0_A "Getriebe-Codierung (CAN)" VALUE 0x816EAA ME7_FW1 0 DEZ 0.000000 255.000000 /end CHARACTERISTIC
/begin CHARACTERISTIC CWGC_1_A "Getriebe-Codierung (CAN)" VALUE 0x816EAB ME7_FW1 0 DEZ 0.000000 255.000000 /end CHARACTERISTIC
/begin CHARACTERISTIC CWGC_2_A "Getriebe-Codierung (CAN)" VALUE 0x816EAC ME7_FW1 0 DEZ 0.000000 255.000000 /end CHARACTERISTIC
/begin CHARACTERISTIC CWGC_3_A "Getriebe-Codierung (CAN)" VALUE 0x816EAD ME7_FW1 0 DEZ 0.000000 255.000000 /end CHARACTERISTIC
/begin CHARACTERISTIC CWGEEIN "Codewort fÅr öbernahme der Getriebeanforderung" VALUE 0x8144D9 ME7_FW1 0 DEZ 0.000000 255.000000 /end CHARACTERISTIC
/begin CHARACTERISTIC CWGGEGAS "Codewort fÅr GGEGAS" VALUE 0x814F5E ME7_FW1 0 dez 0.000000 255.000000 /end CHARACTERISTIC
/begin CHARACTERISTIC CWGGFGRH "Codewort  GGFGRH" VALUE 0x814DB3 ME7_FW1 0 dez 0.000000 255.000000 /end CHARACTERISTIC
/begin CHARACTERISTIC CWGGLSH "Codeword fÅr Ri-Auswertung fÅr Sonde hinter KAT (Heizung nicht voll ein)" VALUE 0x8184B0 ME7_FW1 0 dez 0.000000 255.000000 /end CHARACTERISTIC
/begin CHARACTERISTIC CWGGLSV "Codeword fÅr Ri-Auswertung fÅr Sonde vor KAT (Heizung nicht voll ein)" VALUE 0x8184C9 ME7_FW1 0 dez 0.000000 255.000000 /end CHARACTERISTIC
/begin CHARACTERISTIC CWKHMD "Codewort fÅr Drehmomentenreserve bei Katheizen" VALUE 0x81908F ME7_FW1 0 dez 0.000000 255.000000 /end CHARACTERISTIC
/begin CHARACTERISTIC CWKHZ "Codewort fÅr Katheizsteuerung" VALUE 0x819019 ME7_FW1 0 dez 0.000000 255.000000 /end CHARACTERISTIC
/begin CHARACTERISTIC CWKLIMA "Codewort fÅr Klimaanlage" VALUE 0x81431C ME7_FW1 0 dez 0.000000 255.000000 /end CHARACTERISTIC
/begin CHARACTERISTIC CWKONABG "Codewort fÅr Konfiguration Abgasbehandlung" VALUE 0x81431D ME7_FW1 0 dez 0.000000 255.000000 /end CHARACTERISTIC
/begin CHARACTERISTIC CWKONFZ1_0_A "Codewort fÅr Konfiguration Fahrzeug" VALUE 0x8164D2 ME7_FW1 0 dez 0.000000 255.000000 /end CHARACTERISTIC
/begin CHARACTERISTIC CWKONFZ1_1_A "Codewort fÅr Konfiguration Fahrzeug" VALUE 0x8164D3 ME7_FW1 0 dez 0.000000 255.000000 /end CHARACTERISTIC
/begin CHARACTERISTIC CWKONFZ1_2_A "Codewort fÅr Konfiguration Fahrzeug" VALUE 0x8164D4 ME7_FW1 0 dez 0.000000 255.000000 /end CHARACTERISTIC
/begin CHARACTERISTIC CWKONFZ1_3_A "Codewort fÅr Konfiguration Fahrzeug" VALUE 0x8164D5 ME7_FW1 0 dez 0.000000 255.000000 /end CHARACTERISTIC
/begin CHARACTERISTIC CWKONLS "Codewort fÅr Konfiguration Lambda Sonden" VALUE 0x81431E ME7_FW1 0 dez 0.000000 255.000000 /end CHARACTERISTIC
/begin CHARACTERISTIC CWKR "Codewort KR" VALUE 0x819450 ME7_FW1 0 dez 0.000000 1.000000 EXTENDED_LIMITS 0.000000 255.000000 /end CHARACTERISTIC
/begin CHARACTERISTIC CWKRAPP "Codewort fÅr Applikation KR" VALUE 0x819162 ME7_FW1 0 dez 0.000000 255.000000 /end CHARACTERISTIC
/begin CHARACTERISTIC CWKRNLR "Codewort Notlauf KR bei Abfall eines von zwei KS" VALUE 0x819361 ME7_FW1 0 dez 0.000000 255.000000 /end CHARACTERISTIC
/begin CHARACTERISTIC CWKRREF "Codewort: Verhalten ReferenzpegelnachfÅhrung bei Drehzahldynamik" VALUE 0x8191BE ME7_FW1 0 dez 0.000000 1.000000 EXTENDED_LIMITS 0.000000 255.000000 /end CHARACTERISTIC
/begin CHARACTERISTIC CWLAMBTS "Codewort: Lambda Bauteileschutz" VALUE 0x818E22 ME7_FW1 0 dez 0.000000 255.000000 /end CHARACTERISTIC
/begin CHARACTERISTIC CWLAMKH "Codewort Lambdakoordination bei Kat-heizen" VALUE 0x8151C5 ME7_FW1 0 dez 0.000000 255.000000 /end CHARACTERISTIC
/begin CHARACTERISTIC CWLDIMX "Codewort fÅr Applikationsverfahren KFLDIMX/KFLDIOPU" VALUE 0x81945B ME7_FW1 0 dez 0.000000 255.000000 /end CHARACTERISTIC
/begin CHARACTERISTIC CWLSHA "Codewort fÅr Lambdasonden hinter KAT Alterung in %DLSAHK" VALUE 0x81431F ME7_FW1 0 dez 0.000000 255.000000 /end CHARACTERISTIC
/begin CHARACTERISTIC CWMDAPP "Codewort Applikation ohne Drehmomentfunktionen" VALUE 0x814320 ME7_FW1 0 dez 0.000000 255.000000 /end CHARACTERISTIC
/begin CHARACTERISTIC CWMDKOG "Codewort MDKOG: ZÅndwinkelspÑtverstellung bei Unterdruckbegrenzung" VALUE 0x815708 ME7_FW1 0 dez 0.000000 255.000000 /end CHARACTERISTIC
/begin CHARACTERISTIC CWMSRCAN "Codewort fÅr MSR/ASR Åber CAN" VALUE 0x8144DA ME7_FW1 0 DEZ 0.000000 255.000000 /end CHARACTERISTIC
/begin CHARACTERISTIC CWNOMIL "Codewort MIL-Ansteuerung nicht aktiv" VALUE 0x8183AA ME7_FW1 0 dez 0.000000 255.000000 /end CHARACTERISTIC
/begin CHARACTERISTIC CWNSTAT "Codewort zur nstat-Filterung" VALUE 0x815538 ME7_FW1 0 dez 0.000000 255.000000 /end CHARACTERISTIC
/begin CHARACTERISTIC CWNWGE "Codewort Nockenwellensteuerung bei Getriebeeingriff" VALUE 0x8187BC ME7_FW1 0 dez 0.000000 255.000000 /end CHARACTERISTIC
/begin CHARACTERISTIC CWNWLL "Codewort zur Deaktivierung der Bedingung Leerlauf fÅr die NWS-Ansteuerung" VALUE 0x8187BD ME7_FW1 0 dez 0.000000 255.000000 /end CHARACTERISTIC
/begin CHARACTERISTIC CWNWREF "Nockenwellenverhalten im Start" VALUE 0x814D6B ME7_FW1 0 dez 0.000000 255.000000 /end CHARACTERISTIC
/begin CHARACTERISTIC CWNWS "Codewort Nockenwellensteuerung" VALUE 0x8187BE ME7_FW1 0 dez 0.000000 255.000000 /end CHARACTERISTIC
/begin CHARACTERISTIC CWOBD "Codewort fÅr Konfiguration OBD Zertifikationsnachweis" VALUE 0x814321 ME7_FW1 0 dez 0.000000 255.000000 /end CHARACTERISTIC
/begin CHARACTERISTIC CWPKAPP "Codewort Applikation Druckreferenz fÅr Kraftstoffdruckregler" VALUE 0x818C6D ME7_FW1 0 dez 0.000000 255.000000 /end CHARACTERISTIC
/begin CHARACTERISTIC CWPWF "Codewort Powerfail" VALUE 0x819A28 ME7_FW1 0 dez 0.000000 255.000000 /end CHARACTERISTIC
/begin CHARACTERISTIC CWREFI "Codewort: Neuinitialisierung von rkr mit REFINI bei Dynamik" VALUE 0x8191BF ME7_FW1 0 dez 0.000000 1.000000 EXTENDED_LIMITS 0.000000 255.000000 /end CHARACTERISTIC
/begin CHARACTERISTIC CWSAWE "Codewort Schubabschalten - Wiedereinsetzen" VALUE 0x81552D ME7_FW1 0 dez 0.000000 255.000000 /end CHARACTERISTIC
/begin CHARACTERISTIC CWSLS "Codewort fÅr SekundÑrluftsystem" VALUE 0x814322 ME7_FW1 0 dez 0.000000 255.000000 /end CHARACTERISTIC
/begin CHARACTERISTIC CWSTAKD "Codewort zur Konfiguration der Stellglieddiagnose" VALUE 0x81BFE4 ME7_FW3 0 dez___UW 0.000000 65535.000000 /end CHARACTERISTIC
/begin CHARACTERISTIC CWTAF "Codewort fÅr Testeranpassung: Anpassung frei" VALUE 0x81C07A ME7_FW3 0 dez___UW 0.000000 65535.000000 /end CHARACTERISTIC
/begin CHARACTERISTIC CWTAK "Codewort fÅr Testeranpassung: Anpassung fÅr Kundendienst" VALUE 0x81C07C ME7_FW3 0 dez___UW 0.000000 65535.000000 /end CHARACTERISTIC
/begin CHARACTERISTIC CWTAS "Codewort fÅr Testeranpassung: Anpassung fÅr Entwicklung" VALUE 0x81C07E ME7_FW3 0 dez___UW 0.000000 65535.000000 /end CHARACTERISTIC
/begin CHARACTERISTIC CWTEMPK "Codeword fÅr Adressierung FWFTBRTA (tans/evtmod)" VALUE 0x818621 ME7_FW1 0 dez 0.000000 255.000000 /end CHARACTERISTIC
/begin CHARACTERISTIC CWTEZW "Codewort ZÅndwinkeleingriff bei TEV-PrÅfung" VALUE 0x815709 ME7_FW1 0 dez 0.000000 255.000000 /end CHARACTERISTIC
/begin CHARACTERISTIC CWTF "Codewort fÅr Konfiguration TemperaturfÅhler" VALUE 0x814323 ME7_FW1 0 dez 0.000000 255.000000 /end CHARACTERISTIC
/begin CHARACTERISTIC CWTIPIN "Codewort fÅr Tip in - Funktion" VALUE 0x819451 ME7_FW1 0 dez 0.000000 255.000000 /end CHARACTERISTIC
/begin CHARACTERISTIC CWUHR "Codewort fÅr Uhr" VALUE 0x814324 ME7_FW1 0 dez 0.000000 255.000000 /end CHARACTERISTIC
/begin CHARACTERISTIC CWUM_ZDG "" VALUE 0x819007 ME7_FW1 0 dez 0.000000 20.000000 EXTENDED_LIMITS 0.000000 255.000000 /end CHARACTERISTIC
/begin CHARACTERISTIC CWVSV "Codewort fÅr Deaktivierung VS_VERST (CWVSV = 0: VS_VERST nicht aktiv)" VALUE 0x8144D4 ME7_FW1 0 dez 0.000000 255.000000 /end CHARACTERISTIC
/begin CHARACTERISTIC CWVWKNWS "Code Wort: Vorlagerungswinkelkorrektur bei NWS" VALUE 0x818A1B ME7_FW1 0 dez 0.000000 255.000000 /end CHARACTERISTIC
/begin CHARACTERISTIC CWWDKSPE "Codewort: prÑdizierende DK-Sollwertentjitterung aktiv" VALUE 0x815120 ME7_FW1 0 dez 0.000000 255.000000 /end CHARACTERISTIC
/begin CHARACTERISTIC CWWL "Codewort fÅr Warmlaufsteuerung" VALUE 0x818B40 ME7_FW1 0 dez 0.000000 255.000000 /end CHARACTERISTIC
/begin CHARACTERISTIC CWZWVMX "Codewort ZÅndwinkeleingriff bei VMAX-Begrenzung" VALUE 0x81570A ME7_FW1 0 dez 0.000000 255.000000 /end CHARACTERISTIC
/begin CHARACTERISTIC CW_CAN_C "Codewort fÅr KodierfehlerÅberwachung" VALUE 0x8144DB ME7_FW1 0 DEZ 0.000000 255.000000 /end CHARACTERISTIC
/begin CHARACTERISTIC CW_CAN_R_0___A "Codewort fÅr CAN-Empfangskonfiguration" VALUE 0x816EAE ME7_FW1 0 DEZ 0.000000 255.000000 /end CHARACTERISTIC
/begin CHARACTERISTIC CW_CAN_R_1___A "Codewort fÅr CAN-Empfangskonfiguration" VALUE 0x816EAF ME7_FW1 0 DEZ 0.000000 255.000000 /end CHARACTERISTIC
/begin CHARACTERISTIC CW_CAN_R_2___A "Codewort fÅr CAN-Empfangskonfiguration" VALUE 0x816EB0 ME7_FW1 0 DEZ 0.000000 255.000000 /end CHARACTERISTIC
/begin CHARACTERISTIC CW_CAN_R_3___A "Codewort fÅr CAN-Empfangskonfiguration" VALUE 0x816EB1 ME7_FW1 0 DEZ 0.000000 255.000000 /end CHARACTERISTIC
/begin CHARACTERISTIC CW_CAN_S_0___A "Codewort fÅr CAN-Sendekonfiguration" VALUE 0x816EB2 ME7_FW1 0 DEZ 0.000000 255.000000 /end CHARACTERISTIC
/begin CHARACTERISTIC CW_CAN_S_1___A "Codewort fÅr CAN-Sendekonfiguration" VALUE 0x816EB3 ME7_FW1 0 DEZ 0.000000 255.000000 /end CHARACTERISTIC
/begin CHARACTERISTIC CW_CAN_S_2___A "Codewort fÅr CAN-Sendekonfiguration" VALUE 0x816EB4 ME7_FW1 0 DEZ 0.000000 255.000000 /end CHARACTERISTIC
/begin CHARACTERISTIC CW_CAN_S_3___A "Codewort fÅr CAN-Sendekonfiguration" VALUE 0x816EB5 ME7_FW1 0 DEZ 0.000000 255.000000 /end CHARACTERISTIC
/begin CHARACTERISTIC CW_NOROMCHKRESET "" VALUE 0x815E14 ME7_FW1 0 dez 0.000000 255.000000 /end CHARACTERISTIC
/begin CHARACTERISTIC CW_SWE_0__A "" VALUE 0x81AC32 ME7_FW3 0 dez___UW 0.000000 65535.000000 /end CHARACTERISTIC
/begin CHARACTERISTIC CW_SWE_1__A "" VALUE 0x81AC34 ME7_FW3 0 dez___UW 0.000000 65535.000000 /end CHARACTERISTIC
/begin CHARACTERISTIC DANTGESWNV "Schwelle Aktivierung D-Anteil (Geschwindigkeit) im unverstÑrkten Bereich" VALUE 0x810CA2 ME7_FW4 0 relDK_q0p02441 -800.000000 799.976000 EXTENDED_LIMITS -800.000000 799.975586 /end CHARACTERISTIC
/begin CHARACTERISTIC DANTGESWV "Schwelle Aktivierung D-Anteil (Geschwindigkeit) im verstÑrkten Bereich" VALUE 0x810CA4 ME7_FW4 0 relDK_q0p02441 -800.000000 799.976000 EXTENDED_LIMITS -800.000000 799.975586 /end CHARACTERISTIC
/begin CHARACTERISTIC DANTSCHWNV "Schwelle Aktivierung D-Anteil (Abweichung) im unverstÑrkten Bereich" VALUE 0x810CA6 ME7_FW4 0 relDK_q0p02441 -800.000000 799.976000 EXTENDED_LIMITS -800.000000 799.975586 /end CHARACTERISTIC
/begin CHARACTERISTIC DANTSCHWV "Schwelle Aktivierung D-Anteil (Abweichung) im verstÑrkten Bereich" VALUE 0x810CA8 ME7_FW4 0 relDK_q0p02441 -800.000000 799.976000 EXTENDED_LIMITS -800.000000 799.975586 /end CHARACTERISTIC
/begin CHARACTERISTIC DASA "Anzahl der SAS-Phasen zur Erkennung LLS Fehler" VALUE 0x819906 ME7_FW1 0 dez 0.000000 255.000000 /end CHARACTERISTIC
/begin CHARACTERISTIC DASE_CMD "Codewort DMD-Ausblendbedingungen abschalten - nur fÅr Testzwecke !!!" VALUE 0x8147FE ME7_FW1 0 dez 0.000000 7.000000 EXTENDED_LIMITS 0.000000 255.000000 /end CHARACTERISTIC
/begin CHARACTERISTIC DBZ_MN "kleinstes zulÑssiges Delta des BotschaftszÑhlers in der Funktion" VALUE 0x8144DC ME7_FW1 0 DEZ 0.000000 255.000000 /end CHARACTERISTIC
/begin CHARACTERISTIC DBZ_MN_UC "" VALUE 0x815C7B ME7_FW1 0 dez 0.000000 255.000000 /end CHARACTERISTIC
/begin CHARACTERISTIC DBZ_MN_UM "kleinstes zulÑssiges Delta des BotschaftszÑhlers" VALUE 0x814070 ME7_FW1 0 dez 0.000000 255.000000 /end CHARACTERISTIC
/begin CHARACTERISTIC DBZ_MX "Grî·tes zulÑssiges Delta des BotschaftszÑhlers in der Funktion" VALUE 0x8144DD ME7_FW1 0 DEZ 0.000000 255.000000 /end CHARACTERISTIC
/begin CHARACTERISTIC DBZ_MX_UC "" VALUE 0x815C7C ME7_FW1 0 dez 0.000000 255.000000 /end CHARACTERISTIC
/begin CHARACTERISTIC DBZ_MX_UM "grî·tes zulÑssiges Delta des BotschaftszÑhlers" VALUE 0x814071 ME7_FW1 0 dez 0.000000 255.000000 /end CHARACTERISTIC
/begin CHARACTERISTIC DECKSTAI "Decrement-Step fÅr STADAP-Faktor" CURVE 0x8151CD ME7_KL98 0 fak_sb_b1 -1.000000 0.000000 /begin AXIS_DESCR STD_AXIS tmadb dez 3 0.000000 255.000000 DEPOSIT ABSOLUTE /end AXIS_DESCR EXTENDED_LIMITS -1.000000 0.992188 /end CHARACTERISTIC
/begin CHARACTERISTIC DEVTMAGR "Offset fÅr evtmod abhÑngig von tsges_w bei hoher tans verursacht d. AGR" CURVE 0x81B4F4 ZF_KL118 0 temp_sw_q0p75 -24576.000000 24575.300000
 /begin AXIS_DESCR STD_AXIS tsges_w temp_sw_q0p75 8 -24576.000000 24575.300000 DEPOSIT ABSOLUTE /end AXIS_DESCR
 EXTENDED_LIMITS -24576.000000 24575.250000 /end CHARACTERISTIC
/begin RECORD_LAYOUT ZF_KL118 NO_AXIS_PTS_X 1 UWORD AXIS_PTS_X 2 SWORD INDEX_INCR DIRECT FNC_VALUES 3 SWORD ROW_DIR DIRECT /end RECORD_LAYOUT
/begin CHARACTERISTIC DFAFRG "Aufreglungsfaktor nach Einschalten des FÅllungsreglers" VALUE 0x815104 ME7_FW1 0 fak_ub_b1 0.000000 0.996094 /end CHARACTERISTIC
/begin CHARACTERISTIC DFKMSMN "Delta FKMSDKMN zum RÅcksetzen von B_fkmsmn" VALUE 0x818600 ME7_FW1 0 fak_ub_b4 0.000000 3.984380 EXTENDED_LIMITS 0.000000 3.984375 /end CHARACTERISTIC
/begin CHARACTERISTIC DFKMSMX "Delta FKMSDKMX zum RÅcksetzen von B_fkmsmx" VALUE 0x818601 ME7_FW1 0 fak_ub_b4 0.000000 3.984380 EXTENDED_LIMITS 0.000000 3.984375 /end CHARACTERISTIC
/begin CHARACTERISTIC DFKPVMN "Delta FKPVDKMN zum RÅcksetzen von B_fkpvmn" VALUE 0x818602 ME7_FW1 0 fak_ub_b4 0.000000 3.984380 EXTENDED_LIMITS 0.000000 3.984375 /end CHARACTERISTIC
/begin CHARACTERISTIC DFKPVMX "Delta FKPVDKMX zum RÅcksetzen von B_fkpvmx" VALUE 0x818603 ME7_FW1 0 fak_ub_b4 0.000000 3.984380 EXTENDED_LIMITS 0.000000 3.984375 /end CHARACTERISTIC
/begin CHARACTERISTIC DFPSLBIT "Selektionsbits fÅr Kennzeichnung der aktivierten Fehlerpfade" VAL_BLK 0x81AC3A ME7_FWB3 0 dez___UW 0.000000 65535.000000 NUMBER 16 /end CHARACTERISTIC
/begin CHARACTERISTIC DFRBAF "Delta Lambdaregler zur Erkennung BA fett" VALUE 0x812038 ME7_FW4 0 fak_sw_b1 -1.000000 0.999969 /end CHARACTERISTIC
/begin CHARACTERISTIC DFRBAM "Delta Lambdaregler zur Erkennung BA mager" VALUE 0x81203A ME7_FW4 0 fak_sw_b1 -1.000000 0.999969 /end CHARACTERISTIC
/begin CHARACTERISTIC DFRMDTEE "Delta-frm-Schwelle fÅr Erkennung der eingeschwungenen Gemischkorrektur" VALUE 0x81D980 ME7_FW3 0 fak_uw_b2 0.000000 0.031250 EXTENDED_LIMITS 0.000000 1.999969 /end CHARACTERISTIC
/begin CHARACTERISTIC DFRMDTEF "Regelhubschwelle fÅr Fettkorrektur des fr fÅr PrÅfung i.O." VALUE 0x81D982 ME7_FW4 0 fak_sw_b1 -0.200012 0.000000 EXTENDED_LIMITS -1.000000 0.999969 /end CHARACTERISTIC
/begin CHARACTERISTIC DFRMDTEM "Regelhubschwelle fÅr Magerkorrektur des fr fÅr PrÅfung i.O." VALUE 0x81D984 ME7_FW4 0 fak_sw_b1 0.000000 0.200012 EXTENDED_LIMITS -1.000000 0.999969 /end CHARACTERISTIC
/begin CHARACTERISTIC DFRMN "Min. Lambda-Abweichung fÅr Bestimmung StationÑrbedingung und öK-Adaption" VALUE 0x81375C ME7_FW4 0 fak_sw_b1 -1.000000 0.999969 /end CHARACTERISTIC
/begin CHARACTERISTIC DFRMOFNX "frm-Offset-Schwelle (negativ): Kontrolle Vorsteuerproblem" VALUE 0x81A114 ME7_FW4 0 fak_sw_b1 -1.000000 0.999969 /end CHARACTERISTIC
/begin CHARACTERISTIC DFRMOFPX "frm-Offset-Schwelle (positiv): Kontrolle Vorsteuerproblem" VALUE 0x81A116 ME7_FW4 0 fak_sw_b1 -1.000000 0.999969 /end CHARACTERISTIC
/begin CHARACTERISTIC DFRMST "Delta frm-schwelle fÅr Erkennung der eingeschwungenen Grundadaption" VALUE 0x818E16 ME7_FW1 0 fak_ub_b2 0.000000 1.992190 EXTENDED_LIMITS 0.000000 1.992188 /end CHARACTERISTIC
/begin CHARACTERISTIC DFRSPS "Hub des Lambda-Regelfaktors (Sollwert)" VALUE 0x81375E ME7_FW4 0 fak_sw_b1 -1.000000 0.999969 /end CHARACTERISTIC
/begin CHARACTERISTIC DFRVAF "Delta Lambdaregler zur Erkennung VA fett" VALUE 0x81203C ME7_FW4 0 fak_sw_b1 -1.000000 0.999969 /end CHARACTERISTIC
/begin CHARACTERISTIC DFRVAM "Delta Lambdaregler zur Erkennung VA mager" VALUE 0x81203E ME7_FW4 0 fak_sw_b1 -1.000000 0.999969 /end CHARACTERISTIC
/begin CHARACTERISTIC DFSEFO2N "drehzahlabh. max. plausible Abweichungen der FSE-Werte" CURVE 0x8144FC ME7_GKL2 0 dtsegn_b11p25divZyl -2.812500 2.790530
 /begin AXIS_DESCR COM_AXIS nmot nmot_ub_q40 0 0.000000 10200.000000 AXIS_PTS_REF SDZ08DMUB2 /end AXIS_DESCR
 EXTENDED_LIMITS -2.812501 2.790528 /end CHARACTERISTIC
/begin RECORD_LAYOUT ME7_GKL2 FNC_VALUES 1 SBYTE COLUMN_DIR DIRECT /end RECORD_LAYOUT
/begin CHARACTERISTIC DFSEFON "drehzahlabh. max. plausible Abweichungen der FSE-Werte" CURVE 0x814504 ME7_GKL2 0 dtsegn_b11p25divZyl -2.812500 2.790530
 /begin AXIS_DESCR COM_AXIS nmot nmot_ub_q40 0 0.000000 10200.000000 AXIS_PTS_REF SDZ08DMUB /end AXIS_DESCR
 EXTENDED_LIMITS -2.812501 2.790528 /end CHARACTERISTIC
/begin CHARACTERISTIC DFSERES "Differenz der Adaptionswerte zum Auslîsen eines Reset der fuel-on/-off adaption" VALUE 0x81450C ME7_FW1 0 dtsegn_b11p25divZyl___UB 0.000000 5.603030 EXTENDED_LIMITS 0.000000 5.603029 /end CHARACTERISTIC
/begin CHARACTERISTIC DFTEAHB "Schwelle Gemischanteil TankentlÅftung zum Setzen Bit 'Hohe Beladung'" VALUE 0x819A37 ME7_FW2 0 fak_sb_b1 -1.000000 0.992188 /end CHARACTERISTIC
/begin CHARACTERISTIC DFTEDS "Hysteresebreite Beladung fÅr Umschaltung auf DauertankentlÅftung" VALUE 0x81B8E6 ME7_FW4 0 fak_sw_b64 -64.000000 63.998000 EXTENDED_LIMITS -64.000000 63.998047 /end CHARACTERISTIC
/begin CHARACTERISTIC DIFFMAX "max. zulÑssige DruckÑnderung wÑhrend 100ms" VALUE 0x81361C ME7_FW3 0 p_uw_q0p039 0.000000 2559.960000 EXTENDED_LIMITS 0.000000 2559.960938 /end CHARACTERISTIC
/begin CHARACTERISTIC DKATCW "einmaliger Lauf bzw. Initialisierung der DKAT-Funktion" VALUE 0x8184D3 ME7_FW1 0 dez 0.000000 255.000000 /end CHARACTERISTIC
/begin CHARACTERISTIC DKLAGERT "zulÑssige Fehlerzeit fÅr DK-Soll-/Istvergleich" VALUE 0x814ED0 ME7_FW1 0 t20msxs_ub_b5p1 0.000000 5.100000 /end CHARACTERISTIC
/begin CHARACTERISTIC DKLDPN "Maximaler Drosselklappenwinkel bei Leckdiagnose" CURVE 0x815E4A ME7_KL97 0 relDK_ub_b100 0.000000 100.000000
 /begin AXIS_DESCR STD_AXIS nmot nmot_ub_q40 6 0.000000 10200.000000 DEPOSIT ABSOLUTE /end AXIS_DESCR
/end CHARACTERISTIC
/begin CHARACTERISTIC DKNOTBEGR "Sollwertbegrenzung bei DK-Potinotfahren als f(nmot)" CURVE 0x811D86 ME7_KL99 0 relDK_uw_b100 0.000000 100.000000
 /begin AXIS_DESCR STD_AXIS nmot nmot_ub_q40 8 0.000000 10200.000000 DEPOSIT ABSOLUTE /end AXIS_DESCR
/end CHARACTERISTIC
/begin RECORD_LAYOUT ME7_KL99 NO_AXIS_PTS_X 1 UBYTE AXIS_PTS_X 2 UBYTE INDEX_INCR DIRECT FNC_VALUES 3 UWORD COLUMN_DIR DIRECT /end RECORD_LAYOUT
/begin CHARACTERISTIC DKPSTGMIN "min. Steigung des DK-Poti zur Umr. abs. auf rel. Winkel im worst case" VALUE 0x810C52 ME7_FW3 0 rel_uw_b40 0.000000 39.999400 EXTENDED_LIMITS 0.000000 39.999390 /end CHARACTERISTIC
/begin CHARACTERISTIC DKRAMX "Maximale Anzahl SpÑtverstellungen fÅr Klopfregelanschlag" VALUE 0x812084 ME7_FW3 0 dez___UW 0.000000 65535.000000 /end CHARACTERISTIC
/begin CHARACTERISTIC DKRAZ "ZÅndungzÑhler fÅr Klopfregelanschlag" VALUE 0x812086 ME7_FW3 0 dez___UW 0.000000 65535.000000 /end CHARACTERISTIC
/begin CHARACTERISTIC DKRISNT "Grenzwert der Integratorsteigung fÅr Nulltest" VALUE 0x812226 ME7_FW3 0 tknockintgrad_sy 0.000000 6102.950000 EXTENDED_LIMITS 0.000000 6102.921319 /end CHARACTERISTIC
/begin CHARACTERISTIC DKROKMX "Maximaler Offsetkompensationswert" VALUE 0x8153FF ME7_FW1 0 spg_ub_b5 0.000000 4.980470 EXTENDED_LIMITS 0.000000 4.980469 /end CHARACTERISTIC
/begin CHARACTERISTIC DKROKO "Obere Drehzahlschwelle fÅr Ermittlung Offsetkompensationswert" VALUE 0x819163 ME7_FW1 0 nmot_ub_q40 0.000000 10200.000000 /end CHARACTERISTIC
/begin CHARACTERISTIC DKROKU "Untere Drehzahlschwelle fÅr Ermittlung Offsetkompensationswert" VALUE 0x81543E ME7_FW1 0 nmot_ub_q40 0.000000 10200.000000 /end CHARACTERISTIC
/begin CHARACTERISTIC DKTLMT "Max. Dauer tL-/wdkbl- GrenzwertÅberschreitung" CURVE 0x815E57 ME7_KL97 0 t1sxs_ub_b255 0.000000 255.000000
 /begin AXIS_DESCR STD_AXIS tfpg t1sxs_ub_b255 6 0.000000 255.000000 DEPOSIT ABSOLUTE /end AXIS_DESCR
/end CHARACTERISTIC
/begin CHARACTERISTIC DLAMELSH "Delta-Lambda-Sollwert fÅr elektrische Sonendiagnose hinter KAT (Kurztrip)" VALUE 0x81AD30 ME7_FW3 0 fak_uw_b16 0.000000 15.999800 EXTENDED_LIMITS 0.000000 15.999756 /end CHARACTERISTIC
/begin CHARACTERISTIC DLAMKR "Schwellwert fÅr Aktivierung Anfettung bei ZW-SpÑtverstellung" VALUE 0x818C71 ME7_FW1 0 fak_ub_b2 0.000000 1.992190 EXTENDED_LIMITS 0.000000 1.992188 /end CHARACTERISTIC
/begin CHARACTERISTIC DLAMLASHF "Delta-Lambda-Sollwert (Fett) fÅr Test SchwingungsprÅfung hinter KAT" VALUE 0x81AD44 ME7_FW3 0 fak_uw_b16 0.000000 15.999800 EXTENDED_LIMITS 0.000000 15.999756 /end CHARACTERISTIC
/begin CHARACTERISTIC DLAMLASHM "Delta-Lambda-Sollwert (Mager) fÅr Test SchwingungsprÅfung hinter KAT" VALUE 0x81AD46 ME7_FW3 0 fak_uw_b16 0.000000 15.999800 EXTENDED_LIMITS 0.000000 15.999756 /end CHARACTERISTIC
/begin CHARACTERISTIC DLAMNSWL "max. Abweichung fÅr lamnswl_w=1.0" VALUE 0x815306 ME7_FW1 0 fak_ub_b1 0.000000 0.996094 /end CHARACTERISTIC
/begin CHARACTERISTIC DLAMOB "Delta Lambda bei Overboost" CURVE 0x818C72 ME7_KL97 0 fak_ub_b2 0.000000 1.992190
 /begin AXIS_DESCR STD_AXIS nmot nmot_ub_q40 6 0.000000 10200.000000 DEPOSIT ABSOLUTE /end AXIS_DESCR
 EXTENDED_LIMITS 0.000000 1.992188 /end CHARACTERISTIC
/begin CHARACTERISTIC DLBTS "Delta Lambdasoll fÅr Bauteileschutz" CURVE 0x81BA1E ME7_KL98 0 fak_sb_b1 -1.000000 0.000000
 /begin AXIS_DESCR STD_AXIS detazwbs rel_ub_b127p5 8 0.000000 127.500000 DEPOSIT ABSOLUTE /end AXIS_DESCR
 EXTENDED_LIMITS -1.000000 0.992188 /end CHARACTERISTIC
/begin CHARACTERISTIC DLRDWDKSS1 "DLR, obere Grenze zur Parameterumschaltung" VALUE 0x810CAA ME7_FW4 0 relDK_q0p00152 -50.000000 49.998500 EXTENDED_LIMITS -50.000000 49.998474 /end CHARACTERISTIC
/begin CHARACTERISTIC DLRDWDKSS2 "DLR, untere Grenze zur Parameterumschaltung" VALUE 0x810CAC ME7_FW4 0 relDK_q0p00152 -50.000000 49.998500 EXTENDED_LIMITS -50.000000 49.998474 /end CHARACTERISTIC
/begin CHARACTERISTIC DLRIAMAXA "maximal zulÑssiger I-Anteil" VALUE 0x810CAE ME7_FW3 0 rel_q0p1957 0.000000 100.000000 EXTENDED_LIMITS 0.000000 12824.853229 /end CHARACTERISTIC
/begin CHARACTERISTIC DLRIKLPAR "DLR, I-Klein Parameter" VALUE 0x814ED1 ME7_FW1 0 relDK_q0p0625 0.000000 15.937500 /end CHARACTERISTIC
/begin CHARACTERISTIC DLRININI "I-Anteil bei Inititialisierung der NLP-Funktion" VALUE 0x810CB0 ME7_FW3 0 rel_q0p1957 0.000000 12824.900000 EXTENDED_LIMITS 0.000000 12824.853229 /end CHARACTERISTIC
/begin CHARACTERISTIC DLRKDONLP0 "DLR, D-Parameter Åber NLP" VALUE 0x814ED2 ME7_FW1 0 relDK_q4 0.000000 1020.000000 /end CHARACTERISTIC
/begin CHARACTERISTIC DLRKDUNLP0 "DLR, D-Parameter unter NLP (schwach)" VALUE 0x814ED3 ME7_FW1 0 relDK_q4 0.000000 1020.000000 /end CHARACTERISTIC
/begin CHARACTERISTIC DLRKDUNLP1 "DLR, D-Parameter unter NLP (mittel)" VALUE 0x814ED4 ME7_FW1 0 relDK_q4 0.000000 1020.000000 /end CHARACTERISTIC
/begin CHARACTERISTIC DLRKDUNLP2 "DLR, D-Parameter unter NLP (stark)" VALUE 0x814ED5 ME7_FW1 0 relDK_q4 0.000000 1020.000000 /end CHARACTERISTIC
/begin CHARACTERISTIC DLRKIONLP0 "I-Anteil als f(abs(dwdkdlr_w)), Åber NLP" VAL_BLK 0x814ED6 ME7_FWB1 0 relDK_q0p0625 0.000000 15.937500 NUMBER 32 /end CHARACTERISTIC
/begin CHARACTERISTIC DLRKIUNLP0 "I-Anteil als f(abs(dwdkdlr_w)), unter NLP (schwach)" VAL_BLK 0x814EF6 ME7_FWB1 0 relDK_q0p0625 0.000000 15.937500 NUMBER 32 /end CHARACTERISTIC
/begin CHARACTERISTIC DLRKIUNLP1 "I-Anteil als f(abs(dwdkdlr_w)), unter NLP (mittel)" VAL_BLK 0x814F16 ME7_FWB1 0 relDK_q0p0625 0.000000 15.937500 NUMBER 32 /end CHARACTERISTIC
/begin CHARACTERISTIC DLRKIUNLP2 "I-Anteil als f(abs(dwdkdlr_w)), unter NLP (stark)" VAL_BLK 0x814F36 ME7_FWB1 0 relDK_q0p0625 0.000000 15.937500 NUMBER 32 /end CHARACTERISTIC
/begin CHARACTERISTIC DLRKPONLP0 "DLR, P-Parameter Åber NLP" VALUE 0x814F56 ME7_FW1 0 relDK_q1 0.000000 255.000000 /end CHARACTERISTIC
/begin CHARACTERISTIC DLRKPUNLP0 "DLR, P-Parameter unter NLP (schwach)" VALUE 0x814F57 ME7_FW1 0 relDK_q1 0.000000 255.000000 /end CHARACTERISTIC
/begin CHARACTERISTIC DLRKPUNLP1 "DLR, P-Parameter unter NLP (mittel)" VALUE 0x814F58 ME7_FW1 0 relDK_q1 0.000000 255.000000 /end CHARACTERISTIC
/begin CHARACTERISTIC DLRKPUNLP2 "DLR, P-Parameter unter NLP (stark)" VALUE 0x814F59 ME7_FW1 0 relDK_q1 0.000000 255.000000 /end CHARACTERISTIC
/begin CHARACTERISTIC DLRKREIS "DLR, Faktor KreisverstÑrkung" VALUE 0x81859E ME7_FW1 0 fak_ub_b2 0.000000 1.992190 EXTENDED_LIMITS 0.000000 1.992188 /end CHARACTERISTIC
/begin CHARACTERISTIC DLRKREISST "DLR, Faktor KreisverstÑrkung zur Zeit des Motorstarts" VALUE 0x81859F ME7_FW1 0 fak_ub_b2 0.000000 1.992190 EXTENDED_LIMITS 0.000000 1.992188 /end CHARACTERISTIC
/begin CHARACTERISTIC DLRNLPD "UnschÑrfebereich fÅr DK-Notluftposition" VALUE 0x810CB2 ME7_FW3 0 relDK_uw_b100 0.000000 100.000000 /end CHARACTERISTIC
/begin CHARACTERISTIC DLRPID0T "Fehlerzeit fÅr DLR-Stellbereich im Anschlag zur erweiterten Stellertauscherkenng" VALUE 0x810CB4 ME7_FW3 0 t10msxs_uw_b655p35 0.000000 655.350000 /end CHARACTERISTIC
/begin CHARACTERISTIC DLRPID1T "zulÑssige Fehlerzeit 1 fÅr DLR-Stellbereich am Anschlag" VALUE 0x810CB6 ME7_FW3 0 t10msxs_uw_b655p35 0.000000 655.350000 /end CHARACTERISTIC
/begin CHARACTERISTIC DLRPID2T "zulÑssige Fehlerzeit 2 fÅr DLR-Stellbereich am Anschlag" VALUE 0x810CB8 ME7_FW3 0 t10msxs_uw_b655p35 0.000000 655.350000 /end CHARACTERISTIC
/begin CHARACTERISTIC DLRPIDMAX "max. zulÑssiges PWM-TastverhÑltnis fÅr DLR" VALUE 0x810CBA ME7_FW3 0 rel_uw_b100 0.000000 99.998500 EXTENDED_LIMITS 0.000000 99.998474 /end CHARACTERISTIC
/begin CHARACTERISTIC DLRPIDMIN "min. zulÑssiges PWM-TastverhÑltnis fÅr DLR" VALUE 0x810CBC ME7_FW3 0 rel_uw_b100 0.000000 99.998500 EXTENDED_LIMITS 0.000000 99.998474 /end CHARACTERISTIC
/begin CHARACTERISTIC DLRPIDSTMN "min. Schwelle fÅr PWM-TastverhÑltnis des DLR bei temp. UMA-Adapt." VALUE 0x810C54 ME7_FW3 0 rel_uw_b100 0.000000 99.998500 EXTENDED_LIMITS 0.000000 99.998474 /end CHARACTERISTIC
/begin CHARACTERISTIC DLRUBSOLL "DLR, Batterie Normalspannung" VALUE 0x8185A0 ME7_FW1 0 spg_ubatt 0.000000 17.952000 /end CHARACTERISTIC
/begin CHARACTERISTIC DLRUMABAND "Unsicherheitsband bei Sprung aus UMA-Bereich" VALUE 0x810CBE ME7_FW3 0 relDK_q0p02441___UW 0.000000 4.882810 EXTENDED_LIMITS 0.000000 1599.975586 /end CHARACTERISTIC
/begin CHARACTERISTIC DLRUMAIINI "Vorladewert I-Anteil bei Sprung aus UMA-Bereich" VALUE 0x810CC0 ME7_FW4 0 rel_q0p1957___SW -6412.520000 6412.330000 EXTENDED_LIMITS -6412.524462 6412.328767 /end CHARACTERISTIC
/begin CHARACTERISTIC DLUL "Delta-Last fÅr öberladeschutz-Reset" VALUE 0x81969F ME7_FW2 0 p_sb_q10 0.000000 250.000000 EXTENDED_LIMITS -1280.000000 1270.000000 /end CHARACTERISTIC
/begin CHARACTERISTIC DLURMIN "Drehzahlabh. Laufunruhe-Referenz-Minimalwert 1" CURVE 0x8146B3 ME7_GKL2 0 luquant -80.844000 80.212400
 /begin AXIS_DESCR COM_AXIS nmot nmot_ub_q40 0 0.000000 10200.000000 AXIS_PTS_REF SNM08DMUB /end AXIS_DESCR
 EXTENDED_LIMITS -80.843807 80.212215 /end CHARACTERISTIC
/begin CHARACTERISTIC DMADFK "Maximal adaptierbares Delta-Verlustmoment pro Adaptionsphase Fahrst.+Kompr." VALUE 0x81982D ME7_FW1 0 rel_ub_b24p9 0.000000 24.900000 /end CHARACTERISTIC
/begin CHARACTERISTIC DMADFS "Maximal adaptierbares Delta-Verlustmoment pro Adaptionsphase mit Fahrstufe ein" VALUE 0x81982E ME7_FW1 0 rel_ub_b24p9 0.000000 24.900000 /end CHARACTERISTIC
/begin CHARACTERISTIC DMADKO "Maximal adaptierbares Delta-Verlustmoment pro Adaptionsphase Kompr.ein" VALUE 0x81982F ME7_FW1 0 rel_ub_b24p9 0.000000 24.900000 /end CHARACTERISTIC
/begin CHARACTERISTIC DMADLL "Maximal adaptierbares Delta-Verlustmoment pro Adaptionsphase ohne Last" VALUE 0x819830 ME7_FW1 0 rel_ub_b24p9 0.000000 24.900000 /end CHARACTERISTIC
/begin CHARACTERISTIC DMADMNFK "Minimal adaptierbares Delta-Verlustmoment Fahrstufe eingelegt + Kompressor ein" VALUE 0x819831 ME7_FW1 0 rel_ub_bn24p9 -24.900000 0.000000 /end CHARACTERISTIC
/begin CHARACTERISTIC DMADMNFS "Minimal adaptierbares Delta-Verlustmoment Fahrstufe eingelegt" VALUE 0x819832 ME7_FW1 0 rel_ub_bn24p9 -24.900000 0.000000 /end CHARACTERISTIC
/begin CHARACTERISTIC DMADMNKO "Minimal adaptierbares Delta-Verlustmoment Klimakompressor ein" VALUE 0x819833 ME7_FW1 0 rel_ub_bn24p9 -24.900000 0.000000 /end CHARACTERISTIC
/begin CHARACTERISTIC DMADMNLL "Minimal adaptierbares Delta-Verlustmoment ohne Last" VALUE 0x819834 ME7_FW1 0 rel_ub_bn24p9 -24.900000 0.000000 /end CHARACTERISTIC
/begin CHARACTERISTIC DMADMXFK "Maximal adaptierbares Delta-Verlustmoment Farstufe + Klimakompressor ein" VALUE 0x819835 ME7_FW1 0 rel_ub_b24p9 0.000000 24.900000 /end CHARACTERISTIC
/begin CHARACTERISTIC DMADMXFS "Maximal adaptierbares Delta-Verlustmoment Farstufe ein" VALUE 0x819836 ME7_FW1 0 rel_ub_b24p9 0.000000 24.900000 /end CHARACTERISTIC
/begin CHARACTERISTIC DMADMXKO "Maximal adaptierbares Delta-Verlustmoment Klimakompressor ein" VALUE 0x819837 ME7_FW1 0 rel_ub_b24p9 0.000000 24.900000 /end CHARACTERISTIC
/begin CHARACTERISTIC DMADMXLL "Maximal adaptierbares Delta-Verlustmoment ohne Last" VALUE 0x819838 ME7_FW1 0 rel_ub_b24p9 0.000000 24.900000 /end CHARACTERISTIC
/begin CHARACTERISTIC DMAUFN "Delta-Moment Aufregelung nach Drehmomenteingriff" CURVE 0x81EB1E ZF_KL111 0 rel_uw_b100 0.000000 99.998500
 /begin AXIS_DESCR STD_AXIS nmot_w nmot_uw_q0p25 8 0.000000 16383.800000 DEPOSIT ABSOLUTE /end AXIS_DESCR
 EXTENDED_LIMITS 0.000000 99.998474 /end CHARACTERISTIC
/begin CHARACTERISTIC DMDLWS "Lenkhilfelastmoment" CURVE 0x81CBEC ME7_KL103 0 rel_ub_b49p725 0.000000 49.725000
 /begin AXIS_DESCR STD_AXIS lws lw_sb_q11p2 6 -1445.290000 1434.000000 DEPOSIT ABSOLUTE /end AXIS_DESCR
/end CHARACTERISTIC
/begin RECORD_LAYOUT ME7_KL103 NO_AXIS_PTS_X 1 UBYTE AXIS_PTS_X 2 SBYTE INDEX_INCR DIRECT FNC_VALUES 3 UBYTE COLUMN_DIR DIRECT /end RECORD_LAYOUT
/begin CHARACTERISTIC DMDNSM "Delta Moment zur Nachstartkompensation" CURVE 0x8198E4 ME7_KL97 0 rel_ub_b99p6 0.000000 99.609400
 /begin AXIS_DESCR STD_AXIS tmot temp_ub_q0p75_o48 8 -48.000000 143.250000 DEPOSIT ABSOLUTE /end AXIS_DESCR
 EXTENDED_LIMITS 0.000000 99.609375 /end CHARACTERISTIC
/begin CHARACTERISTIC DMDPUG_0_A "delta Moment Dashpotende" CURVE 0x812ACC ZF_KL117 0 rel_uw_b100 0.000000 99.998500
 /begin AXIS_DESCR STD_AXIS mkfanb_w rel_sw_b100 8 -100.000000 99.996900 DEPOSIT ABSOLUTE /end AXIS_DESCR
 EXTENDED_LIMITS 0.000000 99.998474 /end CHARACTERISTIC
/begin RECORD_LAYOUT ZF_KL117 NO_AXIS_PTS_X 1 UWORD AXIS_PTS_X 2 SWORD INDEX_INCR DIRECT FNC_VALUES 3 UWORD ROW_DIR DIRECT /end RECORD_LAYOUT
/begin CHARACTERISTIC DMDPUG_1_A "delta Moment Dashpotende" CURVE 0x812AEE ZF_KL117 0 rel_uw_b100 0.000000 99.998500
 /begin AXIS_DESCR STD_AXIS mkfanb_w rel_sw_b100 8 -100.000000 99.996900 DEPOSIT ABSOLUTE /end AXIS_DESCR
 EXTENDED_LIMITS 0.000000 99.998474 /end CHARACTERISTIC
/begin CHARACTERISTIC DMDWHYS "Hysterese fÅr Bildung D-Anteil-Wandlermoment" VALUE 0x815575 ME7_FW1 0 rel_ub_b99p6 0.000000 99.609400 EXTENDED_LIMITS 0.000000 99.609375 /end CHARACTERISTIC
/begin CHARACTERISTIC DMDWM "D-Anteil Wandlermoment bei Einlegen der Fahrstufe" CURVE 0x81983B ME7_GKL1 0 rel_ub_b99p6 0.000000 99.609400
 /begin AXIS_DESCR COM_AXIS tmot temp_ub_q0p75_o48 0 -48.000000 143.250000 AXIS_PTS_REF STM08MDUB /end AXIS_DESCR
 EXTENDED_LIMITS 0.000000 99.609375 /end CHARACTERISTIC
/begin CHARACTERISTIC DMIFLSD "Delta-Moment fÅr Initialisierung Filter LastschlagdÑmpfung" VALUE 0x812B10 ME7_FW3 0 rel_uw_b100 0.000000 99.998500 EXTENDED_LIMITS 0.000000 99.998474 /end CHARACTERISTIC
/begin CHARACTERISTIC DMIZWMN "Offset auf indiziertes Motormoment bei spÑtestem ZÅndwinkel und ASR-Eingriff" VALUE 0x815984 ME7_FW1 0 rel_ub_b99p6 0.000000 99.609400 EXTENDED_LIMITS 0.000000 99.609375 /end CHARACTERISTIC
/begin CHARACTERISTIC DMLDTEFN "Schwelle Luftmassenstrom unplausibel fÅr Erkennung Fehler in DTEV" VALUE 0x81D986 ME7_FW4 0 m_q0p0031 -2.000000 0.000000 EXTENDED_LIMITS -102.400000 102.396875 /end CHARACTERISTIC
/begin CHARACTERISTIC DMLDTEFX "Luftmassenschwelle fÅr Erkennung TEV defekt nicht mehr nîtig" VALUE 0x81D988 ME7_FW4 0 m_q0p0031 0.000000 2.000000 EXTENDED_LIMITS -102.400000 102.396875 /end CHARACTERISTIC
/begin CHARACTERISTIC DMLDTEMN "Untere Schwelle fÅr Erkennung Luftmassenstrom unplausibel fÅr Auswertung in DTEV" VALUE 0x81D98A ME7_FW4 0 m_q0p0031 -2.000000 0.000000 EXTENDED_LIMITS -102.400000 102.396875 /end CHARACTERISTIC
/begin CHARACTERISTIC DMLDTEMX "Obere Schwelle fÅr Erkennung Luftmassenstrom unplausibel fÅr Auswertung in DTEV" VALUE 0x81D98C ME7_FW4 0 m_q0p0031 0.000000 2.000000 EXTENDED_LIMITS -102.400000 102.396875 /end CHARACTERISTIC
/begin CHARACTERISTIC DMLLNG "LLR: D-VerstÑrkung abh. von ngasf fÅr Luftpfad" CURVE 0x81285E ZF_KL118 0 rel_q0p00305 -99.993600 99.990500
 /begin AXIS_DESCR STD_AXIS ngasf_w nmotg_sw_q0p39 6 -12800.200000 12799.800000 DEPOSIT ABSOLUTE /end AXIS_DESCR
 EXTENDED_LIMITS -99.993600 99.990548 /end CHARACTERISTIC
/begin CHARACTERISTIC DMLLNGV "LLR: D-VerstÑrkung abh. von ngasf fÅr Luftpfad" CURVE 0x812878 ZF_KL118 0 rel_q0p00305 -99.993600 99.990500
 /begin AXIS_DESCR STD_AXIS ngasf_w nmotg_sw_q0p39 6 -12800.200000 12799.800000 DEPOSIT ABSOLUTE /end AXIS_DESCR
 EXTENDED_LIMITS -99.993600 99.990548 /end CHARACTERISTIC
/begin CHARACTERISTIC DMLLRLMNN "Untere Begrenzung fÅr dmllrl" CURVE 0x815667 ME7_GKL2 0 rel_sb_q0p39 -49.996800 0.000000
 /begin AXIS_DESCR COM_AXIS nmot_w nmot_uw_q0p25 0 0.000000 16383.800000 AXIS_PTS_REF SNM06LLUB /end AXIS_DESCR
 EXTENDED_LIMITS -49.996800 49.606200 /end CHARACTERISTIC
/begin CHARACTERISTIC DMLLRLMXN "Sicherheitskonzept: obere Begrenzung fÅr dmllrl" CURVE 0x81566D ME7_GKL1 0 rel_ub_b99p6 0.000000 99.609400
 /begin AXIS_DESCR COM_AXIS nmot_w nmot_uw_q0p25 0 0.000000 16383.800000 AXIS_PTS_REF SNM06LLUB /end AXIS_DESCR
 EXTENDED_LIMITS 0.000000 99.609375 /end CHARACTERISTIC
/begin CHARACTERISTIC DMLLRMNN "Untere Begrenzung fÅr dmllr_w" CURVE 0x815673 ME7_GKL2 0 rel_sb_q0p39 -49.996800 0.000000
 /begin AXIS_DESCR COM_AXIS nmot_w nmot_uw_q0p25 0 0.000000 16383.800000 AXIS_PTS_REF SNM06LLUB /end AXIS_DESCR
 EXTENDED_LIMITS -49.996800 49.606200 /end CHARACTERISTIC
/begin CHARACTERISTIC DMLLRMXN "Sicherheitskonzept: obere Begrenzung fÅr dmllr" CURVE 0x815679 ME7_GKL1 0 rel_ub_b99p6 0.000000 99.609400
 /begin AXIS_DESCR COM_AXIS nmot_w nmot_uw_q0p25 0 0.000000 16383.800000 AXIS_PTS_REF SNM06LLUB /end AXIS_DESCR
 EXTENDED_LIMITS 0.000000 99.609375 /end CHARACTERISTIC
/begin CHARACTERISTIC DMLSDUG_0_A "Delta Moment Ende LastschlagdÑmpfung" CURVE 0x812B12 ZF_KL117 0 rel_uw_b100 0.000000 99.998500
 /begin AXIS_DESCR STD_AXIS mkfanb_w rel_sw_b100 8 -100.000000 99.996900 DEPOSIT ABSOLUTE /end AXIS_DESCR
 EXTENDED_LIMITS 0.000000 99.998474 /end CHARACTERISTIC
/begin CHARACTERISTIC DMLSDUG_1_A "Delta Moment Ende LastschlagdÑmpfung" CURVE 0x812B34 ZF_KL117 0 rel_uw_b100 0.000000 99.998500
 /begin AXIS_DESCR STD_AXIS mkfanb_w rel_sw_b100 8 -100.000000 99.996900 DEPOSIT ABSOLUTE /end AXIS_DESCR
 EXTENDED_LIMITS 0.000000 99.998474 /end CHARACTERISTIC
/begin CHARACTERISTIC DMRESLL "LLR: Abbaugeschwindigkeit der erhîhten Drehmomentreserve" VALUE 0x8155F3 ME7_FW1 0 rel_ub_bn6p375 -6.375000 0.000000 /end CHARACTERISTIC
/begin CHARACTERISTIC DMRFAWE "Schwelle mrfa-Gradient fÅr Deaktivierung PT1-Filter beim Wiedereinsetzen" VALUE 0x812B56 ME7_FW3 0 rel_uw_b200 0.000000 199.997000 EXTENDED_LIMITS 0.000000 199.996948 /end CHARACTERISTIC
/begin CHARACTERISTIC DMRFGRAL "Delta Relatives Moment bei langsamer FGR-Abschaltung" VALUE 0x810F0A ME7_FW3 0 rel_uw_b200 0.000000 199.997000 EXTENDED_LIMITS 0.000000 199.996948 /end CHARACTERISTIC
/begin CHARACTERISTIC DMRKTD "Momentenreserve fÅr Katalysator-Diagnose" VALUE 0x81AD64 ME7_FW3 0 rel_uw_b100 0.000000 99.998500 EXTENDED_LIMITS 0.000000 99.998474 /end CHARACTERISTIC
/begin CHARACTERISTIC DMRLASH "Momentenreserve fÅr Diagnose Lambdasonden-AlterungsÅberwachung hinter KAT" VALUE 0x81AD48 ME7_FW3 0 rel_uw_b100 0.000000 99.998500 EXTENDED_LIMITS 0.000000 99.998474 /end CHARACTERISTIC
/begin CHARACTERISTIC DMRLSH "Momentenreserve fÅr Diagnose Lambdasonden hinter KAT" VALUE 0x81AD32 ME7_FW3 0 rel_uw_b100 0.000000 99.998500 EXTENDED_LIMITS 0.000000 99.998474 /end CHARACTERISTIC
/begin CHARACTERISTIC DMSLIFT "Delta-mslift-Schwelle fÅr Erkennung Messwert stabil" VALUE 0x818370 ME7_FW1 0 m_q0p4 0.000000 102.000000 /end CHARACTERISTIC
/begin CHARACTERISTIC DMSNTEMN "Minmale normierte MassenstromÑnderung TEV" VALUE 0x81D98E ME7_FW4 0 m_q0p1___SW -5.000000 3276.700000 EXTENDED_LIMITS -3276.800000 3276.700000 /end CHARACTERISTIC
/begin CHARACTERISTIC DMSNTEMX "Maximale normierte MassenstromÑnderung TEV" VALUE 0x81D990 ME7_FW4 0 m_q0p1___SW 2.000000 3276.700000 EXTENDED_LIMITS -3276.800000 3276.700000 /end CHARACTERISTIC
/begin CHARACTERISTIC DMSTES "Kennlinie maximale Zunahme Massenstrom TankentlÅftung" CURVE 0x8134EC ZF_KL111 0 m_uw_q3p2 0.000000 3276.800000
 /begin AXIS_DESCR STD_AXIS mstesoll_w m_uw_b25p6 6 0.000000 25.599600 DEPOSIT ABSOLUTE /end AXIS_DESCR
 EXTENDED_LIMITS 0.000000 209712.000000 /end CHARACTERISTIC
/begin CHARACTERISTIC DMVTEVDO "Schwelle Verlustadaption zur Unterscheidung min, max Fehler in DTEV" VALUE 0x81D992 ME7_FW4 0 rel_sw_b100 -100.000000 99.996900 EXTENDED_LIMITS -100.000000 99.996948 /end CHARACTERISTIC
/begin CHARACTERISTIC DMXRDL "Begrenzung bei max. Laufunruhe-Referenzwert-énderung von dlurs" VALUE 0x8146BB ME7_FW2 0 luquant 0.000000 80.212400 EXTENDED_LIMITS -80.843807 80.212215 /end CHARACTERISTIC
/begin CHARACTERISTIC DMXRFL "Begrenzung bei max. Filter-Laufunruhe-Referenzwert-énderung" VALUE 0x81456A ME7_FW2 0 luquant 0.000000 80.212400 EXTENDED_LIMITS -80.843807 80.212215 /end CHARACTERISTIC
/begin CHARACTERISTIC DMXRLU "Begrenzung bei max. Laufunruhe-Referenzwert-énderung" VALUE 0x814812 ME7_FW2 0 luquant 0.000000 80.212400 EXTENDED_LIMITS -80.843807 80.212215 /end CHARACTERISTIC
/begin CHARACTERISTIC DN10BURN "Minimaler Drehzahlanstieg fÅr 'Verbrennnung erfolgt'" VALUE 0x815221 ME7_FW1 0 nmot_ub_q10 0.000000 2550.000000 /end CHARACTERISTIC
/begin CHARACTERISTIC DNBURN "Minimaler Drehzahlanstieg fÅr erkannte Verbrennung" CURVE 0x8151D4 ME7_KL97 0 dez 0.000000 255.000000
 /begin AXIS_DESCR STD_AXIS nmot nmot_ub_q40 12 0.000000 10200.000000 DEPOSIT ABSOLUTE /end AXIS_DESCR
/end CHARACTERISTIC
/begin CHARACTERISTIC DNDLLRO "Maxmimale Drehzahlabweichung (Unterdrehzahl) fÅr Diagnose LLR" VALUE 0x819907 ME7_FW1 0 nmot_ub_q10 0.000000 1270.000000 EXTENDED_LIMITS 0.000000 2550.000000 /end CHARACTERISTIC
/begin CHARACTERISTIC DNDLLRU "Maxmimale Drehzahlabweichung (öberdrehzahl) fÅr Diagnose LLR" VALUE 0x819908 ME7_FW2 0 nmot_ub_q10___SB -1280.000000 0.000000 EXTENDED_LIMITS -1280.000000 1270.000000 /end CHARACTERISTIC
/begin CHARACTERISTIC DNDTEO "obere Nsoll-Nist-Schwelle fÅr Abbruch Diagnose TEV" VALUE 0x819BD1 ME7_FW2 0 nmot_ub_q10___SB 0.000000 200.000000 EXTENDED_LIMITS -1280.000000 1270.000000 /end CHARACTERISTIC
/begin CHARACTERISTIC DNDTEU "lower Nsoll-Nist-Schwelle fÅr Abbruch Diagnose TEV" VALUE 0x819BD2 ME7_FW2 0 nmot_ub_q10___SB -200.000000 0.000000 EXTENDED_LIMITS -1280.000000 1270.000000 /end CHARACTERISTIC
/begin CHARACTERISTIC DNDWG "Delta- n fÅr Erkennung Konstantfahrt bei Diagnose Waste- Gate" VALUE 0x81BFE6 ME7_FW3 0 nmot_uw_q0p25 0.000000 16383.800000 EXTENDED_LIMITS 0.000000 16383.750000 /end CHARACTERISTIC
/begin CHARACTERISTIC DNFILO_0_A "obere Schwelle fÅr Gradient des Filterausgangs ndfil" VALUE 0x812AC4 ME7_FW4 0 nmot_sw_q0p25 0.000000 8191.750000 EXTENDED_LIMITS -8192.000000 8191.750000 /end CHARACTERISTIC
/begin CHARACTERISTIC DNFILO_1_A "obere Schwelle fÅr Gradient des Filterausgangs ndfil" VALUE 0x812AC6 ME7_FW4 0 nmot_sw_q0p25 0.000000 8191.750000 EXTENDED_LIMITS -8192.000000 8191.750000 /end CHARACTERISTIC
/begin CHARACTERISTIC DNFILO_2_A "obere Schwelle fÅr Gradient des Filterausgangs ndfil" VALUE 0x812AC8 ME7_FW4 0 nmot_sw_q0p25 0.000000 8191.750000 EXTENDED_LIMITS -8192.000000 8191.750000 /end CHARACTERISTIC
/begin CHARACTERISTIC DNFILO_3_A "obere Schwelle fÅr Gradient des Filterausgangs ndfil" VALUE 0x812ACA ME7_FW4 0 nmot_sw_q0p25 0.000000 8191.750000 EXTENDED_LIMITS -8192.000000 8191.750000 /end CHARACTERISTIC
/begin CHARACTERISTIC DNFSAKH "Abregelung der Katheiz-Solldrehzahl (B_fs=1)" VALUE 0x8197B3 ME7_FW2 0 nmot_sb_q10 -1280.000000 0.000000 EXTENDED_LIMITS -1280.000000 1270.000000 /end CHARACTERISTIC
/begin CHARACTERISTIC DNLLAKH "Abregelung der Katheiz-Solldrehzahl (B_fs=0)" VALUE 0x8197B4 ME7_FW2 0 nmot_sb_q10 -1280.000000 0.000000 EXTENDED_LIMITS -1280.000000 1270.000000 /end CHARACTERISTIC
/begin CHARACTERISTIC DNLLR "Drehzahlband oberhalb nstat fÅr LLR-Freigabe" VALUE 0x8155D5 ME7_FW1 0 nmot_ub_q10 0.000000 2550.000000 /end CHARACTERISTIC
/begin CHARACTERISTIC DNLLRES "LLR: Unterdrehzahlschwelle zur Erhîhung der Momentenreserve im LL" VALUE 0x8155F4 ME7_FW2 0 nmotd_sb_q10 -1280.000000 1270.000000 /end CHARACTERISTIC
/begin CHARACTERISTIC DNLLRIST "öberdrehzahlschwelle fÅr Integratorreset" VALUE 0x81567F ME7_FW2 0 nmotd_sb_q10 -1280.000000 1270.000000 /end CHARACTERISTIC
/begin CHARACTERISTIC DNMAX "Drehzahlhysterese fÅr Drehzahlbegrenzung" VALUE 0x813454 ME7_FW3 0 nmot_uw_q0p25 0.000000 16383.800000 EXTENDED_LIMITS 0.000000 16383.750000 /end CHARACTERISTIC
/begin CHARACTERISTIC DNMAXH "Hysterese fÅr harte Drehzahlbegrenzung" VALUE 0x813456 ME7_FW3 0 nmot_uw_q0p25 0.000000 2550.000000 EXTENDED_LIMITS 0.000000 16383.750000 /end CHARACTERISTIC
/begin CHARACTERISTIC DNMNI "Kleinstmîglicher Wert fÅr dn beim I-Anteil" VALUE 0x815680 ME7_FW2 0 nmotd_sb_q10 -1280.000000 1270.000000 /end CHARACTERISTIC
/begin CHARACTERISTIC DNSAH "Delta n SA high bezogen auf nWE" VALUE 0x81552E ME7_FW1 0 nmot_ub_q40 0.000000 5080.000000 EXTENDED_LIMITS 0.000000 10200.000000 /end CHARACTERISTIC
/begin CHARACTERISTIC DNSAL "Delta n SA low bezogen auf nWE" VALUE 0x81552F ME7_FW1 0 nmot_ub_q40 0.000000 5080.000000 EXTENDED_LIMITS 0.000000 10200.000000 /end CHARACTERISTIC
/begin CHARACTERISTIC DNSATIP "Schubabschaltedrehzahlanhebung bei Tipgasse" VALUE 0x815530 ME7_FW1 0 nmot_ub_q40 0.000000 10200.000000 /end CHARACTERISTIC
/begin CHARACTERISTIC DNSLL "Schubabschalte-Hysterese bei WE im Leerlauf" VALUE 0x815531 ME7_FW1 0 nmot_ub_q40 0.000000 10200.000000 /end CHARACTERISTIC
/begin CHARACTERISTIC DNSNFX "Offset zur Bestimmung der oberen Grenze fÅr die SolldrehzahlnachfÅhrung" VALUE 0x8197B5 ME7_FW1 0 nmot_ub_q10 0.000000 2550.000000 /end CHARACTERISTIC
/begin CHARACTERISTIC DNVSA "Schubabschaltedrehzahlanhebung bei kleiner Geschwindigkeit" VALUE 0x815532 ME7_FW1 0 nmot_ub_q40 0.000000 10200.000000 /end CHARACTERISTIC
/begin CHARACTERISTIC DNWEK "Delta n fÅr WE bei Klima (AC)" VALUE 0x815533 ME7_FW1 0 nmot_ub_q40 0.000000 10200.000000 /end CHARACTERISTIC
/begin CHARACTERISTIC DPDSVLU "Delta Druckwert fÅr Signalvergleich Ladedruck mit Umgebungsdruck" VALUE 0x81B4AE ME7_FW3 0 p_uw_q0p039 0.000000 2559.960000 EXTENDED_LIMITS 0.000000 2559.960938 /end CHARACTERISTIC
/begin CHARACTERISTIC DPLSDWG "Max. Delta plsol fÅr Diagnose Waste- Gate" CURVE 0x8171B0 ME7_KL99 0 p_uw_q0p039 0.000000 2559.960000
 /begin AXIS_DESCR STD_AXIS nmot nmot_ub_q40 8 0.000000 10200.000000 DEPOSIT ABSOLUTE /end AXIS_DESCR
 EXTENDED_LIMITS 0.000000 2559.960938 /end CHARACTERISTIC
/begin CHARACTERISTIC DPSLV "minimale Druckdifferenz SekundÑrluftventi" VALUE 0x8182DA ME7_FW1 0 p_ub_q5 0.000000 1275.000000 /end CHARACTERISTIC
/begin CHARACTERISTIC DPUBABMX "Maximale Schwelle Delta Umgebungsdruck fÅr Bergaberkennung" VALUE 0x81358E ME7_FW3 0 p_uw_q0p039 0.000000 2559.960000 EXTENDED_LIMITS 0.000000 2559.960938 /end CHARACTERISTIC
/begin CHARACTERISTIC DPUFVMN "Spezifische Druckdifferenz fÅr SaugrohrdruckÅberwachung" VALUE 0x813590 ME7_FW3 0 p_uw_q0p039 0.000000 2559.960000 EXTENDED_LIMITS 0.000000 2559.960938 /end CHARACTERISTIC
/begin CHARACTERISTIC DPUFVSMN "Soll-Druckdifferenz fÅr SaugrohrdruckÅberwachung" VALUE 0x813592 ME7_FW3 0 p_uw_q0p039 0.000000 2559.960000 EXTENDED_LIMITS 0.000000 2559.960938 /end CHARACTERISTIC
/begin CHARACTERISTIC DPUPS "Druckdifferenz fÅr Umschaltung Referenzdruck vor Drosselklappe" VALUE 0x815113 ME7_FW1 0 p_ub_q10 0.000000 2550.000000 /end CHARACTERISTIC
/begin CHARACTERISTIC DPUPVDK "Differenzdruck pu-pvdk" CURVE 0x81B4B0 ZF_KL111 0 p_uw_q0p039 0.000000 2559.960000
 /begin AXIS_DESCR STD_AXIS ml_w m_uw_b6553p5 8 0.000000 6553.500000 DEPOSIT ABSOLUTE /end AXIS_DESCR
 EXTENDED_LIMITS 0.000000 2559.960938 /end CHARACTERISTIC
/begin CHARACTERISTIC DPVDKDWG "Min. Delta Druck vor DK fÅr Diagnose Waste- Gate" CURVE 0x8171CA ME7_KL99 0 p_uw_q0p039 0.000000 2559.960000
 /begin AXIS_DESCR STD_AXIS nmot nmot_ub_q40 8 0.000000 10200.000000 DEPOSIT ABSOLUTE /end AXIS_DESCR
 EXTENDED_LIMITS 0.000000 2559.960938 /end CHARACTERISTIC
/begin CHARACTERISTIC DPVLMS "Druckabfall am Luftfilter zur Berechnung Massestrom TankentlÅftung hinter Lader" CURVE 0x813622 ZF_KL111 0 p_uw_q0p039 0.000000 2559.960000
 /begin AXIS_DESCR STD_AXIS mshfm_w m_uw_b6553p5 6 0.000000 6553.500000 DEPOSIT ABSOLUTE /end AXIS_DESCR
 EXTENDED_LIMITS 0.000000 2559.960938 /end CHARACTERISTIC
/begin CHARACTERISTIC DPVRDKMN "Relativer Delta- Druck vor DK fÅr Diagnose Waste- Gate" CURVE 0x81BFE8 ZF_KL111 0 p_uw_q0p039 0.000000 2559.960000
 /begin AXIS_DESCR STD_AXIS pvdkrel_w p_uw_q0p039 4 0.000000 2559.960000 DEPOSIT ABSOLUTE /end AXIS_DESCR
 EXTENDED_LIMITS 0.000000 2559.960938 /end CHARACTERISTIC
/begin CHARACTERISTIC DRISIGH "Diagnoseschwelle Ri-Sonde fÅr Signalunterbrechung hinter KAT" VALUE 0x81AD34 ME7_FW3 0 r_uw_q2 0.000000 131070.000000 /end CHARACTERISTIC
/begin CHARACTERISTIC DRISIGV "Diagnoseschwelle Ri-Sonde fÅr Signalunterbrechung vor KAT" VALUE 0x81AD6E ME7_FW3 0 r_uw_q2 0.000000 131070.000000 /end CHARACTERISTIC
/begin CHARACTERISTIC DRLDWG "Delta- rl fÅr Erkennung Konstantfahrt bei Diagnose Waste- Gate" VALUE 0x81BFFA ME7_FW3 0 rel_uw_q0p0234 0.000000 1535.980000 EXTENDED_LIMITS 0.000000 1535.976562 /end CHARACTERISTIC
/begin CHARACTERISTIC DRLDYNU "drl-Schwellwert fÅr te-Nachspritzer/Reduktion" VALUE 0x811F2C ME7_FW4 0 rel_sw_q0p0234 0.023438 767.977000 EXTENDED_LIMITS -768.000000 767.976562 /end CHARACTERISTIC
/begin CHARACTERISTIC DRLKRAN "Erkennungsschwelle Lastdynamik fÅr StationÑradaption" CURVE 0x81BD44 ME7_GKL3 0 rel_uw_q0p0234 0.000000 767.977000
 /begin AXIS_DESCR COM_AXIS nmot nmot_ub_q40 0 0.000000 10200.000000 AXIS_PTS_REF SNM16KRUB /end AXIS_DESCR
 EXTENDED_LIMITS 0.000000 1535.976562 /end CHARACTERISTIC
/begin CHARACTERISTIC DRLKTDP "Schwelle fÅr LastÑnderung in Kat-Diagnose" VALUE 0x8184D4 ME7_FW2 0 rel_sb_q0p75 -96.000000 95.250000 /end CHARACTERISTIC
/begin CHARACTERISTIC DRLKTDPT "Schwelle fÅr LastÑnderung in Kat-Diagnose bei Testeransteuerung" VALUE 0x8184D5 ME7_FW2 0 rel_sb_q0p75 -96.000000 95.250000 /end CHARACTERISTIC
/begin CHARACTERISTIC DRLMIN "Min. FÅllungsÑnderung zur Auslîsung eines Nachspritzers" VALUE 0x811F2E ME7_FW4 0 rel_sw_q0p0234 -768.000000 767.977000 EXTENDED_LIMITS -768.000000 767.976562 /end CHARACTERISTIC
/begin CHARACTERISTIC DRLMINDP "Offset auf rlmin fÅr Abschaltung Dashpot" VALUE 0x812B58 ME7_FW4 0 rel_sw_q0p0234 -768.000000 767.977000 EXTENDED_LIMITS -768.000000 767.976562 /end CHARACTERISTIC
/begin CHARACTERISTIC DRLRLPU "Delta rl fÅr rlp - Untergrenze" VALUE 0x811F30 ME7_FW3 0 rel_uw_q0p0234 0.000000 1535.980000 EXTENDED_LIMITS 0.000000 1535.976562 /end CHARACTERISTIC
/begin CHARACTERISTIC DRLSOLA "Misfire Detection : Schwelle Lastdynamik fÅr Ausblendung" CURVE 0x810192 ME7_GKL3 0 rel_sw_q0p0234___UW 0.000000 767.977000
 /begin AXIS_DESCR COM_AXIS rl rel_ub_q0p75 0 0.000000 191.250000 AXIS_PTS_REF SRL08DMUB /end AXIS_DESCR
 EXTENDED_LIMITS 0.000000 1535.976562 /end CHARACTERISTIC
/begin CHARACTERISTIC DRLSPMN "Min. LastÑnderung zwischen 2 SondensprÅngen fÅr öK-Adaption" VALUE 0x8153F2 ME7_FW2 0 rel_sb_q0p75 0.000000 95.250000 EXTENDED_LIMITS -96.000000 95.250000 /end CHARACTERISTIC
/begin CHARACTERISTIC DSLGRAD "Gradient fÅr Drucksensor Ladedruck" VALUE 0x81185C ME7_FW3 0 dgrad_uw_q0p015 0.000000 1023.980000 EXTENDED_LIMITS 0.000000 1023.984375 /end CHARACTERISTIC
/begin CHARACTERISTIC DSLOFS "Offset Drucksensor Ladedruck" VALUE 0x81185E ME7_FW4 0 p_sw_q0p039 -1280.000000 1279.960000 EXTENDED_LIMITS -1280.000000 1279.960938 /end CHARACTERISTIC
/begin CHARACTERISTIC DSTEMIN "Minimalwert fÅr Weitertransport in Totzeitglied Gemischtransport" VALUE 0x813506 ME7_FW3 0 fak_uw_b2 0.000000 0.999969 EXTENDED_LIMITS 0.000000 1.999969 /end CHARACTERISTIC
/begin CHARACTERISTIC DSTGRAD "Gradient fÅr Umrechnung Spannung -> Druck bei Tankdrucksensor" VALUE 0x813562 ME7_FW3 0 adb_uw_q0p00195 0.000000 127.998000 EXTENDED_LIMITS 0.000000 127.998047 /end CHARACTERISTIC
/begin CHARACTERISTIC DSTOFFS "Offset fÅr Umrechnung Spannung -> Druck bei Tankdrucksensor" VALUE 0x813564 ME7_FW4 0 spg_sw_b5 -320.000000 10.000000 EXTENDED_LIMITS -320.000000 319.990234 /end CHARACTERISTIC
/begin CHARACTERISTIC DSUGRAD "Gradient fÅr Drucksensor Umgebung" VALUE 0x81B4D2 ME7_FW3 0 dgrad_uw_q0p015 0.000000 1023.980000 EXTENDED_LIMITS 0.000000 1023.984375 /end CHARACTERISTIC
/begin CHARACTERISTIC DSUOFS "Offset Drucksensor Umgebung" VALUE 0x81B4D4 ME7_FW4 0 p_sw_q0p039 -1280.000000 1279.960000 EXTENDED_LIMITS -1280.000000 1279.960938 /end CHARACTERISTIC
/begin CHARACTERISTIC DTABUNPL "Schwelle Abstellzeit unplausibel" VALUE 0x81B9A2 ME7_FW3 0 t1sxs_uw_q1 0.000000 65535.000000 /end CHARACTERISTIC
/begin CHARACTERISTIC DTAHLL "Delta Ansauglufttemperatur fÅr Abbruch erhîhte Solldrehzahl im Hei·-Leerlauf" VALUE 0x815539 ME7_FW1 0 temp_ub_b191p25 0.000000 191.250000 /end CHARACTERISTIC
/begin CHARACTERISTIC DTASWEMN "Delta TastverhÑltnis ABS Schlechtwegsignal" VALUE 0x8101C0 ME7_FW4 0 rel_sw_b50 0.000000 49.998500 EXTENDED_LIMITS -50.000000 49.998474 /end CHARACTERISTIC
/begin CHARACTERISTIC DTBTS "Temperaturhysterese fÅr Bauteileschutz" VALUE 0x81BA30 ME7_FW3 0 temp_uw_q0p0195 0.000000 1279.980000 EXTENDED_LIMITS 0.000000 1279.980469 /end CHARACTERISTIC
/begin CHARACTERISTIC DTEPRU "delta-te-Schwelle fuer Nachspritzer-/ti-Reduktion erkannt" VALUE 0x811F32 ME7_FW3 0 tinjection_sy 0.000000 209.712000 /end CHARACTERISTIC
/begin CHARACTERISTIC DTIABS "Dti-Schwellwert fÅr ersten Nachspritzer" VALUE 0x810CEE ME7_FW3 0 tinjection_sy 0.000000 209.712000 /end CHARACTERISTIC
/begin CHARACTERISTIC DTIREL "Dti-Schwellwert fÅr zweiten Nachspritzer" VALUE 0x814F61 ME7_FW1 0 rel_ub_b99p6 0.000000 99.609400 EXTENDED_LIMITS 0.000000 99.609375 /end CHARACTERISTIC
/begin CHARACTERISTIC DTKATMN "Hysterese Katalysatortemperaturregelschwelle fÅr Kat warmhalten" VALUE 0x81901A ME7_FW1 0 temp_ub_q5_o50 -50.000000 1225.000000 /end CHARACTERISTIC
/begin CHARACTERISTIC DTKH "Betrag Differenztemperatur (tans-tmst) fÅr Katheizen" VALUE 0x81901B ME7_FW1 0 temp_ub_b191p25 0.000000 191.250000 /end CHARACTERISTIC
/begin CHARACTERISTIC DTLRTML "Bewertungsfaktor Zeitdekrementierung fÅr Erreichen tmot-Einschaltschwelle LR" CURVE 0x818FDA ME7_KL97 0 rel_ub_b99p6 0.000000 99.609400
 /begin AXIS_DESCR STD_AXIS ml m_ub_b1020 7 0.000000 1020.000000 DEPOSIT ABSOLUTE /end AXIS_DESCR
 EXTENDED_LIMITS 0.000000 99.609375 /end CHARACTERISTIC
/begin CHARACTERISTIC DTMABKH "Temperaturdifferenz zwischen Abstellen und Neustart fÅr Freigabe Katheizen" VALUE 0x81901C ME7_FW1 0 temp_ub_b191p25 0.000000 191.250000 /end CHARACTERISTIC
/begin CHARACTERISTIC DTMDMA "Abstand Motortemperaturmodell zur Starttemperatur" VALUE 0x818FE9 ME7_FW1 0 temp_ub_b191p25 0.000000 191.250000 /end CHARACTERISTIC
/begin CHARACTERISTIC DTMDNPO "Abstand Motortemperaturmodell zur oberen UnplausibilitÑtsschwelle" VALUE 0x818FEA ME7_FW1 0 temp_ub_b191p25 0.000000 191.250000 /end CHARACTERISTIC
/begin CHARACTERISTIC DTMHLL "Delta Motortemperatur fÅr Abbruch erhîhte Solldrehzahl im Hei·-Leerlauf" VALUE 0x81553A ME7_FW1 0 temp_ub_b191p25 0.000000 191.250000 /end CHARACTERISTIC
/begin CHARACTERISTIC DTMLDP "Differenz Motorabstelltemperatur - TMOT bei Start" VALUE 0x819C40 ME7_FW1 0 temp_sb_q0p75 0.000000 191.250000 /end CHARACTERISTIC
/begin CHARACTERISTIC DTMR "Hysterese fÅr Einschaltschwelle" VALUE 0x819C73 ME7_FW1 0 temp_ub_b191p25 0.000000 191.250000 /end CHARACTERISTIC
/begin CHARACTERISTIC DTMSRT "Delta Motortemp.zu Starttemp. f.Retrigg. Modelle (Blockheater-Erkennung)" VALUE 0x818FEB ME7_FW1 0 temp_ub_b191p25 0.000000 191.250000 /end CHARACTERISTIC
/begin CHARACTERISTIC DTMTMRW "Temperaturdiff.-Schwelle fÅr die PrÅfung, ob Zwangseinschaltung LR nîtig (CARB)" VALUE 0x819C74 ME7_FW1 0 temp_sb_q0p75 0.000000 191.250000 /end CHARACTERISTIC
/begin CHARACTERISTIC DTMWUC "Delta Motortemperaturschwelle fÅr ErfÅllung 'warm up cycle'" VALUE 0x814D57 ME7_FW1 0 temp_ub_b191p25 0.000000 191.250000 /end CHARACTERISTIC
/begin CHARACTERISTIC DTPLDP "Delta-Periodendauer zur Berechnung des Fensters bei Leckdiagnose" VALUE 0x813594 ME7_FW3 0 t10msxs_uw_b655p35 0.000000 655.350000 /end CHARACTERISTIC
/begin CHARACTERISTIC DTPSWE "Toleranz Periodendauer Schlechtwegsignal" VALUE 0x8183A2 ME7_FW1 0 t100msxms_ub_b255 0.000000 255.000000 /end CHARACTERISTIC
/begin CHARACTERISTIC DTSDRL "LastÑnderungsgradientenschwelle fÅr Lastdynamikauslîsung" VALUE 0x81398C ME7_FW4 0 rel_sw_q0p0234 -768.000000 767.977000 EXTENDED_LIMITS -768.000000 767.976562 /end CHARACTERISTIC
/begin CHARACTERISTIC DTUMTA "Offset Ansauglufttemperatur -> Umgebungstemperatur" VALUE 0x818E10 ME7_FW2 0 temp_sb_q0p75___SB -96.000000 95.250000 /end CHARACTERISTIC
/begin CHARACTERISTIC DTUMTAT "Offset Ansauglufttemperatur -> Umgebungstemperatur" VALUE 0x8183E2 ME7_FW1 0 temp_ub_b191p25 0.000000 191.250000 /end CHARACTERISTIC
/begin CHARACTERISTIC DTVKAML "Delta-tv fÅr Katalysator-AusrÑumen (luftmassenabhÑngig)" CURVE 0x819CB0 ME7_GKL2 0 t100msxs_sb_q0p01 -1.280000 1.270000
 /begin AXIS_DESCR COM_AXIS ml m_ub_b1020 0 0.000000 1020.000000 AXIS_PTS_REF SML05LKUB /end AXIS_DESCR
/end CHARACTERISTIC
/begin CHARACTERISTIC DTVKAML2 "Delta-tv fÅr Katalysator-AusrÑumen (luftmassenabhÑngig) Bank2" CURVE 0x819CB5 ME7_GKL2 0 t100msxs_sb_q0p01 -1.280000 1.270000
 /begin AXIS_DESCR COM_AXIS ml m_ub_b1020 0 0.000000 1020.000000 AXIS_PTS_REF SML05LKUB /end AXIS_DESCR
/end CHARACTERISTIC
/begin CHARACTERISTIC DUBLBZ "Spannungsoffset fÅr Ladebilanzberechnung" VALUE 0x81858D ME7_FW1 0 spg_ubatt 0.000000 17.952000 /end CHARACTERISTIC
/begin CHARACTERISTIC DUBZS "Spannungsversatz zwischen SG und ZS" VALUE 0x81630E ME7_FW1 0 spg_ubatt 0.000000 17.952000 /end CHARACTERISTIC
/begin CHARACTERISTIC DUDKNLPO "Toleranzband fÅr NLP nach oben (inkl. RÅ)" VALUE 0x810C56 ME7_FW3 0 spg_uw_q0p001222 0.000000 5.004090 EXTENDED_LIMITS 0.000000 80.083770 /end CHARACTERISTIC
/begin CHARACTERISTIC DUDKNLPU "Toleranzband fÅr NLP nach unten" VALUE 0x810C58 ME7_FW3 0 spg_uw_q0p001222 0.000000 5.004090 EXTENDED_LIMITS 0.000000 80.083770 /end CHARACTERISTIC
/begin CHARACTERISTIC DUDKP1HY "Offset fÅr Hysterese bei Umschaltung auf verstÑrktes Signal von DK-Poti 1" VALUE 0x810C50 ME7_FW3 0 spg_uw_q0p001222 0.000000 80.083800 EXTENDED_LIMITS 0.000000 80.083770 /end CHARACTERISTIC
/begin CHARACTERISTIC DUDKPTMP "Delta eines Rampenschrittes bei der temp. UMA-Adaption" VALUE 0x810C5A ME7_FW3 0 spg_uw_q0p001222 0.004888 80.083800 EXTENDED_LIMITS 0.000000 80.083770 /end CHARACTERISTIC
/begin CHARACTERISTIC DUF_T "Zeit fÅrs Setzen der Zyklusflags der FunktionsÅberwachungs-Diagnose" VALUE 0x815E15 ME7_FW1 0 t100msxs_ub_b25p5 0.000000 25.500000 /end CHARACTERISTIC
/begin CHARACTERISTIC DUKK "Schwelle fÅr Kurzzeitanteil" VALUE 0x811FE6 ME7_FW4 0 rel_sw_q0p1875 -6144.000000 6143.810000 EXTENDED_LIMITS -6144.000000 6143.812500 /end CHARACTERISTIC
/begin CHARACTERISTIC DUPW12 "ZulÑssige Spannungsabweichung zwischen PWG-Poti 1 und 2" VALUE 0x814DB5 ME7_FW1 0 spg_ub_b5 0.000000 4.980470 EXTENDED_LIMITS 0.000000 4.980469 /end CHARACTERISTIC
/begin CHARACTERISTIC DUPW12BE "notweniger Spannungsweg von Poti 2 zur Bewegungserkennung" VALUE 0x810C30 ME7_FW3 0 spg_uw_q0p00488 0.000000 4.995120 EXTENDED_LIMITS 0.000000 319.995117 /end CHARACTERISTIC
/begin CHARACTERISTIC DUPW12KD "Maximal zulÑssige Differenz der PWG-Poti-Spannungen beim Kick-Down-Lernen" VALUE 0x810C3C ME7_FW3 0 spg_uw_q0p004888 0.000000 320.335000 EXTENDED_LIMITS 0.000000 320.335080 /end CHARACTERISTIC
/begin CHARACTERISTIC DUPW12TG "ZulÑssige Spannungsabweichung zwischen PWG Poti 1 und  2 im Teilgasbereich" VALUE 0x814DB6 ME7_FW1 0 spg_ub_b5 0.000000 4.980470 EXTENDED_LIMITS 0.000000 4.980469 /end CHARACTERISTIC
/begin CHARACTERISTIC DUPW12VG "ZulÑssige Spannungsabweichung zwischen PWG-Poti 1 und 2 im Vollgasbereich" VALUE 0x814DB7 ME7_FW1 0 spg_ub_b5 0.000000 4.980470 EXTENDED_LIMITS 0.000000 4.980469 /end CHARACTERISTIC
/begin CHARACTERISTIC DUPWGHY "Spannungshysterese bei Entjitterung der PWG-Spannung" VALUE 0x810C32 ME7_FW3 0 spg_uw_q0p00488 0.000000 4.995120 EXTENDED_LIMITS 0.000000 319.995117 /end CHARACTERISTIC
/begin CHARACTERISTIC DUPWGLKD "Maximal zulÑssige énderung der PWG-Poti-Spannung wÑhrend KD-Abspeicherung" VALUE 0x810C3E ME7_FW3 0 spg_uw_q0p004888 0.000000 320.335000 EXTENDED_LIMITS 0.000000 320.335080 /end CHARACTERISTIC
/begin CHARACTERISTIC DUPWKDLB "MindestÅberschreitung des gespeicherten KD-Werts fÅr KD-Lernen im Betrieb" VALUE 0x810C40 ME7_FW3 0 spg_uw_q0p004888 0.000000 320.335000 EXTENDED_LIMITS 0.000000 320.335080 /end CHARACTERISTIC
/begin CHARACTERISTIC DUPWKDO "Delta PWG-Poti-Spannung zum Setzen der Kick-Down-Information" VALUE 0x810C42 ME7_FW3 0 spg_uw_q0p004888 0.000000 320.335000 EXTENDED_LIMITS 0.000000 320.335080 /end CHARACTERISTIC
/begin CHARACTERISTIC DUPWKDU "Delta PWG-Poti-Spannung zum RÅcksetzen der Kick-Down-Information" VALUE 0x810C44 ME7_FW3 0 spg_uw_q0p004888 0.000000 320.335000 EXTENDED_LIMITS 0.000000 320.335080 /end CHARACTERISTIC
/begin CHARACTERISTIC DUSRIH "Delta Sondenspannung h. Kat zwischen Neu-und Altwert im Raster fÅr Ri-Messung" VALUE 0x810BB4 ME7_FW4 0 spg_sw_q0p00488 -160.000000 159.995000 EXTENDED_LIMITS -160.000000 159.995117 /end CHARACTERISTIC
/begin CHARACTERISTIC DUSRIV "Delta Sondenspannung vor Kat zwischen Neu-und Altwert im Raster fÅr Ri-Messung" VALUE 0x810BCC ME7_FW4 0 spg_sw_q0p00488 -160.000000 159.995000 EXTENDED_LIMITS -160.000000 159.995117 /end CHARACTERISTIC
/begin CHARACTERISTIC DUSSPH "Delta Sondensp. hinter Kat zwischen Neu-und 2 Altwerten fÅr Sonden Sprungmessung" VALUE 0x810BB6 ME7_FW4 0 spg_sw_q0p00488 -160.000000 159.995000 EXTENDED_LIMITS -160.000000 159.995117 /end CHARACTERISTIC
/begin CHARACTERISTIC DUSSPV "Delta Sondensp. vor Kat zwischen Neu-und Altwert fÅr Sonden Sprungmessung" VALUE 0x810BCE ME7_FW4 0 spg_sw_q0p00488 -160.000000 159.995000 EXTENDED_LIMITS -160.000000 159.995117 /end CHARACTERISTIC
/begin CHARACTERISTIC DVAQUGMX "Max. zul. Geschw.differenz bei Aquaplaningerkennung fÅr gro·e Geschw." VALUE 0x810CF0 ME7_FW3 0 vfzg_uw_b512 0.000000 511.992000 EXTENDED_LIMITS 0.000000 511.992188 /end CHARACTERISTIC
/begin CHARACTERISTIC DVAQUKMX "Max. zul. Geschw.differenz bei Aquaplaningerkennung fÅr kleine Geschw." VALUE 0x810CF2 ME7_FW3 0 vfzg_uw_b512 0.000000 511.992000 EXTENDED_LIMITS 0.000000 511.992188 /end CHARACTERISTIC
/begin CHARACTERISTIC DVEEST "Zeit fÅr Heilungsversuch der DV-E-Endstufe" VALUE 0x814F5A ME7_FW1 0 t10msxs_ub_b2p55 0.000000 2.550000 /end CHARACTERISTIC
/begin CHARACTERISTIC DVFGREO "Delta-Geschw. fÅr obere FGR-Einschaltgeschwindigkeit" VALUE 0x810CF4 ME7_FW3 0 vfzg_uw_b512 0.000000 511.992000 EXTENDED_LIMITS 0.000000 511.992188 /end CHARACTERISTIC
/begin CHARACTERISTIC DVFGREU "Delta-Geschw. fÅr untere FGR-Einschaltgeschwindigkeit" VALUE 0x810CF6 ME7_FW3 0 vfzg_uw_b512 0.000000 511.992000 EXTENDED_LIMITS 0.000000 511.992188 /end CHARACTERISTIC
/begin CHARACTERISTIC DVFZAR_0_A "Hysterese fuer Geschwindigkeitsschwelle bei AR" VALUE 0x817270 ME7_FW1 0 vfzg_ub_q1p25___UB 0.000000 318.750000 /end CHARACTERISTIC
/begin CHARACTERISTIC DVFZAR_1_A "Hysterese fuer Geschwindigkeitsschwelle bei AR" VALUE 0x817271 ME7_FW1 0 vfzg_ub_q1p25___UB 0.000000 318.750000 /end CHARACTERISTIC
/begin CHARACTERISTIC DVFZAR_2_A "Hysterese fuer Geschwindigkeitsschwelle bei AR" VALUE 0x817272 ME7_FW1 0 vfzg_ub_q1p25___UB 0.000000 318.750000 /end CHARACTERISTIC
/begin CHARACTERISTIC DVFZAR_3_A "Hysterese fuer Geschwindigkeitsschwelle bei AR" VALUE 0x817273 ME7_FW1 0 vfzg_ub_q1p25___UB 0.000000 318.750000 /end CHARACTERISTIC
/begin CHARACTERISTIC DVFZBAB "Geschwindigkeitsdifferenz zur Bergaberkennung" VALUE 0x819C41 ME7_FW2 0 vfzg_ub_q1p25 -160.000000 158.750000 /end CHARACTERISTIC
/begin CHARACTERISTIC DVFZBEG "Delta-Geschwindigkeit fÅr énderungsbegrenzung" VALUE 0x810004 ME7_FW3 0 vfzg_uw_b512 0.000000 511.992000 EXTENDED_LIMITS 0.000000 511.992188 /end CHARACTERISTIC
/begin CHARACTERISTIC DVIVZMX "Max. zul. Abweichung zw. Istgeschw. und Zielgeschw. bei FGR-Konstantfahrt" VALUE 0x810CF8 ME7_FW3 0 vfzg_uw_b512 0.000000 511.992000 EXTENDED_LIMITS 0.000000 511.992188 /end CHARACTERISTIC
/begin CHARACTERISTIC DVIVZTMX "Maximales Delta zw. Ist- und Zielgeschw. fÅr Tip-Erlaubnis" VALUE 0x81AF02 ME7_FW3 0 vfzg_uw_b512 0.000000 511.992000 EXTENDED_LIMITS 0.000000 511.992188 /end CHARACTERISTIC
/begin CHARACTERISTIC DVLLVO "Delta Geschwindigkeit fÅr RÅcksetzen Leerlauf-Verbot vom FGR" VALUE 0x81AF04 ME7_FW3 0 vfzg_uw_b512 0.000000 511.992000 EXTENDED_LIMITS 0.000000 511.992188 /end CHARACTERISTIC
/begin CHARACTERISTIC DVLLVU "Delta Geschwindigkeit fÅr Setzen Leerlauf-Verbot vom FGR" VALUE 0x81AF06 ME7_FW3 0 vfzg_uw_b512 0.000000 511.992000 EXTENDED_LIMITS 0.000000 511.992188 /end CHARACTERISTIC
/begin CHARACTERISTIC DVNG "LLR: D-VerstÑrkung abh. von ngfil bei stehendem Fahrzeug" CURVE 0x815681 ME7_GKL1 0 rel_qn0p000488 -0.124512 0.000000
 /begin AXIS_DESCR COM_AXIS ngfil nmotg_sb_q100 0 -12800.000000 12700.000000 AXIS_PTS_REF SNG06LLSB /end AXIS_DESCR
/end CHARACTERISTIC
/begin CHARACTERISTIC DVNGV "LLR: D-VerstÑrkung abh. von ngfil bei roolendem Fahrzeug" CURVE 0x815687 ME7_GKL1 0 rel_qn0p000488 -0.124512 0.000000
 /begin AXIS_DESCR COM_AXIS ngfil nmotg_sb_q100 0 -12800.000000 12700.000000 AXIS_PTS_REF SNG06LLSB /end AXIS_DESCR
/end CHARACTERISTIC
/begin CHARACTERISTIC DVSA "delta Geschwindigkeitsschwelle fÅr SA-Drehzahlanhebung" VALUE 0x815534 ME7_FW1 0 vfzg_ub_q1p25___UB 0.000000 318.750000 /end CHARACTERISTIC
/begin CHARACTERISTIC DVSAVO "Delta Geschwindigkeit fÅr RÅcksetzen Schubabschalteverbot vom FGR" VALUE 0x81AF08 ME7_FW3 0 vfzg_uw_b512 0.000000 511.992000 EXTENDED_LIMITS 0.000000 511.992188 /end CHARACTERISTIC
/begin CHARACTERISTIC DVSAVU "Delta Geschwindigkeit fÅr Setzen Schubabschalteverbot vom FGR" VALUE 0x81AF0A ME7_FW3 0 vfzg_uw_b512 0.000000 511.992000 EXTENDED_LIMITS 0.000000 511.992188 /end CHARACTERISTIC
/begin CHARACTERISTIC DVSKNBGA_0_A "Delta Geschwindigkeit fÅr Setzwertkorrektur nach Beschleunigen" CURVE 0x810D0A ME7_GKL3 0 vfzg_uw_b512 0.000000 511.992000
 /begin AXIS_DESCR COM_AXIS uevges fak_q0p1 0 0.000000 25.500000 AXIS_PTS_REF SUE08MFUB /end AXIS_DESCR
 EXTENDED_LIMITS 0.000000 511.992188 /end CHARACTERISTIC
/begin CHARACTERISTIC DVSKNBGA_1_A "Delta Geschwindigkeit fÅr Setzwertkorrektur nach Beschleunigen" CURVE 0x810D1A ME7_GKL3 0 vfzg_uw_b512 0.000000 511.992000
 /begin AXIS_DESCR COM_AXIS uevges fak_q0p1 0 0.000000 25.500000 AXIS_PTS_REF SUE08MFUB /end AXIS_DESCR
 EXTENDED_LIMITS 0.000000 511.992188 /end CHARACTERISTIC
/begin CHARACTERISTIC DVSKNVGA_0_A "Delta Geschwindigkeit fÅr Setzwertkorrektur nach Verzîgern" CURVE 0x810D2A ME7_GKL3 0 vfzg_uw_b512 0.000000 511.992000
 /begin AXIS_DESCR COM_AXIS uevges fak_q0p1 0 0.000000 25.500000 AXIS_PTS_REF SUE08MFUB /end AXIS_DESCR
 EXTENDED_LIMITS 0.000000 511.992188 /end CHARACTERISTIC
/begin CHARACTERISTIC DVSKNVGA_1_A "Delta Geschwindigkeit fÅr Setzwertkorrektur nach Verzîgern" CURVE 0x810D3A ME7_GKL3 0 vfzg_uw_b512 0.000000 511.992000
 /begin AXIS_DESCR COM_AXIS uevges fak_q0p1 0 0.000000 25.500000 AXIS_PTS_REF SUE08MFUB /end AXIS_DESCR
 EXTENDED_LIMITS 0.000000 511.992188 /end CHARACTERISTIC
/begin CHARACTERISTIC DVTIPUD "énderung der Zielgeschwindigkeit bei Tip-Up oder Tip-Down" VALUE 0x81AF0C ME7_FW3 0 vfzg_uw_b512 0.000000 511.992000 EXTENDED_LIMITS 0.000000 511.992188 /end CHARACTERISTIC
/begin CHARACTERISTIC DVZVIMX "Max. zul. Abweichung zw. Zielgeschw. und Istgeschw. bei FGR-Konstantfahrt" VALUE 0x810CFA ME7_FW3 0 vfzg_uw_b512 0.000000 511.992000 EXTENDED_LIMITS 0.000000 511.992188 /end CHARACTERISTIC
/begin CHARACTERISTIC DVZVITMX "Maximales Delta zw. Ziel- und Istgeschw. fÅr Tip-Erlaubnis" VALUE 0x81AF0E ME7_FW3 0 vfzg_uw_b512 0.000000 511.992000 EXTENDED_LIMITS 0.000000 511.992188 /end CHARACTERISTIC
/begin CHARACTERISTIC DVZVIWA "Delta zw. Ziel- und Istgeschw. fÅr öbergang von Konstantfahrt in Wiederaufnahme" VALUE 0x81AF10 ME7_FW3 0 vfzg_uw_b512 0.000000 511.992000 EXTENDED_LIMITS 0.000000 511.992188 /end CHARACTERISTIC
/begin CHARACTERISTIC DVZVRWA1_0_A "Delta zw. Ziel- und Sollgeschw. fÅr öbergang in WA-Lande-Mode Bereich 1" VALUE 0x81AF8E ME7_FW3 0 vfzg_uw_b512 0.000000 511.992000 EXTENDED_LIMITS 0.000000 511.992188 /end CHARACTERISTIC
/begin CHARACTERISTIC DVZVRWA1_1_A "Delta zw. Ziel- und Sollgeschw. fÅr öbergang in WA-Lande-Mode Bereich 1" VALUE 0x81AF90 ME7_FW3 0 vfzg_uw_b512 0.000000 511.992000 EXTENDED_LIMITS 0.000000 511.992188 /end CHARACTERISTIC
/begin CHARACTERISTIC DVZVRWA2_0_A "Delta zw. Ziel- und Sollgeschw. fÅr öbergang in WA-Lande-Mode Bereich 2" VALUE 0x81AF92 ME7_FW3 0 vfzg_uw_b512 0.000000 511.992000 EXTENDED_LIMITS 0.000000 511.992188 /end CHARACTERISTIC
/begin CHARACTERISTIC DVZVRWA2_1_A "Delta zw. Ziel- und Sollgeschw. fÅr öbergang in WA-Lande-Mode Bereich 2" VALUE 0x81AF94 ME7_FW3 0 vfzg_uw_b512 0.000000 511.992000 EXTENDED_LIMITS 0.000000 511.992188 /end CHARACTERISTIC
/begin CHARACTERISTIC DVZVRWA3_0_A "Delta zw. Ziel- und Sollgeschw. fÅr öbergang in WA-Lande-Mode Bereich 3" VALUE 0x81AF96 ME7_FW3 0 vfzg_uw_b512 0.000000 511.992000 EXTENDED_LIMITS 0.000000 511.992188 /end CHARACTERISTIC
/begin CHARACTERISTIC DVZVRWA3_1_A "Delta zw. Ziel- und Sollgeschw. fÅr öbergang in WA-Lande-Mode Bereich 3" VALUE 0x81AF98 ME7_FW3 0 vfzg_uw_b512 0.000000 511.992000 EXTENDED_LIMITS 0.000000 511.992188 /end CHARACTERISTIC
/begin CHARACTERISTIC DWDK12O "Maximal zulÑssige Abweichung zwischen den DK-Winkeln aus Poti 1 und 2" VALUE 0x814DD6 ME7_FW1 0 relDK_ub_b100 0.000000 100.000000 /end CHARACTERISTIC
/begin CHARACTERISTIC DWDK13O "Maximal zulÑssige Abweichung zwischen DK-Winkel aus Poti 1 und Ersatzwert" VALUE 0x814DD7 ME7_FW1 0 relDK_ub_b100 0.000000 100.000000 /end CHARACTERISTIC
/begin CHARACTERISTIC DWDK23O "Maximal zulÑssige Abweichung zwischen DK-Winkel aus Poti 2 und Ersatzwert" VALUE 0x814DD8 ME7_FW1 0 relDK_ub_b100 0.000000 100.000000 /end CHARACTERISTIC
/begin CHARACTERISTIC DWDKSBAMX "max. Soll-/Ist-DK-Winkel-Abweichung als f(dwdks)" CURVE 0x810CC2 ZF_KL111 0 relDK_uw_b100 0.000000 100.000000
 /begin AXIS_DESCR STD_AXIS gwdk_kge relDK_q0p00152___UW 5 0.000000 99.998500 DEPOSIT ABSOLUTE /end AXIS_DESCR
/end CHARACTERISTIC
/begin CHARACTERISTIC DWDKSIKLS "Schwelle zur Aktivierung des I-Kleinanteils" VALUE 0x810CD8 ME7_FW4 0 relDK_q0p02441 -800.000000 799.976000 EXTENDED_LIMITS -800.000000 799.975586 /end CHARACTERISTIC
/begin CHARACTERISTIC DWEEMX "maximal zulÑssige énderung Winkel Einspritzende pro ZÅndundung" VALUE 0x8151C4 ME7_FW1 0 zw_ub_q6 0.000000 1530.000000 /end CHARACTERISTIC
/begin CHARACTERISTIC DWKRMSN "delta Winkel KR Abstand zur gemittelten SpÑtverstellung" CURVE 0x819362 ME7_GKL1 0 zw_ub_qn0p75 -191.250000 0.000000
 /begin AXIS_DESCR COM_AXIS nmot nmot_ub_q40 0 0.000000 10200.000000 AXIS_PTS_REF SNM16KRUB /end AXIS_DESCR
/end CHARACTERISTIC
/begin CHARACTERISTIC DWNWEMXT "theoretisch maximales delta zwischen SpÑt- und FrÅhstellung des Einla·ventil" VALUE 0x8187BF ME7_FW1 0 kw_ub_q0p5 0.000000 127.500000 /end CHARACTERISTIC
/begin CHARACTERISTIC DWPEDKOB "Gradient des norm. Fahrpedalwinkels fÅr KOS-Auschalten" VALUE 0x816476 ME7_FW2 0 rel_sb_q0p39 -49.996800 49.606200 /end CHARACTERISTIC
/begin CHARACTERISTIC DWPMXNB "Maximal zulÑssige Pedalwerterhîhung pro Rechenschritt nach BremsbetÑtigung" VALUE 0x810C34 ME7_FW3 0 relPED_uw_b100 0.000000 100.000000 /end CHARACTERISTIC
/begin CHARACTERISTIC DWPMXNOT "Maximal zulÑssige Pedalwerterhîhung pro Rechenschritt im PWG-Ersatzbetrieb" VALUE 0x810C36 ME7_FW3 0 relPED_uw_b100 0.000000 100.000000 /end CHARACTERISTIC
/begin CHARACTERISTIC DWPR "Delta PrÑdiktionswinkel ohne Nachspritzer/ti-Reduktion" VALUE 0x8151C0 ME7_FW2 0 kw_q6___SB -768.000000 762.000000 /end CHARACTERISTIC
/begin CHARACTERISTIC DWPRNSP "Delta PrÑdiktionswinkel bei Nachspritzerfreigabe" VALUE 0x8151C1 ME7_FW2 0 kw_q6___SB -768.000000 762.000000 /end CHARACTERISTIC
/begin CHARACTERISTIC DYADMXN "Max. Wert des add. Dynamikvorhalts" CURVE 0x8120A8 ZF_KL117 0 zw_uw_qn0p75 -20.250000 0.000000
 /begin AXIS_DESCR STD_AXIS stuetz dez___SW 5 -32768.000000 32767.000000 DEPOSIT ABSOLUTE /end AXIS_DESCR
 EXTENDED_LIMITS -49151.250000 0.000000 /end CHARACTERISTIC
/begin CHARACTERISTIC DYADS "Add. SpÑtverstellung pro Zyk. durch lern. Dyn." VALUE 0x815435 ME7_FW1 0 zw_ub_qn0p75 -24.000000 0.000000 EXTENDED_LIMITS -191.250000 0.000000 /end CHARACTERISTIC
/begin CHARACTERISTIC DYAFVS "Stufenhîhe fÅr Abregelung des Dynamikvorhalts" VALUE 0x815436 ME7_FW1 0 zw_ub_q0p75 0.000000 20.250000 EXTENDED_LIMITS 0.000000 191.250000 /end CHARACTERISTIC
/begin CHARACTERISTIC DYAMNV "Min. Wert des add. Dynamikvorhalts" VALUE 0x815437 ME7_FW1 0 zw_ub_qn0p75 -24.000000 0.000000 EXTENDED_LIMITS -191.250000 0.000000 /end CHARACTERISTIC
/begin CHARACTERISTIC DYAVF "Abregelkonstante fÅr Dynamikvorhalt" VALUE 0x815438 ME7_FW1 0 dez 1.000000 255.000000 EXTENDED_LIMITS 0.000000 255.000000 /end CHARACTERISTIC
/begin CHARACTERISTIC DZWAML "Auf/Abregelgeschwindigkeit zwischen den Begrenzungskennfeldern" CURVE 0x81EB40 ME7_KL98 0 zw_sb_q0p75 -96.000000 95.250000
 /begin AXIS_DESCR STD_AXIS ml m_ub_b1020 12 0.000000 1020.000000 DEPOSIT ABSOLUTE /end AXIS_DESCR
/end CHARACTERISTIC
/begin CHARACTERISTIC DZWETA "DeltazÅndwinkel aus Wirkungsgrad" CURVE 0x815EE4 ME7_FKL2 0 zw_sb_q0p75 -96.000000 95.250000
 /begin AXIS_DESCR FIX_AXIS etazws rel_ub_b127p5___SL 201 0.000000 100.000000 FIX_AXIS_PAR 0 0 201 /end AXIS_DESCR
/end CHARACTERISTIC
/begin RECORD_LAYOUT ME7_FKL2 FNC_VALUES 1 SBYTE COLUMN_DIR DIRECT /end RECORD_LAYOUT
/begin CHARACTERISTIC DZWNWSUE "Delta ZÅndwinkel abhÑngig von NockenwellenÅberschneidung" CURVE 0x813968 ME7_KL98 0 zw_sb_q0p75 -96.000000 95.250000
 /begin AXIS_DESCR STD_AXIS wnwue kw_ub_q0p5 10 0.000000 127.500000 DEPOSIT ABSOLUTE /end AXIS_DESCR
/end CHARACTERISTIC
/begin CHARACTERISTIC DZWOLA "Lambda-AbhÑngigkeit des optimalen ZÅndwinkels bezogen auf Lambda 1" CURVE 0x8132BA ME7_KL98 0 zw_sb_q0p75 -96.000000 95.250000
 /begin AXIS_DESCR STD_AXIS lambas fak_ub_b2 10 0.000000 1.992190 DEPOSIT ABSOLUTE /end AXIS_DESCR
/end CHARACTERISTIC
/begin CHARACTERISTIC DZWOM "temperaturabhÑngiger Offset des optimalen ZW" CURVE 0x8132D0 ME7_KL98 0 zw_sb_q0p75 -96.000000 95.250000
 /begin AXIS_DESCR STD_AXIS tmot temp_ub_q0p75_o48 5 -48.000000 143.250000 DEPOSIT ABSOLUTE /end AXIS_DESCR
/end CHARACTERISTIC
/begin CHARACTERISTIC DZWSPM "Delta spÑtester ZÅndwinkel abhÑngig von Motortemperatur" CURVE 0x819E3A ME7_GKL2 0 zw_sb_q0p75 -96.000000 95.250000
 /begin AXIS_DESCR COM_AXIS tmot temp_ub_q0p75_o48 0 -48.000000 143.250000 AXIS_PTS_REF STM06__UB /end AXIS_DESCR
/end CHARACTERISTIC
/begin CHARACTERISTIC DZWSTTA "Delta ZÅndwinkel im Start" CURVE 0x81EB92 ME7_KL98 0 zw_sb_q0p75 -96.000000 95.250000
 /begin AXIS_DESCR STD_AXIS tans temp_ub_q0p75_o48 6 -48.000000 143.250000 DEPOSIT ABSOLUTE /end AXIS_DESCR
/end CHARACTERISTIC
/begin CHARACTERISTIC DZWTIN "delta-ZÅndwinkel bei Tip in" CURVE 0x8120BE ZF_KL117 0 zw_uw_qn0p75 -20.250000 0.000000
 /begin AXIS_DESCR STD_AXIS nmot nmot_ub_q40___SW 16 -1310720.000000 1310680.000000 DEPOSIT ABSOLUTE /end AXIS_DESCR
 EXTENDED_LIMITS -49151.250000 0.000000 /end CHARACTERISTIC
/begin CHARACTERISTIC DZW_AOG "oberer Grenzwert Anpassung ZÅndwinkel additiv" VALUE 0x815448 ME7_FW2 0 zw_sb_q0p75 -96.000000 95.250000 /end CHARACTERISTIC
/begin CHARACTERISTIC DZW_AUG "unterer Grenzwert Anpassung ZÅndwinkel additiv" VALUE 0x815449 ME7_FW2 0 zw_sb_q0p75 -96.000000 95.250000 /end CHARACTERISTIC
/begin CHARACTERISTIC DZZST "Anzahl ZÑhne bei ZahnunterdrÅckung im Start" VALUE 0x814D6C ME7_FW1 0 dez 0.000000 254.000000 EXTENDED_LIMITS 0.000000 255.000000 /end CHARACTERISTIC
/begin CHARACTERISTIC EDLDRP "Schwelle Regelabweichung fÅr Diagnose LDR-Regelabweichung positiv" VALUE 0x8196A0 ME7_FW2 0 p_sb_q10 0.000000 1270.000000 EXTENDED_LIMITS -1280.000000 1270.000000 /end CHARACTERISTIC
/begin CHARACTERISTIC ELDOB "Regelabweichungsschwelle fÅr Start ZeitzÑhler LDR-Overboost activ" VALUE 0x8194BF ME7_FW2 0 p_sb_q10 0.000000 1270.000000 EXTENDED_LIMITS -1280.000000 1270.000000 /end CHARACTERISTIC
/begin CHARACTERISTIC ENASAG "Freigabe SA gangabhaengig" VALUE 0x815535 ME7_FW1 0 dez 0.000000 255.000000 /end CHARACTERISTIC
/begin CHARACTERISTIC ENTDKLL "Entjitterschwelle (Ink) fÅr DK-Sollwert im Leerlauf (B_ll)" VALUE 0x815121 ME7_FW1 0 dez 0.000000 20.000000 EXTENDED_LIMITS 0.000000 255.000000 /end CHARACTERISTIC
/begin CHARACTERISTIC ENTDKNLL "Entjitterschwelle (Ink) fÅr DK-Sollwert au·erhalb Leerlauf (!B_ll)" VALUE 0x815122 ME7_FW1 0 dez 0.000000 20.000000 EXTENDED_LIMITS 0.000000 255.000000 /end CHARACTERISTIC
/begin CHARACTERISTIC ESKONF "Konfiguration Endstufen" VAL_BLK 0x814FF1 ME7_FWB1 0 dez 0.000000 255.000000 NUMBER 7 /end CHARACTERISTIC
/begin CHARACTERISTIC ETADZW "ZW-Wirkungsgrad in AbhÑngigkeit von delta ZW" CURVE 0x81570D ME7_FKL1 0 rel_ub_b127p5 0.000000 127.500000
 /begin AXIS_DESCR FIX_AXIS dzw_kge zw_sb_q0p75___SL 65 0.000000 48.000000 FIX_AXIS_PAR 0 0 65 /end AXIS_DESCR
/end CHARACTERISTIC
/begin RECORD_LAYOUT ME7_FKL1 FNC_VALUES 1 UBYTE COLUMN_DIR DIRECT /end RECORD_LAYOUT
/begin CHARACTERISTIC ETALAM "Lambda-Wirkungsgrad" CURVE 0x81574E ME7_KL97 0 rel_ub_b127p5 0.000000 127.500000
 /begin AXIS_DESCR STD_AXIS lambas fak_ub_b2 10 0.000000 1.992190 DEPOSIT ABSOLUTE /end AXIS_DESCR
/end CHARACTERISTIC
/begin CHARACTERISTIC ETAZWTEN "minimale ZÅndwinkelwirkungsgrad Schwelle fÅr DTEV" VALUE 0x819BD3 ME7_FW1 0 rel_ub_b127p5 0.000000 60.000000 EXTENDED_LIMITS 0.000000 127.500000 /end CHARACTERISTIC
/begin CHARACTERISTIC EVTMODO "Offset fÅr evtmod abhÑngig von gefilterter Motortemperatur" CURVE 0x818622 ME7_KL97 0 temp_ub_q0p75_o48 -48.000000 143.250000
 /begin AXIS_DESCR STD_AXIS tmotfil temp_ub_q0p75_o48 12 -48.000000 143.250000 DEPOSIT ABSOLUTE /end AXIS_DESCR
/end CHARACTERISTIC
/begin CHARACTERISTIC EVZ_DAT_UC "" VAL_BLK 0x815AEA ME7_FWB1 0 dez 0.000000 255.000000 NUMBER 16 /end CHARACTERISTIC
/begin CHARACTERISTIC FABMDWA "Faktor zur Absteuerung des Wandlermoments abhÑngig von nturb/nsol" CURVE 0x815576 ME7_KL97 0 fak_ub_b1 0.000000 0.996094
 /begin AXIS_DESCR STD_AXIS qntns fak_ub_b8 6 0.000000 7.968750 DEPOSIT ABSOLUTE /end AXIS_DESCR
/end CHARACTERISTIC
/begin CHARACTERISTIC FABSTT "Faktor Abstellzeit fÅr Modelltemparatur" CURVE 0x81BA3A ZF_KL111 0 fak_uw_b2 0.000000 1.999970
 /begin AXIS_DESCR STD_AXIS tabst_w t1sxs_uw_q1 5 0.000000 65535.000000 DEPOSIT ABSOLUTE /end AXIS_DESCR
 EXTENDED_LIMITS 0.000000 1.999969 /end CHARACTERISTIC
/begin CHARACTERISTIC FALRKTD "VerstÑrkungsfaktor fÅr Amplitude des Lambdareglers" VALUE 0x8184D6 ME7_FW1 0 fak_ub_b8 0.000000 7.968750 /end CHARACTERISTIC
/begin CHARACTERISTIC FALRKTT "VerstÑrkungsfaktor fÅr Amplitude des Lambdareglers bei Testerbetrieb" VALUE 0x8184D7 ME7_FW1 0 fak_ub_b8 0.000000 7.968750 /end CHARACTERISTIC
/begin CHARACTERISTIC FASKIV1 "Faktor fÅr VerlÑngerung 1. KAT-Intervall, Aussetzererkennung" VALUE 0x814AC4 ME7_FW1 0 dez 1.000000 5.000000 EXTENDED_LIMITS 0.000000 255.000000 /end CHARACTERISTIC
/begin CHARACTERISTIC FATMRML "Faktor fuer die Aufteilung Abgas-/Abgas-Rohrwandtemperatur" CURVE 0x8183E3 ME7_GKL1 0 fak_ub_b1 0.000000 0.996094
 /begin AXIS_DESCR COM_AXIS ml_w m_uw_b6553p5 0 0.000000 6553.500000 AXIS_PTS_REF SML07TMUW /end AXIS_DESCR
/end CHARACTERISTIC
/begin CHARACTERISTIC FBA_AOG "oberer Grenzwert Anpassung Faktor BA" VALUE 0x81544A ME7_FW1 0 fak_ub_b2 0.000000 1.992190 EXTENDED_LIMITS 0.000000 1.992188 /end CHARACTERISTIC
/begin CHARACTERISTIC FBA_AUG "unterer Grenzwert Anpassung Faktor BA" VALUE 0x81544B ME7_FW1 0 fak_ub_b2 0.000000 1.992190 EXTENDED_LIMITS 0.000000 1.992188 /end CHARACTERISTIC
/begin CHARACTERISTIC FBSTABGM "Faktor Bauteileschutz abhÑngig von model. Abgastemperatur" CURVE 0x812026 ZF_KL111 0 fak_uw_b2 0.000000 1.999970
 /begin AXIS_DESCR STD_AXIS tabgm_w temp_uw_q0p0195_o50 4 -50.000000 1229.980000 DEPOSIT ABSOLUTE /end AXIS_DESCR
 EXTENDED_LIMITS 0.000000 1.999969 /end CHARACTERISTIC
/begin CHARACTERISTIC FBTEB "Faktor Begrenzung Lerngeschwindigkeit fÅr Beladung" CURVE 0x819A38 ME7_KL97 0 fak_ub_b1 0.000000 0.996094
 /begin AXIS_DESCR STD_AXIS ftefvab fak_ub_b0p03125 6 0.000000 0.031128 DEPOSIT ABSOLUTE /end AXIS_DESCR
/end CHARACTERISTIC
/begin CHARACTERISTIC FBTEVA "Faktor ftefva-abhÑngige Lerngeschwindigkeit der Beladung" CURVE 0x819A45 ME7_KL97 0 fak_ub_b1 0.000000 0.996094
 /begin AXIS_DESCR STD_AXIS ftefva fak_ub_b0p5 6 0.000000 0.498047 DEPOSIT ABSOLUTE /end AXIS_DESCR
/end CHARACTERISTIC
/begin CHARACTERISTIC FDDN "LLR: Gewichtungsfaktor fÅr D-VerstÑrkung" CURVE 0x81568D ME7_GKL1 0 fak_ub_b1 0.000000 0.996094
 /begin AXIS_DESCR COM_AXIS dns nmotd_sb_q10 0 -1280.000000 1270.000000 AXIS_PTS_REF SNS06LLSB /end AXIS_DESCR
/end CHARACTERISTIC
/begin CHARACTERISTIC FDMDWAN "Wichtungsfaktor fÅr Einrechnung D-Anteil in Wandlermoment" VALUE 0x815583 ME7_FW1 0 fak_ub_b1 0.000000 0.996094 /end CHARACTERISTIC
/begin CHARACTERISTIC FDNIKOR "Faktor fÅr Korrektur auif I-Anteil Åber dn" VALUE 0x815693 ME7_FW1 0 fak_ub_b2 0.000000 1.992190 EXTENDED_LIMITS 0.000000 1.992188 /end CHARACTERISTIC
/begin CHARACTERISTIC FDVAGR "Temperaturfaktor fÅr Drosselventildurchflu·-AGR" CURVE 0x8150F2 ME7_KL97 0 fak_ub_b2 0.000000 1.992190
 /begin AXIS_DESCR STD_AXIS tagrv temp_ub_q5_o50 8 -50.000000 1225.000000 DEPOSIT ABSOLUTE /end AXIS_DESCR
 EXTENDED_LIMITS 0.000000 1.992188 /end CHARACTERISTIC
/begin CHARACTERISTIC FDVANS "Temperaturfaktor fÅr Drosselventildurchflu·" CURVE 0x81863B ME7_KL97 0 fak_ub_b2 0.000000 1.992190
 /begin AXIS_DESCR STD_AXIS tans temp_ub_q0p75_o48 8 -48.000000 143.250000 DEPOSIT ABSOLUTE /end AXIS_DESCR
 EXTENDED_LIMITS 0.000000 1.992188 /end CHARACTERISTIC
/begin CHARACTERISTIC FETATEBN "Kennlinie fÅr drehzahlabhÑngigen Sollwert des Motorwirkungsgrades" CURVE 0x819A52 ME7_KL97 0 fak_ub_b1 0.000000 0.996094
 /begin AXIS_DESCR STD_AXIS nmot nmot_ub_q40 5 0.000000 10200.000000 DEPOSIT ABSOLUTE /end AXIS_DESCR
/end CHARACTERISTIC
/begin CHARACTERISTIC FFRITMS "Faktor fÅr I-Dynamik des Lambdareglers in AbhÑngigkeit von tmst" CURVE 0x819D2D ME7_KL97 0 fak_ub_b1 0.000000 0.996094
 /begin AXIS_DESCR STD_AXIS tmst temp_ub_q0p75_o48 4 -48.000000 143.250000 DEPOSIT ABSOLUTE /end AXIS_DESCR
/end CHARACTERISTIC
/begin CHARACTERISTIC FFTAAA "Dummy: Tabellenanfang" VAL_BLK 0x814B92 ME7_FWB1 0 dez 0.000000 255.000000 NUMBER 2 /end CHARACTERISTIC
/begin CHARACTERISTIC FFTAAVE "Freeze Frame Tabelle: Absperrventil Aktivkohlefilter (Endstufe)" VAL_BLK 0x814B94 ME7_FWB1 0 dez 0.000000 255.000000 NUMBER 2 /end CHARACTERISTIC
/begin CHARACTERISTIC FFTAGRE "Freeze Frame Tabelle: AGR-Ventil Endstufe" VAL_BLK 0x814B96 ME7_FWB1 0 dez 0.000000 255.000000 NUMBER 2 /end CHARACTERISTIC
/begin CHARACTERISTIC FFTAGRF "Freeze Frame Tabelle: öberwachung AGR-Flow" VAL_BLK 0x814B98 ME7_FWB1 0 dez 0.000000 255.000000 NUMBER 2 /end CHARACTERISTIC
/begin CHARACTERISTIC FFTBM "Freeze Frame Tabelle: Bezugsmarkengeber" VAL_BLK 0x814B9A ME7_FWB1 0 dez 0.000000 255.000000 NUMBER 2 /end CHARACTERISTIC
/begin CHARACTERISTIC FFTBREMS "Freeze Frame Tabelle: Pedalwertgeber Bremse" VAL_BLK 0x814B9C ME7_FWB1 0 dez 0.000000 255.000000 NUMBER 2 /end CHARACTERISTIC
/begin CHARACTERISTIC FFTBWF "Freeze Frame Tabelle: PWG Bewegung" VAL_BLK 0x814B9E ME7_FWB1 0 dez 0.000000 255.000000 NUMBER 2 /end CHARACTERISTIC
/begin CHARACTERISTIC FFTCADR "Freeze Frame Tabelle: CAN- Timeout ADR" VAL_BLK 0x814BA0 ME7_FWB1 0 dez 0.000000 255.000000 NUMBER 2 /end CHARACTERISTIC
/begin CHARACTERISTIC FFTCAS "Freeze Frame Tabelle: CAN-Timeout ASC-Botschaft" VAL_BLK 0x814BA2 ME7_FWB1 0 dez 0.000000 255.000000 NUMBER 2 /end CHARACTERISTIC
/begin CHARACTERISTIC FFTCAT "Freeze Frame Tabelle: CAN-Schnittstelle, Timeout ASR" VAL_BLK 0x814BA4 ME7_FWB1 0 dez 0.000000 255.000000 NUMBER 2 /end CHARACTERISTIC
/begin CHARACTERISTIC FFTCGE "Freeze Frame Tabelle: CAN-Timeout EGS-Botschaft" VAL_BLK 0x814BA6 ME7_FWB1 0 dez 0.000000 255.000000 NUMBER 2 /end CHARACTERISTIC
/begin CHARACTERISTIC FFTCIF "Freeze Frame Tabelle: CAN-Schnittstelle, interner Fehler" VAL_BLK 0x814BA8 ME7_FWB1 0 dez 0.000000 255.000000 NUMBER 2 /end CHARACTERISTIC
/begin CHARACTERISTIC FFTCINS "Freeze Frame Tabelle: CAN-Timeout Instr.-Botschaft" VAL_BLK 0x814BAA ME7_FWB1 0 dez 0.000000 255.000000 NUMBER 2 /end CHARACTERISTIC
/begin CHARACTERISTIC FFTCLWS "Freeze Frame Tabelle: CAN-Schnittstelle, Timeout Botschaft Lenkwinkelsensor" VAL_BLK 0x814BAC ME7_FWB1 0 dez 0.000000 255.000000 NUMBER 2 /end CHARACTERISTIC
/begin CHARACTERISTIC FFTDK "Freeze Frame Tabelle: DK- Potentiometer" VAL_BLK 0x814BAE ME7_FWB1 0 dez 0.000000 255.000000 NUMBER 2 /end CHARACTERISTIC
/begin CHARACTERISTIC FFTDK1P "Freeze Frame Tabelle: Drosselklappe 1. Poti" VAL_BLK 0x814BB0 ME7_FWB1 0 dez 0.000000 255.000000 NUMBER 2 /end CHARACTERISTIC
/begin CHARACTERISTIC FFTDK2P "Freeze Frame Tabelle: Drosselklappenpotentiometer 2" VAL_BLK 0x814BB2 ME7_FWB1 0 dez 0.000000 255.000000 NUMBER 2 /end CHARACTERISTIC
/begin CHARACTERISTIC FFTDPL "Freeze Frame Tabelle: Dauerplus" VAL_BLK 0x814BB4 ME7_FWB1 0 dez 0.000000 255.000000 NUMBER 2 /end CHARACTERISTIC
/begin CHARACTERISTIC FFTDSL "Freeze Frame Tabelle: Drucksensor Ladedruck" VAL_BLK 0x814BB6 ME7_FWB1 0 dez 0.000000 255.000000 NUMBER 2 /end CHARACTERISTIC
/begin CHARACTERISTIC FFTDSS "Freeze Frame Tabelle: Saugrohrdrucksensor" VAL_BLK 0x814BB8 ME7_FWB1 0 dez 0.000000 255.000000 NUMBER 2 /end CHARACTERISTIC
/begin CHARACTERISTIC FFTDSU "Freeze Frame Tabelle: Umgebungsdrucksensor" VAL_BLK 0x814BBA ME7_FWB1 0 dez 0.000000 255.000000 NUMBER 2 /end CHARACTERISTIC
/begin CHARACTERISTIC FFTDSVLU "" VAL_BLK 0x814BBC ME7_FWB1 0 dez 0.000000 255.000000 NUMBER 2 /end CHARACTERISTIC
/begin CHARACTERISTIC FFTDVEE "Freeze Frame Tabelle: DV-E Endstufe" VAL_BLK 0x814BBE ME7_FWB1 0 dez 0.000000 255.000000 NUMBER 2 /end CHARACTERISTIC
/begin CHARACTERISTIC FFTDVEF "Freeze Frame Tabelle: DV-E Fehler bei FederprÅfung" VAL_BLK 0x814BC0 ME7_FWB1 0 dez 0.000000 255.000000 NUMBER 2 /end CHARACTERISTIC
/begin CHARACTERISTIC FFTDVEFO "" VAL_BLK 0x814BC2 ME7_FWB1 0 dez 0.000000 255.000000 NUMBER 2 /end CHARACTERISTIC
/begin CHARACTERISTIC FFTDVEL "Freeze Frame Tabelle: DV-E Lageabweichung" VAL_BLK 0x814BC4 ME7_FWB1 0 dez 0.000000 255.000000 NUMBER 2 /end CHARACTERISTIC
/begin CHARACTERISTIC FFTDVEN "Freeze Frame Tabelle: DV-E Fehler bei PrÅfung Notluftposition" VAL_BLK 0x814BC6 ME7_FWB1 0 dez 0.000000 255.000000 NUMBER 2 /end CHARACTERISTIC
/begin CHARACTERISTIC FFTDVER "Freeze Frame Tabelle: DV-E Regelbereich" VAL_BLK 0x814BC8 ME7_FWB1 0 dez 0.000000 255.000000 NUMBER 2 /end CHARACTERISTIC
/begin CHARACTERISTIC FFTDVET "" VAL_BLK 0x814BCA ME7_FWB1 0 dez 0.000000 255.000000 NUMBER 2 /end CHARACTERISTIC
/begin CHARACTERISTIC FFTDVEU "Freeze Frame Tabelle: DV-E Fehler beim UMA-Lernen" VAL_BLK 0x814BCC ME7_FWB1 0 dez 0.000000 255.000000 NUMBER 2 /end CHARACTERISTIC
/begin CHARACTERISTIC FFTDVEUB "" VAL_BLK 0x814BCE ME7_FWB1 0 dez 0.000000 255.000000 NUMBER 2 /end CHARACTERISTIC
/begin CHARACTERISTIC FFTDVEUW "" VAL_BLK 0x814BD0 ME7_FWB1 0 dez 0.000000 255.000000 NUMBER 2 /end CHARACTERISTIC
/begin CHARACTERISTIC FFTDVEV "Freeze Frame Tabelle: DV-E Fehler bei VerstÑrkerabgleich" VAL_BLK 0x814BD2 ME7_FWB1 0 dez 0.000000 255.000000 NUMBER 2 /end CHARACTERISTIC
/begin CHARACTERISTIC FFTEGFE "" VAL_BLK 0x814BD4 ME7_FWB1 0 dez 0.000000 255.000000 NUMBER 2 /end CHARACTERISTIC
/begin CHARACTERISTIC FFTEPCLE "Freeze Frame Tabelle: Fahrverhaltens- Fehllampe ( Endstufe )" VAL_BLK 0x814BD6 ME7_FWB1 0 dez 0.000000 255.000000 NUMBER 2 /end CHARACTERISTIC
/begin CHARACTERISTIC FFTETSE "Freeze Frame Tabelle: Elektrisches Thermostat Endstufe" VAL_BLK 0x814BD8 ME7_FWB1 0 dez 0.000000 255.000000 NUMBER 2 /end CHARACTERISTIC
/begin CHARACTERISTIC FFTEV1 "Freeze Frame Tabelle: EV Endstufe 1" VAL_BLK 0x814BDA ME7_FWB1 0 dez 0.000000 255.000000 NUMBER 2 /end CHARACTERISTIC
/begin CHARACTERISTIC FFTEV2 "Freeze Frame Tabelle: EV Endstufe 2" VAL_BLK 0x814BDC ME7_FWB1 0 dez 0.000000 255.000000 NUMBER 2 /end CHARACTERISTIC
/begin CHARACTERISTIC FFTEV3 "Freeze Frame Tabelle: EV Endstufe 3" VAL_BLK 0x814BDE ME7_FWB1 0 dez 0.000000 255.000000 NUMBER 2 /end CHARACTERISTIC
/begin CHARACTERISTIC FFTEV4 "Freeze Frame Tabelle: EV Endstufe 4" VAL_BLK 0x814BE0 ME7_FWB1 0 dez 0.000000 255.000000 NUMBER 2 /end CHARACTERISTIC
/begin CHARACTERISTIC FFTEV5 "Freeze Frame Tabelle: EV Endstufe 5" VAL_BLK 0x814BE2 ME7_FWB1 0 dez 0.000000 255.000000 NUMBER 2 /end CHARACTERISTIC
/begin CHARACTERISTIC FFTEV6 "Freeze frame Tabelle: EV Endstufe 6" VAL_BLK 0x814BE4 ME7_FWB1 0 dez 0.000000 255.000000 NUMBER 2 /end CHARACTERISTIC
/begin CHARACTERISTIC FFTEV7 "Freeze Frame Tabelle: EV Endstufe 7" VAL_BLK 0x814BE6 ME7_FWB1 0 dez 0.000000 255.000000 NUMBER 2 /end CHARACTERISTIC
/begin CHARACTERISTIC FFTEV8 "Freeze Frame Tabelle: EV Endstufe 8" VAL_BLK 0x814BE8 ME7_FWB1 0 dez 0.000000 255.000000 NUMBER 2 /end CHARACTERISTIC
/begin CHARACTERISTIC FFTFP1P "Freeze Frame Tabelle: Poti 1, Fahrpedal" VAL_BLK 0x814BEA ME7_FWB1 0 dez 0.000000 255.000000 NUMBER 2 /end CHARACTERISTIC
/begin CHARACTERISTIC FFTFP2P "Freeze Frame Tabelle: Poti 2, Fahrpedal" VAL_BLK 0x814BEC ME7_FWB1 0 dez 0.000000 255.000000 NUMBER 2 /end CHARACTERISTIC
/begin CHARACTERISTIC FFTFPP "Freeze Frame Tabelle: Poti Fahrpedal" VAL_BLK 0x814BEE ME7_FWB1 0 dez 0.000000 255.000000 NUMBER 2 /end CHARACTERISTIC
/begin CHARACTERISTIC FFTFRAO "Freeze Frame Tabelle: FRAO Gemischadaption" VAL_BLK 0x814BF0 ME7_FWB1 0 dez 0.000000 255.000000 NUMBER 2 /end CHARACTERISTIC
/begin CHARACTERISTIC FFTFRAU "Freeze Frame Tabelle: FRAU Gemischadaption" VAL_BLK 0x814BF2 ME7_FWB1 0 dez 0.000000 255.000000 NUMBER 2 /end CHARACTERISTIC
/begin CHARACTERISTIC FFTFRST "Freeze Frame Tabelle: LR-Abweichung" VAL_BLK 0x814BF4 ME7_FWB1 0 dez 0.000000 255.000000 NUMBER 2 /end CHARACTERISTIC
/begin CHARACTERISTIC FFTGECOD "" VAL_BLK 0x814BF6 ME7_FWB1 0 dez 0.000000 255.000000 NUMBER 2 /end CHARACTERISTIC
/begin CHARACTERISTIC FFTGRBH "Freeze Frame Tabelle: GRA- Bedienhebel" VAL_BLK 0x814BF8 ME7_FWB1 0 dez 0.000000 255.000000 NUMBER 2 /end CHARACTERISTIC
/begin CHARACTERISTIC FFTHSH "Tabelle Umweltbedingungen Heizung Lambdasonde hinter Kat" VAL_BLK 0x814BFA ME7_FWB1 0 dez 0.000000 255.000000 NUMBER 2 /end CHARACTERISTIC
/begin CHARACTERISTIC FFTHSHE "Tabelle Umweltbedingungen Endstufe Heizung Lambdasonde hinter Kat" VAL_BLK 0x814BFC ME7_FWB1 0 dez 0.000000 255.000000 NUMBER 2 /end CHARACTERISTIC
/begin CHARACTERISTIC FFTHSHE2 "Freeze Frame Tabelle: Endstufe Heizung Sonde hinter Kat. Bank 2" VAL_BLK 0x814BFE ME7_FWB1 0 dez 0.000000 255.000000 NUMBER 2 /end CHARACTERISTIC
/begin CHARACTERISTIC FFTHSV "Tabelle Umweltbedingungen Heizung Lambdasonde vor Kat" VAL_BLK 0x814C00 ME7_FWB1 0 dez 0.000000 255.000000 NUMBER 2 /end CHARACTERISTIC
/begin CHARACTERISTIC FFTHSV2 "Tabelle Umweltbedingungen Heizung Lambdasonde vor Kat Bank2" VAL_BLK 0x814C02 ME7_FWB1 0 dez 0.000000 255.000000 NUMBER 2 /end CHARACTERISTIC
/begin CHARACTERISTIC FFTKAT "Freeze Frame Tabelle: Katalysator" VAL_BLK 0x814C04 ME7_FWB1 0 dez 0.000000 255.000000 NUMBER 2 /end CHARACTERISTIC
/begin CHARACTERISTIC FFTKPE "Freeze Frame Tabelle: EKP-Relais Endstufe" VAL_BLK 0x814C06 ME7_FWB1 0 dez 0.000000 255.000000 NUMBER 2 /end CHARACTERISTIC
/begin CHARACTERISTIC FFTKRA01 "Freeze Frame Tabelle: Klopfregelanschlag Zylinder 1" VAL_BLK 0x814C08 ME7_FWB1 0 dez 0.000000 255.000000 NUMBER 2 /end CHARACTERISTIC
/begin CHARACTERISTIC FFTKRA02 "Freeze Frame Tabelle: Klopfregelanschlag Zylinder 2" VAL_BLK 0x814C0A ME7_FWB1 0 dez 0.000000 255.000000 NUMBER 2 /end CHARACTERISTIC
/begin CHARACTERISTIC FFTKRA03 "Freeze Frame Tabelle: Klopfregelanschlag Zylinder 3" VAL_BLK 0x814C0C ME7_FWB1 0 dez 0.000000 255.000000 NUMBER 2 /end CHARACTERISTIC
/begin CHARACTERISTIC FFTKRA04 "Freeze Frame Tabelle: Klopfregelanschlag Zylinder 4" VAL_BLK 0x814C0E ME7_FWB1 0 dez 0.000000 255.000000 NUMBER 2 /end CHARACTERISTIC
/begin CHARACTERISTIC FFTKRA05 "Freeze Frame Tabelle: Klopfregelanschlag Zylinder 5" VAL_BLK 0x814C10 ME7_FWB1 0 dez 0.000000 255.000000 NUMBER 2 /end CHARACTERISTIC
/begin CHARACTERISTIC FFTKRA06 "Freeze Frame Tabelle: Klopfregelanschlag Zylinder 6" VAL_BLK 0x814C12 ME7_FWB1 0 dez 0.000000 255.000000 NUMBER 2 /end CHARACTERISTIC
/begin CHARACTERISTIC FFTKRA07 "Freeze Frame Tabelle: Klopfregelanschlag Zylinder 7" VAL_BLK 0x814C14 ME7_FWB1 0 dez 0.000000 255.000000 NUMBER 2 /end CHARACTERISTIC
/begin CHARACTERISTIC FFTKRA08 "Freeze Frame Tabelle: Klopfregelanschlag Zylinder 8" VAL_BLK 0x814C16 ME7_FWB1 0 dez 0.000000 255.000000 NUMBER 2 /end CHARACTERISTIC
/begin CHARACTERISTIC FFTKRNT "Freeze frame Tabelle: Klopfregelung Nulltest" VAL_BLK 0x814C18 ME7_FWB1 0 dez 0.000000 255.000000 NUMBER 2 /end CHARACTERISTIC
/begin CHARACTERISTIC FFTKROF "Freeze Frame Tabelle: Klopfregelung Offset" VAL_BLK 0x814C1A ME7_FWB1 0 dez 0.000000 255.000000 NUMBER 2 /end CHARACTERISTIC
/begin CHARACTERISTIC FFTKRTP "Freeze Frame Tabelle: Klopfregelung Testimpuls" VAL_BLK 0x814C1C ME7_FWB1 0 dez 0.000000 255.000000 NUMBER 2 /end CHARACTERISTIC
/begin CHARACTERISTIC FFTKS1 "Freeze Frame Tabelle: Klopfsensor 1" VAL_BLK 0x814C1E ME7_FWB1 0 dez 0.000000 255.000000 NUMBER 2 /end CHARACTERISTIC
/begin CHARACTERISTIC FFTKS2 "Freeze Frame Tabelle: Klopfsensor 2" VAL_BLK 0x814C20 ME7_FWB1 0 dez 0.000000 255.000000 NUMBER 2 /end CHARACTERISTIC
/begin CHARACTERISTIC FFTKS3 "Freeze Frame Tabelle: Klopfsensor 3" VAL_BLK 0x814C22 ME7_FWB1 0 dez 0.000000 255.000000 NUMBER 2 /end CHARACTERISTIC
/begin CHARACTERISTIC FFTKS4 "Freeze Frame Tabelle: Klopfsensor 4" VAL_BLK 0x814C24 ME7_FWB1 0 dez 0.000000 255.000000 NUMBER 2 /end CHARACTERISTIC
/begin CHARACTERISTIC FFTKUPPL "Freeze Frame Tabelle: Pedalwertgeber Kupplung" VAL_BLK 0x814C26 ME7_FWB1 0 dez 0.000000 255.000000 NUMBER 2 /end CHARACTERISTIC
/begin CHARACTERISTIC FFTLASH "Tabelle Umweltbedingungen Lambdasonde hinter Kat" VAL_BLK 0x814C28 ME7_FWB1 0 dez 0.000000 255.000000 NUMBER 2 /end CHARACTERISTIC
/begin CHARACTERISTIC FFTLASH2 "Tabelle Umweltbedingungen Lambdasonde hinter Kat Bank2" VAL_BLK 0x814C2A ME7_FWB1 0 dez 0.000000 255.000000 NUMBER 2 /end CHARACTERISTIC
/begin CHARACTERISTIC FFTLATP "Tabelle Umweltbedingungen Lambda-Sondenalterung Tp vor Kat" VAL_BLK 0x814C2C ME7_FWB1 0 dez 0.000000 255.000000 NUMBER 2 /end CHARACTERISTIC
/begin CHARACTERISTIC FFTLATP2 "Tabelle Umweltbedingungen Lambda-Sondenalterung Tp vor Kat Bank2" VAL_BLK 0x814C2E ME7_FWB1 0 dez 0.000000 255.000000 NUMBER 2 /end CHARACTERISTIC
/begin CHARACTERISTIC FFTLATV "Tabelle Umweltbedingungen Lambda-Sondenalterung Tv vor Kat" VAL_BLK 0x814C30 ME7_FWB1 0 dez 0.000000 255.000000 NUMBER 2 /end CHARACTERISTIC
/begin CHARACTERISTIC FFTLATV2 "Tabelle Umweltbedingungen Lambda-Sondenalterung Tv vor Kat Bank2" VAL_BLK 0x814C32 ME7_FWB1 0 dez 0.000000 255.000000 NUMBER 2 /end CHARACTERISTIC
/begin CHARACTERISTIC FFTLDE "Freeze Frame Tabelle: LDR Taktventil Endstufe" VAL_BLK 0x814C34 ME7_FWB1 0 dez 0.000000 255.000000 NUMBER 2 /end CHARACTERISTIC
/begin CHARACTERISTIC FFTLDO "Freeze Frame Tabelle: LDR öberladefehler" VAL_BLK 0x814C36 ME7_FWB1 0 dez 0.000000 255.000000 NUMBER 2 /end CHARACTERISTIC
/begin CHARACTERISTIC FFTLDP "Freeze Frame Tabelle: Leckdiagnosepumpe" VAL_BLK 0x814C38 ME7_FWB1 0 dez 0.000000 255.000000 NUMBER 2 /end CHARACTERISTIC
/begin CHARACTERISTIC FFTLDPE "Freeze Frame Tabelle: LDP Endstufe" VAL_BLK 0x814C3A ME7_FWB1 0 dez 0.000000 255.000000 NUMBER 2 /end CHARACTERISTIC
/begin CHARACTERISTIC FFTLDRA "Freeze Frame Tabelle: LDR Regelabweichungsfehler" VAL_BLK 0x814C3C ME7_FWB1 0 dez 0.000000 255.000000 NUMBER 2 /end CHARACTERISTIC
/begin CHARACTERISTIC FFTLLR "Freeze Frame Tabelle: Leerlaufregelung" VAL_BLK 0x814C3E ME7_FWB1 0 dez 0.000000 255.000000 NUMBER 2 /end CHARACTERISTIC
/begin CHARACTERISTIC FFTLM "Freeze Frame Tabelle: HauptfÅllungssensor" VAL_BLK 0x814C40 ME7_FWB1 0 dez 0.000000 255.000000 NUMBER 2 /end CHARACTERISTIC
/begin CHARACTERISTIC FFTLSH "Tabelle Umweltbedingungen Lambdasonde hinter Kat" VAL_BLK 0x814C42 ME7_FWB1 0 dez 0.000000 255.000000 NUMBER 2 /end CHARACTERISTIC
/begin CHARACTERISTIC FFTLSV "Tabelle Umweltbedingungen: Lambdasonde vor Kat" VAL_BLK 0x814C44 ME7_FWB1 0 dez 0.000000 255.000000 NUMBER 2 /end CHARACTERISTIC
/begin CHARACTERISTIC FFTMD "Freeze Frame Tabelle: Aussetzer, Summenfehler (multiple)" VAL_BLK 0x814C46 ME7_FWB1 0 dez 0.000000 255.000000 NUMBER 2 /end CHARACTERISTIC
/begin CHARACTERISTIC FFTMD01 "Freeze Frame Tabelle: Aussetzer Zyl. 1" VAL_BLK 0x814C48 ME7_FWB1 0 dez 0.000000 255.000000 NUMBER 2 /end CHARACTERISTIC
/begin CHARACTERISTIC FFTMD02 "Freeze Frame Tabelle: Aussetzer Zylinder 2" VAL_BLK 0x814C4A ME7_FWB1 0 dez 0.000000 255.000000 NUMBER 2 /end CHARACTERISTIC
/begin CHARACTERISTIC FFTMD03 "Freeze Frame Tabelle: Aussetzer Zylinder 3" VAL_BLK 0x814C4C ME7_FWB1 0 dez 0.000000 255.000000 NUMBER 2 /end CHARACTERISTIC
/begin CHARACTERISTIC FFTMD04 "Freeze Frame Tabelle: Aussetzer Zylinder 4" VAL_BLK 0x814C4E ME7_FWB1 0 dez 0.000000 255.000000 NUMBER 2 /end CHARACTERISTIC
/begin CHARACTERISTIC FFTMDB "Freeze Frame Tabelle: Momentbegrenzung Sollmoment" VAL_BLK 0x814C50 ME7_FWB1 0 dez 0.000000 255.000000 NUMBER 2 /end CHARACTERISTIC
/begin CHARACTERISTIC FFTMDK "Freeze Frame Tabelle: Aussetzer, Summenfehler - multiple, kundendienstrelevant" VAL_BLK 0x814C52 ME7_FWB1 0 dez 0.000000 255.000000 NUMBER 2 /end CHARACTERISTIC
/begin CHARACTERISTIC FFTMDK01 "Freeze Frame Tabelle: Aussetzer, Zylinder 1, kundendienstrelevant" VAL_BLK 0x814C54 ME7_FWB1 0 dez 0.000000 255.000000 NUMBER 2 /end CHARACTERISTIC
/begin CHARACTERISTIC FFTMDK02 "Freeze Frame Tabelle: Aussetzer, Zylinder 2, kundendienstrelevant" VAL_BLK 0x814C56 ME7_FWB1 0 dez 0.000000 255.000000 NUMBER 2 /end CHARACTERISTIC
/begin CHARACTERISTIC FFTMDK03 "Freeze Frame Tabelle: Aussetzer, Zylinder 3, kundendienstrelevant" VAL_BLK 0x814C58 ME7_FWB1 0 dez 0.000000 255.000000 NUMBER 2 /end CHARACTERISTIC
/begin CHARACTERISTIC FFTMDK04 "Freeze Frame Tabelle: Aussetzer, Zylinder 4, kundendienstrelevant" VAL_BLK 0x814C5A ME7_FWB1 0 dez 0.000000 255.000000 NUMBER 2 /end CHARACTERISTIC
/begin CHARACTERISTIC FFTMILE "Freeze Frame Tabelle: MIL-Endstufe" VAL_BLK 0x814C5C ME7_FWB1 0 dez 0.000000 255.000000 NUMBER 2 /end CHARACTERISTIC
/begin CHARACTERISTIC FFTN "Freeze Frame Tabelle: Drehzahlgeber" VAL_BLK 0x814C5E ME7_FWB1 0 dez 0.000000 255.000000 NUMBER 2 /end CHARACTERISTIC
/begin CHARACTERISTIC FFTNWKW "Freeze Frame Tabelle: Zuordnung Nockenwelle zu Kurbelwelle" VAL_BLK 0x814C60 ME7_FWB1 0 dez 0.000000 255.000000 NUMBER 2 /end CHARACTERISTIC
/begin CHARACTERISTIC FFTNWKW2 "Freeze Frame Tabelle: Zuordnung Nockenwelle 2 zu Kurbelwelle" VAL_BLK 0x814C62 ME7_FWB1 0 dez 0.000000 255.000000 NUMBER 2 /end CHARACTERISTIC
/begin CHARACTERISTIC FFTNWS "Freeze Frame Tabelle: Nockenwellensteuerung" VAL_BLK 0x814C64 ME7_FWB1 0 dez 0.000000 255.000000 NUMBER 2 /end CHARACTERISTIC
/begin CHARACTERISTIC FFTNWS2 "Freeze Frame Tabelle: Nockenwellensteuerung Bank 2" VAL_BLK 0x814C66 ME7_FWB1 0 dez 0.000000 255.000000 NUMBER 2 /end CHARACTERISTIC
/begin CHARACTERISTIC FFTNWSE "Freeze Frame Tabelle: Nockenwellensteuerungsventil Endstufe" VAL_BLK 0x814C68 ME7_FWB1 0 dez 0.000000 255.000000 NUMBER 2 /end CHARACTERISTIC
/begin CHARACTERISTIC FFTNX "Freeze Frame Tabelle: ^NMAX- öberschreitung" VAL_BLK 0x814C6A ME7_FWB1 0 dez 0.000000 255.000000 NUMBER 2 /end CHARACTERISTIC
/begin CHARACTERISTIC FFTPH "Freeze Frame Tabelle: Phasensensor" VAL_BLK 0x814C6C ME7_FWB1 0 dez 0.000000 255.000000 NUMBER 2 /end CHARACTERISTIC
/begin CHARACTERISTIC FFTPWM "" VAL_BLK 0x814C6E ME7_FWB1 0 dez 0.000000 255.000000 NUMBER 2 /end CHARACTERISTIC
/begin CHARACTERISTIC FFTRKAT "Freeze Frame Tabelle: RKAT Gemischadaption" VAL_BLK 0x814C70 ME7_FWB1 0 dez 0.000000 255.000000 NUMBER 2 /end CHARACTERISTIC
/begin CHARACTERISTIC FFTRKAZ "Freeze Frame Tabelle: RKAZ Gemischadaption" VAL_BLK 0x814C72 ME7_FWB1 0 dez 0.000000 255.000000 NUMBER 2 /end CHARACTERISTIC
/begin CHARACTERISTIC FFTSGEEW "Freeze Frame Tabelle: SG defekt (EEPROM WFS- Bereich)" VAL_BLK 0x814C74 ME7_FWB1 0 dez 0.000000 255.000000 NUMBER 2 /end CHARACTERISTIC
/begin CHARACTERISTIC FFTSLPE "Freeze Frame Tabelle: SekundÑrluftpumpe Endstufe" VAL_BLK 0x814C76 ME7_FWB1 0 dez 0.000000 255.000000 NUMBER 2 /end CHARACTERISTIC
/begin CHARACTERISTIC FFTSLS "Freeze Frame Tabelle: SekundÑrluftsystem" VAL_BLK 0x814C78 ME7_FWB1 0 dez 0.000000 255.000000 NUMBER 2 /end CHARACTERISTIC
/begin CHARACTERISTIC FFTSLV "Freeze Frame Tabelle: Dichtheit SekundÑrluftventil" VAL_BLK 0x814C7A ME7_FWB1 0 dez 0.000000 255.000000 NUMBER 2 /end CHARACTERISTIC
/begin CHARACTERISTIC FFTSLVE "Freeze Frame Tabelle: SekundÑrluftventil Endstufe" VAL_BLK 0x814C7C ME7_FWB1 0 dez 0.000000 255.000000 NUMBER 2 /end CHARACTERISTIC
/begin CHARACTERISTIC FFTSLWG "Freeze Frame Tabelle: Waste- Gate- Ansteuerung" VAL_BLK 0x814C7E ME7_FWB1 0 dez 0.000000 255.000000 NUMBER 2 /end CHARACTERISTIC
/begin CHARACTERISTIC FFTSUE "Freeze Frame Tabelle: Saugrohrumschaltung Endstufe" VAL_BLK 0x814C80 ME7_FWB1 0 dez 0.000000 255.000000 NUMBER 2 /end CHARACTERISTIC
/begin CHARACTERISTIC FFTSWE "Freeze Frame Tabelle: Beschleunigungssensor Schlechtwegeerk." VAL_BLK 0x814C82 ME7_FWB1 0 dez 0.000000 255.000000 NUMBER 2 /end CHARACTERISTIC
/begin CHARACTERISTIC FFTTA "Freeze Frame Tabelle: Ansauglufttemperatur TANS (/Ladeluft-)" VAL_BLK 0x814C84 ME7_FWB1 0 dez 0.000000 255.000000 NUMBER 2 /end CHARACTERISTIC
/begin CHARACTERISTIC FFTTANKL "Freeze Frame Tabelle : tankl (Tank leer)" VAL_BLK 0x814C86 ME7_FWB1 0 dez 0.000000 255.000000 NUMBER 2 /end CHARACTERISTIC
/begin CHARACTERISTIC FFTTES "Freeze Frame Tabelle: TankentlÅftungsventil" VAL_BLK 0x814C88 ME7_FWB1 0 dez 0.000000 255.000000 NUMBER 2 /end CHARACTERISTIC
/begin CHARACTERISTIC FFTTESF "Freeze Frame Tabelle: Tankdiagnose, Feinleck" VAL_BLK 0x814C8A ME7_FWB1 0 dez 0.000000 255.000000 NUMBER 2 /end CHARACTERISTIC
/begin CHARACTERISTIC FFTTESG "Freeze Frame Tabelle: Tankdiagnose, Grobleck" VAL_BLK 0x814C8C ME7_FWB1 0 dez 0.000000 255.000000 NUMBER 2 /end CHARACTERISTIC
/begin CHARACTERISTIC FFTTEVE "Freeze Frame Tabelle: TankentlÅftungsventil Endstufe" VAL_BLK 0x814C8E ME7_FWB1 0 dez 0.000000 255.000000 NUMBER 2 /end CHARACTERISTIC
/begin CHARACTERISTIC FFTTEVE2 "Freeze Frame Tabelle: TankentlÅftungsventil" VAL_BLK 0x814C90 ME7_FWB1 0 dez 0.000000 255.000000 NUMBER 2 /end CHARACTERISTIC
/begin CHARACTERISTIC FFTTM "Freeze Frame Tabelle: Motortemperatur TMOT" VAL_BLK 0x814C92 ME7_FWB1 0 dez 0.000000 255.000000 NUMBER 2 /end CHARACTERISTIC
/begin CHARACTERISTIC FFTTOL "Freeze Frame Tabelle: (Motor-) Oeltemperatur TOL" VAL_BLK 0x814C94 ME7_FWB1 0 dez 0.000000 255.000000 NUMBER 2 /end CHARACTERISTIC
/begin CHARACTERISTIC FFTTUM "Freeze Frame Tabelle: Umgebungstemperatur TUM" VAL_BLK 0x814C96 ME7_FWB1 0 dez 0.000000 255.000000 NUMBER 2 /end CHARACTERISTIC
/begin CHARACTERISTIC FFTTUN "Freeze Frame Tabelle: Tuningschutz" VAL_BLK 0x814C98 ME7_FWB1 0 dez 0.000000 255.000000 NUMBER 2 /end CHARACTERISTIC
/begin CHARACTERISTIC FFTUB "Freeze Frame Tabelle: Batteriespannung UB (Bordnetz)" VAL_BLK 0x814C9A ME7_FWB1 0 dez 0.000000 255.000000 NUMBER 2 /end CHARACTERISTIC
/begin CHARACTERISTIC FFTUFMV "Freeze Frame Tabelle: FunktionsÅberwachung: Momentenvergleich" VAL_BLK 0x814C9C ME7_FWB1 0 dez 0.000000 255.000000 NUMBER 2 /end CHARACTERISTIC
/begin CHARACTERISTIC FFTUFSKA "Freeze Frame Tabelle: FunktionsÅberwachung: Sicherheits-Kraftstoff-Abschaltung" VAL_BLK 0x814C9E ME7_FWB1 0 dez 0.000000 255.000000 NUMBER 2 /end CHARACTERISTIC
/begin CHARACTERISTIC FFTURRAM "Freeze Frame Tabelle: RechnerÅberwachung: RAM" VAL_BLK 0x814CA0 ME7_FWB1 0 dez 0.000000 255.000000 NUMBER 2 /end CHARACTERISTIC
/begin CHARACTERISTIC FFTURROM "Freeze Frame Tabelle: RechnerÅberwachung: ROM" VAL_BLK 0x814CA2 ME7_FWB1 0 dez 0.000000 255.000000 NUMBER 2 /end CHARACTERISTIC
/begin CHARACTERISTIC FFTURRST "Freeze Frame Tabelle: RechnerÅberwachung: Reset" VAL_BLK 0x814CA4 ME7_FWB1 0 dez 0.000000 255.000000 NUMBER 2 /end CHARACTERISTIC
/begin CHARACTERISTIC FFTUVSE "Freeze Frame Tabelle:Endstufe Umluftventil Turbo" VAL_BLK 0x814CA6 ME7_FWB1 0 dez 0.000000 255.000000 NUMBER 2 /end CHARACTERISTIC
/begin CHARACTERISTIC FFTVFZ "Freeze Frame Tabelle: Geschwindigkeitssignal" VAL_BLK 0x814CA8 ME7_FWB1 0 dez 0.000000 255.000000 NUMBER 2 /end CHARACTERISTIC
/begin CHARACTERISTIC FFTWFS "Freeze Frame Tabelle: Wegfahrsperre" VAL_BLK 0x814CAA ME7_FWB1 0 dez 0.000000 255.000000 NUMBER 2 /end CHARACTERISTIC
/begin CHARACTERISTIC FFTWFSRC "" VAL_BLK 0x814CAC ME7_FWB1 0 dez 0.000000 255.000000 NUMBER 2 /end CHARACTERISTIC
/begin CHARACTERISTIC FFTZET1 "" VAL_BLK 0x814CAE ME7_FWB1 0 dez 0.000000 255.000000 NUMBER 2 /end CHARACTERISTIC
/begin CHARACTERISTIC FFTZET2 "" VAL_BLK 0x814CB0 ME7_FWB1 0 dez 0.000000 255.000000 NUMBER 2 /end CHARACTERISTIC
/begin CHARACTERISTIC FFTZET3 "" VAL_BLK 0x814CB2 ME7_FWB1 0 dez 0.000000 255.000000 NUMBER 2 /end CHARACTERISTIC
/begin CHARACTERISTIC FFTZET4 "" VAL_BLK 0x814CB4 ME7_FWB1 0 dez 0.000000 255.000000 NUMBER 2 /end CHARACTERISTIC
/begin CHARACTERISTIC FFTZET5 "" VAL_BLK 0x814CB6 ME7_FWB1 0 dez 0.000000 255.000000 NUMBER 2 /end CHARACTERISTIC
/begin CHARACTERISTIC FFTZET6 "" VAL_BLK 0x814CB8 ME7_FWB1 0 dez 0.000000 255.000000 NUMBER 2 /end CHARACTERISTIC
/begin CHARACTERISTIC FFTZET7 "" VAL_BLK 0x814CBA ME7_FWB1 0 dez 0.000000 255.000000 NUMBER 2 /end CHARACTERISTIC
/begin CHARACTERISTIC FFTZET8 "" VAL_BLK 0x814CBC ME7_FWB1 0 dez 0.000000 255.000000 NUMBER 2 /end CHARACTERISTIC
/begin CHARACTERISTIC FFTZZZ "Dummy: Tabellenende" VAL_BLK 0x814CBE ME7_FWB1 0 dez 0.000000 255.000000 NUMBER 2 /end CHARACTERISTIC
/begin CHARACTERISTIC FFWEKA "Gewichtungsfaktor zur Einrechnung Wiedereinsetzfaktor fwe in FettflÑche" VALUE 0x815E8E ME7_FW1 0 fak_ub_b1 0.000000 0.996094 /end CHARACTERISTIC
/begin CHARACTERISTIC FHDLLR "Hîhenschwelle fÅr DurchfÅhrung Diagnose Leerlaufsteller" VALUE 0x819909 ME7_FW1 0 fak_ub_b4 0.000000 3.984380 EXTENDED_LIMITS 0.000000 3.984375 /end CHARACTERISTIC
/begin RECORD_LAYOUT ME7_SST97 NO_AXIS_PTS_X 1 UBYTE AXIS_PTS_X 2 UBYTE INDEX_INCR DIRECT /end RECORD_LAYOUT
/begin CHARACTERISTIC FHODSL "minimaler Hîhenfaktor fÅr DSLS" VALUE 0x81A118 ME7_FW3 0 fak_uw_b4 0.000000 3.999940 EXTENDED_LIMITS 0.000000 3.999939 /end CHARACTERISTIC
/begin CHARACTERISTIC FHODTEA "untere Hîhenschwelle fÅr DTEV aktiv" VALUE 0x81D994 ME7_FW3 0 fak_uw_b4 0.200012 0.799988 EXTENDED_LIMITS 0.000000 3.999939 /end CHARACTERISTIC
/begin CHARACTERISTIC FHOE "Ersatzwert fÅr Hîhe" VALUE 0x818608 ME7_FW1 0 fak_ub_b4 0.000000 3.984380 EXTENDED_LIMITS 0.000000 3.984375 /end CHARACTERISTIC
/begin CHARACTERISTIC FHOKH "minimaler Hîhenfaktor fÅr Katheizen" VALUE 0x81BB22 ME7_FW3 0 fak_uw_b4 0.000000 3.999940 EXTENDED_LIMITS 0.000000 3.999939 /end CHARACTERISTIC
/begin CHARACTERISTIC FHOKOB "Hîhenschwelle fÅr Kompressorabschaltung bei Beschleunigung" VALUE 0x816477 ME7_FW1 0 fak_ub_b4 0.000000 3.984380 EXTENDED_LIMITS 0.000000 3.984375 /end CHARACTERISTIC
/begin CHARACTERISTIC FHSTT "Faktor Hei·start" CURVE 0x815222 ME7_KL97 0 fak_ub_b64 0.000000 63.750000
 /begin AXIS_DESCR STD_AXIS tans temp_ub_q0p75_o48 6 -48.000000 143.250000 DEPOSIT ABSOLUTE /end AXIS_DESCR
/end CHARACTERISTIC
/begin CHARACTERISTIC FIAMALU "Anhebungsfaktor fÅr Filter Mehrfachaussetzererkennung" VALUE 0x814813 ME7_FW1 0 fak_ub_b4 0.000000 3.984380 EXTENDED_LIMITS 0.000000 3.984375 /end CHARACTERISTIC
/begin CHARACTERISTIC FIMALU "Filterfaktor Mehrfachaussetzererkennung" VALUE 0x814814 ME7_FW1 0 fak_ub_b1 0.000000 0.996094 /end CHARACTERISTIC
/begin CHARACTERISTIC FIMHU "Faktor Impuls hart" CURVE 0x8153C7 ME7_FKL1 0 fak_ub_b2 0.000000 1.992190
 /begin AXIS_DESCR FIX_AXIS anzwefim dez___SL 16 0.000000 15.000000 FIX_AXIS_PAR 0 0 16 /end AXIS_DESCR
 EXTENDED_LIMITS 0.000000 1.992188 /end CHARACTERISTIC
/begin CHARACTERISTIC FIMWU "Faktor Impuls weich" CURVE 0x8153D7 ME7_FKL1 0 fak_ub_b2 0.000000 1.992190
 /begin AXIS_DESCR FIX_AXIS anzwefim dez___SL 16 0.000000 15.000000 FIX_AXIS_PAR 0 0 16 /end AXIS_DESCR
 EXTENDED_LIMITS 0.000000 1.992188 /end CHARACTERISTIC
/begin CHARACTERISTIC FKADPMN "miminaler Kraftstoffanteil Åber TEV fÅr passive i.O. PrÅfung." VALUE 0x819BD4 ME7_FW2 0 fak_sb_b1 0.101563 0.796875 EXTENDED_LIMITS -1.000000 0.992188 /end CHARACTERISTIC
/begin CHARACTERISTIC FKATEB "Kennlinie Kraftstoffanteil TankentlÅftung abh. von te / TEMIN" CURVE 0x81D8F6 ME7_KL97 0 fak_ub_b1 0.000000 0.996094
 /begin AXIS_DESCR STD_AXIS qtetemin fak_ub_b4 5 0.000000 3.984380 DEPOSIT ABSOLUTE /end AXIS_DESCR
/end CHARACTERISTIC
/begin CHARACTERISTIC FKAXAVKAT "Gewichtungsfaktor Sauerstoffspeicher in AbhÑngigkeit von avkatf" CURVE 0x819CBA ME7_KL97 0 fak_ub_b1 0.000000 0.996094
 /begin AXIS_DESCR STD_AXIS avkatf fak_ub_b1 5 0.000000 0.996094 DEPOSIT ABSOLUTE /end AXIS_DESCR
/end CHARACTERISTIC
/begin CHARACTERISTIC FKELDY "Korrekturfaktor fÅr Klopferkennungsschwelle bei Lastdynamik" VALUE 0x815400 ME7_FW1 0 fak_ub_b16 0.000000 2.000000 EXTENDED_LIMITS 0.000000 15.937500 /end CHARACTERISTIC
/begin CHARACTERISTIC FKELDYA "Korrekturfaktor fÅr Klopferkennungsschwelle bei Lastdynamikadaption" VALUE 0x815439 ME7_FW1 0 fak_ub_b16 0.625000 1.250000 EXTENDED_LIMITS 0.000000 15.937500 /end CHARACTERISTIC
/begin CHARACTERISTIC FKENDY "Korrekturfaktor fÅr Klopferkennungsschwelle bei Drehzahldynamik" VALUE 0x815401 ME7_FW1 0 fak_ub_b16 0.000000 2.000000 EXTENDED_LIMITS 0.000000 15.937500 /end CHARACTERISTIC
/begin CHARACTERISTIC FKHABMN "Schwelle Abregelfaktor Katheizen" VALUE 0x81901D ME7_FW1 0 fak_ub_b1 0.000000 0.996094 /end CHARACTERISTIC
/begin CHARACTERISTIC FKHLA "Wichtungsfaktor Lambda-Soll fÅr Katheizen" CURVE 0x81BB24 ZF_KL111 0 fak_uw_b1 0.000000 0.999985
 /begin AXIS_DESCR STD_AXIS imlpr_w fak_uw_b1 8 0.000000 0.999985 DEPOSIT ABSOLUTE /end AXIS_DESCR
/end CHARACTERISTIC
/begin CHARACTERISTIC FKHMD "Wichtungsfaktor Drehmomentreserve fÅr Katheizen" CURVE 0x81BB46 ZF_KL111 0 fak_uw_b1 0.000000 0.999985
 /begin AXIS_DESCR STD_AXIS imlpr_w fak_uw_b1 8 0.000000 0.999985 DEPOSIT ABSOLUTE /end AXIS_DESCR
/end CHARACTERISTIC
/begin CHARACTERISTIC FKKVS "Korrekturfaktor Kraftstoffversorgungssystem" MAP 0x81B626 ME7_KF339 0 fak_uw_b2 0.000000 1.999970
 /begin AXIS_DESCR STD_AXIS nmot nmot_ub_q40 16 0.000000 10200.000000 DEPOSIT ABSOLUTE /end AXIS_DESCR
 /begin AXIS_DESCR STD_AXIS tevfa_w_kge tinjection_sy 16 0.000000 209.712000 DEPOSIT ABSOLUTE /end AXIS_DESCR
 EXTENDED_LIMITS 0.000000 1.999969 /end CHARACTERISTIC
/begin RECORD_LAYOUT ME7_KF339 NO_AXIS_PTS_X 1 UBYTE NO_AXIS_PTS_Y 2 UBYTE AXIS_PTS_X 3 UBYTE INDEX_INCR DIRECT AXIS_PTS_Y 4 UWORD INDEX_INCR DIRECT FNC_VALUES 5 UWORD COLUMN_DIR DIRECT /end RECORD_LAYOUT
/begin CHARACTERISTIC FKMRFGRN "Korrekturfaktor fÅr relatives Moment vom Fahrgeschwindigkeitsregler" CURVE 0x8185BC ME7_KL97 0 fak_ub_b2 0.000000 1.992190
 /begin AXIS_DESCR STD_AXIS nmot nmot_ub_q40 8 0.000000 10200.000000 DEPOSIT ABSOLUTE /end AXIS_DESCR
 EXTENDED_LIMITS 0.000000 1.992188 /end CHARACTERISTIC
/begin CHARACTERISTIC FKMSDKMN "min.Korrekturfaktor schneller Massenstromabgleich" VALUE 0x818604 ME7_FW1 0 fak_ub_b4 0.000000 3.984380 EXTENDED_LIMITS 0.000000 3.984375 /end CHARACTERISTIC
/begin CHARACTERISTIC FKMSDKMX "max.Korrekturfaktor schneller Massenstromabgleich" VALUE 0x818605 ME7_FW1 0 fak_ub_b4 0.000000 3.984380 EXTENDED_LIMITS 0.000000 3.984375 /end CHARACTERISTIC
/begin CHARACTERISTIC FKPVDKMN "Minimaler Korrekturfaktor langsamer Massenstomabgleich" VALUE 0x818606 ME7_FW1 0 fak_ub_b4 0.000000 3.984380 EXTENDED_LIMITS 0.000000 3.984375 /end CHARACTERISTIC
/begin CHARACTERISTIC FKPVDKMX "Maximaler Korrekturfaktor langsamer Massenstomabgleich" VALUE 0x818607 ME7_FW1 0 fak_ub_b4 0.000000 3.984380 EXTENDED_LIMITS 0.000000 3.984375 /end CHARACTERISTIC
/begin CHARACTERISTIC FKSTT "Faktor Kaltstart" CURVE 0x81522F ME7_KL97 0 fak_ub_b64 0.000000 63.750000
 /begin AXIS_DESCR STD_AXIS tmst temp_ub_q0p75_o48 12 -48.000000 143.250000 DEPOSIT ABSOLUTE /end AXIS_DESCR
/end CHARACTERISTIC
/begin CHARACTERISTIC FKVA "Konstanter Umrechnungsfaktor fÅr Verbrauchsanzeige" VALUE 0x819FC2 ME7_FW1 0 fak_ub_b16 0.000000 15.937500 /end CHARACTERISTIC
/begin CHARACTERISTIC FLAMKRN "Wichtungsfaktor fÅr Anfettung bei ZÅndwinkelspÑtverstellung" CURVE 0x818C7F ME7_KL97 0 fak_ub_b2 0.000000 1.992190
 /begin AXIS_DESCR STD_AXIS nmot nmot_ub_q40 6 0.000000 10200.000000 DEPOSIT ABSOLUTE /end AXIS_DESCR
 EXTENDED_LIMITS 0.000000 1.992188 /end CHARACTERISTIC
/begin CHARACTERISTIC FLFO "Filterfaktor Lernfilter der fuel-on/-off Adaption" VALUE 0x810188 ME7_FW4 0 fak_uw_b2___SW -1.000000 0.999969 /end CHARACTERISTIC
/begin CHARACTERISTIC FLMLKAMA "Faktor zur Bewertung Schwellwert integr. Fettfl. f. Abbruch Kat-Ausr. Pre/Main" VALUE 0x815E8F ME7_FW1 0 fak_ub_b8 0.000000 7.968750 /end CHARACTERISTIC
/begin CHARACTERISTIC FLMLKAPR "Faktor zur Bewertung des gemessenen gespeicherten Sauerstoffs" VALUE 0x815E90 ME7_FW1 0 fak_ub_b8 0.000000 7.968750 /end CHARACTERISTIC
/begin CHARACTERISTIC FLRAG "VerstÑrkung Lastregler bei AT" CURVE 0x81990D ME7_FKL1 0 fak_ub_b16 0.000000 15.937500
 /begin AXIS_DESCR FIX_AXIS gangi dez___SL 6 1.000000 6.000000 FIX_AXIS_PAR 1 0 6 /end AXIS_DESCR
/end CHARACTERISTIC
/begin CHARACTERISTIC FLRAWG "VerstÑrkung Lastregler bei AT, WK geschlossen" CURVE 0x819913 ME7_FKL1 0 fak_ub_b16 0.000000 15.937500
 /begin AXIS_DESCR FIX_AXIS gangi dez___SL 6 1.000000 6.000000 FIX_AXIS_PAR 1 0 6 /end AXIS_DESCR
/end CHARACTERISTIC
/begin CHARACTERISTIC FLRFKATE "Gewichtung des Adaptionswertes fkatei aus %TEB zur Anpassung der Reglerparameter" CURVE 0x813760 ME7_KL103 0 fak_ub_b2 0.000000 1.992190
 /begin AXIS_DESCR STD_AXIS fkatei fak_sb_b1 5 -1.000000 0.992188 DEPOSIT ABSOLUTE /end AXIS_DESCR
 EXTENDED_LIMITS 0.000000 1.992188 /end CHARACTERISTIC
/begin CHARACTERISTIC FLRHG_0_A "VerstÑrkung Lastregler" CURVE 0x819919 ME7_FKL1 0 fak_ub_b16 0.000000 15.937500
 /begin AXIS_DESCR FIX_AXIS gangi dez___SL 6 1.000000 6.000000 FIX_AXIS_PAR 1 0 6 /end AXIS_DESCR
/end CHARACTERISTIC
/begin CHARACTERISTIC FLRHG_1_A "VerstÑrkung Lastregler" CURVE 0x81991F ME7_FKL1 0 fak_ub_b16 0.000000 15.937500
 /begin AXIS_DESCR FIX_AXIS gangi dez___SL 6 1.000000 6.000000 FIX_AXIS_PAR 1 0 6 /end AXIS_DESCR
/end CHARACTERISTIC
/begin CHARACTERISTIC FLRHG_2_A "VerstÑrkung Lastregler" CURVE 0x819925 ME7_FKL1 0 fak_ub_b16 0.000000 15.937500
 /begin AXIS_DESCR FIX_AXIS gangi dez___SL 6 1.000000 6.000000 FIX_AXIS_PAR 1 0 6 /end AXIS_DESCR
/end CHARACTERISTIC
/begin CHARACTERISTIC FLRHG_3_A "VerstÑrkung Lastregler" CURVE 0x81992B ME7_FKL1 0 fak_ub_b16 0.000000 15.937500
 /begin AXIS_DESCR FIX_AXIS gangi dez___SL 6 1.000000 6.000000 FIX_AXIS_PAR 1 0 6 /end AXIS_DESCR
/end CHARACTERISTIC
/begin CHARACTERISTIC FLRM "Faktor fÅr I-Dynamik des Lambdareglers in AbhÑngigkeit von tmot" CURVE 0x815EB4 ME7_KL97 0 fak_ub_b4 0.000000 3.984380
 /begin AXIS_DESCR STD_AXIS tmot temp_ub_q0p75_o48 5 -48.000000 143.250000 DEPOSIT ABSOLUTE /end AXIS_DESCR
 EXTENDED_LIMITS 0.000000 3.984375 /end CHARACTERISTIC
/begin CHARACTERISTIC FLR_AOG "oberer Grenzwert Anpassung Lambdaregelung-TV-Verschiebung" VALUE 0x81544C ME7_FW2 0 t10msxs_sb_q0p01 -1.280000 1.270000 /end CHARACTERISTIC
/begin CHARACTERISTIC FLR_AUG "unterer Grenzwert Anpassung Lambdaregelung-TV-Verschiebung" VALUE 0x81544D ME7_FW2 0 t10msxs_sb_q0p01 -1.280000 1.270000 /end CHARACTERISTIC
/begin CHARACTERISTIC FLUTN "Filterfaktor Laufunruhe-Filter" CURVE 0x81456B ME7_GKL1 0 fak_ub_b1 0.000000 0.996094
 /begin AXIS_DESCR COM_AXIS nmot nmot_ub_q40 0 0.000000 10200.000000 AXIS_PTS_REF SNM08DMUB /end AXIS_DESCR
/end CHARACTERISTIC
/begin CHARACTERISTIC FLUV1 "Schalter der Modifikation 1 der Laufunruhe-Berechnung" VALUE 0x814815 ME7_FW1 0 dez 0.000000 255.000000 /end CHARACTERISTIC
/begin CHARACTERISTIC FLUV2 "Schalter der Modifikation 2 der Laufunruhe-Berechnung" VALUE 0x814816 ME7_FW1 0 dez 0.000000 255.000000 /end CHARACTERISTIC
/begin CHARACTERISTIC FMDKHFH "Hîhenkorrektur Drehmomentenreserve fÅr Katheizen" CURVE 0x81BB76 ZF_KL111 0 fak_uw_b2 0.000000 1.999970
 /begin AXIS_DESCR STD_AXIS fho_w fak_uw_b4 4 0.000000 3.999940 DEPOSIT ABSOLUTE /end AXIS_DESCR
 EXTENDED_LIMITS 0.000000 1.999969 /end CHARACTERISTIC
/begin CHARACTERISTIC FMDKHTMST "tmst-Korrektur Drehmomentenresrve fÅr Katheizen" CURVE 0x819090 ME7_KL97 0 fak_ub_b2 0.000000 1.992190
 /begin AXIS_DESCR STD_AXIS tmst temp_ub_q0p75_o48 8 -48.000000 143.250000 DEPOSIT ABSOLUTE /end AXIS_DESCR
 EXTENDED_LIMITS 0.000000 1.992188 /end CHARACTERISTIC
/begin CHARACTERISTIC FMDWAT "Faktor zur Berechnung des Wandlermoments abh. von der ôltemperatur des Wandlers" CURVE 0x819843 ME7_GKL1 0 fak_ub_q4p7Em7 0.000000 0.000120
 /begin AXIS_DESCR COM_AXIS tmot temp_ub_q0p75_o48 0 -48.000000 143.250000 AXIS_PTS_REF STM08MDUB /end AXIS_DESCR
/end CHARACTERISTIC
/begin CHARACTERISTIC FMFKR "Mittenfrequenz fÅr Bandpa·filter Klopfregelung" VALUE 0x819164 ME7_FW1 0 fmfkr_dez 0.000000 16.000000 EXTENDED_LIMITS 0.000000 255.000000 /end CHARACTERISTIC
/begin CHARACTERISTIC FMIUGDS "Faktor maximales Moment fuer ungedrosselten Betrieb" VALUE 0x815114 ME7_FW1 0 fak_ub_b1 0.000000 0.996094 /end CHARACTERISTIC
/begin CHARACTERISTIC FMIVL "Faktor Korrektur maximales Moment bei VL" VALUE 0x81995B ME7_FW1 0 fak_ub_b2 0.000000 1.992190 EXTENDED_LIMITS 0.000000 1.992188 /end CHARACTERISTIC
/begin CHARACTERISTIC FMLKAMA "Faktor zur Bewertung Schwellwert integr. Luftm. f. Abbruch Kat-Ausr. Pre/Main" VALUE 0x815E91 ME7_FW1 0 fak_ub_b8 0.000000 7.968750 /end CHARACTERISTIC
/begin CHARACTERISTIC FMOTC "Motor-Codierung (CAN)" VALUE 0x8144DE ME7_FW1 0 DEZ 0.000000 255.000000 /end CHARACTERISTIC
/begin CHARACTERISTIC FMSL "Faktor Korrektur SekundÑrluftmasse" VALUE 0x8182DB ME7_FW1 0 fak_ub_b2 0.000000 1.992190 EXTENDED_LIMITS 0.000000 1.992188 /end CHARACTERISTIC
/begin CHARACTERISTIC FMSL2 "Faktor Korrektur SekundÑrluftmasse, Bank 2" VALUE 0x8182DC ME7_FW1 0 fak_ub_b2 0.000000 1.992190 EXTENDED_LIMITS 0.000000 1.992188 /end CHARACTERISTIC
/begin CHARACTERISTIC FMSLAMN "minimaler Adaptionsfaktor SekundÑrluftmasse" VALUE 0x818371 ME7_FW1 0 fak_ub_b2 0.000000 1.992190 EXTENDED_LIMITS 0.000000 1.992188 /end CHARACTERISTIC
/begin CHARACTERISTIC FMSLAMX "maximaler Adaptionsfaktor SekundÑrluftmasse" VALUE 0x818372 ME7_FW1 0 fak_ub_b2 0.000000 1.992190 EXTENDED_LIMITS 0.000000 1.992188 /end CHARACTERISTIC
/begin CHARACTERISTIC FMSLOFF "Schwelle AusrÑumen der SekundÑrluft beendet" VALUE 0x8182DD ME7_FW1 0 fak_ub_b1 0.000000 0.996094 /end CHARACTERISTIC
/begin CHARACTERISTIC FMSRHOL "Dichtekorrektur der SekundÑrluftmasse" CURVE 0x81A0FE ZF_KL111 0 fak_uw_b2 0.000000 1.999970
 /begin AXIS_DESCR STD_AXIS frhol_w fak_uw_b2 4 0.000000 1.999970 DEPOSIT ABSOLUTE /end AXIS_DESCR
 EXTENDED_LIMITS 0.000000 1.999969 /end CHARACTERISTIC
/begin CHARACTERISTIC FMSTMOT "tmot- Korrektur der SekundÑrluftmasse" CURVE 0x8182DE ME7_KL97 0 fak_ub_b2 0.000000 1.992190
 /begin AXIS_DESCR STD_AXIS tmot temp_ub_q0p75_o48 8 -48.000000 143.250000 DEPOSIT ABSOLUTE /end AXIS_DESCR
 EXTENDED_LIMITS 0.000000 1.992188 /end CHARACTERISTIC
/begin CHARACTERISTIC FNRAD "Faktor zwischen Raddrehzahl und Geschwindigkeit f(Radumfang)" VALUE 0x815584 ME7_FW1 0 fak_ub_b16 0.000000 15.937500 /end CHARACTERISTIC
/begin CHARACTERISTIC FNSA "Nachstartanhebung" CURVE 0x8189C8 ME7_GKL1 0 fak_ub_b2 0.000000 1.992190
 /begin AXIS_DESCR COM_AXIS tans temp_ub_q0p75_o48 0 -48.000000 143.250000 AXIS_PTS_REF STA06ESUB /end AXIS_DESCR
 EXTENDED_LIMITS 0.000000 1.992188 /end CHARACTERISTIC
/begin CHARACTERISTIC FNSHO "Wichtung Nachstartanhebung" CURVE 0x8189CE ME7_KL97 0 fak_ub_b2 0.000000 1.992190
 /begin AXIS_DESCR STD_AXIS fho fak_ub_b4 4 0.000000 3.984380 DEPOSIT ABSOLUTE /end AXIS_DESCR
 EXTENDED_LIMITS 0.000000 1.992188 /end CHARACTERISTIC
/begin CHARACTERISTIC FNSKHLL "Faktor fÅr Drehzahlanhebung direkt nach Start" CURVE 0x81901E ME7_KL97 0 fak_ub_b2 0.000000 1.992190
 /begin AXIS_DESCR STD_AXIS imlpr fak_ub_b1 5 0.000000 0.996094 DEPOSIT ABSOLUTE /end AXIS_DESCR
 EXTENDED_LIMITS 0.000000 1.992188 /end CHARACTERISTIC
/begin CHARACTERISTIC FNSNF "Faktor fÅr SolldrehzahlnachfÅhrung" VALUE 0x8197B6 ME7_FW1 0 fak_ub_b1 0.000000 0.996094 /end CHARACTERISTIC
/begin CHARACTERISTIC FNSSM "Nachstartanhebung" CURVE 0x8189D7 ME7_GKL1 0 fak_ub_b2 0.000000 1.992190
 /begin AXIS_DESCR COM_AXIS tmst temp_ub_q0p75_o48 0 -48.000000 143.250000 AXIS_PTS_REF STS14ESUB /end AXIS_DESCR
 EXTENDED_LIMITS 0.000000 1.992188 /end CHARACTERISTIC
/begin CHARACTERISTIC FNSSTKM "Faktor zur Wichtung der Solldrehzahl im Start bei Kat-Heizen" CURVE 0x8197B7 ME7_KL97 0 fak_ub_b2 0.000000 1.992190
 /begin AXIS_DESCR STD_AXIS tmot temp_ub_q0p75_o48 6 -48.000000 143.250000 DEPOSIT ABSOLUTE /end AXIS_DESCR
 EXTENDED_LIMITS 0.000000 1.992188 /end CHARACTERISTIC
/begin CHARACTERISTIC FNSSTM "Faktor zur Wichtung der Solldrehzahl im Start" CURVE 0x8197C4 ME7_KL97 0 fak_ub_b2 0.000000 1.992190
 /begin AXIS_DESCR STD_AXIS tmot temp_ub_q0p75_o48 6 -48.000000 143.250000 DEPOSIT ABSOLUTE /end AXIS_DESCR
 EXTENDED_LIMITS 0.000000 1.992188 /end CHARACTERISTIC
/begin CHARACTERISTIC FNSTABNV "Faktor zur Drehzahlstabilisierung durch Drehmoment" CURVE 0x812892 ZF_KL111 0 fak_uw_b8 0.000000 7.999880
 /begin AXIS_DESCR STD_AXIS nver_w fak_uw_b8 6 0.000000 7.999880 DEPOSIT ABSOLUTE /end AXIS_DESCR
 EXTENDED_LIMITS 0.000000 7.999878 /end CHARACTERISTIC
/begin CHARACTERISTIC FNS_AOG "oberer Grenzwert Anpassung Faktor Nachstart" VALUE 0x81544E ME7_FW1 0 fak_ub_b2 0.000000 1.992190 EXTENDED_LIMITS 0.000000 1.992188 /end CHARACTERISTIC
/begin CHARACTERISTIC FNS_AUG "unterer Grenzwert Anpassung Faktor Nachstart" VALUE 0x81544F ME7_FW1 0 fak_ub_b2 0.000000 1.992190 EXTENDED_LIMITS 0.000000 1.992188 /end CHARACTERISTIC
/begin CHARACTERISTIC FPLMRM "Wichtungsfaktor fÅr P-Anteil Luftmassenregler" CURVE 0x815105 ME7_KL97 0 fak_ub_b1 0.000000 0.996094
 /begin AXIS_DESCR STD_AXIS tmot temp_ub_q0p75_o48 6 -48.000000 143.250000 DEPOSIT ABSOLUTE /end AXIS_DESCR
/end CHARACTERISTIC
/begin CHARACTERISTIC FPRAT "Ansauglufttemperaturschwelle fÅr DV-E-FederprÅfung" VALUE 0x814EB7 ME7_FW1 0 temp_ub_q0p75_o48 -48.000000 143.250000 /end CHARACTERISTIC
/begin CHARACTERISTIC FPRMT "Motortemperaturschwelle fÅr DV-E-FederprÅfung" VALUE 0x814EB8 ME7_FW1 0 temp_ub_q0p75_o48 -48.000000 143.250000 /end CHARACTERISTIC
/begin CHARACTERISTIC FPRNMAX "Motordrehzahlschwelle fÅr DV-E-FederprÅfung" VALUE 0x814EB9 ME7_FW1 0 nmot_ub_q10 0.000000 2550.000000 /end CHARACTERISTIC
/begin CHARACTERISTIC FPRTIM1_T "DV-E-FederprÅfung, Wartezeit in PrÅfschritt 1" VALUE 0x814EBA ME7_FW1 0 t10msxs_ub_b2p55 0.010000 2.550000 EXTENDED_LIMITS 0.000000 2.550000 /end CHARACTERISTIC
/begin CHARACTERISTIC FPRTIM2_T "DV-E-FederprÅfung, Wartezeit in PrÅfschritt 2" VALUE 0x814EBB ME7_FW1 0 t10msxs_ub_b2p55 0.010000 2.550000 EXTENDED_LIMITS 0.000000 2.550000 /end CHARACTERISTIC
/begin CHARACTERISTIC FPRTIM3_T "DV-E-FederprÅfung: Wartezeit in PrÅfschritt 5" VALUE 0x814EBC ME7_FW1 0 t10msxs_ub_b2p55 0.010000 2.550000 EXTENDED_LIMITS 0.000000 2.550000 /end CHARACTERISTIC
/begin CHARACTERISTIC FPRTIM4_T "DV-E-FederprÅfung: Wartezeit in PrÅfschritt 6" VALUE 0x814EBD ME7_FW1 0 t10msxs_ub_b2p55 0.010000 2.550000 EXTENDED_LIMITS 0.000000 2.550000 /end CHARACTERISTIC
/begin CHARACTERISTIC FPUPT "Periodendauer fÅr Fast Pulse Leckdiagnosepumpe" CURVE 0x815E64 ME7_KL97 0 t10msxs_ub_b2p55 0.000000 2.550000
 /begin AXIS_DESCR STD_AXIS tfpg t1sxs_ub_b255 6 0.000000 255.000000 DEPOSIT ABSOLUTE /end AXIS_DESCR
/end CHARACTERISTIC
/begin CHARACTERISTIC FPVMXN2 "Faktor maximales DruckverhÑltnis mit Nebenlastsignal" CURVE 0x81B2C2 ZF_KL111 0 fak_uw_b4 0.000000 3.999940
 /begin AXIS_DESCR STD_AXIS nmot_w nmot_uw_q0p25 6 0.000000 16383.800000 DEPOSIT ABSOLUTE /end AXIS_DESCR
 EXTENDED_LIMITS 0.000000 3.999939 /end CHARACTERISTIC
/begin CHARACTERISTIC FPVMXP "Faktor maximales DruckverhÑltnis fuer Lastpraediktion" VALUE 0x811F34 ME7_FW3 0 fak_uw_b2 0.000000 1.999970 EXTENDED_LIMITS 0.000000 1.999969 /end CHARACTERISTIC
/begin CHARACTERISTIC FPWDKAPP "Drosselklappenkennlinie abh. von Fahrpedal nur f. Applik." CURVE 0x811A48 ZF_KL111 0 rel_uw_b100 0.000000 99.998500
 /begin AXIS_DESCR STD_AXIS wped_w relPED_uw_b100 16 0.000000 100.000000 DEPOSIT ABSOLUTE /end AXIS_DESCR
 EXTENDED_LIMITS 0.000000 99.998474 /end CHARACTERISTIC
/begin CHARACTERISTIC FQTEDL "Kennlinie Faktor fÅr exponentielle Absteuerung SpÅlrate" CURVE 0x815E18 ME7_KL97 0 fak_ub_b2 0.000000 1.992190
 /begin AXIS_DESCR STD_AXIS dmlftef fak_ub_b0p5 5 0.000000 0.498047 DEPOSIT ABSOLUTE /end AXIS_DESCR
 EXTENDED_LIMITS 0.000000 1.992188 /end CHARACTERISTIC
/begin CHARACTERISTIC FQTEFR "Kennlinie stetige Grenzwertregelung (fr)" CURVE 0x81D902 ME7_KL98 0 fak_sb_b16 0.000000 15.875000
 /begin AXIS_DESCR STD_AXIS frmxa fak_ub_b2 8 0.000000 1.992190 DEPOSIT ABSOLUTE /end AXIS_DESCR
 EXTENDED_LIMITS -16.000000 15.875000 /end CHARACTERISTIC
/begin RECORD_LAYOUT ME7_SST109 NO_AXIS_PTS_X 1 UWORD AXIS_PTS_X 2 UWORD INDEX_INCR DIRECT /end RECORD_LAYOUT
/begin RECORD_LAYOUT ME7_SST103 NO_AXIS_PTS_X 1 UBYTE AXIS_PTS_X 2 SBYTE INDEX_INCR DIRECT /end RECORD_LAYOUT
/begin AXIS_PTS SDZ08DMUB "SST-Verteilung in DMD, 8 Drehzahl-SST" 0x814558 nmot ME7_SST97 0 nmot_ub_q40 8 0.000000 10200.000000 DEPOSIT ABSOLUTE EXTENDED_LIMITS 0.000000 2550.000000 /end AXIS_PTS
/begin AXIS_PTS SDZ08DMUB2 "" 0x814561 nmot ME7_SST97 0 nmot_ub_q40 8 0.000000 10200.000000 DEPOSIT ABSOLUTE EXTENDED_LIMITS 0.000000 2550.000000 /end AXIS_PTS
/begin AXIS_PTS SML05LKUB "" 0x8181AF ml ME7_SST97 0 m_ub_b1020 5 0.000000 1020.000000 DEPOSIT ABSOLUTE EXTENDED_LIMITS 0.000000 65535.000000 /end AXIS_PTS
/begin AXIS_PTS SML07TMUW "" 0x81A0E0 ml_w ME7_SST109 0 m_uw_b6553p5 7 0.000000 6553.500000 DEPOSIT ABSOLUTE EXTENDED_LIMITS 0.000000 65535.000000 /end AXIS_PTS
/begin AXIS_PTS SNG06LLSB "StÅtzstellenverteilung Drehzahlgradient, 6 Sst." 0x814394 ngfil ME7_SST103 0 nmotg_sb_q100 6 -12800.000000 12700.000000 DEPOSIT ABSOLUTE EXTENDED_LIMITS 0.000000 182.041667 /end AXIS_PTS
/begin AXIS_PTS SNM06LLUB "SÅtzstellenverteilung fÅr Motordrehzahl" 0x810030 nmot_w ME7_SST109 0 nmot_uw_q0p25 6 0.000000 16383.800000 DEPOSIT ABSOLUTE EXTENDED_LIMITS 0.000000 182.041667 /end AXIS_PTS
/begin AXIS_PTS SNM08DMUB "SST-Verteilung in DMD, 8 Drehzahl-SST" 0x81439B nmot ME7_SST97 0 nmot_ub_q40 8 0.000000 10200.000000 DEPOSIT ABSOLUTE EXTENDED_LIMITS 0.000000 182.041667 /end AXIS_PTS
/begin AXIS_PTS SNM16KRUB "StÅtzstellenverteilung Drehzahl, 16 Sst." 0x818242 nmot ME7_SST97 0 nmot_ub_q40 16 0.000000 10200.000000 DEPOSIT ABSOLUTE EXTENDED_LIMITS 0.000000 182.041667 /end AXIS_PTS
/begin AXIS_PTS SNS06LLSB "StÅtzstellenvert., Solldrehzahlabw., 06 Sst., LL-Regel." 0x815568 dns ME7_SST103 0 nmotd_sb_q10 6 -1280.000000 1270.000000 DEPOSIT ABSOLUTE EXTENDED_LIMITS 0.000000 182.041667 /end AXIS_PTS
/begin AXIS_PTS SRL08DMUB "SST-Verteilung in DMD, 8 Last-SST" 0x814408 rl ME7_SST97 0 rel_ub_q0p75 8 0.000000 191.250000 DEPOSIT ABSOLUTE EXTENDED_LIMITS 0.000000 5.100000 /end AXIS_PTS
/begin AXIS_PTS STA06ESUB "SST-Verteilung fÅr die Ansauglufttemperatur" 0x818297 tans ME7_SST97 0 temp_ub_q0p75_o48 6 -48.000000 143.250000 DEPOSIT ABSOLUTE EXTENDED_LIMITS 0.000000 255.000000 /end AXIS_PTS
/begin AXIS_PTS STM06__UB "StÅtzstellenverteilung Motortemperatur, 6 Sst." 0x8182B6 tmot ME7_SST97 0 temp_ub_q0p75_o48 6 -48.000000 143.250000 DEPOSIT ABSOLUTE EXTENDED_LIMITS 0.000000 10200.000000 /end AXIS_PTS
/begin AXIS_PTS STM08MDUB "" 0x8182C6 tmot ME7_SST97 0 temp_ub_q0p75_o48 8 -48.000000 143.250000 DEPOSIT ABSOLUTE EXTENDED_LIMITS 0.000000 10200.000000 /end AXIS_PTS
/begin AXIS_PTS STS14ESUB "" 0x814484 tmst ME7_SST97 0 temp_ub_q0p75_o48 14 -48.000000 143.250000 DEPOSIT ABSOLUTE EXTENDED_LIMITS 0.000000 10200.000000 /end AXIS_PTS
/begin AXIS_PTS SUE08MFUB "" 0x814493 uevges ME7_SST97 0 fak_q0p1 8 0.000000 25.500000 DEPOSIT ABSOLUTE EXTENDED_LIMITS 0.000000 10200.000000 /end AXIS_PTS
/begin COMPU_METHOD adb_uw_q0p00195 "" RAT_FUNC "%6.4" "hPa/V" COEFFS 0 6.553600e+04 0.000000 0 0.000000 128.000000 /end COMPU_METHOD
/begin COMPU_METHOD DEZ "1 : 1 Umrechnug (dez/hex)" RAT_FUNC "%6.2" "" COEFFS 0 1.000000 0.000000 0 0.000000 1.000000 /end COMPU_METHOD
/begin COMPU_METHOD dez "1 : 1 Umrechnug (dez/hex)" RAT_FUNC "%6.2" "" COEFFS 0 1.000000 0.000000 0 0.000000 1.000000 /end COMPU_METHOD
/begin COMPU_METHOD dez___SL "1 : 1 Umrechnug (dez/hex)" RAT_FUNC "%6.2" "" COEFFS 0 1.000000 0.000000 0 0.000000 1.000000 /end COMPU_METHOD
/begin COMPU_METHOD dez___SW "1 : 1 Umrechnug (dez/hex)" RAT_FUNC "%6.2" "" COEFFS 0 1.000000 0.000000 0 0.000000 1.000000 /end COMPU_METHOD
/begin COMPU_METHOD dez___UW "1 : 1 Umrechnug (dez/hex)" RAT_FUNC "%6.2" "" COEFFS 0 1.000000 0.000000 0 0.000000 1.000000 /end COMPU_METHOD
/begin COMPU_METHOD dgrad_uw_q0p015 "" RAT_FUNC "%6.4" "hPa/V" COEFFS 0 6.553600e+04 0.000000 0 0.000000 1024.000000 /end COMPU_METHOD
/begin COMPU_METHOD dtsegn_b11p25divZyl "" RAT_FUNC "%6.4" "grad/KW" COEFFS 0 45.511100 0.000000 0 0.000000 1.000000 /end COMPU_METHOD
/begin COMPU_METHOD dtsegn_b11p25divZyl___UB "" RAT_FUNC "%6.4" "grad/KW" COEFFS 0 45.511100 0.000000 0 0.000000 1.000000 /end COMPU_METHOD
/begin COMPU_METHOD fak_q0p1 "" RAT_FUNC "%6.3" "" COEFFS 0 1.000000 0.000000 0 0.000000 1.000000e-01 /end COMPU_METHOD
/begin COMPU_METHOD fak_sb_b1 "" RAT_FUNC "%6.4" "-" COEFFS 0 256.000000 0.000000 0 0.000000 2.000000 /end COMPU_METHOD
/begin COMPU_METHOD fak_sb_b16 "" RAT_FUNC "%6.3" "-" COEFFS 0 256.000000 0.000000 0 0.000000 32.000000 /end COMPU_METHOD
/begin COMPU_METHOD fak_sw_b1 "" RAT_FUNC "%7.6" "-" COEFFS 0 6.553600e+04 0.000000 0 0.000000 2.000000 /end COMPU_METHOD
/begin COMPU_METHOD fak_sw_b64 "" RAT_FUNC "%6.4" "-" COEFFS 0 6.553600e+04 0.000000 0 0.000000 128.000000 /end COMPU_METHOD
/begin COMPU_METHOD fak_ub_b0p03125 "" RAT_FUNC "%6.5" "-" COEFFS 0 256.000000 0.000000 0 0.000000 3.125000e-02 /end COMPU_METHOD
/begin COMPU_METHOD fak_ub_b0p5 "" RAT_FUNC "%6.4" "-" COEFFS 0 256.000000 0.000000 0 0.000000 5.000000e-01 /end COMPU_METHOD
/begin COMPU_METHOD fak_ub_b1 "" RAT_FUNC "%6.4" "-" COEFFS 0 256.000000 0.000000 0 0.000000 1.000000 /end COMPU_METHOD
/begin COMPU_METHOD fak_ub_b16 "" RAT_FUNC "%6.4" "-" COEFFS 0 256.000000 0.000000 0 0.000000 16.000000 /end COMPU_METHOD
/begin COMPU_METHOD fak_ub_b2 "" RAT_FUNC "%6.4" "-" COEFFS 0 256.000000 0.000000 0 0.000000 2.000000 /end COMPU_METHOD
/begin COMPU_METHOD fak_ub_b4 "" RAT_FUNC "%6.4" "-" COEFFS 0 256.000000 0.000000 0 0.000000 4.000000 /end COMPU_METHOD
/begin COMPU_METHOD fak_ub_b64 "" RAT_FUNC "%6.3" "-" COEFFS 0 256.000000 0.000000 0 0.000000 64.000000 /end COMPU_METHOD
/begin COMPU_METHOD fak_ub_b8 "" RAT_FUNC "%6.4" "-" COEFFS 0 256.000000 0.000000 0 0.000000 8.000000 /end COMPU_METHOD
/begin COMPU_METHOD fak_ub_q4p7Em7 "" RAT_FUNC "%9.8" "-" COEFFS 0 1.000000 0.000000 0 0.000000 4.700000e-07 /end COMPU_METHOD
/begin COMPU_METHOD fak_uw_b1 "" RAT_FUNC "%7.6" "-" COEFFS 0 6.553600e+04 0.000000 0 0.000000 1.000000 /end COMPU_METHOD
/begin COMPU_METHOD fak_uw_b16 "" RAT_FUNC "%6.5" "-" COEFFS 0 6.553600e+04 0.000000 0 0.000000 16.000000 /end COMPU_METHOD
/begin COMPU_METHOD fak_uw_b2 "" RAT_FUNC "%7.6" "-" COEFFS 0 6.553600e+04 0.000000 0 0.000000 2.000000 /end COMPU_METHOD
/begin COMPU_METHOD fak_uw_b2___SW "" RAT_FUNC "%7.6" "-" COEFFS 0 6.553600e+04 0.000000 0 0.000000 2.000000 /end COMPU_METHOD
/begin COMPU_METHOD fak_uw_b4 "" RAT_FUNC "%7.6" "-" COEFFS 0 6.553600e+04 0.000000 0 0.000000 4.000000 /end COMPU_METHOD
/begin COMPU_METHOD fak_uw_b8 "" RAT_FUNC "%6.5" "-" COEFFS 0 6.553600e+04 0.000000 0 0.000000 8.000000 /end COMPU_METHOD
/begin COMPU_METHOD fmfkr_dez "" RAT_FUNC "%6.2" "kHz" COEFFS 0 1.000000 0.000000 0 0.000000 1.000000 /end COMPU_METHOD
/begin COMPU_METHOD kw_q6___SB "" RAT_FUNC "%6.2" "∞KW" COEFFS 0 1.000000 0.000000 0 0.000000 6.000000 /end COMPU_METHOD
/begin COMPU_METHOD kw_ub_q0p5 "" RAT_FUNC "%6.3" "∞KW" COEFFS 0 256.000000 0.000000 0 0.000000 128.000000 /end COMPU_METHOD
/begin COMPU_METHOD luquant "Umrechnung Laufunruhe in DMD" RAT_FUNC "%6.3" "(Umdr./sec)^2" COEFFS 0 1.583300 0.000000 0 0.000000 1.000000 /end COMPU_METHOD
/begin COMPU_METHOD lw_sb_q11p2 "" RAT_FUNC "%6.1" "∞" COEFFS 0 127.000000 0.000000 0 0.000000 1434.000000 /end COMPU_METHOD
/begin COMPU_METHOD m_q0p0031 "" RAT_FUNC "%6.4" "kg/h" COEFFS 0 320.000000 0.000000 0 0.000000 1.000000 /end COMPU_METHOD
/begin COMPU_METHOD m_q0p1___SW "" RAT_FUNC "%6.3" "kg/h" COEFFS 0 10.000000 0.000000 0 0.000000 1.000000 /end COMPU_METHOD
/begin COMPU_METHOD m_q0p4 "" RAT_FUNC "%6.3" "kg/h" COEFFS 0 1.000000 0.000000 0 0.000000 4.000000e-01 /end COMPU_METHOD
/begin COMPU_METHOD m_ub_b1020 "" RAT_FUNC "%6.2" "kg/h" COEFFS 0 1.000000 0.000000 0 0.000000 4.000000 /end COMPU_METHOD
/begin COMPU_METHOD m_uw_b25p6 "" RAT_FUNC "%6.5" "kg/h" COEFFS 0 6.553600e+04 0.000000 0 0.000000 25.600000 /end COMPU_METHOD
/begin COMPU_METHOD m_uw_b6553p5 "" RAT_FUNC "%6.3" "kg/h" COEFFS 0 1.000000 0.000000 0 0.000000 1.000000e-01 /end COMPU_METHOD
/begin COMPU_METHOD m_uw_q3p2 "" RAT_FUNC "%6.2" "kg/h" COEFFS 0 1.000000 0.000000 0 0.000000 3.200000 /end COMPU_METHOD
/begin COMPU_METHOD nmotd_sb_q10 "" RAT_FUNC "%6.1" "U/min" COEFFS 0 1.000000 0.000000 0 0.000000 10.000000 /end COMPU_METHOD
/begin COMPU_METHOD nmotg_sb_q100 "" RAT_FUNC "%6.0" "U/min/s" COEFFS 0 1.000000 0.000000 0 0.000000 100.000000 /end COMPU_METHOD
/begin COMPU_METHOD nmotg_sw_q0p39 "" RAT_FUNC "%6.3" "U/min/s" COEFFS 0 1.000000 0.000000 0 0.000000 3.906300e-01 /end COMPU_METHOD
/begin COMPU_METHOD nmot_sb_q10 "" RAT_FUNC "%6.1" "U/min" COEFFS 0 1.000000 0.000000 0 0.000000 10.000000 /end COMPU_METHOD
/begin COMPU_METHOD nmot_sw_q0p25 "" RAT_FUNC "%6.3" "U/min" COEFFS 0 1.000000 0.000000 0 0.000000 2.500000e-01 /end COMPU_METHOD
/begin COMPU_METHOD nmot_ub_q10 "" RAT_FUNC "%6.1" "U/min" COEFFS 0 1.000000 0.000000 0 0.000000 10.000000 /end COMPU_METHOD
/begin COMPU_METHOD nmot_ub_q10___SB "" RAT_FUNC "%6.1" "U/min" COEFFS 0 1.000000 0.000000 0 0.000000 10.000000 /end COMPU_METHOD
/begin COMPU_METHOD nmot_ub_q40 "" RAT_FUNC "%6.1" "Upm" COEFFS 0 1.000000 0.000000 0 0.000000 40.000000 /end COMPU_METHOD
/begin COMPU_METHOD nmot_ub_q40___SW "" RAT_FUNC "%6.1" "Upm" COEFFS 0 1.000000 0.000000 0 0.000000 40.000000 /end COMPU_METHOD
/begin COMPU_METHOD nmot_uw_q0p25 "" RAT_FUNC "%6.3" "U/min" COEFFS 0 1.000000 0.000000 0 0.000000 2.500000e-01 /end COMPU_METHOD
/begin COMPU_METHOD p_sb_q10 "" RAT_FUNC "%6.1" "hPa" COEFFS 0 1.000000 0.000000 0 0.000000 10.000000 /end COMPU_METHOD
/begin COMPU_METHOD p_sw_q0p039 "" RAT_FUNC "%6.4" "hPa" COEFFS 0 256.000000 0.000000 0 0.000000 10.000000 /end COMPU_METHOD
/begin COMPU_METHOD p_ub_q10 "" RAT_FUNC "%6.1" "hPa" COEFFS 0 1.000000 0.000000 0 0.000000 10.000000 /end COMPU_METHOD
/begin COMPU_METHOD p_ub_q5 "" RAT_FUNC "%6.2" "hPa" COEFFS 0 1.000000 0.000000 0 0.000000 5.000000 /end COMPU_METHOD
/begin COMPU_METHOD p_uw_q0p039 "" RAT_FUNC "%6.4" "hPa" COEFFS 0 256.000000 0.000000 0 0.000000 10.000000 /end COMPU_METHOD
/begin COMPU_METHOD relDK_q0p00152 "" RAT_FUNC "%6.4" "%DK" COEFFS 0 6.553600e+04 0.000000 0 0.000000 100.000000 /end COMPU_METHOD
/begin COMPU_METHOD relDK_q0p00152___UW "" RAT_FUNC "%6.4" "%DK" COEFFS 0 6.553600e+04 0.000000 0 0.000000 100.000000 /end COMPU_METHOD
/begin COMPU_METHOD relDK_q0p02441 "" RAT_FUNC "%6.4" "% DK" COEFFS 0 6.553600e+04 0.000000 0 0.000000 1600.000000 /end COMPU_METHOD
/begin COMPU_METHOD relDK_q0p02441___UW "" RAT_FUNC "%6.4" "% DK" COEFFS 0 6.553600e+04 0.000000 0 0.000000 1600.000000 /end COMPU_METHOD
/begin COMPU_METHOD relDK_q0p0625 "" RAT_FUNC "%6.4" "%PWM/%DK" COEFFS 0 16.000000 0.000000 0 0.000000 1.000000 /end COMPU_METHOD
/begin COMPU_METHOD relDK_q1 "" RAT_FUNC "%6.2" "%PWM/%DK" COEFFS 0 1.000000 0.000000 0 0.000000 1.000000 /end COMPU_METHOD
/begin COMPU_METHOD relDK_q4 "" RAT_FUNC "%6.2" "%PWM/%DK" COEFFS 0 1.000000 0.000000 0 0.000000 4.000000 /end COMPU_METHOD
/begin COMPU_METHOD relDK_ub_b100 "" RAT_FUNC "%6.3" "% DK" COEFFS 0 255.000000 0.000000 0 0.000000 100.000000 /end COMPU_METHOD
/begin COMPU_METHOD relDK_uw_b100 "" RAT_FUNC "%6.4" "% DK" COEFFS 0 65535.000000 0.000000 0 0.000000 100.000000 /end COMPU_METHOD
/begin COMPU_METHOD relPED_uw_b100 "" RAT_FUNC "%6.4" "% PED" COEFFS 0 65535.000000 0.000000 0 0.000000 100.000000 /end COMPU_METHOD
/begin COMPU_METHOD rel_q0p00305 "" RAT_FUNC "%6.4" "%/(U/min)" COEFFS 0 256.000000 0.000000 0 0.000000 7.812000e-01 /end COMPU_METHOD
/begin COMPU_METHOD rel_q0p1957 "" RAT_FUNC "%6.3" "%" COEFFS 0 511.000000 0.000000 0 0.000000 100.000000 /end COMPU_METHOD
/begin COMPU_METHOD rel_q0p1957___SW "" RAT_FUNC "%6.3" "%" COEFFS 0 511.000000 0.000000 0 0.000000 100.000000 /end COMPU_METHOD
/begin COMPU_METHOD rel_qn0p000488 "" RAT_FUNC "%8.7" "(%*s)/(U/min)" COEFFS 0 -256.000000 0.000000 0 0.000000 1.250000e-01 /end COMPU_METHOD
/begin COMPU_METHOD rel_sb_q0p39 "" RAT_FUNC "%6.3" "%" COEFFS 0 1.000000 0.000000 0 0.000000 3.906000e-01 /end COMPU_METHOD
/begin COMPU_METHOD rel_sb_q0p75 "" RAT_FUNC "%6.3" "%" COEFFS 0 1.000000 0.000000 0 0.000000 7.500000e-01 /end COMPU_METHOD
/begin COMPU_METHOD rel_sw_b100 "" RAT_FUNC "%6.4" "%" COEFFS 0 3.276800e+04 0.000000 0 0.000000 100.000000 /end COMPU_METHOD
/begin COMPU_METHOD rel_sw_b50 "" RAT_FUNC "%6.4" "%" COEFFS 0 6.553600e+04 0.000000 0 0.000000 100.000000 /end COMPU_METHOD
/begin COMPU_METHOD rel_sw_q0p0234 "" RAT_FUNC "%6.4" "%/seg" COEFFS 0 32.000000 0.000000 0 0.000000 7.500000e-01 /end COMPU_METHOD
/begin COMPU_METHOD rel_sw_q0p0234___UW "" RAT_FUNC "%6.4" "%/seg" COEFFS 0 32.000000 0.000000 0 0.000000 7.500000e-01 /end COMPU_METHOD
/begin COMPU_METHOD rel_sw_q0p1875 "" RAT_FUNC "%6.3" "%" COEFFS 0 6.553600e+04 0.000000 0 0.000000 12288.000000 /end COMPU_METHOD
/begin COMPU_METHOD rel_ub_b127p5 "" RAT_FUNC "%6.3" "%" COEFFS 0 2.000000 0.000000 0 0.000000 1.000000 /end COMPU_METHOD
/begin COMPU_METHOD rel_ub_b127p5___SL "" RAT_FUNC "%6.3" "%" COEFFS 0 2.000000 0.000000 0 0.000000 1.000000 /end COMPU_METHOD
/begin COMPU_METHOD rel_ub_b24p9 "" RAT_FUNC "%6.3" "%" COEFFS 0 255.000000 0.000000 0 0.000000 24.900000 /end COMPU_METHOD
/begin COMPU_METHOD rel_ub_b49p725 "" RAT_FUNC "%6.3" "%" COEFFS 0 255.000000 0.000000 0 0.000000 49.725000 /end COMPU_METHOD
/begin COMPU_METHOD rel_ub_b99p6 "" RAT_FUNC "%6.3" "%" COEFFS 0 256.000000 0.000000 0 0.000000 100.000000 /end COMPU_METHOD
/begin COMPU_METHOD rel_ub_bn24p9 "" RAT_FUNC "%6.5" "%" COEFFS 0 -255.000000 0.000000 0 0.000000 24.900000 /end COMPU_METHOD
/begin COMPU_METHOD rel_ub_bn6p375 "" RAT_FUNC "%6.5" "%" COEFFS 0 -255.000000 0.000000 0 0.000000 6.375000 /end COMPU_METHOD
/begin COMPU_METHOD rel_ub_q0p3906___UB "" RAT_FUNC "%6.3" "%" COEFFS 0 256.000000 0.000000 0 0.000000 100.000000 /end COMPU_METHOD
/begin COMPU_METHOD rel_ub_q0p75 "" RAT_FUNC "%6.3" "%" COEFFS 0 1.000000 0.000000 0 0.000000 7.500000e-01 /end COMPU_METHOD
/begin COMPU_METHOD rel_uw_b100 "" RAT_FUNC "%6.4" "%" COEFFS 0 6.553600e+04 0.000000 0 0.000000 100.000000 /end COMPU_METHOD
/begin COMPU_METHOD rel_uw_b200 "" RAT_FUNC "%6.4" "%" COEFFS 0 6.553600e+04 0.000000 0 0.000000 200.000000 /end COMPU_METHOD
/begin COMPU_METHOD rel_uw_b40 "" RAT_FUNC "%6.5" "%" COEFFS 0 6.553600e+04 0.000000 0 0.000000 40.000000 /end COMPU_METHOD
/begin COMPU_METHOD rel_uw_q0p0234 "" RAT_FUNC "%6.4" "%" COEFFS 0 32.000000 0.000000 0 0.000000 7.500000e-01 /end COMPU_METHOD
/begin COMPU_METHOD r_uw_q2 "" RAT_FUNC "%6.2" "Ohm" COEFFS 0 1.000000 0.000000 0 0.000000 2.000000 /end COMPU_METHOD
/begin COMPU_METHOD spg_sw_b5 "" RAT_FUNC "%6.4" "V" COEFFS 0 1024.000000 0.000000 0 0.000000 10.000000 /end COMPU_METHOD
/begin COMPU_METHOD spg_sw_q0p00488 "" RAT_FUNC "%6.4" "V" COEFFS 0 1024.000000 0.000000 0 0.000000 5.000000 /end COMPU_METHOD
/begin COMPU_METHOD spg_ubatt "" RAT_FUNC "%6.4" "V" COEFFS 0 1.000000 0.000000 0 0.000000 7.040000e-02 /end COMPU_METHOD
/begin COMPU_METHOD spg_ub_b5 "" RAT_FUNC "%6.4" "V" COEFFS 0 256.000000 0.000000 0 0.000000 5.000000 /end COMPU_METHOD
/begin COMPU_METHOD spg_uw_q0p001222 "" RAT_FUNC "%6.4" "V" COEFFS 0 1.000000 0.000000 0 0.000000 1.222000e-03 /end COMPU_METHOD
/begin COMPU_METHOD spg_uw_q0p00488 "" RAT_FUNC "%6.4" "V" COEFFS 0 1024.000000 0.000000 0 0.000000 5.000000 /end COMPU_METHOD
/begin COMPU_METHOD spg_uw_q0p004888 "" RAT_FUNC "%6.4" "V" COEFFS 0 1.000000 0.000000 0 0.000000 4.888000e-03 /end COMPU_METHOD
/begin COMPU_METHOD t100msxms_ub_b255 "" RAT_FUNC "%6.2" "ms" COEFFS 0 1.000000 0.000000 0 0.000000 1.000000 /end COMPU_METHOD
/begin COMPU_METHOD t100msxs_sb_q0p01 "" RAT_FUNC "%6.4" "s" COEFFS 0 1.000000 0.000000 0 0.000000 1.000000e-02 /end COMPU_METHOD
/begin COMPU_METHOD t100msxs_ub_b25p5 "" RAT_FUNC "%6.3" "s" COEFFS 0 1.000000 0.000000 0 0.000000 1.000000e-01 /end COMPU_METHOD
/begin COMPU_METHOD t10msxs_sb_q0p01 "" RAT_FUNC "%6.4" "s" COEFFS 0 1.000000 0.000000 0 0.000000 1.000000e-02 /end COMPU_METHOD
/begin COMPU_METHOD t10msxs_ub_b2p55 "" RAT_FUNC "%6.4" "s" COEFFS 0 1.000000 0.000000 0 0.000000 1.000000e-02 /end COMPU_METHOD
/begin COMPU_METHOD t10msxs_uw_b655p35 "" RAT_FUNC "%6.4" "s" COEFFS 0 1.000000 0.000000 0 0.000000 1.000000e-02 /end COMPU_METHOD
/begin COMPU_METHOD t1sxs_ub_b255 "" RAT_FUNC "%6.2" "s" COEFFS 0 1.000000 0.000000 0 0.000000 1.000000 /end COMPU_METHOD
/begin COMPU_METHOD t1sxs_uw_q1 "" RAT_FUNC "%6.2" "s" COEFFS 0 1.000000 0.000000 0 0.000000 1.000000 /end COMPU_METHOD
/begin COMPU_METHOD t20msxs_ub_b5p1 "" RAT_FUNC "%6.4" "s" COEFFS 0 1.000000 0.000000 0 0.000000 2.000000e-02 /end COMPU_METHOD
/begin COMPU_METHOD temp_sb_q0p75 "" RAT_FUNC "%6.3" "Grad C" COEFFS 0 1.000000 0.000000 0 0.000000 7.500000e-01 /end COMPU_METHOD
/begin COMPU_METHOD temp_sb_q0p75___SB "" RAT_FUNC "%6.3" "Grad C" COEFFS 0 1.000000 0.000000 0 0.000000 7.500000e-01 /end COMPU_METHOD
/begin COMPU_METHOD temp_sw_q0p75 "" RAT_FUNC "%6.3" "Grad C" COEFFS 0 4.000000 0.000000 0 0.000000 3.000000 /end COMPU_METHOD
/begin COMPU_METHOD temp_ub_b191p25 "" RAT_FUNC "%6.3" "Grad C" COEFFS 0 1.000000 0.000000 0 0.000000 7.500000e-01 /end COMPU_METHOD
/begin COMPU_METHOD temp_ub_q0p75_o48 "" RAT_FUNC "%6.2" "Grad C" COEFFS 0 1.000000 48.000000 0 0.000000 7.500000e-01 /end COMPU_METHOD
/begin COMPU_METHOD temp_ub_q5_o50 "" RAT_FUNC "%6.2" "Grad C" COEFFS 0 1.000000 50.000000 0 0.000000 5.000000 /end COMPU_METHOD
/begin COMPU_METHOD temp_uw_q0p0195 "" RAT_FUNC "%6.4" "Grad C" COEFFS 0 256.000000 0.000000 0 0.000000 5.000000 /end COMPU_METHOD
/begin COMPU_METHOD temp_uw_q0p0195_o50 "" RAT_FUNC "%6.2" "Grad C" COEFFS 0 256.000000 12800.000000 0 0.000000 5.000000 /end COMPU_METHOD
/begin COMPU_METHOD tinjection_sy "" RAT_FUNC "%6.4" "ms" COEFFS 0 312.500000 0.000000 0 0.000000 1.000000 /end COMPU_METHOD
/begin COMPU_METHOD tknockintgrad_sy "" RAT_FUNC "%6.3" "V/s" COEFFS 0 10.738300 0.000000 0 0.000000 1.000000 /end COMPU_METHOD
/begin COMPU_METHOD vfzg_ub_q1p25 "" RAT_FUNC "%6.2" "km/h" COEFFS 0 1.000000 0.000000 0 0.000000 1.250000 /end COMPU_METHOD
/begin COMPU_METHOD vfzg_ub_q1p25___UB "" RAT_FUNC "%6.2" "km/h" COEFFS 0 1.000000 0.000000 0 0.000000 1.250000 /end COMPU_METHOD
/begin COMPU_METHOD vfzg_uw_b512 "" RAT_FUNC "%6.4" "km/h" COEFFS 0 6.553600e+04 0.000000 0 0.000000 512.000000 /end COMPU_METHOD
/begin COMPU_METHOD zw_sb_q0p75 "" RAT_FUNC "%6.3" "grad KW" COEFFS 0 255.000000 0.000000 0 0.000000 191.250000 /end COMPU_METHOD
/begin COMPU_METHOD zw_sb_q0p75___SL "" RAT_FUNC "%6.3" "grad KW" COEFFS 0 255.000000 0.000000 0 0.000000 191.250000 /end COMPU_METHOD
/begin COMPU_METHOD zw_ub_q0p75 "" RAT_FUNC "%6.3" "Grad KW" COEFFS 0 255.000000 0.000000 0 0.000000 191.250000 /end COMPU_METHOD
/begin COMPU_METHOD zw_ub_q6 "" RAT_FUNC "%6.2" "Grad KW" COEFFS 0 255.000000 0.000000 0 0.000000 1530.000000 /end COMPU_METHOD
/begin COMPU_METHOD zw_ub_qn0p75 "" RAT_FUNC "%6.4" "grad KW" COEFFS 0 1.000000 0.000000 0 0.000000 -7.500000e-01 /end COMPU_METHOD
/begin COMPU_METHOD zw_uw_qn0p75 "" RAT_FUNC "%6.4" "grad KW" COEFFS 0 1.000000 0.000000 0 0.000000 -7.500000e-01 /end COMPU_METHOD
/end MODULE
/end PROJECT
