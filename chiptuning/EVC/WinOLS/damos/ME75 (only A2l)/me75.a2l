ASAP2_VERSION 1 21
/begin PROJECT Pro4017 "R4 1.8l 5V T lÑngs FR5ROM F5051"
/begin HEADER "" PROJECT_NO Pro4017 VERSION "PrV = F21dc mit 00" /end HEADER
/begin MODULE DIM " "
/begin MOD_COMMON " " S_REC_LAYOUT ME7 BYTE_ORDER MSB_LAST /end MOD_COMMON
/begin RECORD_LAYOUT ME7_FW4 FNC_VALUES 1 SWORD COLUMN_DIR DIRECT /end RECORD_LAYOUT
/begin RECORD_LAYOUT ME7_FW1 FNC_VALUES 1 UBYTE COLUMN_DIR DIRECT /end RECORD_LAYOUT
/begin RECORD_LAYOUT ME7_FW3 FNC_VALUES 1 UWORD COLUMN_DIR DIRECT /end RECORD_LAYOUT
/begin RECORD_LAYOUT ME7_GKL1 FNC_VALUES 1 UBYTE COLUMN_DIR DIRECT /end RECORD_LAYOUT
/begin RECORD_LAYOUT ME7_GKL3 FNC_VALUES 1 UWORD COLUMN_DIR DIRECT /end RECORD_LAYOUT
/begin RECORD_LAYOUT ME7_KL98 NO_AXIS_PTS_X 1 UBYTE AXIS_PTS_X 2 UBYTE INDEX_INCR DIRECT FNC_VALUES 3 SBYTE COLUMN_DIR DIRECT /end RECORD_LAYOUT
/begin RECORD_LAYOUT ME7_FW2 FNC_VALUES 1 SBYTE COLUMN_DIR DIRECT /end RECORD_LAYOUT
/begin RECORD_LAYOUT ZF_KL111 NO_AXIS_PTS_X 1 UWORD AXIS_PTS_X 2 UWORD INDEX_INCR DIRECT FNC_VALUES 3 UWORD ROW_DIR DIRECT /end RECORD_LAYOUT
/begin RECORD_LAYOUT ME7_KL97 NO_AXIS_PTS_X 1 UBYTE AXIS_PTS_X 2 UBYTE INDEX_INCR DIRECT FNC_VALUES 3 UBYTE COLUMN_DIR DIRECT /end RECORD_LAYOUT
/begin RECORD_LAYOUT ZF_KL118 NO_AXIS_PTS_X 1 UWORD AXIS_PTS_X 2 SWORD INDEX_INCR DIRECT FNC_VALUES 3 SWORD ROW_DIR DIRECT /end RECORD_LAYOUT
/begin RECORD_LAYOUT ME7_GKL2 FNC_VALUES 1 SBYTE COLUMN_DIR DIRECT /end RECORD_LAYOUT
/begin RECORD_LAYOUT ME7_KL99 NO_AXIS_PTS_X 1 UBYTE AXIS_PTS_X 2 UBYTE INDEX_INCR DIRECT FNC_VALUES 3 UWORD COLUMN_DIR DIRECT /end RECORD_LAYOUT
/begin RECORD_LAYOUT ZF_KL117 NO_AXIS_PTS_X 1 UWORD AXIS_PTS_X 2 SWORD INDEX_INCR DIRECT FNC_VALUES 3 UWORD ROW_DIR DIRECT /end RECORD_LAYOUT
/begin RECORD_LAYOUT ME7_FKL1 FNC_VALUES 1 UBYTE COLUMN_DIR DIRECT /end RECORD_LAYOUT
/begin AXIS_PTS FHO04ESUB "SST-Verteilung fÅr Hîhenfaktor" 0x81437A fho ME7_SST97 0 fak_ub_b4 4 0.000000 3.984380 DEPOSIT ABSOLUTE EXTENDED_LIMITS 0.000000 3.984375 /end AXIS_PTS
/begin RECORD_LAYOUT ME7_SST97 NO_AXIS_PTS_X 1 UBYTE AXIS_PTS_X 2 UBYTE INDEX_INCR DIRECT /end RECORD_LAYOUT
/begin RECORD_LAYOUT ME7_KF339 NO_AXIS_PTS_X 1 UBYTE NO_AXIS_PTS_Y 2 UBYTE AXIS_PTS_X 3 UBYTE INDEX_INCR DIRECT AXIS_PTS_Y 4 UWORD INDEX_INCR DIRECT FNC_VALUES 5 UWORD COLUMN_DIR DIRECT /end RECORD_LAYOUT
/begin CHARACTERISTIC FQTEPT "Kennlinie Tankunterdruckbegrenzung (pte)" CURVE 0x81D914 ME7_KL104 0 fak_sb_b16 0.000000 15.875000
 /begin AXIS_DESCR STD_AXIS pte p_sb_q0p25 6 -32.000000 31.750000 DEPOSIT ABSOLUTE /end AXIS_DESCR
 EXTENDED_LIMITS -16.000000 15.875000 /end CHARACTERISTIC
/begin RECORD_LAYOUT ME7_KL104 NO_AXIS_PTS_X 1 UBYTE AXIS_PTS_X 2 SBYTE INDEX_INCR DIRECT FNC_VALUES 3 SBYTE COLUMN_DIR DIRECT /end RECORD_LAYOUT
/begin CHARACTERISTIC FQTEVA "Progression bei SpÅlratenaufsteuerung" CURVE 0x819A5D ME7_KL97 0 fak_ub_b16 0.000000 15.937500
 /begin AXIS_DESCR STD_AXIS ftefva fak_ub_b0p5 6 0.000000 0.498047 DEPOSIT ABSOLUTE /end AXIS_DESCR
/end CHARACTERISTIC
/begin CHARACTERISTIC FRAE "Delta-fra-Schwelle fÅr Erkennung der eingeschwungenen Grundadaption" VALUE 0x81BA04 ME7_FW3 0 fak_uw_b2 0.000000 1.999970 EXTENDED_LIMITS 0.000000 1.999969 /end CHARACTERISTIC
/begin CHARACTERISTIC FRAODN "untere Diagnoseschwelle des Korrekturfaktors frao" VALUE 0x81BA06 ME7_FW3 0 fak_uw_b2 0.000000 1.999970 EXTENDED_LIMITS 0.000000 1.999969 /end CHARACTERISTIC
/begin CHARACTERISTIC FRAODX "obere Diagnoseschwelle des Korrekturfaktors frao" VALUE 0x81BA08 ME7_FW3 0 fak_uw_b2 0.000000 1.999970 EXTENDED_LIMITS 0.000000 1.999969 /end CHARACTERISTIC
/begin CHARACTERISTIC FRAOMN "untere Begrenzung des Korrekturfaktors frao" VALUE 0x818B06 ME7_FW1 0 fak_ub_b2 0.000000 1.992190 EXTENDED_LIMITS 0.000000 1.992188 /end CHARACTERISTIC
/begin CHARACTERISTIC FRAOMX "obere Begrenzung des Korrekturfaktors frao" VALUE 0x818B07 ME7_FW1 0 fak_ub_b2 0.000000 1.992190 EXTENDED_LIMITS 0.000000 1.992188 /end CHARACTERISTIC
/begin CHARACTERISTIC FRAORN "untere reduzierte Schwelle des Korrekturfaktors frao" VALUE 0x818B08 ME7_FW1 0 fak_ub_b2 0.000000 1.992190 EXTENDED_LIMITS 0.000000 1.992188 /end CHARACTERISTIC
/begin CHARACTERISTIC FRAORX "obere reduzierte Schwelle des Korrekturfaktors frao" VALUE 0x818B09 ME7_FW1 0 fak_ub_b2 0.000000 1.992190 EXTENDED_LIMITS 0.000000 1.992188 /end CHARACTERISTIC
/begin CHARACTERISTIC FRARAG "VerstÑrkungsfaktor bei AT" CURVE 0x819931 ME7_FKL1 0 fak_ub_b3p125 0.000000 3.112790
 /begin AXIS_DESCR FIX_AXIS gangi dez___SL 6 1.000000 6.000000 FIX_AXIS_PAR 1 0 6 /end AXIS_DESCR
 EXTENDED_LIMITS 0.000000 3.112793 /end CHARACTERISTIC
/begin CHARACTERISTIC FRARAWG "VerstÑrkungsfaktor bei AT, WK geschlossen" CURVE 0x819937 ME7_FKL1 0 fak_ub_b3p125 0.000000 3.112790
 /begin AXIS_DESCR FIX_AXIS gangi dez___SL 6 1.000000 6.000000 FIX_AXIS_PAR 1 0 6 /end AXIS_DESCR
 EXTENDED_LIMITS 0.000000 3.112793 /end CHARACTERISTIC
/begin CHARACTERISTIC FRARHG_0_A "VerstÑrkungsfaktor" CURVE 0x81993D ME7_FKL1 0 fak_ub_b3p125 0.000000 3.112790
 /begin AXIS_DESCR FIX_AXIS gangi dez___SL 6 1.000000 6.000000 FIX_AXIS_PAR 1 0 6 /end AXIS_DESCR
 EXTENDED_LIMITS 0.000000 3.112793 /end CHARACTERISTIC
/begin CHARACTERISTIC FRARHG_1_A "VerstÑrkungsfaktor" CURVE 0x819943 ME7_FKL1 0 fak_ub_b3p125 0.000000 3.112790
 /begin AXIS_DESCR FIX_AXIS gangi dez___SL 6 1.000000 6.000000 FIX_AXIS_PAR 1 0 6 /end AXIS_DESCR
 EXTENDED_LIMITS 0.000000 3.112793 /end CHARACTERISTIC
/begin CHARACTERISTIC FRARHG_2_A "VerstÑrkungsfaktor" CURVE 0x819949 ME7_FKL1 0 fak_ub_b3p125 0.000000 3.112790
 /begin AXIS_DESCR FIX_AXIS gangi dez___SL 6 1.000000 6.000000 FIX_AXIS_PAR 1 0 6 /end AXIS_DESCR
 EXTENDED_LIMITS 0.000000 3.112793 /end CHARACTERISTIC
/begin CHARACTERISTIC FRARHG_3_A "VerstÑrkungsfaktor" CURVE 0x81994F ME7_FKL1 0 fak_ub_b3p125 0.000000 3.112790
 /begin AXIS_DESCR FIX_AXIS gangi dez___SL 6 1.000000 6.000000 FIX_AXIS_PAR 1 0 6 /end AXIS_DESCR
 EXTENDED_LIMITS 0.000000 3.112793 /end CHARACTERISTIC
/begin CHARACTERISTIC FRAUDN "untere Diagnoseschwelle des Korrekturfaktors frau" VALUE 0x81BA0A ME7_FW3 0 fak_uw_b2 0.000000 1.999970 EXTENDED_LIMITS 0.000000 1.999969 /end CHARACTERISTIC
/begin CHARACTERISTIC FRAUDX "obere Diagnoseschwelle des Korrekturfaktors frau" VALUE 0x81BA0C ME7_FW3 0 fak_uw_b2 0.000000 1.999970 EXTENDED_LIMITS 0.000000 1.999969 /end CHARACTERISTIC
/begin CHARACTERISTIC FRAUMN "untere Begrenzung des Korrekturfaktors frau" VALUE 0x818B0A ME7_FW1 0 fak_ub_b2 0.000000 1.992190 EXTENDED_LIMITS 0.000000 1.992188 /end CHARACTERISTIC
/begin CHARACTERISTIC FRAUMX "obere Begrenzung des Korrekturfaktors frau" VALUE 0x818B0B ME7_FW1 0 fak_ub_b2 0.000000 1.992190 EXTENDED_LIMITS 0.000000 1.992188 /end CHARACTERISTIC
/begin CHARACTERISTIC FRAURN "untere reduzierte Schwelle des Korrekturfaktors frau" VALUE 0x818B0C ME7_FW1 0 fak_ub_b2 0.000000 1.992190 EXTENDED_LIMITS 0.000000 1.992188 /end CHARACTERISTIC
/begin CHARACTERISTIC FRAURX "obere reduzierte Schwelle des Korrekturfaktors frau" VALUE 0x818B0D ME7_FW1 0 fak_ub_b2 0.000000 1.992190 EXTENDED_LIMITS 0.000000 1.992188 /end CHARACTERISTIC
/begin CHARACTERISTIC FRHB "fr-Schwelle fÅr mîgliches RÅcksetzten Flip-Flop 'Hohe Beladung'" VALUE 0x819A6A ME7_FW1 0 fak_ub_b2 0.000000 1.992190 EXTENDED_LIMITS 0.000000 1.992188 /end CHARACTERISTIC
/begin CHARACTERISTIC FRINH1 "Multiplikativer Faktor fÅr RIN Sollwert hinter Kat" CURVE 0x8183AE ME7_KL97 0 fak_ub_b64 0.000000 63.750000
 /begin AXIS_DESCR STD_AXIS tkatmf temp_ub_q5_o50 5 -50.000000 1225.000000 DEPOSIT ABSOLUTE /end AXIS_DESCR
/end CHARACTERISTIC
/begin CHARACTERISTIC FRINOF "Faktor fÅr Bewertung alter Ri-Wert ohne Filter" VALUE 0x814D78 ME7_FW1 0 fak_ub_b16 0.000000 15.937500 /end CHARACTERISTIC
/begin CHARACTERISTIC FRINV1 "Multiplikativer Faktor fÅr RIN Sollwert vor Kat" CURVE 0x81857E ME7_KL97 0 fak_ub_b64 0.000000 63.750000
 /begin AXIS_DESCR STD_AXIS tabgmf temp_ub_q5_o50 5 -50.000000 1225.000000 DEPOSIT ABSOLUTE /end AXIS_DESCR
/end CHARACTERISTIC
/begin CHARACTERISTIC FRIPDTES "Faktor zur Verstellung von fri und frp wÑhrend DTEV aktiv" VALUE 0x815EBF ME7_FW1 0 fak_ub_b4 0.000000 3.984380 EXTENDED_LIMITS 0.000000 3.984375 /end CHARACTERISTIC
/begin CHARACTERISTIC FRIPTES "Faktor zur Verstellung von fri und frp bei Fehler 'offenes TEV klemmt'" VALUE 0x815EC0 ME7_FW1 0 fak_ub_b4 0.000000 3.984380 EXTENDED_LIMITS 0.000000 3.984375 /end CHARACTERISTIC
/begin CHARACTERISTIC FRKAP "Faktor relative Kraftstoffmasse fÅr Applikation" VALUE 0x8188E9 ME7_FW1 0 fak_ub_b2 0.000000 1.992190 EXTENDED_LIMITS 0.000000 1.992188 /end CHARACTERISTIC
/begin CHARACTERISTIC FRK_AOG "oberer Grenzwert Anpassung Faktor Grundanpassung" VALUE 0x815450 ME7_FW1 0 fak_ub_b1p25_o0p75 0.750000 1.248050 EXTENDED_LIMITS 0.750000 1.248048 /end CHARACTERISTIC
/begin CHARACTERISTIC FRK_AUG "unterer Grenzwert Anpassung Faktor Grundanpassung" VALUE 0x815451 ME7_FW1 0 fak_ub_b1p25_o0p75 0.750000 1.248050 EXTENDED_LIMITS 0.750000 1.248048 /end CHARACTERISTIC
/begin CHARACTERISTIC FRLFSDP "Einspritzkorrektur bei RLFS" CURVE 0x81B8B6 ZF_KL117 0 fak_uw_b2 0.000000 1.999970
 /begin AXIS_DESCR STD_AXIS dpus_w p_sw_q0p078 11 -2560.000000 2559.920000 DEPOSIT ABSOLUTE /end AXIS_DESCR
 EXTENDED_LIMITS 0.000000 1.999969 /end CHARACTERISTIC
/begin CHARACTERISTIC FRLKEVT "Korrektur max. rl in AbhÑngigkeit der Ventiltemperatur" CURVE 0x81D2D4 ME7_KL99 0 fak_uw_b2 0.000000 1.999970
 /begin AXIS_DESCR STD_AXIS evtmod temp_ub_q0p75_o48 6 -48.000000 143.250000 DEPOSIT ABSOLUTE /end AXIS_DESCR
 EXTENDED_LIMITS 0.000000 1.999969 /end CHARACTERISTIC
/begin CHARACTERISTIC FRLMNHO "Korrekturfaktor rlmin Åber Hîhe" CURVE 0x815115 ME7_KL97 0 fak_ub_b2 0.000000 1.992190
 /begin AXIS_DESCR STD_AXIS fho fak_ub_b4 5 0.000000 3.984380 DEPOSIT ABSOLUTE /end AXIS_DESCR
 EXTENDED_LIMITS 0.000000 1.992188 /end CHARACTERISTIC
/begin CHARACTERISTIC FRMAX "obere Regelbereichsgrenze" VALUE 0x81376C ME7_FW3 0 fak_uw_b2 0.000000 1.999970 EXTENDED_LIMITS 0.000000 1.999969 /end CHARACTERISTIC
/begin CHARACTERISTIC FRMDPMO "obere frm Schwelle fÅr passive Einschaltbedingungen Diagnose TEV" VALUE 0x81D996 ME7_FW3 0 fak_uw_b2 1.000000 1.149990 EXTENDED_LIMITS 0.000000 1.999969 /end CHARACTERISTIC
/begin CHARACTERISTIC FRMDPMU "untere frm Schwelle fÅr passive Einschaltbedingungen Diagnose TEV" VALUE 0x81D998 ME7_FW3 0 fak_uw_b2 0.850006 1.000000 EXTENDED_LIMITS 0.000000 1.999969 /end CHARACTERISTIC
/begin CHARACTERISTIC FRMDTEVO "obere frm Schwelle fÅr passive i.O. PrÅfung Diagnose TEV" VALUE 0x81D99A ME7_FW3 0 fak_uw_b2 1.000000 1.149990 EXTENDED_LIMITS 0.000000 1.999969 /end CHARACTERISTIC
/begin CHARACTERISTIC FRMDTEVU "untere frm Schwelle fÅr passive i.O. PrÅfung Diagnose TEV" VALUE 0x81D99C ME7_FW3 0 fak_uw_b2 0.850006 1.000000 EXTENDED_LIMITS 0.000000 1.999969 /end CHARACTERISTIC
/begin CHARACTERISTIC FRMLASHO "obere Schwelle fÅr Mittelwert des Lambdareglerfaktors" VALUE 0x81AD4A ME7_FW3 0 fak_uw_b2 0.000000 1.999970 EXTENDED_LIMITS 0.000000 1.999969 /end CHARACTERISTIC
/begin CHARACTERISTIC FRMLASHU "untere Schwelle fÅr Mittelwert des Lambdareglerfaktors" VALUE 0x81AD4C ME7_FW3 0 fak_uw_b2 0.000000 1.999970 EXTENDED_LIMITS 0.000000 1.999969 /end CHARACTERISTIC
/begin CHARACTERISTIC FRMSTDN "untere Diagnoseschwelle (short test)" VALUE 0x818E17 ME7_FW1 0 fak_ub_b2 0.000000 1.992190 EXTENDED_LIMITS 0.000000 1.992188 /end CHARACTERISTIC
/begin CHARACTERISTIC FRMSTDX "obere Diagnoseschwelle (short test)" VALUE 0x818E18 ME7_FW1 0 fak_ub_b2 0.000000 1.992190 EXTENDED_LIMITS 0.000000 1.992188 /end CHARACTERISTIC
/begin CHARACTERISTIC FRTEMX "obere Regelbereichsgrenze bei Fehler 'offen klemmendes TEV'" VALUE 0x81376E ME7_FW3 0 fak_uw_b2 0.000000 1.999970 EXTENDED_LIMITS 0.000000 1.999969 /end CHARACTERISTIC
/begin CHARACTERISTIC FS1FO "Filterfaktor Segmentzeit-Filter 1 der fuel-on/-off Adaption" VALUE 0x81018A ME7_FW3 0 fak_uw_b2 0.000000 0.999969 EXTENDED_LIMITS 0.000000 1.999969 /end CHARACTERISTIC
/begin CHARACTERISTIC FS2FO "Filterfaktor Segmentzeit-Filter 2 der fuel-on/-off Adaption" VALUE 0x81018C ME7_FW3 0 fak_uw_b2 0.000000 0.999969 EXTENDED_LIMITS 0.000000 1.999969 /end CHARACTERISTIC
/begin CHARACTERISTIC FSRFTEF "Faktor Steilheit SpÅlratenregelung in der NÑhe des gewÅnschten Krafstoffanteils" VALUE 0x815E23 ME7_FW1 0 fak_ub_b64 4.000000 63.750000 EXTENDED_LIMITS 0.000000 63.750000 /end CHARACTERISTIC
/begin CHARACTERISTIC FSTHO "Wichtung Startfaktor" CURVE 0x818B37 ME7_KL97 0 fak_ub_b2 0.000000 1.992190
 /begin AXIS_DESCR STD_AXIS fho fak_ub_b4 4 0.000000 3.984380 DEPOSIT ABSOLUTE /end AXIS_DESCR
 EXTENDED_LIMITS 0.000000 1.992188 /end CHARACTERISTIC
/begin CHARACTERISTIC FST_AOG "oberer Grenzwert Anpassung Faktor Start" VALUE 0x815452 ME7_FW1 0 fak_ub_b2 0.000000 1.992190 EXTENDED_LIMITS 0.000000 1.992188 /end CHARACTERISTIC
/begin CHARACTERISTIC FST_AUG "unterer Grenzwert Anpassung Faktor Start" VALUE 0x815453 ME7_FW1 0 fak_ub_b2 0.000000 1.992190 EXTENDED_LIMITS 0.000000 1.992188 /end CHARACTERISTIC
/begin CHARACTERISTIC FSZTM "Faktor Schlie·zeitkorrektur tmot-abhÑngig" CURVE 0x81630F ME7_KL97 0 fak_ub_b2 0.000000 1.992190
 /begin AXIS_DESCR STD_AXIS tmot temp_ub_q0p75_o48 5 -48.000000 143.250000 DEPOSIT ABSOLUTE /end AXIS_DESCR
 EXTENDED_LIMITS 0.000000 1.992188 /end CHARACTERISTIC
/begin CHARACTERISTIC FTEADAB "Schwelle Beladung fÅr Abbruch TE-Phase" VALUE 0x819A6B ME7_FW2 0 fak_sb_b64 -64.000000 63.500000 /end CHARACTERISTIC
/begin CHARACTERISTIC FTEADDPO "obere Beladungsschwelle fÅr passive i.O. PrÅfung" VALUE 0x81D99E ME7_FW4 0 fak_sw_b64 20.000000 50.000000 EXTENDED_LIMITS -64.000000 63.998047 /end CHARACTERISTIC
/begin CHARACTERISTIC FTEADDPU "untere Beladungsschwelle fÅr passive i.O. PrÅfung" VALUE 0x81D9A0 ME7_FW4 0 fak_sw_b64 2.000000 10.000000 EXTENDED_LIMITS -64.000000 63.998047 /end CHARACTERISTIC
/begin CHARACTERISTIC FTEADMX "Maximalwert der Beladung des AKF's" VALUE 0x819A6C ME7_FW2 0 fak_sb_b64 -64.000000 63.500000 /end CHARACTERISTIC
/begin CHARACTERISTIC FTEADSZ "Schwelle Beladung fÅr TEV sofort schlie·en aus DTEV" VALUE 0x81D9A2 ME7_FW4 0 fak_sw_b64 0.000000 15.000000 EXTENDED_LIMITS -64.000000 63.998047 /end CHARACTERISTIC
/begin CHARACTERISTIC FTEADZU "Schwelle Beladung fÅr Unterbrechung TE-Phase fÅr Diagnose Funktionen" VALUE 0x81B8E8 ME7_FW4 0 fak_sw_b64 -64.000000 63.998000 EXTENDED_LIMITS -64.000000 63.998047 /end CHARACTERISTIC
/begin CHARACTERISTIC FTEDS "Schwelle Beladung fÅr Umschaltung auf DauertankentlÅftung" VALUE 0x81B8EA ME7_FW4 0 fak_sw_b64 -64.000000 63.998000 EXTENDED_LIMITS -64.000000 63.998047 /end CHARACTERISTIC
/begin CHARACTERISTIC FTEFHB "Schwelle fÅr SpÅlrate TankentlÅftung fÅr Erkennung hohe Beladung" VALUE 0x819A6D ME7_FW1 0 fak_ub_b0p5 0.000000 0.498047 /end CHARACTERISTIC
/begin CHARACTERISTIC FTEHB "Schwelle fÅr Faktor TankentlÅftung fÅr Erkennung hohe Beladung" VALUE 0x819A6E ME7_FW2 0 fak_sb_b64 -64.000000 63.500000 /end CHARACTERISTIC
/begin CHARACTERISTIC FTEINIX "Kennlinie Max. SpÅlrate abhÑngig vom Integral Massenstrom TE nach TE Stop" CURVE 0x819A6F ME7_KL97 0 fak_ub_b0p5 0.000000 0.199219
 /begin AXIS_DESCR STD_AXIS imsteini m_ub_q0p0444 5 0.000000 11.322000 DEPOSIT ABSOLUTE /end AXIS_DESCR
 EXTENDED_LIMITS 0.000000 0.498047 /end CHARACTERISTIC
/begin CHARACTERISTIC FTLDIA "Faktor fÅr Entprellzeit Adaptionsfreigabe" VALUE 0x81945C ME7_FW1 0 fak_ub_b2 0.000000 1.992190 EXTENDED_LIMITS 0.000000 1.992188 /end CHARACTERISTIC
/begin CHARACTERISTIC FTLDIAP "Faktor fÅr Entprellzeit schnelle positive NachfÅhrung" VALUE 0x81945D ME7_FW1 0 fak_ub_b2 0.000000 1.992190 EXTENDED_LIMITS 0.000000 1.992188 /end CHARACTERISTIC
/begin CHARACTERISTIC FTMLAKH "tmot-Korrektur der Lambda-Bewertung bei Katheizen" CURVE 0x819029 ME7_KL97 0 fak_ub_b1 0.000000 0.996094
 /begin AXIS_DESCR STD_AXIS tmot temp_ub_q0p75_o48 4 -48.000000 143.250000 DEPOSIT ABSOLUTE /end AXIS_DESCR
/end CHARACTERISTIC
/begin CHARACTERISTIC FTOMN "minimale ôffnungszeit" VALUE 0x81631A ME7_FW1 0 txms_ub_q0p1 0.000000 25.500000 /end CHARACTERISTIC
/begin CHARACTERISTIC FTSDRLW "Faktor Schlie·zeit bei Lastdynamik" CURVE 0x81398E ZF_KL117 0 fak_uw_b8 0.000000 7.999880
 /begin AXIS_DESCR STD_AXIS tsdrlmx_w rel_sw_q0p0234 6 -768.000000 767.977000 DEPOSIT ABSOLUTE /end AXIS_DESCR
 EXTENDED_LIMITS 0.000000 7.999878 /end CHARACTERISTIC
/begin CHARACTERISTIC FTSLWSDN "Faktor Schlie·zeit bei LastwechselschlagdÑmpfung" CURVE 0x8139A8 ZF_KL111 0 fak_uw_b8 0.000000 7.999880
 /begin AXIS_DESCR STD_AXIS nmot_w nmot_uw_q0p25 6 0.000000 16383.800000 DEPOSIT ABSOLUTE /end AXIS_DESCR
 EXTENDED_LIMITS 0.000000 7.999878 /end CHARACTERISTIC
/begin CHARACTERISTIC FUEPMLD "Faktor fÅr gleitender öbergang Druckmittelwert(Referenzdruck) beim Turbo" CURVE 0x811A8A ZF_KL117 0 fak_uw_b1 0.000000 0.999985
 /begin AXIS_DESCR STD_AXIS lditv_w tv_sw_q0p005 4 -163.840000 163.835000 DEPOSIT ABSOLUTE /end AXIS_DESCR
/end CHARACTERISTIC
/begin CHARACTERISTIC FUKABAKI "Init.-Wert adaptiver öK-Korrekturfaktor BA fÅr kalten Motor" VALUE 0x8153F3 ME7_FW1 0 fak_ub_b4 0.000000 3.984380 EXTENDED_LIMITS 0.000000 3.984375 /end CHARACTERISTIC
/begin CHARACTERISTIC FUKABAKO "Obergrenze adaptiver öK-Korrekturfaktor BA bei kaltem Motor" VALUE 0x818FA3 ME7_FW1 0 fak_ub_b4 0.000000 3.984380 EXTENDED_LIMITS 0.000000 3.984375 /end CHARACTERISTIC
/begin CHARACTERISTIC FUKABAKU "Untergrenze adaptiver öK-Korrekturfaktor BA bei kaltem Motor" VALUE 0x818FA4 ME7_FW1 0 fak_ub_b4 0.093750 3.984380 EXTENDED_LIMITS 0.000000 3.984375 /end CHARACTERISTIC
/begin CHARACTERISTIC FUKABAWI "Init.-Wert adaptiver öK-Korrekturfaktor BA fÅr warmen Motor" VALUE 0x8153F4 ME7_FW1 0 fak_ub_b4 0.000000 3.984380 EXTENDED_LIMITS 0.000000 3.984375 /end CHARACTERISTIC
/begin CHARACTERISTIC FUKABAWO "Obergrenze adaptiver öK-Korrekturfaktor BA bei warmem Motor" VALUE 0x818FA5 ME7_FW1 0 fak_ub_b4 0.000000 3.984380 EXTENDED_LIMITS 0.000000 3.984375 /end CHARACTERISTIC
/begin CHARACTERISTIC FUKABAWU "Untergrenze adaptiver öK-Korrekturfaktor BA bei warmem Motor" VALUE 0x818FA6 ME7_FW1 0 fak_ub_b4 0.093750 3.984380 EXTENDED_LIMITS 0.000000 3.984375 /end CHARACTERISTIC
/begin CHARACTERISTIC FUKAVAKI "Init.-Wert adaptiver öK-Korrekturfaktor VA fÅr kalten Motor" VALUE 0x8153F5 ME7_FW1 0 fak_ub_b4 0.000000 3.984380 EXTENDED_LIMITS 0.000000 3.984375 /end CHARACTERISTIC
/begin CHARACTERISTIC FUKAVAKO "Obergrenze adaptiver öK-Korrekturfaktor VA bei kaltem Motor" VALUE 0x818FA7 ME7_FW1 0 fak_ub_b4 0.000000 3.984380 EXTENDED_LIMITS 0.000000 3.984375 /end CHARACTERISTIC
/begin CHARACTERISTIC FUKAVAKU "Untergrenze adaptiver öK-Korrekturfaktor VA bei kaltem Motor" VALUE 0x818FA8 ME7_FW1 0 fak_ub_b4 0.093750 3.984380 EXTENDED_LIMITS 0.000000 3.984375 /end CHARACTERISTIC
/begin CHARACTERISTIC FUKAVAWI "Init.-Wert adaptiver öK-Korrekturfaktor VA fÅr warmen Motor" VALUE 0x8153F6 ME7_FW1 0 fak_ub_b4 0.000000 3.984380 EXTENDED_LIMITS 0.000000 3.984375 /end CHARACTERISTIC
/begin CHARACTERISTIC FUKAVAWO "Obergrenze adaptiver öK-Korrekturfaktor VA bei warmem Motor" VALUE 0x818FA9 ME7_FW1 0 fak_ub_b4 0.000000 3.984380 EXTENDED_LIMITS 0.000000 3.984375 /end CHARACTERISTIC
/begin CHARACTERISTIC FUKAVAWU "Untergrenze adaptiver öK-Korrekturfaktor VA bei warmem Motor" VALUE 0x818FAA ME7_FW1 0 fak_ub_b4 0.093750 3.984380 EXTENDED_LIMITS 0.000000 3.984375 /end CHARACTERISTIC
/begin CHARACTERISTIC FUKE "Faktor öK-Ersatzwert" VALUE 0x811FE8 ME7_FW3 0 fak_uw_b8 0.000000 7.999880 EXTENDED_LIMITS 0.000000 7.999878 /end CHARACTERISTIC
/begin CHARACTERISTIC FUKNSTHO "Hoehenfaktor öK im Nachstart" CURVE 0x818CE2 ME7_KL97 0 fak_ub_b2 0.000000 1.992190
 /begin AXIS_DESCR STD_AXIS fho fak_ub_b4 6 0.000000 3.984380 DEPOSIT ABSOLUTE /end AXIS_DESCR
 EXTENDED_LIMITS 0.000000 1.992188 /end CHARACTERISTIC
/begin CHARACTERISTIC FUKNSTM "Startwert Faktor öK im Nachstart" CURVE 0x818CEF ME7_KL97 0 fak_ub_b4 0.000000 3.984380
 /begin AXIS_DESCR STD_AXIS tmst temp_ub_q0p75_o48 9 -48.000000 143.250000 DEPOSIT ABSOLUTE /end AXIS_DESCR
 EXTENDED_LIMITS 0.000000 3.984375 /end CHARACTERISTIC
/begin CHARACTERISTIC FUMRBRK "Faktor Umrechnung HC-Konzentration in Beladung ftead" VALUE 0x819A7A ME7_FW1 0 fak_ub_b32 0.000000 31.875000 /end CHARACTERISTIC
/begin CHARACTERISTIC FUMRMV "Faktor Dichte der Luft" VALUE 0x815E88 ME7_FW1 0 dichte_ub_b2 0.000000 1.992190 EXTENDED_LIMITS 0.000000 1.992188 /end CHARACTERISTIC
/begin CHARACTERISTIC FVANST "Gewichtungsfaktor VA im Nachstart" VALUE 0x8153EA ME7_FW1 0 fak_ub_b2 0.000000 1.992190 EXTENDED_LIMITS 0.000000 1.992188 /end CHARACTERISTIC
/begin CHARACTERISTIC FVA_AOG "oberer Grenzwert Anpassung Faktor VA" VALUE 0x815454 ME7_FW1 0 fak_ub_b2 0.000000 1.992190 EXTENDED_LIMITS 0.000000 1.992188 /end CHARACTERISTIC
/begin CHARACTERISTIC FVA_AUG "unterer Grenzwert Anpassung Faktor VA" VALUE 0x815455 ME7_FW1 0 fak_ub_b2 0.000000 1.992190 EXTENDED_LIMITS 0.000000 1.992188 /end CHARACTERISTIC
/begin CHARACTERISTIC FVDMDWAN "VerstÑrkungsfaktor zur Bildung D-Ateil-Wandlermomnet" VALUE 0x815585 ME7_FW1 0 fak_ub_b8 0.000000 7.968750 /end CHARACTERISTIC
/begin CHARACTERISTIC FVERMN "Kennlinie Faktor Vermischung Regeneriergas TankentlÅftung mit Frischluft" CURVE 0x815E24 ME7_KL97 0 fak_ub_b1 0.000000 0.996094
 /begin AXIS_DESCR STD_AXIS nmot nmot_ub_q40 6 0.000000 10200.000000 DEPOSIT ABSOLUTE /end AXIS_DESCR
/end CHARACTERISTIC
/begin CHARACTERISTIC FVERZDYN "Dynamischer Faktor Verzîgerung Regeneriergas zw. Drosselklappe, Einspritzventil" CURVE 0x813508 ME7_GKL3 0 t_min_q5p96em8 0.000000 0.003906
 /begin AXIS_DESCR COM_AXIS qmsdyn fak_ub_b16 0 0.000000 15.937500 AXIS_PTS_REF SQM05TEUB /end AXIS_DESCR
/end CHARACTERISTIC
/begin CHARACTERISTIC FVRMDYN "dynamischer Faktor Vermischung Regeneriergas TankentlÅftung mit Frischluft" CURVE 0x815E31 ME7_GKL1 0 fak_ub_b8 0.000000 7.968750
 /begin AXIS_DESCR COM_AXIS qmsdyn fak_ub_b16 0 0.000000 15.937500 AXIS_PTS_REF SQM05TEUB /end AXIS_DESCR
/end CHARACTERISTIC
/begin CHARACTERISTIC FWEAB "Rekursionskostante Wiedereinsetzfaktor abnehmend" VALUE 0x814F62 ME7_FW1 0 fak_ub_b1 0.000000 0.996094 /end CHARACTERISTIC
/begin CHARACTERISTIC FWEAUF "Rekursionskonstante Wiedereinsetzfaktor zunehmend" VALUE 0x814F63 ME7_FW1 0 fak_ub_b1 0.000000 0.996094 /end CHARACTERISTIC
/begin CHARACTERISTIC FWEMXT "maximaler Faktor Wiedereinsetzen Temperaturkennlinie" CURVE 0x8185A7 ME7_KL97 0 fak_ub_b2 1.000000 1.992190
 /begin AXIS_DESCR STD_AXIS tmot temp_ub_q0p75_o48 8 -48.000000 143.250000 DEPOSIT ABSOLUTE /end AXIS_DESCR
 EXTENDED_LIMITS 0.000000 1.992188 /end CHARACTERISTIC
/begin CHARACTERISTIC FWFN "Faktor Wandfilm Drehzahleinfluss" VALUE 0x811FEA ME7_FW4 0 rel_sw_b1p5 -1.500000 1.499950 EXTENDED_LIMITS -1.500000 1.499954 /end CHARACTERISTIC
/begin CHARACTERISTIC FWFTBRTA "Wichtung ftbr in AbhÑngigkeit von tans" CURVE 0x81864C ME7_KL97 0 fak_ub_b2 0.000000 1.992190
 /begin AXIS_DESCR STD_AXIS tempin temp_ub_q0p75_o48 14 -48.000000 143.250000 DEPOSIT ABSOLUTE /end AXIS_DESCR
 EXTENDED_LIMITS 0.000000 1.992188 /end CHARACTERISTIC
/begin CHARACTERISTIC FWL_AOG "oberer Grenzwert Anpassung Faktor Warmlauf" VALUE 0x815456 ME7_FW1 0 fak_ub_b2 0.000000 1.992190 EXTENDED_LIMITS 0.000000 1.992188 /end CHARACTERISTIC
/begin CHARACTERISTIC FWL_AUG "unterer Grenzwert Anpassung Faktor Warmlauf" VALUE 0x815457 ME7_FW1 0 fak_ub_b2 0.000000 1.992190 EXTENDED_LIMITS 0.000000 1.992188 /end CHARACTERISTIC
/begin CHARACTERISTIC FWMABGW "Faktor fÅr WÑrmemengen bei Wiederholstart Abgas" VALUE 0x8183EA ME7_FW1 0 fak_ub_b1 0.000000 0.996094 /end CHARACTERISTIC
/begin CHARACTERISTIC FWMKATW "Faktor fÅr WÑrmemengen bei Wiederholstart Kat fÅr Taupunktende" VALUE 0x8183EB ME7_FW1 0 fak_ub_b1 0.000000 0.996094 /end CHARACTERISTIC
/begin CHARACTERISTIC FWSTAA1 "Wichtung Nachstart" CURVE 0x815124 ME7_GKL1 0 fak_ub_b2 0.000000 1.992190
 /begin AXIS_DESCR COM_AXIS kstaa fak_ub_b2 0 0.000000 1.992190 AXIS_PTS_REF SKS06ESUB /end AXIS_DESCR
 EXTENDED_LIMITS 0.000000 1.992188 /end CHARACTERISTIC
/begin CHARACTERISTIC FWSTAA2 "Wichtung Nachstart Umschaltschwelle" CURVE 0x81512A ME7_GKL1 0 fak_ub_b2 0.000000 1.992190
 /begin AXIS_DESCR COM_AXIS kstaa fak_ub_b2 0 0.000000 1.992190 AXIS_PTS_REF SKS06ESUB /end AXIS_DESCR
 EXTENDED_LIMITS 0.000000 1.992188 /end CHARACTERISTIC
/begin CHARACTERISTIC FWSTAA3 "Wichtung Nachstart Abregelung Bereich 1" CURVE 0x815130 ME7_GKL1 0 fak_ub_b2 0.000000 1.992190
 /begin AXIS_DESCR COM_AXIS kstaa fak_ub_b2 0 0.000000 1.992190 AXIS_PTS_REF SKS06ESUB /end AXIS_DESCR
 EXTENDED_LIMITS 0.000000 1.992188 /end CHARACTERISTIC
/begin CHARACTERISTIC FWSTAA4 "Wichtung Nachstart Abregelung Bereich 2" CURVE 0x815136 ME7_GKL1 0 fak_ub_b2 0.000000 1.992190
 /begin AXIS_DESCR COM_AXIS kstaa fak_ub_b2 0 0.000000 1.992190 AXIS_PTS_REF SKS06ESUB /end AXIS_DESCR
 EXTENDED_LIMITS 0.000000 1.992188 /end CHARACTERISTIC
/begin CHARACTERISTIC FZANSSA1 "Faktor fÅr zÅndsynchrone Abregelung des Nachstartfaktors bei Hei·start Bereich 1" CURVE 0x8189E5 ME7_GKL1 0 fak_ub_b0p25 0.000000 0.249023
 /begin AXIS_DESCR COM_AXIS tans temp_ub_q0p75_o48 0 -48.000000 143.250000 AXIS_PTS_REF STA06ESUB /end AXIS_DESCR
/end CHARACTERISTIC
/begin CHARACTERISTIC FZANSSA2 "Faktor fÅr zÅndsynchrone Abregelung des Nachstartfaktors bei Hei·start Bereich 2" CURVE 0x8189EB ME7_GKL1 0 fak_ub_b0p25 0.000000 0.249023
 /begin AXIS_DESCR COM_AXIS tans temp_ub_q0p75_o48 0 -48.000000 143.250000 AXIS_PTS_REF STA06ESUB /end AXIS_DESCR
/end CHARACTERISTIC
/begin CHARACTERISTIC FZANSSM1 "Faktor fÅr zÅndsynchrone Abregelung des Nachstartfaktors oberhalb Schwelle" CURVE 0x8189F1 ME7_GKL1 0 fak_ub_b0p25 0.000000 0.249023
 /begin AXIS_DESCR COM_AXIS tmst temp_ub_q0p75_o48 0 -48.000000 143.250000 AXIS_PTS_REF STS14ESUB /end AXIS_DESCR
/end CHARACTERISTIC
/begin CHARACTERISTIC FZANSSM2 "Faktor fÅr zÅndsynchrone Abregelung des Nachstartfaktors unterhalb Schwelle" CURVE 0x8189FF ME7_GKL1 0 fak_ub_b0p25 0.000000 0.249023
 /begin AXIS_DESCR COM_AXIS tmst temp_ub_q0p75_o48 0 -48.000000 143.250000 AXIS_PTS_REF STS14ESUB /end AXIS_DESCR
/end CHARACTERISTIC
/begin CHARACTERISTIC FZN0 "Zylinderindividueller Faktor bei neutraler NW-Stellung EV 1" CURVE 0x814F64 ME7_GKL1 0 fak_ub_b2 0.000000 1.992190
 /begin AXIS_DESCR COM_AXIS nmot nmot_ub_q40 0 0.000000 10200.000000 AXIS_PTS_REF SNM16CIUB /end AXIS_DESCR
 EXTENDED_LIMITS 0.000000 1.992188 /end CHARACTERISTIC
/begin CHARACTERISTIC FZN1 "Zylinderindividueller Faktor bei neutraler NW-Stellung EV 1" CURVE 0x814F74 ME7_GKL1 0 fak_ub_b2 0.000000 1.992190
 /begin AXIS_DESCR COM_AXIS nmot nmot_ub_q40 0 0.000000 10200.000000 AXIS_PTS_REF SNM16CIUB /end AXIS_DESCR
 EXTENDED_LIMITS 0.000000 1.992188 /end CHARACTERISTIC
/begin CHARACTERISTIC FZN2 "Zylinderindividueller Faktor bei neutraler NW-Stellung EV 2" CURVE 0x814F84 ME7_GKL1 0 fak_ub_b2 0.000000 1.992190
 /begin AXIS_DESCR COM_AXIS nmot nmot_ub_q40 0 0.000000 10200.000000 AXIS_PTS_REF SNM16CIUB /end AXIS_DESCR
 EXTENDED_LIMITS 0.000000 1.992188 /end CHARACTERISTIC
/begin CHARACTERISTIC FZN3 "Zylinderindividueller Faktor bei neutraler NW-Stellung EV 3" CURVE 0x814F94 ME7_GKL1 0 fak_ub_b2 0.000000 1.992190
 /begin AXIS_DESCR COM_AXIS nmot nmot_ub_q40 0 0.000000 10200.000000 AXIS_PTS_REF SNM16CIUB /end AXIS_DESCR
 EXTENDED_LIMITS 0.000000 1.992188 /end CHARACTERISTIC
/begin CHARACTERISTIC FZNWN0 "Zylinderindividueller Faktor bei aktiver NW-Stellung EV 1" CURVE 0x814FA4 ME7_GKL1 0 fak_ub_b2 0.000000 1.992190
 /begin AXIS_DESCR COM_AXIS nmot nmot_ub_q40 0 0.000000 10200.000000 AXIS_PTS_REF SNM16CIUB /end AXIS_DESCR
 EXTENDED_LIMITS 0.000000 1.992188 /end CHARACTERISTIC
/begin CHARACTERISTIC FZNWN1 "Zylinderindividueller Faktor bei aktiver NW-Stellung EV 1" CURVE 0x814FB4 ME7_GKL1 0 fak_ub_b2 0.000000 1.992190
 /begin AXIS_DESCR COM_AXIS nmot nmot_ub_q40 0 0.000000 10200.000000 AXIS_PTS_REF SNM16CIUB /end AXIS_DESCR
 EXTENDED_LIMITS 0.000000 1.992188 /end CHARACTERISTIC
/begin CHARACTERISTIC FZNWN2 "Zylinderindividueller Faktor bei aktiver NW-Stellung EV 2" CURVE 0x814FC4 ME7_GKL1 0 fak_ub_b2 0.000000 1.992190
 /begin AXIS_DESCR COM_AXIS nmot nmot_ub_q40 0 0.000000 10200.000000 AXIS_PTS_REF SNM16CIUB /end AXIS_DESCR
 EXTENDED_LIMITS 0.000000 1.992188 /end CHARACTERISTIC
/begin CHARACTERISTIC FZNWN3 "Zylinderindividueller Faktor bei aktiver NW-Stellung EV 3" CURVE 0x814FD4 ME7_GKL1 0 fak_ub_b2 0.000000 1.992190
 /begin AXIS_DESCR COM_AXIS nmot nmot_ub_q40 0 0.000000 10200.000000 AXIS_PTS_REF SNM16CIUB /end AXIS_DESCR
 EXTENDED_LIMITS 0.000000 1.992188 /end CHARACTERISTIC
/begin CHARACTERISTIC FZWSTNM "ZÅndwinkel im Start" CURVE 0x81397E ME7_KL98 0 zw_sb_q0p75 -96.000000 95.250000
 /begin AXIS_DESCR STD_AXIS nmot nmot_ub_q40 6 0.000000 10200.000000 DEPOSIT ABSOLUTE /end AXIS_DESCR
/end CHARACTERISTIC
/begin CHARACTERISTIC FZWSTTM "ZÅndwinkel im Start" CURVE 0x81EBA0 ME7_KL98 0 zw_sb_q0p75 -96.000000 95.250000
 /begin AXIS_DESCR STD_AXIS tmst temp_ub_q0p75_o48 6 -48.000000 143.250000 DEPOSIT ABSOLUTE /end AXIS_DESCR
/end CHARACTERISTIC
/begin CHARACTERISTIC FZWWLRLN "Wichtung Delta-ZÅndwinkel im Warmlauf" MAP 0x8161EE ME7_GKF1 0 fak_ub_b2 0.000000 1.992190
 /begin AXIS_DESCR COM_AXIS nmot nmot_ub_q40 0 0.000000 10200.000000 AXIS_PTS_REF SNM12ESUB /end AXIS_DESCR
 /begin AXIS_DESCR COM_AXIS rl rel_ub_q0p75 0 0.000000 191.250000 AXIS_PTS_REF SRL06ESUB /end AXIS_DESCR
 EXTENDED_LIMITS 0.000000 1.992188 /end CHARACTERISTIC
/begin RECORD_LAYOUT ME7_GKF1 FNC_VALUES 1 UBYTE COLUMN_DIR DIRECT /end RECORD_LAYOUT
/begin CHARACTERISTIC GAFGRO_0_A "Max. zul. Gang bei FGR-Betrieb" VALUE 0x81700C ME7_FW1 0 dez 0.000000 255.000000 /end CHARACTERISTIC
/begin CHARACTERISTIC GAFGRO_1_A "Max. zul. Gang bei FGR-Betrieb" VALUE 0x81700D ME7_FW1 0 dez 0.000000 255.000000 /end CHARACTERISTIC
/begin CHARACTERISTIC GAFGRU "Min. zul. Gang bei FGR-Betrieb" VALUE 0x814FEC ME7_FW1 0 dez 0.000000 255.000000 /end CHARACTERISTIC
/begin CHARACTERISTIC GFDLDN "LLR: Gewichtungsfaktor fÅr D-VerstÑrkung auf Luftpfad" CURVE 0x815694 ME7_GKL1 0 rel_ub_b1p0 0.000000 0.996094
 /begin AXIS_DESCR COM_AXIS dns nmotd_sb_q10 0 -1280.000000 1270.000000 AXIS_PTS_REF SNS06LLSB /end AXIS_DESCR
/end CHARACTERISTIC
/begin CHARACTERISTIC GRAOFLOGIN "Login-Code fÅr GRA sperren" VALUE 0x812262 ME7_FW3 0 dez___UW 0.000000 65535.000000 /end CHARACTERISTIC
/begin CHARACTERISTIC GRAONLOGIN "Login-Code fÅr GRA freischalten" VALUE 0x812264 ME7_FW3 0 dez___UW 0.000000 65535.000000 /end CHARACTERISTIC
/begin CHARACTERISTIC GWPLDOB "Gradient Pedalwinkel zum Ausloesen des Overboost" VALUE 0x8194C0 ME7_FW1 0 rel_ub_q8 0.000000 2000.000000 EXTENDED_LIMITS 0.000000 2040.000000 /end CHARACTERISTIC
/begin CHARACTERISTIC GWPLDU "Gradientenschwelle pedal fÅr dynamische Freigabe Umluftventilsteuerung" VALUE 0x815484 ME7_FW2 0 rel_sb_q0p39 -49.996800 49.606200 /end CHARACTERISTIC
/begin CHARACTERISTIC GWPLDUR "Gradient Pedalwert fÅr Reset LDR Umluftventilansteuerung dynamisch" VALUE 0x815485 ME7_FW2 0 rel_sb_q0p39 -49.996800 49.606200 /end CHARACTERISTIC
/begin CHARACTERISTIC HLDPU "Untere Hîhenschwelle fÅr Leckdiagnosemodul" VALUE 0x819C42 ME7_FW1 0 fak_ub_b4 0.000000 3.984380 EXTENDED_LIMITS 0.000000 3.984375 /end CHARACTERISTIC
/begin CHARACTERISTIC HSLDSUA "Hysterese fÅr stationÑre Schubumluftventilansteuerung" VALUE 0x815486 ME7_FW1 0 p_ub_q10 0.000000 2550.000000 /end CHARACTERISTIC
/begin CHARACTERISTIC HSSLDSUA "Hysterese zum Schlie·en der Turbo Umluftventile im StationÑrpfad" VALUE 0x815487 ME7_FW1 0 fak_ub_b4 0.000000 3.984380 EXTENDED_LIMITS 0.000000 3.984375 /end CHARACTERISTIC
/begin CHARACTERISTIC IGESGA "Gesamt-öbersetzungsverhÑltnis" CURVE 0x814DAB ME7_FKL1 0 fak_q0p1 0.000000 25.500000
 /begin AXIS_DESCR FIX_AXIS gangi dez___SL 8 0.000000 7.000000 FIX_AXIS_PAR 0 0 8 /end AXIS_DESCR
/end CHARACTERISTIC
/begin CHARACTERISTIC ILMLKAXTK "Schwelle FettflÑche Kat-AusrÑumen nach SA f(tkatm)" CURVE 0x81EA32 ZF_KL111 0 m_uw_b4660 0.000000 4660.270000
 /begin AXIS_DESCR STD_AXIS tkatm_w temp_uw_q0p0195_o50 5 -50.000000 1229.980000 DEPOSIT ABSOLUTE /end AXIS_DESCR
 EXTENDED_LIMITS 0.000000 4660.266667 /end CHARACTERISTIC
/begin CHARACTERISTIC ILMRMN "Minimalwert des Luftmassenreglers" VALUE 0x8119CC ME7_FW4 0 rel_sw_q0p0234 -768.000000 767.977000 EXTENDED_LIMITS -768.000000 767.976562 /end CHARACTERISTIC
/begin CHARACTERISTIC ILMRMX "Maximalwert des Luftmassenreglers" VALUE 0x8119CE ME7_FW4 0 rel_sw_q0p0234 -768.000000 767.977000 EXTENDED_LIMITS -768.000000 767.976562 /end CHARACTERISTIC
/begin CHARACTERISTIC ILMRN "IntegratorverstÑrkung von Luftmassenregler" CURVE 0x818754 ME7_GKL1 0 fak_ub_b8 0.000000 7.968750
 /begin AXIS_DESCR COM_AXIS nmot nmot_ub_q40 0 0.000000 10200.000000 AXIS_PTS_REF SNM08FEUB /end AXIS_DESCR
/end CHARACTERISTIC
/begin CHARACTERISTIC IMLAKMN "" VALUE 0x8136CE ME7_FW3 0 m_uw_b4660 0.000000 4660.270000 EXTENDED_LIMITS 0.000000 4660.266667 /end CHARACTERISTIC
/begin CHARACTERISTIC IMLATDSL "min. Luftmassenflu· fÅr Adaption/Zusatzdiagnose" VALUE 0x81A11A ME7_FW3 0 m_uw_b23p3 0.000000 23.301300 EXTENDED_LIMITS 0.000000 23.301333 /end CHARACTERISTIC
/begin CHARACTERISTIC IMLATDSLK "min. Luftmassenflu· fÅr Kurztest" VALUE 0x81A11C ME7_FW3 0 m_uw_b23p3 0.000000 23.301300 EXTENDED_LIMITS 0.000000 23.301333 /end CHARACTERISTIC
/begin CHARACTERISTIC IMLATWS "Luftmassen-Schwelle fÅr Kat-Heizen nach Wiederholstart" VALUE 0x81BB68 ME7_FW3 0 m_uw_b23p3 0.000000 23.301300 EXTENDED_LIMITS 0.000000 23.301333 /end CHARACTERISTIC
/begin CHARACTERISTIC IMLDSL "minimale durchgestrîmte Luftmasse" VALUE 0x818373 ME7_FW1 0 fak_ub_b1 0.000000 0.996094 /end CHARACTERISTIC
/begin CHARACTERISTIC IMLHS "Luftmassenintegral Hei·start" VALUE 0x815248 ME7_FW1 0 m_ub_b23p3 0.000000 23.210700 EXTENDED_LIMITS 0.000000 23.210667 /end CHARACTERISTIC
/begin CHARACTERISTIC IMLKAXTK "Schwellwert f(tkatm_w) integr. Luftmasse f. Abbruch Katalysator-AusrÑumen" CURVE 0x81EA48 ZF_KL111 0 m_uw_b4660 0.000000 4660.270000
 /begin AXIS_DESCR STD_AXIS tkatm_w temp_uw_q0p0195_o50 5 -50.000000 1229.980000 DEPOSIT ABSOLUTE /end AXIS_DESCR
 EXTENDED_LIMITS 0.000000 4660.266667 /end CHARACTERISTIC
/begin CHARACTERISTIC IMLKHMX "max. VerhÑltnisfaktor psum_w/mlsu fÅr Einschaltung Katheizen" VALUE 0x819032 ME7_FW1 0 fak_ub_b1 0.000000 0.996094 /end CHARACTERISTIC
/begin CHARACTERISTIC IMLKHTMS "imlpr-Schwelle fÅr öbergang auf Lambda-Katheizen" CURVE 0x812058 ME7_KL97 0 fak_ub_b1 0.000000 0.996094
 /begin AXIS_DESCR STD_AXIS tmst temp_ub_q0p75_o48 8 -48.000000 143.250000 DEPOSIT ABSOLUTE /end AXIS_DESCR
/end CHARACTERISTIC
/begin CHARACTERISTIC IMLKVSMX "Maximale Integrationsschwelle fÅr Fehlerfreigabe in DKVS (Tank leer)" VALUE 0x81BA0E ME7_FW3 0 m_q0p00355 0.000000 233.013000 EXTENDED_LIMITS 0.000000 233.013333 /end CHARACTERISTIC
/begin CHARACTERISTIC IMLLASKH "imlpr-Schwelle fÅr öbergang auf Lambda-Abgas-Vorgabe" VALUE 0x8190A1 ME7_FW1 0 fak_ub_b1 0.000000 0.996094 /end CHARACTERISTIC
/begin CHARACTERISTIC IMLSALR "Schwellwert integr. Luftmasse f. Einschaltverzîgerung LR nach SA" VALUE 0x8136A0 ME7_FW3 0 m_uw_b4660 0.000000 4660.270000 EXTENDED_LIMITS 0.000000 4660.266667 /end CHARACTERISTIC
/begin CHARACTERISTIC IMLSLMN "min. VerhÑltnisfaktor psum_w/mlsu fÅr Einschaltung SLS" VALUE 0x8182EF ME7_FW1 0 fak_ub_b1 0.000000 0.996094 /end CHARACTERISTIC
/begin CHARACTERISTIC IMLSLMX "max. VerhÑltnisfaktor psum_w/mlsu fÅr Einschaltung SLS" VALUE 0x8182F0 ME7_FW1 0 fak_ub_b1 0.000000 0.996094 /end CHARACTERISTIC
/begin CHARACTERISTIC IMLSLSA "Schwelle Luftmassenintegral fÅr Anfang SekundÑrluft im Abgas" VALUE 0x81A110 ME7_FW3 0 m_uw_b4660 0.000000 4660.270000 EXTENDED_LIMITS 0.000000 4660.266667 /end CHARACTERISTIC
/begin CHARACTERISTIC IMLSLSE "Schwelle Luftmassenintegral fÅr Ende SekundÑrluft im Abgas" VALUE 0x81A112 ME7_FW3 0 m_uw_b4660 0.000000 4660.270000 EXTENDED_LIMITS 0.000000 4660.266667 /end CHARACTERISTIC
/begin CHARACTERISTIC IMSDTEVA "Schwelle fÅr Intergal des Massenstroms TEV nach lÑngerm TE-Stop" VALUE 0x819BD5 ME7_FW1 0 m_ub_q0p0444 0.000000 11.322000 /end CHARACTERISTIC
/begin CHARACTERISTIC IMSLADAP "Schwelle Luftmassenintegral fÅr Wiederholung Adaption" VALUE 0x81A11E ME7_FW3 0 m_uw_b4660 0.000000 4660.270000 EXTENDED_LIMITS 0.000000 4660.266667 /end CHARACTERISTIC
/begin CHARACTERISTIC IMTUMTA "Schwelle integrierte Luftmasse fÅr Bestimmung Umgebungstemperatur" VALUE 0x818E11 ME7_FW1 0 m_ub_b23p3 0.000000 23.210700 EXTENDED_LIMITS 0.000000 23.210667 /end CHARACTERISTIC
/begin CHARACTERISTIC IMTUMTAT "Schwelle integrierte Luftmasse fÅr Bestimmung Umgebungstemperatur aus TANS" VALUE 0x8183EC ME7_FW1 0 m_ub_b23p3 0.000000 23.210700 EXTENDED_LIMITS 0.000000 23.210667 /end CHARACTERISTIC
/begin CHARACTERISTIC INCKSTAI "Inkrement-Step fÅr STADAP-Faktor" CURVE 0x8151ED ME7_KL98 0 fak_sb_b1 0.000000 0.992188 /begin AXIS_DESCR STD_AXIS tmadb dez 3 0.000000 255.000000 DEPOSIT ABSOLUTE /end AXIS_DESCR EXTENDED_LIMITS -1.000000 0.992188 /end CHARACTERISTIC
/begin CHARACTERISTIC IP1A_MX_UM "max. Spannung fÅr DK-Istwert-Poti 1 am unteren Anschlag fÅr die FunktionsÅberw." VALUE 0x81400E ME7_FW1 0 spg_ub_q0p019 0.000000 4.980470 EXTENDED_LIMITS 0.000000 4.980469 /end CHARACTERISTIC
/begin CHARACTERISTIC IP2A_MN_UM "min. Spannung fÅr DK-Istwert-Poti 2 am unteren Anschlag fÅr die FunktionsÅberw." VALUE 0x81400F ME7_FW1 0 spg_ub_q0p019 0.000000 4.980470 EXTENDED_LIMITS 0.000000 4.980469 /end CHARACTERISTIC
/begin CHARACTERISTIC IPA_T_UM "Fehlertoleranzzeit fÅr unteren DK-Anschlag im ungÅltigen Bereich f. d. FktÅberw." VALUE 0x814010 ME7_FW1 0 t40ms_ub_b10200 0.000000 10200.000000 /end CHARACTERISTIC
/begin CHARACTERISTIC ITNMAXP "Zeitdauer fÅr aktive alternative Abstimmung der Drehzahlbegrenzung" VALUE 0x813458 ME7_FW3 0 t10msxs_uw_b655p35 0.000000 10.240000 EXTENDED_LIMITS 0.000000 655.350000 /end CHARACTERISTIC
/begin CHARACTERISTIC ITNMXH "Verweilzeit unterhalb unterer Drehzahlgrenze vor Aktivierung der oberen Grenze" VALUE 0x81345A ME7_FW3 0 t10msxs_uw_b655p35 0.000000 655.350000 /end CHARACTERISTIC
/begin CHARACTERISTIC IVDN "LLR: I-VerstÑrkung bei stehendem Fahrzeug" CURVE 0x81569A ME7_GKL1 0 rel_q0p002383 0.000000 0.607617
 /begin AXIS_DESCR COM_AXIS dn nmotd_sb_q10 0 -1280.000000 1270.000000 AXIS_PTS_REF SDN06LLSB /end AXIS_DESCR
/end CHARACTERISTIC
/begin CHARACTERISTIC IVDNDTE "LLR: I-VerstÑrkung bei DTEV" CURVE 0x8156A0 ME7_GKL1 0 rel_q0p002383 0.000000 0.607617
 /begin AXIS_DESCR COM_AXIS dn nmotd_sb_q10 0 -1280.000000 1270.000000 AXIS_PTS_REF SDN06LLSB /end AXIS_DESCR
/end CHARACTERISTIC
/begin CHARACTERISTIC IVDNV "LLR: I-VerstÑrkung bei rollendem Fahrzeug" CURVE 0x8156A6 ME7_GKL1 0 rel_q0p002383 0.000000 0.607617
 /begin AXIS_DESCR COM_AXIS dn nmotd_sb_q10 0 -1280.000000 1270.000000 AXIS_PTS_REF SDN06LLSB /end AXIS_DESCR
/end CHARACTERISTIC
/begin CHARACTERISTIC KAMFZ_0_A "Segment- bzw. Messfensterbeginn bei Segmentzeiterfassung Aussetzererkennung" VALUE 0x81A0C8 ME7_FW2 0 kw_q6___SB -768.000000 762.000000 /end CHARACTERISTIC
/begin CHARACTERISTIC KAMFZ_1_A "Segment- bzw. Messfensterbeginn bei Segmentzeiterfassung Aussetzererkennung" VALUE 0x81A0C9 ME7_FW2 0 kw_q6___SB -768.000000 762.000000 /end CHARACTERISTIC
/begin CHARACTERISTIC KATBFML "Filterzeitkonstante fÅr SignaldÑmpfung in Katbelastung" CURVE 0x814D7D ME7_GKL1 0 zk50msxs_ub_b12p8 0.050196 12.800000
 /begin AXIS_DESCR COM_AXIS ml m_ub_b1020 0 0.000000 1020.000000 AXIS_PTS_REF SML05DKUB /end AXIS_DESCR
/end CHARACTERISTIC
/begin CHARACTERISTIC KATBFMN "Schwellwert fÅr kleine Katalysatorbelastung" VALUE 0x8184D8 ME7_FW1 0 fak_ub_b1 0.000000 0.996094 /end CHARACTERISTIC
/begin CHARACTERISTIC KATBFMNT "Schwellwert fÅr kleine Katalysatorbelastung bei Testeransteuerung" VALUE 0x8184D9 ME7_FW1 0 fak_ub_b1 0.000000 0.996094 /end CHARACTERISTIC
/begin CHARACTERISTIC KATBFN "normierter Mittelwert der Sondenamplitude" VALUE 0x8184DA ME7_FW1 0 fak_ub_b1 0.000000 0.996094 /end CHARACTERISTIC
/begin CHARACTERISTIC KATBFNM "Normierungsfaktor multiplikativ fÅr Katbelastung" VALUE 0x8184DB ME7_FW1 0 spg_ub_b1p33 0.000000 1.330000 /end CHARACTERISTIC
/begin CHARACTERISTIC KATBFNP "Normierungsfaktor additiv fÅr Katbelastung" VALUE 0x8184DC ME7_FW1 0 spg_ub_b1p33 0.000000 1.330000 /end CHARACTERISTIC
/begin CHARACTERISTIC KATBFSX "Max. Integrationsschwelle fÅr Stoppbedingung" VALUE 0x8184DD ME7_FW2 0 fak_sb_b1 -1.000000 0.992188 /end CHARACTERISTIC
/begin CHARACTERISTIC KATBFXM "Maximale Katbelastungsschwelle fÅr Stoppbedingung" CURVE 0x810BE0 ME7_GKL4 0 freq_sw_b512 -512.000000 511.984000
 /begin AXIS_DESCR COM_AXIS ml m_ub_b1020 0 0.000000 1020.000000 AXIS_PTS_REF SML05DKUB /end AXIS_DESCR
 EXTENDED_LIMITS -512.000000 511.984375 /end CHARACTERISTIC
/begin RECORD_LAYOUT ME7_GKL4 FNC_VALUES 1 SWORD COLUMN_DIR DIRECT /end RECORD_LAYOUT
/begin CHARACTERISTIC KATBSG "Katalysatorspeichergrî·e fÅr Katbelastung" VALUE 0x8184DE ME7_FW1 0 m_ub_b221p35 0.868056 221.354000 EXTENDED_LIMITS 0.000000 221.354167 /end CHARACTERISTIC
/begin CHARACTERISTIC KATBSH "Offset fÅr Lambdaregelung leicht im fetten Bereich" VALUE 0x8184DF ME7_FW1 0 mgrad_ub_b221p35 0.000000 221.354000 EXTENDED_LIMITS 0.000000 221.354167 /end CHARACTERISTIC
/begin CHARACTERISTIC KATBSHF "VerstÑrkungsfaktor fÅr Regellagendifferenz" VALUE 0x81AD66 ME7_FW3 0 mgrad_uw_q0p0961 0.000000 9996.310000 EXTENDED_LIMITS 0.000000 681694.136747 /end CHARACTERISTIC
/begin CHARACTERISTIC KATBSHG "Begrenzungsfaktor der Regellagenkorrektur" VALUE 0x8184E0 ME7_FW1 0 fak_ub_b1 0.000000 0.996094 /end CHARACTERISTIC
/begin CHARACTERISTIC KATMEXML "Exotherme Temperatur im KAT" CURVE 0x8183ED ME7_GKL2 0 temp_q5 -640.000000 635.000000
 /begin AXIS_DESCR COM_AXIS ml_w m_uw_b6553p5 0 0.000000 6553.500000 AXIS_PTS_REF SML07TMUW /end AXIS_DESCR
/end CHARACTERISTIC
/begin CHARACTERISTIC KD "BA Normierungsfaktor (DRIVE)" VALUE 0x819FC3 ME7_FW1 0 dez 0.000000 255.000000 /end CHARACTERISTIC
/begin CHARACTERISTIC KDLASHKI "Kennlinie Åber dlashkm, Bewertungsfaktor fÅr I-Anteil in der LRHK" CURVE 0x81EA72 ZF_KL118 0 fak_sw_b1 -1.000000 0.999969
 /begin AXIS_DESCR STD_AXIS idlashkm_w fak_sw_b1 10 -1.000000 0.999969 DEPOSIT ABSOLUTE /end AXIS_DESCR
/end CHARACTERISTIC
/begin CHARACTERISTIC KDLASHKP "Kennlinie Åber dlashkm, Bewertungsfaktor fÅr P-Anteil in der LRHK" CURVE 0x81EA9C ZF_KL118 0 fak_sw_b1 -1.000000 0.999969
 /begin AXIS_DESCR STD_AXIS idlashkm_w fak_sw_b1 10 -1.000000 0.999969 DEPOSIT ABSOLUTE /end AXIS_DESCR
/end CHARACTERISTIC
/begin CHARACTERISTIC KDLRIDDVE "Identifizierung des DLR-Parametersatzes zu DV-E-Typ" VALUE 0x8185A1 ME7_FW1 0 dez 0.000000 255.000000 /end CHARACTERISTIC
/begin CHARACTERISTIC KEMLN "MessfensterlÑnge fÅr Klopfregelung" CURVE 0x819165 ME7_GKL1 0 zw_ub_q0p75 0.000000 191.250000
 /begin AXIS_DESCR COM_AXIS nmot nmot_ub_q40 0 0.000000 10200.000000 AXIS_PTS_REF SNM16KRUB /end AXIS_DESCR
/end CHARACTERISTIC
/begin CHARACTERISTIC KFABAK "Aufteilungsfaktor Wandfilm bei BA" MAP 0x818D02 ME7_GKF1 0 fak_ub_b1 0.000000 0.996094
 /begin AXIS_DESCR COM_AXIS tmot temp_ub_q0p75_o48 0 -48.000000 143.250000 AXIS_PTS_REF STM09ESUB /end AXIS_DESCR
 /begin AXIS_DESCR COM_AXIS nmot nmot_ub_q40 0 0.000000 10200.000000 AXIS_PTS_REF SNM07ESUB /end AXIS_DESCR
/end CHARACTERISTIC
/begin CHARACTERISTIC KFAMAL_0_A "Kennfeld Absenkungsfaktor fÅr Lur-Wert bei erkannten Mehrfachaussetzern" MAP 0x814817 ME7_GKF1 0 fak_ub_b1 0.000000 0.996094
 /begin AXIS_DESCR COM_AXIS rl rel_ub_q0p75 0 0.000000 191.250000 AXIS_PTS_REF SRL08DMUB /end AXIS_DESCR
 /begin AXIS_DESCR COM_AXIS nmot nmot_ub_q40 0 0.000000 10200.000000 AXIS_PTS_REF SNM08DMUB /end AXIS_DESCR
/end CHARACTERISTIC
/begin CHARACTERISTIC KFAMAL_1_A "Kennfeld Absenkungsfaktor fÅr Lur-Wert bei erkannten Mehrfachaussetzern" MAP 0x814857 ME7_GKF1 0 fak_ub_b1 0.000000 0.996094
 /begin AXIS_DESCR COM_AXIS rl rel_ub_q0p75 0 0.000000 191.250000 AXIS_PTS_REF SRL08DMUB /end AXIS_DESCR
 /begin AXIS_DESCR COM_AXIS nmot nmot_ub_q40 0 0.000000 10200.000000 AXIS_PTS_REF SNM08DMUB /end AXIS_DESCR
/end CHARACTERISTIC
/begin CHARACTERISTIC KFATMLA "Kennfeld Abgastemperatur-Korrektur = f(Lambda)" MAP 0x8183F4 ME7_GKF2 0 temp_q5 -640.000000 635.000000
 /begin AXIS_DESCR COM_AXIS ml m_ub_b1020 0 0.000000 1020.000000 AXIS_PTS_REF SML06TMUB /end AXIS_DESCR
 /begin AXIS_DESCR COM_AXIS lamsbg_w fak_uw_b16 0 0.000000 15.999800 AXIS_PTS_REF SLX06TMUW /end AXIS_DESCR
/end CHARACTERISTIC
/begin RECORD_LAYOUT ME7_GKF2 FNC_VALUES 1 SBYTE COLUMN_DIR DIRECT /end RECORD_LAYOUT
/begin CHARACTERISTIC KFATMZW "Kennfeld Abgastemperatur-Korrektur = f(ZÅndwinkelverstellung)" MAP 0x818418 ME7_GKF2 0 temp_q5 -640.000000 635.000000
 /begin AXIS_DESCR COM_AXIS ml m_ub_b1020 0 0.000000 1020.000000 AXIS_PTS_REF SML06TMUB /end AXIS_DESCR
 /begin AXIS_DESCR COM_AXIS etazwimt rel_ub_b127p5 0 0.000000 127.500000 AXIS_PTS_REF SEZ06TMUB /end AXIS_DESCR
/end CHARACTERISTIC
/begin CHARACTERISTIC KFAVAK "Aufteilungsfaktor Wandfilm bei VA" MAP 0x818D41 ME7_GKF1 0 fak_ub_b1 0.000000 0.996094
 /begin AXIS_DESCR COM_AXIS tmot temp_ub_q0p75_o48 0 -48.000000 143.250000 AXIS_PTS_REF STM09ESUB /end AXIS_DESCR
 /begin AXIS_DESCR COM_AXIS nmot nmot_ub_q40 0 0.000000 10200.000000 AXIS_PTS_REF SNM07ESUB /end AXIS_DESCR
/end CHARACTERISTIC
/begin CHARACTERISTIC KFBAKL "Faktor Beschleunigungsanreicherung (K+L-Anteil)" MAP 0x818D80 ME7_GKF1 0 fak_ub_b16 0.000000 15.937500
 /begin AXIS_DESCR COM_AXIS tmot temp_ub_q0p75_o48 0 -48.000000 143.250000 AXIS_PTS_REF STM09ESUB /end AXIS_DESCR
 /begin AXIS_DESCR COM_AXIS nmot nmot_ub_q40 0 0.000000 10200.000000 AXIS_PTS_REF SNM07ESUB /end AXIS_DESCR
/end CHARACTERISTIC
/begin CHARACTERISTIC KFBS "Kennfeld fÅr banksel. Gemischfaktor" MAP 0x811EC2 ME7_KF290 0 fak_sb_b0p25 -0.250000 0.248047
 /begin AXIS_DESCR STD_AXIS nmot nmot_ub_q40 8 0.000000 10200.000000 DEPOSIT ABSOLUTE /end AXIS_DESCR
 /begin AXIS_DESCR STD_AXIS rl rel_ub_q0p75 8 0.000000 191.250000 DEPOSIT ABSOLUTE /end AXIS_DESCR
/end CHARACTERISTIC
/begin RECORD_LAYOUT ME7_KF290 NO_AXIS_PTS_X 1 UBYTE NO_AXIS_PTS_Y 2 UBYTE AXIS_PTS_X 3 UBYTE INDEX_INCR DIRECT AXIS_PTS_Y 4 UBYTE INDEX_INCR DIRECT FNC_VALUES 5 SBYTE COLUMN_DIR DIRECT /end RECORD_LAYOUT
/begin CHARACTERISTIC KFCFO "Kennfeld zur Definition der Bereichseigenschaften (dominant..)" MAP 0x81450D ME7_GKF1 0 dez 0.000000 255.000000
 /begin AXIS_DESCR COM_AXIS rl rel_ub_q0p75 0 0.000000 191.250000 AXIS_PTS_REF SDZ03DMUB /end AXIS_DESCR
 /begin AXIS_DESCR COM_AXIS nmot nmot_ub_q40 0 0.000000 10200.000000 AXIS_PTS_REF SDZ08DMUB /end AXIS_DESCR
/end CHARACTERISTIC
/begin CHARACTERISTIC KFCFO2 "Kennfeld zur Definition der Bereichseigenschaften (dominant..)" MAP 0x814525 ME7_GKF1 0 dez 0.000000 255.000000
 /begin AXIS_DESCR COM_AXIS rl rel_ub_q0p75 0 0.000000 191.250000 AXIS_PTS_REF SDZ03DMUB2 /end AXIS_DESCR
 /begin AXIS_DESCR COM_AXIS nmot nmot_ub_q40 0 0.000000 10200.000000 AXIS_PTS_REF SDZ08DMUB2 /end AXIS_DESCR
/end CHARACTERISTIC
/begin CHARACTERISTIC KFDETATE "ZÅndwinkelwirkungsgrad Korrektur for DTEV" MAP 0x819BD6 ME7_KF289 0 rel_ub_b127p5 0.000000 127.500000
 /begin AXIS_DESCR STD_AXIS etazwist rel_ub_b127p5 4 0.000000 127.500000 DEPOSIT ABSOLUTE /end AXIS_DESCR
 /begin AXIS_DESCR STD_AXIS dmletanu m_q0p1 6 0.000000 25.500000 DEPOSIT ABSOLUTE /end AXIS_DESCR
/end CHARACTERISTIC
/begin RECORD_LAYOUT ME7_KF289 NO_AXIS_PTS_X 1 UBYTE NO_AXIS_PTS_Y 2 UBYTE AXIS_PTS_X 3 UBYTE INDEX_INCR DIRECT AXIS_PTS_Y 4 UBYTE INDEX_INCR DIRECT FNC_VALUES 5 UBYTE COLUMN_DIR DIRECT /end RECORD_LAYOUT
/begin CHARACTERISTIC KFDLSD_0_A "DÑmpfung PT2-Filter LastschlagdÑmpfung" MAP 0x81CF9A ME7_GKF3 0 fak_uw_b2 0.000000 1.999970
 /begin AXIS_DESCR COM_AXIS gangi dez 0 0.000000 255.000000 AXIS_PTS_REF SGA08MDUB /end AXIS_DESCR
 /begin AXIS_DESCR COM_AXIS nmot_w nmot_uw_q0p25 0 0.000000 16383.800000 AXIS_PTS_REF SNM06MDUW /end AXIS_DESCR
 EXTENDED_LIMITS 0.000000 1.999969 /end CHARACTERISTIC
/begin RECORD_LAYOUT ME7_GKF3 FNC_VALUES 1 UWORD COLUMN_DIR DIRECT /end RECORD_LAYOUT
/begin CHARACTERISTIC KFDLSD_1_A "DÑmpfung PT2-Filter LastschlagdÑmpfung" MAP 0x81CFFA ME7_GKF3 0 fak_uw_b2 0.000000 1.999970
 /begin AXIS_DESCR COM_AXIS gangi dez 0 0.000000 255.000000 AXIS_PTS_REF SGA08MDUB /end AXIS_DESCR
 /begin AXIS_DESCR COM_AXIS nmot_w nmot_uw_q0p25 0 0.000000 16383.800000 AXIS_PTS_REF SNM06MDUW /end AXIS_DESCR
 EXTENDED_LIMITS 0.000000 1.999969 /end CHARACTERISTIC
/begin CHARACTERISTIC KFDLULS "Delta Druck fÅr öberladeschutzdiagnose" MAP 0x8196A1 ME7_KF289 0 p_ub_q5 0.000000 1275.000000
 /begin AXIS_DESCR STD_AXIS nmot nmot_ub_q40 8 0.000000 10200.000000 DEPOSIT ABSOLUTE /end AXIS_DESCR
 /begin AXIS_DESCR STD_AXIS plsol p_ub_q10 8 0.000000 2550.000000 DEPOSIT ABSOLUTE /end AXIS_DESCR
/end CHARACTERISTIC
/begin CHARACTERISTIC KFDLUR1 "Kennfeld fÅr Laufunruhedifferenz dluts Referenzwert" MAP 0x81473C ME7_GKF2 0 luquant -80.844000 80.212400
 /begin AXIS_DESCR COM_AXIS rl rel_ub_q0p75 0 0.000000 191.250000 AXIS_PTS_REF SRL08DMUB /end AXIS_DESCR
 /begin AXIS_DESCR COM_AXIS nmot nmot_ub_q40 0 0.000000 10200.000000 AXIS_PTS_REF SNM08DMUB /end AXIS_DESCR
 EXTENDED_LIMITS -80.843807 80.212215 /end CHARACTERISTIC
/begin CHARACTERISTIC KFDLUR2 "Kennfeld fÅr Laufunruhedifferenz dluts Referenzwert" MAP 0x81477C ME7_GKF2 0 luquant -80.844000 80.212400
 /begin AXIS_DESCR COM_AXIS rl rel_ub_q0p75 0 0.000000 191.250000 AXIS_PTS_REF SRL08DMUB /end AXIS_DESCR
 /begin AXIS_DESCR COM_AXIS nmot nmot_ub_q40 0 0.000000 10200.000000 AXIS_PTS_REF SNM08DMUB /end AXIS_DESCR
 EXTENDED_LIMITS -80.843807 80.212215 /end CHARACTERISTIC
/begin CHARACTERISTIC KFDLURZ "Kennfeld fÅr Laufunruhedifferenz dluts Referenzwert bei ZAS" MAP 0x8147BC ME7_GKF2 0 luquant -80.844000 80.212400
 /begin AXIS_DESCR COM_AXIS rl rel_ub_q0p75 0 0.000000 191.250000 AXIS_PTS_REF SRL08DMUB /end AXIS_DESCR
 /begin AXIS_DESCR COM_AXIS nmot nmot_ub_q40 0 0.000000 10200.000000 AXIS_PTS_REF SNM08DMUB /end AXIS_DESCR
 EXTENDED_LIMITS -80.843807 80.212215 /end CHARACTERISTIC
/begin CHARACTERISTIC KFDLUR_0_A "Kennfeld fÅr Laufunruhedifferenz dluts Referenzwert" MAP 0x8146BC ME7_GKF2 0 luquant -80.844000 80.212400
 /begin AXIS_DESCR COM_AXIS rl rel_ub_q0p75 0 0.000000 191.250000 AXIS_PTS_REF SRL08DMUB /end AXIS_DESCR
 /begin AXIS_DESCR COM_AXIS nmot nmot_ub_q40 0 0.000000 10200.000000 AXIS_PTS_REF SNM08DMUB /end AXIS_DESCR
 EXTENDED_LIMITS -80.843807 80.212215 /end CHARACTERISTIC
/begin CHARACTERISTIC KFDLUR_1_A "Kennfeld fÅr Laufunruhedifferenz dluts Referenzwert" MAP 0x8146FC ME7_GKF2 0 luquant -80.844000 80.212400
 /begin AXIS_DESCR COM_AXIS rl rel_ub_q0p75 0 0.000000 191.250000 AXIS_PTS_REF SRL08DMUB /end AXIS_DESCR
 /begin AXIS_DESCR COM_AXIS nmot nmot_ub_q40 0 0.000000 10200.000000 AXIS_PTS_REF SNM08DMUB /end AXIS_DESCR
 EXTENDED_LIMITS -80.843807 80.212215 /end CHARACTERISTIC
/begin CHARACTERISTIC KFDMDARO_0_A "Obere Schwelle fÅr Momenteneingriff" MAP 0x81CC34 ME7_GKF4 0 rel_sw_b100 -100.000000 99.996900
 /begin AXIS_DESCR COM_AXIS gangi dez 0 0.000000 255.000000 AXIS_PTS_REF SGA06MDUB /end AXIS_DESCR
 /begin AXIS_DESCR COM_AXIS mkar_w rel_sw_b100 0 -100.000000 99.996900 AXIS_PTS_REF SMK08MDSW /end AXIS_DESCR
 EXTENDED_LIMITS -100.000000 99.996948 /end CHARACTERISTIC
/begin RECORD_LAYOUT ME7_GKF4 FNC_VALUES 1 SWORD COLUMN_DIR DIRECT /end RECORD_LAYOUT
/begin CHARACTERISTIC KFDMDARO_1_A "Obere Schwelle fÅr Momenteneingriff" MAP 0x81CC94 ME7_GKF4 0 rel_sw_b100 -100.000000 99.996900
 /begin AXIS_DESCR COM_AXIS gangi dez 0 0.000000 255.000000 AXIS_PTS_REF SGA06MDUB /end AXIS_DESCR
 /begin AXIS_DESCR COM_AXIS mkar_w rel_sw_b100 0 -100.000000 99.996900 AXIS_PTS_REF SMK08MDSW /end AXIS_DESCR
 EXTENDED_LIMITS -100.000000 99.996948 /end CHARACTERISTIC
/begin CHARACTERISTIC KFDMDARO_2_A "Obere Schwelle fÅr Momenteneingriff" MAP 0x81CCF4 ME7_GKF4 0 rel_sw_b100 -100.000000 99.996900
 /begin AXIS_DESCR COM_AXIS gangi dez 0 0.000000 255.000000 AXIS_PTS_REF SGA06MDUB /end AXIS_DESCR
 /begin AXIS_DESCR COM_AXIS mkar_w rel_sw_b100 0 -100.000000 99.996900 AXIS_PTS_REF SMK08MDSW /end AXIS_DESCR
 EXTENDED_LIMITS -100.000000 99.996948 /end CHARACTERISTIC
/begin CHARACTERISTIC KFDMDARO_3_A "Obere Schwelle fÅr Momenteneingriff" MAP 0x81CD54 ME7_GKF4 0 rel_sw_b100 -100.000000 99.996900
 /begin AXIS_DESCR COM_AXIS gangi dez 0 0.000000 255.000000 AXIS_PTS_REF SGA06MDUB /end AXIS_DESCR
 /begin AXIS_DESCR COM_AXIS mkar_w rel_sw_b100 0 -100.000000 99.996900 AXIS_PTS_REF SMK08MDSW /end AXIS_DESCR
 EXTENDED_LIMITS -100.000000 99.996948 /end CHARACTERISTIC
/begin CHARACTERISTIC KFDMDARU_0_A "Untere Schwelle fÅr Momenteneingriff" MAP 0x81CDB4 ME7_GKF4 0 rel_sw_b100 -100.000000 99.996900
 /begin AXIS_DESCR COM_AXIS gangi dez 0 0.000000 255.000000 AXIS_PTS_REF SGA06MDUB /end AXIS_DESCR
 /begin AXIS_DESCR COM_AXIS mkar_w rel_sw_b100 0 -100.000000 99.996900 AXIS_PTS_REF SMK08MDSW /end AXIS_DESCR
 EXTENDED_LIMITS -100.000000 99.996948 /end CHARACTERISTIC
/begin CHARACTERISTIC KFDMDARU_1_A "Untere Schwelle fÅr Momenteneingriff" MAP 0x81CE14 ME7_GKF4 0 rel_sw_b100 -100.000000 99.996900
 /begin AXIS_DESCR COM_AXIS gangi dez 0 0.000000 255.000000 AXIS_PTS_REF SGA06MDUB /end AXIS_DESCR
 /begin AXIS_DESCR COM_AXIS mkar_w rel_sw_b100 0 -100.000000 99.996900 AXIS_PTS_REF SMK08MDSW /end AXIS_DESCR
 EXTENDED_LIMITS -100.000000 99.996948 /end CHARACTERISTIC
/begin CHARACTERISTIC KFDMDARU_2_A "Untere Schwelle fÅr Momenteneingriff" MAP 0x81CE74 ME7_GKF4 0 rel_sw_b100 -100.000000 99.996900
 /begin AXIS_DESCR COM_AXIS gangi dez 0 0.000000 255.000000 AXIS_PTS_REF SGA06MDUB /end AXIS_DESCR
 /begin AXIS_DESCR COM_AXIS mkar_w rel_sw_b100 0 -100.000000 99.996900 AXIS_PTS_REF SMK08MDSW /end AXIS_DESCR
 EXTENDED_LIMITS -100.000000 99.996948 /end CHARACTERISTIC
/begin CHARACTERISTIC KFDMDARU_3_A "Untere Schwelle fÅr Momenteneingriff" MAP 0x81CED4 ME7_GKF4 0 rel_sw_b100 -100.000000 99.996900
 /begin AXIS_DESCR COM_AXIS gangi dez 0 0.000000 255.000000 AXIS_PTS_REF SGA06MDUB /end AXIS_DESCR
 /begin AXIS_DESCR COM_AXIS mkar_w rel_sw_b100 0 -100.000000 99.996900 AXIS_PTS_REF SMK08MDSW /end AXIS_DESCR
 EXTENDED_LIMITS -100.000000 99.996948 /end CHARACTERISTIC
/begin CHARACTERISTIC KFDMDKOE "Anfangswert Momentenfilter bei Klimakompressor Einschalten" MAP 0x81987F ME7_KF289 0 rel_ub_b49p725 0.000000 49.725000
 /begin AXIS_DESCR STD_AXIS nmot nmot_ub_q40 6 0.000000 10200.000000 DEPOSIT ABSOLUTE /end AXIS_DESCR
 /begin AXIS_DESCR STD_AXIS tans temp_ub_q0p75_o48 6 -48.000000 143.250000 DEPOSIT ABSOLUTE /end AXIS_DESCR
/end CHARACTERISTIC
/begin CHARACTERISTIC KFDMDPO_0_A "Delta Moment Dashpotauslîsung" MAP 0x812B5A ME7_KF309 0 rel_uw_b100 0.000000 99.998500
 /begin AXIS_DESCR STD_AXIS mkfanb_w rel_sw_b100 6 -100.000000 99.996900 DEPOSIT ABSOLUTE /end AXIS_DESCR
 /begin AXIS_DESCR STD_AXIS gangi dez 8 0.000000 255.000000 DEPOSIT ABSOLUTE /end AXIS_DESCR
 EXTENDED_LIMITS 0.000000 99.998474 /end CHARACTERISTIC
/begin RECORD_LAYOUT ME7_KF309 NO_AXIS_PTS_X 1 UBYTE NO_AXIS_PTS_Y 2 UBYTE AXIS_PTS_X 3 SWORD INDEX_INCR DIRECT AXIS_PTS_Y 4 UBYTE INDEX_INCR DIRECT FNC_VALUES 5 UWORD COLUMN_DIR DIRECT /end RECORD_LAYOUT
/begin CHARACTERISTIC KFDMDPO_1_A "Delta Moment Dashpotauslîsung" MAP 0x812BD0 ME7_KF309 0 rel_uw_b100 0.000000 99.998500
 /begin AXIS_DESCR STD_AXIS mkfanb_w rel_sw_b100 6 -100.000000 99.996900 DEPOSIT ABSOLUTE /end AXIS_DESCR
 /begin AXIS_DESCR STD_AXIS gangi dez 8 0.000000 255.000000 DEPOSIT ABSOLUTE /end AXIS_DESCR
 EXTENDED_LIMITS 0.000000 99.998474 /end CHARACTERISTIC
/begin CHARACTERISTIC KFDMLSDO_0_A "Delta Moment Auslîsung LastschlagdÑmpfung" MAP 0x812C46 ME7_KF357 0 rel_uw_b100 0.000000 99.998500
 /begin AXIS_DESCR STD_AXIS mkfanb_w rel_sw_b100 8 -100.000000 99.996900 DEPOSIT ABSOLUTE /end AXIS_DESCR
 /begin AXIS_DESCR STD_AXIS nmot_w nmot_uw_q0p25 6 0.000000 16383.800000 DEPOSIT ABSOLUTE /end AXIS_DESCR
 EXTENDED_LIMITS 0.000000 99.998474 /end CHARACTERISTIC
/begin RECORD_LAYOUT ME7_KF357 NO_AXIS_PTS_X 1 UWORD NO_AXIS_PTS_Y 2 UWORD AXIS_PTS_X 3 SWORD INDEX_INCR DIRECT AXIS_PTS_Y 4 UWORD INDEX_INCR DIRECT FNC_VALUES 5 UWORD COLUMN_DIR DIRECT /end RECORD_LAYOUT
/begin CHARACTERISTIC KFDMLSDO_1_A "Delta Moment Auslîsung LastschlagdÑmpfung" MAP 0x812CC6 ME7_KF357 0 rel_uw_b100 0.000000 99.998500
 /begin AXIS_DESCR STD_AXIS mkfanb_w rel_sw_b100 8 -100.000000 99.996900 DEPOSIT ABSOLUTE /end AXIS_DESCR
 /begin AXIS_DESCR STD_AXIS nmot_w nmot_uw_q0p25 6 0.000000 16383.800000 DEPOSIT ABSOLUTE /end AXIS_DESCR
 EXTENDED_LIMITS 0.000000 99.998474 /end CHARACTERISTIC
/begin CHARACTERISTIC KFDMLSDS "Delta Moment Auslîsung LastschlagdÑmpfung nach Schaltvorgang" MAP 0x81D05A ME7_GKF3 0 rel_uw_b100 0.000000 99.998500
 /begin AXIS_DESCR COM_AXIS gangi dez 0 0.000000 255.000000 AXIS_PTS_REF SGA08MDUB /end AXIS_DESCR
 /begin AXIS_DESCR COM_AXIS nmot_w nmot_uw_q0p25 0 0.000000 16383.800000 AXIS_PTS_REF SNM06MDUW /end AXIS_DESCR
 EXTENDED_LIMITS 0.000000 99.998474 /end CHARACTERISTIC
/begin CHARACTERISTIC KFDTMTE "Kennfeld Motortemperaturgradient fÅr Ersatztemperatur" MAP 0x81BA50 ME7_KF290 0 temp_sb_b0p093 -0.093750 0.093018
 /begin AXIS_DESCR STD_AXIS ml m_ub_b1020 5 0.000000 1020.000000 DEPOSIT ABSOLUTE /end AXIS_DESCR
 /begin AXIS_DESCR STD_AXIS tmew temp_ub_q0p75_o48 4 -48.000000 143.250000 DEPOSIT ABSOLUTE /end AXIS_DESCR
/end CHARACTERISTIC
/begin CHARACTERISTIC KFDTMTR "Kennfeld Motortemperaturgradient fÅr Referenztemperatur" MAP 0x81BA70 ME7_KF290 0 temp_sb_b0p093 -0.093750 0.093018
 /begin AXIS_DESCR STD_AXIS ml m_ub_b1020 5 0.000000 1020.000000 DEPOSIT ABSOLUTE /end AXIS_DESCR
 /begin AXIS_DESCR STD_AXIS tmrw temp_ub_q0p75_o48 4 -48.000000 143.250000 DEPOSIT ABSOLUTE /end AXIS_DESCR
/end CHARACTERISTIC
/begin CHARACTERISTIC KFDTMTU "Kennfeld Korrekturgradient Motortemperatur bei geringer ErwÑrmung" MAP 0x81BA90 ME7_KF290 0 temp_sb_b0p093 -0.093750 0.093018
 /begin AXIS_DESCR STD_AXIS ml m_ub_b1020 5 0.000000 1020.000000 DEPOSIT ABSOLUTE /end AXIS_DESCR
 /begin AXIS_DESCR STD_AXIS tumginp temp_ub_q0p75_o48 4 -48.000000 143.250000 DEPOSIT ABSOLUTE /end AXIS_DESCR
/end CHARACTERISTIC
/begin CHARACTERISTIC KFDYES "Lastdynamikerkennungsschwelle" MAP 0x81BD64 ME7_GKF3 0 rel_uw_q0p0234 0.000000 1535.980000
 /begin AXIS_DESCR COM_AXIS nmot nmot_ub_q40 0 0.000000 10200.000000 AXIS_PTS_REF SNM16KRDYUB /end AXIS_DESCR
 /begin AXIS_DESCR COM_AXIS rl rel_ub_q0p75 0 0.000000 191.250000 AXIS_PTS_REF SRL06KRUB /end AXIS_DESCR
 EXTENDED_LIMITS 0.000000 1535.976562 /end CHARACTERISTIC
/begin CHARACTERISTIC KFDYMNT "vorgesteuerter Dynamikvorhalt" MAP 0x812100 ME7_KF339 0 zw_uw_qn0p75 -49151.300000 0.000000
 /begin AXIS_DESCR STD_AXIS evtmod temp_ub_q0p75_o48 16 -48.000000 143.250000 DEPOSIT ABSOLUTE /end AXIS_DESCR
 /begin AXIS_DESCR STD_AXIS nmot nmot_ub_q40___UW 8 0.000000 2621400.000000 DEPOSIT ABSOLUTE /end AXIS_DESCR
 EXTENDED_LIMITS -49151.250000 0.000000 /end CHARACTERISTIC
/begin CHARACTERISTIC KFDYRS "Dynamikvorhalt Erkennungsschwelle" MAP 0x81BE24 ME7_GKF3 0 rel_uw_q0p0234 0.000000 1535.980000
 /begin AXIS_DESCR COM_AXIS nmot nmot_ub_q40 0 0.000000 10200.000000 AXIS_PTS_REF SNM16KRDYUB /end AXIS_DESCR
 /begin AXIS_DESCR COM_AXIS rl rel_ub_q0p75 0 0.000000 191.250000 AXIS_PTS_REF SRL06KRUB /end AXIS_DESCR
 EXTENDED_LIMITS 0.000000 1535.976562 /end CHARACTERISTIC
/begin CHARACTERISTIC KFDYRSOF "Dynamikvorhalt Offsetschwelle" MAP 0x81BEE4 ME7_GKF3 0 rel_uw_q0p0234 0.000000 1535.980000
 /begin AXIS_DESCR COM_AXIS nmot nmot_ub_q40 0 0.000000 10200.000000 AXIS_PTS_REF SNM16KRDYUB /end AXIS_DESCR
 /begin AXIS_DESCR COM_AXIS rl rel_ub_q0p75 0 0.000000 191.250000 AXIS_PTS_REF SRL06KRUB /end AXIS_DESCR
 EXTENDED_LIMITS 0.000000 1535.976562 /end CHARACTERISTIC
/begin CHARACTERISTIC KFDZK "delta ZÅndwinkel bei Dauerklopfen" MAP 0x819E41 ME7_GKF2 0 zw_sb_q0p75 -96.000000 95.250000
 /begin AXIS_DESCR COM_AXIS nmot nmot_ub_q40 0 0.000000 10200.000000 AXIS_PTS_REF SNM16ZUUB /end AXIS_DESCR
 /begin AXIS_DESCR COM_AXIS rl rel_ub_q0p75 0 0.000000 191.250000 AXIS_PTS_REF SRL12ZUUB /end AXIS_DESCR
/end CHARACTERISTIC
/begin CHARACTERISTIC KFDZWKG "ZÅndwinkelkorrektur durch Verschieben der Klopfgrenze" MAP 0x81EB5A ME7_KF290 0 zw_sb_q0p75 -96.000000 95.250000
 /begin AXIS_DESCR STD_AXIS nmot nmot_ub_q40 8 0.000000 10200.000000 DEPOSIT ABSOLUTE /end AXIS_DESCR
 /begin AXIS_DESCR STD_AXIS lambas fak_ub_b2 5 0.000000 1.992190 DEPOSIT ABSOLUTE /end AXIS_DESCR
/end CHARACTERISTIC
/begin CHARACTERISTIC KFDZWOAGR "Offset des optimalen ZW bei AGR-Betrieb" MAP 0x815763 ME7_GKF2 0 zw_sb_q0p75 -96.000000 95.250000
 /begin AXIS_DESCR COM_AXIS nmot_w nmot_uw_q0p25 0 0.000000 16383.800000 AXIS_PTS_REF SNM16OPUW /end AXIS_DESCR
 /begin AXIS_DESCR COM_AXIS rl_w_kge rel_uw_q0p0234 0 0.000000 1535.980000 AXIS_PTS_REF SRL11OPUW /end AXIS_DESCR
/end CHARACTERISTIC
/begin CHARACTERISTIC KFETATE "Kennfeld gewÅnscher Wirkungsgrad bei TankentlÅftung bei Erreichen te = TEMIN" MAP 0x81D922 ME7_KF357 0 rel_q0p00195 50.000000 100.000000
 /begin AXIS_DESCR STD_AXIS fteadf_w fak_q0p00195 3 -64.000000 63.998000 DEPOSIT ABSOLUTE /end AXIS_DESCR
 /begin AXIS_DESCR STD_AXIS mifa_w rel_uw_b100 5 0.000000 99.998500 DEPOSIT ABSOLUTE /end AXIS_DESCR
 EXTENDED_LIMITS 0.000000 127.998047 /end CHARACTERISTIC
/begin CHARACTERISTIC KFFDLBTS "Faktor Delta Lambdasoll fÅr Bauteileschutz" MAP 0x818E23 ME7_GKF1 0 fak_ub_b2 0.000000 1.992190
 /begin AXIS_DESCR COM_AXIS rl rel_ub_q0p75 0 0.000000 191.250000 AXIS_PTS_REF SRL12GKUB /end AXIS_DESCR
 /begin AXIS_DESCR COM_AXIS nmot nmot_ub_q40 0 0.000000 10200.000000 AXIS_PTS_REF SNM16GKUB /end AXIS_DESCR
 EXTENDED_LIMITS 0.000000 1.992188 /end CHARACTERISTIC
/begin CHARACTERISTIC KFFLDEO "Faktor fÅr Ladedruckeingriff auf Overboostwert durch KR" MAP 0x819507 ME7_GKF1 0 fak_ub_b1 0.000000 0.996094
 /begin AXIS_DESCR COM_AXIS nmot nmot_ub_q40 0 0.000000 10200.000000 AXIS_PTS_REF SNM08LDUB /end AXIS_DESCR
 /begin AXIS_DESCR COM_AXIS wkrmsu zw_ub_q0p75 0 0.000000 191.250000 AXIS_PTS_REF SWK208LDUB /end AXIS_DESCR
/end CHARACTERISTIC
/begin CHARACTERISTIC KFFLLDE "Faktor fÅr langsamen Ladedruckeingriff auf rlmax durch KR" MAP 0x819547 ME7_GKF1 0 fak_ub_b2 0.000000 1.992190
 /begin AXIS_DESCR COM_AXIS nmot nmot_ub_q40 0 0.000000 10200.000000 AXIS_PTS_REF SNM08LDUB /end AXIS_DESCR
 /begin AXIS_DESCR COM_AXIS wkrmstat zw_ub_q0p75 0 0.000000 191.250000 AXIS_PTS_REF SWK08LDUB /end AXIS_DESCR
 EXTENDED_LIMITS 0.000000 1.992188 /end CHARACTERISTIC
/begin CHARACTERISTIC KFFLTA "Schwelle zur Erkennung Feinleck" MAP 0x813596 ME7_KF337 0 t50msxs_ub_b12p75 0.000000 12.750000
 /begin AXIS_DESCR STD_AXIS tans temp_ub_q0p75_o48 4 -48.000000 143.250000 DEPOSIT ABSOLUTE /end AXIS_DESCR
 /begin AXIS_DESCR STD_AXIS pukor_w p_uw_q0p039 4 0.000000 2559.960000 DEPOSIT ABSOLUTE /end AXIS_DESCR
/end CHARACTERISTIC
/begin RECORD_LAYOUT ME7_KF337 NO_AXIS_PTS_X 1 UBYTE NO_AXIS_PTS_Y 2 UBYTE AXIS_PTS_X 3 UBYTE INDEX_INCR DIRECT AXIS_PTS_Y 4 UWORD INDEX_INCR DIRECT FNC_VALUES 5 UBYTE COLUMN_DIR DIRECT /end RECORD_LAYOUT
/begin CHARACTERISTIC KFFMSML "Abgasgegendruckkorrektur der SekundÑrluftmasse" MAP 0x8182F1 ME7_KF289 0 fak_ub_b2 0.000000 1.992190
 /begin AXIS_DESCR STD_AXIS nmot nmot_ub_q40 8 0.000000 10200.000000 DEPOSIT ABSOLUTE /end AXIS_DESCR
 /begin AXIS_DESCR STD_AXIS rl rel_ub_q0p75 8 0.000000 191.250000 DEPOSIT ABSOLUTE /end AXIS_DESCR
 EXTENDED_LIMITS 0.000000 1.992188 /end CHARACTERISTIC
/begin CHARACTERISTIC KFFRMIN "untere Regelbereichsgrenze" MAP 0x81EAC6 ME7_KF339 0 fak_uw_b2 0.000000 1.999970
 /begin AXIS_DESCR STD_AXIS tmot temp_ub_q0p75_o48 5 -48.000000 143.250000 DEPOSIT ABSOLUTE /end AXIS_DESCR
 /begin AXIS_DESCR STD_AXIS tnst_w t10msxs_uw_b655p35 5 0.000000 655.350000 DEPOSIT ABSOLUTE /end AXIS_DESCR
 EXTENDED_LIMITS 0.000000 1.999969 /end CHARACTERISTIC
/begin CHARACTERISTIC KFFSLDE "Faktor fÅr schnellen LDR-Eingriff(Absenkung)" MAP 0x819587 ME7_GKF1 0 fak_ub_b2 0.000000 1.992190
 /begin AXIS_DESCR COM_AXIS nmot nmot_ub_q40 0 0.000000 10200.000000 AXIS_PTS_REF SNM08LDUB /end AXIS_DESCR
 /begin AXIS_DESCR COM_AXIS wkrmdy zw_ub_q0p75 0 0.000000 191.250000 AXIS_PTS_REF SWK108LDUB /end AXIS_DESCR
 EXTENDED_LIMITS 0.000000 1.992188 /end CHARACTERISTIC
/begin CHARACTERISTIC KFFTAGRV "Kennfeld fÅr Faktor fÅr Temperaturabfall an AGR-leitung bis AGR-Ventil" MAP 0x8186CF ME7_KF289 0 fak_ub_b2 0.000000 1.992190
 /begin AXIS_DESCR STD_AXIS msagr m_ub_q0p398 8 0.000000 101.602000 DEPOSIT ABSOLUTE /end AXIS_DESCR
 /begin AXIS_DESCR STD_AXIS nmot nmot_ub_q40 6 0.000000 10200.000000 DEPOSIT ABSOLUTE /end AXIS_DESCR
 EXTENDED_LIMITS 0.000000 1.992188 /end CHARACTERISTIC
/begin CHARACTERISTIC KFFTDAG "Kennfeld fÅr Faktor fÅr Temperaturabfall an AGR-Leitung bis Einleitstelle" MAP 0x81870F ME7_KF289 0 fak_ub_b2 0.000000 1.992190
 /begin AXIS_DESCR STD_AXIS msagr m_ub_q0p398 8 0.000000 101.602000 DEPOSIT ABSOLUTE /end AXIS_DESCR
 /begin AXIS_DESCR STD_AXIS nmot nmot_ub_q40 6 0.000000 10200.000000 DEPOSIT ABSOLUTE /end AXIS_DESCR
 EXTENDED_LIMITS 0.000000 1.992188 /end CHARACTERISTIC
/begin CHARACTERISTIC KFFTEAN "Kennfeld Maximale SpÅlrate bei NotlauftankentlÅftung" MAP 0x819A7B ME7_GKF1 0 fak_ub_b0p5 0.000000 0.199219
 /begin AXIS_DESCR COM_AXIS nmot nmot_ub_q40 0 0.000000 10200.000000 AXIS_PTS_REF SNM10TEUB /end AXIS_DESCR
 /begin AXIS_DESCR COM_AXIS wdkba relDK_ub_b100 0 0.000000 100.000000 AXIS_PTS_REF SDK10TEUB /end AXIS_DESCR
 EXTENDED_LIMITS 0.000000 0.498047 /end CHARACTERISTIC
/begin CHARACTERISTIC KFFTEAX "Kennfeld maximale SpÅlrate" MAP 0x819ADF ME7_KF289 0 fak_ub_b0p5 0.000000 0.199219
 /begin AXIS_DESCR STD_AXIS ml m_ub_b1020 5 0.000000 1020.000000 DEPOSIT ABSOLUTE /end AXIS_DESCR
 /begin AXIS_DESCR STD_AXIS tans temp_ub_q0p75_o48 4 -48.000000 143.250000 DEPOSIT ABSOLUTE /end AXIS_DESCR
 EXTENDED_LIMITS 0.000000 0.498047 /end CHARACTERISTIC
/begin CHARACTERISTIC KFFTV "Gewichtungskennfeld fÅr TVLRH" MAP 0x819CC5 ME7_GKF1 0 fak_ub_b2 0.000000 1.992190
 /begin AXIS_DESCR COM_AXIS nmot nmot_ub_q40 0 0.000000 10200.000000 AXIS_PTS_REF SNM06LHUB /end AXIS_DESCR
 /begin AXIS_DESCR COM_AXIS rl rel_ub_q0p75 0 0.000000 191.250000 AXIS_PTS_REF SRL06LHUB /end AXIS_DESCR
 EXTENDED_LIMITS 0.000000 1.992188 /end CHARACTERISTIC
/begin CHARACTERISTIC KFFWL "Kennfeld Warmlauffaktor" MAP 0x818B41 ME7_GKF1 0 fak_ub_b2 0.000000 1.992190
 /begin AXIS_DESCR COM_AXIS tmot temp_ub_q0p75_o48 0 -48.000000 143.250000 AXIS_PTS_REF STM12ESUB /end AXIS_DESCR
 /begin AXIS_DESCR COM_AXIS tmst temp_ub_q0p75_o48 0 -48.000000 143.250000 AXIS_PTS_REF STS12ESUB /end AXIS_DESCR
 EXTENDED_LIMITS 0.000000 1.992188 /end CHARACTERISTIC
/begin CHARACTERISTIC KFFWLW "Kennfeld Wichtung Warmlauffaktor" MAP 0x815307 ME7_GKF1 0 fak_ub_b1 0.000000 0.996094
 /begin AXIS_DESCR COM_AXIS nmot nmot_ub_q40 0 0.000000 10200.000000 AXIS_PTS_REF SNM12ESUB /end AXIS_DESCR
 /begin AXIS_DESCR COM_AXIS rl rel_ub_q0p75 0 0.000000 191.250000 AXIS_PTS_REF SRL12ESUB /end AXIS_DESCR
/end CHARACTERISTIC
/begin CHARACTERISTIC KFFWTBR "Wichtungsfaktor Tans/Tmot fÅr Brennraumtemperaturmodell" MAP 0x818669 ME7_KF289 0 fak_ub_b1 0.000000 0.996094
 /begin AXIS_DESCR STD_AXIS rl rel_ub_q0p75 10 0.000000 191.250000 DEPOSIT ABSOLUTE /end AXIS_DESCR
 /begin AXIS_DESCR STD_AXIS nmot nmot_ub_q40 8 0.000000 10200.000000 DEPOSIT ABSOLUTE /end AXIS_DESCR
/end CHARACTERISTIC
/begin CHARACTERISTIC KFGLTA "Schwelle zur Erkennung Grobleck" MAP 0x8135B4 ME7_KF337 0 t50msxs_ub_b12p75 0.000000 12.750000
 /begin AXIS_DESCR STD_AXIS tans temp_ub_q0p75_o48 4 -48.000000 143.250000 DEPOSIT ABSOLUTE /end AXIS_DESCR
 /begin AXIS_DESCR STD_AXIS pukor_w p_uw_q0p039 4 0.000000 2559.960000 DEPOSIT ABSOLUTE /end AXIS_DESCR
/end CHARACTERISTIC
/begin CHARACTERISTIC KFGNSOL "" MAP 0x8171E4 ME7_KF301 0 rel_ub_b99p6 0.000000 99.609400
 /begin AXIS_DESCR STD_AXIS tnst_w t10msxs_uw_b655p35 6 0.000000 655.350000 DEPOSIT ABSOLUTE /end AXIS_DESCR
 /begin AXIS_DESCR STD_AXIS tmot temp_ub_q0p75_o48 6 -48.000000 143.250000 DEPOSIT ABSOLUTE /end AXIS_DESCR
 EXTENDED_LIMITS 0.000000 99.609375 /end CHARACTERISTIC
/begin RECORD_LAYOUT ME7_KF301 NO_AXIS_PTS_X 1 UBYTE NO_AXIS_PTS_Y 2 UBYTE AXIS_PTS_X 3 UWORD INDEX_INCR DIRECT AXIS_PTS_Y 4 UBYTE INDEX_INCR DIRECT FNC_VALUES 5 UBYTE COLUMN_DIR DIRECT /end RECORD_LAYOUT
/begin CHARACTERISTIC KFKEF1 "Klopferkennungsfaktorkennfeld ZÅndung 1" MAP 0x8191C0 ME7_GKF1 0 fak_ub_b16 0.000000 15.937500
 /begin AXIS_DESCR COM_AXIS nmot nmot_ub_q40 0 0.000000 10200.000000 AXIS_PTS_REF SNM16KRUB /end AXIS_DESCR
 /begin AXIS_DESCR COM_AXIS rl rel_ub_q0p75 0 0.000000 191.250000 AXIS_PTS_REF SRL03KRUB /end AXIS_DESCR
/end CHARACTERISTIC
/begin CHARACTERISTIC KFKEF2 "Klopferkennungsfaktorkennfeld ZÅndung 2" MAP 0x8191F0 ME7_GKF1 0 fak_ub_b16 0.000000 15.937500
 /begin AXIS_DESCR COM_AXIS nmot nmot_ub_q40 0 0.000000 10200.000000 AXIS_PTS_REF SNM16KRUB /end AXIS_DESCR
 /begin AXIS_DESCR COM_AXIS rl rel_ub_q0p75 0 0.000000 191.250000 AXIS_PTS_REF SRL03KRUB /end AXIS_DESCR
/end CHARACTERISTIC
/begin CHARACTERISTIC KFKEF3 "Klopferkennungsfaktorkennfeld ZÅndung 3" MAP 0x819220 ME7_GKF1 0 fak_ub_b16 0.000000 15.937500
 /begin AXIS_DESCR COM_AXIS nmot nmot_ub_q40 0 0.000000 10200.000000 AXIS_PTS_REF SNM16KRUB /end AXIS_DESCR
 /begin AXIS_DESCR COM_AXIS rl rel_ub_q0p75 0 0.000000 191.250000 AXIS_PTS_REF SRL03KRUB /end AXIS_DESCR
/end CHARACTERISTIC
/begin CHARACTERISTIC KFKEF4 "Klopferkennungsfaktorkennfeld ZÅndung 4" MAP 0x819250 ME7_GKF1 0 fak_ub_b16 0.000000 15.937500
 /begin AXIS_DESCR COM_AXIS nmot nmot_ub_q40 0 0.000000 10200.000000 AXIS_PTS_REF SNM16KRUB /end AXIS_DESCR
 /begin AXIS_DESCR COM_AXIS rl rel_ub_q0p75 0 0.000000 191.250000 AXIS_PTS_REF SRL03KRUB /end AXIS_DESCR
/end CHARACTERISTIC
/begin CHARACTERISTIC KFKEF5 "Klopferkennungsfaktorkennfeld ZÅndung 5" MAP 0x819280 ME7_GKF1 0 fak_ub_b16 0.000000 15.937500
 /begin AXIS_DESCR COM_AXIS nmot nmot_ub_q40 0 0.000000 10200.000000 AXIS_PTS_REF SNM16KRUB /end AXIS_DESCR
 /begin AXIS_DESCR COM_AXIS rl rel_ub_q0p75 0 0.000000 191.250000 AXIS_PTS_REF SRL03KRUB /end AXIS_DESCR
/end CHARACTERISTIC
/begin CHARACTERISTIC KFKEF6 "Klopferkennungsfaktorkennfeld ZÅndung 6" MAP 0x8192B0 ME7_GKF1 0 fak_ub_b16 0.000000 15.937500
 /begin AXIS_DESCR COM_AXIS nmot nmot_ub_q40 0 0.000000 10200.000000 AXIS_PTS_REF SNM16KRUB /end AXIS_DESCR
 /begin AXIS_DESCR COM_AXIS rl rel_ub_q0p75 0 0.000000 191.250000 AXIS_PTS_REF SRL03KRUB /end AXIS_DESCR
/end CHARACTERISTIC
/begin CHARACTERISTIC KFKEF7 "Klopferkennungsfaktorkennfeld ZÅndung 7" MAP 0x8192E0 ME7_GKF1 0 fak_ub_b16 0.000000 15.937500
 /begin AXIS_DESCR COM_AXIS nmot nmot_ub_q40 0 0.000000 10200.000000 AXIS_PTS_REF SNM16KRUB /end AXIS_DESCR
 /begin AXIS_DESCR COM_AXIS rl rel_ub_q0p75 0 0.000000 191.250000 AXIS_PTS_REF SRL03KRUB /end AXIS_DESCR
/end CHARACTERISTIC
/begin CHARACTERISTIC KFKEF8 "Klopferkennungsfaktorkennfeld ZÅndung 8" MAP 0x819310 ME7_GKF1 0 fak_ub_b16 0.000000 15.937500
 /begin AXIS_DESCR COM_AXIS nmot nmot_ub_q40 0 0.000000 10200.000000 AXIS_PTS_REF SNM16KRUB /end AXIS_DESCR
 /begin AXIS_DESCR COM_AXIS rl rel_ub_q0p75 0 0.000000 191.250000 AXIS_PTS_REF SRL03KRUB /end AXIS_DESCR
/end CHARACTERISTIC
/begin CHARACTERISTIC KFKHFM "Korrekturkennfeld fÅr HFM" MAP 0x814FF8 ME7_KF289 0 fak_ub_b2 0.000000 1.992190
 /begin AXIS_DESCR STD_AXIS nmot nmot_ub_q40 14 0.000000 10200.000000 DEPOSIT ABSOLUTE /end AXIS_DESCR
 /begin AXIS_DESCR STD_AXIS rl rel_ub_q0p75 14 0.000000 191.250000 DEPOSIT ABSOLUTE /end AXIS_DESCR
 EXTENDED_LIMITS 0.000000 1.992188 /end CHARACTERISTIC
/begin CHARACTERISTIC KFKSWF "Kennfeld fÅr Kat.-Schutz-Wichtungsfaktoren" MAP 0x814AC5 ME7_KF289 0 dez 0.000000 255.000000
 /begin AXIS_DESCR STD_AXIS nmot nmot_ub_q40 6 0.000000 10200.000000 DEPOSIT ABSOLUTE /end AXIS_DESCR
 /begin AXIS_DESCR STD_AXIS rl rel_ub_q0p75 6 0.000000 191.250000 DEPOSIT ABSOLUTE /end AXIS_DESCR
/end CHARACTERISTIC
/begin CHARACTERISTIC KFKWTMP "Kennfeld Drehmomentenreserve fÅr Kat warmhalten, zeitweise" MAP 0x81BB88 ME7_KF351 0 rel_uw_b100 0.000000 99.998500
 /begin AXIS_DESCR STD_AXIS nmot_w nmot_uw_q0p25 4 0.000000 16383.800000 DEPOSIT ABSOLUTE /end AXIS_DESCR
 /begin AXIS_DESCR STD_AXIS mifakh_w rel_uw_b100 4 0.000000 99.998500 DEPOSIT ABSOLUTE /end AXIS_DESCR
 EXTENDED_LIMITS 0.000000 99.998474 /end CHARACTERISTIC
/begin RECORD_LAYOUT ME7_KF351 NO_AXIS_PTS_X 1 UWORD NO_AXIS_PTS_Y 2 UWORD AXIS_PTS_X 3 UWORD INDEX_INCR DIRECT AXIS_PTS_Y 4 UWORD INDEX_INCR DIRECT FNC_VALUES 5 UWORD COLUMN_DIR DIRECT /end RECORD_LAYOUT
/begin CHARACTERISTIC KFLAMKRL "Anfettung bei ZÅndwinkelspÑtverstellung" MAP 0x818C8C ME7_KF289 0 fak_ub_b2 0.000000 1.992190
 /begin AXIS_DESCR STD_AXIS dzwlamfaw zw_ub_qn0p75 6 -191.250000 0.000000 DEPOSIT ABSOLUTE /end AXIS_DESCR
 /begin AXIS_DESCR STD_AXIS rl rel_ub_q0p75 6 0.000000 191.250000 DEPOSIT ABSOLUTE /end AXIS_DESCR
 EXTENDED_LIMITS 0.000000 1.992188 /end CHARACTERISTIC
/begin CHARACTERISTIC KFLANS "Kennfeld Lambda-Motor-Beschreibung im Nachstart" MAP 0x811DA2 ME7_GKF3 0 fak_uw_b16 0.099853 15.999800
 /begin AXIS_DESCR COM_AXIS tmst temp_ub_q0p75_o48 0 -48.000000 143.250000 AXIS_PTS_REF STS12ESUB /end AXIS_DESCR
 /begin AXIS_DESCR COM_AXIS anztib_w dez___UW 0 0.000000 65535.000000 AXIS_PTS_REF SAN12ESUW /end AXIS_DESCR
 EXTENDED_LIMITS 0.000000 15.999756 /end CHARACTERISTIC
/begin CHARACTERISTIC KFLANSKH "Kennfeld Lambda-Motor-Vorgabe bei Katheizen im Nachstart" MAP 0x81BC94 ME7_KF339 0 fak_uw_b16 0.099853 15.999800
 /begin AXIS_DESCR STD_AXIS tmst temp_ub_q0p75_o48 6 -48.000000 143.250000 DEPOSIT ABSOLUTE /end AXIS_DESCR
 /begin AXIS_DESCR STD_AXIS anztib_w dez___UW 12 0.000000 65535.000000 DEPOSIT ABSOLUTE /end AXIS_DESCR
 EXTENDED_LIMITS 0.000000 15.999756 /end CHARACTERISTIC
/begin CHARACTERISTIC KFLASKH "Kennfeld Lambda-Abgas-Soll bei Katheizen" MAP 0x8190A2 ME7_KF289 0 fak_ub_b2 0.000000 1.992190
 /begin AXIS_DESCR STD_AXIS nmot nmot_ub_q40 8 0.000000 10200.000000 DEPOSIT ABSOLUTE /end AXIS_DESCR
 /begin AXIS_DESCR STD_AXIS rl rel_ub_q0p75 8 0.000000 191.250000 DEPOSIT ABSOLUTE /end AXIS_DESCR
 EXTENDED_LIMITS 0.000000 1.992188 /end CHARACTERISTIC
/begin CHARACTERISTIC KFLASWLR "Kennfeld Lambda-Motor-Soll im Warmlauf bei aktiver LR" MAP 0x818BD1 ME7_GKF1 0 fak_ub_b2 0.000000 1.992190
 /begin AXIS_DESCR COM_AXIS tmot temp_ub_q0p75_o48 0 -48.000000 143.250000 AXIS_PTS_REF STM12ESUB /end AXIS_DESCR
 /begin AXIS_DESCR COM_AXIS tmst temp_ub_q0p75_o48 0 -48.000000 143.250000 AXIS_PTS_REF STS12ESUB /end AXIS_DESCR
 EXTENDED_LIMITS 0.000000 1.992188 /end CHARACTERISTIC
/begin CHARACTERISTIC KFLASWLRL "Offset Lambda-Motor-Soll" MAP 0x811F8E ME7_KF290 0 fak_sb_b1 -1.000000 0.992188
 /begin AXIS_DESCR STD_AXIS rl rel_ub_q0p75 6 0.000000 191.250000 DEPOSIT ABSOLUTE /end AXIS_DESCR
 /begin AXIS_DESCR STD_AXIS tmot temp_ub_q0p75_o48 8 -48.000000 143.250000 DEPOSIT ABSOLUTE /end AXIS_DESCR
/end CHARACTERISTIC
/begin CHARACTERISTIC KFLBTS "Lambdasoll fÅr Bauteileschutz" MAP 0x818EE3 ME7_GKF1 0 fak_ub_b2 0.000000 1.992190
 /begin AXIS_DESCR COM_AXIS rl rel_ub_q0p75 0 0.000000 191.250000 AXIS_PTS_REF SRL12GKUB /end AXIS_DESCR
 /begin AXIS_DESCR COM_AXIS nmot nmot_ub_q40 0 0.000000 10200.000000 AXIS_PTS_REF SNM16GKUB /end AXIS_DESCR
 EXTENDED_LIMITS 0.000000 1.992188 /end CHARACTERISTIC
/begin CHARACTERISTIC KFLDFK "Ladedruck Filterkonstante" MAP 0x811860 ME7_KF351 0 zk10msxs_uw_b655 0.010000 655.360000
 /begin AXIS_DESCR STD_AXIS nmot_w nmot_uw_q0p25 4 0.000000 16383.800000 DEPOSIT ABSOLUTE /end AXIS_DESCR
 /begin AXIS_DESCR STD_AXIS psspvdkd_w fak_uw_b4 6 0.000000 3.999940 DEPOSIT ABSOLUTE /end AXIS_DESCR
/end CHARACTERISTIC
/begin CHARACTERISTIC KFLDHBN "LDR-Hîhenbegrenzung (max. VerdichterdruckverhÑltnis)" MAP 0x8195C7 ME7_GKF1 0 fak_ub_b4 0.000000 3.984380
 /begin AXIS_DESCR COM_AXIS nmot nmot_ub_q40 0 0.000000 10200.000000 AXIS_PTS_REF SNM08LDUB /end AXIS_DESCR
 /begin AXIS_DESCR COM_AXIS tans temp_ub_q0p75_o48 0 -48.000000 143.250000 AXIS_PTS_REF STA08LDUB /end AXIS_DESCR
 EXTENDED_LIMITS 0.000000 3.984375 /end CHARACTERISTIC
/begin CHARACTERISTIC KFLDIMX "Kennfeld LDR I-Reglerbegrenzung" MAP 0x81C7CC ME7_GKF3 0 tv_uw_q0p005 0.000000 327.675000
 /begin AXIS_DESCR COM_AXIS nmot_w nmot_uw_q0p25 0 0.000000 16383.800000 AXIS_PTS_REF SNM16LDUW /end AXIS_DESCR
 /begin AXIS_DESCR COM_AXIS plsolr_w p_uw_q0p039 0 0.000000 2559.960000 AXIS_PTS_REF SPL08LDUW /end AXIS_DESCR
/end CHARACTERISTIC
/begin CHARACTERISTIC KFLDIOPU "Korrektur der TV-Werte durch Hîheneinflu·" MAP 0x81945E ME7_GKF1 0 tv_ub_q0p64 0.000000 163.200000
 /begin AXIS_DESCR COM_AXIS nmot nmot_ub_q40 0 0.000000 10200.000000 AXIS_PTS_REF SNM08LDUB /end AXIS_DESCR
 /begin AXIS_DESCR COM_AXIS pu p_ub_q5 0 0.000000 1275.000000 AXIS_PTS_REF SPU08LDUB /end AXIS_DESCR
/end CHARACTERISTIC
/begin CHARACTERISTIC KFLDRAPP "Kennfeld fÅr LDR-Applikation ohne Md-Koordination" MAP 0x8154AA ME7_KF289 0 tv_ub_b100 0.000000 99.609400
 /begin AXIS_DESCR STD_AXIS nmot nmot_ub_q40 8 0.000000 10200.000000 DEPOSIT ABSOLUTE /end AXIS_DESCR
 /begin AXIS_DESCR STD_AXIS wped relPED_ub_b100 8 0.000000 100.000000 DEPOSIT ABSOLUTE /end AXIS_DESCR
 EXTENDED_LIMITS 0.000000 99.609375 /end CHARACTERISTIC
/begin CHARACTERISTIC KFLDRL "KF zur Linearisierung Ladedruck=f(TV)" MAP 0x81C8CC ME7_GKF4 0 tv_sw_q0p005 -163.840000 163.835000
 /begin AXIS_DESCR COM_AXIS nmot_w nmot_uw_q0p25 0 0.000000 16383.800000 AXIS_PTS_REF SNM16LDUW /end AXIS_DESCR
 /begin AXIS_DESCR COM_AXIS ldtvr_w tv_sw_q0p005 0 -163.840000 163.835000 AXIS_PTS_REF STV10LDSW /end AXIS_DESCR
/end CHARACTERISTIC
/begin CHARACTERISTIC KFLDRQ2 "Kennfeld LDR-Reglerparameter Q2" MAP 0x81CA0C ME7_GKF3 0 rel_uw_b3276p75 0.000000 3276.750000
 /begin AXIS_DESCR COM_AXIS nmot nmot_ub_q40 0 0.000000 10200.000000 AXIS_PTS_REF SNM08LDUB /end AXIS_DESCR
 /begin AXIS_DESCR COM_AXIS lde p_sb_q10___UB 0 0.000000 2550.000000 AXIS_PTS_REF SLD04LDUB /end AXIS_DESCR
/end CHARACTERISTIC
/begin CHARACTERISTIC KFLDRXO "Delta FÅllung (rl) im Overboostbetrieb" MAP 0x8194C1 ME7_KF289 0 rel_ub_q0p75 0.000000 191.250000
 /begin AXIS_DESCR STD_AXIS nmot nmot_ub_q40 8 0.000000 10200.000000 DEPOSIT ABSOLUTE /end AXIS_DESCR
 /begin AXIS_DESCR STD_AXIS tans temp_ub_q0p75_o48 4 -48.000000 143.250000 DEPOSIT ABSOLUTE /end AXIS_DESCR
/end CHARACTERISTIC
/begin CHARACTERISTIC KFLF "Lambdakennfeld bei Teillast" MAP 0x8188EA ME7_KF289 0 fak_ub_b2 0.000000 1.992190
 /begin AXIS_DESCR STD_AXIS nmot nmot_ub_q40 12 0.000000 10200.000000 DEPOSIT ABSOLUTE /end AXIS_DESCR
 /begin AXIS_DESCR STD_AXIS rl rel_ub_q0p75 16 0.000000 191.250000 DEPOSIT ABSOLUTE /end AXIS_DESCR
 EXTENDED_LIMITS 0.000000 1.992188 /end CHARACTERISTIC
/begin CHARACTERISTIC KFLMSKH "Kennfeld Lambda-Motor-Soll bei Katheizen" MAP 0x8190F4 ME7_KF289 0 fak_ub_b2 0.000000 1.992190
 /begin AXIS_DESCR STD_AXIS nmot nmot_ub_q40 8 0.000000 10200.000000 DEPOSIT ABSOLUTE /end AXIS_DESCR
 /begin AXIS_DESCR STD_AXIS rl rel_ub_q0p75 8 0.000000 191.250000 DEPOSIT ABSOLUTE /end AXIS_DESCR
 EXTENDED_LIMITS 0.000000 1.992188 /end CHARACTERISTIC
/begin CHARACTERISTIC KFLUAR1 "Kennfeld fÅr Laufunruhe-Abstandsmass-Referenzwert" MAP 0x8145F3 ME7_GKF1 0 luquant___UB 0.000000 161.056000
 /begin AXIS_DESCR COM_AXIS rl rel_ub_q0p75 0 0.000000 191.250000 AXIS_PTS_REF SRL08DMUB /end AXIS_DESCR
 /begin AXIS_DESCR COM_AXIS nmot nmot_ub_q40 0 0.000000 10200.000000 AXIS_PTS_REF SNM08DMUB /end AXIS_DESCR
 EXTENDED_LIMITS 0.000000 161.056022 /end CHARACTERISTIC
/begin CHARACTERISTIC KFLUAR2 "Kennfeld fÅr Laufunruhe-Abstandsmass-Referenzwert" MAP 0x814633 ME7_GKF1 0 luquant___UB 0.000000 161.056000
 /begin AXIS_DESCR COM_AXIS rl rel_ub_q0p75 0 0.000000 191.250000 AXIS_PTS_REF SRL08DMUB /end AXIS_DESCR
 /begin AXIS_DESCR COM_AXIS nmot nmot_ub_q40 0 0.000000 10200.000000 AXIS_PTS_REF SNM08DMUB /end AXIS_DESCR
 EXTENDED_LIMITS 0.000000 161.056022 /end CHARACTERISTIC
/begin CHARACTERISTIC KFLUARZ "Kennfeld fÅr Laufunruhe-Abstandsmass-Referenzwert bei ZAS" MAP 0x814673 ME7_GKF1 0 luquant___UB 0.000000 161.056000
 /begin AXIS_DESCR COM_AXIS rl rel_ub_q0p75 0 0.000000 191.250000 AXIS_PTS_REF SRL08DMUB /end AXIS_DESCR
 /begin AXIS_DESCR COM_AXIS nmot nmot_ub_q40 0 0.000000 10200.000000 AXIS_PTS_REF SNM08DMUB /end AXIS_DESCR
 EXTENDED_LIMITS 0.000000 161.056022 /end CHARACTERISTIC
/begin CHARACTERISTIC KFLUAR_0_A "Kennfeld fÅr Laufunruhe-Abstandsmass-Referenzwert" MAP 0x814573 ME7_GKF1 0 luquant___UB 0.000000 161.056000
 /begin AXIS_DESCR COM_AXIS rl rel_ub_q0p75 0 0.000000 191.250000 AXIS_PTS_REF SRL08DMUB /end AXIS_DESCR
 /begin AXIS_DESCR COM_AXIS nmot nmot_ub_q40 0 0.000000 10200.000000 AXIS_PTS_REF SNM08DMUB /end AXIS_DESCR
 EXTENDED_LIMITS 0.000000 161.056022 /end CHARACTERISTIC
/begin CHARACTERISTIC KFLUAR_1_A "Kennfeld fÅr Laufunruhe-Abstandsmass-Referenzwert" MAP 0x8145B3 ME7_GKF1 0 luquant___UB 0.000000 161.056000
 /begin AXIS_DESCR COM_AXIS rl rel_ub_q0p75 0 0.000000 191.250000 AXIS_PTS_REF SRL08DMUB /end AXIS_DESCR
 /begin AXIS_DESCR COM_AXIS nmot nmot_ub_q40 0 0.000000 10200.000000 AXIS_PTS_REF SNM08DMUB /end AXIS_DESCR
 EXTENDED_LIMITS 0.000000 161.056022 /end CHARACTERISTIC
/begin CHARACTERISTIC KFLURB1 "Kennfeld fÅr Laufunruhe-Referenz-Basiswert" MAP 0x814917 ME7_GKF2 0 luquant -80.844000 80.212400
 /begin AXIS_DESCR COM_AXIS rl rel_ub_q0p75 0 0.000000 191.250000 AXIS_PTS_REF SRL08DMUB /end AXIS_DESCR
 /begin AXIS_DESCR COM_AXIS nmot nmot_ub_q40 0 0.000000 10200.000000 AXIS_PTS_REF SNM08DMUB /end AXIS_DESCR
 EXTENDED_LIMITS -80.843807 80.212215 /end CHARACTERISTIC
/begin CHARACTERISTIC KFLURB2 "Kennfeld fÅr Laufunruhe-Referenz-Basiswert" MAP 0x814957 ME7_GKF2 0 luquant -80.844000 80.212400
 /begin AXIS_DESCR COM_AXIS rl rel_ub_q0p75 0 0.000000 191.250000 AXIS_PTS_REF SRL08DMUB /end AXIS_DESCR
 /begin AXIS_DESCR COM_AXIS nmot nmot_ub_q40 0 0.000000 10200.000000 AXIS_PTS_REF SNM08DMUB /end AXIS_DESCR
 EXTENDED_LIMITS -80.843807 80.212215 /end CHARACTERISTIC
/begin CHARACTERISTIC KFLURBZ "Kennfeld fÅr Laufunruhe-Referenz-Basiswert bei ZAS" MAP 0x814997 ME7_GKF2 0 luquant -80.844000 80.212400
 /begin AXIS_DESCR COM_AXIS rl rel_ub_q0p75 0 0.000000 191.250000 AXIS_PTS_REF SRL08DMUB /end AXIS_DESCR
 /begin AXIS_DESCR COM_AXIS nmot nmot_ub_q40 0 0.000000 10200.000000 AXIS_PTS_REF SNM08DMUB /end AXIS_DESCR
 EXTENDED_LIMITS -80.843807 80.212215 /end CHARACTERISTIC
/begin CHARACTERISTIC KFLURB_0_A "Kennfeld fÅr Laufunruhe-Referenz-Basiswert" MAP 0x814897 ME7_GKF2 0 luquant -80.844000 80.212400
 /begin AXIS_DESCR COM_AXIS rl rel_ub_q0p75 0 0.000000 191.250000 AXIS_PTS_REF SRL08DMUB /end AXIS_DESCR
 /begin AXIS_DESCR COM_AXIS nmot nmot_ub_q40 0 0.000000 10200.000000 AXIS_PTS_REF SNM08DMUB /end AXIS_DESCR
 EXTENDED_LIMITS -80.843807 80.212215 /end CHARACTERISTIC
/begin CHARACTERISTIC KFLURB_1_A "Kennfeld fÅr Laufunruhe-Referenz-Basiswert" MAP 0x8148D7 ME7_GKF2 0 luquant -80.844000 80.212400
 /begin AXIS_DESCR COM_AXIS rl rel_ub_q0p75 0 0.000000 191.250000 AXIS_PTS_REF SRL08DMUB /end AXIS_DESCR
 /begin AXIS_DESCR COM_AXIS nmot nmot_ub_q40 0 0.000000 10200.000000 AXIS_PTS_REF SNM08DMUB /end AXIS_DESCR
 EXTENDED_LIMITS -80.843807 80.212215 /end CHARACTERISTIC
/begin CHARACTERISTIC KFLURM1 "Kennfeld fÅr Laufunruhe-Referenzwert zur Mehrfachaussetzererkennung ->Lum-Vergl." MAP 0x814A57 ME7_GKF2 0 luquant -80.844000 80.212400
 /begin AXIS_DESCR COM_AXIS rl rel_ub_q0p75 0 0.000000 191.250000 AXIS_PTS_REF SRL08DMUB /end AXIS_DESCR
 /begin AXIS_DESCR COM_AXIS nmot nmot_ub_q40 0 0.000000 10200.000000 AXIS_PTS_REF SNM08DMUB /end AXIS_DESCR
 EXTENDED_LIMITS -80.843807 80.212215 /end CHARACTERISTIC
/begin CHARACTERISTIC KFLURM_0_A "Kennfeld fÅr Laufunruhe-Referenzwert zur Mehrfachaussetzererkennung ->Lum-Vergl." MAP 0x8149D7 ME7_GKF2 0 luquant -80.844000 80.212400
 /begin AXIS_DESCR COM_AXIS rl rel_ub_q0p75 0 0.000000 191.250000 AXIS_PTS_REF SRL08DMUB /end AXIS_DESCR
 /begin AXIS_DESCR COM_AXIS nmot nmot_ub_q40 0 0.000000 10200.000000 AXIS_PTS_REF SNM08DMUB /end AXIS_DESCR
 EXTENDED_LIMITS -80.843807 80.212215 /end CHARACTERISTIC
/begin CHARACTERISTIC KFLURM_1_A "Kennfeld fÅr Laufunruhe-Referenzwert zur Mehrfachaussetzererkennung ->Lum-Vergl." MAP 0x814A17 ME7_GKF2 0 luquant -80.844000 80.212400
 /begin AXIS_DESCR COM_AXIS rl rel_ub_q0p75 0 0.000000 191.250000 AXIS_PTS_REF SRL08DMUB /end AXIS_DESCR
 /begin AXIS_DESCR COM_AXIS nmot nmot_ub_q40 0 0.000000 10200.000000 AXIS_PTS_REF SNM08DMUB /end AXIS_DESCR
 EXTENDED_LIMITS -80.843807 80.212215 /end CHARACTERISTIC
/begin CHARACTERISTIC KFMAKR "Kennfeld Me·fensteranfang Klopfregelung" MAP 0x819175 ME7_GKF1 0 zw_ub_q0p75 0.000000 191.250000
 /begin AXIS_DESCR COM_AXIS nmot nmot_ub_q40 0 0.000000 10200.000000 AXIS_PTS_REF SNM16KRUB /end AXIS_DESCR
 /begin AXIS_DESCR COM_AXIS rl rel_ub_q0p75 0 0.000000 191.250000 AXIS_PTS_REF SRL04KRUB /end AXIS_DESCR
/end CHARACTERISTIC
/begin CHARACTERISTIC KFMDBGRG "Kennfeld mit dem Wert der Momentenbegrenzung" MAP 0x81D2F8 ME7_KF351 0 rel_uw_b100 0.000000 99.998500
 /begin AXIS_DESCR STD_AXIS nmot nmot_ub_q40___UW 4 0.000000 2621400.000000 DEPOSIT ABSOLUTE /end AXIS_DESCR
 /begin AXIS_DESCR STD_AXIS gangi dez___UW 7 0.000000 65535.000000 DEPOSIT ABSOLUTE /end AXIS_DESCR
 EXTENDED_LIMITS 0.000000 99.998474 /end CHARACTERISTIC
/begin CHARACTERISTIC KFMDDSLA "Kennfeld Drehmomentenreserve bei Testereingriff SekundÑrluftdiagnose" MAP 0x81BBBC ME7_KF351 0 rel_uw_b100 0.000000 99.998500
 /begin AXIS_DESCR STD_AXIS nmot_w nmot_uw_q0p25 4 0.000000 16383.800000 DEPOSIT ABSOLUTE /end AXIS_DESCR
 /begin AXIS_DESCR STD_AXIS mifakh_w rel_uw_b100 4 0.000000 99.998500 DEPOSIT ABSOLUTE /end AXIS_DESCR
 EXTENDED_LIMITS 0.000000 99.998474 /end CHARACTERISTIC
/begin CHARACTERISTIC KFMDKH "Kennfeld Drehmomentenreserve fÅr Katheizen" MAP 0x81BBF0 ME7_KF351 0 rel_uw_b100 0.000000 99.998500
 /begin AXIS_DESCR STD_AXIS nmot_w nmot_uw_q0p25 8 0.000000 16383.800000 DEPOSIT ABSOLUTE /end AXIS_DESCR
 /begin AXIS_DESCR STD_AXIS mifakh_w rel_uw_b100 8 0.000000 99.998500 DEPOSIT ABSOLUTE /end AXIS_DESCR
 EXTENDED_LIMITS 0.000000 99.998474 /end CHARACTERISTIC
/begin CHARACTERISTIC KFMDKO "Drehmomentaufnahme Klimakompressor" MAP 0x8198B1 ME7_KF289 0 rel_ub_b49p725 0.000000 49.725000
 /begin AXIS_DESCR STD_AXIS nmot nmot_ub_q40 6 0.000000 10200.000000 DEPOSIT ABSOLUTE /end AXIS_DESCR
 /begin AXIS_DESCR STD_AXIS tans temp_ub_q0p75_o48 6 -48.000000 143.250000 DEPOSIT ABSOLUTE /end AXIS_DESCR
/end CHARACTERISTIC
/begin CHARACTERISTIC KFMDS "Schleppmoment Drehzahl- und LastabhÑngigkeit" MAP 0x812946 ME7_KF351 0 rel_uw_b100 0.000000 99.998500
 /begin AXIS_DESCR STD_AXIS nmot_w nmot_uw_q0p25 10 0.000000 16383.800000 DEPOSIT ABSOLUTE /end AXIS_DESCR
 /begin AXIS_DESCR STD_AXIS rl_w rel_uw_q0p0234 12 0.000000 1535.980000 DEPOSIT ABSOLUTE /end AXIS_DESCR
 EXTENDED_LIMITS 0.000000 99.998474 /end CHARACTERISTIC
/begin CHARACTERISTIC KFMDWMX "Max. Begrenzung fÅr Drehmomentaufnahme des Wandlers" MAP 0x815586 ME7_KF289 0 rel_ub_b99p6 0.000000 99.609400
 /begin AXIS_DESCR STD_AXIS vfzg vfzg_ub_q1p25___UB 6 0.000000 318.750000 DEPOSIT ABSOLUTE /end AXIS_DESCR
 /begin AXIS_DESCR STD_AXIS tmot temp_ub_q0p75_o48 8 -48.000000 143.250000 DEPOSIT ABSOLUTE /end AXIS_DESCR
 EXTENDED_LIMITS 0.000000 99.609375 /end CHARACTERISTIC
/begin CHARACTERISTIC KFMDZOF_UC "" MAP 0x815D34 ME7_GKF1 0 rel_ub_b99p6 0.000000 99.609400
 /begin AXIS_DESCR COM_AXIS mzmax_uc rel_ub_b99p6 0 0.000000 99.609400 AXIS_PTS_REF MDV08_UC /end AXIS_DESCR
 /begin AXIS_DESCR COM_AXIS nmot_uc nmot_ub_q40 0 0.000000 10200.000000 AXIS_PTS_REF NMV08_UC /end AXIS_DESCR
 EXTENDED_LIMITS 0.000000 99.609375 /end CHARACTERISTIC
/begin CHARACTERISTIC KFMDZOF_UM "Kennfeld fÅr Offset-Toleranz in AbhÑngigkeit vom zulÑssigen Moment" MAP 0x814129 ME7_GKF1 0 rel_ub_b99p6 0.000000 99.609400
 /begin AXIS_DESCR COM_AXIS mzmax_um rel_ub_b99p6 0 0.000000 99.609400 AXIS_PTS_REF MDV08_UM /end AXIS_DESCR
 /begin AXIS_DESCR COM_AXIS nmot_um nmot_ub_q40 0 0.000000 10200.000000 AXIS_PTS_REF NMV08_UM /end AXIS_DESCR
 EXTENDED_LIMITS 0.000000 99.609375 /end CHARACTERISTIC
/begin CHARACTERISTIC KFMIFABG "Delta-Moment fÅr Gradientenbegrenzung" MAP 0x812D46 ME7_KF357 0 rel_uw_b100 0.000000 99.998500
 /begin AXIS_DESCR STD_AXIS mkfa_w rel_sw_b50 8 -50.000000 49.998500 DEPOSIT ABSOLUTE /end AXIS_DESCR
 /begin AXIS_DESCR STD_AXIS nmot_w nmot_uw_q0p25 8 0.000000 16383.800000 DEPOSIT ABSOLUTE /end AXIS_DESCR
 EXTENDED_LIMITS 0.000000 99.998474 /end CHARACTERISTIC
/begin CHARACTERISTIC KFMIFALS "Indiziertes Fahrerwunschmoment fÅr FÅllungspfad bei LastschlagdÑmpfung" MAP 0x812DEA ME7_KF339 0 rel_uw_b100 0.000000 99.998500 /begin AXIS_DESCR STD_AXIS gangi dez 8 0.000000 255.000000 DEPOSIT ABSOLUTE /end AXIS_DESCR
 /begin AXIS_DESCR STD_AXIS mifa_w rel_uw_b100 8 0.000000 99.998500 DEPOSIT ABSOLUTE /end AXIS_DESCR
 EXTENDED_LIMITS 0.000000 99.998474 /end CHARACTERISTIC
/begin CHARACTERISTIC KFMILSD_0_A "Startwert indiziertes Moment fÅr LastschlagdÑmpfung" MAP 0x812E84 ME7_KF351 0 rel_uw_b100 0.000000 99.998500
 /begin AXIS_DESCR STD_AXIS mivbeb_w rel_uw_b100 6 0.000000 99.998500 DEPOSIT ABSOLUTE /end AXIS_DESCR
 /begin AXIS_DESCR STD_AXIS nmot_w nmot_uw_q0p25 8 0.000000 16383.800000 DEPOSIT ABSOLUTE /end AXIS_DESCR
 EXTENDED_LIMITS 0.000000 99.998474 /end CHARACTERISTIC
/begin CHARACTERISTIC KFMILSD_1_A "Startwert indiziertes Moment fÅr LastschlagdÑmpfung" MAP 0x812F04 ME7_KF351 0 rel_uw_b100 0.000000 99.998500
 /begin AXIS_DESCR STD_AXIS mivbeb_w rel_uw_b100 6 0.000000 99.998500 DEPOSIT ABSOLUTE /end AXIS_DESCR
 /begin AXIS_DESCR STD_AXIS nmot_w nmot_uw_q0p25 8 0.000000 16383.800000 DEPOSIT ABSOLUTE /end AXIS_DESCR
 EXTENDED_LIMITS 0.000000 99.998474 /end CHARACTERISTIC
/begin CHARACTERISTIC KFMIMN "Minimales Schubmoment" MAP 0x8128AC ME7_KF339 0 rel_uw_b100 0.000000 99.998500 /begin AXIS_DESCR STD_AXIS gangi dez 8 0.000000 255.000000 DEPOSIT ABSOLUTE /end AXIS_DESCR
 /begin AXIS_DESCR STD_AXIS nmot_w nmot_uw_q0p25 8 0.000000 16383.800000 DEPOSIT ABSOLUTE /end AXIS_DESCR
 EXTENDED_LIMITS 0.000000 99.998474 /end CHARACTERISTIC
/begin CHARACTERISTIC KFMIOP "Kennfeld optimales Motormoment" MAP 0x8132DC ME7_GKF3 0 rel_uw_b100 0.000000 99.998500
 /begin AXIS_DESCR COM_AXIS nmot_w nmot_uw_q0p25 0 0.000000 16383.800000 AXIS_PTS_REF SNM16OPUW /end AXIS_DESCR
 /begin AXIS_DESCR COM_AXIS rl_w_kge rel_uw_q0p0234 0 0.000000 1535.980000 AXIS_PTS_REF SRL11OPUW /end AXIS_DESCR
 EXTENDED_LIMITS 0.000000 99.998474 /end CHARACTERISTIC
/begin CHARACTERISTIC KFMIRED "Kennfeld Abregelungsmoment fÅr VMAX-Regelung" MAP 0x815A58 ME7_GKF1 0 rel_ub_b99p6 0.000000 99.609400
 /begin AXIS_DESCR COM_AXIS bfzglf bfzg_sb_q0p217 0 -27.776000 27.559000 AXIS_PTS_REF SBF02MFSB /end AXIS_DESCR
 /begin AXIS_DESCR COM_AXIS rl_w rel_uw_q0p0234 0 0.000000 1535.980000 AXIS_PTS_REF SRL03MFUW /end AXIS_DESCR
 EXTENDED_LIMITS 0.000000 99.609375 /end CHARACTERISTIC
/begin CHARACTERISTIC KFMIRL "Kennfeld fÅr Berechnung SollfÅllung" MAP 0x811BC8 ME7_KF351 0 rel_uw_q0p0234 0.000000 1535.980000
 /begin AXIS_DESCR STD_AXIS nmot_w nmot_uw_q0p25 16 0.000000 16383.800000 DEPOSIT ABSOLUTE /end AXIS_DESCR
 /begin AXIS_DESCR STD_AXIS misopl1_w rel_uw_b100 12 0.000000 99.998500 DEPOSIT ABSOLUTE /end AXIS_DESCR
 EXTENDED_LIMITS 0.000000 1535.976562 /end CHARACTERISTIC
/begin CHARACTERISTIC KFMIZUFIL "ZulÑssiges indiziertes Moment zur Momentenbegrenzung vor Filter" MAP 0x815989 ME7_GKF1 0 rel_ub_b99p6 0.000000 99.609400
 /begin AXIS_DESCR COM_AXIS wped relPED_ub_b100 0 0.000000 100.000000 AXIS_PTS_REF SWP08OPUB /end AXIS_DESCR
 /begin AXIS_DESCR COM_AXIS nmot nmot_ub_q40 0 0.000000 10200.000000 AXIS_PTS_REF SNM08OPUB /end AXIS_DESCR
 EXTENDED_LIMITS 0.000000 99.609375 /end CHARACTERISTIC
/begin CHARACTERISTIC KFMIZUNS "ZulÑssiges Moment bei Nachstartaufweitung" MAP 0x8159C9 ME7_GKF1 0 rel_ub_b99p6 0.000000 99.609400
 /begin AXIS_DESCR COM_AXIS wped relPED_ub_b100 0 0.000000 100.000000 AXIS_PTS_REF SWP08OPUB /end AXIS_DESCR
 /begin AXIS_DESCR COM_AXIS nmot nmot_ub_q40 0 0.000000 10200.000000 AXIS_PTS_REF SNM08OPUB /end AXIS_DESCR
 EXTENDED_LIMITS 0.000000 99.609375 /end CHARACTERISTIC
/begin CHARACTERISTIC KFMIZUOF "ZulÑssiges indiziertes Moment zur Momentenbegrenzung" MAP 0x815A09 ME7_GKF1 0 rel_ub_b99p6 0.000000 99.609400
 /begin AXIS_DESCR COM_AXIS mizuvfil rel_ub_b99p6 0 0.000000 99.609400 AXIS_PTS_REF SMO08OPUB /end AXIS_DESCR
 /begin AXIS_DESCR COM_AXIS nmot nmot_ub_q40 0 0.000000 10200.000000 AXIS_PTS_REF SNM08OPUB /end AXIS_DESCR
 EXTENDED_LIMITS 0.000000 99.609375 /end CHARACTERISTIC
/begin CHARACTERISTIC KFMI_UC "" MAP 0x815CA3 ME7_GKF1 0 rel_ub_b99p6 0.000000 99.609400
 /begin AXIS_DESCR COM_AXIS rl_uc rel_ub_q0p75 0 0.000000 191.250000 AXIS_PTS_REF RLV08_UC /end AXIS_DESCR
 /begin AXIS_DESCR COM_AXIS nmot_uc nmot_ub_q40 0 0.000000 10200.000000 AXIS_PTS_REF NZWV08_UC /end AXIS_DESCR
 EXTENDED_LIMITS 0.000000 99.609375 /end CHARACTERISTIC
/begin CHARACTERISTIC KFMI_UM "Kennfeld optimales Motormoment in der FunktionsÅberwachung" MAP 0x814098 ME7_GKF1 0 rel_ub_b99p6 0.000000 99.609400
 /begin AXIS_DESCR COM_AXIS rl_um rel_ub_q0p75 0 0.000000 191.250000 AXIS_PTS_REF RLV08_UM /end AXIS_DESCR
 /begin AXIS_DESCR COM_AXIS nmot_um nmot_ub_q40 0 0.000000 10200.000000 AXIS_PTS_REF NZWV08_UM /end AXIS_DESCR
 EXTENDED_LIMITS 0.000000 99.609375 /end CHARACTERISTIC
/begin CHARACTERISTIC KFMLDMN "ML-Schwelle fÅr B_minflr-Diagnose HFM/HLM" MAP 0x81B19E ME7_GKF4 0 m_sw_q0p1 -3276.800000 3276.700000
 /begin AXIS_DESCR COM_AXIS wdkbad_w relDK_q0p02441 0 -800.000000 799.976000 AXIS_PTS_REF SDK08FEUW /end AXIS_DESCR
 /begin AXIS_DESCR COM_AXIS nmot_w nmot_uw_q0p25 0 0.000000 16383.800000 AXIS_PTS_REF SNM08FEUW /end AXIS_DESCR
/end CHARACTERISTIC
/begin CHARACTERISTIC KFMLDMX "ML-Schwelle fÅr B_maxflr-Diagnose HFM/HLM" MAP 0x81B21E ME7_GKF3 0 m_uw_b6553p5 0.000000 6553.500000
 /begin AXIS_DESCR COM_AXIS wdkbad_w relDK_q0p02441 0 -800.000000 799.976000 AXIS_PTS_REF SDK08FEUW /end AXIS_DESCR
 /begin AXIS_DESCR COM_AXIS nmot_w nmot_uw_q0p25 0 0.000000 16383.800000 AXIS_PTS_REF SNM08FEUW /end AXIS_DESCR
/end CHARACTERISTIC
/begin CHARACTERISTIC KFMPED_UC "" MAP 0x815D74 ME7_GKF1 0 rel_ub_b99p6 0.000000 99.609400
 /begin AXIS_DESCR COM_AXIS spsn_uc spg_ub_q0p019 0 0.000000 4.980470 AXIS_PTS_REF SPSNV08_UC /end AXIS_DESCR
 /begin AXIS_DESCR COM_AXIS nmot_uc nmot_ub_q40 0 0.000000 10200.000000 AXIS_PTS_REF NMV08_UC /end AXIS_DESCR
 EXTENDED_LIMITS 0.000000 99.609375 /end CHARACTERISTIC
/begin CHARACTERISTIC KFMPED_UM "Kennfeld fÅr zulÑssiges Moment aus der Pedalstellung in der FunktionsÅberwachg" MAP 0x814169 ME7_GKF1 0 rel_ub_b99p6 0.000000 99.609400
 /begin AXIS_DESCR COM_AXIS spsn_um spg_ub_q0p019 0 0.000000 4.980470 AXIS_PTS_REF SPSNV08_UM /end AXIS_DESCR
 /begin AXIS_DESCR COM_AXIS nmot_um nmot_ub_q40 0 0.000000 10200.000000 AXIS_PTS_REF NMV08_UM /end AXIS_DESCR
 EXTENDED_LIMITS 0.000000 99.609375 /end CHARACTERISTIC
/begin CHARACTERISTIC KFMPNS_UC "" MAP 0x815DB4 ME7_GKF1 0 rel_ub_b99p6 0.000000 99.609400
 /begin AXIS_DESCR COM_AXIS spsn_uc spg_ub_q0p019 0 0.000000 4.980470 AXIS_PTS_REF SPSNV08_UC /end AXIS_DESCR
 /begin AXIS_DESCR COM_AXIS nmot_uc nmot_ub_q40 0 0.000000 10200.000000 AXIS_PTS_REF NMV08_UC /end AXIS_DESCR
 EXTENDED_LIMITS 0.000000 99.609375 /end CHARACTERISTIC
/begin CHARACTERISTIC KFMPNS_UM "Kennfeld fÅr zul. Moment aus Pedalstellung bei kaltem Motor" MAP 0x8141A9 ME7_GKF1 0 rel_ub_b99p6 0.000000 99.609400
 /begin AXIS_DESCR COM_AXIS spsn_um spg_ub_q0p019 0 0.000000 4.980470 AXIS_PTS_REF SPSNV08_UM /end AXIS_DESCR
 /begin AXIS_DESCR COM_AXIS nmot_um nmot_ub_q40 0 0.000000 10200.000000 AXIS_PTS_REF NMV08_UM /end AXIS_DESCR
 EXTENDED_LIMITS 0.000000 99.609375 /end CHARACTERISTIC
/begin CHARACTERISTIC KFMRES "LLR: Basis Momentenreserve im LL und ll-nahem Bereich" MAP 0x8155F5 ME7_GKF1 0 rel_ub_b24p9 0.000000 24.900000
 /begin AXIS_DESCR COM_AXIS nmot_w nmot_uw_q0p25 0 0.000000 16383.800000 AXIS_PTS_REF SNM06LLUB /end AXIS_DESCR
 /begin AXIS_DESCR COM_AXIS mifa_w rel_uw_b100 0 0.000000 99.998500 AXIS_PTS_REF SMI04LLUB /end AXIS_DESCR
/end CHARACTERISTIC
/begin CHARACTERISTIC KFMRESK "LLR: Basis Momentenreserve im LL und ll-nahem Bereich,ausgekuppelt" MAP 0x81560D ME7_GKF1 0 rel_ub_b24p9 0.000000 24.900000
 /begin AXIS_DESCR COM_AXIS nmot_w nmot_uw_q0p25 0 0.000000 16383.800000 AXIS_PTS_REF SNM06LLUB /end AXIS_DESCR
 /begin AXIS_DESCR COM_AXIS mifa_w rel_uw_b100 0 0.000000 99.998500 AXIS_PTS_REF SMI04LLUB /end AXIS_DESCR
/end CHARACTERISTIC
/begin CHARACTERISTIC KFMRESKH "Momentenreserve bei Kat.heizen" MAP 0x815625 ME7_GKF1 0 rel_ub_b24p9 0.000000 24.900000
 /begin AXIS_DESCR COM_AXIS dns nmotd_sb_q10 0 -1280.000000 1270.000000 AXIS_PTS_REF SNS06LLSB /end AXIS_DESCR
 /begin AXIS_DESCR COM_AXIS tmot temp_ub_q0p75_o48 0 -48.000000 143.250000 AXIS_PTS_REF STM04SAUB /end AXIS_DESCR
/end CHARACTERISTIC
/begin CHARACTERISTIC KFMRESNL "Momentenreserve im nicht Leerlauf" MAP 0x81563D ME7_GKF1 0 rel_ub_b24p9 0.000000 24.900000
 /begin AXIS_DESCR COM_AXIS nmot_w nmot_uw_q0p25 0 0.000000 16383.800000 AXIS_PTS_REF SNM06LLUB /end AXIS_DESCR
 /begin AXIS_DESCR COM_AXIS mifa_w rel_uw_b100 0 0.000000 99.998500 AXIS_PTS_REF SMI04LLUB /end AXIS_DESCR
/end CHARACTERISTIC
/begin CHARACTERISTIC KFMRESTA "Momentreserve abhÑngig von tans" MAP 0x815655 ME7_GKF1 0 rel_ub_b24p9 0.000000 24.900000
 /begin AXIS_DESCR COM_AXIS tans temp_ub_q0p75_o48___UW 0 -48.000000 49103.300000 AXIS_PTS_REF STA04LLUB /end AXIS_DESCR
 /begin AXIS_DESCR COM_AXIS mifa_w rel_uw_b100 0 0.000000 99.998500 AXIS_PTS_REF SMI04LLUB /end AXIS_DESCR
/end CHARACTERISTIC
/begin CHARACTERISTIC KFMSNTAG "AGR-Massenstrom normiert" MAP 0x8118AC ME7_KF351 0 m_uw_b6553p5 0.000000 6553.500000
 /begin AXIS_DESCR STD_AXIS nmot_w nmot_uw_q0p25 10 0.000000 16383.800000 DEPOSIT ABSOLUTE /end AXIS_DESCR
 /begin AXIS_DESCR STD_AXIS hagr_w rel_uw_b100 12 0.000000 99.998500 DEPOSIT ABSOLUTE /end AXIS_DESCR
/end CHARACTERISTIC
/begin CHARACTERISTIC KFMSNWDK "Kennfeld normierter Massenstrom Åber DK" MAP 0x811324 ME7_KF351 0 m_uw_b6553p5 0.000000 6553.500000
 /begin AXIS_DESCR STD_AXIS wdkbab_w rel_uw_b100 16 0.000000 99.998500 DEPOSIT ABSOLUTE /end AXIS_DESCR
 /begin AXIS_DESCR STD_AXIS nmot_w nmot_uw_q0p25 6 0.000000 16383.800000 DEPOSIT ABSOLUTE /end AXIS_DESCR
/end CHARACTERISTIC
/begin CHARACTERISTIC KFNSWRL "Wichtung Nachstartanhebung" MAP 0x81513C ME7_KF289 0 fak_ub_b2 0.000000 1.992190
 /begin AXIS_DESCR STD_AXIS tmst temp_ub_q0p75_o48 8 -48.000000 143.250000 DEPOSIT ABSOLUTE /end AXIS_DESCR
 /begin AXIS_DESCR STD_AXIS rl rel_ub_q0p75 6 0.000000 191.250000 DEPOSIT ABSOLUTE /end AXIS_DESCR
 EXTENDED_LIMITS 0.000000 1.992188 /end CHARACTERISTIC
/begin CHARACTERISTIC KFNW "Kennfeld fÅr variable Nockenwellenspreizung" MAP 0x8187C0 ME7_KF289 0 fak_ub_b2 0.000000 1.992190
 /begin AXIS_DESCR STD_AXIS nmot nmot_ub_q40 12 0.000000 10200.000000 DEPOSIT ABSOLUTE /end AXIS_DESCR
 /begin AXIS_DESCR STD_AXIS rlsnwtm rel_ub_q0p75 8 0.000000 191.250000 DEPOSIT ABSOLUTE /end AXIS_DESCR
 EXTENDED_LIMITS 0.000000 1.992188 /end CHARACTERISTIC
/begin CHARACTERISTIC KFNWEGM "Wiedereinsetzdrehzahlkennfeld" MAP 0x819758 ME7_GKF1 0 nmot_ub_q40 0.000000 10200.000000
 /begin AXIS_DESCR COM_AXIS tmot temp_ub_q0p75_o48 0 -48.000000 143.250000 AXIS_PTS_REF STM05SAUB /end AXIS_DESCR
 /begin AXIS_DESCR COM_AXIS gangi dez 0 0.000000 255.000000 AXIS_PTS_REF SGA08MDUB /end AXIS_DESCR
/end CHARACTERISTIC
/begin CHARACTERISTIC KFNWWL "Kennfeld Nockenwellensteuerung im Warmlauf" MAP 0x818836 ME7_KF289 0 fak_ub_b2 0.000000 1.992190
 /begin AXIS_DESCR STD_AXIS nmot nmot_ub_q40 12 0.000000 10200.000000 DEPOSIT ABSOLUTE /end AXIS_DESCR
 /begin AXIS_DESCR STD_AXIS rlsnwtm rel_ub_q0p75 8 0.000000 191.250000 DEPOSIT ABSOLUTE /end AXIS_DESCR
 EXTENDED_LIMITS 0.000000 1.992188 /end CHARACTERISTIC
/begin CHARACTERISTIC KFPED "Pedalkennfeld (MR)" MAP 0x812F84 ME7_KF351 0 rel_uw_b200 0.000000 199.997000
 /begin AXIS_DESCR STD_AXIS wped_w relPED_uw_b100 16 0.000000 100.000000 DEPOSIT ABSOLUTE /end AXIS_DESCR
 /begin AXIS_DESCR STD_AXIS nmot_w nmot_uw_q0p25 12 0.000000 16383.800000 DEPOSIT ABSOLUTE /end AXIS_DESCR
 EXTENDED_LIMITS 0.000000 199.996948 /end CHARACTERISTIC
/begin CHARACTERISTIC KFPEDR "Pedalkennfeld fÅr RÅckwÑrtsgang bei Automatik-Fahrzeug" MAP 0x813140 ME7_KF351 0 rel_uw_b200 0.000000 199.997000
 /begin AXIS_DESCR STD_AXIS wped_w relPED_uw_b100 16 0.000000 100.000000 DEPOSIT ABSOLUTE /end AXIS_DESCR
 /begin AXIS_DESCR STD_AXIS nmot_w nmot_uw_q0p25 8 0.000000 16383.800000 DEPOSIT ABSOLUTE /end AXIS_DESCR
 EXTENDED_LIMITS 0.000000 199.996948 /end CHARACTERISTIC
/begin CHARACTERISTIC KFPLMR "P-Anteil von Luftmassenregler" MAP 0x8119D0 ME7_KF310 0 rel_sw_q0p0234 -768.000000 767.977000
 /begin AXIS_DESCR STD_AXIS drlm_w rel_sw_q0p0234 8 -768.000000 767.977000 DEPOSIT ABSOLUTE /end AXIS_DESCR
 /begin AXIS_DESCR STD_AXIS nmotll nmot_ub_q10 6 0.000000 2550.000000 DEPOSIT ABSOLUTE /end AXIS_DESCR
 EXTENDED_LIMITS -768.000000 767.976562 /end CHARACTERISTIC
/begin RECORD_LAYOUT ME7_KF310 NO_AXIS_PTS_X 1 UBYTE NO_AXIS_PTS_Y 2 UBYTE AXIS_PTS_X 3 SWORD INDEX_INCR DIRECT AXIS_PTS_Y 4 UBYTE INDEX_INCR DIRECT FNC_VALUES 5 SWORD COLUMN_DIR DIRECT /end RECORD_LAYOUT
/begin CHARACTERISTIC KFPRG "interner Abgaspartialdruck abhÑngig von NW-Verstellung bei sumode=0" MAP 0x81B2DC ME7_KF339 0 p_uw_q0p039 0.000000 2559.960000
 /begin AXIS_DESCR STD_AXIS wnwue kw_ub_q0p5 10 0.000000 127.500000 DEPOSIT ABSOLUTE /end AXIS_DESCR
 /begin AXIS_DESCR STD_AXIS nmot_w nmot_uw_q0p25 10 0.000000 16383.800000 DEPOSIT ABSOLUTE /end AXIS_DESCR
 EXTENDED_LIMITS 0.000000 2559.960938 /end CHARACTERISTIC
/begin CHARACTERISTIC KFQTE "Kennfeld Auf-/Absteuergeschwindigkeit der SollspÅlrate TankentlÅftung" MAP 0x819AFE ME7_GKF1 0 perio_ub_b0p012207 0.000000 0.012159
 /begin AXIS_DESCR COM_AXIS ml m_ub_b1020 0 0.000000 1020.000000 AXIS_PTS_REF SML06TEUB /end AXIS_DESCR
 /begin AXIS_DESCR COM_AXIS frmit fak_ub_b2 0 0.000000 1.992190 AXIS_PTS_REF SFR05TEUB /end AXIS_DESCR
/end CHARACTERISTIC
/begin CHARACTERISTIC KFRI "I - Kennfeld" MAP 0x819D36 ME7_GKF1 0 fak_ub_b77p81 0.000000 77.819800
 /begin AXIS_DESCR COM_AXIS nmot nmot_ub_q40 0 0.000000 10200.000000 AXIS_PTS_REF SNM07LRUB /end AXIS_DESCR
 /begin AXIS_DESCR COM_AXIS rl rel_ub_q0p75 0 0.000000 191.250000 AXIS_PTS_REF SRL06LRUB /end AXIS_DESCR
 EXTENDED_LIMITS 0.000000 77.819824 /end CHARACTERISTIC
/begin CHARACTERISTIC KFRI2 "LR-I-Kennfeld fÅr Bank 2" MAP 0x819D60 ME7_GKF1 0 fak_ub_b77p81 0.000000 77.819800
 /begin AXIS_DESCR COM_AXIS nmot nmot_ub_q40 0 0.000000 10200.000000 AXIS_PTS_REF SNM07LRUB /end AXIS_DESCR
 /begin AXIS_DESCR COM_AXIS rl rel_ub_q0p75 0 0.000000 191.250000 AXIS_PTS_REF SRL06LRUB /end AXIS_DESCR
 EXTENDED_LIMITS 0.000000 77.819824 /end CHARACTERISTIC
/begin CHARACTERISTIC KFRINH "Kennfeld fÅr Nernst-Innenwiderstand hinter Kat" MAP 0x8183B9 ME7_KF289 0 r_q8 0.000000 2040.000000
 /begin AXIS_DESCR STD_AXIS tkatmf temp_ub_q5_o50 5 -50.000000 1225.000000 DEPOSIT ABSOLUTE /end AXIS_DESCR
 /begin AXIS_DESCR STD_AXIS phlsnhf fak_ub_q0p01 3 0.000000 2.550000 DEPOSIT ABSOLUTE /end AXIS_DESCR
/end CHARACTERISTIC
/begin CHARACTERISTIC KFRINV "Kennfeld fÅr Nernst-Innenwiderstand vor Kat" MAP 0x81AD82 ME7_KF289 0 r_q8 0.000000 2040.000000
 /begin AXIS_DESCR STD_AXIS tabgmf temp_ub_q5_o50 5 -50.000000 1225.000000 DEPOSIT ABSOLUTE /end AXIS_DESCR
 /begin AXIS_DESCR STD_AXIS phlsnvf fak_ub_q0p01 3 0.000000 2.550000 DEPOSIT ABSOLUTE /end AXIS_DESCR
/end CHARACTERISTIC
/begin CHARACTERISTIC KFRLIP_UM "Kennfeld fÅr rl - Berechnung aus Drosselklappenwinkel in der FunktionsÅberwachg" MAP 0x814011 ME7_KF289 0 rel_ub_q0p75 0.000000 191.250000
 /begin AXIS_DESCR STD_AXIS ipsn_um spg_ub_q0p019 8 0.000000 4.980470 DEPOSIT ABSOLUTE /end AXIS_DESCR
 /begin AXIS_DESCR STD_AXIS nmot_um nmot_ub_q40 8 0.000000 10200.000000 DEPOSIT ABSOLUTE /end AXIS_DESCR
/end CHARACTERISTIC
/begin CHARACTERISTIC KFRLMN "minimale FÅllung im befeuerten Betrieb" MAP 0x81875C ME7_GKF1 0 rel_ub_q0p75 0.000000 191.250000
 /begin AXIS_DESCR COM_AXIS nmot nmot_ub_q40 0 0.000000 10200.000000 AXIS_PTS_REF SNM12FEUB /end AXIS_DESCR
 /begin AXIS_DESCR COM_AXIS tmot temp_ub_q0p75_o48 0 -48.000000 143.250000 AXIS_PTS_REF STM04FEUB /end AXIS_DESCR
/end CHARACTERISTIC
/begin CHARACTERISTIC KFRLMNSA "minimales rl bei Schubabschalten" MAP 0x81878C ME7_GKF1 0 rel_ub_q0p75 0.000000 191.250000
 /begin AXIS_DESCR COM_AXIS nmot nmot_ub_q40 0 0.000000 10200.000000 AXIS_PTS_REF SNM12FEUB /end AXIS_DESCR
 /begin AXIS_DESCR COM_AXIS tmot temp_ub_q0p75_o48 0 -48.000000 143.250000 AXIS_PTS_REF STM04FEUB /end AXIS_DESCR
/end CHARACTERISTIC
/begin CHARACTERISTIC KFRP "P - Kennfeld" MAP 0x819D8A ME7_GKF1 0 fak_ub_b12p45 0.000000 9.765630
 /begin AXIS_DESCR COM_AXIS nmot nmot_ub_q40 0 0.000000 10200.000000 AXIS_PTS_REF SNM07LRUB /end AXIS_DESCR
 /begin AXIS_DESCR COM_AXIS rl rel_ub_q0p75 0 0.000000 191.250000 AXIS_PTS_REF SRL06LRUB /end AXIS_DESCR
 EXTENDED_LIMITS 0.000000 12.451172 /end CHARACTERISTIC
/begin CHARACTERISTIC KFRP2 "LR-P-Kennfeld fÅr rechten Abgasstrang" MAP 0x819DB4 ME7_GKF1 0 fak_ub_b12p45 0.000000 9.765630
 /begin AXIS_DESCR COM_AXIS nmot nmot_ub_q40 0 0.000000 10200.000000 AXIS_PTS_REF SNM07LRUB /end AXIS_DESCR
 /begin AXIS_DESCR COM_AXIS rl rel_ub_q0p75 0 0.000000 191.250000 AXIS_PTS_REF SRL06LRUB /end AXIS_DESCR
 EXTENDED_LIMITS 0.000000 12.451172 /end CHARACTERISTIC
/begin CHARACTERISTIC KFRTV "TV - Kennfeld (Lambdaregelung Reglerumschaltverzîgerung)" MAP 0x819DDE ME7_GKF2 0 t10msxs_sb_q0p01 -1.280000 1.270000
 /begin AXIS_DESCR COM_AXIS nmot nmot_ub_q40 0 0.000000 10200.000000 AXIS_PTS_REF SNM07LRUB /end AXIS_DESCR
 /begin AXIS_DESCR COM_AXIS rl rel_ub_q0p75 0 0.000000 191.250000 AXIS_PTS_REF SRL06LRUB /end AXIS_DESCR
/end CHARACTERISTIC
/begin CHARACTERISTIC KFRTV2 "TV - Kennfeld Bank 2" MAP 0x819E08 ME7_GKF2 0 t10msxs_sb_q0p01 -1.280000 1.270000
 /begin AXIS_DESCR COM_AXIS nmot nmot_ub_q40 0 0.000000 10200.000000 AXIS_PTS_REF SNM07LRUB /end AXIS_DESCR
 /begin AXIS_DESCR COM_AXIS rl rel_ub_q0p75 0 0.000000 191.250000 AXIS_PTS_REF SRL06LRUB /end AXIS_DESCR
/end CHARACTERISTIC
/begin CHARACTERISTIC KFSWKFZK "Schwelle der ZW-SpÑtverstellungen fÅr ZW-Kennfeldumschaltung" MAP 0x819F01 ME7_GKF1 0 zw_ub_qn0p75 -191.250000 0.000000
 /begin AXIS_DESCR COM_AXIS nmot nmot_ub_q40 0 0.000000 10200.000000 AXIS_PTS_REF SNM16ZUUB /end AXIS_DESCR
 /begin AXIS_DESCR COM_AXIS rl rel_ub_q0p75 0 0.000000 191.250000 AXIS_PTS_REF SRL12ZUUB /end AXIS_DESCR
/end CHARACTERISTIC
/begin CHARACTERISTIC KFSZDUB "Schlie·zeitkorrektur in AbhÑngigkeit von UB" MAP 0x81631B ME7_KF289 0 fak_ub_b8 0.000000 7.968750
 /begin AXIS_DESCR STD_AXIS uzue spg_ubatt 7 0.000000 17.952000 DEPOSIT ABSOLUTE /end AXIS_DESCR
 /begin AXIS_DESCR STD_AXIS tsrldyn txms_ub_q0p1 16 0.000000 25.500000 DEPOSIT ABSOLUTE /end AXIS_DESCR
/end CHARACTERISTIC
/begin CHARACTERISTIC KFSZT "Schlie·zeit-Kennfeld" MAP 0x8163A4 ME7_KF289 0 txms_ub_q0p1 0.000000 25.500000
 /begin AXIS_DESCR STD_AXIS ub spg_ubatt 8 0.000000 17.952000 DEPOSIT ABSOLUTE /end AXIS_DESCR
 /begin AXIS_DESCR STD_AXIS nmot nmot_ub_q40 8 0.000000 10200.000000 DEPOSIT ABSOLUTE /end AXIS_DESCR
/end CHARACTERISTIC
/begin CHARACTERISTIC KFTADMS "dynamischer Bewertungsfaktor fÅr das Absteuern des TEV" MAP 0x813512 ME7_KF295 0 fak_ub_b2 0.000000 1.992190
 /begin AXIS_DESCR STD_AXIS dmssginr fak_sb_b1 5 -1.000000 0.992188 DEPOSIT ABSOLUTE /end AXIS_DESCR
 /begin AXIS_DESCR STD_AXIS nmot nmot_ub_q40 4 0.000000 10200.000000 DEPOSIT ABSOLUTE /end AXIS_DESCR
 EXTENDED_LIMITS 0.000000 1.992188 /end CHARACTERISTIC
/begin RECORD_LAYOUT ME7_KF295 NO_AXIS_PTS_X 1 UBYTE NO_AXIS_PTS_Y 2 UBYTE AXIS_PTS_X 3 SBYTE INDEX_INCR DIRECT AXIS_PTS_Y 4 UBYTE INDEX_INCR DIRECT FNC_VALUES 5 UBYTE COLUMN_DIR DIRECT /end RECORD_LAYOUT
/begin CHARACTERISTIC KFTAGAV "AGR-Temperatur am Ausla·ventil" MAP 0x81B51A ME7_KF289 0 temp_ub_q5_o50 -50.000000 1225.000000
 /begin AXIS_DESCR STD_AXIS rl rel_ub_q0p75 6 0.000000 191.250000 DEPOSIT ABSOLUTE /end AXIS_DESCR
 /begin AXIS_DESCR STD_AXIS nmot nmot_ub_q40 6 0.000000 10200.000000 DEPOSIT ABSOLUTE /end AXIS_DESCR
/end CHARACTERISTIC
/begin CHARACTERISTIC KFTARX "Kennfeld Maximalfuellung Tans Korrekturfaktor" MAP 0x819607 ME7_GKF1 0 fak_ub_b2 0.000000 1.992190
 /begin AXIS_DESCR COM_AXIS nmot nmot_ub_q40 0 0.000000 10200.000000 AXIS_PTS_REF SNM08LDUB /end AXIS_DESCR
 /begin AXIS_DESCR COM_AXIS tans temp_ub_q0p75_o48 0 -48.000000 143.250000 AXIS_PTS_REF STA08LDUB /end AXIS_DESCR
 EXTENDED_LIMITS 0.000000 1.992188 /end CHARACTERISTIC
/begin CHARACTERISTIC KFTARXZK "Kennfeld Maximalfuellung Tans Korrekturfaktor bei Dauerklopfen" MAP 0x819647 ME7_GKF1 0 fak_ub_b2 0.000000 1.992190
 /begin AXIS_DESCR COM_AXIS nmot nmot_ub_q40 0 0.000000 10200.000000 AXIS_PTS_REF SNM08LDUB /end AXIS_DESCR
 /begin AXIS_DESCR COM_AXIS tans temp_ub_q0p75_o48 0 -48.000000 143.250000 AXIS_PTS_REF STA08LDUB /end AXIS_DESCR
 EXTENDED_LIMITS 0.000000 1.992188 /end CHARACTERISTIC
/begin CHARACTERISTIC KFTATM "Kennfeld Abgastemperatur   f(nmot,rl)" MAP 0x81843C ME7_KF289 0 temp_ub_q5_o50 -50.000000 1225.000000
 /begin AXIS_DESCR STD_AXIS nmot nmot_ub_q40 8 0.000000 10200.000000 DEPOSIT ABSOLUTE /end AXIS_DESCR
 /begin AXIS_DESCR STD_AXIS rl rel_ub_q0p75 8 0.000000 191.250000 DEPOSIT ABSOLUTE /end AXIS_DESCR
/end CHARACTERISTIC
/begin CHARACTERISTIC KFTATX "Kennfeld fÅr maximales TastverhÑltnis" MAP 0x819B1C ME7_KF289 0 rel_ub_b99p6 0.000000 99.609400
 /begin AXIS_DESCR STD_AXIS nmot nmot_ub_q40 10 0.000000 10200.000000 DEPOSIT ABSOLUTE /end AXIS_DESCR
 /begin AXIS_DESCR STD_AXIS pspu fak_ub_b2 6 0.000000 1.992190 DEPOSIT ABSOLUTE /end AXIS_DESCR
 EXTENDED_LIMITS 0.000000 99.609375 /end CHARACTERISTIC
/begin CHARACTERISTIC KFTEKA "Kennfeld Sollkraftstoffanteil bei Regenerierung" MAP 0x81D954 ME7_KF290 0 fak_sb_b1 0.000000 0.992188
 /begin AXIS_DESCR STD_AXIS nmot nmot_ub_q40 5 0.000000 10200.000000 DEPOSIT ABSOLUTE /end AXIS_DESCR
 /begin AXIS_DESCR STD_AXIS rl rel_ub_q0p75 5 0.000000 191.250000 DEPOSIT ABSOLUTE /end AXIS_DESCR
 EXTENDED_LIMITS -1.000000 0.992188 /end CHARACTERISTIC
/begin CHARACTERISTIC KFTEVP "Kennfeld Periodendauer TEV" MAP 0x819B73 ME7_KF289 0 t500usxms_ub_q0p5 0.000000 127.500000
 /begin AXIS_DESCR STD_AXIS nmot nmot_ub_q40 5 0.000000 10200.000000 DEPOSIT ABSOLUTE /end AXIS_DESCR
 /begin AXIS_DESCR STD_AXIS tateroh rel_ub_b99p6 9 0.000000 99.609400 DEPOSIT ABSOLUTE /end AXIS_DESCR
/end CHARACTERISTIC
/begin CHARACTERISTIC KFTPKOR "Korrekturkennfeld fÅr gemessene Periodendauer TP (tpsvkof)" MAP 0x818530 ME7_KF289 0 fak_ub_b2 0.000000 1.992190
 /begin AXIS_DESCR STD_AXIS nmot nmot_ub_q40 8 0.000000 10200.000000 DEPOSIT ABSOLUTE /end AXIS_DESCR
 /begin AXIS_DESCR STD_AXIS rl rel_ub_q0p75 7 0.000000 191.250000 DEPOSIT ABSOLUTE /end AXIS_DESCR
 EXTENDED_LIMITS 0.000000 1.992188 /end CHARACTERISTIC
/begin CHARACTERISTIC KFTSDYN "Schlie·zeitkorrektur in AbhÑngigkeit des Drehzahlgradienten" MAP 0x8139C2 ME7_KF309 0 fak_uw_b8 0.000000 7.999880
 /begin AXIS_DESCR STD_AXIS ngfil_w nmotg_sw_q0p39 3 -12800.200000 12799.800000 DEPOSIT ABSOLUTE /end AXIS_DESCR
 /begin AXIS_DESCR STD_AXIS nmot nmot_ub_q40 8 0.000000 10200.000000 DEPOSIT ABSOLUTE /end AXIS_DESCR
 EXTENDED_LIMITS 0.000000 7.999878 /end CHARACTERISTIC
/begin CHARACTERISTIC KFTSRL "Schlie·zeitkennfeld" MAP 0x8163F6 ME7_KF289 0 txms_ub_q0p1 0.000000 25.500000
 /begin AXIS_DESCR STD_AXIS nmot nmot_ub_q40 9 0.000000 10200.000000 DEPOSIT ABSOLUTE /end AXIS_DESCR
 /begin AXIS_DESCR STD_AXIS rl rel_ub_q0p75 10 0.000000 191.250000 DEPOSIT ABSOLUTE /end AXIS_DESCR
/end CHARACTERISTIC
/begin CHARACTERISTIC KFTVFRR "Kennfeld: Lambda-Regler nach dieser Zeit auf Referenzwert zurÅcksetzen" MAP 0x819BFA ME7_KF289 0 t100msxs_ub_b25p5 0.000000 25.500000
 /begin AXIS_DESCR STD_AXIS tadteazs rel_ub_b99p6 4 0.000000 99.609400 DEPOSIT ABSOLUTE /end AXIS_DESCR
 /begin AXIS_DESCR STD_AXIS ml m_ub_b1020 3 0.000000 1020.000000 DEPOSIT ABSOLUTE /end AXIS_DESCR
/end CHARACTERISTIC
/begin CHARACTERISTIC KFTVLDRE "Kennfeld tastverhÑltnisersatzwert fÅr LDR" MAP 0x8154FC ME7_KF289 0 tv_ub_b100 0.000000 99.609400
 /begin AXIS_DESCR STD_AXIS nmot nmot_ub_q40 8 0.000000 10200.000000 DEPOSIT ABSOLUTE /end AXIS_DESCR
 /begin AXIS_DESCR STD_AXIS plsol p_ub_q10 4 0.000000 2550.000000 DEPOSIT ABSOLUTE /end AXIS_DESCR
 EXTENDED_LIMITS 0.000000 99.609375 /end CHARACTERISTIC
/begin CHARACTERISTIC KFTVSA "Verzîgerungszeit fÅr Schubabschalten" MAP 0x819780 ME7_GKF1 0 t10msxs_ub_b2p55 0.000000 2.550000
 /begin AXIS_DESCR COM_AXIS tmot temp_ub_q0p75_o48 0 -48.000000 143.250000 AXIS_PTS_REF STM05SAUB /end AXIS_DESCR
 /begin AXIS_DESCR COM_AXIS nmot nmot_ub_q40 0 0.000000 10200.000000 AXIS_PTS_REF SNM08__UB /end AXIS_DESCR
/end CHARACTERISTIC
/begin CHARACTERISTIC KFTVTEV "Kennfeld Verzugszeit TankentlÅftungsventil" MAP 0x819BB0 ME7_KF289 0 t500usxms_ub_q0p5 0.000000 127.500000
 /begin AXIS_DESCR STD_AXIS ub spg_ubatt 6 0.000000 17.952000 DEPOSIT ABSOLUTE /end AXIS_DESCR
 /begin AXIS_DESCR STD_AXIS tans temp_ub_q0p75_o48 3 -48.000000 143.250000 DEPOSIT ABSOLUTE /end AXIS_DESCR
/end CHARACTERISTIC
/begin CHARACTERISTIC KFURL "Umrechnungsfaktor von ps->rl abhÑngig von NW-Verstellung bei sumode=0" MAP 0x81B3C4 ME7_KF339 0 rel_uw_b0p3 0.000000 0.299995
 /begin AXIS_DESCR STD_AXIS wnwue kw_ub_q0p5 10 0.000000 127.500000 DEPOSIT ABSOLUTE /end AXIS_DESCR
 /begin AXIS_DESCR STD_AXIS nmot_w nmot_uw_q0p25 10 0.000000 16383.800000 DEPOSIT ABSOLUTE /end AXIS_DESCR
/end CHARACTERISTIC
/begin CHARACTERISTIC KFUSHK "Sondenspannungssollwert fÅr Regelung hinter Kat. (statt KFUSRHK fÅr Variantenk.)" MAP 0x819CE9 ME7_GKF1 0 spg_ub_q0p0052_o0p2 -0.200000 1.130000
 /begin AXIS_DESCR COM_AXIS nmot nmot_ub_q40 0 0.000000 10200.000000 AXIS_PTS_REF SNM06LHUB /end AXIS_DESCR
 /begin AXIS_DESCR COM_AXIS rl rel_ub_q0p75 0 0.000000 191.250000 AXIS_PTS_REF SRL06LHUB /end AXIS_DESCR
/end CHARACTERISTIC
/begin CHARACTERISTIC KFVAKL "Faktor Verzîgerungsabmagerung (K+L-Anteil)" MAP 0x818DBF ME7_GKF1 0 fak_ub_b16 0.000000 15.937500
 /begin AXIS_DESCR COM_AXIS tmot temp_ub_q0p75_o48 0 -48.000000 143.250000 AXIS_PTS_REF STM09ESUB /end AXIS_DESCR
 /begin AXIS_DESCR COM_AXIS nmot nmot_ub_q40 0 0.000000 10200.000000 AXIS_PTS_REF SNM07ESUB /end AXIS_DESCR
/end CHARACTERISTIC
/begin CHARACTERISTIC KFVOFFS_0_A "Geschwindigkeits-Offset fÅr FGR-Regler" MAP 0x810D4A ME7_GKF3 0 vfzg_uw_b512 0.000000 511.992000
 /begin AXIS_DESCR COM_AXIS vziel_w vfzg_uw_b512 0 0.000000 511.992000 AXIS_PTS_REF SVZ06MFUW /end AXIS_DESCR
 /begin AXIS_DESCR COM_AXIS uevges fak_q0p1 0 0.000000 25.500000 AXIS_PTS_REF SUE08MFUB /end AXIS_DESCR
 EXTENDED_LIMITS 0.000000 511.992188 /end CHARACTERISTIC
/begin CHARACTERISTIC KFVOFFS_1_A "Geschwindigkeits-Offset fÅr FGR-Regler" MAP 0x810DAA ME7_GKF3 0 vfzg_uw_b512 0.000000 511.992000
 /begin AXIS_DESCR COM_AXIS vziel_w vfzg_uw_b512 0 0.000000 511.992000 AXIS_PTS_REF SVZ06MFUW /end AXIS_DESCR
 /begin AXIS_DESCR COM_AXIS uevges fak_q0p1 0 0.000000 25.500000 AXIS_PTS_REF SUE08MFUB /end AXIS_DESCR
 EXTENDED_LIMITS 0.000000 511.992188 /end CHARACTERISTIC
/begin CHARACTERISTIC KFVPDKLD "Max. zulÑssiges DruckverhÑltnis DK fÅr ldra Diagnose" MAP 0x8196F3 ME7_KF289 0 fak_ub_b4 0.000000 3.984380
 /begin AXIS_DESCR STD_AXIS nmot nmot_ub_q40 8 0.000000 10200.000000 DEPOSIT ABSOLUTE /end AXIS_DESCR
 /begin AXIS_DESCR STD_AXIS wdkba relDK_ub_b100 8 0.000000 100.000000 DEPOSIT ABSOLUTE /end AXIS_DESCR
 EXTENDED_LIMITS 0.000000 3.984375 /end CHARACTERISTIC
/begin CHARACTERISTIC KFVPDKSD "SolldruckverhÑltnis DK im Dynamikbetrieb" MAP 0x81260C ME7_GKF3 0 fak_uw_b2 0.000000 1.999970
 /begin AXIS_DESCR COM_AXIS nmot_w nmot_uw_q0p25 0 0.000000 16383.800000 AXIS_PTS_REF SNM12LDUW /end AXIS_DESCR
 /begin AXIS_DESCR COM_AXIS vpsspu_w fak_uw_b4 0 0.000000 3.999940 AXIS_PTS_REF SVP12LDUW /end AXIS_DESCR
 EXTENDED_LIMITS 0.000000 1.999969 /end CHARACTERISTIC
/begin CHARACTERISTIC KFVPDKSE "SolldruckverhÑltnis DK im StationÑrbetrieb" MAP 0x81272C ME7_GKF3 0 fak_uw_b2 0.000000 1.999970
 /begin AXIS_DESCR COM_AXIS nmot_w nmot_uw_q0p25 0 0.000000 16383.800000 AXIS_PTS_REF SNM12LDUW /end AXIS_DESCR
 /begin AXIS_DESCR COM_AXIS vpsspu_w fak_uw_b4 0 0.000000 3.999940 AXIS_PTS_REF SVP12LDUW /end AXIS_DESCR
 EXTENDED_LIMITS 0.000000 1.999969 /end CHARACTERISTIC
/begin CHARACTERISTIC KFWDKMSN "Kennfeld fÅr Drosselklappen-Sollwinkel" MAP 0x811A9C ME7_KF351 0 rel_uw_b100 0.000000 99.998500
 /begin AXIS_DESCR STD_AXIS mlwdkns_w m_uw_b6553p5 16 0.000000 6553.500000 DEPOSIT ABSOLUTE /end AXIS_DESCR
 /begin AXIS_DESCR STD_AXIS nmot_w nmot_uw_q0p25 6 0.000000 16383.800000 DEPOSIT ABSOLUTE /end AXIS_DESCR
 EXTENDED_LIMITS 0.000000 99.998474 /end CHARACTERISTIC
/begin CHARACTERISTIC KFWDKPP "Ersatzwert fÅr Drosselklappenwinkel aus FÅllungssignal" MAP 0x814DD9 ME7_KF289 0 relDK_ub_b100 0.000000 100.000000
 /begin AXIS_DESCR STD_AXIS nmot nmot_ub_q40 12 0.000000 10200.000000 DEPOSIT ABSOLUTE /end AXIS_DESCR
 /begin AXIS_DESCR STD_AXIS rlvppl rel_ub_q0p75 12 0.000000 191.250000 DEPOSIT ABSOLUTE /end AXIS_DESCR
/end CHARACTERISTIC
/begin CHARACTERISTIC KFWDKSMX "maximaler Solldrosselklappenwinkel" MAP 0x81B56C ME7_KF351 0 rel_uw_b100 0.000000 99.998500
 /begin AXIS_DESCR STD_AXIS nmot_w nmot_uw_q0p25 10 0.000000 16383.800000 DEPOSIT ABSOLUTE /end AXIS_DESCR
 /begin AXIS_DESCR STD_AXIS fho_w fak_uw_b4 3 0.000000 3.999940 DEPOSIT ABSOLUTE /end AXIS_DESCR
 EXTENDED_LIMITS 0.000000 99.998474 /end CHARACTERISTIC
/begin CHARACTERISTIC KFWEE "Kennfeld Winkel Einspritzende" MAP 0x818A1C ME7_GKF1 0 zw_ub_q6 0.000000 1530.000000
 /begin AXIS_DESCR COM_AXIS rl rel_ub_q0p75 0 0.000000 191.250000 AXIS_PTS_REF SRL08GKUB /end AXIS_DESCR
 /begin AXIS_DESCR COM_AXIS nmot nmot_ub_q40 0 0.000000 10200.000000 AXIS_PTS_REF SNM08GKUB /end AXIS_DESCR
/end CHARACTERISTIC
/begin CHARACTERISTIC KFWEEK "Kennfeld-Kalt Winkel Einspritzende" MAP 0x818A5C ME7_GKF1 0 zw_ub_q6 0.000000 1530.000000
 /begin AXIS_DESCR COM_AXIS rl rel_ub_q0p75 0 0.000000 191.250000 AXIS_PTS_REF SRL08GKUB /end AXIS_DESCR
 /begin AXIS_DESCR COM_AXIS nmot nmot_ub_q40 0 0.000000 10200.000000 AXIS_PTS_REF SNM08GKUB /end AXIS_DESCR
/end CHARACTERISTIC
/begin CHARACTERISTIC KFWHSTT "Wichtungskennfeld Hei·start" MAP 0x815249 ME7_KF289 0 fak_ub_b2 0.000000 1.992190
 /begin AXIS_DESCR STD_AXIS tans temp_ub_q0p75_o48 6 -48.000000 143.250000 DEPOSIT ABSOLUTE /end AXIS_DESCR
 /begin AXIS_DESCR STD_AXIS anztist dez 6 0.000000 255.000000 DEPOSIT ABSOLUTE /end AXIS_DESCR
 EXTENDED_LIMITS 0.000000 1.992188 /end CHARACTERISTIC
/begin CHARACTERISTIC KFWKSTAB "Faktor Wiederholkaltstart zur Reduzierung der Startmenge" MAP 0x811F3E ME7_KF301 0 fak_ub_b2 0.000000 1.992190
 /begin AXIS_DESCR STD_AXIS tabst_w t1sxs_uw_q1 4 0.000000 65535.000000 DEPOSIT ABSOLUTE /end AXIS_DESCR
 /begin AXIS_DESCR STD_AXIS tmst temp_ub_q0p75_o48 4 -48.000000 143.250000 DEPOSIT ABSOLUTE /end AXIS_DESCR
 EXTENDED_LIMITS 0.000000 1.992188 /end CHARACTERISTIC
/begin CHARACTERISTIC KFWKSTN "Wichtungskennfeld Kaltstart" MAP 0x81527B ME7_KF289 0 fak_ub_b1 0.000000 0.996094
 /begin AXIS_DESCR STD_AXIS tmst temp_ub_q0p75_o48 4 -48.000000 143.250000 DEPOSIT ABSOLUTE /end AXIS_DESCR
 /begin AXIS_DESCR STD_AXIS nmot nmot_ub_q40 4 0.000000 10200.000000 DEPOSIT ABSOLUTE /end AXIS_DESCR
/end CHARACTERISTIC
/begin CHARACTERISTIC KFWKSTT "Wichtungskennfeld Kaltstart" MAP 0x815295 ME7_KF289 0 fak_ub_b2 0.000000 1.992190
 /begin AXIS_DESCR STD_AXIS tmst temp_ub_q0p75_o48 12 -48.000000 143.250000 DEPOSIT ABSOLUTE /end AXIS_DESCR
 /begin AXIS_DESCR STD_AXIS anztist dez 6 0.000000 255.000000 DEPOSIT ABSOLUTE /end AXIS_DESCR
 EXTENDED_LIMITS 0.000000 1.992188 /end CHARACTERISTIC
/begin CHARACTERISTIC KFWLHO "Kennfeld fÅr HîhenabhÑngigkeit des Warmlauffaktors" MAP 0x815397 ME7_GKF1 0 fak_ub_b4 0.000000 3.984380
 /begin AXIS_DESCR COM_AXIS fho fak_ub_b4 0 0.000000 3.984380 AXIS_PTS_REF FHO04ESUB /end AXIS_DESCR
 /begin AXIS_DESCR COM_AXIS rl rel_ub_q0p75 0 0.000000 191.250000 AXIS_PTS_REF SRL12ESUB /end AXIS_DESCR
 EXTENDED_LIMITS 0.000000 3.984375 /end CHARACTERISTIC
/begin CHARACTERISTIC KFWMABG "Kennfeld fÅr WÑrmemengen-Schwellwert Taupunktende Abgas" MAP 0x81AC6A ME7_GKF3 0 q_uw_q0p0566 0.000000 3712.000000
 /begin AXIS_DESCR COM_AXIS tabgmst temp_ub_q5_o50 0 -50.000000 1225.000000 AXIS_PTS_REF ST107TMUB /end AXIS_DESCR
 /begin AXIS_DESCR COM_AXIS tmst temp_ub_q0p75_o48 0 -48.000000 143.250000 AXIS_PTS_REF STM05TMUB /end AXIS_DESCR
/end CHARACTERISTIC
/begin CHARACTERISTIC KFWMKAT "Kennfeld fÅr WÑrmemengen-Schwellwert Taupunktende hinter Kat" MAP 0x81ACB0 ME7_GKF3 0 q_uw_q0p0566 0.000000 3712.000000
 /begin AXIS_DESCR COM_AXIS tkatmst temp_ub_q5_o50 0 -50.000000 1225.000000 AXIS_PTS_REF ST307TMUB /end AXIS_DESCR
 /begin AXIS_DESCR COM_AXIS tmst temp_ub_q0p75_o48 0 -48.000000 143.250000 AXIS_PTS_REF STM05TMUB /end AXIS_DESCR
/end CHARACTERISTIC
/begin CHARACTERISTIC KFWPFGR "Inverses Pedalkennfeld fÅr FGR-Betrieb" MAP 0x81AF9A ME7_KF351 0 rel_uw_b100 0.000000 99.998500
 /begin AXIS_DESCR STD_AXIS mrfgr_w rel_uw_b200 16 0.000000 199.997000 DEPOSIT ABSOLUTE /end AXIS_DESCR
 /begin AXIS_DESCR STD_AXIS nmot_w nmot_uw_q0p25 12 0.000000 16383.800000 DEPOSIT ABSOLUTE /end AXIS_DESCR
 EXTENDED_LIMITS 0.000000 99.998474 /end CHARACTERISTIC
/begin CHARACTERISTIC KFWWNS "Wiederholstartzeitfaktor" MAP 0x81B5CC ME7_KF301 0 fak_ub_b2 0.000000 1.992190
 /begin AXIS_DESCR STD_AXIS tabst_w t1sxs_uw_q1 8 0.000000 65535.000000 DEPOSIT ABSOLUTE /end AXIS_DESCR
 /begin AXIS_DESCR STD_AXIS tmst temp_ub_q0p75_o48 8 -48.000000 143.250000 DEPOSIT ABSOLUTE /end AXIS_DESCR
 EXTENDED_LIMITS 0.000000 1.992188 /end CHARACTERISTIC
/begin CHARACTERISTIC KFZDASH2 "Zeitkonstante PT1-Filter Dashpot bei kleinem Kupplungsmoment" MAP 0x81D17A ME7_GKF3 0 zk10msxs_uw_b655 0.010000 655.360000
 /begin AXIS_DESCR COM_AXIS gangi dez 0 0.000000 255.000000 AXIS_PTS_REF SGA08MDUB /end AXIS_DESCR
 /begin AXIS_DESCR COM_AXIS nmot_w nmot_uw_q0p25 0 0.000000 16383.800000 AXIS_PTS_REF SNM06MDUW /end AXIS_DESCR
/end CHARACTERISTIC
/begin CHARACTERISTIC KFZDASH_0_A "Zeitkonstante PT1-Filter Dashpot" MAP 0x81D0BA ME7_GKF3 0 zk10msxs_uw_b655 0.010000 655.360000
 /begin AXIS_DESCR COM_AXIS gangi dez 0 0.000000 255.000000 AXIS_PTS_REF SGA08MDUB /end AXIS_DESCR
 /begin AXIS_DESCR COM_AXIS nmot_w nmot_uw_q0p25 0 0.000000 16383.800000 AXIS_PTS_REF SNM06MDUW /end AXIS_DESCR
/end CHARACTERISTIC
/begin CHARACTERISTIC KFZDASH_1_A "Zeitkonstante PT1-Filter Dashpot" MAP 0x81D11A ME7_GKF3 0 zk10msxs_uw_b655 0.010000 655.360000
 /begin AXIS_DESCR COM_AXIS gangi dez 0 0.000000 255.000000 AXIS_PTS_REF SGA08MDUB /end AXIS_DESCR
 /begin AXIS_DESCR COM_AXIS nmot_w nmot_uw_q0p25 0 0.000000 16383.800000 AXIS_PTS_REF SNM06MDUW /end AXIS_DESCR
/end CHARACTERISTIC
/begin CHARACTERISTIC KFZLSD_0_A "Zeitkonstante PT2-Filter LastschlagdÑmpfung" MAP 0x81D1DA ME7_GKF3 0 zk10msxs_uw_b655 0.010000 655.360000
 /begin AXIS_DESCR COM_AXIS gangi dez 0 0.000000 255.000000 AXIS_PTS_REF SGA08MDUB /end AXIS_DESCR
 /begin AXIS_DESCR COM_AXIS nmot_w nmot_uw_q0p25 0 0.000000 16383.800000 AXIS_PTS_REF SNM06MDUW /end AXIS_DESCR
/end CHARACTERISTIC
/begin CHARACTERISTIC KFZLSD_1_A "Zeitkonstante PT2-Filter LastschlagdÑmpfung" MAP 0x81D23A ME7_GKF3 0 zk10msxs_uw_b655 0.010000 655.360000
 /begin AXIS_DESCR COM_AXIS gangi dez 0 0.000000 255.000000 AXIS_PTS_REF SGA08MDUB /end AXIS_DESCR
 /begin AXIS_DESCR COM_AXIS nmot_w nmot_uw_q0p25 0 0.000000 16383.800000 AXIS_PTS_REF SNM06MDUW /end AXIS_DESCR
/end CHARACTERISTIC
/begin CHARACTERISTIC KFZNSM "Zeitkonstante fÅr Solldrehzahlabregelung" MAP 0x81553B ME7_GKF1 0 zk20msxs_ub_b5p1 0.020000 5.100000
 /begin AXIS_DESCR COM_AXIS tmot temp_ub_q0p75_o48 0 -48.000000 143.250000 AXIS_PTS_REF STM06LLUB /end AXIS_DESCR
 /begin AXIS_DESCR COM_AXIS dns nmotd_sb_q10 0 -1280.000000 1270.000000 AXIS_PTS_REF SNS06LLSB /end AXIS_DESCR
/end CHARACTERISTIC
/begin CHARACTERISTIC KFZW "ZÅndwinkelkennfeld" MAP 0x81606D ME7_GKF2 0 zw_sb_q0p75 -96.000000 95.250000
 /begin AXIS_DESCR COM_AXIS nmot nmot_ub_q40 0 0.000000 10200.000000 AXIS_PTS_REF SNM16ZUUB /end AXIS_DESCR
 /begin AXIS_DESCR COM_AXIS rl rel_ub_q0p75 0 0.000000 191.250000 AXIS_PTS_REF SRL12ZUUB /end AXIS_DESCR
/end CHARACTERISTIC
/begin CHARACTERISTIC KFZW2 "ZÅndwinkelkennfeld Variante 2" MAP 0x81612D ME7_GKF2 0 zw_sb_q0p75 -96.000000 95.250000
 /begin AXIS_DESCR COM_AXIS nmot nmot_ub_q40 0 0.000000 10200.000000 AXIS_PTS_REF SNM16ZUUB /end AXIS_DESCR
 /begin AXIS_DESCR COM_AXIS rl rel_ub_q0p75 0 0.000000 191.250000 AXIS_PTS_REF SRL12ZUUB /end AXIS_DESCR
/end CHARACTERISTIC
/begin CHARACTERISTIC KFZWMN "Min-ZÅndwinkel" MAP 0x81378E ME7_KF290 0 zw_sb_q0p75 -96.000000 95.250000
 /begin AXIS_DESCR STD_AXIS nmot nmot_ub_q40 16 0.000000 10200.000000 DEPOSIT ABSOLUTE /end AXIS_DESCR
 /begin AXIS_DESCR STD_AXIS rl rel_ub_q0p75 12 0.000000 191.250000 DEPOSIT ABSOLUTE /end AXIS_DESCR
/end CHARACTERISTIC
/begin CHARACTERISTIC KFZWMNST "Min-ZÅndwinkel fÅr Start und Nachstart" MAP 0x81386C ME7_KF290 0 zw_sb_q0p75 -96.000000 95.250000
 /begin AXIS_DESCR STD_AXIS nmot nmot_ub_q40 16 0.000000 10200.000000 DEPOSIT ABSOLUTE /end AXIS_DESCR
 /begin AXIS_DESCR STD_AXIS rl rel_ub_q0p75 12 0.000000 191.250000 DEPOSIT ABSOLUTE /end AXIS_DESCR
/end CHARACTERISTIC
/begin CHARACTERISTIC KFZWMS "Kennfeld mit dauerhaft spÑtest mîglichem ZÅndwinkel" MAP 0x815FAD ME7_GKF2 0 zw_sb_q0p75 -96.000000 95.250000
 /begin AXIS_DESCR COM_AXIS nmot nmot_ub_q40 0 0.000000 10200.000000 AXIS_PTS_REF SNM16ZUUB /end AXIS_DESCR
 /begin AXIS_DESCR COM_AXIS rl rel_ub_q0p75 0 0.000000 191.250000 AXIS_PTS_REF SRL12ZUUB /end AXIS_DESCR
/end CHARACTERISTIC
/begin CHARACTERISTIC KFZWOP "optimaler ZÅndwinkel" MAP 0x815813 ME7_GKF2 0 zw_sb_q0p75 -96.000000 95.250000
 /begin AXIS_DESCR COM_AXIS nmot_w nmot_uw_q0p25 0 0.000000 16383.800000 AXIS_PTS_REF SNM16OPUW /end AXIS_DESCR
 /begin AXIS_DESCR COM_AXIS rl_w_kge rel_uw_q0p0234 0 0.000000 1535.980000 AXIS_PTS_REF SRL11OPUW /end AXIS_DESCR
/end CHARACTERISTIC
/begin CHARACTERISTIC KFZWOP2 "optimaler ZÅndwinkel Variante 2" MAP 0x8158C3 ME7_GKF2 0 zw_sb_q0p75 -96.000000 95.250000
 /begin AXIS_DESCR COM_AXIS nmot_w nmot_uw_q0p25 0 0.000000 16383.800000 AXIS_PTS_REF SNM16OPUW /end AXIS_DESCR
 /begin AXIS_DESCR COM_AXIS rl_w_kge rel_uw_q0p0234 0 0.000000 1535.980000 AXIS_PTS_REF SRL11OPUW /end AXIS_DESCR
/end CHARACTERISTIC
/begin CHARACTERISTIC KFZWWLNM "Delta ZÅndwinkel im Warmlauf" MAP 0x816236 ME7_GKF2 0 zw_sb_q0p75 -96.000000 95.250000
 /begin AXIS_DESCR COM_AXIS nmot nmot_ub_q40 0 0.000000 10200.000000 AXIS_PTS_REF SNM12ESUB /end AXIS_DESCR
 /begin AXIS_DESCR COM_AXIS tans temp_ub_q0p75_o48 0 -48.000000 143.250000 AXIS_PTS_REF STA12WLUB /end AXIS_DESCR
/end CHARACTERISTIC
/begin CHARACTERISTIC KFZWWLRL "Delta ZÅndwinkel im Warmlauf" MAP 0x8162C6 ME7_GKF2 0 zw_sb_q0p75 -96.000000 95.250000
 /begin AXIS_DESCR COM_AXIS tmot temp_ub_q0p75_o48 0 -48.000000 143.250000 AXIS_PTS_REF STM12ESUB /end AXIS_DESCR
 /begin AXIS_DESCR COM_AXIS rl rel_ub_q0p75 0 0.000000 191.250000 AXIS_PTS_REF SRL06ESUB /end AXIS_DESCR
/end CHARACTERISTIC
/begin CHARACTERISTIC KFZW_UC "" MAP 0x815CE3 ME7_GKF2 0 zw_sb_q0p75 -96.000000 95.250000
 /begin AXIS_DESCR COM_AXIS rl_uc rel_ub_q0p75 0 0.000000 191.250000 AXIS_PTS_REF RLV08_UC /end AXIS_DESCR
 /begin AXIS_DESCR COM_AXIS nmot_uc nmot_ub_q40 0 0.000000 10200.000000 AXIS_PTS_REF NZWV08_UC /end AXIS_DESCR
/end CHARACTERISTIC
/begin CHARACTERISTIC KFZW_UM "Kennfeld fÅr optimalen ZÅndwinkel in der FunktionsÅberwachung" MAP 0x8140D8 ME7_GKF2 0 zw_sb_q0p75 -96.000000 95.250000
 /begin AXIS_DESCR COM_AXIS rl_um rel_ub_q0p75 0 0.000000 191.250000 AXIS_PTS_REF RLV08_UM /end AXIS_DESCR
 /begin AXIS_DESCR COM_AXIS nmot_um nmot_ub_q40 0 0.000000 10200.000000 AXIS_PTS_REF NZWV08_UM /end AXIS_DESCR
/end CHARACTERISTIC
/begin CHARACTERISTIC KHCTEMN "Minimalwert HC-Konzentration Regeneriergas TankentlÅftung" VALUE 0x819B6A ME7_FW2 0 fak_sb_b2 -2.000000 1.984380 EXTENDED_LIMITS -2.000000 1.984375 /end CHARACTERISTIC
/begin CHARACTERISTIC KHCTEMX "Maximalwert HC-Konzentration Regeneriergas TankentlÅftung" VALUE 0x819B6B ME7_FW2 0 fak_sb_b2 -2.000000 1.984380 EXTENDED_LIMITS -2.000000 1.984375 /end CHARACTERISTIC
/begin CHARACTERISTIC KIDMSNTE "Integrationsgeschwindigkeit fÅr die Berechnung der MassenstromÑnderung TEV" VALUE 0x81D9A4 ME7_FW3 0 m_q0p00195 0.000000 127.998000 EXTENDED_LIMITS 0.000000 127.998047 /end CHARACTERISTIC
/begin CHARACTERISTIC KIFZGAG "IntegratorverstÑrkung des Fahrzeugmodells bei AT" CURVE 0x81CF34 ME7_FKL3 0 fak_uw_b4864 0.000000 4863.930000
 /begin AXIS_DESCR FIX_AXIS gangi dez___SL 6 1.000000 6.000000 FIX_AXIS_PAR 1 0 6 /end AXIS_DESCR
 EXTENDED_LIMITS 0.000000 4863.925781 /end CHARACTERISTIC
/begin RECORD_LAYOUT ME7_FKL3 FNC_VALUES 1 UWORD COLUMN_DIR DIRECT /end RECORD_LAYOUT
/begin CHARACTERISTIC KIFZGAWG "IntegratorverstÑrkung des Fahrzeugmodells bei AT,geschlossene WK" CURVE 0x81CF40 ME7_FKL3 0 fak_uw_b4864 0.000000 4863.930000
 /begin AXIS_DESCR FIX_AXIS gangi dez___SL 6 1.000000 6.000000 FIX_AXIS_PAR 1 0 6 /end AXIS_DESCR
 EXTENDED_LIMITS 0.000000 4863.925781 /end CHARACTERISTIC
/begin CHARACTERISTIC KIFZGHG_0_A "IntegratorverstÑrkung des Fahrzeugmodells bei AT" CURVE 0x81CF4C ME7_FKL3 0 fak_uw_b4864 0.000000 4863.930000
 /begin AXIS_DESCR FIX_AXIS gangi dez___SL 6 1.000000 6.000000 FIX_AXIS_PAR 1 0 6 /end AXIS_DESCR
 EXTENDED_LIMITS 0.000000 4863.925781 /end CHARACTERISTIC
/begin CHARACTERISTIC KIFZGHG_1_A "IntegratorverstÑrkung des Fahrzeugmodells bei AT" CURVE 0x81CF58 ME7_FKL3 0 fak_uw_b4864 0.000000 4863.930000
 /begin AXIS_DESCR FIX_AXIS gangi dez___SL 6 1.000000 6.000000 FIX_AXIS_PAR 1 0 6 /end AXIS_DESCR
 EXTENDED_LIMITS 0.000000 4863.925781 /end CHARACTERISTIC
/begin CHARACTERISTIC KIFZGHG_2_A "IntegratorverstÑrkung des Fahrzeugmodells bei AT" CURVE 0x81CF64 ME7_FKL3 0 fak_uw_b4864 0.000000 4863.930000
 /begin AXIS_DESCR FIX_AXIS gangi dez___SL 6 1.000000 6.000000 FIX_AXIS_PAR 1 0 6 /end AXIS_DESCR
 EXTENDED_LIMITS 0.000000 4863.925781 /end CHARACTERISTIC
/begin CHARACTERISTIC KIFZGHG_3_A "IntegratorverstÑrkung des Fahrzeugmodells bei AT" CURVE 0x81CF70 ME7_FKL3 0 fak_uw_b4864 0.000000 4863.930000
 /begin AXIS_DESCR FIX_AXIS gangi dez___SL 6 1.000000 6.000000 FIX_AXIS_PAR 1 0 6 /end AXIS_DESCR
 EXTENDED_LIMITS 0.000000 4863.925781 /end CHARACTERISTIC
/begin CHARACTERISTIC KIMSALL "Beiwert fÅr Leerlaufluftmassenintegrator fÅr E-Gas" VALUE 0x8150DD ME7_FW1 0 mk1sxs_ub_b25p6 0.100392 25.600000 /end CHARACTERISTIC
/begin CHARACTERISTIC KINMXG "öbertragungsfaktor I-Regler fÅr NMAX-Regelung" CURVE 0x81998A ME7_GKL1 0 relnmot_q0p02 0.000000 5.100000
 /begin AXIS_DESCR COM_AXIS gangi dez 0 0.000000 255.000000 AXIS_PTS_REF SGA08MDUB /end AXIS_DESCR
/end CHARACTERISTIC
/begin CHARACTERISTIC KINMXRLG "öbertragungsfaktor I-Regler fÅr NMAX-Regelung" MAP 0x819992 ME7_GKF1 0 relnmot_q0p02 0.000000 5.100000
 /begin AXIS_DESCR COM_AXIS rl rel_ub_q0p75 0 0.000000 191.250000 AXIS_PTS_REF SRL08NXUB /end AXIS_DESCR
 /begin AXIS_DESCR COM_AXIS gangi dez 0 0.000000 255.000000 AXIS_PTS_REF SGA08MDUB /end AXIS_DESCR
/end CHARACTERISTIC
/begin CHARACTERISTIC KIRMSMS "Integrationsgeschwindigkeit Abgleich Massenstrom TEV mit berechnetem Massenstrom" CURVE 0x813580 ME7_KL99 0 fak_q0p03815 0.991821 2499.960000
 /begin AXIS_DESCR STD_AXIS mstedte m_ub_b25p6 4 0.000000 25.500000 DEPOSIT ABSOLUTE /end AXIS_DESCR
 EXTENDED_LIMITS 0.000000 2499.961853 /end CHARACTERISTIC
/begin CHARACTERISTIC KISRM "Integratorbeiwert fÅr Saugrohrmodell (Dynamik)" VALUE 0x811322 ME7_FW3 0 fak_uw_b1 0.000000 0.999985 /end CHARACTERISTIC
/begin CHARACTERISTIC KKFFGRGA_0_A "VerstÑrkungsfaktor bei Konstantfahrt fÅr FGR-Regler" CURVE 0x810E0A ME7_GKL3 0 rel_uw_b3200 0.000000 3199.950000
 /begin AXIS_DESCR COM_AXIS uevges fak_q0p1 0 0.000000 25.500000 AXIS_PTS_REF SUE08MFUB /end AXIS_DESCR
 EXTENDED_LIMITS 0.000000 3199.951172 /end CHARACTERISTIC
/begin CHARACTERISTIC KKFFGRGA_1_A "VerstÑrkungsfaktor bei Konstantfahrt fÅr FGR-Regler" CURVE 0x810E1A ME7_GKL3 0 rel_uw_b3200 0.000000 3199.950000
 /begin AXIS_DESCR COM_AXIS uevges fak_q0p1 0 0.000000 25.500000 AXIS_PTS_REF SUE08MFUB /end AXIS_DESCR
 EXTENDED_LIMITS 0.000000 3199.951172 /end CHARACTERISTIC
/begin CHARACTERISTIC KLAF "Ausflu·kennlinie" CURVE 0x811414 ME7_FKL3 0 fak_uw_b1 0.000000 0.999985
 /begin AXIS_DESCR FIX_AXIS klaf_kge fak_uw_q0p001___SL 501 0.500000 1.000000 FIX_AXIS_PAR 500 0 501 /end AXIS_DESCR
/end CHARACTERISTIC
/begin CHARACTERISTIC KLAFTE "Ausflu·kennlinie fÅr TEV incl. Leitung AKF-TEV" CURVE 0x81363C ZF_KL111 0 fak_uw_b2 0.000000 1.999970
 /begin AXIS_DESCR STD_AXIS phtevpu_w fak_uw_b2 14 0.000000 1.999970 DEPOSIT ABSOLUTE /end AXIS_DESCR
 EXTENDED_LIMITS 0.000000 1.999969 /end CHARACTERISTIC
/begin CHARACTERISTIC KLATMLAE "Exotherme Temperaturabnahme bei Anfettung" CURVE 0x81848E ME7_GKL1 0 fak_ub_b1 0.000000 0.996094
 /begin AXIS_DESCR COM_AXIS lamsbg_w fak_uw_b16 0 0.000000 15.999800 AXIS_PTS_REF SLX06TMUW /end AXIS_DESCR
/end CHARACTERISTIC
/begin CHARACTERISTIC KLATMZWE "Exotherme Temperaturabnahme im Kat bei spÑterem ZÅndwinkel" CURVE 0x818494 ME7_GKL1 0 fak_ub_b1 0.000000 0.996094
 /begin AXIS_DESCR COM_AXIS etazwimt rel_ub_b127p5 0 0.000000 127.500000 AXIS_PTS_REF SEZ06TMUB /end AXIS_DESCR
/end CHARACTERISTIC
/begin CHARACTERISTIC KLDMASRL "Stellreserve bei ASR-Eingriff" CURVE 0x8144DF ME7_KL97 0 rel_ub_b99p6 0.000000 99.609400
 /begin AXIS_DESCR STD_AXIS nmot nmot_ub_q40 5 0.000000 10200.000000 DEPOSIT ABSOLUTE /end AXIS_DESCR
 EXTENDED_LIMITS 0.000000 99.609375 /end CHARACTERISTIC
/begin CHARACTERISTIC KLDTMRS "Kennlinie Motortemperatur-Gradient im Schub fÅr Referenzmodell" CURVE 0x81BAB0 ME7_KL98 0 temp_sb_b0p093 -0.093750 0.093018
 /begin AXIS_DESCR STD_AXIS tmrw temp_ub_q0p75_o48 5 -48.000000 143.250000 DEPOSIT ABSOLUTE /end AXIS_DESCR
/end CHARACTERISTIC
/begin CHARACTERISTIC KLETAZW_UC "" CURVE 0x815D23 ME7_KL97 0 rel_ub_b127p5 0.000000 127.500000
 /begin AXIS_DESCR STD_AXIS dzw_uc zw_ub_q0p75 8 0.000000 191.250000 DEPOSIT ABSOLUTE /end AXIS_DESCR
/end CHARACTERISTIC
/begin CHARACTERISTIC KLETAZW_UM "ZW-Wirkungsgrad in AbhÑngigkeit von delta ZW in der FunktionsÅberwachung" CURVE 0x814118 ME7_KL97 0 rel_ub_b127p5 0.000000 127.500000
 /begin AXIS_DESCR STD_AXIS dzw_um zw_ub_q0p75 8 0.000000 191.250000 DEPOSIT ABSOLUTE /end AXIS_DESCR
/end CHARACTERISTIC
/begin CHARACTERISTIC KLNPED_UC "" CURVE 0x815E00 ME7_KL97 0 nmot_ub_q40 0.000000 10200.000000
 /begin AXIS_DESCR STD_AXIS spsn_uc spg_ub_q0p019 8 0.000000 4.980470 DEPOSIT ABSOLUTE /end AXIS_DESCR
/end CHARACTERISTIC
/begin CHARACTERISTIC KLNPED_UM "pedalsollwertabh. Drehzahlbegrenzung in der DK-Antrieb-Ersatzfunktion, FktsÅberw" CURVE 0x8141F5 ME7_KL97 0 nmot_ub_q40 0.000000 10200.000000
 /begin AXIS_DESCR STD_AXIS spsn_um spg_ub_q0p019 8 0.000000 4.980470 DEPOSIT ABSOLUTE /end AXIS_DESCR
/end CHARACTERISTIC
/begin CHARACTERISTIC KLNWRLTM "Wichtung von relativer SollfÅllung Åber Motortemp. zur Adressierung von KFNWS" CURVE 0x8188AC ME7_KL97 0 fak_ub_b2 0.000000 1.992190
 /begin AXIS_DESCR STD_AXIS tmot temp_ub_q0p75_o48 4 -48.000000 143.250000 DEPOSIT ABSOLUTE /end AXIS_DESCR
 EXTENDED_LIMITS 0.000000 1.992188 /end CHARACTERISTIC
/begin CHARACTERISTIC KLOGIN "Login-Code fÅr Kundendienst" VALUE 0x812266 ME7_FW3 0 dez___UW 0.000000 65535.000000 /end CHARACTERISTIC
/begin CHARACTERISTIC KLTDS "Konvertierungskennlinie fÅr Tankdrucksensor DS-T2" CURVE 0x813566 ZF_KL118 0 p_sw_q0p000977 -32.014300 32.013400
 /begin AXIS_DESCR STD_AXIS pterw_w p_sw_q0p00244 6 -80.000000 79.997600 DEPOSIT ABSOLUTE /end AXIS_DESCR
 EXTENDED_LIMITS -32.014336 32.013359 /end CHARACTERISTIC
/begin CHARACTERISTIC KLZWBSMN "spÑtest mîglicher BasiszÅndwinkel" CURVE 0x81EB0C ME7_KL98 0 zw_sb_q0p75 -96.000000 95.250000
 /begin AXIS_DESCR STD_AXIS nmot nmot_ub_q40 8 0.000000 10200.000000 DEPOSIT ABSOLUTE /end AXIS_DESCR
/end CHARACTERISTIC
/begin CHARACTERISTIC KLZZWMNST "KL Zeitkonstante fÅr Abregelung ZW-Begrenzung im Nachstart" CURVE 0x81394A ME7_KL99 0 zk10msxs_uw_b655 0.010000 655.360000
 /begin AXIS_DESCR STD_AXIS tmst temp_ub_q0p75_o48 8 -48.000000 143.250000 DEPOSIT ABSOLUTE /end AXIS_DESCR
/end CHARACTERISTIC
/begin CHARACTERISTIC KMXSTG "Filterkonstante fÅr Filter max. Steigung fÅr Sonde hinter KAT" VALUE 0x81AD4E ME7_FW3 0 fak_uw_b1 0.000000 0.999985 /end CHARACTERISTIC
/begin CHARACTERISTIC KNSNF "Sperrband fÅr SolldrehzahlnachfÅhrung" VALUE 0x8197D1 ME7_FW1 0 nmot_ub_q10 0.000000 2550.000000 /end CHARACTERISTIC
/begin CHARACTERISTIC KRAFGRGA_0_A "VerstÑrkungsfaktor bei Rampe fÅr FGR-Regler" CURVE 0x810E2A ME7_GKL3 0 rel_uw_b3200 0.000000 3199.950000
 /begin AXIS_DESCR COM_AXIS uevges fak_q0p1 0 0.000000 25.500000 AXIS_PTS_REF SUE08MFUB /end AXIS_DESCR
 EXTENDED_LIMITS 0.000000 3199.951172 /end CHARACTERISTIC
/begin CHARACTERISTIC KRAFGRGA_1_A "VerstÑrkungsfaktor bei Rampe fÅr FGR-Regler" CURVE 0x810E3A ME7_GKL3 0 rel_uw_b3200 0.000000 3199.950000
 /begin AXIS_DESCR COM_AXIS uevges fak_q0p1 0 0.000000 25.500000 AXIS_PTS_REF SUE08MFUB /end AXIS_DESCR
 EXTENDED_LIMITS 0.000000 3199.951172 /end CHARACTERISTIC
/begin CHARACTERISTIC KRAL1N "Klopfregeladaption Lastbereich 1" CURVE 0x819372 ME7_GKL1 0 rel_ub_q0p75 0.000000 191.250000
 /begin AXIS_DESCR COM_AXIS nmot nmot_ub_q40 0 0.000000 10200.000000 AXIS_PTS_REF SNM16KRUB /end AXIS_DESCR
/end CHARACTERISTIC
/begin CHARACTERISTIC KRAL2N "Klopfregeladaption Lastbereich 2" CURVE 0x819382 ME7_GKL1 0 rel_ub_q0p75 0.000000 191.250000
 /begin AXIS_DESCR COM_AXIS nmot nmot_ub_q40 0 0.000000 10200.000000 AXIS_PTS_REF SNM16KRUB /end AXIS_DESCR
/end CHARACTERISTIC
/begin CHARACTERISTIC KRAL3N "Klopfregeladaption Lastbereich 3" CURVE 0x819392 ME7_GKL1 0 rel_ub_q0p75 0.000000 191.250000
 /begin AXIS_DESCR COM_AXIS nmot nmot_ub_q40 0 0.000000 10200.000000 AXIS_PTS_REF SNM16KRUB /end AXIS_DESCR
/end CHARACTERISTIC
/begin CHARACTERISTIC KRALH "Klopfregeladaption Lasthysterese" VALUE 0x8193A2 ME7_FW1 0 rel_ub_q0p75 0.000000 191.250000 /end CHARACTERISTIC
/begin CHARACTERISTIC KRAN1 "Klopfregeladaption Drehzahlbereich, StÅtzstelle 1" VALUE 0x8193A3 ME7_FW1 0 nmot_ub_q40 0.000000 10200.000000 /end CHARACTERISTIC
/begin CHARACTERISTIC KRAN2 "Klopfregeladaption Drehzahlbereich, StÅtzstelle 2" VALUE 0x8193A4 ME7_FW1 0 nmot_ub_q40 0.000000 10200.000000 /end CHARACTERISTIC
/begin CHARACTERISTIC KRAN3 "Klopfregeladaption Drehzahlbereich, StÅtzstelle 3" VALUE 0x8193A5 ME7_FW1 0 nmot_ub_q40 0.000000 10200.000000 /end CHARACTERISTIC
/begin CHARACTERISTIC KRAN4 "Klopfregeladaption Drehzahlbereich, StÅtzstelle 4" VALUE 0x8193A6 ME7_FW1 0 nmot_ub_q40 0.000000 10200.000000 /end CHARACTERISTIC
/begin CHARACTERISTIC KRANH "Klopfregeladaption Drehzahlhysterese" VALUE 0x8193A7 ME7_FW1 0 nmot_ub_q40 0.000000 10200.000000 /end CHARACTERISTIC
/begin CHARACTERISTIC KRDWA "Klopfregelung Differenz aktueller ZW zu Adaptionskennfeld" VALUE 0x815410 ME7_FW1 0 zw_ub_q0p75 0.000000 191.250000 /end CHARACTERISTIC
/begin CHARACTERISTIC KRDWAA "zulÑssiger ZW-Sprung nach frÅh bei Auslesen Adaptionswerte" VALUE 0x815411 ME7_FW1 0 zw_ub_qn0p75 -191.250000 0.000000 /end CHARACTERISTIC
/begin CHARACTERISTIC KRDWKLA "Der SV-Lernbetrag fÅr die KR-Adaption nach einem erkannten Klopfereignis" VALUE 0x815412 ME7_FW1 0 zw_ub_qn0p75 -6.000000 0.000000 EXTENDED_LIMITS -191.250000 0.000000 /end CHARACTERISTIC
/begin CHARACTERISTIC KRDWSA "Der FV-Lernbetrag fÅr die KR-Adaption wenn wkra-wkr > KRDWA" VALUE 0x815413 ME7_FW1 0 zw_ub_q0p75 0.000000 6.000000 EXTENDED_LIMITS 0.000000 191.250000 /end CHARACTERISTIC
/begin CHARACTERISTIC KRDWSN "Klopfregelung delta - Winkel Sicherheit" CURVE 0x8193A8 ME7_GKL1 0 zw_ub_qn0p75 -191.250000 0.000000
 /begin AXIS_DESCR COM_AXIS nmot nmot_ub_q40 0 0.000000 10200.000000 AXIS_PTS_REF SNM16KRUB /end AXIS_DESCR
/end CHARACTERISTIC
/begin CHARACTERISTIC KRFHKS "FehlerhÑufigkeit Klopfsensoren" VALUE 0x819457 ME7_FW1 0 dez 0.000000 255.000000 /end CHARACTERISTIC
/begin CHARACTERISTIC KRFHT "FehlerhÑufigkeit Testimpuls" VALUE 0x81543F ME7_FW1 0 dez 1.000000 255.000000 EXTENDED_LIMITS 0.000000 255.000000 /end CHARACTERISTIC
/begin CHARACTERISTIC KRFKN "SpÑtverstellung pro Klopfereignis" CURVE 0x8193B8 ME7_GKL1 0 zw_ub_qn0p75 -191.250000 0.000000
 /begin AXIS_DESCR COM_AXIS nmot nmot_ub_q40 0 0.000000 10200.000000 AXIS_PTS_REF SNM16KRUB /end AXIS_DESCR
/end CHARACTERISTIC
/begin CHARACTERISTIC KRFTP1 "Tiefpassverhalten normal" VALUE 0x815402 ME7_FW1 0 dez 8.000000 32.000000 EXTENDED_LIMITS 0.000000 255.000000 /end CHARACTERISTIC
/begin CHARACTERISTIC KRFTP2 "Tiefpassverhalten bei Drehzahldynamik" VALUE 0x815403 ME7_FW1 0 dez 2.000000 16.000000 EXTENDED_LIMITS 0.000000 255.000000 /end CHARACTERISTIC
/begin CHARACTERISTIC KRFTP3 "Tiefpassverhalten bei Lastdynamik" VALUE 0x815404 ME7_FW1 0 dez 2.000000 16.000000 EXTENDED_LIMITS 0.000000 255.000000 /end CHARACTERISTIC
/begin CHARACTERISTIC KRKFKS "Zuordnung der Kloperkennungskennlinie bei fehlender Zyl.-1-Erkennung" VALUE 0x815405 ME7_FW1 0 dez 0.000000 255.000000 /end CHARACTERISTIC
/begin CHARACTERISTIC KRKTE "Umrechnung relative Kraftstoffmasse rk in effektive Einspritzzeit te" VALUE 0x818C6E ME7_FW1 0 rkti_sy 0.000000 0.544000 /end CHARACTERISTIC
/begin CHARACTERISTIC KRMXN "maximale SpÑtverstellung" CURVE 0x8193C8 ME7_GKL1 0 zw_ub_qn0p75 -191.250000 -0.750000
 /begin AXIS_DESCR COM_AXIS nmot nmot_ub_q40 0 0.000000 10200.000000 AXIS_PTS_REF SNM16KRUB /end AXIS_DESCR
 EXTENDED_LIMITS -191.250000 0.000000 /end CHARACTERISTIC
/begin CHARACTERISTIC KRNLZ "Drehzahlschwelle, oberhalb der FÅhrung durch Leitzylinder aktiv ist" VALUE 0x8193D8 ME7_FW1 0 nmot_ub_q40 0.000000 10200.000000 /end CHARACTERISTIC
/begin CHARACTERISTIC KRVFN "Anz. ZÅnd./Zyl., bzw. Zeitangabe von FrÅhverst. zu FrÅhverst. (Stufenbreite-KR)" CURVE 0x8193D9 ME7_GKL1 0 dez 1.000000 255.000000
 /begin AXIS_DESCR COM_AXIS nmot nmot_ub_q40 0 0.000000 10200.000000 AXIS_PTS_REF SNM16KRUB /end AXIS_DESCR
 EXTENDED_LIMITS 0.000000 255.000000 /end CHARACTERISTIC
/begin CHARACTERISTIC KRVFSN "Anzahl ZÅndungen/Zyl., oder Zeitangabe fÅr schnelle FrÅhverstellung der KR" CURVE 0x8193E9 ME7_GKL1 0 dez 1.000000 255.000000
 /begin AXIS_DESCR COM_AXIS nmot nmot_ub_q40 0 0.000000 10200.000000 AXIS_PTS_REF SNM16KRUB /end AXIS_DESCR
 EXTENDED_LIMITS 0.000000 255.000000 /end CHARACTERISTIC
/begin CHARACTERISTIC KRVST "VerstÑrkung nach Start" VALUE 0x815406 ME7_FW1 0 dez 0.000000 6.000000 EXTENDED_LIMITS 0.000000 255.000000 /end CHARACTERISTIC
/begin CHARACTERISTIC KSTAI "Arbeitsbereiche fÅr STADAP-Faktoren" CURVE 0x8151F4 ME7_KL97 0 dez 0.000000 255.000000
 /begin AXIS_DESCR STD_AXIS tmst temp_ub_q0p75_o48 12 -48.000000 143.250000 DEPOSIT ABSOLUTE /end AXIS_DESCR
/end CHARACTERISTIC
/begin CHARACTERISTIC KSTAMX0 "Max-Begrenzung des STADAP-Faktors in Bereich 0" VALUE 0x81520D ME7_FW1 0 fak_ub_b2 1.000000 1.992190 EXTENDED_LIMITS 0.000000 1.992188 /end CHARACTERISTIC
/begin CHARACTERISTIC KSTAMX1 "Max-Begrenzung des STADAP-Faktors in Bereich 1" VALUE 0x81520E ME7_FW1 0 fak_ub_b2 1.000000 1.992190 EXTENDED_LIMITS 0.000000 1.992188 /end CHARACTERISTIC
/begin CHARACTERISTIC KSTAMX2 "Max-Begrenzung des STADAP-Faktors in Bereich 2" VALUE 0x81520F ME7_FW1 0 fak_ub_b2 1.000000 1.992190 EXTENDED_LIMITS 0.000000 1.992188 /end CHARACTERISTIC
/begin CHARACTERISTIC KSZA "Anzahl Klopfsensoren" VALUE 0x815407 ME7_FW1 0 dez 1.000000 4.000000 EXTENDED_LIMITS 0.000000 255.000000 /end CHARACTERISTIC
/begin CHARACTERISTIC KTNDMRKH "Int.-Konstante fÅr Anforderung Drehmomentenreserve Katheizen" VALUE 0x81BB6A ME7_FW3 0 fak_uw_b1 0.000000 0.999985 /end CHARACTERISTIC
/begin CHARACTERISTIC KUMSRL "Umrechnungskonstante von Massenstrom in relative LuftfÅllung" VALUE 0x8150DE ME7_FW1 0 kumsrl_ub_b0p002 0.000000 0.001992 /end CHARACTERISTIC
/begin CHARACTERISTIC KVB "Konstante fÅr Verbrauchsanzeige" VALUE 0x819FC4 ME7_FW1 0 m_ub_b780 0.000000 776.953000 EXTENDED_LIMITS 0.000000 776.953125 /end CHARACTERISTIC
/begin CHARACTERISTIC KVLAD "Konstante fÅr Umrechnung von Ladedruck in Luftmasse" VALUE 0x8150DF ME7_FW1 0 rel_ub_b2p0 0.000000 1.992190 EXTENDED_LIMITS 0.000000 1.992188 /end CHARACTERISTIC
/begin CHARACTERISTIC KVNPZ "normierter Krafstoffverbrauch pro Zylinder fÅr Kombiausgabe" VALUE 0x8144EA ME7_FW1 0 kva_ub_q20 0.000000 5100.000000 /end CHARACTERISTIC
/begin CHARACTERISTIC LADFIL "Ladedruckfilterung" VALUE 0x8150E0 ME7_FW1 0 fak_ub_b1 0.000000 0.996094 /end CHARACTERISTIC
/begin CHARACTERISTIC LALIUSH "Lambdalinearisierung, Sonde hinter Katalysator" CURVE 0x8136EA ZF_KL111 0 fak_uw_b16 0.000000 15.999800
 /begin AXIS_DESCR STD_AXIS ushk_w spg_uw_q0p00488_o1 10 -1.000000 318.995000 DEPOSIT ABSOLUTE /end AXIS_DESCR
 EXTENDED_LIMITS 0.000000 15.999756 /end CHARACTERISTIC
/begin CHARACTERISTIC LALIUSRH "Lambdalinearisierung, Sonde hinter Katalysator, Sollwert" CURVE 0x813714 ME7_KL99 0 fak_uw_b16 0.000000 15.999800
 /begin AXIS_DESCR STD_AXIS usrhk spg_ub_q0p0052_o0p2 10 -0.200000 1.130000 DEPOSIT ABSOLUTE /end AXIS_DESCR
 EXTENDED_LIMITS 0.000000 15.999756 /end CHARACTERISTIC
/begin CHARACTERISTIC LAMDSLMX "max. Lambda-Motor (lamsbg_w)  fÅr Bedingung Diagnose" VALUE 0x81A120 ME7_FW3 0 fak_uw_b16 0.000000 15.999800 EXTENDED_LIMITS 0.000000 15.999756 /end CHARACTERISTIC
/begin CHARACTERISTIC LAMFA "Lambda Fahrerwunsch" MAP 0x81B904 ME7_KF337 0 fak_ub_b2 0.000000 1.992190
 /begin AXIS_DESCR STD_AXIS nmot nmot_ub_q40 15 0.000000 10200.000000 DEPOSIT ABSOLUTE /end AXIS_DESCR
 /begin AXIS_DESCR STD_AXIS mrfa_w rel_uw_b200 6 0.000000 199.997000 DEPOSIT ABSOLUTE /end AXIS_DESCR
 EXTENDED_LIMITS 0.000000 1.992188 /end CHARACTERISTIC
/begin CHARACTERISTIC LAMFAS "Sperre Lambda Fahrerwunsch" CURVE 0x818CBE ME7_KL97 0 fak_ub_b1 0.000000 0.996094
 /begin AXIS_DESCR STD_AXIS fho fak_ub_b4 6 0.000000 3.984380 DEPOSIT ABSOLUTE /end AXIS_DESCR
/end CHARACTERISTIC
/begin CHARACTERISTIC LAMKAML "Lambdasollwert fÅr Katalysator-AusrÑumen (luftmassenabhÑngig)" CURVE 0x81EA5E ME7_GKL3 0 fak_uw_b16 0.000000 15.999800
 /begin AXIS_DESCR COM_AXIS ml m_ub_b1020 0 0.000000 1020.000000 AXIS_PTS_REF SML05LKUB /end AXIS_DESCR
 EXTENDED_LIMITS 0.000000 15.999756 /end CHARACTERISTIC
/begin CHARACTERISTIC LAMKAML2 "Lambdasollwert fÅr Katalysator-AusrÑumen (luftmassenabhÑngig), Bank 2" CURVE 0x81EA68 ME7_GKL3 0 fak_uw_b16 0.000000 15.999800
 /begin AXIS_DESCR COM_AXIS ml m_ub_b1020 0 0.000000 1020.000000 AXIS_PTS_REF SML05LKUB /end AXIS_DESCR
 EXTENDED_LIMITS 0.000000 15.999756 /end CHARACTERISTIC
/begin CHARACTERISTIC LAMLGF "Laufgrenze 'fett'" VALUE 0x8151C6 ME7_FW1 0 fak_ub_b2 0.000000 1.992190 EXTENDED_LIMITS 0.000000 1.992188 /end CHARACTERISTIC
/begin CHARACTERISTIC LAMLGFSL "Laufgrenze 'fett' bei SekundÑrluftbetrieb" VALUE 0x8151C7 ME7_FW1 0 fak_ub_b2 0.000000 1.992190 EXTENDED_LIMITS 0.000000 1.992188 /end CHARACTERISTIC
/begin CHARACTERISTIC LAMLGMTM "Laufgrenze 'mager'" CURVE 0x818AFA ME7_GKL1 0 fak_ub_b2 0.000000 1.992190
 /begin AXIS_DESCR COM_AXIS tmot temp_ub_q0p75_o48 0 -48.000000 143.250000 AXIS_PTS_REF STM12ESUB /end AXIS_DESCR
 EXTENDED_LIMITS 0.000000 1.992188 /end CHARACTERISTIC
/begin CHARACTERISTIC LAMSOSOF "Lambdasonde Soll Obergrenze fÅr 1.0-Fenster" VALUE 0x811F36 ME7_FW3 0 fak_uw_b16 0.000000 15.999800 EXTENDED_LIMITS 0.000000 15.999756 /end CHARACTERISTIC
/begin CHARACTERISTIC LAMSOSUF "Lambdasonde Soll Untergrenze fÅr 1.0-Fenster" VALUE 0x811F38 ME7_FW3 0 fak_uw_b16 0.000000 15.999800 EXTENDED_LIMITS 0.000000 15.999756 /end CHARACTERISTIC
/begin CHARACTERISTIC LASDSLA "Lambda-Abgas-Soll bei SekundÑrluftadaption/Kurztest" CURVE 0x819146 ME7_KL97 0 fak_ub_b2 0.000000 1.992190
 /begin AXIS_DESCR STD_AXIS ml m_ub_b1020 4 0.000000 1020.000000 DEPOSIT ABSOLUTE /end AXIS_DESCR
 EXTENDED_LIMITS 0.000000 1.992188 /end CHARACTERISTIC
/begin CHARACTERISTIC LASHKAB "Startwert fÅr dynamische Sollwertanhebung (lamsolh) in der LRHK" VALUE 0x813734 ME7_FW4 0 fak_sw_b1 0.000000 0.999969 EXTENDED_LIMITS -1.000000 0.999969 /end CHARACTERISTIC
/begin CHARACTERISTIC LASOAB "Lambdasollwert bei Bankabschaltung" VALUE 0x8151C8 ME7_FW1 0 fak_ub_b2 0.000000 1.992190 EXTENDED_LIMITS 0.000000 1.992188 /end CHARACTERISTIC
/begin CHARACTERISTIC LASTMOT "Motortemp.-Korrektur von Lambda-Abgas-Soll" CURVE 0x81914F ME7_KL97 0 fak_ub_b2 0.000000 1.992190
 /begin AXIS_DESCR STD_AXIS tmot temp_ub_q0p75_o48 4 -48.000000 143.250000 DEPOSIT ABSOLUTE /end AXIS_DESCR
 EXTENDED_LIMITS 0.000000 1.992188 /end CHARACTERISTIC
/begin CHARACTERISTIC LASWLTM "Offset Lambda-Motor-Soll bei inaktiver Lambdaregelung" CURVE 0x818C61 ME7_GKL2 0 fak_sb_b1 -1.000000 0.992188
 /begin AXIS_DESCR COM_AXIS tmot temp_ub_q0p75_o48 0 -48.000000 143.250000 AXIS_PTS_REF STM12ESUB /end AXIS_DESCR
/end CHARACTERISTIC
/begin CHARACTERISTIC LBZO1 "Schwelle fÅr lbz zur Solldrehzahlanhebung beim Verlassen des LL" VALUE 0x8197D2 ME7_FW1 0 rel_ub_b99p6 0.000000 99.609400 EXTENDED_LIMITS 0.000000 99.609375 /end CHARACTERISTIC
/begin CHARACTERISTIC LBZO2 "Schwelle fÅr lbz zur Solldrehzahlanhebung im Leerlauf" VALUE 0x8197D3 ME7_FW1 0 rel_ub_b99p6 0.000000 99.609400 EXTENDED_LIMITS 0.000000 99.609375 /end CHARACTERISTIC
/begin CHARACTERISTIC LBZU "Schwelle fÅr lbz zur Solldrehzahlabsenkung beim Verlassen des Leerlaufs" VALUE 0x8197D4 ME7_FW1 0 rel_ub_b99p6 0.000000 99.609400 EXTENDED_LIMITS 0.000000 99.609375 /end CHARACTERISTIC
/begin CHARACTERISTIC LDAMN "Minimalwertbegrenzung der Adaption LDR I-Adaption" VALUE 0x81CA4C ME7_FW4 0 tv_sw_q0p005 -163.840000 163.835000 /end CHARACTERISTIC
/begin CHARACTERISTIC LDDIAN "Schrittweite pro Programmdurchlauf fÅr negativ-NachfÅhrung I-Begrenzung" VALUE 0x81CA4E ME7_FW4 0 tv_sw_q0p005 -163.840000 163.835000 /end CHARACTERISTIC
/begin CHARACTERISTIC LDDIAP "Schrittweite pro Programmdurchlauf fÅr positiv-NachfÅhrung I-Begrenzung" VALUE 0x81CA50 ME7_FW4 0 tv_sw_q0p005 0.000000 163.835000 EXTENDED_LIMITS -163.840000 163.835000 /end CHARACTERISTIC
/begin CHARACTERISTIC LDDIMNN "Sicherheitsabstand LDR I-Regler Begrenzung negativ" CURVE 0x81CA52 ME7_GKL4 0 tv_sw_q0p005 0.000000 163.835000
 /begin AXIS_DESCR COM_AXIS nmot_w nmot_uw_q0p25 0 0.000000 16383.800000 AXIS_PTS_REF SNM08LDUW /end AXIS_DESCR
 EXTENDED_LIMITS -163.840000 163.835000 /end CHARACTERISTIC
/begin CHARACTERISTIC LDDIMXN "Sicherheitsabstand LDR I-Regler Begrenzung" CURVE 0x81CA62 ME7_GKL4 0 tv_sw_q0p005 0.000000 163.835000
 /begin AXIS_DESCR COM_AXIS nmot_w nmot_uw_q0p25 0 0.000000 16383.800000 AXIS_PTS_REF SNM08LDUW /end AXIS_DESCR
 EXTENDED_LIMITS -163.840000 163.835000 /end CHARACTERISTIC
/begin CHARACTERISTIC LDEIAO "Obere Regelabweichungsschwelle fÅr Negativ-Verstellung" VALUE 0x81949E ME7_FW2 0 p_sb_q10 -1280.000000 1270.000000 /end CHARACTERISTIC
/begin CHARACTERISTIC LDEIAP "Regelabweichungsschwelle fÅr  Positiv Adaption I-Regler" VALUE 0x81949F ME7_FW2 0 p_sb_q10 -1280.000000 1270.000000 /end CHARACTERISTIC
/begin CHARACTERISTIC LDEIAPS "Regelabweichungsschwelle fÅr schnelle Positiv-NachfÅhrung" VALUE 0x8194A0 ME7_FW2 0 p_sb_q10 -1280.000000 1270.000000 /end CHARACTERISTIC
/begin CHARACTERISTIC LDEIAU "Untere Regelabweichungsschwelle fÅr Negativ-Verstellung" VALUE 0x8194A1 ME7_FW2 0 p_sb_q10 -1280.000000 1270.000000 /end CHARACTERISTIC
/begin CHARACTERISTIC LDHIA "Hysterese fÅr LDR I-Adaptionskennlinie" VALUE 0x8194A2 ME7_FW2 0 nmot_ub_q40___SB 0.000000 5080.000000 EXTENDED_LIMITS -5120.000000 5080.000000 /end CHARACTERISTIC
/begin CHARACTERISTIC LDIATA "Korrektur I-Begrenzung LDR PID Rgler als Funktion von Tans" CURVE 0x8194A3 ME7_GKL2 0 tv_ub_q0p64___SB -81.920000 81.280000
 /begin AXIS_DESCR COM_AXIS tans temp_ub_q0p75_o48 0 -48.000000 143.250000 AXIS_PTS_REF STA08LDUB /end AXIS_DESCR
/end CHARACTERISTIC
/begin CHARACTERISTIC LDMXNN "Begrenzung max. NachfÅhrung LDR negativ fÅr Regleradaption" VALUE 0x81CA72 ME7_FW4 0 tv_sw_q0p005 -163.840000 0.000000 EXTENDED_LIMITS -163.840000 163.835000 /end CHARACTERISTIC
/begin CHARACTERISTIC LDMXNP "Begrenzung max. NachfÅhrung LDR Adaption positiv bei Bereichswechsel" VALUE 0x81CA74 ME7_FW4 0 tv_sw_q0p005 0.000000 163.835000 EXTENDED_LIMITS -163.840000 163.835000 /end CHARACTERISTIC
/begin CHARACTERISTIC LDORXN "Maximalfuellung LDR bei E_ldo (öberladefehler)" CURVE 0x819687 ME7_GKL1 0 rel_ub_q0p75 0.000000 191.250000
 /begin AXIS_DESCR COM_AXIS nmot nmot_ub_q40 0 0.000000 10200.000000 AXIS_PTS_REF SNM08LDUB /end AXIS_DESCR
/end CHARACTERISTIC
/begin CHARACTERISTIC LDPBN "LDR p-Begrenzung bei zu hoher Motortemperatur" CURVE 0x81968F ME7_GKL1 0 p_ub_q10 0.000000 2550.000000
 /begin AXIS_DESCR COM_AXIS nmot nmot_ub_q40 0 0.000000 10200.000000 AXIS_PTS_REF SNM08LDUB /end AXIS_DESCR
/end CHARACTERISTIC
/begin CHARACTERISTIC LDRAPP "Festwert fÅr LDR-Applikation ohne Md-Koordination" VALUE 0x81552A ME7_FW1 0 tv_ub_b100 0.000000 99.609400 EXTENDED_LIMITS 0.000000 99.609375 /end CHARACTERISTIC
/begin CHARACTERISTIC LDRPBU "P-Regler Kennwert LDR back up Regler" VALUE 0x81552B ME7_FW1 0 tv_q0p001028 0.000000 0.262140 /end CHARACTERISTIC
/begin CHARACTERISTIC LDRQ0DY "LDR-Reglerparameter Q0" CURVE 0x81CA76 ME7_GKL3 0 rel_uw_b3276p75 0.000000 3276.750000
 /begin AXIS_DESCR COM_AXIS nmot nmot_ub_q40 0 0.000000 10200.000000 AXIS_PTS_REF SNM16LDUB /end AXIS_DESCR
/end CHARACTERISTIC
/begin CHARACTERISTIC LDRQ0S "Reglerparameter Q0 LDR-PID Regler im StationÑrbetrieb" VALUE 0x81CA96 ME7_FW3 0 rel_uw_b3276p75 0.000000 3276.750000 /end CHARACTERISTIC
/begin CHARACTERISTIC LDRQ1DY "Reglerparameter Q1 PID-Regler im Dynamikbetrieb (Integrationsbeiwert)" CURVE 0x81CA98 ME7_GKL3 0 rel_uw_b3276p75 0.000000 3276.750000
 /begin AXIS_DESCR COM_AXIS nmot nmot_ub_q40 0 0.000000 10200.000000 AXIS_PTS_REF SNM16LDUB /end AXIS_DESCR
/end CHARACTERISTIC
/begin CHARACTERISTIC LDRQ1ST "Reglerparameter Q1 PID-Regler im StationÑrbetrieb (Integrationsbeiwert)" CURVE 0x81CAB8 ME7_GKL3 0 rel_uw_b3276p75 0.000000 3276.750000
 /begin AXIS_DESCR COM_AXIS nmot nmot_ub_q40 0 0.000000 10200.000000 AXIS_PTS_REF SNM16LDUB /end AXIS_DESCR
/end CHARACTERISTIC
/begin CHARACTERISTIC LDRVL "Vollast Erkennungsschwelle LDR" VALUE 0x8194AB ME7_FW1 0 rel_ub_b99p6 0.000000 99.609400 EXTENDED_LIMITS 0.000000 99.609375 /end CHARACTERISTIC
/begin CHARACTERISTIC LDRXN "Maximalfuellung LDR" CURVE 0x81CAF0 ZF_KL111 0 rel_uw_q0p0234 0.000000 1535.980000
 /begin AXIS_DESCR STD_AXIS nmot_w nmot_uw_q0p25 16 0.000000 16383.800000 DEPOSIT ABSOLUTE /end AXIS_DESCR
 EXTENDED_LIMITS 0.000000 1535.976562 /end CHARACTERISTIC
/begin CHARACTERISTIC LDRXNZK "Maximalfuellung LDR bei Dauerklopfen" CURVE 0x81CB32 ZF_KL111 0 rel_uw_q0p0234 0.000000 1535.980000
 /begin AXIS_DESCR STD_AXIS nmot_w nmot_uw_q0p25 16 0.000000 16383.800000 DEPOSIT ABSOLUTE /end AXIS_DESCR
 EXTENDED_LIMITS 0.000000 1535.976562 /end CHARACTERISTIC
/begin CHARACTERISTIC LDUVRS "LDR Umluftventilsteuerung Reset vom Sollwert" VALUE 0x815488 ME7_FW1 0 p_ub_q10 0.000000 2550.000000 /end CHARACTERISTIC
/begin CHARACTERISTIC LIMN "Untere Integratorbegrenzung bei stehendem Fahrzeug" VALUE 0x8156AC ME7_FW1 0 rel_ub_bn24p9 -24.900000 0.000000 /end CHARACTERISTIC
/begin CHARACTERISTIC LIMNDLLR "Untere Integratorbegrenzung bei Diagnose Leerlaufregelung" VALUE 0x8156AD ME7_FW1 0 rel_ub_bn24p9 -24.900000 0.000000 /end CHARACTERISTIC
/begin CHARACTERISTIC LIMNDTES "Untere Integratorbegrenzung bei DTES" VALUE 0x8156AE ME7_FW1 0 rel_ub_bn24p9 -24.900000 0.000000 /end CHARACTERISTIC
/begin CHARACTERISTIC LIMNV "Untere Integratorbegrenzung bei rollendem Fahrzeug" VALUE 0x8156AF ME7_FW1 0 rel_ub_bn24p9 -24.900000 0.000000 /end CHARACTERISTIC
/begin CHARACTERISTIC LIMTKOA "Zeitschwelle um den Kompressor unbegrenzt auszuschalten" VALUE 0x816478 ME7_FW1 0 t200msxs_ub_b51 0.000000 51.000000 /end CHARACTERISTIC
/begin AXIS_PTS MDV08_UC "" 0x815DF4 mzmax_uc ME7_SST97 0 rel_ub_b99p6 8 0.000000 99.609400 DEPOSIT ABSOLUTE EXTENDED_LIMITS 0.000000 99.060000 /end AXIS_PTS
/begin AXIS_PTS MDV08_UM "" 0x8141E9 mzmax_um ME7_SST97 0 rel_ub_b99p6 8 0.000000 99.609400 DEPOSIT ABSOLUTE EXTENDED_LIMITS 0.000000 99.060000 /end AXIS_PTS
/begin AXIS_PTS NMV08_UC "" 0x815C7F nmot_uc ME7_SST97 0 nmot_ub_q40 8 0.000000 10200.000000 DEPOSIT ABSOLUTE /end AXIS_PTS
/begin AXIS_PTS NMV08_UM "StÅtzstellenverteilung fÅr Motordrehzahl in der FunktionsÅberwachung" 0x814074 nmot_um ME7_SST97 0 nmot_ub_q40 8 0.000000 10200.000000 DEPOSIT ABSOLUTE /end AXIS_PTS
/begin AXIS_PTS NZWV08_UC "" 0x815C88 nmot_uc ME7_SST97 0 nmot_ub_q40 8 0.000000 10200.000000 DEPOSIT ABSOLUTE EXTENDED_LIMITS 0.000000 16383.750000 /end AXIS_PTS
/begin AXIS_PTS NZWV08_UM "" 0x81407D nmot_um ME7_SST97 0 nmot_ub_q40 8 0.000000 10200.000000 DEPOSIT ABSOLUTE EXTENDED_LIMITS 0.000000 16383.750000 /end AXIS_PTS
/begin AXIS_PTS RLV08_UC "" 0x815C91 rl_uc ME7_SST97 0 rel_ub_q0p75 8 0.000000 191.250000 DEPOSIT ABSOLUTE /end AXIS_PTS
/begin AXIS_PTS RLV08_UM "" 0x814086 rl_um ME7_SST97 0 rel_ub_q0p75 8 0.000000 191.250000 DEPOSIT ABSOLUTE /end AXIS_PTS
/begin AXIS_PTS SAN12ESUW "SST-Verteilung fÅr den begrenzten EinspritzzÑhler anztib_w" 0x81000C anztib_w ME7_SST109 0 dez___UW 12 0.000000 65535.000000 DEPOSIT ABSOLUTE EXTENDED_LIMITS 0.000000 0.996094 /end AXIS_PTS
/begin RECORD_LAYOUT ME7_SST109 NO_AXIS_PTS_X 1 UWORD AXIS_PTS_X 2 UWORD INDEX_INCR DIRECT /end RECORD_LAYOUT
/begin AXIS_PTS SBF02MFSB "" 0x815A5F bfzglf ME7_SST103 0 bfzg_sb_q0p217 2 -27.776000 27.559000 DEPOSIT ABSOLUTE EXTENDED_LIMITS 0.000000 0.996094 /end AXIS_PTS
/begin RECORD_LAYOUT ME7_SST103 NO_AXIS_PTS_X 1 UBYTE AXIS_PTS_X 2 SBYTE INDEX_INCR DIRECT /end RECORD_LAYOUT
/begin AXIS_PTS SDK08FEUW "SST-Verteilung fÅr Drosselklappenwinkel" 0x81B29E wdkbad_w ME7_SST115 0 relDK_q0p02441 8 -800.000000 799.976000 DEPOSIT ABSOLUTE EXTENDED_LIMITS 0.000000 0.996094 /end AXIS_PTS
/begin RECORD_LAYOUT ME7_SST115 NO_AXIS_PTS_X 1 UWORD AXIS_PTS_X 2 SWORD INDEX_INCR DIRECT /end RECORD_LAYOUT
/begin AXIS_PTS SDK10TEUB "wdkba abhÑngige StÅtzstellen (Anzahl 10)" 0x818191 wdkba ME7_SST97 0 relDK_ub_b100 10 0.000000 100.000000 DEPOSIT ABSOLUTE EXTENDED_LIMITS 0.000000 0.996094 /end AXIS_PTS
/begin AXIS_PTS SDN06LLSB "StÅtzstellenvert. Drehzahldifferenz, 10 Sst., LL-Reg." 0x8156C9 dn ME7_SST103 0 nmotd_sb_q10 6 -1280.000000 1270.000000 DEPOSIT ABSOLUTE EXTENDED_LIMITS 0.000000 2550.000000 /end AXIS_PTS
/begin AXIS_PTS SDZ03DMUB "SST-Verteilung in DMD, 3 Drehzahl-SST" 0x814550 rl ME7_SST97 0 rel_ub_q0p75 3 0.000000 191.250000 DEPOSIT ABSOLUTE EXTENDED_LIMITS 0.000000 2550.000000 /end AXIS_PTS
/begin AXIS_PTS SDZ03DMUB2 "" 0x814554 rl ME7_SST97 0 rel_ub_q0p75 3 0.000000 191.250000 DEPOSIT ABSOLUTE EXTENDED_LIMITS 0.000000 2550.000000 /end AXIS_PTS
/begin AXIS_PTS SDZ08DMUB "SST-Verteilung in DMD, 8 Drehzahl-SST" 0x814558 nmot ME7_SST97 0 nmot_ub_q40 8 0.000000 10200.000000 DEPOSIT ABSOLUTE EXTENDED_LIMITS 0.000000 2550.000000 /end AXIS_PTS
/begin AXIS_PTS SDZ08DMUB2 "" 0x814561 nmot ME7_SST97 0 nmot_ub_q40 8 0.000000 10200.000000 DEPOSIT ABSOLUTE EXTENDED_LIMITS 0.000000 2550.000000 /end AXIS_PTS
/begin AXIS_PTS SEZ06TMUB "" 0x81819C etazwimt ME7_SST97 0 rel_ub_b127p5 6 0.000000 127.500000 DEPOSIT ABSOLUTE EXTENDED_LIMITS 0.000000 256.000000 /end AXIS_PTS
/begin AXIS_PTS SFR05TEUB "frmit abhÑngige StÅtzstellen (Anzahl 5)" 0x8181A3 frmit ME7_SST97 0 fak_ub_b2 5 0.000000 1.992190 DEPOSIT ABSOLUTE EXTENDED_LIMITS 0.000000 143.250000 /end AXIS_PTS
/begin AXIS_PTS SGA06MDUB "" 0x81A0CA gangi ME7_SST97 0 dez 6 0.000000 255.000000 DEPOSIT ABSOLUTE EXTENDED_LIMITS 0.000000 143.250000 /end AXIS_PTS
/begin AXIS_PTS SGA08MDUB "StÅtzstellenverteilung Ist Gang 8 Sst." 0x81437F gangi ME7_SST97 0 dez 8 0.000000 255.000000 DEPOSIT ABSOLUTE EXTENDED_LIMITS 0.000000 143.250000 /end AXIS_PTS
/begin AXIS_PTS SKS06ESUB "SST-Verteilung fÅr den Startadaptionsfaktor kstaa" 0x814388 kstaa ME7_SST97 0 fak_ub_b2 6 0.000000 1.992190 DEPOSIT ABSOLUTE EXTENDED_LIMITS 0.000000 10200.000000 /end AXIS_PTS
/begin AXIS_PTS SLD04LDUB "" 0x81438F lde ME7_SST97 0 p_sb_q10___UB 4 0.000000 2550.000000 DEPOSIT ABSOLUTE EXTENDED_LIMITS 0.000000 10200.000000 /end AXIS_PTS
/begin AXIS_PTS SLX06TMUW "" 0x81A0D2 lamsbg_w ME7_SST109 0 fak_uw_b16 6 0.000000 15.999800 DEPOSIT ABSOLUTE EXTENDED_LIMITS 0.000000 65535.000000 /end AXIS_PTS
/begin AXIS_PTS SMI04LLUB "" 0x810026 mifa_w ME7_SST109 0 rel_uw_b100 4 0.000000 99.998500 DEPOSIT ABSOLUTE EXTENDED_LIMITS 0.000000 65535.000000 /end AXIS_PTS
/begin AXIS_PTS SMK08MDSW "" 0x81CF88 mkar_w ME7_SST115 0 rel_sw_b100 8 -100.000000 99.996900 DEPOSIT ABSOLUTE EXTENDED_LIMITS 0.000000 65535.000000 /end AXIS_PTS
/begin AXIS_PTS SML05DKUB "" 0x8181A9 ml ME7_SST97 0 m_ub_b1020 5 0.000000 1020.000000 DEPOSIT ABSOLUTE EXTENDED_LIMITS 0.000000 65535.000000 /end AXIS_PTS
/begin AXIS_PTS SML05LKUB "" 0x8181AF ml ME7_SST97 0 m_ub_b1020 5 0.000000 1020.000000 DEPOSIT ABSOLUTE EXTENDED_LIMITS 0.000000 65535.000000 /end AXIS_PTS
/begin AXIS_PTS SML06TEUB "ml abhÑngige StÅtzstellen (Anzahl 6)" 0x8181B5 ml ME7_SST97 0 m_ub_b1020 6 0.000000 1020.000000 DEPOSIT ABSOLUTE EXTENDED_LIMITS 0.000000 65535.000000 /end AXIS_PTS
/begin AXIS_PTS SML06TMUB "" 0x8181BC ml ME7_SST97 0 m_ub_b1020 6 0.000000 1020.000000 DEPOSIT ABSOLUTE EXTENDED_LIMITS 0.000000 65535.000000 /end AXIS_PTS
/begin AXIS_PTS SML07TMUW "" 0x81A0E0 ml_w ME7_SST109 0 m_uw_b6553p5 7 0.000000 6553.500000 DEPOSIT ABSOLUTE EXTENDED_LIMITS 0.000000 65535.000000 /end AXIS_PTS
/begin AXIS_PTS SMO08OPUB "" 0x815A4B mizuvfil ME7_SST97 0 rel_ub_b99p6 8 0.000000 99.609400 DEPOSIT ABSOLUTE EXTENDED_LIMITS 0.000000 182.041667 /end AXIS_PTS
/begin AXIS_PTS SNM06LHUB "" 0x8181D2 nmot ME7_SST97 0 nmot_ub_q40 6 0.000000 10200.000000 DEPOSIT ABSOLUTE EXTENDED_LIMITS 0.000000 182.041667 /end AXIS_PTS
/begin AXIS_PTS SNM06LLUB "SÅtzstellenverteilung fÅr Motordrehzahl" 0x810030 nmot_w ME7_SST109 0 nmot_uw_q0p25 6 0.000000 16383.800000 DEPOSIT ABSOLUTE EXTENDED_LIMITS 0.000000 182.041667 /end AXIS_PTS
/begin AXIS_PTS SNM06MDUW "" 0x81A0F0 nmot_w ME7_SST109 0 nmot_uw_q0p25 6 0.000000 16383.800000 DEPOSIT ABSOLUTE EXTENDED_LIMITS 0.000000 182.041667 /end AXIS_PTS
/begin AXIS_PTS SNM07ESUB "StÅtzstellenverteilung Drehzahl, 7 Sst." 0x8181D9 nmot ME7_SST97 0 nmot_ub_q40 7 0.000000 10200.000000 DEPOSIT ABSOLUTE EXTENDED_LIMITS 0.000000 182.041667 /end AXIS_PTS
/begin AXIS_PTS SNM07LRUB "" 0x8181E1 nmot ME7_SST97 0 nmot_ub_q40 7 0.000000 10200.000000 DEPOSIT ABSOLUTE EXTENDED_LIMITS 0.000000 182.041667 /end AXIS_PTS
/begin AXIS_PTS SNM08DMUB "SST-Verteilung in DMD, 8 Drehzahl-SST" 0x81439B nmot ME7_SST97 0 nmot_ub_q40 8 0.000000 10200.000000 DEPOSIT ABSOLUTE EXTENDED_LIMITS 0.000000 182.041667 /end AXIS_PTS
/begin AXIS_PTS SNM08FEUB "StÅtzstellenverteilung Drehzahl, 08 Sst., FÅllungseingriffe" 0x8181E9 nmot ME7_SST97 0 nmot_ub_q40 8 0.000000 10200.000000 DEPOSIT ABSOLUTE EXTENDED_LIMITS 0.000000 182.041667 /end AXIS_PTS
/begin AXIS_PTS SNM08FEUW "SST-Verteilung fÅr Drehzahl" 0x81B2B0 nmot_w ME7_SST109 0 nmot_uw_q0p25 8 0.000000 16383.800000 DEPOSIT ABSOLUTE EXTENDED_LIMITS 0.000000 182.041667 /end AXIS_PTS
/begin AXIS_PTS SNM08GKUB "StÅtzstellenverteilung Gemischkontrolle 8 nmot StÅtzstellen" 0x818A9C nmot ME7_SST97 0 nmot_ub_q40 8 0.000000 10200.000000 DEPOSIT ABSOLUTE EXTENDED_LIMITS 0.000000 182.041667 /end AXIS_PTS
/begin AXIS_PTS SNM08LDUB "" 0x8143A4 nmot ME7_SST97 0 nmot_ub_q40 8 0.000000 10200.000000 DEPOSIT ABSOLUTE EXTENDED_LIMITS 0.000000 182.041667 /end AXIS_PTS
/begin AXIS_PTS SNM08LDUW "" 0x81003E nmot_w ME7_SST109 0 nmot_uw_q0p25 8 0.000000 16383.800000 DEPOSIT ABSOLUTE EXTENDED_LIMITS 0.000000 182.041667 /end AXIS_PTS
/begin AXIS_PTS SNM08OPUB "" 0x8143AD nmot ME7_SST97 0 nmot_ub_q40 8 0.000000 10200.000000 DEPOSIT ABSOLUTE EXTENDED_LIMITS 0.000000 182.041667 /end AXIS_PTS
/begin AXIS_PTS SNM08__UB "StÅtzstellenverteilung Drehzahl, 8 Sst." 0x8181FB nmot ME7_SST97 0 nmot_ub_q40 8 0.000000 10200.000000 DEPOSIT ABSOLUTE EXTENDED_LIMITS 0.000000 182.041667 /end AXIS_PTS
/begin AXIS_PTS SNM10TEUB "nmot abhÑngige StÅtzstellen (Anzahl 10)" 0x818204 nmot ME7_SST97 0 nmot_ub_q40 10 0.000000 10200.000000 DEPOSIT ABSOLUTE EXTENDED_LIMITS 0.000000 182.041667 /end AXIS_PTS
/begin AXIS_PTS SNM12ESUB "SST-Verteilung fÅr die Motordrehzahl nmot" 0x8143B6 nmot ME7_SST97 0 nmot_ub_q40 12 0.000000 10200.000000 DEPOSIT ABSOLUTE EXTENDED_LIMITS 0.000000 182.041667 /end AXIS_PTS
/begin AXIS_PTS SNM12FEUB "StÅtzstellen fÅr WDKSMX, WDKUGDN" 0x8143C3 nmot ME7_SST97 0 nmot_ub_q40 12 0.000000 10200.000000 DEPOSIT ABSOLUTE EXTENDED_LIMITS 0.000000 182.041667 /end AXIS_PTS
/begin AXIS_PTS SNM12LDUW "" 0x810050 nmot_w ME7_SST109 0 nmot_uw_q0p25 12 0.000000 16383.800000 DEPOSIT ABSOLUTE EXTENDED_LIMITS 0.000000 182.041667 /end AXIS_PTS
/begin AXIS_PTS SNM16CIUB "" 0x81820F nmot ME7_SST97 0 nmot_ub_q40 16 0.000000 10200.000000 DEPOSIT ABSOLUTE EXTENDED_LIMITS 0.000000 182.041667 /end AXIS_PTS
/begin AXIS_PTS SNM16GKUB "" 0x818220 nmot ME7_SST97 0 nmot_ub_q40 16 0.000000 10200.000000 DEPOSIT ABSOLUTE EXTENDED_LIMITS 0.000000 182.041667 /end AXIS_PTS
/begin AXIS_PTS SNM16KRDYUB "" 0x818231 nmot ME7_SST97 0 nmot_ub_q40 16 0.000000 10200.000000 DEPOSIT ABSOLUTE EXTENDED_LIMITS 0.000000 182.041667 /end AXIS_PTS
/begin AXIS_PTS SNM16KRUB "StÅtzstellenverteilung Drehzahl, 16 Sst." 0x818242 nmot ME7_SST97 0 nmot_ub_q40 16 0.000000 10200.000000 DEPOSIT ABSOLUTE EXTENDED_LIMITS 0.000000 182.041667 /end AXIS_PTS
/begin AXIS_PTS SNM16LDUB "" 0x8143D0 nmot ME7_SST97 0 nmot_ub_q40 16 0.000000 10200.000000 DEPOSIT ABSOLUTE EXTENDED_LIMITS 0.000000 182.041667 /end AXIS_PTS
/begin AXIS_PTS SNM16LDUW "" 0x81006A nmot_w ME7_SST109 0 nmot_uw_q0p25 16 0.000000 16383.800000 DEPOSIT ABSOLUTE EXTENDED_LIMITS 0.000000 182.041667 /end AXIS_PTS
/begin AXIS_PTS SNM16OPUW "StÅtzstellenverteilung Drehzahl" 0x81008C nmot_w ME7_SST109 0 nmot_uw_q0p25 16 0.000000 16383.800000 DEPOSIT ABSOLUTE EXTENDED_LIMITS 0.000000 182.041667 /end AXIS_PTS
/begin AXIS_PTS SNM16ZUUB "StÅtzstellenverteilung Drehzahl, 16 Sst." 0x8143E1 nmot ME7_SST97 0 nmot_ub_q40 16 0.000000 10200.000000 DEPOSIT ABSOLUTE EXTENDED_LIMITS 0.000000 182.041667 /end AXIS_PTS
/begin AXIS_PTS SNS06LLSB "StÅtzstellenvert., Solldrehzahlabw., 06 Sst., LL-Regel." 0x815568 dns ME7_SST103 0 nmotd_sb_q10 6 -1280.000000 1270.000000 DEPOSIT ABSOLUTE EXTENDED_LIMITS 0.000000 182.041667 /end AXIS_PTS
/begin AXIS_PTS SPL08LDUW "" 0x8100AE plsolr_w ME7_SST109 0 p_uw_q0p039 8 0.000000 2559.960000 DEPOSIT ABSOLUTE EXTENDED_LIMITS 0.000000 2.550000 /end AXIS_PTS
/begin AXIS_PTS SPSNV08_UC "" 0x815C9A spsn_uc ME7_SST97 0 spg_ub_q0p019 8 0.000000 4.980470 DEPOSIT ABSOLUTE EXTENDED_LIMITS 0.000000 10200.000000 /end AXIS_PTS
/begin AXIS_PTS SPSNV08_UM "StÅtzstellenverteilung fÅr Pedalwert in der FunktionsÅberwachung" 0x81408F spsn_um ME7_SST97 0 spg_ub_q0p019 8 0.000000 4.980470 DEPOSIT ABSOLUTE EXTENDED_LIMITS 0.000000 10200.000000 /end AXIS_PTS
/begin AXIS_PTS SPU08LDUB "" 0x8143F2 pu ME7_SST97 0 p_ub_q5 8 0.000000 1275.000000 DEPOSIT ABSOLUTE EXTENDED_LIMITS 0.000000 4.980469 /end AXIS_PTS
/begin AXIS_PTS SQM05TEUB "Luftmassenquotient-abhÑngige StÅtzstellen (Anzahl =5)" 0x8143FB qmsdyn ME7_SST97 0 fak_ub_b16 5 0.000000 15.937500 DEPOSIT ABSOLUTE EXTENDED_LIMITS 0.000000 4.980469 /end AXIS_PTS
/begin AXIS_PTS SRL03KRUB "StÅtzstellenverteilung relative FÅllung, 3 Sst." 0x818253 rl ME7_SST97 0 rel_ub_q0p75 3 0.000000 191.250000 DEPOSIT ABSOLUTE EXTENDED_LIMITS 0.000000 5.100000 /end AXIS_PTS
/begin AXIS_PTS SRL03MFUW "" 0x813470 rl_w ME7_SST109 0 rel_uw_q0p0234 3 0.000000 1535.980000 DEPOSIT ABSOLUTE EXTENDED_LIMITS 0.000000 5.100000 /end AXIS_PTS
/begin AXIS_PTS SRL04KRUB "StÅtzstellenverteilung relative FÅllung, 4 Sst." 0x818257 rl ME7_SST97 0 rel_ub_q0p75 4 0.000000 191.250000 DEPOSIT ABSOLUTE EXTENDED_LIMITS 0.000000 5.100000 /end AXIS_PTS
/begin AXIS_PTS SRL06ESUB "Sst-Verteilung fÅr die relative FÅllung rl" 0x814401 rl ME7_SST97 0 rel_ub_q0p75 6 0.000000 191.250000 DEPOSIT ABSOLUTE EXTENDED_LIMITS 0.000000 5.100000 /end AXIS_PTS
/begin AXIS_PTS SRL06KRUB "" 0x81825C rl ME7_SST97 0 rel_ub_q0p75 6 0.000000 191.250000 DEPOSIT ABSOLUTE EXTENDED_LIMITS 0.000000 5.100000 /end AXIS_PTS
/begin AXIS_PTS SRL06LHUB "" 0x818263 rl ME7_SST97 0 rel_ub_q0p75 6 0.000000 191.250000 DEPOSIT ABSOLUTE EXTENDED_LIMITS 0.000000 5.100000 /end AXIS_PTS
/begin AXIS_PTS SRL06LRUB "" 0x81826A rl ME7_SST97 0 rel_ub_q0p75 6 0.000000 191.250000 DEPOSIT ABSOLUTE EXTENDED_LIMITS 0.000000 5.100000 /end AXIS_PTS
/begin AXIS_PTS SRL08DMUB "SST-Verteilung in DMD, 8 Last-SST" 0x814408 rl ME7_SST97 0 rel_ub_q0p75 8 0.000000 191.250000 DEPOSIT ABSOLUTE EXTENDED_LIMITS 0.000000 5.100000 /end AXIS_PTS
/begin AXIS_PTS SRL08GKUB "StÅtzstellenverteilung Gemischkontrolle 8 rl StÅtzstellen" 0x818AA5 rl ME7_SST97 0 rel_ub_q0p75 8 0.000000 191.250000 DEPOSIT ABSOLUTE EXTENDED_LIMITS 0.000000 5.100000 /end AXIS_PTS
/begin AXIS_PTS SRL08NXUB "StÅtzstellenverteilung relative LuftfÅllung 8 Sst." 0x818271 rl ME7_SST97 0 rel_ub_q0p75 8 0.000000 191.250000 DEPOSIT ABSOLUTE EXTENDED_LIMITS 0.000000 5.100000 /end AXIS_PTS
/begin AXIS_PTS SRL11OPUW "StÅtzstellenverteilung relative LuftfÅllung" 0x81343C rl_w_kge ME7_SST109 0 rel_uw_q0p0234 11 0.000000 1535.980000 DEPOSIT ABSOLUTE EXTENDED_LIMITS 0.000000 5.100000 /end AXIS_PTS
/begin AXIS_PTS SRL12ESUB "Sst-Verteilung fÅr die relative FÅllung rl" 0x814411 rl ME7_SST97 0 rel_ub_q0p75 12 0.000000 191.250000 DEPOSIT ABSOLUTE EXTENDED_LIMITS 0.000000 5.100000 /end AXIS_PTS
/begin AXIS_PTS SRL12GKUB "" 0x81827A rl ME7_SST97 0 rel_ub_q0p75 12 0.000000 191.250000 DEPOSIT ABSOLUTE EXTENDED_LIMITS 0.000000 5.100000 /end AXIS_PTS
/begin AXIS_PTS SRL12ZUUB "StÅtzstellenverteilung relative LuftfÅllung, 12 St." 0x81441E rl ME7_SST97 0 rel_ub_q0p75 12 0.000000 191.250000 DEPOSIT ABSOLUTE EXTENDED_LIMITS 0.000000 5.100000 /end AXIS_PTS
/begin AXIS_PTS ST107TMUB "" 0x818287 tabgmst ME7_SST97 0 temp_ub_q5_o50 7 -50.000000 1225.000000 DEPOSIT ABSOLUTE EXTENDED_LIMITS 0.000000 255.000000 /end AXIS_PTS
/begin AXIS_PTS ST307TMUB "" 0x81828F tkatmst ME7_SST97 0 temp_ub_q5_o50 7 -50.000000 1225.000000 DEPOSIT ABSOLUTE EXTENDED_LIMITS 0.000000 255.000000 /end AXIS_PTS
/begin AXIS_PTS STA04LLUB "" 0x8100C0 tans ME7_SST109 0 temp_ub_q0p75_o48___UW 4 -48.000000 49103.300000 DEPOSIT ABSOLUTE EXTENDED_LIMITS 0.000000 255.000000 /end AXIS_PTS
/begin AXIS_PTS STA06ESUB "SST-Verteilung fÅr die Ansauglufttemperatur" 0x818297 tans ME7_SST97 0 temp_ub_q0p75_o48 6 -48.000000 143.250000 DEPOSIT ABSOLUTE EXTENDED_LIMITS 0.000000 255.000000 /end AXIS_PTS
/begin AXIS_PTS STA08LDUB "" 0x81442B tans ME7_SST97 0 temp_ub_q0p75_o48 8 -48.000000 143.250000 DEPOSIT ABSOLUTE EXTENDED_LIMITS 0.000000 255.000000 /end AXIS_PTS
/begin AXIS_PTS STA12WLUB "" 0x814441 tans ME7_SST97 0 temp_ub_q0p75_o48 12 -48.000000 143.250000 DEPOSIT ABSOLUTE EXTENDED_LIMITS 0.000000 255.000000 /end AXIS_PTS
/begin AXIS_PTS STM04FEUB "" 0x81444E tmot ME7_SST97 0 temp_ub_q0p75_o48 4 -48.000000 143.250000 DEPOSIT ABSOLUTE EXTENDED_LIMITS 0.000000 10200.000000 /end AXIS_PTS
/begin AXIS_PTS STM04SAUB "StÅtzstellenverteilung Motortemperatur, 4 Sst." 0x814453 tmot ME7_SST97 0 temp_ub_q0p75_o48 4 -48.000000 143.250000 DEPOSIT ABSOLUTE EXTENDED_LIMITS 0.000000 10200.000000 /end AXIS_PTS
/begin AXIS_PTS STM05SAUB "" 0x8182A3 tmot ME7_SST97 0 temp_ub_q0p75_o48 5 -48.000000 143.250000 DEPOSIT ABSOLUTE EXTENDED_LIMITS 0.000000 10200.000000 /end AXIS_PTS
/begin AXIS_PTS STM05TMUB "" 0x8182A9 tmst ME7_SST97 0 temp_ub_q0p75_o48 5 -48.000000 143.250000 DEPOSIT ABSOLUTE EXTENDED_LIMITS 0.000000 10200.000000 /end AXIS_PTS
/begin AXIS_PTS STM06LLUB "StÅtzstellenverteilung Motortemperatur, 6 Sst." 0x8182AF tmot ME7_SST97 0 temp_ub_q0p75_o48 6 -48.000000 143.250000 DEPOSIT ABSOLUTE EXTENDED_LIMITS 0.000000 10200.000000 /end AXIS_PTS
/begin AXIS_PTS STM09ESUB "StÅtzstellenverteilung Motortemperatur, 9 Sst." 0x8182CF tmot ME7_SST97 0 temp_ub_q0p75_o48 9 -48.000000 143.250000 DEPOSIT ABSOLUTE EXTENDED_LIMITS 0.000000 10200.000000 /end AXIS_PTS
/begin AXIS_PTS STM12ESUB "SST-Verteilung fÅr die Motortemperatur tmot" 0x81446A tmot ME7_SST97 0 temp_ub_q0p75_o48 12 -48.000000 143.250000 DEPOSIT ABSOLUTE EXTENDED_LIMITS 0.000000 10200.000000 /end AXIS_PTS
/begin AXIS_PTS STS12ESUB "SST-Verteilung fÅr Motorstarttemperatur" 0x814477 tmst ME7_SST97 0 temp_ub_q0p75_o48 12 -48.000000 143.250000 DEPOSIT ABSOLUTE EXTENDED_LIMITS 0.000000 10200.000000 /end AXIS_PTS
/begin AXIS_PTS STS14ESUB "" 0x814484 tmst ME7_SST97 0 temp_ub_q0p75_o48 14 -48.000000 143.250000 DEPOSIT ABSOLUTE EXTENDED_LIMITS 0.000000 10200.000000 /end AXIS_PTS
/begin AXIS_PTS STV10LDSW "" 0x81CAD8 ldtvr_w ME7_SST115 0 tv_sw_q0p005 10 -163.840000 163.835000 DEPOSIT ABSOLUTE EXTENDED_LIMITS 0.000000 10200.000000 /end AXIS_PTS
/begin AXIS_PTS SUE08MFUB "" 0x814493 uevges ME7_SST97 0 fak_q0p1 8 0.000000 25.500000 DEPOSIT ABSOLUTE EXTENDED_LIMITS 0.000000 10200.000000 /end AXIS_PTS
/begin AXIS_PTS SVP12LDUW "" 0x8100CA vpsspu_w ME7_SST109 0 fak_uw_b4 12 0.000000 3.999940 DEPOSIT ABSOLUTE EXTENDED_LIMITS 0.000000 3.984375 /end AXIS_PTS
/begin AXIS_PTS SVZ06MFUW "" 0x810E4A vziel_w ME7_SST109 0 vfzg_uw_b512 6 0.000000 511.992000 DEPOSIT ABSOLUTE EXTENDED_LIMITS 0.000000 3.984375 /end AXIS_PTS
/begin AXIS_PTS SWK08LDUB "" 0x81449C wkrmstat ME7_SST97 0 zw_ub_q0p75 8 0.000000 191.250000 DEPOSIT ABSOLUTE EXTENDED_LIMITS 0.000000 3.984375 /end AXIS_PTS
/begin AXIS_PTS SWK108LDUB "" 0x8144A5 wkrmdy ME7_SST97 0 zw_ub_q0p75 8 0.000000 191.250000 DEPOSIT ABSOLUTE EXTENDED_LIMITS 0.000000 3.984375 /end AXIS_PTS
/begin AXIS_PTS SWK208LDUB "" 0x8144AE wkrmsu ME7_SST97 0 zw_ub_q0p75 8 0.000000 191.250000 DEPOSIT ABSOLUTE EXTENDED_LIMITS 0.000000 3.984375 /end AXIS_PTS
/begin AXIS_PTS SWP08OPUB "" 0x8144B7 wped ME7_SST97 0 relPED_ub_b100 8 0.000000 100.000000 DEPOSIT ABSOLUTE EXTENDED_LIMITS 0.000000 3.984375 /end AXIS_PTS
/begin COMPU_METHOD bfzg_sb_q0p217 "" RAT_FUNC "%6.3" "m/s^2" COEFFS 0 1.000000 0.000000 0 0.000000 2.170000e-01 /end COMPU_METHOD
/begin COMPU_METHOD dez "1 : 1 Umrechnug (dez/hex)" RAT_FUNC "%6.2" "" COEFFS 0 1.000000 0.000000 0 0.000000 1.000000 /end COMPU_METHOD
/begin COMPU_METHOD dez___SL "1 : 1 Umrechnug (dez/hex)" RAT_FUNC "%6.2" "" COEFFS 0 1.000000 0.000000 0 0.000000 1.000000 /end COMPU_METHOD
/begin COMPU_METHOD dez___UW "1 : 1 Umrechnug (dez/hex)" RAT_FUNC "%6.2" "" COEFFS 0 1.000000 0.000000 0 0.000000 1.000000 /end COMPU_METHOD
/begin COMPU_METHOD dichte_ub_b2 "" RAT_FUNC "%6.4" "kg/m^3" COEFFS 0 256.000000 0.000000 0 0.000000 2.000000 /end COMPU_METHOD
/begin COMPU_METHOD fak_q0p00195 "" RAT_FUNC "%6.4" "-" COEFFS 0 6.553600e+04 0.000000 0 0.000000 128.000000 /end COMPU_METHOD
/begin COMPU_METHOD fak_q0p03815 "" RAT_FUNC "%6.4" "%/(s*kg/h)" COEFFS 0 6.553600e+04 0.000000 0 0.000000 2500.000000 /end COMPU_METHOD
/begin COMPU_METHOD fak_q0p1 "" RAT_FUNC "%6.3" "" COEFFS 0 1.000000 0.000000 0 0.000000 1.000000e-01 /end COMPU_METHOD
/begin COMPU_METHOD fak_sb_b0p25 "" RAT_FUNC "%6.4" "-" COEFFS 0 256.000000 0.000000 0 0.000000 5.000000e-01 /end COMPU_METHOD
/begin COMPU_METHOD fak_sb_b1 "" RAT_FUNC "%6.4" "-" COEFFS 0 256.000000 0.000000 0 0.000000 2.000000 /end COMPU_METHOD
/begin COMPU_METHOD fak_sb_b16 "" RAT_FUNC "%6.3" "-" COEFFS 0 256.000000 0.000000 0 0.000000 32.000000 /end COMPU_METHOD
/begin COMPU_METHOD fak_sb_b2 "" RAT_FUNC "%6.4" "-" COEFFS 0 256.000000 0.000000 0 0.000000 4.000000 /end COMPU_METHOD
/begin COMPU_METHOD fak_sb_b64 "" RAT_FUNC "%6.3" "-" COEFFS 0 256.000000 0.000000 0 0.000000 128.000000 /end COMPU_METHOD
/begin COMPU_METHOD fak_sw_b1 "" RAT_FUNC "%7.6" "-" COEFFS 0 6.553600e+04 0.000000 0 0.000000 2.000000 /end COMPU_METHOD
/begin COMPU_METHOD fak_sw_b64 "" RAT_FUNC "%6.4" "-" COEFFS 0 6.553600e+04 0.000000 0 0.000000 128.000000 /end COMPU_METHOD
/begin COMPU_METHOD fak_ub_b0p25 "" RAT_FUNC "%6.5" "-" COEFFS 0 256.000000 0.000000 0 0.000000 2.500000e-01 /end COMPU_METHOD
/begin COMPU_METHOD fak_ub_b0p5 "" RAT_FUNC "%6.4" "-" COEFFS 0 256.000000 0.000000 0 0.000000 5.000000e-01 /end COMPU_METHOD
/begin COMPU_METHOD fak_ub_b1 "" RAT_FUNC "%6.4" "-" COEFFS 0 256.000000 0.000000 0 0.000000 1.000000 /end COMPU_METHOD
/begin COMPU_METHOD fak_ub_b12p45 "" RAT_FUNC "%6.4" "%" COEFFS 0 2048.000000 0.000000 0 0.000000 100.000000 /end COMPU_METHOD
/begin COMPU_METHOD fak_ub_b16 "" RAT_FUNC "%6.4" "-" COEFFS 0 256.000000 0.000000 0 0.000000 16.000000 /end COMPU_METHOD
/begin COMPU_METHOD fak_ub_b1p25_o0p75 "" RAT_FUNC "%6.3" "-" COEFFS 0 1.000000 -7.500000e-01 0 0.000000 1.953130e-03 /end COMPU_METHOD
/begin COMPU_METHOD fak_ub_b2 "" RAT_FUNC "%6.4" "-" COEFFS 0 256.000000 0.000000 0 0.000000 2.000000 /end COMPU_METHOD
/begin COMPU_METHOD fak_ub_b32 "" RAT_FUNC "%6.3" "-" COEFFS 0 256.000000 0.000000 0 0.000000 32.000000 /end COMPU_METHOD
/begin COMPU_METHOD fak_ub_b3p125 "" RAT_FUNC "%6.4" "%/Upm" COEFFS 0 2048.000000 0.000000 0 0.000000 25.000000 /end COMPU_METHOD
/begin COMPU_METHOD fak_ub_b4 "" RAT_FUNC "%6.4" "-" COEFFS 0 256.000000 0.000000 0 0.000000 4.000000 /end COMPU_METHOD
/begin COMPU_METHOD fak_ub_b64 "" RAT_FUNC "%6.3" "-" COEFFS 0 256.000000 0.000000 0 0.000000 64.000000 /end COMPU_METHOD
/begin COMPU_METHOD fak_ub_b77p81 "" RAT_FUNC "%6.3" "%/s" COEFFS 0 327.680000 0.000000 0 0.000000 100.000000 /end COMPU_METHOD
/begin COMPU_METHOD fak_ub_b8 "" RAT_FUNC "%6.4" "-" COEFFS 0 256.000000 0.000000 0 0.000000 8.000000 /end COMPU_METHOD
/begin COMPU_METHOD fak_ub_q0p01 "" RAT_FUNC "%6.4" "-" COEFFS 0 1.000000 0.000000 0 0.000000 1.000000e-02 /end COMPU_METHOD
/begin COMPU_METHOD fak_uw_b1 "" RAT_FUNC "%7.6" "-" COEFFS 0 6.553600e+04 0.000000 0 0.000000 1.000000 /end COMPU_METHOD
/begin COMPU_METHOD fak_uw_b16 "" RAT_FUNC "%6.5" "-" COEFFS 0 6.553600e+04 0.000000 0 0.000000 16.000000 /end COMPU_METHOD
/begin COMPU_METHOD fak_uw_b2 "" RAT_FUNC "%7.6" "-" COEFFS 0 6.553600e+04 0.000000 0 0.000000 2.000000 /end COMPU_METHOD
/begin COMPU_METHOD fak_uw_b4 "" RAT_FUNC "%7.6" "-" COEFFS 0 6.553600e+04 0.000000 0 0.000000 4.000000 /end COMPU_METHOD
/begin COMPU_METHOD fak_uw_b4864 "" RAT_FUNC "%6.4" "-" COEFFS 0 6.553600e+04 0.000000 0 0.000000 4864.000000 /end COMPU_METHOD
/begin COMPU_METHOD fak_uw_b8 "" RAT_FUNC "%6.5" "-" COEFFS 0 6.553600e+04 0.000000 0 0.000000 8.000000 /end COMPU_METHOD
/begin COMPU_METHOD fak_uw_q0p001___SL "" RAT_FUNC "%6.4" "" COEFFS 0 6.553600e+04 0.000000 0 0.000000 65.536000 /end COMPU_METHOD
/begin COMPU_METHOD freq_sw_b512 "" RAT_FUNC "%6.4" "1/s" COEFFS 0 6.553600e+04 0.000000 0 0.000000 1024.000000 /end COMPU_METHOD
/begin COMPU_METHOD kumsrl_ub_b0p002 "" RAT_FUNC "%8.7" "(kg/h)/(1/min)(%)" COEFFS 0 128000.000000 0.000000 0 0.000000 1.000000 /end COMPU_METHOD
/begin COMPU_METHOD kva_ub_q20 "" RAT_FUNC "%6.1" "L/Zyl." COEFFS 0 1.000000 0.000000 0 0.000000 20.000000 /end COMPU_METHOD
/begin COMPU_METHOD kw_q6___SB "" RAT_FUNC "%6.2" "∞KW" COEFFS 0 1.000000 0.000000 0 0.000000 6.000000 /end COMPU_METHOD
/begin COMPU_METHOD kw_ub_q0p5 "" RAT_FUNC "%6.3" "∞KW" COEFFS 0 256.000000 0.000000 0 0.000000 128.000000 /end COMPU_METHOD
/begin COMPU_METHOD luquant "Umrechnung Laufunruhe in DMD" RAT_FUNC "%6.3" "(Umdr./sec)^2" COEFFS 0 1.583300 0.000000 0 0.000000 1.000000 /end COMPU_METHOD
/begin COMPU_METHOD luquant___UB "Umrechnung Laufunruhe in DMD" RAT_FUNC "%6.3" "(Umdr./sec)^2" COEFFS 0 1.583300 0.000000 0 0.000000 1.000000 /end COMPU_METHOD
/begin COMPU_METHOD mgrad_ub_b221p35 "" RAT_FUNC "%6.2" "mg/s" COEFFS 0 230.400000 0.000000 0 0.000000 200.000000 /end COMPU_METHOD
/begin COMPU_METHOD mgrad_uw_q0p0961 "" RAT_FUNC "%6.1" "mg/(V*s)" COEFFS 0 9805.820000 0.000000 0 0.000000 102000.000000 /end COMPU_METHOD
/begin COMPU_METHOD mk1sxs_ub_b25p6 "" RAT_FUNC "%6.3" "kg/h*s" COEFFS 0 0.000000 256.000000 0 10.000000 0.000000 /end COMPU_METHOD
/begin COMPU_METHOD m_q0p00195 "" RAT_FUNC "%6.4" "kg/(h*s)" COEFFS 0 6.553600e+04 0.000000 0 0.000000 128.000000 /end COMPU_METHOD
/begin COMPU_METHOD m_q0p00355 "" RAT_FUNC "%6.4" "kg" COEFFS 0 1125.000000 0.000000 0 0.000000 4.000000 /end COMPU_METHOD
/begin COMPU_METHOD m_q0p1 "" RAT_FUNC "%6.3" "kg/h" COEFFS 0 10.000000 0.000000 0 0.000000 1.000000 /end COMPU_METHOD
/begin COMPU_METHOD m_sw_q0p1 "" RAT_FUNC "%6.3" "kg/h" COEFFS 0 1.000000 0.000000 0 0.000000 1.000000e-01 /end COMPU_METHOD
/begin COMPU_METHOD m_ub_b1020 "" RAT_FUNC "%6.2" "kg/h" COEFFS 0 1.000000 0.000000 0 0.000000 4.000000 /end COMPU_METHOD
/begin COMPU_METHOD m_ub_b221p35 "" RAT_FUNC "%6.2" "mg" COEFFS 0 230.400000 0.000000 0 0.000000 200.000000 /end COMPU_METHOD
/begin COMPU_METHOD m_ub_b23p3 "" RAT_FUNC "%6.3" "kg" COEFFS 0 2812.500000 0.000000 0 0.000000 256.000000 /end COMPU_METHOD
/begin COMPU_METHOD m_ub_b25p6 "" RAT_FUNC "%6.3" "kg/h" COEFFS 0 256.000000 0.000000 0 0.000000 25.600000 /end COMPU_METHOD
/begin COMPU_METHOD m_ub_b780 "" RAT_FUNC "%6.2" "cm^3/min" COEFFS 0 256.000000 0.000000 0 0.000000 780.000000 /end COMPU_METHOD
/begin COMPU_METHOD m_ub_q0p0444 "" RAT_FUNC "%6.4" "g" COEFFS 0 1.000000 0.000000 0 0.000000 4.440000e-02 /end COMPU_METHOD
/begin COMPU_METHOD m_ub_q0p398 "" RAT_FUNC "%6.3" "kg/h" COEFFS 0 256.000000 0.000000 0 0.000000 102.000000 /end COMPU_METHOD
/begin COMPU_METHOD m_uw_b23p3 "" RAT_FUNC "%6.5" "kg" COEFFS 0 2812.500000 0.000000 0 0.000000 1.000000 /end COMPU_METHOD
/begin COMPU_METHOD m_uw_b4660 "" RAT_FUNC "%6.4" "g" COEFFS 0 3600.000000 0.000000 0 0.000000 256.000000 /end COMPU_METHOD
/begin COMPU_METHOD m_uw_b6553p5 "" RAT_FUNC "%6.3" "kg/h" COEFFS 0 1.000000 0.000000 0 0.000000 1.000000e-01 /end COMPU_METHOD
/begin COMPU_METHOD nmotd_sb_q10 "" RAT_FUNC "%6.1" "U/min" COEFFS 0 1.000000 0.000000 0 0.000000 10.000000 /end COMPU_METHOD
/begin COMPU_METHOD nmotg_sw_q0p39 "" RAT_FUNC "%6.3" "U/min/s" COEFFS 0 1.000000 0.000000 0 0.000000 3.906300e-01 /end COMPU_METHOD
/begin COMPU_METHOD nmot_ub_q10 "" RAT_FUNC "%6.1" "U/min" COEFFS 0 1.000000 0.000000 0 0.000000 10.000000 /end COMPU_METHOD
/begin COMPU_METHOD nmot_ub_q40 "" RAT_FUNC "%6.1" "Upm" COEFFS 0 1.000000 0.000000 0 0.000000 40.000000 /end COMPU_METHOD
/begin COMPU_METHOD nmot_ub_q40___SB "" RAT_FUNC "%6.1" "Upm" COEFFS 0 1.000000 0.000000 0 0.000000 40.000000 /end COMPU_METHOD
/begin COMPU_METHOD nmot_ub_q40___UW "" RAT_FUNC "%6.1" "Upm" COEFFS 0 1.000000 0.000000 0 0.000000 40.000000 /end COMPU_METHOD
/begin COMPU_METHOD nmot_uw_q0p25 "" RAT_FUNC "%6.3" "U/min" COEFFS 0 1.000000 0.000000 0 0.000000 2.500000e-01 /end COMPU_METHOD
/begin COMPU_METHOD perio_ub_b0p012207 "" RAT_FUNC "%7.6" "1/s" COEFFS 0 256.000000 0.000000 0 0.000000 1.220700e-02 /end COMPU_METHOD
/begin COMPU_METHOD p_sb_q0p25 "" RAT_FUNC "%6.3" "hPa" COEFFS 0 1.000000 0.000000 0 0.000000 2.500000e-01 /end COMPU_METHOD
/begin COMPU_METHOD p_sb_q10 "" RAT_FUNC "%6.1" "hPa" COEFFS 0 1.000000 0.000000 0 0.000000 10.000000 /end COMPU_METHOD
/begin COMPU_METHOD p_sb_q10___UB "" RAT_FUNC "%6.1" "hPa" COEFFS 0 1.000000 0.000000 0 0.000000 10.000000 /end COMPU_METHOD
/begin COMPU_METHOD p_sw_q0p000977 "" RAT_FUNC "%6.5" "hPa" COEFFS 0 1.000000 0.000000 0 0.000000 9.770000e-04 /end COMPU_METHOD
/begin COMPU_METHOD p_sw_q0p00244 "" RAT_FUNC "%6.4" "hPa" COEFFS 0 3.276800e+04 0.000000 0 0.000000 80.000000 /end COMPU_METHOD
/begin COMPU_METHOD p_sw_q0p078 "" RAT_FUNC "%6.4" "hPa" COEFFS 0 6.553600e+04 0.000000 0 0.000000 5120.000000 /end COMPU_METHOD
/begin COMPU_METHOD p_ub_q10 "" RAT_FUNC "%6.1" "hPa" COEFFS 0 1.000000 0.000000 0 0.000000 10.000000 /end COMPU_METHOD
/begin COMPU_METHOD p_ub_q5 "" RAT_FUNC "%6.2" "hPa" COEFFS 0 1.000000 0.000000 0 0.000000 5.000000 /end COMPU_METHOD
/begin COMPU_METHOD p_uw_q0p039 "" RAT_FUNC "%6.4" "hPa" COEFFS 0 256.000000 0.000000 0 0.000000 10.000000 /end COMPU_METHOD
/begin COMPU_METHOD q_uw_q0p0566 "" RAT_FUNC "%6.4" "kJ" COEFFS 0 65535.000000 0.000000 0 0.000000 3712.000000 /end COMPU_METHOD
/begin COMPU_METHOD relDK_q0p02441 "" RAT_FUNC "%6.4" "% DK" COEFFS 0 6.553600e+04 0.000000 0 0.000000 1600.000000 /end COMPU_METHOD
/begin COMPU_METHOD relDK_ub_b100 "" RAT_FUNC "%6.3" "% DK" COEFFS 0 255.000000 0.000000 0 0.000000 100.000000 /end COMPU_METHOD
/begin COMPU_METHOD relnmot_q0p02 "" RAT_FUNC "%6.4" "%/(U/min)/s" COEFFS 0 1.000000 0.000000 0 0.000000 2.000000e-02 /end COMPU_METHOD
/begin COMPU_METHOD relPED_ub_b100 "" RAT_FUNC "%6.3" "% PED" COEFFS 0 255.000000 0.000000 0 0.000000 100.000000 /end COMPU_METHOD
/begin COMPU_METHOD relPED_uw_b100 "" RAT_FUNC "%6.4" "% PED" COEFFS 0 65535.000000 0.000000 0 0.000000 100.000000 /end COMPU_METHOD
/begin COMPU_METHOD rel_q0p00195 "" RAT_FUNC "%6.4" "%" COEFFS 0 6.553600e+04 0.000000 0 0.000000 128.000000 /end COMPU_METHOD
/begin COMPU_METHOD rel_q0p002383 "" RAT_FUNC "%6.4" "%/(s*U/min)" COEFFS 0 256.000000 0.000000 0 0.000000 6.100000e-01 /end COMPU_METHOD
/begin COMPU_METHOD rel_sb_q0p39 "" RAT_FUNC "%6.3" "%" COEFFS 0 1.000000 0.000000 0 0.000000 3.906000e-01 /end COMPU_METHOD
/begin COMPU_METHOD rel_sw_b100 "" RAT_FUNC "%6.4" "%" COEFFS 0 3.276800e+04 0.000000 0 0.000000 100.000000 /end COMPU_METHOD
/begin COMPU_METHOD rel_sw_b1p5 "" RAT_FUNC "%7.6" "%/(1/min)" COEFFS 0 3.276800e+04 0.000000 0 0.000000 1.500000 /end COMPU_METHOD
/begin COMPU_METHOD rel_sw_b50 "" RAT_FUNC "%6.4" "%" COEFFS 0 6.553600e+04 0.000000 0 0.000000 100.000000 /end COMPU_METHOD
/begin COMPU_METHOD rel_sw_q0p0234 "" RAT_FUNC "%6.4" "%/seg" COEFFS 0 32.000000 0.000000 0 0.000000 7.500000e-01 /end COMPU_METHOD
/begin COMPU_METHOD rel_ub_b127p5 "" RAT_FUNC "%6.3" "%" COEFFS 0 2.000000 0.000000 0 0.000000 1.000000 /end COMPU_METHOD
/begin COMPU_METHOD rel_ub_b1p0 "" RAT_FUNC "%6.4" "%" COEFFS 0 256.000000 0.000000 0 0.000000 1.000000 /end COMPU_METHOD
/begin COMPU_METHOD rel_ub_b24p9 "" RAT_FUNC "%6.3" "%" COEFFS 0 255.000000 0.000000 0 0.000000 24.900000 /end COMPU_METHOD
/begin COMPU_METHOD rel_ub_b2p0 "" RAT_FUNC "%6.4" "%" COEFFS 0 256.000000 0.000000 0 0.000000 2.000000 /end COMPU_METHOD
/begin COMPU_METHOD rel_ub_b49p725 "" RAT_FUNC "%6.3" "%" COEFFS 0 255.000000 0.000000 0 0.000000 49.725000 /end COMPU_METHOD
/begin COMPU_METHOD rel_ub_b99p6 "" RAT_FUNC "%6.3" "%" COEFFS 0 256.000000 0.000000 0 0.000000 100.000000 /end COMPU_METHOD
/begin COMPU_METHOD rel_ub_bn24p9 "" RAT_FUNC "%6.5" "%" COEFFS 0 -255.000000 0.000000 0 0.000000 24.900000 /end COMPU_METHOD
/begin COMPU_METHOD rel_ub_q0p75 "" RAT_FUNC "%6.3" "%" COEFFS 0 1.000000 0.000000 0 0.000000 7.500000e-01 /end COMPU_METHOD
/begin COMPU_METHOD rel_ub_q8 "" RAT_FUNC "%6.2" "%/s" COEFFS 0 1.000000 0.000000 0 0.000000 8.000000 /end COMPU_METHOD
/begin COMPU_METHOD rel_uw_b0p3 "" RAT_FUNC "%8.7" "%/hPa" COEFFS 0 6.553600e+04 0.000000 0 0.000000 3.000000e-01 /end COMPU_METHOD
/begin COMPU_METHOD rel_uw_b100 "" RAT_FUNC "%6.4" "%" COEFFS 0 6.553600e+04 0.000000 0 0.000000 100.000000 /end COMPU_METHOD
/begin COMPU_METHOD rel_uw_b200 "" RAT_FUNC "%6.4" "%" COEFFS 0 6.553600e+04 0.000000 0 0.000000 200.000000 /end COMPU_METHOD
/begin COMPU_METHOD rel_uw_b3200 "" RAT_FUNC "%6.4" "%/(km/h)" COEFFS 0 6.553600e+04 0.000000 0 0.000000 3200.000000 /end COMPU_METHOD
/begin COMPU_METHOD rel_uw_b3276p75 "" RAT_FUNC "%6.4" "%/100hPa" COEFFS 0 1.000000 0.000000 0 0.000000 5.000000e-02 /end COMPU_METHOD
/begin COMPU_METHOD rel_uw_q0p0234 "" RAT_FUNC "%6.4" "%" COEFFS 0 32.000000 0.000000 0 0.000000 7.500000e-01 /end COMPU_METHOD
/begin COMPU_METHOD rkti_sy "" RAT_FUNC "%6.4" "ms/%" COEFFS 0 468.750000 0.000000 0 0.000000 1.000000 /end COMPU_METHOD
/begin COMPU_METHOD r_q8 "" RAT_FUNC "%6.2" "Ohm" COEFFS 0 1.000000 0.000000 0 0.000000 8.000000 /end COMPU_METHOD
/begin COMPU_METHOD spg_ubatt "" RAT_FUNC "%6.4" "V" COEFFS 0 1.000000 0.000000 0 0.000000 7.040000e-02 /end COMPU_METHOD
/begin COMPU_METHOD spg_ub_b1p33 "" RAT_FUNC "%6.4" "V" COEFFS 0 255.000000 0.000000 0 0.000000 1.330000 /end COMPU_METHOD
/begin COMPU_METHOD spg_ub_q0p0052_o0p2 "" RAT_FUNC "%6.3" "V" COEFFS 0 255.000000 51.000000 0 0.000000 1.330000 /end COMPU_METHOD
/begin COMPU_METHOD spg_ub_q0p019 "" RAT_FUNC "%6.4" "V" COEFFS 0 256.000000 0.000000 0 0.000000 5.000000 /end COMPU_METHOD
/begin COMPU_METHOD spg_uw_q0p00488_o1 "" RAT_FUNC "%6.3" "V" COEFFS 0 1024.000000 1024.000000 0 0.000000 5.000000 /end COMPU_METHOD
/begin COMPU_METHOD t100msxs_ub_b25p5 "" RAT_FUNC "%6.3" "s" COEFFS 0 1.000000 0.000000 0 0.000000 1.000000e-01 /end COMPU_METHOD
/begin COMPU_METHOD t10msxs_sb_q0p01 "" RAT_FUNC "%6.4" "s" COEFFS 0 1.000000 0.000000 0 0.000000 1.000000e-02 /end COMPU_METHOD
/begin COMPU_METHOD t10msxs_ub_b2p55 "" RAT_FUNC "%6.4" "s" COEFFS 0 1.000000 0.000000 0 0.000000 1.000000e-02 /end COMPU_METHOD
/begin COMPU_METHOD t10msxs_uw_b655p35 "" RAT_FUNC "%6.4" "s" COEFFS 0 1.000000 0.000000 0 0.000000 1.000000e-02 /end COMPU_METHOD
/begin COMPU_METHOD t1sxs_uw_q1 "" RAT_FUNC "%6.2" "s" COEFFS 0 1.000000 0.000000 0 0.000000 1.000000 /end COMPU_METHOD
/begin COMPU_METHOD t200msxs_ub_b51 "" RAT_FUNC "%6.3" "s" COEFFS 0 1.000000 0.000000 0 0.000000 2.000000e-01 /end COMPU_METHOD
/begin COMPU_METHOD t40ms_ub_b10200 "" RAT_FUNC "%7.2" "ms" COEFFS 0 1.000000 0.000000 0 0.000000 40.000000 /end COMPU_METHOD
/begin COMPU_METHOD t500usxms_ub_q0p5 "" RAT_FUNC "%6.3" "ms" COEFFS 0 1.000000 0.000000 0 0.000000 5.000000e-01 /end COMPU_METHOD
/begin COMPU_METHOD t50msxs_ub_b12p75 "" RAT_FUNC "%6.4" "s" COEFFS 0 1.000000 0.000000 0 0.000000 5.000000e-02 /end COMPU_METHOD
/begin COMPU_METHOD temp_q5 "" RAT_FUNC "%6.2" "Grad C" COEFFS 0 1.000000 0.000000 0 0.000000 5.000000 /end COMPU_METHOD
/begin COMPU_METHOD temp_sb_b0p093 "" RAT_FUNC "%6.5" "Grad C" COEFFS 0 512.000000 0.000000 0 0.000000 3.750000e-01 /end COMPU_METHOD
/begin COMPU_METHOD temp_ub_q0p75_o48 "" RAT_FUNC "%6.2" "Grad C" COEFFS 0 1.000000 48.000000 0 0.000000 7.500000e-01 /end COMPU_METHOD
/begin COMPU_METHOD temp_ub_q0p75_o48___UW "" RAT_FUNC "%6.2" "Grad C" COEFFS 0 1.000000 48.000000 0 0.000000 7.500000e-01 /end COMPU_METHOD
/begin COMPU_METHOD temp_ub_q5_o50 "" RAT_FUNC "%6.2" "Grad C" COEFFS 0 1.000000 50.000000 0 0.000000 5.000000 /end COMPU_METHOD
/begin COMPU_METHOD temp_uw_q0p0195_o50 "" RAT_FUNC "%6.2" "Grad C" COEFFS 0 256.000000 12800.000000 0 0.000000 5.000000 /end COMPU_METHOD
/begin COMPU_METHOD tv_q0p001028 "" RAT_FUNC "%6.4" "%" COEFFS 0 1.000000 0.000000 0 0.000000 1.028000e-03 /end COMPU_METHOD
/begin COMPU_METHOD tv_sw_q0p005 "" RAT_FUNC "%6.4" "%" COEFFS 0 1.000000 0.000000 0 0.000000 5.000000e-03 /end COMPU_METHOD
/begin COMPU_METHOD tv_ub_b100 "" RAT_FUNC "%6.3" "%" COEFFS 0 256.000000 0.000000 0 0.000000 100.000000 /end COMPU_METHOD
/begin COMPU_METHOD tv_ub_q0p64 "" RAT_FUNC "%6.3" "%" COEFFS 0 100.000000 0.000000 0 0.000000 64.000000 /end COMPU_METHOD
/begin COMPU_METHOD tv_ub_q0p64___SB "" RAT_FUNC "%6.3" "%" COEFFS 0 100.000000 0.000000 0 0.000000 64.000000 /end COMPU_METHOD
/begin COMPU_METHOD tv_uw_q0p005 "" RAT_FUNC "%6.4" "%" COEFFS 0 1.000000 0.000000 0 0.000000 5.000000e-03 /end COMPU_METHOD
/begin COMPU_METHOD txms_ub_q0p1 "" RAT_FUNC "%6.3" "ms" COEFFS 0 10.000000 0.000000 0 0.000000 1.000000 /end COMPU_METHOD
/begin COMPU_METHOD t_min_q5p96em8 "" RAT_FUNC "%10.9" "Min" COEFFS 0 1.000000 0.000000 0 0.000000 5.960000e-08 /end COMPU_METHOD
/begin COMPU_METHOD vfzg_ub_q1p25___UB "" RAT_FUNC "%6.2" "km/h" COEFFS 0 1.000000 0.000000 0 0.000000 1.250000 /end COMPU_METHOD
/begin COMPU_METHOD vfzg_uw_b512 "" RAT_FUNC "%6.4" "km/h" COEFFS 0 6.553600e+04 0.000000 0 0.000000 512.000000 /end COMPU_METHOD
/begin COMPU_METHOD zk10msxs_uw_b655 "" RAT_FUNC "%10.4" "s" COEFFS 0 0.000000 6.553600e+04 0 100.000000 0.000000 /end COMPU_METHOD
/begin COMPU_METHOD zk20msxs_ub_b5p1 "" RAT_FUNC "%6.4" "s" COEFFS 0 0.000000 5.100000 0 1.000000 0.000000 /end COMPU_METHOD
/begin COMPU_METHOD zk50msxs_ub_b12p8 "" RAT_FUNC "%6.3" "s" COEFFS 0 0.000000 128.000000 0 10.000000 0.000000 /end COMPU_METHOD
/begin COMPU_METHOD zw_sb_q0p75 "" RAT_FUNC "%6.3" "grad KW" COEFFS 0 255.000000 0.000000 0 0.000000 191.250000 /end COMPU_METHOD
/begin COMPU_METHOD zw_ub_q0p75 "" RAT_FUNC "%6.3" "Grad KW" COEFFS 0 255.000000 0.000000 0 0.000000 191.250000 /end COMPU_METHOD
/begin COMPU_METHOD zw_ub_q6 "" RAT_FUNC "%6.2" "Grad KW" COEFFS 0 255.000000 0.000000 0 0.000000 1530.000000 /end COMPU_METHOD
/begin COMPU_METHOD zw_ub_qn0p75 "" RAT_FUNC "%6.4" "grad KW" COEFFS 0 1.000000 0.000000 0 0.000000 -7.500000e-01 /end COMPU_METHOD
/begin COMPU_METHOD zw_uw_qn0p75 "" RAT_FUNC "%6.4" "grad KW" COEFFS 0 1.000000 0.000000 0 0.000000 -7.500000e-01 /end COMPU_METHOD
/end MODULE
/end PROJECT
