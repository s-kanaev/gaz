/begin PROJECT _7804367 "156"
/begin HEADER "" VERSION "_7804367" PROJECT_NO _7804367 /end HEADER
/begin MODULE DIM ""
/begin MOD_COMMON "" BYTE_ORDER BIG_ENDIAN S_REC_LAYOUT DAMOS /end MOD_COMMON
/begin AXIS_PTS SDR02LDUB "" 0x810055 drlmaxo SstAUbSstUb 191.3 rel_ub_q0p75 2 0.00 191.3 FUNCTION_LIST SSTBER87 DEPOSIT ABSOLUT IF_DATA DIM_X DIRECT 0x810055 /end AXIS_PTS
/begin AXIS_PTS SML04DUUB "" 0x81801E msabg SstAUbSstUb 1020. m_ub_b1020 4 0.00 1020. FUNCTION_LIST SSTBER87 DEPOSIT ABSOLUT IF_DATA DIM_X DIRECT 0x81801E /end AXIS_PTS
/begin AXIS_PTS SNM06LSUB "Stützstellenverteilung Kat-Vorsteuerwert LRS" 0x810087 nmot SstAUbSstUb 10200. nmot_ub_q40 6 0.00 10200. FUNCTION_LIST SSTBER87 DEPOSIT ABSOLUT IF_DATA DIM_X DIRECT 0x810087 /end AXIS_PTS
/begin AXIS_PTS SNM12ESUB "SST-Verteilung für die Motordrehzahl nmot" 0x81804E nmot SstAUbSstUb 10200. nmot_ub_q40 12 0.00 10200. FUNCTION_LIST SSTBER87 DEPOSIT ABSOLUT IF_DATA DIM_X DIRECT 0x81804E /end AXIS_PTS
/begin AXIS_PTS SPL08LDUB "Stützstellenverteilung für Ladedruckregelung" 0x810140 plsol SstAUbSstUb 2550. p_ub_q10 8 0.00 2550. FUNCTION_LIST SSTBER87 DEPOSIT ABSOLUT IF_DATA DIM_X DIRECT 0x810140 /end AXIS_PTS
/begin AXIS_PTS SRL03ZUUB "Stützstellenverteilung relative Füllung, 3 Sst." 0x810158 rl SstAUbSstUb 191.3 rel_ub_q0p75 3 0.00 191.3 FUNCTION_LIST SSTBER87 ZWGRU DEPOSIT ABSOLUT IF_DATA DIM_X DIRECT 0x810158 /end AXIS_PTS
/begin AXIS_PTS SRL06LSUB "Stützstellenverteilung Kat-Vorsteuerwert LRS" 0x81015C rl SstAUbSstUb 191.3 rel_ub_q0p75 6 0.00 191.3 FUNCTION_LIST SSTBER87 DEPOSIT ABSOLUT IF_DATA DIM_X DIRECT 0x81015C /end AXIS_PTS
/begin AXIS_PTS SRL08LDUB "" 0x810175 rl SstAUbSstUb 191.3 rel_ub_q0p75 8 0.00 191.3 FUNCTION_LIST SSTBER87 DEPOSIT ABSOLUT IF_DATA DIM_X DIRECT 0x810175 /end AXIS_PTS
/begin AXIS_PTS SRL08MFUB "" 0x81017E rl SstAUbSstUb 191.3 rel_ub_q0p75 8 0.00 191.3 FUNCTION_LIST SSTBER87 DEPOSIT ABSOLUT IF_DATA DIM_X DIRECT 0x81017E /end AXIS_PTS
/begin AXIS_PTS STM04LDUB "" 0x8101D4 tmki SstAUbSstUb 191.3 temp_ub_q0p75_o48 4 -48.00 143.3 FUNCTION_LIST SSTBER87 DEPOSIT ABSOLUT IF_DATA DIM_X DIRECT 0x8101D4 /end AXIS_PTS
/begin AXIS_PTS STN12ESUB "" 0x8180EF tans SstAUbSstUb 191.3 temp_ub_q0p75_o48 12 -48.00 143.3 FUNCTION_LIST SSTBER87 DEPOSIT ABSOLUT IF_DATA DIM_X DIRECT 0x8180EF /end AXIS_PTS
/begin AXIS_PTS SWP08LDUB "" 0x810201 wped SstAUbSstUb 100.0 relPED_ub_b100 8 0.00 100.0 FUNCTION_LIST SSTBER87 DEPOSIT ABSOLUT IF_DATA DIM_X DIRECT 0x810201 /end AXIS_PTS
/begin AXIS_PTS SZK04LDUB "" 0x810213 wkrmdy SstAUbSstUb 191.3 zw_ub_q0p75 4 0.00 191.3 FUNCTION_LIST SSTBER87 DEPOSIT ABSOLUT IF_DATA DIM_X DIRECT 0x810213 /end AXIS_PTS
/begin AXIS_PTS SZK08LDUB "" 0x810218 wkrmstat SstAUbSstUb 191.3 zw_ub_q0p75 8 0.00 191.3 FUNCTION_LIST SSTBER87 DEPOSIT ABSOLUT IF_DATA DIM_X DIRECT 0x810218 /end AXIS_PTS
/begin MEASUREMENT ushk "Spannung Lambdasonde hinter Katalysator" UBYTE spg_ub_q0p0052_o0p2 1 100 -0.2 1.13 FUNCTION_LIST GGLSH DFFT DFPM DKATLRS DLSAHK DLSSA DLSU LRSKA T2LID IF_DATA DIM_X 0x380A87 EXTERN WORD IF_DATA MCMESS 0x380A87 EXTERN /end MEASUREMENT
/begin MEASUREMENT ushk2 "Spannung Lambdasonde hinter Katalysator 2" UBYTE spg_ub_q0p0052_o0p2 1 100 -0.2 1.13 FUNCTION_LIST GGLSH DFFT DFPM DKATLRS DLSAHK DLSSA DLSU LRSKA T2LID IF_DATA DIM_X 0x380A88 EXTERN WORD IF_DATA MCMESS 0x380A88 EXTERN /end MEASUREMENT
/begin MEASUREMENT ushk2_w "Spannung Lambdasonde (4.88mV/LSB) hinter Katalysator 2" UWORD spg_uw_q0p00488_o1 1 100 -1 318.995 FUNCTION_LIST GGLSH DLSH LRSHK IF_DATA DIM_X 0x381D8E EXTERN WORD IF_DATA MCMESS 0x381D8E EXTERN /end MEASUREMENT
/begin MEASUREMENT ushkj "Spannung Lambdasonde hinter Kat, ohne Offset, DLSSA, Bank 1" UBYTE spg_ub_b1p33 1 100 0 1.33 FUNCTION_LIST DLSSA TC1MOD IF_DATA DIM_X 0x380AE5 EXTERN WORD IF_DATA MCMESS 0x380AE5 EXTERN /end MEASUREMENT
/begin MEASUREMENT ushkj2 "Spannung Lambdasonde hinter Kat, ohne Offset, DLSSA, Bank 2" UBYTE spg_ub_b1p33 1 100 0 1.33 FUNCTION_LIST DLSSA TC1MOD IF_DATA DIM_X 0x380AE6 EXTERN WORD IF_DATA MCMESS 0x380AE6 EXTERN /end MEASUREMENT
/begin MEASUREMENT ushkjf2_w "Gefilterte Spannung Lambdasonde hinter Kat, ohne Offset, DLSSA (Bank2)" UWORD spg_uw_b1p33 1 100 0 1.33 FUNCTION_LIST DLSSA IF_DATA DIM_X 0x381FE8 EXTERN WORD IF_DATA MCMESS 0x381FE8 EXTERN /end MEASUREMENT
/begin MEASUREMENT ushkjf_w "Gefilterte Spannung Lambdasonde hinter Kat, ohne Offset, DLSSA" UWORD spg_uw_b1p33 1 100 0 1.33 FUNCTION_LIST DLSSA IF_DATA DIM_X 0x381FEA EXTERN WORD IF_DATA MCMESS 0x381FEA EXTERN /end MEASUREMENT
/begin MEASUREMENT ushkmxstg "Maximale Steigung der Sondenspannung hinter KAT" UBYTE spgg_q0p52 1 100 0 132.6 FUNCTION_LIST DLSAHK IF_DATA DIM_X 0x380A7C EXTERN WORD IF_DATA MCMESS 0x380A7C EXTERN /end MEASUREMENT
/begin MEASUREMENT ushkmxstg2 "Maximale Steigung der Sondenspannung hinter KAT Bank2" UBYTE spgg_q0p52 1 100 0 132.6 FUNCTION_LIST DLSAHK IF_DATA DIM_X 0x380A7D EXTERN WORD IF_DATA MCMESS 0x380A7D EXTERN /end MEASUREMENT
/begin MEASUREMENT ushkr2_w "Spannung (word) Lambdasonde Rohwert hinter KAT Bank2" UWORD spg_uw_q0p00488_o1 1 100 -1 318.995 FUNCTION_LIST GGLSH IF_DATA DIM_X 0x381D90 EXTERN WORD IF_DATA MCMESS 0x381D90 EXTERN /end MEASUREMENT
/begin MEASUREMENT ushkr_w "Spannung (word) Lambdasonde Rohwert hinter KAT" UWORD spg_uw_q0p00488_o1 1 100 -1 318.995 FUNCTION_LIST GGLSH IF_DATA DIM_X 0x381D92 EXTERN WORD IF_DATA MCMESS 0x381D92 EXTERN /end MEASUREMENT
/begin MEASUREMENT ushksteig "Steigung der Sondenspannung hinter KAT" UBYTE spgg_q0p52 1 100 0 132.6 FUNCTION_LIST DLSAHK IF_DATA DIM_X 0x380A7E EXTERN WORD IF_DATA MCMESS 0x380A7E EXTERN /end MEASUREMENT
/begin MEASUREMENT ushksteig2 "Steigung der Sondenspannung hinter KAT Bank2" UBYTE spgg_q0p52 1 100 0 132.6 FUNCTION_LIST DLSAHK IF_DATA DIM_X 0x380A7F EXTERN WORD IF_DATA MCMESS 0x380A7F EXTERN /end MEASUREMENT
/begin MEASUREMENT ushk_w "Spannung Lambdasonde (4.88mV/LSB) hinter Katalysator" UWORD spg_uw_q0p00488_o1 1 100 -1 318.995 FUNCTION_LIST GGLSH DLSH LRSHK IF_DATA DIM_X 0x381D94 EXTERN WORD IF_DATA MCMESS 0x381D94 EXTERN /end MEASUREMENT
/begin MEASUREMENT ushmb2_w "Spannung (word,10 ms-Raster) Lambdasonde mit Widerst. belastet hinter KAT Bank2" UWORD spg_uw_q0p00488_o1 1 100 -1 318.995 FUNCTION_LIST GGLSH IF_DATA DIM_X 0x381D96 EXTERN WORD IF_DATA MCMESS 0x381D96 EXTERN /end MEASUREMENT
/begin MEASUREMENT ushmb_w "Spannung (word, 10 ms-Raster) Lambdasonde mit Widerstand belastet hinter KAT" UWORD spg_uw_q0p00488_o1 1 100 -1 318.995 FUNCTION_LIST GGLSH IF_DATA DIM_X 0x381D98 EXTERN WORD IF_DATA MCMESS 0x381D98 EXTERN /end MEASUREMENT
/begin MEASUREMENT ushob2_w "Spannung (word, 10 ms-Raster) Lambdasonde ohne Belastung hinter KAT Bank2" UWORD spg_uw_q0p00488_o1 1 100 -1 318.995 FUNCTION_LIST GGLSH IF_DATA DIM_X 0x381D9A EXTERN WORD IF_DATA MCMESS 0x381D9A EXTERN /end MEASUREMENT
/begin MEASUREMENT ushob_w "Spannung (word, 10 ms-Raster) Lambdasonde ohne Belastung hinter KAT" UWORD spg_uw_q0p00488_o1 1 100 -1 318.995 FUNCTION_LIST GGLSH IF_DATA DIM_X 0x381D9C EXTERN WORD IF_DATA MCMESS 0x381D9C EXTERN /end MEASUREMENT
/begin MEASUREMENT usmnsha "minimal erkannter Sondenspannungswert h.K. (alt), DLSSA, Bank 1" UBYTE spg_ub_b1p33 1 100 0 1.33 FUNCTION_LIST DLSSA IF_DATA DIM_X 0x380AE7 EXTERN WORD IF_DATA MCMESS 0x380AE7 EXTERN /end MEASUREMENT
/begin MEASUREMENT usmnsha2 "minimal erkannter Sondenspannungswert h.K. (alt), DLSSA, Bank 2" UBYTE spg_ub_b1p33 1 100 0 1.33 FUNCTION_LIST DLSSA IF_DATA DIM_X 0x380AE8 EXTERN WORD IF_DATA MCMESS 0x380AE8 EXTERN /end MEASUREMENT
/begin MEASUREMENT usmnshn "minimal erkannter Sondenspannungswert h.K. (neu), DLSSA" UBYTE spg_ub_b1p33 1 100 0 1.33 FUNCTION_LIST DLSSA TC5MOD IF_DATA DIM_X 0x382FFA EXTERN WORD IF_DATA MCMESS 0x382FFA EXTERN /end MEASUREMENT
/begin MEASUREMENT usmnshn2 "minimal erkannter Sondenspannungswert h.K. (neu), DLSSA (Bank2)" UBYTE spg_ub_b1p33 1 100 0 1.33 FUNCTION_LIST DLSSA TC5MOD IF_DATA DIM_X 0x382FFB EXTERN WORD IF_DATA MCMESS 0x382FFB EXTERN /end MEASUREMENT
/begin MEASUREMENT usmxsha "maximal erkannter Sondenspannungswert h.K. (alt), DLSSA, Bank 1" UBYTE spg_ub_b1p33 1 100 0 1.33 FUNCTION_LIST DLSSA IF_DATA DIM_X 0x380AE9 EXTERN WORD IF_DATA MCMESS 0x380AE9 EXTERN /end MEASUREMENT
/begin MEASUREMENT usmxsha2 "maximal erkannter Sondenspannungswert h.K. (alt), DLSSA, Bank 2" UBYTE spg_ub_b1p33 1 100 0 1.33 FUNCTION_LIST DLSSA IF_DATA DIM_X 0x380AEA EXTERN WORD IF_DATA MCMESS 0x380AEA EXTERN /end MEASUREMENT
/begin MEASUREMENT usmxshn "maximal erkannter Sondenspannungswert h.K. (neu), DLSSA" UBYTE spg_ub_b1p33 1 100 0 1.33 FUNCTION_LIST DLSSA TC5MOD IF_DATA DIM_X 0x382FFC EXTERN WORD IF_DATA MCMESS 0x382FFC EXTERN /end MEASUREMENT
/begin MEASUREMENT usmxshn2 "maximal erkannter Sondenspannungswert h.K. (neu), DLSSA (Bank2)" UBYTE spg_ub_b1p33 1 100 0 1.33 FUNCTION_LIST DLSSA TC5MOD IF_DATA DIM_X 0x382FFD EXTERN WORD IF_DATA MCMESS 0x382FFD EXTERN /end MEASUREMENT
/begin MEASUREMENT usobh2_w "Spannung (word) Lambdasonde ohne Belastung hinter KAT Bank2" UWORD spg_uw_q0p00488_o1 1 100 -1 318.995 FUNCTION_LIST GGLSH IF_DATA DIM_X 0x381D9E EXTERN WORD IF_DATA MCMESS 0x381D9E EXTERN /end MEASUREMENT
/begin MEASUREMENT usobh_w "Spannung (word) Lambdasonde ohne Belastung hinter KAT" UWORD spg_uw_q0p00488_o1 1 100 -1 318.995 FUNCTION_LIST GGLSH IF_DATA DIM_X 0x381DA0 EXTERN WORD IF_DATA MCMESS 0x381DA0 EXTERN /end MEASUREMENT
/begin MEASUREMENT usp1plaus "" UBYTE spg_ub_b5 1 100 0 4.98047 FUNCTION_LIST ADC VHW IF_DATA DIM_X 0x380952 EXTERN WORD IF_DATA MCMESS 0x380952 EXTERN /end MEASUREMENT
/begin MEASUREMENT usrhk "aktuelle Regelschwelle Lambdasignal h.K." UBYTE spg_ub_q0p0052_o0p2 1 100 -0.2 1.13 FUNCTION_LIST LRSHK DLSAHK IF_DATA DIM_X 0x380C8F EXTERN WORD IF_DATA MCMESS 0x380C8F EXTERN /end MEASUREMENT
/begin MEASUREMENT usrhk2 "aktuelle Regelschwelle Lambdasignal h.K., Bank 2" UBYTE spg_ub_q0p0052_o0p2 1 100 -0.2 1.13 FUNCTION_LIST LRSHK DLSAHK IF_DATA DIM_X 0x380C90 EXTERN WORD IF_DATA MCMESS 0x380C90 EXTERN /end MEASUREMENT
/begin MEASUREMENT usvk "Spannung Lambdasonde vor Kat" UBYTE spg_ub_q0p0052_o0p2 1 100 -0.2 1.13 FUNCTION_LIST SWADP DFFT DFPM IF_DATA DIM_X 0x380C9C EXTERN WORD IF_DATA MCMESS 0x380C9C EXTERN /end MEASUREMENT
/begin MEASUREMENT usvk2 "Spannung Lambdasonde vor Kat 2" UBYTE spg_ub_q0p0052_o0p2 1 100 -0.2 1.13 FUNCTION_LIST SWADP DFFT DFPM IF_DATA DIM_X 0x380C9D EXTERN WORD IF_DATA MCMESS 0x380C9D EXTERN /end MEASUREMENT
/begin MEASUREMENT usvkj "Spannung Lambdasonde vor Kat, ohne Offset, DLSSA" UBYTE spg_ub_b1p33 1 100 0 1.33 FUNCTION_LIST SWADP IF_DATA DIM_X 0x380C9E EXTERN WORD IF_DATA MCMESS 0x380C9E EXTERN /end MEASUREMENT
/begin MEASUREMENT usvkj2 "Spannung Lambdasonde vor Kat, ohne Offset, DLSSA (Bank2)" UBYTE spg_ub_b1p33 1 100 0 1.33 FUNCTION_LIST SWADP IF_DATA DIM_X 0x380C9F EXTERN WORD IF_DATA MCMESS 0x380C9F EXTERN /end MEASUREMENT
/begin MEASUREMENT usvkk2_w "LSU-Spannung vor Kat, korrigiert Bank2" UWORD spg_uw_q0p00488 1 100 0 319.995 FUNCTION_LIST GGLSU DHLSU T2LID IF_DATA DIM_X 0x381DF0 EXTERN WORD IF_DATA MCMESS 0x381DF0 EXTERN /end MEASUREMENT
/begin MEASUREMENT usvkk_w "LSU-Spannung vor Kat, korrigiert" UWORD spg_uw_q0p00488 1 100 0 319.995 FUNCTION_LIST GGLSU DHLSU T2LID IF_DATA DIM_X 0x381DF2 EXTERN WORD IF_DATA MCMESS 0x381DF2 EXTERN /end MEASUREMENT
/begin MEASUREMENT uulsuf2_w "gefilterte Sondenspannung vor Kat einer Breitbandlambdasonde Bank2" UWORD spg_uw_q0p00488 1 100 0 319.995 FUNCTION_LIST GGLSU IF_DATA DIM_X 0x381DF4 EXTERN WORD IF_DATA MCMESS 0x381DF4 EXTERN /end MEASUREMENT
/begin MEASUREMENT uulsuf_w "gefilterte Sondenspannung vor Kat einer Breitbandlambdasonde" UWORD spg_uw_q0p00488 1 100 0 319.995 FUNCTION_LIST GGLSU IF_DATA DIM_X 0x381DF6 EXTERN WORD IF_DATA MCMESS 0x381DF6 EXTERN /end MEASUREMENT
/begin MEASUREMENT uulsuv2_u "Sondenspannung vor Kat einer Breitbandlambdasonde Bank2 (ADC-Wert) (Byte)" UBYTE spg_ub_b5 1 100 0 4.98047 FUNCTION_LIST DFFTCNV DFFTK IF_DATA DIM_X 0x380A06 EXTERN WORD IF_DATA MCMESS 0x380A06 EXTERN /end MEASUREMENT
/begin MEASUREMENT uulsuv2_w "Sondenspannung vor Kat einer Breitbandlambdasonde Bank2 (ADC-Wert)" UWORD spg_uw_b5 1 100 0 319.995 FUNCTION_LIST VHW DFFTCNV DLSU GGLSU T2LID IF_DATA DIM_X 0x3823DA EXTERN WORD IF_DATA MCMESS 0x3823DA EXTERN /end MEASUREMENT
/begin MEASUREMENT uulsuv_u "Sondenspannung vor Kat einer Breitbandlambdasonde (ADC-Wert) (Byte)" UBYTE spg_ub_b5 1 100 0 4.98047 FUNCTION_LIST DFFTCNV DFFTK IF_DATA DIM_X 0x380A07 EXTERN WORD IF_DATA MCMESS 0x380A07 EXTERN /end MEASUREMENT
/begin MEASUREMENT uulsuv_w "Sondenspannung vor Kat einer Breitbandlambdasonde (ADC-Wert)" UWORD spg_uw_b5 1 100 0 319.995 FUNCTION_LIST VHW DFFTCNV DLSU GGLSU T2LID IF_DATA DIM_X 0x3823DC EXTERN WORD IF_DATA MCMESS 0x3823DC EXTERN /end MEASUREMENT
/begin MEASUREMENT uushk2_w "ADC-Spannung Lambdasonde hinter Katalysator Bank2 (Word)" UWORD spg_uw_q0p00488 1 100 0 319.995 FUNCTION_LIST VHW GGLSH IF_DATA DIM_X 0x3823DE EXTERN WORD IF_DATA MCMESS 0x3823DE EXTERN /end MEASUREMENT
/begin MEASUREMENT uushk_w "ADC-Spannung Lambdasonde hinter Katalysator (Word)" UWORD spg_uw_q0p00488 1 100 0 319.995 FUNCTION_LIST VHW GGLSH IF_DATA DIM_X 0x3823E0 EXTERN WORD IF_DATA MCMESS 0x3823E0 EXTERN /end MEASUREMENT
/begin MEASUREMENT uushmb2_w "Spannung (word,1 ms-Raster) Lambdasonde mit Widerstand belastet hinter KAT Bank2" UWORD spg_uw_q0p00488 1 100 0 319.995 FUNCTION_LIST GGLSH IF_DATA DIM_X 0xFA16 INTERN WORD IF_DATA MCMESS 0xFA16 INTERN /end MEASUREMENT
/begin MEASUREMENT uushmb_w "Spannung (word, 1 ms-Raster) Lambdasonde mit Widerstand belastet hinter KAT" UWORD spg_uw_q0p00488 1 100 0 319.995 FUNCTION_LIST GGLSH IF_DATA DIM_X 0xFA18 INTERN WORD IF_DATA MCMESS 0xFA18 INTERN /end MEASUREMENT
/begin MEASUREMENT uushob2_w "ADC-Spannung (word, 1 ms-Raster) Sonde ohne Belastung hinter Katalysator Bank2" UWORD spg_uw_q0p00488 1 100 0 319.995 FUNCTION_LIST GGLSH IF_DATA DIM_X 0xFA1A INTERN WORD IF_DATA MCMESS 0xFA1A INTERN /end MEASUREMENT
/begin MEASUREMENT uushob_w "ADC-Spannung (word, 1 ms-Raster) Sonde ohne Belastung hinter Katalysator" UWORD spg_uw_q0p00488 1 100 0 319.995 FUNCTION_LIST GGLSH IF_DATA DIM_X 0xFA1C INTERN WORD IF_DATA MCMESS 0xFA1C INTERN /end MEASUREMENT
/begin MEASUREMENT uzkw_w "Kurbelwellen-Umdrehungszähler" UWORD dez 1 100 0 65535 FUNCTION_LIST GGDPG DHFM DNWS ESVW IF_DATA DIM_X 0x381B5C EXTERN WORD IF_DATA MCMESS 0x381B5C EXTERN /end MEASUREMENT
/begin MEASUREMENT vfil_w "gefilterte Geschwindigkeit (16-Bit)" UWORD vfzg_uw_b512 1 100 0 511.992 FUNCTION_LIST GGVFZG IF_DATA DIM_X 0x381E42 EXTERN WORD IF_DATA MCMESS 0x381E42 EXTERN /end MEASUREMENT
/begin MEASUREMENT vfzg "Fahrzeuggeschwindigkeit" UBYTE vfzg_ub_q1p25 1 100 0 318.75 FUNCTION_LIST GGVFZG ARMD ATM BBSAWE BGDVE BGRBS BGTABS DFFTCNV DFPM DKUPPL DLLR DMDLU DMDSTP DSLSLRS DSWEC DTEV GGPED GGTFUMG GGTGET GGUB KOS MDBGRG MDWAN MLS NMAXMD SLS T2DFA T2DVE T2LID T2STA TC1MOD VS IF_DATA DIM_X 0x380A9C EXTERN WORD IF_DATA MCMESS 0x380A9C EXTERN /end MEASUREMENT
/begin MEASUREMENT vfzg2_w "Fahrzeuggeschwindigkeit 2. Signal" UWORD vfzg_uw_b512 1 100 0 511.992 FUNCTION_LIST SWADP BBFGR IF_DATA DIM_X 0x382B3A EXTERN WORD IF_DATA MCMESS 0x382B3A EXTERN /end MEASUREMENT
/begin MEASUREMENT vfzgc_w "Fahrzeuggeschwindigkeit, CAN-Signal" UWORD vfzg_uw_b325 1 100 0 324.995 FUNCTION_LIST CAN GGVFZG IF_DATA DIM_X 0x380F6C EXTERN WORD IF_DATA MCMESS 0x380F6C EXTERN /end MEASUREMENT
/begin MEASUREMENT vfzgpr_w "Prädizierte Fahrzeuggeschwindigkeit für VMAX-Regelung" UWORD vfzg_uw_q0p00781 1 100 0 511.992 FUNCTION_LIST VMAXMD IF_DATA DIM_X 0x3826FC EXTERN WORD IF_DATA MCMESS 0x3826FC EXTERN /end MEASUREMENT
/begin MEASUREMENT vfzg_u "Fahrzeuggeschwindigkeit, mit def. Quantisierung für Tester" UBYTE vfzg_q1p0 1 100 0 255 FUNCTION_LIST DFFTCNV BGKMST DFFT IF_DATA DIM_X 0x380A08 EXTERN WORD IF_DATA MCMESS 0x380A08 EXTERN /end MEASUREMENT
/begin MEASUREMENT vfzg_uc "Fahrzeuggeschwindigkeit im Befehlstest" UWORD vfzg_uw_q0p00781 1 100 0 511.992 FUNCTION_LIST URCEIN URCFGRC IF_DATA DIM_X 0x382920 EXTERN WORD IF_DATA MCMESS 0x382920 EXTERN /end MEASUREMENT
/begin MEASUREMENT vfzg_um "Fahrzeuggeschwindigkeit in der Funktionsüberwachung" UWORD vfzg_uw_q0p00781 1 100 0 511.992 FUNCTION_LIST UFEING UFFGRC IF_DATA DIM_X 0x382E8C EXTERN WORD IF_DATA MCMESS 0x382E8C EXTERN /end MEASUREMENT
/begin MEASUREMENT vfzg_w "Fahrzeuggeschwindigkeit" UWORD vfzg_uw_b512 1 100 0 511.992 FUNCTION_LIST GGVFZG BBFGR BBGANG BGTEV DDG FGRMD MDBGV SWADP T2LID UFEING VMAXMD WFS IF_DATA DIM_X 0x381E44 EXTERN WORD IF_DATA MCMESS 0x381E44 EXTERN /end MEASUREMENT
/begin MEASUREMENT vfzroh_u "Fahrzeuggeschwindigkeit Rohwert (Umwelt)" UBYTE vfzg_ub_q2 1 100 0 510 FUNCTION_LIST DFFTCNV DFFTK IF_DATA DIM_X 0x380A09 EXTERN WORD IF_DATA MCMESS 0x380A09 EXTERN /end MEASUREMENT
/begin MEASUREMENT vfzroh_w "Fahrzeuggeschwindigkeit Ausgabewert an SCAN-Tool" UWORD vfzg_uw_b512 1 100 0 511.992 FUNCTION_LIST GGVFZG DFFTCNV DVFZ LLRBB LLRMR IF_DATA DIM_X 0x381E46 EXTERN WORD IF_DATA MCMESS 0x381E46 EXTERN /end MEASUREMENT
/begin MEASUREMENT virkr "Verhältnis Integrator / Referenzpegel Klopfregelung" UBYTE fak_ub_b16 1 100 0 15.9375 FUNCTION_LIST KRKE KRDY IF_DATA DIM_X 0xFAF3 INTERN WORD IF_DATA MCMESS 0xFAF3 INTERN /end MEASUREMENT
/begin MEASUREMENT vkr_0_A "Verstärkungsstufe für Eingangsverstärkung Klopf-IC" UBYTE dez 1 100 0 255 FUNCTION_LIST KRKE DKRS T2LID IF_DATA DIM_X 0x380BB6 EXTERN WORD IF_DATA MCMESS 0x380BB6 EXTERN /end MEASUREMENT
/begin MEASUREMENT vkr_1_A "Verstärkungsstufe für Eingangsverstärkung Klopf-IC" UBYTE dez 1 100 0 255 FUNCTION_LIST KRKE DKRS T2LID IF_DATA DIM_X 0x380BB7 EXTERN WORD IF_DATA MCMESS 0x380BB7 EXTERN /end MEASUREMENT
/begin MEASUREMENT vkr_2_A "Verstärkungsstufe für Eingangsverstärkung Klopf-IC" UBYTE dez 1 100 0 255 FUNCTION_LIST KRKE DKRS T2LID IF_DATA DIM_X 0x380BB8 EXTERN WORD IF_DATA MCMESS 0x380BB8 EXTERN /end MEASUREMENT
/begin MEASUREMENT vkr_3_A "Verstärkungsstufe für Eingangsverstärkung Klopf-IC" UBYTE dez 1 100 0 255 FUNCTION_LIST KRKE DKRS T2LID IF_DATA DIM_X 0x380BB9 EXTERN WORD IF_DATA MCMESS 0x380BB9 EXTERN /end MEASUREMENT
/begin MEASUREMENT vkr_4_A "Verstärkungsstufe für Eingangsverstärkung Klopf-IC" UBYTE dez 1 100 0 255 FUNCTION_LIST KRKE DKRS T2LID IF_DATA DIM_X 0x380BBA EXTERN WORD IF_DATA MCMESS 0x380BBA EXTERN /end MEASUREMENT
/begin MEASUREMENT vkr_5_A "Verstärkungsstufe für Eingangsverstärkung Klopf-IC" UBYTE dez 1 100 0 255 FUNCTION_LIST KRKE DKRS T2LID IF_DATA DIM_X 0x380BBB EXTERN WORD IF_DATA MCMESS 0x380BBB EXTERN /end MEASUREMENT
/begin MEASUREMENT vkr_6_A "Verstärkungsstufe für Eingangsverstärkung Klopf-IC" UBYTE dez 1 100 0 255 FUNCTION_LIST KRKE DKRS T2LID IF_DATA DIM_X 0x380BBC EXTERN WORD IF_DATA MCMESS 0x380BBC EXTERN /end MEASUREMENT
/begin MEASUREMENT vkr_7_A "Verstärkungsstufe für Eingangsverstärkung Klopf-IC" UBYTE dez 1 100 0 255 FUNCTION_LIST KRKE DKRS T2LID IF_DATA DIM_X 0x380BBD EXTERN WORD IF_DATA MCMESS 0x380BBD EXTERN /end MEASUREMENT
/begin MEASUREMENT vkr_tst "Verstärkungsstufe für Eingangsverstärkung Klopf-IC rollierend mit Zyl.zähler" UBYTE dez 1 100 0 255 FUNCTION_LIST KRKE IF_DATA DIM_X 0x380BBE EXTERN WORD IF_DATA MCMESS 0x380BBE EXTERN /end MEASUREMENT
/begin MEASUREMENT vlast_w "Zusätzliche Offset-Geschwindigkeit für FGR-Regler bei höherer Last" UWORD vfzg_uw_b512 1 100 0 511.992 FUNCTION_LIST FGRMD IF_DATA DIM_X 0x381FA6 EXTERN WORD IF_DATA MCMESS 0x381FA6 EXTERN /end MEASUREMENT
/begin MEASUREMENT voffs_w "Offsetgeschwindigkeit für FGR-Regler" UWORD vfzg_uw_b512 1 100 0 511.992 FUNCTION_LIST FGRMD IF_DATA DIM_X 0x381FA8 EXTERN WORD IF_DATA MCMESS 0x381FA8 EXTERN /end MEASUREMENT
/begin MEASUREMENT vplspu "Druckverhältnis Solladedruck zu Umgebungsdruck (8 Bit)" UBYTE fak_ub_b4 1 100 0 3.98438 FUNCTION_LIST BBLDR IF_DATA DIM_X 0x380BF0 EXTERN WORD IF_DATA MCMESS 0x380BF0 EXTERN /end MEASUREMENT
/begin MEASUREMENT vplspu_w "Druckverhältnis Solladedruck zu Umgebungsdruck" UWORD fak_uw_b4 1 100 0 3.99994 FUNCTION_LIST BBLDR IF_DATA DIM_X 0x38249E EXTERN WORD IF_DATA MCMESS 0x38249E EXTERN /end MEASUREMENT
/begin MEASUREMENT vpsspls_w "Verhältnis Soll-Saugrohrdruck zu Druck Sollladedruck" UWORD fak_uw_b2 1 100 0 1.99997 FUNCTION_LIST LDRPLS FUEDK IF_DATA DIM_X 0x3824F0 EXTERN WORD IF_DATA MCMESS 0x3824F0 EXTERN /end MEASUREMENT
/begin MEASUREMENT vpsspu_w "Solldruckverhältnis Umgebung/Saugrohr" UWORD fak_uw_b4 1 100 0 3.99994 FUNCTION_LIST LDRPLS FUEDK SSTBER87 IF_DATA DIM_X 0x3824F2 EXTERN WORD IF_DATA MCMESS 0x3824F2 EXTERN /end MEASUREMENT
/begin MEASUREMENT vrad_hl_w "Radgeschwindigkeit hinten links" UWORD vfzg_uw_b325 1 100 0 324.995 FUNCTION_LIST CAN BGRBS IF_DATA DIM_X 0x380F6E EXTERN WORD IF_DATA MCMESS 0x380F6E EXTERN /end MEASUREMENT
/begin MEASUREMENT vrad_hr_w "Radgeschwindigkeit hinten rechts" UWORD vfzg_uw_b325 1 100 0 324.995 FUNCTION_LIST CAN BGRBS IF_DATA DIM_X 0x380F70 EXTERN WORD IF_DATA MCMESS 0x380F70 EXTERN /end MEASUREMENT
/begin MEASUREMENT vrad_vl_w "Radgeschwindigkeit vorne links" UWORD vfzg_uw_b325 1 100 0 324.995 FUNCTION_LIST CAN BGRBS IF_DATA DIM_X 0x380F72 EXTERN WORD IF_DATA MCMESS 0x380F72 EXTERN /end MEASUREMENT
/begin MEASUREMENT vrad_vr_w "Radgeschwindigkeit vorne rechts" UWORD vfzg_uw_b325 1 100 0 324.995 FUNCTION_LIST CAN BGRBS IF_DATA DIM_X 0x380F74 EXTERN WORD IF_DATA MCMESS 0x380F74 EXTERN /end MEASUREMENT
/begin MEASUREMENT vrbemx_w "Maximalwert für vregl_w bei Beschleunigung" UWORD vfzg_uw_b512 1 100 0 511.992 FUNCTION_LIST FGRMD IF_DATA DIM_X 0x381FAA EXTERN WORD IF_DATA MCMESS 0x381FAA EXTERN /end MEASUREMENT
/begin MEASUREMENT vregdia_w "Volumenstrom Tankentlüftungsventil: Wert für Diagnose Tankdichtheit" UWORD vs_uw_b25p6 1 100 0 25.5996 FUNCTION_LIST BGTEV IF_DATA DIM_X 0x382B8C EXTERN WORD IF_DATA MCMESS 0x382B8C EXTERN /end MEASUREMENT
/begin MEASUREMENT vregl_w "Sollgeschwindigkeit für FGR-Regler" UWORD vfzg_uw_b512 1 100 0 511.992 FUNCTION_LIST FGRMD IF_DATA DIM_X 0x381FAC EXTERN WORD IF_DATA MCMESS 0x381FAC EXTERN /end MEASUREMENT
/begin MEASUREMENT vrlsol "Verhaeltnis relative Soll-Füllung zu Maximalfuellung" UBYTE fak_ub_b1 1 100 0 0.996094 FUNCTION_LIST LDRPLS LDRPID IF_DATA DIM_X 0x380BFD EXTERN WORD IF_DATA MCMESS 0x380BFD EXTERN /end MEASUREMENT
/begin MEASUREMENT vroh_w "Fahrzeuggeschwindigkeit ungefiltert" UWORD vfzg_uw_b512 1 100 0 511.992 FUNCTION_LIST GGVFZG IF_DATA DIM_X 0x381E48 EXTERN WORD IF_DATA MCMESS 0x381E48 EXTERN /end MEASUREMENT
/begin MEASUREMENT vrvemn_w "Minimalwert für vregl_w bei Verzögern" UWORD vfzg_uw_b512 1 100 0 511.992 FUNCTION_LIST FGRMD IF_DATA DIM_X 0x381FAE EXTERN WORD IF_DATA MCMESS 0x381FAE EXTERN /end MEASUREMENT
/begin MEASUREMENT vsdmr "Vorgabe Drehmomentreserve über Verstellsystem VSxy" UBYTE rel_ub_q0p3906 1 100 0 99.6094 FUNCTION_LIST VS_VERST MDKOL IF_DATA DIM_X 0x38093B EXTERN WORD IF_DATA MCMESS 0x38093B EXTERN /end MEASUREMENT
/begin MEASUREMENT vsfpses "Faktor zur Verstellung Saugrohrdruck zur Applikation Einspritzung" UBYTE fak_ub_b2 1 100 0 1.99219 FUNCTION_LIST VS_VERST AES IF_DATA DIM_X 0x38093C EXTERN WORD IF_DATA MCMESS 0x38093C EXTERN /end MEASUREMENT
/begin MEASUREMENT vsfrk "Korrektur der relativen Kraftstoffmasse über Verstellsysteme" UBYTE fak_ub_b1p25_o0p75 1 100 0.75 1.24805 FUNCTION_LIST VS_VERST ESGRU IF_DATA DIM_X 0x38093D EXTERN WORD IF_DATA MCMESS 0x38093D EXTERN /end MEASUREMENT
/begin MEASUREMENT vske "verstellbarer Offset für Klopferkennungsschwelle über VS20" SBYTE fak_ub_b16 1 100 -8 7.9375 FUNCTION_LIST VS_VERST KRKE IF_DATA DIM_X 0x38093E EXTERN WORD IF_DATA MCMESS 0x38093E EXTERN /end MEASUREMENT
/begin MEASUREMENT vsldtv "Verstellgröße LDR-Tastverhältnis vom VSx-System zur Applikation" UBYTE tv_ub_b100 1 100 0 99.6094 FUNCTION_LIST VS_VERST LDTVMA IF_DATA DIM_X 0x38093F EXTERN WORD IF_DATA MCMESS 0x38093F EXTERN /end MEASUREMENT
/begin MEASUREMENT vslokBits01 "" UWORD dez 1 100 0 65535 FUNCTION_LIST VS IF_DATA DIM_X 0x382CBC EXTERN WORD IF_DATA MCMESS 0x382CBC EXTERN /end MEASUREMENT
/begin MEASUREMENT vsns "Änderung der Solldrehzahl über Verstellsystem VSxy" UBYTE nmot_ub_q10 1 100 0 2550 FUNCTION_LIST VS_VERST LLRNS IF_DATA DIM_X 0x380940 EXTERN WORD IF_DATA MCMESS 0x380940 EXTERN /end MEASUREMENT
/begin MEASUREMENT vsrlmx "Additive Füllungskorrektur für rlmx vom Verstellsystem" SBYTE rel_sb_q0p75 1 100 -96 95.25 FUNCTION_LIST VS_VERST LDRLMX IF_DATA DIM_X 0x380941 EXTERN WORD IF_DATA MCMESS 0x380941 EXTERN /end MEASUREMENT
/begin MEASUREMENT vstrlx "Verstellgröße Maximalfüllung vom Tester" UBYTE fak_ub_b1 1 100 0 0.996094 FUNCTION_LIST SWADP LDRLMX IF_DATA DIM_X 0x380CA5 EXTERN WORD IF_DATA MCMESS 0x380CA5 EXTERN /end MEASUREMENT
/begin MEASUREMENT vsvw "Änderung Einspritzvorlagerungswinkel über Verstellsystem" SBYTE zw_sb_q6 1 100 -768 762 FUNCTION_LIST VS_VERST ESVW IF_DATA DIM_X 0x380942 EXTERN WORD IF_DATA MCMESS 0x380942 EXTERN /end MEASUREMENT
/begin MEASUREMENT vswnws "Änderung der Winkel Nockenwelle (variable NWS) über Verstellsystem VSxy" UBYTE wkw_ub_q0p25 1 100 0 63.75 FUNCTION_LIST VS_VERST IF_DATA DIM_X 0x380943 EXTERN WORD IF_DATA MCMESS 0x380943 EXTERN /end MEASUREMENT
/begin MEASUREMENT vszw "Zündwinkelkorrektur durch Verstellsystem" SBYTE zw_sb_q0p75 1 100 -96 95.25 FUNCTION_LIST VS_VERST ZUE IF_DATA DIM_X 0x380944 EXTERN WORD IF_DATA MCMESS 0x380944 EXTERN /end MEASUREMENT
/begin MEASUREMENT vszwkr_0_A "Zylinderindividuelle ZW-Verstellung durch Verstellsystem" SBYTE zw_sb_q0p75 1 100 -96 95.25 FUNCTION_LIST VS_VERST KRRA IF_DATA DIM_X 0x380945 EXTERN WORD IF_DATA MCMESS 0x380945 EXTERN /end MEASUREMENT
/begin MEASUREMENT vszwkr_1_A "Zylinderindividuelle ZW-Verstellung durch Verstellsystem" SBYTE zw_sb_q0p75 1 100 -96 95.25 FUNCTION_LIST VS_VERST KRRA IF_DATA DIM_X 0x380946 EXTERN WORD IF_DATA MCMESS 0x380946 EXTERN /end MEASUREMENT
/begin MEASUREMENT vszwkr_2_A "Zylinderindividuelle ZW-Verstellung durch Verstellsystem" SBYTE zw_sb_q0p75 1 100 -96 95.25 FUNCTION_LIST VS_VERST KRRA IF_DATA DIM_X 0x380947 EXTERN WORD IF_DATA MCMESS 0x380947 EXTERN /end MEASUREMENT
/begin MEASUREMENT vszwkr_3_A "Zylinderindividuelle ZW-Verstellung durch Verstellsystem" SBYTE zw_sb_q0p75 1 100 -96 95.25 FUNCTION_LIST VS_VERST KRRA IF_DATA DIM_X 0x380948 EXTERN WORD IF_DATA MCMESS 0x380948 EXTERN /end MEASUREMENT
/begin MEASUREMENT vszwkr_4_A "Zylinderindividuelle ZW-Verstellung durch Verstellsystem" SBYTE zw_sb_q0p75 1 100 -96 95.25 FUNCTION_LIST VS_VERST KRRA IF_DATA DIM_X 0x380949 EXTERN WORD IF_DATA MCMESS 0x380949 EXTERN /end MEASUREMENT
/begin MEASUREMENT vszwkr_5_A "Zylinderindividuelle ZW-Verstellung durch Verstellsystem" SBYTE zw_sb_q0p75 1 100 -96 95.25 FUNCTION_LIST VS_VERST KRRA IF_DATA DIM_X 0x38094A EXTERN WORD IF_DATA MCMESS 0x38094A EXTERN /end MEASUREMENT
/begin MEASUREMENT vszwkr_6_A "Zylinderindividuelle ZW-Verstellung durch Verstellsystem" SBYTE zw_sb_q0p75 1 100 -96 95.25 FUNCTION_LIST VS_VERST KRRA IF_DATA DIM_X 0x38094B EXTERN WORD IF_DATA MCMESS 0x38094B EXTERN /end MEASUREMENT
/begin MEASUREMENT vszwkr_7_A "Zylinderindividuelle ZW-Verstellung durch Verstellsystem" SBYTE zw_sb_q0p75 1 100 -96 95.25 FUNCTION_LIST VS_VERST KRRA IF_DATA DIM_X 0x38094C EXTERN WORD IF_DATA MCMESS 0x38094C EXTERN /end MEASUREMENT
/begin MEASUREMENT vszwm "Mittelwert der ZW-Verstellung über VS2x" SBYTE zw_sb_q0p75 1 100 -96 95.25 FUNCTION_LIST KRRA IF_DATA DIM_X 0x380BE4 EXTERN WORD IF_DATA MCMESS 0x380BE4 EXTERN /end MEASUREMENT
/begin MEASUREMENT vwfs_w "" UWORD vfzg_uw_b512 1 100 0 511.992 FUNCTION_LIST WFS IF_DATA DIM_X 0x383A28 EXTERN WORD IF_DATA MCMESS 0x383A28 EXTERN /end MEASUREMENT
/begin MEASUREMENT vwkw "KW-Winkelgeschwindigkeit" UBYTE rel_ub_q0p1875 1 100 0 47.8125 FUNCTION_LIST BGRLP IF_DATA DIM_X 0x380B17 EXTERN WORD IF_DATA MCMESS 0x380B17 EXTERN /end MEASUREMENT
/begin MEASUREMENT vziel_w "Zielgeschwindigkeit FGR" UWORD vfzg_uw_b512 1 100 0 511.992 FUNCTION_LIST FGRMD BBFGR T2LID IF_DATA DIM_X 0x381FB0 EXTERN WORD IF_DATA MCMESS 0x381FB0 EXTERN /end MEASUREMENT
/begin MEASUREMENT wanwkwNvBits "" UBYTE dez 1 100 0 255 FUNCTION_LIST WANWKW DNWKW IF_DATA DIM_X 0x382FDC EXTERN WORD IF_DATA MCMESS 0x382FDC EXTERN /end MEASUREMENT
/begin MEASUREMENT wdk1 "Drosselklappenwinkel aus Poti 1" UBYTE relDK_ub_b100 1 100 0 100 FUNCTION_LIST GGDVE IF_DATA DIM_X 0x380AB9 EXTERN WORD IF_DATA MCMESS 0x380AB9 EXTERN /end MEASUREMENT
/begin MEASUREMENT wdk1g "DK-Winkel aus Poti 1 begrenzt u. gefiltert für Vergl. mit Ersatzwert aus Füllung" UBYTE relDK_ub_b100 1 100 0 100 FUNCTION_LIST GGDVE DFFTK IF_DATA DIM_X 0x380ABA EXTERN WORD IF_DATA MCMESS 0x380ABA EXTERN /end MEASUREMENT
/begin MEASUREMENT wdk1_u "DK-Winkel aus Poti 1 (Bytegröße)" SBYTE relDK_q6p25 1 100 -800 793.75 FUNCTION_LIST DFFTCNV DFFTK IF_DATA DIM_X 0x380A0A EXTERN WORD IF_DATA MCMESS 0x380A0A EXTERN /end MEASUREMENT
/begin MEASUREMENT wdk1_w "DK-Winkel aus Poti 1" SWORD relDK_q0p02441 1 100 -800 799.976 FUNCTION_LIST GGDVE DFFTCNV T2LID IF_DATA DIM_X 0x381EA4 EXTERN WORD IF_DATA MCMESS 0x381EA4 EXTERN /end MEASUREMENT
/begin MEASUREMENT wdk2 "Drosselklappenwinkel aus Poti 2" UBYTE relDK_ub_b100 1 100 0 100 FUNCTION_LIST GGDVE IF_DATA DIM_X 0x380ABB EXTERN WORD IF_DATA MCMESS 0x380ABB EXTERN /end MEASUREMENT
/begin MEASUREMENT wdk2g "DK-Winkel aus Poti 2 begrenzt u. gefiltert für Vergl. mit Ersatzwert aus Füllung" UBYTE relDK_ub_b100 1 100 0 100 FUNCTION_LIST GGDVE DFFTK IF_DATA DIM_X 0x380ABC EXTERN WORD IF_DATA MCMESS 0x380ABC EXTERN /end MEASUREMENT
/begin MEASUREMENT wdk2_u "DK-Winkel aus Poti 2 (Bytegröße)" SBYTE relDK_q6p25 1 100 -800 793.75 FUNCTION_LIST DFFTCNV DFFTK IF_DATA DIM_X 0x380A0B EXTERN WORD IF_DATA MCMESS 0x380A0B EXTERN /end MEASUREMENT
/begin MEASUREMENT wdk2_w "DK-Winkel aus Poti 2" SWORD relDK_q0p02441 1 100 -800 799.976 FUNCTION_LIST GGDVE DFFTCNV T2LID IF_DATA DIM_X 0x381EA6 EXTERN WORD IF_DATA MCMESS 0x381EA6 EXTERN /end MEASUREMENT
/begin MEASUREMENT wdk3 "DK-Winkel-Ersatzwert aus Füllungssignal" UBYTE relDK_ub_b100 1 100 0 100 FUNCTION_LIST GGDVE DFFTK T2LID IF_DATA DIM_X 0x380ABD EXTERN WORD IF_DATA MCMESS 0x380ABD EXTERN /end MEASUREMENT
/begin MEASUREMENT wdkada_w "Sollwert DK-Winkel, aus DV-E Adaption- und Prüffunktion" UWORD relDK_uw_b100 1 100 0 100 FUNCTION_LIST BGDVE ADVE T2LID IF_DATA DIM_X 0x381E96 EXTERN WORD IF_DATA MCMESS 0x381E96 EXTERN /end MEASUREMENT
/begin MEASUREMENT wdkba "Drosselklappenwinkel bezogen auf unteren Anschlag" UBYTE relDK_ub_b100 1 100 0 100 FUNCTION_LIST GGDVE CAN DFFT DLDR GGDSAS LRAEB RUNTIME SSTBER87 T2LID TC1MOD TEB IF_DATA DIM_X 0x380ABE EXTERN WORD IF_DATA MCMESS 0x380ABE EXTERN /end MEASUREMENT
/begin MEASUREMENT wdkbab_w "wdkba_w begrenzt (Minimalauswahl zwischen wdkba_w und wdkugd_w)" UWORD rel_uw_b100 1 100 0 99.9985 FUNCTION_LIST BGMSZS IF_DATA DIM_X 0x38202A EXTERN WORD IF_DATA MCMESS 0x38202A EXTERN /end MEASUREMENT
/begin MEASUREMENT wdkbadmn_w "Winkel-DK für Adressierung von KFMLDMN" SWORD relDK_q0p02441 1 100 -800 799.976 FUNCTION_LIST DHFM IF_DATA DIM_X 0x38207C EXTERN WORD IF_DATA MCMESS 0x38207C EXTERN /end MEASUREMENT
/begin MEASUREMENT wdkbadmx_w "Winkel-DK für Adressierung von KFMLDMX" SWORD relDK_q0p02441 1 100 -800 799.976 FUNCTION_LIST DHFM IF_DATA DIM_X 0x38207E EXTERN WORD IF_DATA MCMESS 0x38207E EXTERN /end MEASUREMENT
/begin MEASUREMENT wdkbapb_w "fuer Einspritzung praediz. begr. Drosselklappenwinkel (Word)" UWORD rel_uw_b100 1 100 0 99.9985 FUNCTION_LIST BGRLP IF_DATA DIM_X 0x382214 EXTERN WORD IF_DATA MCMESS 0x382214 EXTERN /end MEASUREMENT
/begin MEASUREMENT wdkbap_w "fuer Einspritzung praedizierter Drosselklappenwinkel (Word)" UWORD rel_uw_b100 1 100 0 99.9985 FUNCTION_LIST BGWDKM BGRLP IF_DATA DIM_X 0x382228 EXTERN WORD IF_DATA MCMESS 0x382228 EXTERN /end MEASUREMENT
/begin MEASUREMENT wdkba_w "Drosselklappenwinkel bezogen auf unteren Anschlag" SWORD relDK_q0p02441 1 100 -800 799.976 FUNCTION_LIST GGDVE ADVE BGDVE BGMSZS DHFM KRDY SSTBER87 T2LID IF_DATA DIM_X 0xFA4A INTERN WORD IF_DATA MCMESS 0xFA4A INTERN /end MEASUREMENT
/begin MEASUREMENT wdkdlra_w "Alter Sollwert DK-Winkel in 12 Bit-Auflösung" UWORD relDK_q0p02441 1 100 0 1599.98 FUNCTION_LIST ADVE IF_DATA DIM_X 0x381E62 EXTERN WORD IF_DATA MCMESS 0x381E62 EXTERN /end MEASUREMENT
/begin MEASUREMENT wdkdlr_w "Sollwert DK-Winkel in 12 Bit-Auflösung" UWORD relDK_q0p02441 1 100 0 1599.98 FUNCTION_LIST ADVE IF_DATA DIM_X 0xFA32 INTERN WORD IF_DATA MCMESS 0xFA32 INTERN /end MEASUREMENT
/begin MEASUREMENT wdkink_w "aktuelles Inkrement des DK-Sollwinkels" UWORD relDK_uw_b100 1 100 0 100 FUNCTION_LIST FUEDKSA IF_DATA DIM_X 0x38218E EXTERN WORD IF_DATA MCMESS 0x38218E EXTERN /end MEASUREMENT
/begin MEASUREMENT wdknlp "Diagnose: 8 Bit Kopie von wdknlp_w als Umweltgröße" UBYTE relDK_q0p3922 1 100 0 100 FUNCTION_LIST BGDVE DFFTK IF_DATA DIM_X 0x380AA3 EXTERN WORD IF_DATA MCMESS 0x380AA3 EXTERN /end MEASUREMENT
/begin MEASUREMENT wdknlpr "Diagnose: 8 Bit Kopie von wdknlpr_w als Umweltgröße" UBYTE relDK_q0p3922 1 100 0 100 FUNCTION_LIST BGDVE IF_DATA DIM_X 0x380AA4 EXTERN WORD IF_DATA MCMESS 0x380AA4 EXTERN /end MEASUREMENT
/begin MEASUREMENT wdknlpr_w "Dauer-RAM: Sollwert DK-Winkel in NLP-Stellung, bez. auf UMA" UWORD relDK_uw_b100 1 100 0 100 FUNCTION_LIST BGDVE IF_DATA DIM_X 0x3839A6 EXTERN WORD IF_DATA MCMESS 0x3839A6 EXTERN /end MEASUREMENT
/begin MEASUREMENT wdknlp_w "DK-Winkel der Notluftposition" UWORD relDK_uw_b100 1 100 0 100 FUNCTION_LIST BGDVE ADVE FUEDKSA IF_DATA DIM_X 0x381E98 EXTERN WORD IF_DATA MCMESS 0x381E98 EXTERN /end MEASUREMENT
/begin MEASUREMENT wdkpmx "Maximaler Drosselklappenwinkel für Plausibilisierung mit Füllungssignal" UBYTE relDK_ub_b100 1 100 0 100 FUNCTION_LIST GGDVE IF_DATA DIM_X 0x380ABF EXTERN WORD IF_DATA MCMESS 0x380ABF EXTERN /end MEASUREMENT
/begin MEASUREMENT wdks "Sollwert DK-Winkel, bezogen auf unteren Anschlag" UBYTE relDK_ub_b100 1 100 0 100 FUNCTION_LIST FUEDKSA CAN DFFT IF_DATA DIM_X 0x380AFF EXTERN WORD IF_DATA MCMESS 0x380AFF EXTERN /end MEASUREMENT
/begin MEASUREMENT wdksap_w "DK-Sollwinkel aus Applikationsblock" UWORD rel_uw_b100 1 100 0 99.9985 FUNCTION_LIST FUEDK FUEDKSA IF_DATA DIM_X 0x382156 EXTERN WORD IF_DATA MCMESS 0x382156 EXTERN /end MEASUREMENT
/begin MEASUREMENT wdksba2_w "DK-Sollwinkel nach der Begrenzung, Wert aus Rechenraster n-2" UWORD relDK_uw_b100 1 100 0 100 FUNCTION_LIST FUEDKSA IF_DATA DIM_X 0x382190 EXTERN WORD IF_DATA MCMESS 0x382190 EXTERN /end MEASUREMENT
/begin MEASUREMENT wdksba_w "DK-Sollwinkel nach der Begrenzung, Wert aus Rechenraster n-1" UWORD relDK_uw_b100 1 100 0 100 FUNCTION_LIST FUEDKSA IF_DATA DIM_X 0x382192 EXTERN WORD IF_DATA MCMESS 0x382192 EXTERN /end MEASUREMENT
/begin MEASUREMENT wdksb_w "DK-Sollwinkel nach der Begrenzung" UWORD relDK_uw_b100 1 100 0 100 FUNCTION_LIST FUEDKSA IF_DATA DIM_X 0x382194 EXTERN WORD IF_DATA MCMESS 0x382194 EXTERN /end MEASUREMENT
/begin MEASUREMENT wdksfi_w "aus wdks_w prädizierter DK-Winkel" SWORD relDK_q0p02441 1 100 -800 799.976 FUNCTION_LIST ADVE IF_DATA DIM_X 0x381E64 EXTERN WORD IF_DATA MCMESS 0x381E64 EXTERN /end MEASUREMENT
/begin MEASUREMENT wdksfl "Flankenwechselanzeige für DK-Sollwert wdksap_w" SBYTE fak_sb_b1 1 100 -1 0.992188 FUNCTION_LIST FUEDKSA IF_DATA DIM_X 0x380B00 EXTERN WORD IF_DATA MCMESS 0x380B00 EXTERN /end MEASUREMENT
/begin MEASUREMENT wdksgv_w "Drosselklappen-Sollwinkel vor Applikationsschnittstelle (gefiltert)" UWORD rel_uw_b100 1 100 0 99.9985 FUNCTION_LIST FUEDK IF_DATA DIM_X 0x382158 EXTERN WORD IF_DATA MCMESS 0x382158 EXTERN /end MEASUREMENT
/begin MEASUREMENT wdksmx_w "max. Sollwert Drosselklappenwinkel" UWORD rel_uw_b100 1 100 0 99.9985 FUNCTION_LIST FUEDK IF_DATA DIM_X 0x38215A EXTERN WORD IF_DATA MCMESS 0x38215A EXTERN /end MEASUREMENT
/begin MEASUREMENT wdksom_w "Drosselklappensollwinkel ohne Momentenstruktur" UWORD rel_uw_b100 1 100 0 99.9985 FUNCTION_LIST SWADP FUEDK IF_DATA DIM_X 0x382B3C EXTERN WORD IF_DATA MCMESS 0x382B3C EXTERN /end MEASUREMENT
/begin MEASUREMENT wdkspa_w "prädizierter DK-Winkel, Wert aus Rechenraster n-1" UWORD relDK_uw_b100 1 100 0 100 FUNCTION_LIST FUEDKSA IF_DATA DIM_X 0x382196 EXTERN WORD IF_DATA MCMESS 0x382196 EXTERN /end MEASUREMENT
/begin MEASUREMENT wdksp_w "Prädizierter Drosselklappen-Sollwinkel" UWORD relDK_uw_b100 1 100 0 100 FUNCTION_LIST FUEDKSA BGRLP BGWDKM IF_DATA DIM_X 0x382198 EXTERN WORD IF_DATA MCMESS 0x382198 EXTERN /end MEASUREMENT
/begin MEASUREMENT wdksvfl "Flankenwechselanzeige für DK-Sollwert wdksapa_w" SBYTE fak_sb_b1 1 100 -1 0.992188 FUNCTION_LIST FUEDKSA IF_DATA DIM_X 0x380B01 EXTERN WORD IF_DATA MCMESS 0x380B01 EXTERN /end MEASUREMENT
/begin MEASUREMENT wdksv_w "Drosselklappen-Sollwinkel vor Applikationsschnittstelle (ungefiltert)" UWORD rel_uw_b100 1 100 0 99.9985 FUNCTION_LIST FUEDK IF_DATA DIM_X 0x38215C EXTERN WORD IF_DATA MCMESS 0x38215C EXTERN /end MEASUREMENT
/begin MEASUREMENT wdkswe_w "DK-Sollwertschwelle für prädiz. Entjitterung" UWORD relDK_uw_b100 1 100 0 100 FUNCTION_LIST FUEDKSA IF_DATA DIM_X 0x38219A EXTERN WORD IF_DATA MCMESS 0x38219A EXTERN /end MEASUREMENT
/begin MEASUREMENT wdks_w "Sollwert Drosselklappenwinkel, bezogen auf (unteren) Anschlag" UWORD relDK_uw_b100 1 100 0 100 FUNCTION_LIST FUEDKSA ADVE BGDVE T2LID IF_DATA DIM_X 0x38219C EXTERN WORD IF_DATA MCMESS 0x38219C EXTERN /end MEASUREMENT
/begin MEASUREMENT wdkugd_w "Drosselklappenwinkel, bei dem 95% Füllung erreicht wird" UWORD rel_uw_b100 1 100 0 99.9985 FUNCTION_LIST BGMSZS BGRLP FUEDK IF_DATA DIM_X 0x38202C EXTERN WORD IF_DATA MCMESS 0x38202C EXTERN /end MEASUREMENT
/begin MEASUREMENT wdkvabob "DK-Sollwert für oberen Abgleichpunkt" UWORD relDK_uw_b100 1 100 0 100 FUNCTION_LIST BGDVE IF_DATA DIM_X 0x381E9A EXTERN WORD IF_DATA MCMESS 0x381E9A EXTERN /end MEASUREMENT
/begin MEASUREMENT wdkvabub "DK-Sollwert für unteren Abgleichpunkt" UWORD relDK_uw_b100 1 100 0 100 FUNCTION_LIST BGDVE IF_DATA DIM_X 0x381E9C EXTERN WORD IF_DATA MCMESS 0x381E9C EXTERN /end MEASUREMENT
/begin MEASUREMENT wea "Winkelmarke Einspritzabbruch" UBYTE zw_ub_q6 1 100 0 1530 FUNCTION_LIST ESVW BGRLP IF_DATA DIM_X 0x380B35 EXTERN WORD IF_DATA MCMESS 0x380B35 EXTERN /end MEASUREMENT
/begin MEASUREMENT wee "Winkel Einspritzende im Normalbetrieb" UBYTE zw_ub_q6 1 100 0 1530 FUNCTION_LIST ESVW BGRLP IF_DATA DIM_X 0x380B38 EXTERN WORD IF_DATA MCMESS 0x380B38 EXTERN /end MEASUREMENT
/begin MEASUREMENT weemrfa "Winkel Einspritzende im maximalem Fahrerwunschmomment" UBYTE zw_ub_q6 1 100 0 1530 FUNCTION_LIST ESVW IF_DATA DIM_X 0x380B36 EXTERN WORD IF_DATA MCMESS 0x380B36 EXTERN /end MEASUREMENT
/begin MEASUREMENT weenst "Winkel Einspritzende nach Startende" UBYTE zw_ub_q6 1 100 0 1530 FUNCTION_LIST ESVW IF_DATA DIM_X 0x380B39 EXTERN WORD IF_DATA MCMESS 0x380B39 EXTERN /end MEASUREMENT
/begin MEASUREMENT weer "Winkel Einspritzende resultierend" UBYTE kw_q2p8125 1 100 0 717.188 FUNCTION_LIST ESVW ACIFI IF_DATA DIM_X 0x380B3A EXTERN WORD IF_DATA MCMESS 0x380B3A EXTERN /end MEASUREMENT
/begin MEASUREMENT weest "Winkel Einspritzende im Start" UBYTE zw_ub_q6 1 100 0 1530 FUNCTION_LIST ESVW IF_DATA DIM_X 0x380B3B EXTERN WORD IF_DATA MCMESS 0x380B3B EXTERN /end MEASUREMENT
/begin MEASUREMENT weests_r "" UBYTE kw_q2p8125 1 100 0 717.188 FUNCTION_LIST ACIFI IF_DATA DIM_X 0xFA6C INTERN WORD IF_DATA MCMESS 0xFA6C INTERN /end MEASUREMENT
/begin MEASUREMENT weg_high "Wegsignal (High-Word)" UWORD s_q32_km 1 100 0 2.09712e+006 FUNCTION_LIST BGKMKI IF_DATA DIM_X 0x383538 EXTERN WORD IF_DATA MCMESS 0x383538 EXTERN /end MEASUREMENT
/begin MEASUREMENT weg_info "" UBYTE dez 1 100 0 255 FUNCTION_LIST CAN BGKMKI IF_DATA DIM_X 0x38096A EXTERN WORD IF_DATA MCMESS 0x38096A EXTERN /end MEASUREMENT
/begin MEASUREMENT weg_low "Wegsignal (Low-Byte)" UBYTE s_q1_km 1 100 0 255 FUNCTION_LIST BGKMKI IF_DATA DIM_X 0x382FC5 EXTERN WORD IF_DATA MCMESS 0x382FC5 EXTERN /end MEASUREMENT
/begin MEASUREMENT weg_mux "" UBYTE dez 1 100 0 255 FUNCTION_LIST CAN BGKMKI IF_DATA DIM_X 0x38096B EXTERN WORD IF_DATA MCMESS 0x38096B EXTERN /end MEASUREMENT
/begin MEASUREMENT WfsBits "" UBYTE dez 1 100 0 255 FUNCTION_LIST WFS IF_DATA DIM_X 0x3830B5 EXTERN WORD IF_DATA MCMESS 0x3830B5 EXTERN /end MEASUREMENT
/begin MEASUREMENT wf_w "Wandfilmmenge" SWORD rel_sw_q0p1875 1 100 -6144 6143.81 FUNCTION_LIST ESUK IF_DATA DIM_X 0x3822A6 EXTERN WORD IF_DATA MCMESS 0x3822A6 EXTERN /end MEASUREMENT
/begin MEASUREMENT winkl_b1 "" UWORD dez 1 100 0 65535 FUNCTION_LIST ACIFI IF_DATA DIM_X 0xFAB0 INTERN WORD IF_DATA MCMESS 0xFAB0 INTERN /end MEASUREMENT
/begin MEASUREMENT winkl_b2 "" UWORD dez 1 100 0 65535 FUNCTION_LIST ACIFI IF_DATA DIM_X 0xFAB2 INTERN WORD IF_DATA MCMESS 0xFAB2 INTERN /end MEASUREMENT
/begin MEASUREMENT wkr_0_A "zylinderindividuelle Zündwinkelspätverstellung KR" UBYTE zw_ub_qn0p75 1 100 -191.25 0 FUNCTION_LIST KRRA IF_DATA DIM_X 0xFAF4 INTERN WORD IF_DATA MCMESS 0xFAF4 INTERN /end MEASUREMENT
/begin MEASUREMENT wkr_1_A "zylinderindividuelle Zündwinkelspätverstellung KR" UBYTE zw_ub_qn0p75 1 100 -191.25 0 FUNCTION_LIST KRRA IF_DATA DIM_X 0xFAF5 INTERN WORD IF_DATA MCMESS 0xFAF5 INTERN /end MEASUREMENT
/begin MEASUREMENT wkr_2_A "zylinderindividuelle Zündwinkelspätverstellung KR" UBYTE zw_ub_qn0p75 1 100 -191.25 0 FUNCTION_LIST KRRA IF_DATA DIM_X 0xFAF6 INTERN WORD IF_DATA MCMESS 0xFAF6 INTERN /end MEASUREMENT
/begin MEASUREMENT wkr_3_A "zylinderindividuelle Zündwinkelspätverstellung KR" UBYTE zw_ub_qn0p75 1 100 -191.25 0 FUNCTION_LIST KRRA IF_DATA DIM_X 0xFAF7 INTERN WORD IF_DATA MCMESS 0xFAF7 INTERN /end MEASUREMENT
/begin MEASUREMENT wkr_4_A "zylinderindividuelle Zündwinkelspätverstellung KR" UBYTE zw_ub_qn0p75 1 100 -191.25 0 FUNCTION_LIST KRRA IF_DATA DIM_X 0xFAF8 INTERN WORD IF_DATA MCMESS 0xFAF8 INTERN /end MEASUREMENT
/begin MEASUREMENT wkr_5_A "zylinderindividuelle Zündwinkelspätverstellung KR" UBYTE zw_ub_qn0p75 1 100 -191.25 0 FUNCTION_LIST KRRA IF_DATA DIM_X 0xFAF9 INTERN WORD IF_DATA MCMESS 0xFAF9 INTERN /end MEASUREMENT
/begin MEASUREMENT wkr_6_A "zylinderindividuelle Zündwinkelspätverstellung KR" UBYTE zw_ub_qn0p75 1 100 -191.25 0 FUNCTION_LIST KRRA IF_DATA DIM_X 0xFAFA INTERN WORD IF_DATA MCMESS 0xFAFA INTERN /end MEASUREMENT
/begin MEASUREMENT wkr_7_A "zylinderindividuelle Zündwinkelspätverstellung KR" UBYTE zw_ub_qn0p75 1 100 -191.25 0 FUNCTION_LIST KRRA IF_DATA DIM_X 0xFAFB INTERN WORD IF_DATA MCMESS 0xFAFB INTERN /end MEASUREMENT
/begin MEASUREMENT wkra_0_A "last und drehzahlabh. Adaptionskennfeld f. wkr" UBYTE zw_ub_qn0p75 1 100 -191.25 0 FUNCTION_LIST KRRA T2LID IF_DATA DIM_X 0x383013 EXTERN WORD IF_DATA MCMESS 0x383013 EXTERN /end MEASUREMENT
/begin MEASUREMENT wkra_1_A "last und drehzahlabh. Adaptionskennfeld f. wkr" UBYTE zw_ub_qn0p75 1 100 -191.25 0 FUNCTION_LIST KRRA T2LID IF_DATA DIM_X 0x383014 EXTERN WORD IF_DATA MCMESS 0x383014 EXTERN /end MEASUREMENT
/begin MEASUREMENT wkra_2_A "last und drehzahlabh. Adaptionskennfeld f. wkr" UBYTE zw_ub_qn0p75 1 100 -191.25 0 FUNCTION_LIST KRRA T2LID IF_DATA DIM_X 0x383015 EXTERN WORD IF_DATA MCMESS 0x383015 EXTERN /end MEASUREMENT
/begin MEASUREMENT wkra_3_A "last und drehzahlabh. Adaptionskennfeld f. wkr" UBYTE zw_ub_qn0p75 1 100 -191.25 0 FUNCTION_LIST KRRA T2LID IF_DATA DIM_X 0x383016 EXTERN WORD IF_DATA MCMESS 0x383016 EXTERN /end MEASUREMENT
/begin MEASUREMENT wkra_4_A "last und drehzahlabh. Adaptionskennfeld f. wkr" UBYTE zw_ub_qn0p75 1 100 -191.25 0 FUNCTION_LIST KRRA T2LID IF_DATA DIM_X 0x383017 EXTERN WORD IF_DATA MCMESS 0x383017 EXTERN /end MEASUREMENT
/begin MEASUREMENT wkra_5_A "last und drehzahlabh. Adaptionskennfeld f. wkr" UBYTE zw_ub_qn0p75 1 100 -191.25 0 FUNCTION_LIST KRRA T2LID IF_DATA DIM_X 0x383018 EXTERN WORD IF_DATA MCMESS 0x383018 EXTERN /end MEASUREMENT
/begin MEASUREMENT wkra_6_A "last und drehzahlabh. Adaptionskennfeld f. wkr" UBYTE zw_ub_qn0p75 1 100 -191.25 0 FUNCTION_LIST KRRA T2LID IF_DATA DIM_X 0x383019 EXTERN WORD IF_DATA MCMESS 0x383019 EXTERN /end MEASUREMENT
/begin MEASUREMENT wkra_7_A "last und drehzahlabh. Adaptionskennfeld f. wkr" UBYTE zw_ub_qn0p75 1 100 -191.25 0 FUNCTION_LIST KRRA T2LID IF_DATA DIM_X 0x38301A EXTERN WORD IF_DATA MCMESS 0x38301A EXTERN /end MEASUREMENT
/begin MEASUREMENT wkra_8_A "last und drehzahlabh. Adaptionskennfeld f. wkr" UBYTE zw_ub_qn0p75 1 100 -191.25 0 FUNCTION_LIST KRRA T2LID IF_DATA DIM_X 0x38301B EXTERN WORD IF_DATA MCMESS 0x38301B EXTERN /end MEASUREMENT
/begin MEASUREMENT wkra_9_A "last und drehzahlabh. Adaptionskennfeld f. wkr" UBYTE zw_ub_qn0p75 1 100 -191.25 0 FUNCTION_LIST KRRA T2LID IF_DATA DIM_X 0x38301C EXTERN WORD IF_DATA MCMESS 0x38301C EXTERN /end MEASUREMENT
/begin MEASUREMENT wkra_10_A "last und drehzahlabh. Adaptionskennfeld f. wkr" UBYTE zw_ub_qn0p75 1 100 -191.25 0 FUNCTION_LIST KRRA T2LID IF_DATA DIM_X 0x38301D EXTERN WORD IF_DATA MCMESS 0x38301D EXTERN /end MEASUREMENT
/begin MEASUREMENT wkra_11_A "last und drehzahlabh. Adaptionskennfeld f. wkr" UBYTE zw_ub_qn0p75 1 100 -191.25 0 FUNCTION_LIST KRRA T2LID IF_DATA DIM_X 0x38301E EXTERN WORD IF_DATA MCMESS 0x38301E EXTERN /end MEASUREMENT
/begin MEASUREMENT wkra_12_A "last und drehzahlabh. Adaptionskennfeld f. wkr" UBYTE zw_ub_qn0p75 1 100 -191.25 0 FUNCTION_LIST KRRA T2LID IF_DATA DIM_X 0x38301F EXTERN WORD IF_DATA MCMESS 0x38301F EXTERN /end MEASUREMENT
/begin MEASUREMENT wkra_13_A "last und drehzahlabh. Adaptionskennfeld f. wkr" UBYTE zw_ub_qn0p75 1 100 -191.25 0 FUNCTION_LIST KRRA T2LID IF_DATA DIM_X 0x383020 EXTERN WORD IF_DATA MCMESS 0x383020 EXTERN /end MEASUREMENT
/begin MEASUREMENT wkra_14_A "last und drehzahlabh. Adaptionskennfeld f. wkr" UBYTE zw_ub_qn0p75 1 100 -191.25 0 FUNCTION_LIST KRRA T2LID IF_DATA DIM_X 0x383021 EXTERN WORD IF_DATA MCMESS 0x383021 EXTERN /end MEASUREMENT
/begin MEASUREMENT wkra_15_A "last und drehzahlabh. Adaptionskennfeld f. wkr" UBYTE zw_ub_qn0p75 1 100 -191.25 0 FUNCTION_LIST KRRA T2LID IF_DATA DIM_X 0x383022 EXTERN WORD IF_DATA MCMESS 0x383022 EXTERN /end MEASUREMENT
/begin MEASUREMENT wkra_16_A "last und drehzahlabh. Adaptionskennfeld f. wkr" UBYTE zw_ub_qn0p75 1 100 -191.25 0 FUNCTION_LIST KRRA T2LID IF_DATA DIM_X 0x383023 EXTERN WORD IF_DATA MCMESS 0x383023 EXTERN /end MEASUREMENT
/begin MEASUREMENT wkra_17_A "last und drehzahlabh. Adaptionskennfeld f. wkr" UBYTE zw_ub_qn0p75 1 100 -191.25 0 FUNCTION_LIST KRRA T2LID IF_DATA DIM_X 0x383024 EXTERN WORD IF_DATA MCMESS 0x383024 EXTERN /end MEASUREMENT
/begin MEASUREMENT wkra_18_A "last und drehzahlabh. Adaptionskennfeld f. wkr" UBYTE zw_ub_qn0p75 1 100 -191.25 0 FUNCTION_LIST KRRA T2LID IF_DATA DIM_X 0x383025 EXTERN WORD IF_DATA MCMESS 0x383025 EXTERN /end MEASUREMENT
/begin MEASUREMENT wkra_19_A "last und drehzahlabh. Adaptionskennfeld f. wkr" UBYTE zw_ub_qn0p75 1 100 -191.25 0 FUNCTION_LIST KRRA T2LID IF_DATA DIM_X 0x383026 EXTERN WORD IF_DATA MCMESS 0x383026 EXTERN /end MEASUREMENT
/begin MEASUREMENT wkra_20_A "last und drehzahlabh. Adaptionskennfeld f. wkr" UBYTE zw_ub_qn0p75 1 100 -191.25 0 FUNCTION_LIST KRRA T2LID IF_DATA DIM_X 0x383027 EXTERN WORD IF_DATA MCMESS 0x383027 EXTERN /end MEASUREMENT
/begin MEASUREMENT wkra_21_A "last und drehzahlabh. Adaptionskennfeld f. wkr" UBYTE zw_ub_qn0p75 1 100 -191.25 0 FUNCTION_LIST KRRA T2LID IF_DATA DIM_X 0x383028 EXTERN WORD IF_DATA MCMESS 0x383028 EXTERN /end MEASUREMENT
/begin MEASUREMENT wkra_22_A "last und drehzahlabh. Adaptionskennfeld f. wkr" UBYTE zw_ub_qn0p75 1 100 -191.25 0 FUNCTION_LIST KRRA T2LID IF_DATA DIM_X 0x383029 EXTERN WORD IF_DATA MCMESS 0x383029 EXTERN /end MEASUREMENT
/begin MEASUREMENT wkra_23_A "last und drehzahlabh. Adaptionskennfeld f. wkr" UBYTE zw_ub_qn0p75 1 100 -191.25 0 FUNCTION_LIST KRRA T2LID IF_DATA DIM_X 0x38302A EXTERN WORD IF_DATA MCMESS 0x38302A EXTERN /end MEASUREMENT
/begin MEASUREMENT wkra_24_A "last und drehzahlabh. Adaptionskennfeld f. wkr" UBYTE zw_ub_qn0p75 1 100 -191.25 0 FUNCTION_LIST KRRA T2LID IF_DATA DIM_X 0x38302B EXTERN WORD IF_DATA MCMESS 0x38302B EXTERN /end MEASUREMENT
/begin MEASUREMENT wkra_25_A "last und drehzahlabh. Adaptionskennfeld f. wkr" UBYTE zw_ub_qn0p75 1 100 -191.25 0 FUNCTION_LIST KRRA T2LID IF_DATA DIM_X 0x38302C EXTERN WORD IF_DATA MCMESS 0x38302C EXTERN /end MEASUREMENT
/begin MEASUREMENT wkra_26_A "last und drehzahlabh. Adaptionskennfeld f. wkr" UBYTE zw_ub_qn0p75 1 100 -191.25 0 FUNCTION_LIST KRRA T2LID IF_DATA DIM_X 0x38302D EXTERN WORD IF_DATA MCMESS 0x38302D EXTERN /end MEASUREMENT
/begin MEASUREMENT wkra_27_A "last und drehzahlabh. Adaptionskennfeld f. wkr" UBYTE zw_ub_qn0p75 1 100 -191.25 0 FUNCTION_LIST KRRA T2LID IF_DATA DIM_X 0x38302E EXTERN WORD IF_DATA MCMESS 0x38302E EXTERN /end MEASUREMENT
/begin MEASUREMENT wkra_28_A "last und drehzahlabh. Adaptionskennfeld f. wkr" UBYTE zw_ub_qn0p75 1 100 -191.25 0 FUNCTION_LIST KRRA T2LID IF_DATA DIM_X 0x38302F EXTERN WORD IF_DATA MCMESS 0x38302F EXTERN /end MEASUREMENT
/begin MEASUREMENT wkra_29_A "last und drehzahlabh. Adaptionskennfeld f. wkr" UBYTE zw_ub_qn0p75 1 100 -191.25 0 FUNCTION_LIST KRRA T2LID IF_DATA DIM_X 0x383030 EXTERN WORD IF_DATA MCMESS 0x383030 EXTERN /end MEASUREMENT
/begin MEASUREMENT wkra_30_A "last und drehzahlabh. Adaptionskennfeld f. wkr" UBYTE zw_ub_qn0p75 1 100 -191.25 0 FUNCTION_LIST KRRA T2LID IF_DATA DIM_X 0x383031 EXTERN WORD IF_DATA MCMESS 0x383031 EXTERN /end MEASUREMENT
/begin MEASUREMENT wkra_31_A "last und drehzahlabh. Adaptionskennfeld f. wkr" UBYTE zw_ub_qn0p75 1 100 -191.25 0 FUNCTION_LIST KRRA T2LID IF_DATA DIM_X 0x383032 EXTERN WORD IF_DATA MCMESS 0x383032 EXTERN /end MEASUREMENT
/begin MEASUREMENT wkra_32_A "last und drehzahlabh. Adaptionskennfeld f. wkr" UBYTE zw_ub_qn0p75 1 100 -191.25 0 FUNCTION_LIST KRRA T2LID IF_DATA DIM_X 0x383033 EXTERN WORD IF_DATA MCMESS 0x383033 EXTERN /end MEASUREMENT
/begin MEASUREMENT wkra_33_A "last und drehzahlabh. Adaptionskennfeld f. wkr" UBYTE zw_ub_qn0p75 1 100 -191.25 0 FUNCTION_LIST KRRA T2LID IF_DATA DIM_X 0x383034 EXTERN WORD IF_DATA MCMESS 0x383034 EXTERN /end MEASUREMENT
/begin MEASUREMENT wkra_34_A "last und drehzahlabh. Adaptionskennfeld f. wkr" UBYTE zw_ub_qn0p75 1 100 -191.25 0 FUNCTION_LIST KRRA T2LID IF_DATA DIM_X 0x383035 EXTERN WORD IF_DATA MCMESS 0x383035 EXTERN /end MEASUREMENT
/begin MEASUREMENT wkra_35_A "last und drehzahlabh. Adaptionskennfeld f. wkr" UBYTE zw_ub_qn0p75 1 100 -191.25 0 FUNCTION_LIST KRRA T2LID IF_DATA DIM_X 0x383036 EXTERN WORD IF_DATA MCMESS 0x383036 EXTERN /end MEASUREMENT
/begin MEASUREMENT wkra_36_A "last und drehzahlabh. Adaptionskennfeld f. wkr" UBYTE zw_ub_qn0p75 1 100 -191.25 0 FUNCTION_LIST KRRA T2LID IF_DATA DIM_X 0x383037 EXTERN WORD IF_DATA MCMESS 0x383037 EXTERN /end MEASUREMENT
/begin MEASUREMENT wkra_37_A "last und drehzahlabh. Adaptionskennfeld f. wkr" UBYTE zw_ub_qn0p75 1 100 -191.25 0 FUNCTION_LIST KRRA T2LID IF_DATA DIM_X 0x383038 EXTERN WORD IF_DATA MCMESS 0x383038 EXTERN /end MEASUREMENT
/begin MEASUREMENT wkra_38_A "last und drehzahlabh. Adaptionskennfeld f. wkr" UBYTE zw_ub_qn0p75 1 100 -191.25 0 FUNCTION_LIST KRRA T2LID IF_DATA DIM_X 0x383039 EXTERN WORD IF_DATA MCMESS 0x383039 EXTERN /end MEASUREMENT
/begin MEASUREMENT wkra_39_A "last und drehzahlabh. Adaptionskennfeld f. wkr" UBYTE zw_ub_qn0p75 1 100 -191.25 0 FUNCTION_LIST KRRA T2LID IF_DATA DIM_X 0x38303A EXTERN WORD IF_DATA MCMESS 0x38303A EXTERN /end MEASUREMENT
/begin MEASUREMENT wkra_40_A "last und drehzahlabh. Adaptionskennfeld f. wkr" UBYTE zw_ub_qn0p75 1 100 -191.25 0 FUNCTION_LIST KRRA T2LID IF_DATA DIM_X 0x38303B EXTERN WORD IF_DATA MCMESS 0x38303B EXTERN /end MEASUREMENT
/begin MEASUREMENT wkra_41_A "last und drehzahlabh. Adaptionskennfeld f. wkr" UBYTE zw_ub_qn0p75 1 100 -191.25 0 FUNCTION_LIST KRRA T2LID IF_DATA DIM_X 0x38303C EXTERN WORD IF_DATA MCMESS 0x38303C EXTERN /end MEASUREMENT
/begin MEASUREMENT wkra_42_A "last und drehzahlabh. Adaptionskennfeld f. wkr" UBYTE zw_ub_qn0p75 1 100 -191.25 0 FUNCTION_LIST KRRA T2LID IF_DATA DIM_X 0x38303D EXTERN WORD IF_DATA MCMESS 0x38303D EXTERN /end MEASUREMENT
/begin MEASUREMENT wkra_43_A "last und drehzahlabh. Adaptionskennfeld f. wkr" UBYTE zw_ub_qn0p75 1 100 -191.25 0 FUNCTION_LIST KRRA T2LID IF_DATA DIM_X 0x38303E EXTERN WORD IF_DATA MCMESS 0x38303E EXTERN /end MEASUREMENT
/begin MEASUREMENT wkra_44_A "last und drehzahlabh. Adaptionskennfeld f. wkr" UBYTE zw_ub_qn0p75 1 100 -191.25 0 FUNCTION_LIST KRRA T2LID IF_DATA DIM_X 0x38303F EXTERN WORD IF_DATA MCMESS 0x38303F EXTERN /end MEASUREMENT
/begin MEASUREMENT wkra_45_A "last und drehzahlabh. Adaptionskennfeld f. wkr" UBYTE zw_ub_qn0p75 1 100 -191.25 0 FUNCTION_LIST KRRA T2LID IF_DATA DIM_X 0x383040 EXTERN WORD IF_DATA MCMESS 0x383040 EXTERN /end MEASUREMENT
/begin MEASUREMENT wkra_46_A "last und drehzahlabh. Adaptionskennfeld f. wkr" UBYTE zw_ub_qn0p75 1 100 -191.25 0 FUNCTION_LIST KRRA T2LID IF_DATA DIM_X 0x383041 EXTERN WORD IF_DATA MCMESS 0x383041 EXTERN /end MEASUREMENT
/begin MEASUREMENT wkra_47_A "last und drehzahlabh. Adaptionskennfeld f. wkr" UBYTE zw_ub_qn0p75 1 100 -191.25 0 FUNCTION_LIST KRRA T2LID IF_DATA DIM_X 0x383042 EXTERN WORD IF_DATA MCMESS 0x383042 EXTERN /end MEASUREMENT
/begin MEASUREMENT wkra_48_A "last und drehzahlabh. Adaptionskennfeld f. wkr" UBYTE zw_ub_qn0p75 1 100 -191.25 0 FUNCTION_LIST KRRA T2LID IF_DATA DIM_X 0x383043 EXTERN WORD IF_DATA MCMESS 0x383043 EXTERN /end MEASUREMENT
/begin MEASUREMENT wkra_49_A "last und drehzahlabh. Adaptionskennfeld f. wkr" UBYTE zw_ub_qn0p75 1 100 -191.25 0 FUNCTION_LIST KRRA T2LID IF_DATA DIM_X 0x383044 EXTERN WORD IF_DATA MCMESS 0x383044 EXTERN /end MEASUREMENT
/begin MEASUREMENT wkra_50_A "last und drehzahlabh. Adaptionskennfeld f. wkr" UBYTE zw_ub_qn0p75 1 100 -191.25 0 FUNCTION_LIST KRRA T2LID IF_DATA DIM_X 0x383045 EXTERN WORD IF_DATA MCMESS 0x383045 EXTERN /end MEASUREMENT
/begin MEASUREMENT wkra_51_A "last und drehzahlabh. Adaptionskennfeld f. wkr" UBYTE zw_ub_qn0p75 1 100 -191.25 0 FUNCTION_LIST KRRA T2LID IF_DATA DIM_X 0x383046 EXTERN WORD IF_DATA MCMESS 0x383046 EXTERN /end MEASUREMENT
/begin MEASUREMENT wkra_52_A "last und drehzahlabh. Adaptionskennfeld f. wkr" UBYTE zw_ub_qn0p75 1 100 -191.25 0 FUNCTION_LIST KRRA T2LID IF_DATA DIM_X 0x383047 EXTERN WORD IF_DATA MCMESS 0x383047 EXTERN /end MEASUREMENT
/begin MEASUREMENT wkra_53_A "last und drehzahlabh. Adaptionskennfeld f. wkr" UBYTE zw_ub_qn0p75 1 100 -191.25 0 FUNCTION_LIST KRRA T2LID IF_DATA DIM_X 0x383048 EXTERN WORD IF_DATA MCMESS 0x383048 EXTERN /end MEASUREMENT
/begin MEASUREMENT wkra_54_A "last und drehzahlabh. Adaptionskennfeld f. wkr" UBYTE zw_ub_qn0p75 1 100 -191.25 0 FUNCTION_LIST KRRA T2LID IF_DATA DIM_X 0x383049 EXTERN WORD IF_DATA MCMESS 0x383049 EXTERN /end MEASUREMENT
/begin MEASUREMENT wkra_55_A "last und drehzahlabh. Adaptionskennfeld f. wkr" UBYTE zw_ub_qn0p75 1 100 -191.25 0 FUNCTION_LIST KRRA T2LID IF_DATA DIM_X 0x38304A EXTERN WORD IF_DATA MCMESS 0x38304A EXTERN /end MEASUREMENT
/begin MEASUREMENT wkra_56_A "last und drehzahlabh. Adaptionskennfeld f. wkr" UBYTE zw_ub_qn0p75 1 100 -191.25 0 FUNCTION_LIST KRRA T2LID IF_DATA DIM_X 0x38304B EXTERN WORD IF_DATA MCMESS 0x38304B EXTERN /end MEASUREMENT
/begin MEASUREMENT wkra_57_A "last und drehzahlabh. Adaptionskennfeld f. wkr" UBYTE zw_ub_qn0p75 1 100 -191.25 0 FUNCTION_LIST KRRA T2LID IF_DATA DIM_X 0x38304C EXTERN WORD IF_DATA MCMESS 0x38304C EXTERN /end MEASUREMENT
/begin MEASUREMENT wkra_58_A "last und drehzahlabh. Adaptionskennfeld f. wkr" UBYTE zw_ub_qn0p75 1 100 -191.25 0 FUNCTION_LIST KRRA T2LID IF_DATA DIM_X 0x38304D EXTERN WORD IF_DATA MCMESS 0x38304D EXTERN /end MEASUREMENT
/begin MEASUREMENT wkra_59_A "last und drehzahlabh. Adaptionskennfeld f. wkr" UBYTE zw_ub_qn0p75 1 100 -191.25 0 FUNCTION_LIST KRRA T2LID IF_DATA DIM_X 0x38304E EXTERN WORD IF_DATA MCMESS 0x38304E EXTERN /end MEASUREMENT
/begin MEASUREMENT wkra_60_A "last und drehzahlabh. Adaptionskennfeld f. wkr" UBYTE zw_ub_qn0p75 1 100 -191.25 0 FUNCTION_LIST KRRA T2LID IF_DATA DIM_X 0x38304F EXTERN WORD IF_DATA MCMESS 0x38304F EXTERN /end MEASUREMENT
/begin MEASUREMENT wkra_61_A "last und drehzahlabh. Adaptionskennfeld f. wkr" UBYTE zw_ub_qn0p75 1 100 -191.25 0 FUNCTION_LIST KRRA T2LID IF_DATA DIM_X 0x383050 EXTERN WORD IF_DATA MCMESS 0x383050 EXTERN /end MEASUREMENT
/begin MEASUREMENT wkra_62_A "last und drehzahlabh. Adaptionskennfeld f. wkr" UBYTE zw_ub_qn0p75 1 100 -191.25 0 FUNCTION_LIST KRRA T2LID IF_DATA DIM_X 0x383051 EXTERN WORD IF_DATA MCMESS 0x383051 EXTERN /end MEASUREMENT
/begin MEASUREMENT wkra_63_A "last und drehzahlabh. Adaptionskennfeld f. wkr" UBYTE zw_ub_qn0p75 1 100 -191.25 0 FUNCTION_LIST KRRA T2LID IF_DATA DIM_X 0x383052 EXTERN WORD IF_DATA MCMESS 0x383052 EXTERN /end MEASUREMENT
/begin MEASUREMENT wkra_64_A "last und drehzahlabh. Adaptionskennfeld f. wkr" UBYTE zw_ub_qn0p75 1 100 -191.25 0 FUNCTION_LIST KRRA T2LID IF_DATA DIM_X 0x383053 EXTERN WORD IF_DATA MCMESS 0x383053 EXTERN /end MEASUREMENT
/begin MEASUREMENT wkra_65_A "last und drehzahlabh. Adaptionskennfeld f. wkr" UBYTE zw_ub_qn0p75 1 100 -191.25 0 FUNCTION_LIST KRRA T2LID IF_DATA DIM_X 0x383054 EXTERN WORD IF_DATA MCMESS 0x383054 EXTERN /end MEASUREMENT
/begin MEASUREMENT wkra_66_A "last und drehzahlabh. Adaptionskennfeld f. wkr" UBYTE zw_ub_qn0p75 1 100 -191.25 0 FUNCTION_LIST KRRA T2LID IF_DATA DIM_X 0x383055 EXTERN WORD IF_DATA MCMESS 0x383055 EXTERN /end MEASUREMENT
/begin MEASUREMENT wkra_67_A "last und drehzahlabh. Adaptionskennfeld f. wkr" UBYTE zw_ub_qn0p75 1 100 -191.25 0 FUNCTION_LIST KRRA T2LID IF_DATA DIM_X 0x383056 EXTERN WORD IF_DATA MCMESS 0x383056 EXTERN /end MEASUREMENT
/begin MEASUREMENT wkra_68_A "last und drehzahlabh. Adaptionskennfeld f. wkr" UBYTE zw_ub_qn0p75 1 100 -191.25 0 FUNCTION_LIST KRRA T2LID IF_DATA DIM_X 0x383057 EXTERN WORD IF_DATA MCMESS 0x383057 EXTERN /end MEASUREMENT
/begin MEASUREMENT wkra_69_A "last und drehzahlabh. Adaptionskennfeld f. wkr" UBYTE zw_ub_qn0p75 1 100 -191.25 0 FUNCTION_LIST KRRA T2LID IF_DATA DIM_X 0x383058 EXTERN WORD IF_DATA MCMESS 0x383058 EXTERN /end MEASUREMENT
/begin MEASUREMENT wkra_70_A "last und drehzahlabh. Adaptionskennfeld f. wkr" UBYTE zw_ub_qn0p75 1 100 -191.25 0 FUNCTION_LIST KRRA T2LID IF_DATA DIM_X 0x383059 EXTERN WORD IF_DATA MCMESS 0x383059 EXTERN /end MEASUREMENT
/begin MEASUREMENT wkra_71_A "last und drehzahlabh. Adaptionskennfeld f. wkr" UBYTE zw_ub_qn0p75 1 100 -191.25 0 FUNCTION_LIST KRRA T2LID IF_DATA DIM_X 0x38305A EXTERN WORD IF_DATA MCMESS 0x38305A EXTERN /end MEASUREMENT
/begin MEASUREMENT wkra_72_A "last und drehzahlabh. Adaptionskennfeld f. wkr" UBYTE zw_ub_qn0p75 1 100 -191.25 0 FUNCTION_LIST KRRA T2LID IF_DATA DIM_X 0x38305B EXTERN WORD IF_DATA MCMESS 0x38305B EXTERN /end MEASUREMENT
/begin MEASUREMENT wkra_73_A "last und drehzahlabh. Adaptionskennfeld f. wkr" UBYTE zw_ub_qn0p75 1 100 -191.25 0 FUNCTION_LIST KRRA T2LID IF_DATA DIM_X 0x38305C EXTERN WORD IF_DATA MCMESS 0x38305C EXTERN /end MEASUREMENT
/begin MEASUREMENT wkra_74_A "last und drehzahlabh. Adaptionskennfeld f. wkr" UBYTE zw_ub_qn0p75 1 100 -191.25 0 FUNCTION_LIST KRRA T2LID IF_DATA DIM_X 0x38305D EXTERN WORD IF_DATA MCMESS 0x38305D EXTERN /end MEASUREMENT
/begin MEASUREMENT wkra_75_A "last und drehzahlabh. Adaptionskennfeld f. wkr" UBYTE zw_ub_qn0p75 1 100 -191.25 0 FUNCTION_LIST KRRA T2LID IF_DATA DIM_X 0x38305E EXTERN WORD IF_DATA MCMESS 0x38305E EXTERN /end MEASUREMENT
/begin MEASUREMENT wkra_76_A "last und drehzahlabh. Adaptionskennfeld f. wkr" UBYTE zw_ub_qn0p75 1 100 -191.25 0 FUNCTION_LIST KRRA T2LID IF_DATA DIM_X 0x38305F EXTERN WORD IF_DATA MCMESS 0x38305F EXTERN /end MEASUREMENT
/begin MEASUREMENT wkra_77_A "last und drehzahlabh. Adaptionskennfeld f. wkr" UBYTE zw_ub_qn0p75 1 100 -191.25 0 FUNCTION_LIST KRRA T2LID IF_DATA DIM_X 0x383060 EXTERN WORD IF_DATA MCMESS 0x383060 EXTERN /end MEASUREMENT
/begin MEASUREMENT wkra_78_A "last und drehzahlabh. Adaptionskennfeld f. wkr" UBYTE zw_ub_qn0p75 1 100 -191.25 0 FUNCTION_LIST KRRA T2LID IF_DATA DIM_X 0x383061 EXTERN WORD IF_DATA MCMESS 0x383061 EXTERN /end MEASUREMENT
/begin MEASUREMENT wkra_79_A "last und drehzahlabh. Adaptionskennfeld f. wkr" UBYTE zw_ub_qn0p75 1 100 -191.25 0 FUNCTION_LIST KRRA T2LID IF_DATA DIM_X 0x383062 EXTERN WORD IF_DATA MCMESS 0x383062 EXTERN /end MEASUREMENT
/begin MEASUREMENT wkra_80_A "last und drehzahlabh. Adaptionskennfeld f. wkr" UBYTE zw_ub_qn0p75 1 100 -191.25 0 FUNCTION_LIST KRRA T2LID IF_DATA DIM_X 0x383063 EXTERN WORD IF_DATA MCMESS 0x383063 EXTERN /end MEASUREMENT
/begin MEASUREMENT wkra_81_A "last und drehzahlabh. Adaptionskennfeld f. wkr" UBYTE zw_ub_qn0p75 1 100 -191.25 0 FUNCTION_LIST KRRA T2LID IF_DATA DIM_X 0x383064 EXTERN WORD IF_DATA MCMESS 0x383064 EXTERN /end MEASUREMENT
/begin MEASUREMENT wkra_82_A "last und drehzahlabh. Adaptionskennfeld f. wkr" UBYTE zw_ub_qn0p75 1 100 -191.25 0 FUNCTION_LIST KRRA T2LID IF_DATA DIM_X 0x383065 EXTERN WORD IF_DATA MCMESS 0x383065 EXTERN /end MEASUREMENT
/begin MEASUREMENT wkra_83_A "last und drehzahlabh. Adaptionskennfeld f. wkr" UBYTE zw_ub_qn0p75 1 100 -191.25 0 FUNCTION_LIST KRRA T2LID IF_DATA DIM_X 0x383066 EXTERN WORD IF_DATA MCMESS 0x383066 EXTERN /end MEASUREMENT
/begin MEASUREMENT wkra_84_A "last und drehzahlabh. Adaptionskennfeld f. wkr" UBYTE zw_ub_qn0p75 1 100 -191.25 0 FUNCTION_LIST KRRA T2LID IF_DATA DIM_X 0x383067 EXTERN WORD IF_DATA MCMESS 0x383067 EXTERN /end MEASUREMENT
/begin MEASUREMENT wkra_85_A "last und drehzahlabh. Adaptionskennfeld f. wkr" UBYTE zw_ub_qn0p75 1 100 -191.25 0 FUNCTION_LIST KRRA T2LID IF_DATA DIM_X 0x383068 EXTERN WORD IF_DATA MCMESS 0x383068 EXTERN /end MEASUREMENT
/begin MEASUREMENT wkra_86_A "last und drehzahlabh. Adaptionskennfeld f. wkr" UBYTE zw_ub_qn0p75 1 100 -191.25 0 FUNCTION_LIST KRRA T2LID IF_DATA DIM_X 0x383069 EXTERN WORD IF_DATA MCMESS 0x383069 EXTERN /end MEASUREMENT
/begin MEASUREMENT wkra_87_A "last und drehzahlabh. Adaptionskennfeld f. wkr" UBYTE zw_ub_qn0p75 1 100 -191.25 0 FUNCTION_LIST KRRA T2LID IF_DATA DIM_X 0x38306A EXTERN WORD IF_DATA MCMESS 0x38306A EXTERN /end MEASUREMENT
/begin MEASUREMENT wkra_88_A "last und drehzahlabh. Adaptionskennfeld f. wkr" UBYTE zw_ub_qn0p75 1 100 -191.25 0 FUNCTION_LIST KRRA T2LID IF_DATA DIM_X 0x38306B EXTERN WORD IF_DATA MCMESS 0x38306B EXTERN /end MEASUREMENT
/begin MEASUREMENT wkra_89_A "last und drehzahlabh. Adaptionskennfeld f. wkr" UBYTE zw_ub_qn0p75 1 100 -191.25 0 FUNCTION_LIST KRRA T2LID IF_DATA DIM_X 0x38306C EXTERN WORD IF_DATA MCMESS 0x38306C EXTERN /end MEASUREMENT
/begin MEASUREMENT wkra_90_A "last und drehzahlabh. Adaptionskennfeld f. wkr" UBYTE zw_ub_qn0p75 1 100 -191.25 0 FUNCTION_LIST KRRA T2LID IF_DATA DIM_X 0x38306D EXTERN WORD IF_DATA MCMESS 0x38306D EXTERN /end MEASUREMENT
/begin MEASUREMENT wkra_91_A "last und drehzahlabh. Adaptionskennfeld f. wkr" UBYTE zw_ub_qn0p75 1 100 -191.25 0 FUNCTION_LIST KRRA T2LID IF_DATA DIM_X 0x38306E EXTERN WORD IF_DATA MCMESS 0x38306E EXTERN /end MEASUREMENT
/begin MEASUREMENT wkra_92_A "last und drehzahlabh. Adaptionskennfeld f. wkr" UBYTE zw_ub_qn0p75 1 100 -191.25 0 FUNCTION_LIST KRRA T2LID IF_DATA DIM_X 0x38306F EXTERN WORD IF_DATA MCMESS 0x38306F EXTERN /end MEASUREMENT
/begin MEASUREMENT wkra_93_A "last und drehzahlabh. Adaptionskennfeld f. wkr" UBYTE zw_ub_qn0p75 1 100 -191.25 0 FUNCTION_LIST KRRA T2LID IF_DATA DIM_X 0x383070 EXTERN WORD IF_DATA MCMESS 0x383070 EXTERN /end MEASUREMENT
/begin MEASUREMENT wkra_94_A "last und drehzahlabh. Adaptionskennfeld f. wkr" UBYTE zw_ub_qn0p75 1 100 -191.25 0 FUNCTION_LIST KRRA T2LID IF_DATA DIM_X 0x383071 EXTERN WORD IF_DATA MCMESS 0x383071 EXTERN /end MEASUREMENT
/begin MEASUREMENT wkra_95_A "last und drehzahlabh. Adaptionskennfeld f. wkr" UBYTE zw_ub_qn0p75 1 100 -191.25 0 FUNCTION_LIST KRRA T2LID IF_DATA DIM_X 0x383072 EXTERN WORD IF_DATA MCMESS 0x383072 EXTERN /end MEASUREMENT
/begin MEASUREMENT wkra_96_A "last und drehzahlabh. Adaptionskennfeld f. wkr" UBYTE zw_ub_qn0p75 1 100 -191.25 0 FUNCTION_LIST KRRA T2LID IF_DATA DIM_X 0x383073 EXTERN WORD IF_DATA MCMESS 0x383073 EXTERN /end MEASUREMENT
/begin MEASUREMENT wkra_97_A "last und drehzahlabh. Adaptionskennfeld f. wkr" UBYTE zw_ub_qn0p75 1 100 -191.25 0 FUNCTION_LIST KRRA T2LID IF_DATA DIM_X 0x383074 EXTERN WORD IF_DATA MCMESS 0x383074 EXTERN /end MEASUREMENT
/begin MEASUREMENT wkra_98_A "last und drehzahlabh. Adaptionskennfeld f. wkr" UBYTE zw_ub_qn0p75 1 100 -191.25 0 FUNCTION_LIST KRRA T2LID IF_DATA DIM_X 0x383075 EXTERN WORD IF_DATA MCMESS 0x383075 EXTERN /end MEASUREMENT
/begin MEASUREMENT wkra_99_A "last und drehzahlabh. Adaptionskennfeld f. wkr" UBYTE zw_ub_qn0p75 1 100 -191.25 0 FUNCTION_LIST KRRA T2LID IF_DATA DIM_X 0x383076 EXTERN WORD IF_DATA MCMESS 0x383076 EXTERN /end MEASUREMENT
/begin MEASUREMENT wkra_100_A "last und drehzahlabh. Adaptionskennfeld f. wkr" UBYTE zw_ub_qn0p75 1 100 -191.25 0 FUNCTION_LIST KRRA T2LID IF_DATA DIM_X 0x383077 EXTERN WORD IF_DATA MCMESS 0x383077 EXTERN /end MEASUREMENT
/begin MEASUREMENT wkra_101_A "last und drehzahlabh. Adaptionskennfeld f. wkr" UBYTE zw_ub_qn0p75 1 100 -191.25 0 FUNCTION_LIST KRRA T2LID IF_DATA DIM_X 0x383078 EXTERN WORD IF_DATA MCMESS 0x383078 EXTERN /end MEASUREMENT
/begin MEASUREMENT wkra_102_A "last und drehzahlabh. Adaptionskennfeld f. wkr" UBYTE zw_ub_qn0p75 1 100 -191.25 0 FUNCTION_LIST KRRA T2LID IF_DATA DIM_X 0x383079 EXTERN WORD IF_DATA MCMESS 0x383079 EXTERN /end MEASUREMENT
/begin MEASUREMENT wkra_103_A "last und drehzahlabh. Adaptionskennfeld f. wkr" UBYTE zw_ub_qn0p75 1 100 -191.25 0 FUNCTION_LIST KRRA T2LID IF_DATA DIM_X 0x38307A EXTERN WORD IF_DATA MCMESS 0x38307A EXTERN /end MEASUREMENT
/begin MEASUREMENT wkra_104_A "last und drehzahlabh. Adaptionskennfeld f. wkr" UBYTE zw_ub_qn0p75 1 100 -191.25 0 FUNCTION_LIST KRRA T2LID IF_DATA DIM_X 0x38307B EXTERN WORD IF_DATA MCMESS 0x38307B EXTERN /end MEASUREMENT
/begin MEASUREMENT wkra_105_A "last und drehzahlabh. Adaptionskennfeld f. wkr" UBYTE zw_ub_qn0p75 1 100 -191.25 0 FUNCTION_LIST KRRA T2LID IF_DATA DIM_X 0x38307C EXTERN WORD IF_DATA MCMESS 0x38307C EXTERN /end MEASUREMENT
/begin MEASUREMENT wkra_106_A "last und drehzahlabh. Adaptionskennfeld f. wkr" UBYTE zw_ub_qn0p75 1 100 -191.25 0 FUNCTION_LIST KRRA T2LID IF_DATA DIM_X 0x38307D EXTERN WORD IF_DATA MCMESS 0x38307D EXTERN /end MEASUREMENT
/begin MEASUREMENT wkra_107_A "last und drehzahlabh. Adaptionskennfeld f. wkr" UBYTE zw_ub_qn0p75 1 100 -191.25 0 FUNCTION_LIST KRRA T2LID IF_DATA DIM_X 0x38307E EXTERN WORD IF_DATA MCMESS 0x38307E EXTERN /end MEASUREMENT
/begin MEASUREMENT wkra_108_A "last und drehzahlabh. Adaptionskennfeld f. wkr" UBYTE zw_ub_qn0p75 1 100 -191.25 0 FUNCTION_LIST KRRA T2LID IF_DATA DIM_X 0x38307F EXTERN WORD IF_DATA MCMESS 0x38307F EXTERN /end MEASUREMENT
/begin MEASUREMENT wkra_109_A "last und drehzahlabh. Adaptionskennfeld f. wkr" UBYTE zw_ub_qn0p75 1 100 -191.25 0 FUNCTION_LIST KRRA T2LID IF_DATA DIM_X 0x383080 EXTERN WORD IF_DATA MCMESS 0x383080 EXTERN /end MEASUREMENT
/begin MEASUREMENT wkra_110_A "last und drehzahlabh. Adaptionskennfeld f. wkr" UBYTE zw_ub_qn0p75 1 100 -191.25 0 FUNCTION_LIST KRRA T2LID IF_DATA DIM_X 0x383081 EXTERN WORD IF_DATA MCMESS 0x383081 EXTERN /end MEASUREMENT
/begin MEASUREMENT wkra_111_A "last und drehzahlabh. Adaptionskennfeld f. wkr" UBYTE zw_ub_qn0p75 1 100 -191.25 0 FUNCTION_LIST KRRA T2LID IF_DATA DIM_X 0x383082 EXTERN WORD IF_DATA MCMESS 0x383082 EXTERN /end MEASUREMENT
/begin MEASUREMENT wkra_112_A "last und drehzahlabh. Adaptionskennfeld f. wkr" UBYTE zw_ub_qn0p75 1 100 -191.25 0 FUNCTION_LIST KRRA T2LID IF_DATA DIM_X 0x383083 EXTERN WORD IF_DATA MCMESS 0x383083 EXTERN /end MEASUREMENT
/begin MEASUREMENT wkra_113_A "last und drehzahlabh. Adaptionskennfeld f. wkr" UBYTE zw_ub_qn0p75 1 100 -191.25 0 FUNCTION_LIST KRRA T2LID IF_DATA DIM_X 0x383084 EXTERN WORD IF_DATA MCMESS 0x383084 EXTERN /end MEASUREMENT
/begin MEASUREMENT wkra_114_A "last und drehzahlabh. Adaptionskennfeld f. wkr" UBYTE zw_ub_qn0p75 1 100 -191.25 0 FUNCTION_LIST KRRA T2LID IF_DATA DIM_X 0x383085 EXTERN WORD IF_DATA MCMESS 0x383085 EXTERN /end MEASUREMENT
/begin MEASUREMENT wkra_115_A "last und drehzahlabh. Adaptionskennfeld f. wkr" UBYTE zw_ub_qn0p75 1 100 -191.25 0 FUNCTION_LIST KRRA T2LID IF_DATA DIM_X 0x383086 EXTERN WORD IF_DATA MCMESS 0x383086 EXTERN /end MEASUREMENT
/begin MEASUREMENT wkra_116_A "last und drehzahlabh. Adaptionskennfeld f. wkr" UBYTE zw_ub_qn0p75 1 100 -191.25 0 FUNCTION_LIST KRRA T2LID IF_DATA DIM_X 0x383087 EXTERN WORD IF_DATA MCMESS 0x383087 EXTERN /end MEASUREMENT
/begin MEASUREMENT wkra_117_A "last und drehzahlabh. Adaptionskennfeld f. wkr" UBYTE zw_ub_qn0p75 1 100 -191.25 0 FUNCTION_LIST KRRA T2LID IF_DATA DIM_X 0x383088 EXTERN WORD IF_DATA MCMESS 0x383088 EXTERN /end MEASUREMENT
/begin MEASUREMENT wkra_118_A "last und drehzahlabh. Adaptionskennfeld f. wkr" UBYTE zw_ub_qn0p75 1 100 -191.25 0 FUNCTION_LIST KRRA T2LID IF_DATA DIM_X 0x383089 EXTERN WORD IF_DATA MCMESS 0x383089 EXTERN /end MEASUREMENT
/begin MEASUREMENT wkra_119_A "last und drehzahlabh. Adaptionskennfeld f. wkr" UBYTE zw_ub_qn0p75 1 100 -191.25 0 FUNCTION_LIST KRRA T2LID IF_DATA DIM_X 0x38308A EXTERN WORD IF_DATA MCMESS 0x38308A EXTERN /end MEASUREMENT
/begin MEASUREMENT wkra_120_A "last und drehzahlabh. Adaptionskennfeld f. wkr" UBYTE zw_ub_qn0p75 1 100 -191.25 0 FUNCTION_LIST KRRA T2LID IF_DATA DIM_X 0x38308B EXTERN WORD IF_DATA MCMESS 0x38308B EXTERN /end MEASUREMENT
/begin MEASUREMENT wkra_121_A "last und drehzahlabh. Adaptionskennfeld f. wkr" UBYTE zw_ub_qn0p75 1 100 -191.25 0 FUNCTION_LIST KRRA T2LID IF_DATA DIM_X 0x38308C EXTERN WORD IF_DATA MCMESS 0x38308C EXTERN /end MEASUREMENT
/begin MEASUREMENT wkra_122_A "last und drehzahlabh. Adaptionskennfeld f. wkr" UBYTE zw_ub_qn0p75 1 100 -191.25 0 FUNCTION_LIST KRRA T2LID IF_DATA DIM_X 0x38308D EXTERN WORD IF_DATA MCMESS 0x38308D EXTERN /end MEASUREMENT
/begin MEASUREMENT wkra_123_A "last und drehzahlabh. Adaptionskennfeld f. wkr" UBYTE zw_ub_qn0p75 1 100 -191.25 0 FUNCTION_LIST KRRA T2LID IF_DATA DIM_X 0x38308E EXTERN WORD IF_DATA MCMESS 0x38308E EXTERN /end MEASUREMENT
/begin MEASUREMENT wkra_124_A "last und drehzahlabh. Adaptionskennfeld f. wkr" UBYTE zw_ub_qn0p75 1 100 -191.25 0 FUNCTION_LIST KRRA T2LID IF_DATA DIM_X 0x38308F EXTERN WORD IF_DATA MCMESS 0x38308F EXTERN /end MEASUREMENT
/begin MEASUREMENT wkra_125_A "last und drehzahlabh. Adaptionskennfeld f. wkr" UBYTE zw_ub_qn0p75 1 100 -191.25 0 FUNCTION_LIST KRRA T2LID IF_DATA DIM_X 0x383090 EXTERN WORD IF_DATA MCMESS 0x383090 EXTERN /end MEASUREMENT
/begin MEASUREMENT wkra_126_A "last und drehzahlabh. Adaptionskennfeld f. wkr" UBYTE zw_ub_qn0p75 1 100 -191.25 0 FUNCTION_LIST KRRA T2LID IF_DATA DIM_X 0x383091 EXTERN WORD IF_DATA MCMESS 0x383091 EXTERN /end MEASUREMENT
/begin MEASUREMENT wkra_127_A "last und drehzahlabh. Adaptionskennfeld f. wkr" UBYTE zw_ub_qn0p75 1 100 -191.25 0 FUNCTION_LIST KRRA T2LID IF_DATA DIM_X 0x383092 EXTERN WORD IF_DATA MCMESS 0x383092 EXTERN /end MEASUREMENT
/begin MEASUREMENT wkra_128_A "last und drehzahlabh. Adaptionskennfeld f. wkr" UBYTE zw_ub_qn0p75 1 100 -191.25 0 FUNCTION_LIST KRRA T2LID IF_DATA DIM_X 0x383093 EXTERN WORD IF_DATA MCMESS 0x383093 EXTERN /end MEASUREMENT
/begin MEASUREMENT wkra_129_A "last und drehzahlabh. Adaptionskennfeld f. wkr" UBYTE zw_ub_qn0p75 1 100 -191.25 0 FUNCTION_LIST KRRA T2LID IF_DATA DIM_X 0x383094 EXTERN WORD IF_DATA MCMESS 0x383094 EXTERN /end MEASUREMENT
/begin MEASUREMENT wkra_130_A "last und drehzahlabh. Adaptionskennfeld f. wkr" UBYTE zw_ub_qn0p75 1 100 -191.25 0 FUNCTION_LIST KRRA T2LID IF_DATA DIM_X 0x383095 EXTERN WORD IF_DATA MCMESS 0x383095 EXTERN /end MEASUREMENT
/begin MEASUREMENT wkra_131_A "last und drehzahlabh. Adaptionskennfeld f. wkr" UBYTE zw_ub_qn0p75 1 100 -191.25 0 FUNCTION_LIST KRRA T2LID IF_DATA DIM_X 0x383096 EXTERN WORD IF_DATA MCMESS 0x383096 EXTERN /end MEASUREMENT
/begin MEASUREMENT wkra_132_A "last und drehzahlabh. Adaptionskennfeld f. wkr" UBYTE zw_ub_qn0p75 1 100 -191.25 0 FUNCTION_LIST KRRA T2LID IF_DATA DIM_X 0x383097 EXTERN WORD IF_DATA MCMESS 0x383097 EXTERN /end MEASUREMENT
/begin MEASUREMENT wkra_133_A "last und drehzahlabh. Adaptionskennfeld f. wkr" UBYTE zw_ub_qn0p75 1 100 -191.25 0 FUNCTION_LIST KRRA T2LID IF_DATA DIM_X 0x383098 EXTERN WORD IF_DATA MCMESS 0x383098 EXTERN /end MEASUREMENT
/begin MEASUREMENT wkra_134_A "last und drehzahlabh. Adaptionskennfeld f. wkr" UBYTE zw_ub_qn0p75 1 100 -191.25 0 FUNCTION_LIST KRRA T2LID IF_DATA DIM_X 0x383099 EXTERN WORD IF_DATA MCMESS 0x383099 EXTERN /end MEASUREMENT
/begin MEASUREMENT wkra_135_A "last und drehzahlabh. Adaptionskennfeld f. wkr" UBYTE zw_ub_qn0p75 1 100 -191.25 0 FUNCTION_LIST KRRA T2LID IF_DATA DIM_X 0x38309A EXTERN WORD IF_DATA MCMESS 0x38309A EXTERN /end MEASUREMENT
/begin MEASUREMENT wkra_136_A "last und drehzahlabh. Adaptionskennfeld f. wkr" UBYTE zw_ub_qn0p75 1 100 -191.25 0 FUNCTION_LIST KRRA T2LID IF_DATA DIM_X 0x38309B EXTERN WORD IF_DATA MCMESS 0x38309B EXTERN /end MEASUREMENT
/begin MEASUREMENT wkra_137_A "last und drehzahlabh. Adaptionskennfeld f. wkr" UBYTE zw_ub_qn0p75 1 100 -191.25 0 FUNCTION_LIST KRRA T2LID IF_DATA DIM_X 0x38309C EXTERN WORD IF_DATA MCMESS 0x38309C EXTERN /end MEASUREMENT
/begin MEASUREMENT wkra_138_A "last und drehzahlabh. Adaptionskennfeld f. wkr" UBYTE zw_ub_qn0p75 1 100 -191.25 0 FUNCTION_LIST KRRA T2LID IF_DATA DIM_X 0x38309D EXTERN WORD IF_DATA MCMESS 0x38309D EXTERN /end MEASUREMENT
/begin MEASUREMENT wkra_139_A "last und drehzahlabh. Adaptionskennfeld f. wkr" UBYTE zw_ub_qn0p75 1 100 -191.25 0 FUNCTION_LIST KRRA T2LID IF_DATA DIM_X 0x38309E EXTERN WORD IF_DATA MCMESS 0x38309E EXTERN /end MEASUREMENT
/begin MEASUREMENT wkra_140_A "last und drehzahlabh. Adaptionskennfeld f. wkr" UBYTE zw_ub_qn0p75 1 100 -191.25 0 FUNCTION_LIST KRRA T2LID IF_DATA DIM_X 0x38309F EXTERN WORD IF_DATA MCMESS 0x38309F EXTERN /end MEASUREMENT
/begin MEASUREMENT wkra_141_A "last und drehzahlabh. Adaptionskennfeld f. wkr" UBYTE zw_ub_qn0p75 1 100 -191.25 0 FUNCTION_LIST KRRA T2LID IF_DATA DIM_X 0x3830A0 EXTERN WORD IF_DATA MCMESS 0x3830A0 EXTERN /end MEASUREMENT
/begin MEASUREMENT wkra_142_A "last und drehzahlabh. Adaptionskennfeld f. wkr" UBYTE zw_ub_qn0p75 1 100 -191.25 0 FUNCTION_LIST KRRA T2LID IF_DATA DIM_X 0x3830A1 EXTERN WORD IF_DATA MCMESS 0x3830A1 EXTERN /end MEASUREMENT
/begin MEASUREMENT wkra_143_A "last und drehzahlabh. Adaptionskennfeld f. wkr" UBYTE zw_ub_qn0p75 1 100 -191.25 0 FUNCTION_LIST KRRA T2LID IF_DATA DIM_X 0x3830A2 EXTERN WORD IF_DATA MCMESS 0x3830A2 EXTERN /end MEASUREMENT
/begin MEASUREMENT wkra_144_A "last und drehzahlabh. Adaptionskennfeld f. wkr" UBYTE zw_ub_qn0p75 1 100 -191.25 0 FUNCTION_LIST KRRA T2LID IF_DATA DIM_X 0x3830A3 EXTERN WORD IF_DATA MCMESS 0x3830A3 EXTERN /end MEASUREMENT
/begin MEASUREMENT wkra_145_A "last und drehzahlabh. Adaptionskennfeld f. wkr" UBYTE zw_ub_qn0p75 1 100 -191.25 0 FUNCTION_LIST KRRA T2LID IF_DATA DIM_X 0x3830A4 EXTERN WORD IF_DATA MCMESS 0x3830A4 EXTERN /end MEASUREMENT
/begin MEASUREMENT wkra_146_A "last und drehzahlabh. Adaptionskennfeld f. wkr" UBYTE zw_ub_qn0p75 1 100 -191.25 0 FUNCTION_LIST KRRA T2LID IF_DATA DIM_X 0x3830A5 EXTERN WORD IF_DATA MCMESS 0x3830A5 EXTERN /end MEASUREMENT
/begin MEASUREMENT wkra_147_A "last und drehzahlabh. Adaptionskennfeld f. wkr" UBYTE zw_ub_qn0p75 1 100 -191.25 0 FUNCTION_LIST KRRA T2LID IF_DATA DIM_X 0x3830A6 EXTERN WORD IF_DATA MCMESS 0x3830A6 EXTERN /end MEASUREMENT
/begin MEASUREMENT wkra_148_A "last und drehzahlabh. Adaptionskennfeld f. wkr" UBYTE zw_ub_qn0p75 1 100 -191.25 0 FUNCTION_LIST KRRA T2LID IF_DATA DIM_X 0x3830A7 EXTERN WORD IF_DATA MCMESS 0x3830A7 EXTERN /end MEASUREMENT
/begin MEASUREMENT wkra_149_A "last und drehzahlabh. Adaptionskennfeld f. wkr" UBYTE zw_ub_qn0p75 1 100 -191.25 0 FUNCTION_LIST KRRA T2LID IF_DATA DIM_X 0x3830A8 EXTERN WORD IF_DATA MCMESS 0x3830A8 EXTERN /end MEASUREMENT
/begin MEASUREMENT wkra_150_A "last und drehzahlabh. Adaptionskennfeld f. wkr" UBYTE zw_ub_qn0p75 1 100 -191.25 0 FUNCTION_LIST KRRA T2LID IF_DATA DIM_X 0x3830A9 EXTERN WORD IF_DATA MCMESS 0x3830A9 EXTERN /end MEASUREMENT
/begin MEASUREMENT wkra_151_A "last und drehzahlabh. Adaptionskennfeld f. wkr" UBYTE zw_ub_qn0p75 1 100 -191.25 0 FUNCTION_LIST KRRA T2LID IF_DATA DIM_X 0x3830AA EXTERN WORD IF_DATA MCMESS 0x3830AA EXTERN /end MEASUREMENT
/begin MEASUREMENT wkra_152_A "last und drehzahlabh. Adaptionskennfeld f. wkr" UBYTE zw_ub_qn0p75 1 100 -191.25 0 FUNCTION_LIST KRRA T2LID IF_DATA DIM_X 0x3830AB EXTERN WORD IF_DATA MCMESS 0x3830AB EXTERN /end MEASUREMENT
/begin MEASUREMENT wkra_153_A "last und drehzahlabh. Adaptionskennfeld f. wkr" UBYTE zw_ub_qn0p75 1 100 -191.25 0 FUNCTION_LIST KRRA T2LID IF_DATA DIM_X 0x3830AC EXTERN WORD IF_DATA MCMESS 0x3830AC EXTERN /end MEASUREMENT
/begin MEASUREMENT wkra_154_A "last und drehzahlabh. Adaptionskennfeld f. wkr" UBYTE zw_ub_qn0p75 1 100 -191.25 0 FUNCTION_LIST KRRA T2LID IF_DATA DIM_X 0x3830AD EXTERN WORD IF_DATA MCMESS 0x3830AD EXTERN /end MEASUREMENT
/begin MEASUREMENT wkra_155_A "last und drehzahlabh. Adaptionskennfeld f. wkr" UBYTE zw_ub_qn0p75 1 100 -191.25 0 FUNCTION_LIST KRRA T2LID IF_DATA DIM_X 0x3830AE EXTERN WORD IF_DATA MCMESS 0x3830AE EXTERN /end MEASUREMENT
/begin MEASUREMENT wkra_156_A "last und drehzahlabh. Adaptionskennfeld f. wkr" UBYTE zw_ub_qn0p75 1 100 -191.25 0 FUNCTION_LIST KRRA T2LID IF_DATA DIM_X 0x3830AF EXTERN WORD IF_DATA MCMESS 0x3830AF EXTERN /end MEASUREMENT
/begin MEASUREMENT wkra_157_A "last und drehzahlabh. Adaptionskennfeld f. wkr" UBYTE zw_ub_qn0p75 1 100 -191.25 0 FUNCTION_LIST KRRA T2LID IF_DATA DIM_X 0x3830B0 EXTERN WORD IF_DATA MCMESS 0x3830B0 EXTERN /end MEASUREMENT
/begin MEASUREMENT wkra_158_A "last und drehzahlabh. Adaptionskennfeld f. wkr" UBYTE zw_ub_qn0p75 1 100 -191.25 0 FUNCTION_LIST KRRA T2LID IF_DATA DIM_X 0x3830B1 EXTERN WORD IF_DATA MCMESS 0x3830B1 EXTERN /end MEASUREMENT
/begin MEASUREMENT wkra_159_A "last und drehzahlabh. Adaptionskennfeld f. wkr" UBYTE zw_ub_qn0p75 1 100 -191.25 0 FUNCTION_LIST KRRA T2LID IF_DATA DIM_X 0x3830B2 EXTERN WORD IF_DATA MCMESS 0x3830B2 EXTERN /end MEASUREMENT
/begin MEASUREMENT wkratst "wkra mit Synchro-Raster rollierend" UBYTE zw_ub_qn0p75 1 100 -191.25 0 FUNCTION_LIST KRRA IF_DATA DIM_X 0x380BE5 EXTERN WORD IF_DATA MCMESS 0x380BE5 EXTERN /end MEASUREMENT
/begin MEASUREMENT wkrdy "Zündwinkelspätverstellung bei KR-Dynamik" UBYTE zw_ub_qn0p75 1 100 -191.25 0 FUNCTION_LIST KRDY KRRA IF_DATA DIM_X 0xFAEA INTERN WORD IF_DATA MCMESS 0xFAEA INTERN /end MEASUREMENT
/begin MEASUREMENT wkrdya_0_A "adaptierter Zündwinkel bei KR-Dynamik" UBYTE zw_ub_qn0p75 1 100 -191.25 0 FUNCTION_LIST KRDY IF_DATA DIM_X 0x38300E EXTERN WORD IF_DATA MCMESS 0x38300E EXTERN /end MEASUREMENT
/begin MEASUREMENT wkrdya_1_A "adaptierter Zündwinkel bei KR-Dynamik" UBYTE zw_ub_qn0p75 1 100 -191.25 0 FUNCTION_LIST KRDY IF_DATA DIM_X 0x38300F EXTERN WORD IF_DATA MCMESS 0x38300F EXTERN /end MEASUREMENT
/begin MEASUREMENT wkrdya_2_A "adaptierter Zündwinkel bei KR-Dynamik" UBYTE zw_ub_qn0p75 1 100 -191.25 0 FUNCTION_LIST KRDY IF_DATA DIM_X 0x383010 EXTERN WORD IF_DATA MCMESS 0x383010 EXTERN /end MEASUREMENT
/begin MEASUREMENT wkrdya_3_A "adaptierter Zündwinkel bei KR-Dynamik" UBYTE zw_ub_qn0p75 1 100 -191.25 0 FUNCTION_LIST KRDY IF_DATA DIM_X 0x383011 EXTERN WORD IF_DATA MCMESS 0x383011 EXTERN /end MEASUREMENT
/begin MEASUREMENT wkrdya_4_A "adaptierter Zündwinkel bei KR-Dynamik" UBYTE zw_ub_qn0p75 1 100 -191.25 0 FUNCTION_LIST KRDY IF_DATA DIM_X 0x383012 EXTERN WORD IF_DATA MCMESS 0x383012 EXTERN /end MEASUREMENT
/begin MEASUREMENT wkrm "Mittelwert der zylinderindividuellen ZW-Spätverstellungen durch KR" UBYTE zw_ub_qn0p75 1 100 -191.25 0 FUNCTION_LIST KRRA IF_DATA DIM_X 0xFAFC INTERN WORD IF_DATA MCMESS 0xFAFC INTERN /end MEASUREMENT
/begin MEASUREMENT wkrma "Mittelwert der ZW-Spätverstellungen KR, allgemein (im Notlauf mit Sicherheit)" UBYTE zw_ub_qn0p75 1 100 -191.25 0 FUNCTION_LIST KRRA LDRLMX IF_DATA DIM_X 0xFAFD INTERN WORD IF_DATA MCMESS 0xFAFD INTERN /end MEASUREMENT
/begin MEASUREMENT wkrmdy "Dynamischer Mittelwert der zylinderindividuellen ZW Spätverstellungen" UBYTE zw_ub_q0p75 1 100 0 191.25 FUNCTION_LIST LDRLMX SSTBER87 IF_DATA DIM_X 0x380BF8 EXTERN WORD IF_DATA MCMESS 0x380BF8 EXTERN /end MEASUREMENT
/begin MEASUREMENT wkrmstat "Quasistationärer Mittelwert der zylinderindividuellen ZW Spätverstellwerte" UBYTE zw_ub_q0p75 1 100 0 191.25 FUNCTION_LIST LDRLMX SSTBER87 IF_DATA DIM_X 0x380BF9 EXTERN WORD IF_DATA MCMESS 0x380BF9 EXTERN /end MEASUREMENT
/begin MEASUREMENT wkrmsu "Summenwert aus dynamischem und statischem Mittelwert der KR Verstellwinkel" UBYTE zw_ub_q0p75 1 100 0 191.25 FUNCTION_LIST LDRLMX SSTBER87 IF_DATA DIM_X 0x380BFA EXTERN WORD IF_DATA MCMESS 0x380BFA EXTERN /end MEASUREMENT
/begin MEASUREMENT wkr_tst "zyl.ind. ZW-Spätverstellung, rollierend" UBYTE zw_ub_qn0p75 1 100 -191.25 0 FUNCTION_LIST KRRA IF_DATA DIM_X 0x380BE6 EXTERN WORD IF_DATA MCMESS 0x380BE6 EXTERN /end MEASUREMENT
/begin MEASUREMENT wkw0rale_w "Winkel Kurbelwelle am Nullpunkt des Arbeitsspieles bei 1. rückdrehendem Zahn" UWORD kw_q6 1 100 0 393210 FUNCTION_LIST ALE IF_DATA DIM_X 0x381B16 EXTERN WORD IF_DATA MCMESS 0x381B16 EXTERN /end MEASUREMENT
/begin MEASUREMENT wkwas_kor "Kurbelwinkel im Arbeitsspiel mit Lückenkorrektur" UBYTE kw_q6 1 100 0 1530 FUNCTION_LIST ALE IF_DATA DIM_X 0x380A1A EXTERN WORD IF_DATA MCMESS 0x380A1A EXTERN /end MEASUREMENT
/begin MEASUREMENT wkwbzm0_w "Winkel Kurbelwelle am Nullpunkt des Arbeitsspiels: R_syn & zzyl = 0 (word)" UWORD kw_q6 1 100 0 393210 FUNCTION_LIST GGDPG ALE AZUE IF_DATA DIM_X 0xF9DC INTERN WORD IF_DATA MCMESS 0xF9DC INTERN /end MEASUREMENT
/begin MEASUREMENT wkwneg_w "Winkel Kurbelwelle bei negativer Phasenflanke im Schnellstart" UWORD kw_q6 1 100 0 393210 FUNCTION_LIST GGDPG IF_DATA DIM_X 0xF9DE INTERN WORD IF_DATA MCMESS 0xF9DE INTERN /end MEASUREMENT
/begin MEASUREMENT wkwpos_w "Winkel Kurbelwelle bei positiver Phasenflanke im Schnellstart" UWORD kw_q6 1 100 0 393210 FUNCTION_LIST GGDPG IF_DATA DIM_X 0xF9E0 INTERN WORD IF_DATA MCMESS 0xF9E0 INTERN /end MEASUREMENT
/begin MEASUREMENT wkwrale_w "Winkel Kurbelwelle beim ersten rückdrehenden Zahn (word)" UWORD kw_q6 1 100 0 393210 FUNCTION_LIST ALE IF_DATA DIM_X 0x381B18 EXTERN WORD IF_DATA MCMESS 0x381B18 EXTERN /end MEASUREMENT
/begin MEASUREMENT wkwstart_w "Winkel Kurbelwelle beim Überschreiten von NMIN im Schnellstart" UWORD kw_q6 1 100 0 393210 FUNCTION_LIST GGDPG IF_DATA DIM_X 0xF9E2 INTERN WORD IF_DATA MCMESS 0xF9E2 INTERN /end MEASUREMENT
/begin MEASUREMENT wkwstop "Motorabstellposition im Arbeitsspiel" UBYTE kw_q6 1 100 0 1530 FUNCTION_LIST ALE GGDPG IF_DATA DIM_X 0x382FD9 EXTERN WORD IF_DATA MCMESS 0x382FD9 EXTERN /end MEASUREMENT
/begin MEASUREMENT wkwsyn_w "Winkel Kurbelwelle am Beginn des Synchros (word)" UWORD kw_q6 1 100 0 393210 FUNCTION_LIST GGDPG IF_DATA DIM_X 0xFB34 INTERN WORD IF_DATA MCMESS 0xFB34 INTERN /end MEASUREMENT
/begin MEASUREMENT wkw_w "Winkel Kurbelwelle (word)" UWORD kw_q6 1 100 0 393210 FUNCTION_LIST GGDPG ALE DDG IF_DATA DIM_X 0xFE50 INTERN WORD IF_DATA MCMESS 0xFE50 INTERN /end MEASUREMENT
/begin MEASUREMENT wkzst_c "Wandlerkupplungs  über CAN" UBYTE dez 1 100 0 255 FUNCTION_LIST CAN WK IF_DATA DIM_X 0x38096C EXTERN WORD IF_DATA MCMESS 0x38096C EXTERN /end MEASUREMENT
/begin MEASUREMENT wmfa "Meßfensteranfang in Grad Kurbelwinkel" UBYTE zw_ub_q0p75 1 100 0 191.25 FUNCTION_LIST GGKS IF_DATA DIM_X 0x380B96 EXTERN WORD IF_DATA MCMESS 0x380B96 EXTERN /end MEASUREMENT
/begin MEASUREMENT wmfl "Meßfensterlänge in Grad Kurbelwinkel" UBYTE zw_ub_q0p75 1 100 0 191.25 FUNCTION_LIST GGKS IF_DATA DIM_X 0x380B97 EXTERN WORD IF_DATA MCMESS 0x380B97 EXTERN /end MEASUREMENT
/begin MEASUREMENT wnwi2_ad_w "Winkeldifferenz zwischen adaptierter und aktueller 2. Phasenflanke (word)" SWORD kw_sw_b128 1 100 -128 127.996 FUNCTION_LIST WANWKW NLDG IF_DATA DIM_X 0x381BB2 EXTERN WORD IF_DATA MCMESS 0x381BB2 EXTERN /end MEASUREMENT
/begin MEASUREMENT wnwi2_u "Istwinkel für Nockenwelle 2 (Byte)" SBYTE kw_sb_q1 1 100 -128 127 FUNCTION_LIST DFFTCNV DFFTK IF_DATA DIM_X 0x380A0C EXTERN WORD IF_DATA MCMESS 0x380A0C EXTERN /end MEASUREMENT
/begin MEASUREMENT wnwi2_w "Istwinkel für Nockenwelle 2 (word)" SWORD kw_sw_b128 1 100 -128 127.996 FUNCTION_LIST SWADP DFFTCNV DNWS NWS T2LID IF_DATA DIM_X 0x382B26 EXTERN WORD IF_DATA MCMESS 0x382B26 EXTERN /end MEASUREMENT
/begin MEASUREMENT wnwia_w "Auswahl zwischen wnwi_w und wnwi2_w" SWORD kw_q0p0039 1 100 -128 127.996 FUNCTION_LIST NWS IF_DATA DIM_X 0x3821C8 EXTERN WORD IF_DATA MCMESS 0x3821C8 EXTERN /end MEASUREMENT
/begin MEASUREMENT wnwim2_w "Mittelwert Abweichung Adaption Nocken-/Kurbelwelle 2" UWORD kw_q0p0039 1 100 0 255.996 FUNCTION_LIST WANWKW IF_DATA DIM_X 0x383968 EXTERN WORD IF_DATA MCMESS 0x383968 EXTERN /end MEASUREMENT
/begin MEASUREMENT wnwim_w "Mittelwert Abweichung Adaption Nocken-/Kurbelwelle" UWORD kw_q0p0039 1 100 0 255.996 FUNCTION_LIST WANWKW IF_DATA DIM_X 0x38396A EXTERN WORD IF_DATA MCMESS 0x38396A EXTERN /end MEASUREMENT
/begin MEASUREMENT wnwix_w "Winkelfehler der berechneten Winkelbasis an der negativen Phasenflanke" SWORD kw_sw_b128 1 100 -128 127.996 FUNCTION_LIST NLDG IF_DATA DIM_X 0x381B82 EXTERN WORD IF_DATA MCMESS 0x381B82 EXTERN /end MEASUREMENT
/begin MEASUREMENT wnwi_ad_w "Winkeldifferenz zwischen adaptierter und aktueller Phasenflanke (word)" SWORD kw_sw_b128 1 100 -128 127.996 FUNCTION_LIST WANWKW NLDG IF_DATA DIM_X 0x381BB4 EXTERN WORD IF_DATA MCMESS 0x381BB4 EXTERN /end MEASUREMENT
/begin MEASUREMENT wnwi_u "Istwinkel für Nockenwelle (Byte)" SBYTE kw_sb_q1 1 100 -128 127 FUNCTION_LIST DFFTCNV DFFTK IF_DATA DIM_X 0x380A0D EXTERN WORD IF_DATA MCMESS 0x380A0D EXTERN /end MEASUREMENT
/begin MEASUREMENT wnwi_w "Istwinkel für Nockenwelle (word)" SWORD kw_sw_b128 1 100 -128 127.996 FUNCTION_LIST SWADP DFFTCNV DNWS ESVW NWS T2LID IF_DATA DIM_X 0x382B28 EXTERN WORD IF_DATA MCMESS 0x382B28 EXTERN /end MEASUREMENT
/begin MEASUREMENT wnwkwas2_w "Winkel Nockenwelle 2 zur Kurbelwelle im Arbeitsspiel" UWORD kw_q0p0156 1 100 0 1023.98 FUNCTION_LIST WANWKW NLDG IF_DATA DIM_X 0x381BB6 EXTERN WORD IF_DATA MCMESS 0x381BB6 EXTERN /end MEASUREMENT
/begin MEASUREMENT wnwkwasx_w "Berechnete Winkelbasis zum Zeitpunkt der negativen Phasenflanke" UWORD kw_q0p0156 1 100 0 1023.98 FUNCTION_LIST NLDG IF_DATA DIM_X 0x381B84 EXTERN WORD IF_DATA MCMESS 0x381B84 EXTERN /end MEASUREMENT
/begin MEASUREMENT wnwkwas_w "Winkel Nockenwelle zur Kurbelwelle im Arbeitsspiel" UWORD kw_q0p0156 1 100 0 1023.98 FUNCTION_LIST WANWKW NLDG IF_DATA DIM_X 0x381BB8 EXTERN WORD IF_DATA MCMESS 0x381BB8 EXTERN /end MEASUREMENT
/begin MEASUREMENT wnwsp2_u "Adaptionswinkel Nockenwelle 2 [Spätanschlag] (Umwelt)" UBYTE kw_q2 1 100 0 510 FUNCTION_LIST DFFTCNV DFFTK IF_DATA DIM_X 0x380A0E EXTERN WORD IF_DATA MCMESS 0x380A0E EXTERN /end MEASUREMENT
/begin MEASUREMENT wnwsp2_w_0__A "Adaptionswinkel Nockenwelle 2 (Spätanschlag)" UWORD kw_q0p0156 1 100 0 1023.98 FUNCTION_LIST WANWKW DFFTCNV DNWKW GGDPG T2LID IF_DATA DIM_X 0x38396C EXTERN WORD IF_DATA MCMESS 0x38396C EXTERN /end MEASUREMENT
/begin MEASUREMENT wnwsp2_w_1__A "Adaptionswinkel Nockenwelle 2 (Spätanschlag)" UWORD kw_q0p0156 1 100 0 1023.98 FUNCTION_LIST WANWKW DFFTCNV DNWKW GGDPG T2LID IF_DATA DIM_X 0x38396E EXTERN WORD IF_DATA MCMESS 0x38396E EXTERN /end MEASUREMENT
/begin MEASUREMENT wnwsp2_w_2__A "Adaptionswinkel Nockenwelle 2 (Spätanschlag)" UWORD kw_q0p0156 1 100 0 1023.98 FUNCTION_LIST WANWKW DFFTCNV DNWKW GGDPG T2LID IF_DATA DIM_X 0x383970 EXTERN WORD IF_DATA MCMESS 0x383970 EXTERN /end MEASUREMENT
/begin MEASUREMENT wnwsp2_w_3__A "Adaptionswinkel Nockenwelle 2 (Spätanschlag)" UWORD kw_q0p0156 1 100 0 1023.98 FUNCTION_LIST WANWKW DFFTCNV DNWKW GGDPG T2LID IF_DATA DIM_X 0x383972 EXTERN WORD IF_DATA MCMESS 0x383972 EXTERN /end MEASUREMENT
/begin MEASUREMENT wnwspas2_w "Adaptionswinkel der Nockenwellenflanken 2 im Arbeitsspiel (Referenzposition)" UWORD kw_q0p0156 1 100 0 1023.98 FUNCTION_LIST WANWKW NLDG IF_DATA DIM_X 0x381BBA EXTERN WORD IF_DATA MCMESS 0x381BBA EXTERN /end MEASUREMENT
/begin MEASUREMENT wnwspasx_w "Adaptierter Wert der aktuellen Phasenflanke" UWORD kw_q0p0156 1 100 0 1023.98 FUNCTION_LIST NLDG IF_DATA DIM_X 0x381B86 EXTERN WORD IF_DATA MCMESS 0x381B86 EXTERN /end MEASUREMENT
/begin MEASUREMENT wnwspas_w "Adaptionswinkel der Nockenwellenflanken im Arbeitsspiel (Referenzposition)" UWORD kw_q0p0156 1 100 0 1023.98 FUNCTION_LIST WANWKW NLDG IF_DATA DIM_X 0x381BBC EXTERN WORD IF_DATA MCMESS 0x381BBC EXTERN /end MEASUREMENT
/begin MEASUREMENT wnwsp_u "Adaptionswinkel Nockenwelle [Spätanschlag] (Umwelt)" UBYTE kw_q2 1 100 0 510 FUNCTION_LIST DFFTCNV DFFTK IF_DATA DIM_X 0x380A0F EXTERN WORD IF_DATA MCMESS 0x380A0F EXTERN /end MEASUREMENT
/begin MEASUREMENT wnwsp_w_0__A "Adaptionswinkel Nockenwelle (Spätanschlag)" UWORD kw_q0p0156 1 100 0 1023.98 FUNCTION_LIST WANWKW DFFTCNV DNWKW GGDPG T2LID IF_DATA DIM_X 0x383974 EXTERN WORD IF_DATA MCMESS 0x383974 EXTERN /end MEASUREMENT
/begin MEASUREMENT wnwsp_w_1__A "Adaptionswinkel Nockenwelle (Spätanschlag)" UWORD kw_q0p0156 1 100 0 1023.98 FUNCTION_LIST WANWKW DFFTCNV DNWKW GGDPG T2LID IF_DATA DIM_X 0x383976 EXTERN WORD IF_DATA MCMESS 0x383976 EXTERN /end MEASUREMENT
/begin MEASUREMENT wnwsp_w_2__A "Adaptionswinkel Nockenwelle (Spätanschlag)" UWORD kw_q0p0156 1 100 0 1023.98 FUNCTION_LIST WANWKW DFFTCNV DNWKW GGDPG T2LID IF_DATA DIM_X 0x383978 EXTERN WORD IF_DATA MCMESS 0x383978 EXTERN /end MEASUREMENT
/begin MEASUREMENT wnwsp_w_3__A "Adaptionswinkel Nockenwelle (Spätanschlag)" UWORD kw_q0p0156 1 100 0 1023.98 FUNCTION_LIST WANWKW DFFTCNV DNWKW GGDPG T2LID IF_DATA DIM_X 0x38397A EXTERN WORD IF_DATA MCMESS 0x38397A EXTERN /end MEASUREMENT
/begin MEASUREMENT wnwue "Winkel Nockenwellenueberschneidung" UBYTE kw_ub_q0p5 1 100 0 127.5 FUNCTION_LIST NWS GGHFM IF_DATA DIM_X 0x380B05 EXTERN WORD IF_DATA MCMESS 0x380B05 EXTERN /end MEASUREMENT
/begin MEASUREMENT wnwue_w "Winkel Nockenwellenueberschneidung" UWORD kw_q0p0019 1 100 0 127.998 FUNCTION_LIST NWS BGSRM IF_DATA DIM_X 0x3821CA EXTERN WORD IF_DATA MCMESS 0x3821CA EXTERN /end MEASUREMENT
/begin MEASUREMENT wouta_0_A "ausgegebener Zündwinkel bei Doppelzündung: erster Zündkreis" UBYTE zw_ub_q0p75 1 100 0 191.25 FUNCTION_LIST AZUE IF_DATA DIM_X 0xF8EC INTERN WORD IF_DATA MCMESS 0xF8EC INTERN /end MEASUREMENT
/begin MEASUREMENT wouta_1_A "ausgegebener Zündwinkel bei Doppelzündung: erster Zündkreis" UBYTE zw_ub_q0p75 1 100 0 191.25 FUNCTION_LIST AZUE IF_DATA DIM_X 0xF8ED INTERN WORD IF_DATA MCMESS 0xF8ED INTERN /end MEASUREMENT
/begin MEASUREMENT wouta_2_A "ausgegebener Zündwinkel bei Doppelzündung: erster Zündkreis" UBYTE zw_ub_q0p75 1 100 0 191.25 FUNCTION_LIST AZUE IF_DATA DIM_X 0xF8EE INTERN WORD IF_DATA MCMESS 0xF8EE INTERN /end MEASUREMENT
/begin MEASUREMENT wouta_3_A "ausgegebener Zündwinkel bei Doppelzündung: erster Zündkreis" UBYTE zw_ub_q0p75 1 100 0 191.25 FUNCTION_LIST AZUE IF_DATA DIM_X 0xF8EF INTERN WORD IF_DATA MCMESS 0xF8EF INTERN /end MEASUREMENT
/begin MEASUREMENT woutst_0_A "Zündwinkelpuffer bei Überlappung" UBYTE zw_ub_q0p75 1 100 0 191.25 FUNCTION_LIST AZUE IF_DATA DIM_X 0xF8F0 INTERN WORD IF_DATA MCMESS 0xF8F0 INTERN /end MEASUREMENT
/begin MEASUREMENT woutst_1_A "Zündwinkelpuffer bei Überlappung" UBYTE zw_ub_q0p75 1 100 0 191.25 FUNCTION_LIST AZUE IF_DATA DIM_X 0xF8F1 INTERN WORD IF_DATA MCMESS 0xF8F1 INTERN /end MEASUREMENT
/begin MEASUREMENT woutst_2_A "Zündwinkelpuffer bei Überlappung" UBYTE zw_ub_q0p75 1 100 0 191.25 FUNCTION_LIST AZUE IF_DATA DIM_X 0xF8F2 INTERN WORD IF_DATA MCMESS 0xF8F2 INTERN /end MEASUREMENT
/begin MEASUREMENT woutst_3_A "Zündwinkelpuffer bei Überlappung" UBYTE zw_ub_q0p75 1 100 0 191.25 FUNCTION_LIST AZUE IF_DATA DIM_X 0xF8F3 INTERN WORD IF_DATA MCMESS 0xF8F3 INTERN /end MEASUREMENT
/begin MEASUREMENT wped "Normierter Fahrpedalwinkel" UBYTE relPED_ub_b100 1 100 0 100 FUNCTION_LIST GGPED ADVE BGDVE CAN DFFT LDOB LDTVMA MDZUL NMAXMD RUNTIME SSTBER87 T2DVE IF_DATA DIM_X 0x380AC3 EXTERN WORD IF_DATA MCMESS 0x380AC3 EXTERN /end MEASUREMENT
/begin MEASUREMENT wpedv_w "Normierter Fahrpedalwinkel vor Berücksichtigung der Begrenzungen im Notfahren" UWORD relPED_uw_b100 1 100 0 100 FUNCTION_LIST GGPED IF_DATA DIM_X 0x381EC6 EXTERN WORD IF_DATA MCMESS 0x381EC6 EXTERN /end MEASUREMENT
/begin MEASUREMENT wped_can "Vitueller Pedalwert auf dem CAN" UBYTE rel_ub_b99p6 1 100 0 99.6094 FUNCTION_LIST CAN IF_DATA DIM_X 0x38096D EXTERN WORD IF_DATA MCMESS 0x38096D EXTERN /end MEASUREMENT
/begin MEASUREMENT wped_w "Normierter Fahrpedalwinkel" UWORD relPED_uw_b100 1 100 0 100 FUNCTION_LIST GGPED CAN FUEDK MDBGV MDFAW MDFUE T2LID IF_DATA DIM_X 0x381EC8 EXTERN WORD IF_DATA MCMESS 0x381EC8 EXTERN /end MEASUREMENT
/begin MEASUREMENT wpfgr_w "Rückgerechneter Pedalwert bei FGR-Betrieb" UWORD rel_uw_b100 1 100 0 99.9985 FUNCTION_LIST MDFAW CAN IF_DATA DIM_X 0x382666 EXTERN WORD IF_DATA MCMESS 0x382666 EXTERN /end MEASUREMENT
/begin MEASUREMENT wphg "Zündwinkel DG-Phasenkorrektur" SBYTE zw_sb_q0p75 1 100 -96 95.25 FUNCTION_LIST ZUE IF_DATA DIM_X 0x380D07 EXTERN WORD IF_DATA MCMESS 0x380D07 EXTERN /end MEASUREMENT
/begin MEASUREMENT wpr "Einspritzberechnungs-Praediktions-Winkel" UBYTE zw_ub_q6 1 100 0 1530 FUNCTION_LIST BGRLP IF_DATA DIM_X 0x380B18 EXTERN WORD IF_DATA MCMESS 0x380B18 EXTERN /end MEASUREMENT
/begin MEASUREMENT wprnsp "Einspritzberechnungs-Praediktions-Winkel bei Nachspritzer" UBYTE zw_ub_q6 1 100 0 1530 FUNCTION_LIST BGRLP IF_DATA DIM_X 0x380B19 EXTERN WORD IF_DATA MCMESS 0x380B19 EXTERN /end MEASUREMENT
/begin MEASUREMENT wri_c_um "Fehlerzähler im Dauer-RAM für RAM-Beschreibbarkeits-Prüfung (Diagnose) in der FU" UBYTE dez 1 100 0 255 FUNCTION_LIST UFURAM IF_DATA DIM_X 0x3830C3 EXTERN WORD IF_DATA MCMESS 0x3830C3 EXTERN /end MEASUREMENT
/begin MEASUREMENT wtans "A/D-Wert für tans" UBYTE spg_ub_b5 1 100 0 4.98047 FUNCTION_LIST ADC GGTFA T2LID VHW IF_DATA DIM_X 0x380953 EXTERN WORD IF_DATA MCMESS 0x380953 EXTERN /end MEASUREMENT
/begin MEASUREMENT wtget "A/D-Wert für Getriebetemperatur" UBYTE spg_ub_b5 1 100 0 4.98047 FUNCTION_LIST ADC GGTGET VHW IF_DATA DIM_X 0x380954 EXTERN WORD IF_DATA MCMESS 0x380954 EXTERN /end MEASUREMENT
/begin MEASUREMENT wtmot "A/D-Wert für tmot" UBYTE spg_ub_b5 1 100 0 4.98047 FUNCTION_LIST ADC T2LID VHW IF_DATA DIM_X 0x380955 EXTERN WORD IF_DATA MCMESS 0x380955 EXTERN /end MEASUREMENT
/begin MEASUREMENT wtmot_w "A/D-Wert für tmot 10 bit" UWORD spg_q0p00488 1 100 0 319.995 FUNCTION_LIST ADC GGTFM VHW IF_DATA DIM_X 0x380F62 EXTERN WORD IF_DATA MCMESS 0x380F62 EXTERN /end MEASUREMENT
/begin MEASUREMENT wtmr "A/D-Wert für tmr" UBYTE spg_ub_b5 1 100 0 4.98047 FUNCTION_LIST ADC GGTFMR T2LID VHW IF_DATA DIM_X 0x380956 EXTERN WORD IF_DATA MCMESS 0x380956 EXTERN /end MEASUREMENT
/begin MEASUREMENT wtol "A/D-Wert für (Motor-) Oeltemperatur" UBYTE spg_ub_b5 1 100 0 4.98047 FUNCTION_LIST ADC GGTFOL T2LID VHW IF_DATA DIM_X 0x380957 EXTERN WORD IF_DATA MCMESS 0x380957 EXTERN /end MEASUREMENT
/begin MEASUREMENT wtsg "Wert Temperatur Steuergerät" UBYTE dez 1 100 0 255 FUNCTION_LIST ADC VHW IF_DATA DIM_X 0x380958 EXTERN WORD IF_DATA MCMESS 0x380958 EXTERN /end MEASUREMENT
/begin MEASUREMENT wub "Batteriespannung; vom AD-Wandler erfaßter Wert" UBYTE spg_ubatt 1 100 0 19.38 FUNCTION_LIST ADC DFFTK GGUB GGZDGON T2LID VHW IF_DATA DIM_X 0x380959 EXTERN WORD IF_DATA MCMESS 0x380959 EXTERN /end MEASUREMENT
/begin MEASUREMENT wub_w "Batteriespannung; vom AD-Wandler erfaßter Wert (16Bit aus 10Bit-Erfassung)" UWORD spg_ubatt_w 1 100 0 1245.17 FUNCTION_LIST ADC VHW IF_DATA DIM_X 0x380F64 EXTERN WORD IF_DATA MCMESS 0x380F64 EXTERN /end MEASUREMENT
/begin MEASUREMENT wuccnt "Warm-up cycle - counter" UBYTE dez 1 100 0 255 FUNCTION_LIST DWUC T2LID IF_DATA DIM_X 0x382FD7 EXTERN WORD IF_DATA MCMESS 0x382FD7 EXTERN /end MEASUREMENT
/begin MEASUREMENT xkopwmr "" SBYTE default 1 100 -128 127 FUNCTION_LIST KOLS IF_DATA DIM_X 0x380D24 EXTERN WORD IF_DATA MCMESS 0x380D24 EXTERN /end MEASUREMENT
/begin MEASUREMENT xqtm_w "Temperaturquotient" UWORD fak_uw_b16 1 100 0 15.9998 FUNCTION_LIST BGTABS IF_DATA DIM_X 0x382220 EXTERN WORD IF_DATA MCMESS 0x382220 EXTERN /end MEASUREMENT
/begin MEASUREMENT xs02 "Segmentabweichung, normiert" UWORD dtsegn_b720divZyl 1 100 0 239.996 FUNCTION_LIST DMDFON IF_DATA DIM_X 0x38167E EXTERN WORD IF_DATA MCMESS 0x38167E EXTERN /end MEASUREMENT
/begin MEASUREMENT xs03 "Segmentabweichung, normiert" UWORD dtsegn_b720divZyl 1 100 0 239.996 FUNCTION_LIST DMDFON IF_DATA DIM_X 0x381680 EXTERN WORD IF_DATA MCMESS 0x381680 EXTERN /end MEASUREMENT
/begin MEASUREMENT xs04 "Segmentabweichung, normiert" UWORD dtsegn_b720divZyl 1 100 0 239.996 FUNCTION_LIST DMDFON IF_DATA DIM_X 0x381682 EXTERN WORD IF_DATA MCMESS 0x381682 EXTERN /end MEASUREMENT
/begin MEASUREMENT xs05 "Segmentabweichung, normiert" UWORD dtsegn_b720divZyl 1 100 0 239.996 FUNCTION_LIST DMDFON IF_DATA DIM_X 0x381684 EXTERN WORD IF_DATA MCMESS 0x381684 EXTERN /end MEASUREMENT
/begin MEASUREMENT xs06 "Segmentabweichung, normiert" UWORD dtsegn_b720divZyl 1 100 0 239.996 FUNCTION_LIST DMDFON IF_DATA DIM_X 0x381686 EXTERN WORD IF_DATA MCMESS 0x381686 EXTERN /end MEASUREMENT
/begin MEASUREMENT xs07 "Segmentabweichung, normiert" UWORD dtsegn_b720divZyl 1 100 0 239.996 FUNCTION_LIST DMDFON IF_DATA DIM_X 0x381688 EXTERN WORD IF_DATA MCMESS 0x381688 EXTERN /end MEASUREMENT
/begin MEASUREMENT xs08 "Segmentabweichung, normiert" UWORD dtsegn_b720divZyl 1 100 0 239.996 FUNCTION_LIST DMDFON IF_DATA DIM_X 0x38168A EXTERN WORD IF_DATA MCMESS 0x38168A EXTERN /end MEASUREMENT
/begin MEASUREMENT xzkrznt "Zähler Klopfregelung Zyklusflag Z_krnt" UBYTE dez 1 100 0 255 FUNCTION_LIST DKRNT IF_DATA DIM_X 0x380B7A EXTERN WORD IF_DATA MCMESS 0x380B7A EXTERN /end MEASUREMENT
/begin MEASUREMENT xzkrzof "Zähler Klopfregelung Zyklusflag Z_krof" UBYTE dez 1 100 0 255 FUNCTION_LIST DKRNT IF_DATA DIM_X 0x380B7B EXTERN WORD IF_DATA MCMESS 0x380B7B EXTERN /end MEASUREMENT
/begin MEASUREMENT xzkrzs_0_A "" UBYTE dez 1 100 0 255 FUNCTION_LIST DKRS IF_DATA DIM_X 0x380B7E EXTERN WORD IF_DATA MCMESS 0x380B7E EXTERN /end MEASUREMENT
/begin MEASUREMENT xzkrzs_1_A "" UBYTE dez 1 100 0 255 FUNCTION_LIST DKRS IF_DATA DIM_X 0x380B7F EXTERN WORD IF_DATA MCMESS 0x380B7F EXTERN /end MEASUREMENT
/begin MEASUREMENT xzkrzs_2_A "" UBYTE dez 1 100 0 255 FUNCTION_LIST DKRS IF_DATA DIM_X 0x380B80 EXTERN WORD IF_DATA MCMESS 0x380B80 EXTERN /end MEASUREMENT
/begin MEASUREMENT xzkrzs_3_A "" UBYTE dez 1 100 0 255 FUNCTION_LIST DKRS IF_DATA DIM_X 0x380B81 EXTERN WORD IF_DATA MCMESS 0x380B81 EXTERN /end MEASUREMENT
/begin MEASUREMENT xzkrztp "Zähler Klopfregelung Zyklusflag Z_krtp" UBYTE dez 1 100 0 255 FUNCTION_LIST DKRTP IF_DATA DIM_X 0x380B86 EXTERN WORD IF_DATA MCMESS 0x380B86 EXTERN /end MEASUREMENT
/begin MEASUREMENT xzsen_0_A "" UBYTE dez 1 100 0 255 FUNCTION_LIST DKRS IF_DATA DIM_X 0x380B82 EXTERN WORD IF_DATA MCMESS 0x380B82 EXTERN /end MEASUREMENT
/begin MEASUREMENT xzsen_1_A "" UBYTE dez 1 100 0 255 FUNCTION_LIST DKRS IF_DATA DIM_X 0x380B83 EXTERN WORD IF_DATA MCMESS 0x380B83 EXTERN /end MEASUREMENT
/begin MEASUREMENT xzsen_2_A "" UBYTE dez 1 100 0 255 FUNCTION_LIST DKRS IF_DATA DIM_X 0x380B84 EXTERN WORD IF_DATA MCMESS 0x380B84 EXTERN /end MEASUREMENT
/begin MEASUREMENT xzsen_3_A "" UBYTE dez 1 100 0 255 FUNCTION_LIST DKRS IF_DATA DIM_X 0x380B85 EXTERN WORD IF_DATA MCMESS 0x380B85 EXTERN /end MEASUREMENT
/begin MEASUREMENT xzskrnt "Sicherheitszähler Klopfregelung Nulltest" UBYTE dez 1 100 0 255 FUNCTION_LIST DKRNT GGKS IF_DATA DIM_X 0x380B7C EXTERN WORD IF_DATA MCMESS 0x380B7C EXTERN /end MEASUREMENT
/begin MEASUREMENT xzskrof "Sicherheitszähler Klopfregelung Offset" UBYTE dez 1 100 0 255 FUNCTION_LIST DKRNT GGKS IF_DATA DIM_X 0x380B7D EXTERN WORD IF_DATA MCMESS 0x380B7D EXTERN /end MEASUREMENT
/begin MEASUREMENT xzskrtp "Zähler Klopfregelung Errorflag E_krtp" UBYTE dez 1 100 0 255 FUNCTION_LIST DKRTP GGKS IF_DATA DIM_X 0x380B87 EXTERN WORD IF_DATA MCMESS 0x380B87 EXTERN /end MEASUREMENT
/begin MEASUREMENT x_uc "" UBYTE dez 1 100 0 255 FUNCTION_LIST URCEIN IF_DATA DIM_X 0x380C5F EXTERN WORD IF_DATA MCMESS 0x380C5F EXTERN /end MEASUREMENT
/begin MEASUREMENT y_uc "" UBYTE dez 1 100 0 255 FUNCTION_LIST URCEIN IF_DATA DIM_X 0x380C60 EXTERN WORD IF_DATA MCMESS 0x380C60 EXTERN /end MEASUREMENT
/begin MEASUREMENT zaldy "Zündungszähler für Abregelung Lastdynamik" UBYTE dez 1 100 0 255 FUNCTION_LIST KRDY IF_DATA DIM_X 0x380B99 EXTERN WORD IF_DATA MCMESS 0x380B99 EXTERN /end MEASUREMENT
/begin MEASUREMENT zalt_um "Zahnzählerwert des vorhergehenden Berechnungszeitpunkts im 40ms-Raster" UWORD dez 1 100 0 65535 FUNCTION_LIST UFNC IF_DATA DIM_X 0x382E92 EXTERN WORD IF_DATA MCMESS 0x382E92 EXTERN /end MEASUREMENT
/begin MEASUREMENT zbale "Abregelfaktor Langzeitanteil bei BA" UBYTE fak_ub_b0p125 1 100 0 0.124512 FUNCTION_LIST ESUK IF_DATA DIM_X 0x380B2C EXTERN WORD IF_DATA MCMESS 0x380B2C EXTERN /end MEASUREMENT
/begin MEASUREMENT zburn "Anzahl erkannter Verbrennungen" UBYTE dez 1 100 0 255 FUNCTION_LIST STADAP IF_DATA DIM_X 0x380B4D EXTERN WORD IF_DATA MCMESS 0x380B4D EXTERN /end MEASUREMENT
/begin MEASUREMENT zburnsu "Summe aller erkannten Verbrennungen während ZSYNABR" UBYTE dez 1 100 0 255 FUNCTION_LIST STADAP IF_DATA DIM_X 0x380B4E EXTERN WORD IF_DATA MCMESS 0x380B4E EXTERN /end MEASUREMENT
/begin MEASUREMENT zburnsum "Summe erkannter Verbrennungen im Start" UBYTE dez 1 100 0 255 FUNCTION_LIST ESSTT IF_DATA DIM_X 0x380B27 EXTERN WORD IF_DATA MCMESS 0x380B27 EXTERN /end MEASUREMENT
/begin MEASUREMENT zcap_um "Zahnzählerwert des aktuellen Berechnungszeitpunkts im 40ms-Raster" UWORD dez 1 100 0 65535 FUNCTION_LIST UFNC IF_DATA DIM_X 0x382E94 EXTERN WORD IF_DATA MCMESS 0x382E94 EXTERN /end MEASUREMENT
/begin MEASUREMENT zdash_w "Zeitkonstante Dashpot" UWORD zk10msxs_uw_b655 1 100 0.0100002 655.36 FUNCTION_LIST MDFAW IF_DATA DIM_X 0x382668 EXTERN WORD IF_DATA MCMESS 0x382668 EXTERN /end MEASUREMENT
/begin MEASUREMENT zdelay "Zahn-Delay-Zähler im Schnellstart" UBYTE dez 1 100 0 255 FUNCTION_LIST GGDPG IF_DATA DIM_X 0xF9D7 INTERN WORD IF_DATA MCMESS 0xF9D7 INTERN /end MEASUREMENT
/begin MEASUREMENT zhklsu "Zähler Heizerkopplung LSU" UBYTE dez 1 100 0 255 FUNCTION_LIST DLSU T2LID IF_DATA DIM_X 0x380A85 EXTERN WORD IF_DATA MCMESS 0x380A85 EXTERN /end MEASUREMENT
/begin MEASUREMENT zhklsu2 "Zähler Heizerkopplung LSU2" UBYTE dez 1 100 0 255 FUNCTION_LIST DLSU T2LID IF_DATA DIM_X 0x380A86 EXTERN WORD IF_DATA MCMESS 0x380A86 EXTERN /end MEASUREMENT
/begin MEASUREMENT zkombi1_c "Botschaftszähler KOMBI1" UBYTE dez 1 100 0 255 FUNCTION_LIST CAN DCKBI IF_DATA DIM_X 0x38096E EXTERN WORD IF_DATA MCMESS 0x38096E EXTERN /end MEASUREMENT
/begin MEASUREMENT zkombi1_old_um "" UBYTE dez 1 100 0 255 FUNCTION_LIST UFFGRE IF_DATA DIM_X 0x382E4D EXTERN WORD IF_DATA MCMESS 0x382E4D EXTERN /end MEASUREMENT
/begin MEASUREMENT zkrvf_0_A "Zähler bestimmt die Frequenz der zylinderindividuellen Zündwinkelfrühverstellung" UBYTE dez 1 100 0 255 FUNCTION_LIST KRRA IF_DATA DIM_X 0x380BE7 EXTERN WORD IF_DATA MCMESS 0x380BE7 EXTERN /end MEASUREMENT
/begin MEASUREMENT zkrvf_1_A "Zähler bestimmt die Frequenz der zylinderindividuellen Zündwinkelfrühverstellung" UBYTE dez 1 100 0 255 FUNCTION_LIST KRRA IF_DATA DIM_X 0x380BE8 EXTERN WORD IF_DATA MCMESS 0x380BE8 EXTERN /end MEASUREMENT
/begin MEASUREMENT zkrvf_2_A "Zähler bestimmt die Frequenz der zylinderindividuellen Zündwinkelfrühverstellung" UBYTE dez 1 100 0 255 FUNCTION_LIST KRRA IF_DATA DIM_X 0x380BE9 EXTERN WORD IF_DATA MCMESS 0x380BE9 EXTERN /end MEASUREMENT
/begin MEASUREMENT zkrvf_3_A "Zähler bestimmt die Frequenz der zylinderindividuellen Zündwinkelfrühverstellung" UBYTE dez 1 100 0 255 FUNCTION_LIST KRRA IF_DATA DIM_X 0x380BEA EXTERN WORD IF_DATA MCMESS 0x380BEA EXTERN /end MEASUREMENT
/begin MEASUREMENT zkrvf_4_A "Zähler bestimmt die Frequenz der zylinderindividuellen Zündwinkelfrühverstellung" UBYTE dez 1 100 0 255 FUNCTION_LIST KRRA IF_DATA DIM_X 0x380BEB EXTERN WORD IF_DATA MCMESS 0x380BEB EXTERN /end MEASUREMENT
/begin MEASUREMENT zkrvf_5_A "Zähler bestimmt die Frequenz der zylinderindividuellen Zündwinkelfrühverstellung" UBYTE dez 1 100 0 255 FUNCTION_LIST KRRA IF_DATA DIM_X 0x380BEC EXTERN WORD IF_DATA MCMESS 0x380BEC EXTERN /end MEASUREMENT
/begin MEASUREMENT zkrvf_6_A "Zähler bestimmt die Frequenz der zylinderindividuellen Zündwinkelfrühverstellung" UBYTE dez 1 100 0 255 FUNCTION_LIST KRRA IF_DATA DIM_X 0x380BED EXTERN WORD IF_DATA MCMESS 0x380BED EXTERN /end MEASUREMENT
/begin MEASUREMENT zkrvf_7_A "Zähler bestimmt die Frequenz der zylinderindividuellen Zündwinkelfrühverstellung" UBYTE dez 1 100 0 255 FUNCTION_LIST KRRA IF_DATA DIM_X 0x380BEE EXTERN WORD IF_DATA MCMESS 0x380BEE EXTERN /end MEASUREMENT
/begin MEASUREMENT zkvek "Shiftkonstante für die Zündmaskenberechnung" UBYTE dez 1 100 0 255 FUNCTION_LIST AZUE IF_DATA DIM_X 0xF8F4 INTERN WORD IF_DATA MCMESS 0xF8F4 INTERN /end MEASUREMENT
/begin MEASUREMENT zlash2_w "Zeitzähler für Sondenspannung hinter KAT ober/unterhalb des Sollwertes, Bank2" UWORD t100msxs_uw_b6553p5 1 100 0 6553.5 FUNCTION_LIST DLSAHK T2LID IF_DATA DIM_X 0x381CC0 EXTERN WORD IF_DATA MCMESS 0x381CC0 EXTERN /end MEASUREMENT
/begin MEASUREMENT zlash_w "Zeitzähler für Sondenspannung hinter KAT ober/unterhalb des Sollwertes" UWORD t100msxs_uw_b6553p5 1 100 0 6553.5 FUNCTION_LIST DLSAHK T2LID IF_DATA DIM_X 0x381CC2 EXTERN WORD IF_DATA MCMESS 0x381CC2 EXTERN /end MEASUREMENT
/begin MEASUREMENT zldy "Zündungszähler für Lastdynamik" UBYTE dez 1 100 0 255 FUNCTION_LIST KRDY IF_DATA DIM_X 0xFAEB INTERN WORD IF_DATA MCMESS 0xFAEB INTERN /end MEASUREMENT
/begin MEASUREMENT zlrs "Verzögerungszeitkonstante der Lambdaregelstrecke" UBYTE zk10msxs_ub_b2p55 1 100 0.01 2.55 FUNCTION_LIST LRS IF_DATA DIM_X 0x380C89 EXTERN WORD IF_DATA MCMESS 0x380C89 EXTERN /end MEASUREMENT
/begin MEASUREMENT zlsd_w "Zeitkonstante PT2-Filter Lastschlagdämpfung" UWORD zk10msxs_uw_b655 1 100 0.0100002 655.36 FUNCTION_LIST MDFAW IF_DATA DIM_X 0x38266A EXTERN WORD IF_DATA MCMESS 0x38266A EXTERN /end MEASUREMENT
/begin MEASUREMENT zn2zkvek "Nächster zu zündender Zündkreis 2tes Zündereignis" UWORD dez 1 100 0 65535 FUNCTION_LIST AZUE IF_DATA DIM_X 0xF90A INTERN WORD IF_DATA MCMESS 0xF90A INTERN /end MEASUREMENT
/begin MEASUREMENT znachanz "Anzahl der Zündungen im Nachlauf" UBYTE dez 1 100 0 255 FUNCTION_LIST ZUE AZUE IF_DATA DIM_X 0xFB3E INTERN WORD IF_DATA MCMESS 0xFB3E INTERN /end MEASUREMENT
/begin MEASUREMENT znbm_w "Zähler Zahninterrupt (word)" UWORD dez 1 100 0 65535 FUNCTION_LIST GGDPG DDG IF_DATA DIM_X 0xFE50 INTERN WORD IF_DATA MCMESS 0xFE50 INTERN /end MEASUREMENT
/begin MEASUREMENT zndy "Zündungszähler für Drehzahldynamik" UBYTE dez 1 100 0 255 FUNCTION_LIST KRDY IF_DATA DIM_X 0xFAEC INTERN WORD IF_DATA MCMESS 0xFAEC INTERN /end MEASUREMENT
/begin MEASUREMENT znlphausf "Zähler für erkannte Aussetzer an falscher Position" UBYTE dez 1 100 0 255 FUNCTION_LIST NLPH IF_DATA DIM_X 0x380A37 EXTERN WORD IF_DATA MCMESS 0x380A37 EXTERN /end MEASUREMENT
/begin MEASUREMENT znlphausr "Zähler für erkannte Aussetzer an richtiger Position" UBYTE dez 1 100 0 255 FUNCTION_LIST NLPH IF_DATA DIM_X 0x380A38 EXTERN WORD IF_DATA MCMESS 0x380A38 EXTERN /end MEASUREMENT
/begin MEASUREMENT znlphstim "Zähler für Stimuli-Bits von Aussetzertrommel" UBYTE dez 1 100 0 255 FUNCTION_LIST NLPH IF_DATA DIM_X 0x380A39 EXTERN WORD IF_DATA MCMESS 0x380A39 EXTERN /end MEASUREMENT
/begin MEASUREMENT znostend "Anzahl Zündung=ein ohne Erreichen von Startende" UBYTE dez 1 100 0 255 FUNCTION_LIST AEKP IF_DATA DIM_X 0x38311C EXTERN WORD IF_DATA MCMESS 0x38311C EXTERN /end MEASUREMENT
/begin MEASUREMENT znzkvek "Nächster zu zündender Zündkreis" UWORD dez 1 100 0 65535 FUNCTION_LIST AZUE IF_DATA DIM_X 0xF90C INTERN WORD IF_DATA MCMESS 0xF90C INTERN /end MEASUREMENT
/begin MEASUREMENT zouttmx "Maximale Programmlaufzeit von der TR Marke bis Ende AZUE" UWORD tsquant 1 100 0 43690 FUNCTION_LIST AZUE IF_DATA DIM_X 0xF90E INTERN WORD IF_DATA MCMESS 0xF90E INTERN /end MEASUREMENT
/begin MEASUREMENT zphfl "Zähler äquidistante Phasenflanken" UBYTE dez 1 100 0 255 FUNCTION_LIST WANWKW NLDG IF_DATA DIM_X 0x380A3B EXTERN WORD IF_DATA MCMESS 0x380A3B EXTERN /end MEASUREMENT
/begin MEASUREMENT zphfl2 "Zähler äquidistante Phasenflanken 2" UBYTE dez 1 100 0 255 FUNCTION_LIST WANWKW NLDG IF_DATA DIM_X 0x380A3C EXTERN WORD IF_DATA MCMESS 0x380A3C EXTERN /end MEASUREMENT
/begin MEASUREMENT zphflsyn "Phasenflankenzähler bei Erkennen der Motorposition im Notlauf DG" UBYTE dez 1 100 0 255 FUNCTION_LIST NLDG WANWKW IF_DATA DIM_X 0x380A32 EXTERN WORD IF_DATA MCMESS 0x380A32 EXTERN /end MEASUREMENT
/begin MEASUREMENT zphflx "Zähler äquidistanter Phasenflanken von %WANWKW" UBYTE dez 1 100 0 255 FUNCTION_LIST NLDG IF_DATA DIM_X 0x380A33 EXTERN WORD IF_DATA MCMESS 0x380A33 EXTERN /end MEASUREMENT
/begin MEASUREMENT zphnok "Zähler Fehler auf Phasensignal" UBYTE dez 1 100 0 255 FUNCTION_LIST DPH IF_DATA DIM_X 0x380A25 EXTERN WORD IF_DATA MCMESS 0x380A25 EXTERN /end MEASUREMENT
/begin MEASUREMENT zphnok2 "Zähler Fehler auf Phasensignal 2" UBYTE dez 1 100 0 255 FUNCTION_LIST DPH IF_DATA DIM_X 0x380A26 EXTERN WORD IF_DATA MCMESS 0x380A26 EXTERN /end MEASUREMENT
/begin MEASUREMENT zriberh "Ri-Berechnungszähler nach Start hinter KAT" UBYTE dez 1 100 0 255 FUNCTION_LIST GGLSH IF_DATA DIM_X 0x380A89 EXTERN WORD IF_DATA MCMESS 0x380A89 EXTERN /end MEASUREMENT
/begin MEASUREMENT zriberh2 "Ri-Berechnungszähler nach Start hinter KAT Bank2" UBYTE dez 1 100 0 255 FUNCTION_LIST GGLSH IF_DATA DIM_X 0x380A8A EXTERN WORD IF_DATA MCMESS 0x380A8A EXTERN /end MEASUREMENT
/begin MEASUREMENT zrinh2_w "Zeitzähler zur Bereitstellung der aktuellen Bedingung Ri-Nernst hinter KAT Bank2" UWORD t100msxs_uw_b6553p5 1 100 0 6553.5 FUNCTION_LIST GGLSH IF_DATA DIM_X 0x381DA2 EXTERN WORD IF_DATA MCMESS 0x381DA2 EXTERN /end MEASUREMENT
/begin MEASUREMENT zrinh_w "Zeitzähler zur Bereitstellung der aktuellen Bedingung Ri-Nernst hinter KAT" UWORD t100msxs_uw_b6553p5 1 100 0 6553.5 FUNCTION_LIST GGLSH IF_DATA DIM_X 0x381DA4 EXTERN WORD IF_DATA MCMESS 0x381DA4 EXTERN /end MEASUREMENT
/begin MEASUREMENT zrph "Zähler Raster Phasensignal" UBYTE dez 1 100 0 255 FUNCTION_LIST GGDPG DDG DPH PHAS IF_DATA DIM_X 0x380A2B EXTERN WORD IF_DATA MCMESS 0x380A2B EXTERN /end MEASUREMENT
/begin MEASUREMENT zrph2 "Zähler Raster Phasensignal 2" UBYTE dez 1 100 0 255 FUNCTION_LIST GGDPG DDG DPH PHAS IF_DATA DIM_X 0x380A2C EXTERN WORD IF_DATA MCMESS 0x380A2C EXTERN /end MEASUREMENT
/begin MEASUREMENT zsynchro "Anzahl Zündungen bis Auswertung der Verbrennungen" UBYTE dez 1 100 0 255 FUNCTION_LIST STADAP IF_DATA DIM_X 0x380B4F EXTERN WORD IF_DATA MCMESS 0x380B4F EXTERN /end MEASUREMENT
/begin MEASUREMENT zsync_um "Kennung für Synchronisation in der Funktionsüberwachung" UBYTE dez 1 100 0 255 FUNCTION_LIST UFNC IF_DATA DIM_X 0x380C4C EXTERN WORD IF_DATA MCMESS 0x380C4C EXTERN /end MEASUREMENT
/begin MEASUREMENT zsynsu "Zündungszähler für Begrenzung Startmengenadaption" UBYTE dez 1 100 0 255 FUNCTION_LIST STADAP IF_DATA DIM_X 0x380B50 EXTERN WORD IF_DATA MCMESS 0x380B50 EXTERN /end MEASUREMENT
/begin MEASUREMENT ztnlsg_w "" UWORD t100msxs_uw_b6553p6 1 100 0 6553.5 FUNCTION_LIST MLS IF_DATA DIM_X 0x383A1E EXTERN WORD IF_DATA MCMESS 0x383A1E EXTERN /end MEASUREMENT
/begin MEASUREMENT ztpnt_a "KR: Zähler für die Freigabe von Nulltest oder Testimpuls" UBYTE dez 1 100 0 255 FUNCTION_LIST GGKS IF_DATA DIM_X 0x380B98 EXTERN WORD IF_DATA MCMESS 0x380B98 EXTERN /end MEASUREMENT
/begin MEASUREMENT ztrwvls_w "Zeitzähler f. sofortige Wiederaufn. VL-Zündw. spät Motorschutz (Word)" UWORD t100msxs_uw_b6553p5 1 100 0 6553.5 FUNCTION_LIST ZWBTSK IF_DATA DIM_X 0x382CEA EXTERN WORD IF_DATA MCMESS 0x382CEA EXTERN /end MEASUREMENT
/begin MEASUREMENT ztwvls_w "Zeitzähler f. Aktivierung Vollastzündw. spät Motorschutz (Word)" UWORD t100msxs_uw_b6553p5 1 100 0 6553.5 FUNCTION_LIST ZWBTSK IF_DATA DIM_X 0x382CEC EXTERN WORD IF_DATA MCMESS 0x382CEC EXTERN /end MEASUREMENT
/begin MEASUREMENT zubkst "Zähler: UBatt < UBKST" UBYTE dez 1 100 0 255 FUNCTION_LIST STADAP IF_DATA DIM_X 0x380B51 EXTERN WORD IF_DATA MCMESS 0x380B51 EXTERN /end MEASUREMENT
/begin MEASUREMENT zueninkr "Inkrementverfeinerung Zündwinkel" UBYTE dez 1 100 0 255 FUNCTION_LIST AZUE IF_DATA DIM_X 0xF8F5 INTERN WORD IF_DATA MCMESS 0xF8F5 INTERN /end MEASUREMENT
/begin MEASUREMENT zueninkr2 "Inkrementverfeinerung Zündwinkel 2tes Zündereignis" UBYTE dez 1 100 0 255 FUNCTION_LIST AZUE IF_DATA DIM_X 0xF8F6 INTERN WORD IF_DATA MCMESS 0xF8F6 INTERN /end MEASUREMENT
/begin MEASUREMENT zueninkr_r "Inkrementverfeinerung Zündwinkel Absolutwinkel" UBYTE dez 1 100 0 255 FUNCTION_LIST AZUE IF_DATA DIM_X 0xF8F7 INTERN WORD IF_DATA MCMESS 0xF8F7 INTERN /end MEASUREMENT
/begin MEASUREMENT zuentmx "Maximale Laufzeit von der TR-Marke bis zur Berechnung des Zündereignisses" UWORD tsquant 1 100 0 43690 FUNCTION_LIST AZUE IF_DATA DIM_X 0xF910 INTERN WORD IF_DATA MCMESS 0xF910 INTERN /end MEASUREMENT
/begin MEASUREMENT zuenzahn "Zündwinkel in Zahnquantisierung" UBYTE dez 1 100 0 255 FUNCTION_LIST AZUE IF_DATA DIM_X 0xF8F8 INTERN WORD IF_DATA MCMESS 0xF8F8 INTERN /end MEASUREMENT
/begin MEASUREMENT zuenzahn2 "Zündwinkel in Zahnquantisierung 2tes Zündereignis" UBYTE dez 1 100 0 255 FUNCTION_LIST AZUE IF_DATA DIM_X 0xF8F9 INTERN WORD IF_DATA MCMESS 0xF8F9 INTERN /end MEASUREMENT
/begin MEASUREMENT zuenzahn_r "Zündwinkel in Zahnquantisierung als Absolutwinkel bzgl TR-Marke Zyl. 0" UBYTE dez 1 100 0 255 FUNCTION_LIST AZUE IF_DATA DIM_X 0xF8FA INTERN WORD IF_DATA MCMESS 0xF8FA INTERN /end MEASUREMENT
/begin MEASUREMENT zuen_beg "Zylinder, bei dem erste Einspritzung stattgefunden hat" UBYTE dez 1 100 0 255 FUNCTION_LIST ACIFI IF_DATA DIM_X 0xFA6D INTERN WORD IF_DATA MCMESS 0xFA6D INTERN /end MEASUREMENT
/begin MEASUREMENT zueoffnl "Zündwinkeloffset von Notlauf-Drehzahlgeber" SBYTE zw_sb_q0p75 1 100 -96 95.25 FUNCTION_LIST NLDG IF_DATA DIM_X 0x380A34 EXTERN WORD IF_DATA MCMESS 0x380A34 EXTERN /end MEASUREMENT
/begin MEASUREMENT zvale "Abregelfaktor Langzeitanteil bei VA" UBYTE fak_ub_b0p125 1 100 0 0.124512 FUNCTION_LIST ESUK IF_DATA DIM_X 0x380B2D EXTERN WORD IF_DATA MCMESS 0x380B2D EXTERN /end MEASUREMENT
/begin MEASUREMENT zvtprg "Zeitkonstante Tiefpaßfilter für fupsrl_w und pirg_w" UWORD zk10msxs_uw_b655 1 100 0.0100002 655.36 FUNCTION_LIST BGSRM IF_DATA DIM_X 0x3820DC EXTERN WORD IF_DATA MCMESS 0x3820DC EXTERN /end MEASUREMENT
/begin MEASUREMENT zwbas "Basiszündwinkel" SBYTE zw_sb_q0p75 1 100 -96 95.25 FUNCTION_LIST ZUE CAN MDBAS T2LID IF_DATA DIM_X 0xFB3F INTERN WORD IF_DATA MCMESS 0xFB3F INTERN /end MEASUREMENT
/begin MEASUREMENT zwbasar_0_A "Basiszündwinkelarray" SBYTE zw_sb_q0p75 1 100 -96 95.25 FUNCTION_LIST ZUE IF_DATA DIM_X 0x380D08 EXTERN WORD IF_DATA MCMESS 0x380D08 EXTERN /end MEASUREMENT
/begin MEASUREMENT zwbasar_1_A "Basiszündwinkelarray" SBYTE zw_sb_q0p75 1 100 -96 95.25 FUNCTION_LIST ZUE IF_DATA DIM_X 0x380D09 EXTERN WORD IF_DATA MCMESS 0x380D09 EXTERN /end MEASUREMENT
/begin MEASUREMENT zwbasar_2_A "Basiszündwinkelarray" SBYTE zw_sb_q0p75 1 100 -96 95.25 FUNCTION_LIST ZUE IF_DATA DIM_X 0x380D0A EXTERN WORD IF_DATA MCMESS 0x380D0A EXTERN /end MEASUREMENT
/begin MEASUREMENT zwbasar_3_A "Basiszündwinkelarray" SBYTE zw_sb_q0p75 1 100 -96 95.25 FUNCTION_LIST ZUE IF_DATA DIM_X 0x380D0B EXTERN WORD IF_DATA MCMESS 0x380D0B EXTERN /end MEASUREMENT
/begin MEASUREMENT zwc_c_um "Fehlerzähler für Zündwinkelüberwachung in der Funktionsüberwachung" UBYTE dez 1 100 0 255 FUNCTION_LIST UFZWC IF_DATA DIM_X 0x382E52 EXTERN WORD IF_DATA MCMESS 0x382E52 EXTERN /end MEASUREMENT
/begin MEASUREMENT zwdynsh "Zähler für Anzahl der Dynamikmessungen für Sonde hinter KAT" UBYTE dez 1 100 0 255 FUNCTION_LIST DLSAHK IF_DATA DIM_X 0x380A79 EXTERN WORD IF_DATA MCMESS 0x380A79 EXTERN /end MEASUREMENT
/begin MEASUREMENT zwdynsh2 "Zähler für Anzahl der Dynamikmessungen für Sonde hinter KAT Bank2" UBYTE dez 1 100 0 255 FUNCTION_LIST DLSAHK IF_DATA DIM_X 0x380A7A EXTERN WORD IF_DATA MCMESS 0x380A7A EXTERN /end MEASUREMENT
/begin MEASUREMENT zwgru "Grundzündwinkel" SBYTE zw_sb_q0p75 1 100 -96 95.25 FUNCTION_LIST ZWGRU LAMBTS ZUE IF_DATA DIM_X 0x380D14 EXTERN WORD IF_DATA MCMESS 0x380D14 EXTERN /end MEASUREMENT
/begin MEASUREMENT zwist "Ist-Zündwinkel" SBYTE zw_sb_q0p75 1 100 -96 95.25 FUNCTION_LIST ZUE CAN MDIST T2LID ZWMIN IF_DATA DIM_X 0xFB40 INTERN WORD IF_DATA MCMESS 0xFB40 INTERN /end MEASUREMENT
/begin MEASUREMENT zwkrafld "Bitmuster des zyl.ind. abgelegten B_zwkra" UBYTE dez 1 100 0 255 FUNCTION_LIST ZUE KRRA IF_DATA DIM_X 0xFB41 INTERN WORD IF_DATA MCMESS 0xFB41 INTERN /end MEASUREMENT
/begin MEASUREMENT zwmatm "Zähler für ATM-Wiederholstart und Faktor für Wärmemengen-Schwellen" UBYTE dez 1 100 0 255 FUNCTION_LIST ATM IF_DATA DIM_X 0x382FE2 EXTERN WORD IF_DATA MCMESS 0x382FE2 EXTERN /end MEASUREMENT
/begin MEASUREMENT zwmatm2 "Zähler für ATM-Wiederholstart und Faktor für Wärmemengen-Schwellen Bank2" UBYTE dez 1 100 0 255 FUNCTION_LIST ATM IF_DATA DIM_X 0x382FE3 EXTERN WORD IF_DATA MCMESS 0x382FE3 EXTERN /end MEASUREMENT
/begin MEASUREMENT zwmatmf "Zähler für ATM-Wiederholstart und Faktor für Wärmemengen-Schwellwert upstream" UBYTE dez 1 100 0 255 FUNCTION_LIST ATM IF_DATA DIM_X 0x382FE4 EXTERN WORD IF_DATA MCMESS 0x382FE4 EXTERN /end MEASUREMENT
/begin MEASUREMENT zwmatmf2 "Zähler für ATM-Wiederholst.und Faktor für Wärmemengen-Schwellw. upstream Bank2" UBYTE dez 1 100 0 255 FUNCTION_LIST ATM IF_DATA DIM_X 0x382FE5 EXTERN WORD IF_DATA MCMESS 0x382FE5 EXTERN /end MEASUREMENT
/begin MEASUREMENT zwmn "Spätester Zündwinkel" SBYTE zw_sb_q0p75 1 100 -96 95.25 FUNCTION_LIST ZWMIN IF_DATA DIM_X 0x380D17 EXTERN WORD IF_DATA MCMESS 0x380D17 EXTERN /end MEASUREMENT
/begin MEASUREMENT zwmnd "dynamisch spätest zulässiger Zündwinkel" SBYTE zw_sb_q0p75 1 100 -96 95.25 FUNCTION_LIST ZWMIN IF_DATA DIM_X 0x380D18 EXTERN WORD IF_DATA MCMESS 0x380D18 EXTERN /end MEASUREMENT
/begin MEASUREMENT zwmnms "dauerhaft spätest möglicher Zündwinkel" SBYTE zw_sb_q0p75 1 100 -96 95.25 FUNCTION_LIST ZWMIN IF_DATA DIM_X 0x380D19 EXTERN WORD IF_DATA MCMESS 0x380D19 EXTERN /end MEASUREMENT
/begin MEASUREMENT zwnst "" SBYTE zw_sb_q0p75 1 100 -96 95.25 FUNCTION_LIST ZWMIN IF_DATA DIM_X 0x380D1A EXTERN WORD IF_DATA MCMESS 0x380D1A EXTERN /end MEASUREMENT
/begin MEASUREMENT zwopt "optimaler Zündwinkel" SBYTE zw_sb_q0p75 1 100 -96 95.25 FUNCTION_LIST MDBAS LAMBTS MDIST MDZW ZWMIN IF_DATA DIM_X 0x380C35 EXTERN WORD IF_DATA MCMESS 0x380C35 EXTERN /end MEASUREMENT
/begin MEASUREMENT zwoptl1 "optimaler Zündwinkel bei Lambda=1" SBYTE zw_sb_q0p75 1 100 -96 95.25 FUNCTION_LIST MDBAS IF_DATA DIM_X 0x380C36 EXTERN WORD IF_DATA MCMESS 0x380C36 EXTERN /end MEASUREMENT
/begin MEASUREMENT zwopt_uc "optimaler Zündwinkel im Befehlstest" SBYTE zw_sb_q0p75 1 100 -96 95.25 FUNCTION_LIST URCMIST IF_DATA DIM_X 0x380C6A EXTERN WORD IF_DATA MCMESS 0x380C6A EXTERN /end MEASUREMENT
/begin MEASUREMENT zwopt_um "optimaler Zündwinkel in der Funktionsüberwachung" SBYTE zw_sb_q0p75 1 100 -96 95.25 FUNCTION_LIST UFMIST IF_DATA DIM_X 0x380C50 EXTERN WORD IF_DATA MCMESS 0x380C50 EXTERN /end MEASUREMENT
/begin MEASUREMENT zwout "Zündwinkel-Ausgabe" SBYTE zw_sb_q0p75 1 100 -96 95.25 FUNCTION_LIST ZUE UFZWC IF_DATA DIM_X 0xFB42 INTERN WORD IF_DATA MCMESS 0xFB42 INTERN /end MEASUREMENT
/begin MEASUREMENT zwoutar_0_A "Zündwinkel-Ausgabe Array" SBYTE zw_sb_q0p75 1 100 -96 95.25 FUNCTION_LIST ZUE AZUE IF_DATA DIM_X 0x380D0C EXTERN WORD IF_DATA MCMESS 0x380D0C EXTERN /end MEASUREMENT
/begin MEASUREMENT zwoutar_1_A "Zündwinkel-Ausgabe Array" SBYTE zw_sb_q0p75 1 100 -96 95.25 FUNCTION_LIST ZUE AZUE IF_DATA DIM_X 0x380D0D EXTERN WORD IF_DATA MCMESS 0x380D0D EXTERN /end MEASUREMENT
/begin MEASUREMENT zwoutar_2_A "Zündwinkel-Ausgabe Array" SBYTE zw_sb_q0p75 1 100 -96 95.25 FUNCTION_LIST ZUE AZUE IF_DATA DIM_X 0x380D0E EXTERN WORD IF_DATA MCMESS 0x380D0E EXTERN /end MEASUREMENT
/begin MEASUREMENT zwoutar_3_A "Zündwinkel-Ausgabe Array" SBYTE zw_sb_q0p75 1 100 -96 95.25 FUNCTION_LIST ZUE AZUE IF_DATA DIM_X 0x380D0F EXTERN WORD IF_DATA MCMESS 0x380D0F EXTERN /end MEASUREMENT
/begin MEASUREMENT zwoutcpl "Einerkomplement des Zündwinkels für die Funktionsüberwachung" SBYTE zw_sb_q0p75 1 100 -96 95.25 FUNCTION_LIST ZUE UFZWC IF_DATA DIM_X 0x380D10 EXTERN WORD IF_DATA MCMESS 0x380D10 EXTERN /end MEASUREMENT
/begin MEASUREMENT zwout_uc "Ausgabe-Zündwinkel im Befehlstest" SBYTE zw_sb_q0p75 1 100 -96 95.25 FUNCTION_LIST URCEIN URCMIST IF_DATA DIM_X 0x380C61 EXTERN WORD IF_DATA MCMESS 0x380C61 EXTERN /end MEASUREMENT
/begin MEASUREMENT zwout_um "Ausgabe-Zündwinkel für die Funktionsüberwachung" SBYTE zw_sb_q0p75 1 100 -96 95.25 FUNCTION_LIST UFZWC UFMIST IF_DATA DIM_X 0x382E53 EXTERN WORD IF_DATA MCMESS 0x382E53 EXTERN /end MEASUREMENT
/begin MEASUREMENT zwsol "Soll-Zündwinkel aus Momenteneingriff" SBYTE zw_sb_q0p75 1 100 -96 95.25 FUNCTION_LIST MDZW T2LID ZUE IF_DATA DIM_X 0x380D06 EXTERN WORD IF_DATA MCMESS 0x380D06 EXTERN /end MEASUREMENT
/begin MEASUREMENT zwspae "Spätester Zündwinkel" SBYTE zw_sb_q0p75 1 100 -96 95.25 FUNCTION_LIST ZWMIN CAN ZUE IF_DATA DIM_X 0x380D1B EXTERN WORD IF_DATA MCMESS 0x380D1B EXTERN /end MEASUREMENT
/begin MEASUREMENT zwstt "Zündwinkel im Start" SBYTE zw_sb_q0p75 1 100 -96 95.25 FUNCTION_LIST ZWSTT ZUE IF_DATA DIM_X 0x380D1C EXTERN WORD IF_DATA MCMESS 0x380D1C EXTERN /end MEASUREMENT
/begin MEASUREMENT zwzyl1 "Zündwinkel Zylinder 1" SBYTE zw_sb_q0p75 1 100 -96 95.25 FUNCTION_LIST ZUE TC1MOD IF_DATA DIM_X 0x380D11 EXTERN WORD IF_DATA MCMESS 0x380D11 EXTERN /end MEASUREMENT
/begin MEASUREMENT zyleausb "auszublendender Zylinder; binäre Darstellung" UBYTE dez 1 100 0 255 FUNCTION_LIST NLPH AEVAB IF_DATA DIM_X 0x380A3A EXTERN WORD IF_DATA MCMESS 0x380A3A EXTERN /end MEASUREMENT
/begin MEASUREMENT zylvek_a "" UBYTE dez 1 100 0 255 FUNCTION_LIST ACIFI IF_DATA DIM_X 0xFA6E INTERN WORD IF_DATA MCMESS 0xFA6E INTERN /end MEASUREMENT
/begin MEASUREMENT zylvirt "Stand Zylinderzähler vor Umsynchronisation aus Schnellstart" UBYTE dez 1 100 0 255 FUNCTION_LIST GGDPG ACIFI IF_DATA DIM_X 0x380A2D EXTERN WORD IF_DATA MCMESS 0x380A2D EXTERN /end MEASUREMENT
/begin MEASUREMENT zzale_ini "Initialisierungswert Zahnzähler zzseg bei aktiver Auslauferkennung (B_ale)" UBYTE dez 1 100 0 255 FUNCTION_LIST GGDPG IF_DATA DIM_X 0x380A2E EXTERN WORD IF_DATA MCMESS 0x380A2E EXTERN /end MEASUREMENT
/begin MEASUREMENT zzseg "Zahnzähler im Segment" UBYTE dez 1 100 0 255 FUNCTION_LIST GGDPG IF_DATA DIM_X 0xFEC4 INTERN WORD IF_DATA MCMESS 0xFEC4 INTERN /end MEASUREMENT
/begin MEASUREMENT zztab_0_A "Zahnzeitentabelle" UWORD dez 1 100 0 65535 FUNCTION_LIST GGDPG IF_DATA DIM_X 0xF9E4 INTERN WORD IF_DATA MCMESS 0xF9E4 INTERN /end MEASUREMENT
/begin MEASUREMENT zztab_1_A "Zahnzeitentabelle" UWORD dez 1 100 0 65535 FUNCTION_LIST GGDPG IF_DATA DIM_X 0xF9E6 INTERN WORD IF_DATA MCMESS 0xF9E6 INTERN /end MEASUREMENT
/begin MEASUREMENT zztab_2_A "Zahnzeitentabelle" UWORD dez 1 100 0 65535 FUNCTION_LIST GGDPG IF_DATA DIM_X 0xF9E8 INTERN WORD IF_DATA MCMESS 0xF9E8 INTERN /end MEASUREMENT
/begin MEASUREMENT zztab_3_A "Zahnzeitentabelle" UWORD dez 1 100 0 65535 FUNCTION_LIST GGDPG IF_DATA DIM_X 0xF9EA INTERN WORD IF_DATA MCMESS 0xF9EA INTERN /end MEASUREMENT
/begin MEASUREMENT zztab_4_A "Zahnzeitentabelle" UWORD dez 1 100 0 65535 FUNCTION_LIST GGDPG IF_DATA DIM_X 0xF9EC INTERN WORD IF_DATA MCMESS 0xF9EC INTERN /end MEASUREMENT
/begin MEASUREMENT zztab_5_A "Zahnzeitentabelle" UWORD dez 1 100 0 65535 FUNCTION_LIST GGDPG IF_DATA DIM_X 0xF9EE INTERN WORD IF_DATA MCMESS 0xF9EE INTERN /end MEASUREMENT
/begin MEASUREMENT zztab_6_A "Zahnzeitentabelle" UWORD dez 1 100 0 65535 FUNCTION_LIST GGDPG IF_DATA DIM_X 0xF9F0 INTERN WORD IF_DATA MCMESS 0xF9F0 INTERN /end MEASUREMENT
/begin MEASUREMENT zztab_7_A "Zahnzeitentabelle" UWORD dez 1 100 0 65535 FUNCTION_LIST GGDPG IF_DATA DIM_X 0xF9F2 INTERN WORD IF_DATA MCMESS 0xF9F2 INTERN /end MEASUREMENT
/begin MEASUREMENT zztab_8_A "Zahnzeitentabelle" UWORD dez 1 100 0 65535 FUNCTION_LIST GGDPG IF_DATA DIM_X 0xF9F4 INTERN WORD IF_DATA MCMESS 0xF9F4 INTERN /end MEASUREMENT
/begin MEASUREMENT zztab_9_A "Zahnzeitentabelle" UWORD dez 1 100 0 65535 FUNCTION_LIST GGDPG IF_DATA DIM_X 0xF9F6 INTERN WORD IF_DATA MCMESS 0xF9F6 INTERN /end MEASUREMENT
/begin MEASUREMENT zztab_10_A "Zahnzeitentabelle" UWORD dez 1 100 0 65535 FUNCTION_LIST GGDPG IF_DATA DIM_X 0xF9F8 INTERN WORD IF_DATA MCMESS 0xF9F8 INTERN /end MEASUREMENT
/begin MEASUREMENT zztab_11_A "Zahnzeitentabelle" UWORD dez 1 100 0 65535 FUNCTION_LIST GGDPG IF_DATA DIM_X 0xF9FA INTERN WORD IF_DATA MCMESS 0xF9FA INTERN /end MEASUREMENT
/begin MEASUREMENT zztab_12_A "Zahnzeitentabelle" UWORD dez 1 100 0 65535 FUNCTION_LIST GGDPG IF_DATA DIM_X 0xF9FC INTERN WORD IF_DATA MCMESS 0xF9FC INTERN /end MEASUREMENT
/begin MEASUREMENT zztab_13_A "Zahnzeitentabelle" UWORD dez 1 100 0 65535 FUNCTION_LIST GGDPG IF_DATA DIM_X 0xF9FE INTERN WORD IF_DATA MCMESS 0xF9FE INTERN /end MEASUREMENT
/begin MEASUREMENT zztab_14_A "Zahnzeitentabelle" UWORD dez 1 100 0 65535 FUNCTION_LIST GGDPG IF_DATA DIM_X 0xFA00 INTERN WORD IF_DATA MCMESS 0xFA00 INTERN /end MEASUREMENT
/begin MEASUREMENT zztab_15_A "Zahnzeitentabelle" UWORD dez 1 100 0 65535 FUNCTION_LIST GGDPG IF_DATA DIM_X 0xFA02 INTERN WORD IF_DATA MCMESS 0xFA02 INTERN /end MEASUREMENT
/begin MEASUREMENT zztab_16_A "Zahnzeitentabelle" UWORD dez 1 100 0 65535 FUNCTION_LIST GGDPG IF_DATA DIM_X 0xFA04 INTERN WORD IF_DATA MCMESS 0xFA04 INTERN /end MEASUREMENT
/begin MEASUREMENT zztab_17_A "Zahnzeitentabelle" UWORD dez 1 100 0 65535 FUNCTION_LIST GGDPG IF_DATA DIM_X 0xFA06 INTERN WORD IF_DATA MCMESS 0xFA06 INTERN /end MEASUREMENT
/begin MEASUREMENT zztab_18_A "Zahnzeitentabelle" UWORD dez 1 100 0 65535 FUNCTION_LIST GGDPG IF_DATA DIM_X 0xFA08 INTERN WORD IF_DATA MCMESS 0xFA08 INTERN /end MEASUREMENT
/begin MEASUREMENT zztab_19_A "Zahnzeitentabelle" UWORD dez 1 100 0 65535 FUNCTION_LIST GGDPG IF_DATA DIM_X 0xFA0A INTERN WORD IF_DATA MCMESS 0xFA0A INTERN /end MEASUREMENT
/begin MEASUREMENT zztab_20_A "Zahnzeitentabelle" UWORD dez 1 100 0 65535 FUNCTION_LIST GGDPG IF_DATA DIM_X 0xFA0C INTERN WORD IF_DATA MCMESS 0xFA0C INTERN /end MEASUREMENT
/begin MEASUREMENT zztab_21_A "Zahnzeitentabelle" UWORD dez 1 100 0 65535 FUNCTION_LIST GGDPG IF_DATA DIM_X 0xFA0E INTERN WORD IF_DATA MCMESS 0xFA0E INTERN /end MEASUREMENT
/begin MEASUREMENT zztab_22_A "Zahnzeitentabelle" UWORD dez 1 100 0 65535 FUNCTION_LIST GGDPG IF_DATA DIM_X 0xFA10 INTERN WORD IF_DATA MCMESS 0xFA10 INTERN /end MEASUREMENT
/begin MEASUREMENT zztab_23_A "Zahnzeitentabelle" UWORD dez 1 100 0 65535 FUNCTION_LIST GGDPG IF_DATA DIM_X 0xFA12 INTERN WORD IF_DATA MCMESS 0xFA12 INTERN /end MEASUREMENT
/begin MEASUREMENT zzuend_0_A "Zähler Zündung, zählt alle Zündungen aller Zylinder" UWORD dez 1 100 0 65535 FUNCTION_LIST DMDMIL T2LID IF_DATA DIM_X 0x383524 EXTERN LONG IF_DATA MCMESS 0x383524 EXTERN /end MEASUREMENT
/begin MEASUREMENT zzuend_1_A "Zähler Zündung, zählt alle Zündungen aller Zylinder" UWORD dez 1 100 0 65535 FUNCTION_LIST DMDMIL T2LID IF_DATA DIM_X 0x383526 EXTERN LONG IF_DATA MCMESS 0x383526 EXTERN /end MEASUREMENT
/begin MEASUREMENT zzvirt "virtueller Zahnzähler im Start bis zur Synchronisation" UBYTE dez 1 100 0 255 FUNCTION_LIST GGDPG ACIFI IF_DATA DIM_X 0x380A2F EXTERN WORD IF_DATA MCMESS 0x380A2F EXTERN /end MEASUREMENT
/begin MEASUREMENT zzyl "SW-Zylinderzähler" UBYTE dez 1 100 0 255 FUNCTION_LIST GGDPG ACIFI AEVAB DMDTSB ESSTT NLPH TN TNOT VSST WANWKW IF_DATA DIM_X 0xF9D8 INTERN WORD IF_DATA MCMESS 0xF9D8 INTERN /end MEASUREMENT
/begin MEASUREMENT zzyldmd "SW-Zylinderzähler für DMD" UBYTE dez 1 100 0 255 FUNCTION_LIST DMDTSB DMDUE IF_DATA DIM_X 0x3809BE EXTERN WORD IF_DATA MCMESS 0x3809BE EXTERN /end MEASUREMENT
/begin MEASUREMENT zzylkr "Zylinderzähler für die KR" UBYTE dez 1 100 0 255 FUNCTION_LIST TNOT GGKS KRDY KRKE KRRA IF_DATA DIM_X 0xF8E0 INTERN WORD IF_DATA MCMESS 0xF8E0 INTERN /end MEASUREMENT
/begin MEASUREMENT zzylzue "SW-Zylinderzähler für Zündungsberechnung" UBYTE dez 1 100 0 255 FUNCTION_LIST SYNC71 ZUE IF_DATA DIM_X 0x380CA8 EXTERN WORD IF_DATA MCMESS 0x380CA8 EXTERN /end MEASUREMENT
/begin MEASUREMENT zzyl_virt "Initialisierungswert Zylinderzähler bei aktiver Auslauferkennung (B_ale)" UBYTE dez 1 100 0 255 FUNCTION_LIST GGDPG IF_DATA DIM_X 0x380A30 EXTERN WORD IF_DATA MCMESS 0x380A30 EXTERN /end MEASUREMENT
/begin MEASUREMENT Z_aaa "Dummy: Tabellenanfang" UWORD B_TRUE 1 100 0 1 BIT_MASK 0x2 FUNCTION_LIST DFPM_DFPM IF_DATA DIM_X 0x383814 EXTERN BYTE IF_DATA MCMESS 0x383814 EXTERN /end MEASUREMENT
/begin MEASUREMENT Z_aave "Zyklusflag: Absperrventil Aktivkohlefilter (Endstufe)" UWORD B_TRUE 1 100 0 1 BIT_MASK 0x2 FUNCTION_LIST DFPM_DEKON IF_DATA DIM_X 0x383816 EXTERN BYTE IF_DATA MCMESS 0x383816 EXTERN /end MEASUREMENT
/begin MEASUREMENT Z_agre "Zyklusflag: Abgasrückführungsventil Endstufe" UWORD B_TRUE 1 100 0 1 BIT_MASK 0x2 FUNCTION_LIST DFPM_DUMMY043 IF_DATA DIM_X 0x383818 EXTERN BYTE IF_DATA MCMESS 0x383818 EXTERN /end MEASUREMENT
/begin MEASUREMENT Z_agrf "Zyklusflag: Überwachung AGR-FLOW" UWORD B_TRUE 1 100 0 1 BIT_MASK 0x2 FUNCTION_LIST DFPM_DUMMY043 IF_DATA DIM_X 0x38381A EXTERN BYTE IF_DATA MCMESS 0x38381A EXTERN /end MEASUREMENT
/begin MEASUREMENT Z_bm "Zyklusflag: Bezugsmarkengeber" UWORD B_TRUE 1 100 0 1 BIT_MASK 0x2 FUNCTION_LIST DFPM_DDG IF_DATA DIM_X 0x38381C EXTERN BYTE IF_DATA MCMESS 0x38381C EXTERN /end MEASUREMENT
/begin MEASUREMENT Z_brems "Zyklusflag: BREMS (Bremsschalter)" UWORD B_TRUE 1 100 0 1 BIT_MASK 0x2 FUNCTION_LIST DFPM_GGEGAS IF_DATA DIM_X 0x38381E EXTERN BYTE IF_DATA MCMESS 0x38381E EXTERN /end MEASUREMENT
/begin MEASUREMENT Z_bwf "Zyklusflag: PWG Bewegung" UWORD B_TRUE 1 100 0 1 BIT_MASK 0x2 FUNCTION_LIST DFPM_GGPED IF_DATA DIM_X 0x383820 EXTERN BYTE IF_DATA MCMESS 0x383820 EXTERN /end MEASUREMENT
/begin MEASUREMENT Z_cas "Zyklusflag: CAN-Schnittstelle, Timeout ASC" UWORD B_TRUE 1 100 0 1 BIT_MASK 0x2 FUNCTION_LIST DFPM_DCAS IF_DATA DIM_X 0x383822 EXTERN BYTE IF_DATA MCMESS 0x383822 EXTERN /end MEASUREMENT
/begin MEASUREMENT Z_cge "Zyklusflag: CAN-Schnittstelle, Timeout EGS" UWORD B_TRUE 1 100 0 1 BIT_MASK 0x2 FUNCTION_LIST DFPM_DCGE IF_DATA DIM_X 0x383824 EXTERN BYTE IF_DATA MCMESS 0x383824 EXTERN /end MEASUREMENT
/begin MEASUREMENT Z_cgegs "Zyklusflag: EGS; Steuergerät" UWORD B_TRUE 1 100 0 1 BIT_MASK 0x2 FUNCTION_LIST DFPM_DCG IF_DATA DIM_X 0x383826 EXTERN BYTE IF_DATA MCMESS 0x383826 EXTERN /end MEASUREMENT
/begin MEASUREMENT Z_cgggp "Zyklusflag: EGS; Gang unplausibel" UWORD B_TRUE 1 100 0 1 BIT_MASK 0x2 FUNCTION_LIST DFPM_DCG IF_DATA DIM_X 0x383828 EXTERN BYTE IF_DATA MCMESS 0x383828 EXTERN /end MEASUREMENT
/begin MEASUREMENT Z_cgggv "Zyklusflag: EGS; Gangvergleich negativ" UWORD B_TRUE 1 100 0 1 BIT_MASK 0x2 FUNCTION_LIST DFPM_DCG IF_DATA DIM_X 0x38382A EXTERN BYTE IF_DATA MCMESS 0x38382A EXTERN /end MEASUREMENT
/begin MEASUREMENT Z_cgm1v "Zyklusflag: EGS; Magnetventil 1-2/4-5 Schaltung" UWORD B_TRUE 1 100 0 1 BIT_MASK 0x2 FUNCTION_LIST DFPM_DCG IF_DATA DIM_X 0x38382C EXTERN BYTE IF_DATA MCMESS 0x38382C EXTERN /end MEASUREMENT
/begin MEASUREMENT Z_cgm2v "Zyklusflag: EGS; Magnetventil 2-3 Schaltung" UWORD B_TRUE 1 100 0 1 BIT_MASK 0x2 FUNCTION_LIST DFPM_DCG IF_DATA DIM_X 0x38382E EXTERN BYTE IF_DATA MCMESS 0x38382E EXTERN /end MEASUREMENT
/begin MEASUREMENT Z_cgm3v "Zyklusflag: EGS; Magnetventil 3-4 Schaltung" UWORD B_TRUE 1 100 0 1 BIT_MASK 0x2 FUNCTION_LIST DFPM_DCG IF_DATA DIM_X 0x383830 EXTERN BYTE IF_DATA MCMESS 0x383830 EXTERN /end MEASUREMENT
/begin MEASUREMENT Z_cgmvk "Zyklusflag: EGS; Magnetventil Wandlerkupplung" UWORD B_TRUE 1 100 0 1 BIT_MASK 0x2 FUNCTION_LIST DFPM_DCG IF_DATA DIM_X 0x383832 EXTERN BYTE IF_DATA MCMESS 0x383832 EXTERN /end MEASUREMENT
/begin MEASUREMENT Z_cgrmm "Zyklusflag: EGS; Regelmagnetventil Modulierdruck" UWORD B_TRUE 1 100 0 1 BIT_MASK 0x2 FUNCTION_LIST DFPM_DCG IF_DATA DIM_X 0x383834 EXTERN BYTE IF_DATA MCMESS 0x383834 EXTERN /end MEASUREMENT
/begin MEASUREMENT Z_cgrms "Zyklusflag: EGS; Regelmagnetventil Schaltdruck" UWORD B_TRUE 1 100 0 1 BIT_MASK 0x2 FUNCTION_LIST DFPM_DCG IF_DATA DIM_X 0x383836 EXTERN BYTE IF_DATA MCMESS 0x383836 EXTERN /end MEASUREMENT
/begin MEASUREMENT Z_cgudg "Zyklusflag: EGS; Versorgungsspannung Drehzahlsensoren" UWORD B_TRUE 1 100 0 1 BIT_MASK 0x2 FUNCTION_LIST DFPM_DCG IF_DATA DIM_X 0x383838 EXTERN BYTE IF_DATA MCMESS 0x383838 EXTERN /end MEASUREMENT
/begin MEASUREMENT Z_cgumv "Zyklusflag: EGS; Versorgungsspannung Magnetventile" UWORD B_TRUE 1 100 0 1 BIT_MASK 0x2 FUNCTION_LIST DFPM_DCG IF_DATA DIM_X 0x38383A EXTERN BYTE IF_DATA MCMESS 0x38383A EXTERN /end MEASUREMENT
/begin MEASUREMENT Z_cgvgc "Zyklusflag: EGS; Verteilergetr.-Stellung unplausibel" UWORD B_TRUE 1 100 0 1 BIT_MASK 0x2 FUNCTION_LIST DFPM_DCG IF_DATA DIM_X 0x38383C EXTERN BYTE IF_DATA MCMESS 0x38383C EXTERN /end MEASUREMENT
/begin MEASUREMENT Z_cgvrc "Zyklusflag: EGS; Raddrehzahl hinten unplausibel" UWORD B_TRUE 1 100 0 1 BIT_MASK 0x2 FUNCTION_LIST DFPM_DCG IF_DATA DIM_X 0x38383E EXTERN BYTE IF_DATA MCMESS 0x38383E EXTERN /end MEASUREMENT
/begin MEASUREMENT Z_cgwk "Zyklusflag: EGS; Wandlerkupplung" UWORD B_TRUE 1 100 0 1 BIT_MASK 0x2 FUNCTION_LIST DFPM_DCG IF_DATA DIM_X 0x383840 EXTERN BYTE IF_DATA MCMESS 0x383840 EXTERN /end MEASUREMENT
/begin MEASUREMENT Z_ckbi "Zyklusflag CAN-Schnittstelle Timeout Kombi" UWORD B_TRUE 1 100 0 1 BIT_MASK 0x2 FUNCTION_LIST DFPM_DCKBI IF_DATA DIM_X 0x383842 EXTERN BYTE IF_DATA MCMESS 0x383842 EXTERN /end MEASUREMENT
/begin MEASUREMENT Z_cmil "Zyklusflag MIL über CAN" UWORD B_TRUE 1 100 0 1 BIT_MASK 0x2 FUNCTION_LIST DFPM_DCMIL IF_DATA DIM_X 0x383844 EXTERN BYTE IF_DATA MCMESS 0x383844 EXTERN /end MEASUREMENT
/begin MEASUREMENT Z_cra "Zyklusflag: EKP Crashfunktion" UWORD B_TRUE 1 100 0 1 BIT_MASK 0x2 FUNCTION_LIST DFPM_GGAIRBAG IF_DATA DIM_X 0x383846 EXTERN BYTE IF_DATA MCMESS 0x383846 EXTERN /end MEASUREMENT
/begin MEASUREMENT Z_dk "Zyklusflag:	DK - Potentiometer" UWORD B_TRUE 1 100 0 1 BIT_MASK 0x2 FUNCTION_LIST DFPM_DDVE IF_DATA DIM_X 0x383848 EXTERN BYTE IF_DATA MCMESS 0x383848 EXTERN /end MEASUREMENT
/begin MEASUREMENT Z_dk1p "Zyklusflag: Drosselklappe 1. Poti" UWORD B_TRUE 1 100 0 1 BIT_MASK 0x2 FUNCTION_LIST DFPM_DDVE IF_DATA DIM_X 0x38384A EXTERN BYTE IF_DATA MCMESS 0x38384A EXTERN /end MEASUREMENT
/begin MEASUREMENT Z_dk2p "Zyklusflag: Drosselklappe 2. Poti" UWORD B_TRUE 1 100 0 1 BIT_MASK 0x2 FUNCTION_LIST DFPM_DDVE IF_DATA DIM_X 0x38384C EXTERN BYTE IF_DATA MCMESS 0x38384C EXTERN /end MEASUREMENT
/begin MEASUREMENT Z_dpl "Zyklusflag:	Dauerplus" UWORD B_TRUE 1 100 0 1 BIT_MASK 0x2 FUNCTION_LIST DFPM_DUMMY043 IF_DATA DIM_X 0x38384E EXTERN BYTE IF_DATA MCMESS 0x38384E EXTERN /end MEASUREMENT
/begin MEASUREMENT Z_dsl "Zyklusflag: Drucksensor Ladedruck" UWORD B_TRUE 1 100 0 1 BIT_MASK 0x2 FUNCTION_LIST DFPM_GGDSAS IF_DATA DIM_X 0x383850 EXTERN BYTE IF_DATA MCMESS 0x383850 EXTERN /end MEASUREMENT
/begin MEASUREMENT Z_dsu "Zyklusflag: Umgebungsdrucksensor" UWORD B_TRUE 1 100 0 1 BIT_MASK 0x2 FUNCTION_LIST DFPM_GGDSAS IF_DATA DIM_X 0x383852 EXTERN BYTE IF_DATA MCMESS 0x383852 EXTERN /end MEASUREMENT
/begin MEASUREMENT Z_dsvlu "Zyklusflag: Drucksensorsignalvergleich (DS-L DS-U)" UWORD B_TRUE 1 100 0 1 BIT_MASK 0x2 FUNCTION_LIST DFPM_GGDSAS IF_DATA DIM_X 0x383854 EXTERN BYTE IF_DATA MCMESS 0x383854 EXTERN /end MEASUREMENT
/begin MEASUREMENT Z_dvee "Zyklusflag: DV-E Endstufe" UWORD B_TRUE 1 100 0 1 BIT_MASK 0x2 FUNCTION_LIST DFPM_DDVE IF_DATA DIM_X 0x383856 EXTERN BYTE IF_DATA MCMESS 0x383856 EXTERN /end MEASUREMENT
/begin MEASUREMENT Z_dvef "Zyklusflag: DV-E Fehler bei Federprüfung" UWORD B_TRUE 1 100 0 1 BIT_MASK 0x2 FUNCTION_LIST DFPM_DDVE IF_DATA DIM_X 0x383858 EXTERN BYTE IF_DATA MCMESS 0x383858 EXTERN /end MEASUREMENT
/begin MEASUREMENT Z_dvefo "Zyklusflag: DV-E-Fehler bei Federprüfung ""Öffnen""" UWORD B_TRUE 1 100 0 1 BIT_MASK 0x2 FUNCTION_LIST DFPM_DDVE IF_DATA DIM_X 0x38385A EXTERN BYTE IF_DATA MCMESS 0x38385A EXTERN /end MEASUREMENT
/begin MEASUREMENT Z_dvel "Zyklusflag: DV-E Lageabweichung" UWORD B_TRUE 1 100 0 1 BIT_MASK 0x2 FUNCTION_LIST DFPM_DDVE IF_DATA DIM_X 0x38385C EXTERN BYTE IF_DATA MCMESS 0x38385C EXTERN /end MEASUREMENT
/begin MEASUREMENT Z_dven "Zyklusflag: DV-E Fehler bei Prüfung Notluftposition" UWORD B_TRUE 1 100 0 1 BIT_MASK 0x2 FUNCTION_LIST DFPM_DDVE IF_DATA DIM_X 0x38385E EXTERN BYTE IF_DATA MCMESS 0x38385E EXTERN /end MEASUREMENT
/begin MEASUREMENT Z_dver "Zyklusflag: DV-E Regelbereich" UWORD B_TRUE 1 100 0 1 BIT_MASK 0x2 FUNCTION_LIST DFPM_DDVE IF_DATA DIM_X 0x383860 EXTERN BYTE IF_DATA MCMESS 0x383860 EXTERN /end MEASUREMENT
/begin MEASUREMENT Z_dvet "Zyklusflag: DV-E-Tauscherkennung ohne Adaption" UWORD B_TRUE 1 100 0 1 BIT_MASK 0x2 FUNCTION_LIST DFPM_DDVE IF_DATA DIM_X 0x383862 EXTERN BYTE IF_DATA MCMESS 0x383862 EXTERN /end MEASUREMENT
/begin MEASUREMENT Z_dveu "Zyklusflag: DV-E Fehler beim UMA-Lernen" UWORD B_TRUE 1 100 0 1 BIT_MASK 0x2 FUNCTION_LIST DFPM_DDVE IF_DATA DIM_X 0x383864 EXTERN BYTE IF_DATA MCMESS 0x383864 EXTERN /end MEASUREMENT
/begin MEASUREMENT Z_dveub "Zyklusflag: DV-E-Adaption Abbruch wg. Umweltbedingung" UWORD B_TRUE 1 100 0 1 BIT_MASK 0x2 FUNCTION_LIST DFPM_DDVE IF_DATA DIM_X 0x383866 EXTERN BYTE IF_DATA MCMESS 0x383866 EXTERN /end MEASUREMENT
/begin MEASUREMENT Z_dveuw "Zyklusflag: Fehler bei UMA-Wiederlernen" UWORD B_TRUE 1 100 0 1 BIT_MASK 0x2 FUNCTION_LIST DFPM_DDVE IF_DATA DIM_X 0x383868 EXTERN BYTE IF_DATA MCMESS 0x383868 EXTERN /end MEASUREMENT
/begin MEASUREMENT Z_dvev "Zyklusflag: DV-E Fehler bei Verstärkerabgleich" UWORD B_TRUE 1 100 0 1 BIT_MASK 0x2 FUNCTION_LIST DFPM_DDVE IF_DATA DIM_X 0x38386A EXTERN BYTE IF_DATA MCMESS 0x38386A EXTERN /end MEASUREMENT
/begin MEASUREMENT Z_egfe "Zyklusflag: Eingangsgrößen Füllungserfassung" UWORD B_TRUE 1 100 0 1 BIT_MASK 0x2 FUNCTION_LIST DFPM_EGFE IF_DATA DIM_X 0x38386C EXTERN BYTE IF_DATA MCMESS 0x38386C EXTERN /end MEASUREMENT
/begin MEASUREMENT Z_ev "Zyklusflag: Einspritzventil Endstufe" UWORD B_TRUE 1 100 0 1 BIT_MASK 0x1 FUNCTION_LIST DEVE IF_DATA DIM_X 0xFD44 INTERN BYTE IF_DATA MCMESS 0xFD44 INTERN /end MEASUREMENT
/begin MEASUREMENT Z_ev1 "Zyklusflag: EV von Zyl. 1" UWORD B_TRUE 1 100 0 1 BIT_MASK 0x2 FUNCTION_LIST DFPM_DEKON IF_DATA DIM_X 0x38386E EXTERN BYTE IF_DATA MCMESS 0x38386E EXTERN /end MEASUREMENT
/begin MEASUREMENT Z_ev2 "Zyklusflag:	EV von Zyl. 2" UWORD B_TRUE 1 100 0 1 BIT_MASK 0x2 FUNCTION_LIST DFPM_DEKON IF_DATA DIM_X 0x383870 EXTERN BYTE IF_DATA MCMESS 0x383870 EXTERN /end MEASUREMENT
/begin MEASUREMENT Z_ev3 "Zyklusflag:	EV von Zyl. 3" UWORD B_TRUE 1 100 0 1 BIT_MASK 0x2 FUNCTION_LIST DFPM_DEKON IF_DATA DIM_X 0x383872 EXTERN BYTE IF_DATA MCMESS 0x383872 EXTERN /end MEASUREMENT
/begin MEASUREMENT Z_ev4 "Zyklusflag:	EV von Zyl. 4" UWORD B_TRUE 1 100 0 1 BIT_MASK 0x2 FUNCTION_LIST DFPM_DEKON IF_DATA DIM_X 0x383874 EXTERN BYTE IF_DATA MCMESS 0x383874 EXTERN /end MEASUREMENT
/begin MEASUREMENT Z_ev5 "Zyklusflag:	EV von Zyl. 5" UWORD B_TRUE 1 100 0 1 BIT_MASK 0x2 FUNCTION_LIST DFPM_DEKON IF_DATA DIM_X 0x383876 EXTERN BYTE IF_DATA MCMESS 0x383876 EXTERN /end MEASUREMENT
/begin MEASUREMENT Z_ev6 "Zyklusflag:	EV von Zyl. 6" UWORD B_TRUE 1 100 0 1 BIT_MASK 0x2 FUNCTION_LIST DFPM_DEKON IF_DATA DIM_X 0x383878 EXTERN BYTE IF_DATA MCMESS 0x383878 EXTERN /end MEASUREMENT
/begin MEASUREMENT Z_fgrl "Zyklusflag FGR-Lampe über CAN" UWORD B_TRUE 1 100 0 1 BIT_MASK 0x2 FUNCTION_LIST DFPM_DCFGRL IF_DATA DIM_X 0x38387A EXTERN BYTE IF_DATA MCMESS 0x38387A EXTERN /end MEASUREMENT
/begin MEASUREMENT z_flags_uc "Byte für Status-Bits beim 2-SG-Konzept im Befehlstestes" UBYTE dez 1 100 0 255 FUNCTION_LIST URCRAM IF_DATA DIM_X 0x380C57 EXTERN WORD IF_DATA MCMESS 0x380C57 EXTERN /end MEASUREMENT
/begin MEASUREMENT z_flags_um "Byte für Status-Bits beim 2-SG-Konzept in der Funktionsüberwachung" UBYTE dez 1 100 0 255 FUNCTION_LIST UFURAM IF_DATA DIM_X 0x382E44 EXTERN WORD IF_DATA MCMESS 0x382E44 EXTERN /end MEASUREMENT
/begin MEASUREMENT Z_fp1p "Zyklusflag: Fahrpedal 1. Poti" UWORD B_TRUE 1 100 0 1 BIT_MASK 0x2 FUNCTION_LIST DFPM_GGPED IF_DATA DIM_X 0x38387C EXTERN BYTE IF_DATA MCMESS 0x38387C EXTERN /end MEASUREMENT
/begin MEASUREMENT Z_fp2p "Zyklusflag: Fahrpedal 2. Poti" UWORD B_TRUE 1 100 0 1 BIT_MASK 0x2 FUNCTION_LIST DFPM_GGPED IF_DATA DIM_X 0x38387E EXTERN BYTE IF_DATA MCMESS 0x38387E EXTERN /end MEASUREMENT
/begin MEASUREMENT Z_fpp "Zyklusflag Fahrpedal-Poti" UWORD B_TRUE 1 100 0 1 BIT_MASK 0x2 FUNCTION_LIST DFPM_GGPED IF_DATA DIM_X 0x383880 EXTERN BYTE IF_DATA MCMESS 0x383880 EXTERN /end MEASUREMENT
/begin MEASUREMENT Z_frao "Zyklusflag:LR-Adaption oberer multiplikativer Bereich" UWORD B_TRUE 1 100 0 1 BIT_MASK 0x2 FUNCTION_LIST DFPM_DKVS IF_DATA DIM_X 0x383882 EXTERN BYTE IF_DATA MCMESS 0x383882 EXTERN /end MEASUREMENT
/begin MEASUREMENT Z_frao2 "Zyklusflag:LR-Adaption oberer multiplikativer Bereich Bank2" UWORD B_TRUE 1 100 0 1 BIT_MASK 0x2 FUNCTION_LIST DFPM_DKVS IF_DATA DIM_X 0x383884 EXTERN BYTE IF_DATA MCMESS 0x383884 EXTERN /end MEASUREMENT
/begin MEASUREMENT Z_frau "Zyklusflag:LR-Adaption unterer multiplikativer Bereich" UWORD B_TRUE 1 100 0 1 BIT_MASK 0x2 FUNCTION_LIST DFPM_DKVS IF_DATA DIM_X 0x383886 EXTERN BYTE IF_DATA MCMESS 0x383886 EXTERN /end MEASUREMENT
/begin MEASUREMENT Z_frau2 "Zyklusflag:LR-Adaption unterer multiplikativer Bereich Bank 2" UWORD B_TRUE 1 100 0 1 BIT_MASK 0x2 FUNCTION_LIST DFPM_DKVS IF_DATA DIM_X 0x383888 EXTERN BYTE IF_DATA MCMESS 0x383888 EXTERN /end MEASUREMENT
/begin MEASUREMENT Z_frst "Zyklusmeldung Diagnose Kraftstoffversorgungssystem (Kurztest)" UWORD B_TRUE 1 100 0 1 BIT_MASK 0x2 FUNCTION_LIST DFPM_DKVS IF_DATA DIM_X 0x38388A EXTERN BYTE IF_DATA MCMESS 0x38388A EXTERN /end MEASUREMENT
/begin MEASUREMENT Z_frst2 "Zyklusmeldung Diagnose Kraftstoffversorgungssystem (Kurztest Bank 2)" UWORD B_TRUE 1 100 0 1 BIT_MASK 0x2 FUNCTION_LIST DFPM_DKVS IF_DATA DIM_X 0x38388C EXTERN BYTE IF_DATA MCMESS 0x38388C EXTERN /end MEASUREMENT
/begin MEASUREMENT Z_hsh "Zyklusflag:Lambdasonden-Heizung hinter Katalysator" UWORD B_TRUE 1 100 0 1 BIT_MASK 0x2 FUNCTION_LIST DFPM_DHLSHK IF_DATA DIM_X 0x38388E EXTERN BYTE IF_DATA MCMESS 0x38388E EXTERN /end MEASUREMENT
/begin MEASUREMENT Z_hsh2 "Zyklusflag:Lambdasonden-Heizung hinter Katalysator, Bank2" UWORD B_TRUE 1 100 0 1 BIT_MASK 0x2 FUNCTION_LIST DFPM_DHLSHK IF_DATA DIM_X 0x383890 EXTERN BYTE IF_DATA MCMESS 0x383890 EXTERN /end MEASUREMENT
/begin MEASUREMENT Z_hshe "Zyklusflag:Lambdasonden-Heizung hinter Katalysator (Endstufe)" UWORD B_TRUE 1 100 0 1 BIT_MASK 0x2 FUNCTION_LIST DFPM_DEKON IF_DATA DIM_X 0x383892 EXTERN BYTE IF_DATA MCMESS 0x383892 EXTERN /end MEASUREMENT
/begin MEASUREMENT Z_hshe2 "Zyklusflag:Lambdasonden-Heizung hinter Katalysator, Bank2 (Endstufe)" UWORD B_TRUE 1 100 0 1 BIT_MASK 0x2 FUNCTION_LIST DFPM_DEKON IF_DATA DIM_X 0x383894 EXTERN BYTE IF_DATA MCMESS 0x383894 EXTERN /end MEASUREMENT
/begin MEASUREMENT Z_hsv "Zyklusflag:Lambdasonden-Heizung vor Katalysator" UWORD B_TRUE 1 100 0 1 BIT_MASK 0x2 FUNCTION_LIST DFPM_DHLSU IF_DATA DIM_X 0x383896 EXTERN BYTE IF_DATA MCMESS 0x383896 EXTERN /end MEASUREMENT
/begin MEASUREMENT Z_hsv2 "Zyklusflag:Lambdasonden-Heizung vor Katalysator, Bank2" UWORD B_TRUE 1 100 0 1 BIT_MASK 0x2 FUNCTION_LIST DFPM_DHLSU IF_DATA DIM_X 0x383898 EXTERN BYTE IF_DATA MCMESS 0x383898 EXTERN /end MEASUREMENT
/begin MEASUREMENT Z_hsvsa "Zyklusflag:  reduzierte  LSU-Heizung oder LSU-Kennlinie abgeflacht" UWORD B_TRUE 1 100 0 1 BIT_MASK 0x2 FUNCTION_LIST DFPM_DHLSU IF_DATA DIM_X 0x38389A EXTERN BYTE IF_DATA MCMESS 0x38389A EXTERN /end MEASUREMENT
/begin MEASUREMENT Z_hsvsa2 "Zyklusflag: reduzierte  LSU_2-Heizung oder LSU_2-Kennlinie abgeflacht" UWORD B_TRUE 1 100 0 1 BIT_MASK 0x2 FUNCTION_LIST DFPM_DHLSU IF_DATA DIM_X 0x38389C EXTERN BYTE IF_DATA MCMESS 0x38389C EXTERN /end MEASUREMENT
/begin MEASUREMENT Z_kat "Zyklusflag:	Katalysator-Konvertierung" UWORD B_TRUE 1 100 0 1 BIT_MASK 0x2 FUNCTION_LIST DFPM_DKAT IF_DATA DIM_X 0x38389E EXTERN BYTE IF_DATA MCMESS 0x38389E EXTERN /end MEASUREMENT
/begin MEASUREMENT Z_kat2 "Zyklusflag:	Katalysator-Konvertierung	(Bank 2)" UWORD B_TRUE 1 100 0 1 BIT_MASK 0x2 FUNCTION_LIST DFPM_DKAT IF_DATA DIM_X 0x3838A0 EXTERN BYTE IF_DATA MCMESS 0x3838A0 EXTERN /end MEASUREMENT
/begin MEASUREMENT Z_kos "Zyklusflag:	Klimakompressorsteuerung" UWORD B_TRUE 1 100 0 1 BIT_MASK 0x2 FUNCTION_LIST DFPM_DEKON IF_DATA DIM_X 0x3838A2 EXTERN BYTE IF_DATA MCMESS 0x3838A2 EXTERN /end MEASUREMENT
/begin MEASUREMENT Z_kpe "Zyklusflag: EKP-Relais Endstufe" UWORD B_TRUE 1 100 0 1 BIT_MASK 0x2 FUNCTION_LIST DFPM_DEKON IF_DATA DIM_X 0x3838A4 EXTERN BYTE IF_DATA MCMESS 0x3838A4 EXTERN /end MEASUREMENT
/begin MEASUREMENT Z_krnt "Zyklusflag: Klopfregelung Nulltest" UWORD B_TRUE 1 100 0 1 BIT_MASK 0x2 FUNCTION_LIST DFPM_DKRNT IF_DATA DIM_X 0x3838A6 EXTERN BYTE IF_DATA MCMESS 0x3838A6 EXTERN /end MEASUREMENT
/begin MEASUREMENT Z_krof "Zyklusflag: Klopfregelung Offset" UWORD B_TRUE 1 100 0 1 BIT_MASK 0x2 FUNCTION_LIST DFPM_DKRNT IF_DATA DIM_X 0x3838A8 EXTERN BYTE IF_DATA MCMESS 0x3838A8 EXTERN /end MEASUREMENT
/begin MEASUREMENT Z_krtp "Zyklusflag: Klopfregelung Testimpuls" UWORD B_TRUE 1 100 0 1 BIT_MASK 0x2 FUNCTION_LIST DFPM_DKRTP IF_DATA DIM_X 0x3838AA EXTERN BYTE IF_DATA MCMESS 0x3838AA EXTERN /end MEASUREMENT
/begin MEASUREMENT Z_ks1 "Zyklusflag: Klopfsensor 1" UWORD B_TRUE 1 100 0 1 BIT_MASK 0x2 FUNCTION_LIST DFPM_DKRS IF_DATA DIM_X 0x3838AC EXTERN BYTE IF_DATA MCMESS 0x3838AC EXTERN /end MEASUREMENT
/begin MEASUREMENT Z_ks2 "Zyklusflag:	Klopfsensor 2" UWORD B_TRUE 1 100 0 1 BIT_MASK 0x2 FUNCTION_LIST DFPM_DKRS IF_DATA DIM_X 0x3838AE EXTERN BYTE IF_DATA MCMESS 0x3838AE EXTERN /end MEASUREMENT
/begin MEASUREMENT Z_ks3 "Zyklusflag:	Klopfsensor 3" UWORD B_TRUE 1 100 0 1 BIT_MASK 0x2 FUNCTION_LIST DFPM_DKRS IF_DATA DIM_X 0x3838B0 EXTERN BYTE IF_DATA MCMESS 0x3838B0 EXTERN /end MEASUREMENT
/begin MEASUREMENT Z_ks4 "Zyklusflag:	Klopfsensor 4" UWORD B_TRUE 1 100 0 1 BIT_MASK 0x2 FUNCTION_LIST DFPM_DKRS IF_DATA DIM_X 0x3838B2 EXTERN BYTE IF_DATA MCMESS 0x3838B2 EXTERN /end MEASUREMENT
/begin MEASUREMENT Z_kuppl "Zyklusflag: Kupplung betaetigt" UWORD B_TRUE 1 100 0 1 BIT_MASK 0x2 FUNCTION_LIST DFPM_DKUPPL IF_DATA DIM_X 0x3838B4 EXTERN BYTE IF_DATA MCMESS 0x3838B4 EXTERN /end MEASUREMENT
/begin MEASUREMENT Z_kwave "Zykluslag: Kühlwasserabsperrventil Endstufe" UWORD B_TRUE 1 100 0 1 BIT_MASK 0x2 FUNCTION_LIST DFPM_DEKON IF_DATA DIM_X 0x3838B6 EXTERN BYTE IF_DATA MCMESS 0x3838B6 EXTERN /end MEASUREMENT
/begin MEASUREMENT Z_lash "Zyklusflag:Lambda-Sondenalterung hinter Kat." UWORD B_TRUE 1 100 0 1 BIT_MASK 0x2 FUNCTION_LIST DFPM_DLSAHK IF_DATA DIM_X 0x3838B8 EXTERN BYTE IF_DATA MCMESS 0x3838B8 EXTERN /end MEASUREMENT
/begin MEASUREMENT Z_lash2 "Zyklusflag:	Lambda-Sondenalterung hinter Kat. (Bank 2)" UWORD B_TRUE 1 100 0 1 BIT_MASK 0x2 FUNCTION_LIST DFPM_DLSAHK IF_DATA DIM_X 0x3838BA EXTERN BYTE IF_DATA MCMESS 0x3838BA EXTERN /end MEASUREMENT
/begin MEASUREMENT Z_lde "Zyklusflag: Ladedrucksteuerventil (Endstufe)" UWORD B_TRUE 1 100 0 1 BIT_MASK 0x2 FUNCTION_LIST DFPM_DEKON IF_DATA DIM_X 0x3838BC EXTERN BYTE IF_DATA MCMESS 0x3838BC EXTERN /end MEASUREMENT
/begin MEASUREMENT Z_ldo "Zyklusflag:	Ladedruckkennlinie; oberer Wert überschritten" UWORD B_TRUE 1 100 0 1 BIT_MASK 0x2 FUNCTION_LIST DFPM_DLDR IF_DATA DIM_X 0x3838BE EXTERN BYTE IF_DATA MCMESS 0x3838BE EXTERN /end MEASUREMENT
/begin MEASUREMENT Z_ldra "Zyklusflag:	Ladedruckregelabweichung" UWORD B_TRUE 1 100 0 1 BIT_MASK 0x2 FUNCTION_LIST DFPM_DLDR IF_DATA DIM_X 0x3838C0 EXTERN BYTE IF_DATA MCMESS 0x3838C0 EXTERN /end MEASUREMENT
/begin MEASUREMENT Z_lf1e "Zyklusflag: Lüfter1 Endstufe" UWORD B_TRUE 1 100 0 1 BIT_MASK 0x2 FUNCTION_LIST DFPM_DEKON IF_DATA DIM_X 0x3838C2 EXTERN BYTE IF_DATA MCMESS 0x3838C2 EXTERN /end MEASUREMENT
/begin MEASUREMENT Z_lf2e "Zyklusflag: Lüfter2 Endstufe" UWORD B_TRUE 1 100 0 1 BIT_MASK 0x2 FUNCTION_LIST DFPM_DEKON IF_DATA DIM_X 0x3838C4 EXTERN BYTE IF_DATA MCMESS 0x3838C4 EXTERN /end MEASUREMENT
/begin MEASUREMENT Z_lf3e "Zyklusflag: Lüfter3 Endstufe" UWORD B_TRUE 1 100 0 1 BIT_MASK 0x2 FUNCTION_LIST DFPM_DEKON IF_DATA DIM_X 0x3838C6 EXTERN BYTE IF_DATA MCMESS 0x3838C6 EXTERN /end MEASUREMENT
/begin MEASUREMENT Z_llr "Zyklusflag: Diagnose Leerlaufregelung, Steller" UWORD B_TRUE 1 100 0 1 BIT_MASK 0x2 FUNCTION_LIST DFPM_DLLR IF_DATA DIM_X 0x3838C8 EXTERN BYTE IF_DATA MCMESS 0x3838C8 EXTERN /end MEASUREMENT
/begin MEASUREMENT Z_lm "Zyklusflag:	LMM/HLM/HFM" UWORD B_TRUE 1 100 0 1 BIT_MASK 0x2 FUNCTION_LIST DFPM_DHFM IF_DATA DIM_X 0x3838CA EXTERN BYTE IF_DATA MCMESS 0x3838CA EXTERN /end MEASUREMENT
/begin MEASUREMENT Z_lsh "Zyklusflag: Lambda-Sonde hinter Kat" UWORD B_TRUE 1 100 0 1 BIT_MASK 0x2 FUNCTION_LIST DFPM_DLSH IF_DATA DIM_X 0x3838CC EXTERN BYTE IF_DATA MCMESS 0x3838CC EXTERN /end MEASUREMENT
/begin MEASUREMENT Z_lsh2 "Zyklusflag: Lambda-Sonde hinter Kat Bank2" UWORD B_TRUE 1 100 0 1 BIT_MASK 0x2 FUNCTION_LIST DFPM_DLSH IF_DATA DIM_X 0x3838CE EXTERN BYTE IF_DATA MCMESS 0x3838CE EXTERN /end MEASUREMENT
/begin MEASUREMENT Z_lsv "Zyklusflag: Lambda-Sonde vor Kat" UWORD B_TRUE 1 100 0 1 BIT_MASK 0x2 FUNCTION_LIST DFPM_DLSU IF_DATA DIM_X 0x3838D0 EXTERN BYTE IF_DATA MCMESS 0x3838D0 EXTERN /end MEASUREMENT
/begin MEASUREMENT Z_lsv2 "Zyklusflag: Lambda-Sonde 2 vor Kat" UWORD B_TRUE 1 100 0 1 BIT_MASK 0x2 FUNCTION_LIST DFPM_DLSU IF_DATA DIM_X 0x3838D2 EXTERN BYTE IF_DATA MCMESS 0x3838D2 EXTERN /end MEASUREMENT
/begin MEASUREMENT Z_lsvv "Zyklusflag: Vertauschte Lambda-Sonden vor Kat" UWORD B_TRUE 1 100 0 1 BIT_MASK 0x2 FUNCTION_LIST DFPM_LSVV IF_DATA DIM_X 0x3838D4 EXTERN BYTE IF_DATA MCMESS 0x3838D4 EXTERN /end MEASUREMENT
/begin MEASUREMENT Z_md "Zyklusflag: Aussetzer, Summenfehler (multiple)" UWORD B_TRUE 1 100 0 1 BIT_MASK 0x2 FUNCTION_LIST DFPM_DMDMIL IF_DATA DIM_X 0x3838D6 EXTERN BYTE IF_DATA MCMESS 0x3838D6 EXTERN /end MEASUREMENT
/begin MEASUREMENT Z_md00 "Zyklusflag: Aussetzer Zündung 0" UWORD B_TRUE 1 100 0 1 BIT_MASK 0x2 FUNCTION_LIST DFPM_DMDMIL IF_DATA DIM_X 0x3838D8 EXTERN BYTE IF_DATA MCMESS 0x3838D8 EXTERN /end MEASUREMENT
/begin MEASUREMENT Z_md01 "Zyklusflag: Aussetzer Zündung 1" UWORD B_TRUE 1 100 0 1 BIT_MASK 0x2 FUNCTION_LIST DFPM_DMDMIL IF_DATA DIM_X 0x3838DA EXTERN BYTE IF_DATA MCMESS 0x3838DA EXTERN /end MEASUREMENT
/begin MEASUREMENT Z_md02 "Zyklusflag: Aussetzer Zündung 2" UWORD B_TRUE 1 100 0 1 BIT_MASK 0x2 FUNCTION_LIST DFPM_DMDMIL IF_DATA DIM_X 0x3838DC EXTERN BYTE IF_DATA MCMESS 0x3838DC EXTERN /end MEASUREMENT
/begin MEASUREMENT Z_md03 "Zyklusflag: Aussetzer Zündung 3" UWORD B_TRUE 1 100 0 1 BIT_MASK 0x2 FUNCTION_LIST DFPM_DMDMIL IF_DATA DIM_X 0x3838DE EXTERN BYTE IF_DATA MCMESS 0x3838DE EXTERN /end MEASUREMENT
/begin MEASUREMENT Z_md04 "Zyklusflag: Aussetzer Zündung 4" UWORD B_TRUE 1 100 0 1 BIT_MASK 0x2 FUNCTION_LIST DFPM_DMDMIL IF_DATA DIM_X 0x3838E0 EXTERN BYTE IF_DATA MCMESS 0x3838E0 EXTERN /end MEASUREMENT
/begin MEASUREMENT Z_md05 "Zyklusflag: Aussetzer Zündung 5" UWORD B_TRUE 1 100 0 1 BIT_MASK 0x2 FUNCTION_LIST DFPM_DMDMIL IF_DATA DIM_X 0x3838E2 EXTERN BYTE IF_DATA MCMESS 0x3838E2 EXTERN /end MEASUREMENT
/begin MEASUREMENT Z_mdb "Zyklusflag: Momentenbegrenzung begrenzt dauerhaft" UWORD B_TRUE 1 100 0 1 BIT_MASK 0x2 FUNCTION_LIST DFPM_MDKOG IF_DATA DIM_X 0x3838E4 EXTERN BYTE IF_DATA MCMESS 0x3838E4 EXTERN /end MEASUREMENT
/begin MEASUREMENT Z_msg "Zyklusflag: Motorraumspülgebläse" UWORD B_TRUE 1 100 0 1 BIT_MASK 0x2 FUNCTION_LIST DFPM_MLS IF_DATA DIM_X 0x3838E6 EXTERN BYTE IF_DATA MCMESS 0x3838E6 EXTERN /end MEASUREMENT
/begin MEASUREMENT Z_msge "Zyklusflag: Motorraumspülgebläse Endstufe" UWORD B_TRUE 1 100 0 1 BIT_MASK 0x2 FUNCTION_LIST DFPM_DEKON IF_DATA DIM_X 0x3838E8 EXTERN BYTE IF_DATA MCMESS 0x3838E8 EXTERN /end MEASUREMENT
/begin MEASUREMENT Z_n "Zyklusflag: Drehzahlsignalgeber" UWORD B_TRUE 1 100 0 1 BIT_MASK 0x2 FUNCTION_LIST DFPM_DDG IF_DATA DIM_X 0x3838EA EXTERN BYTE IF_DATA MCMESS 0x3838EA EXTERN /end MEASUREMENT
/begin MEASUREMENT Z_nwkw "Zyklusflag: Zuordnung Nockenwelle zu Kurbelwelle" UWORD B_TRUE 1 100 0 1 BIT_MASK 0x2 FUNCTION_LIST DFPM_DNWKW IF_DATA DIM_X 0x3838EC EXTERN BYTE IF_DATA MCMESS 0x3838EC EXTERN /end MEASUREMENT
/begin MEASUREMENT Z_nwkw2 "Zyklusflag: Zuordnung Nockenwelle 2 zu Kurbelwelle" UWORD B_TRUE 1 100 0 1 BIT_MASK 0x2 FUNCTION_LIST DFPM_DNWKW IF_DATA DIM_X 0x3838EE EXTERN BYTE IF_DATA MCMESS 0x3838EE EXTERN /end MEASUREMENT
/begin MEASUREMENT Z_nws "Zyklusflag: Nockenwellensteuerung" UWORD B_TRUE 1 100 0 1 BIT_MASK 0x2 FUNCTION_LIST DFPM_DNWS IF_DATA DIM_X 0x3838F0 EXTERN BYTE IF_DATA MCMESS 0x3838F0 EXTERN /end MEASUREMENT
/begin MEASUREMENT Z_nws2 "Zyklusflag: Nockenwellensteuerung (Bank 2)" UWORD B_TRUE 1 100 0 1 BIT_MASK 0x2 FUNCTION_LIST DFPM_DNWS IF_DATA DIM_X 0x3838F2 EXTERN BYTE IF_DATA MCMESS 0x3838F2 EXTERN /end MEASUREMENT
/begin MEASUREMENT Z_nwse "Zyklusflag: Nockenwellensteuerungsventil Endstufe" UWORD B_TRUE 1 100 0 1 BIT_MASK 0x2 FUNCTION_LIST DFPM_DEKON IF_DATA DIM_X 0x3838F4 EXTERN BYTE IF_DATA MCMESS 0x3838F4 EXTERN /end MEASUREMENT
/begin MEASUREMENT Z_nwse2 "Zyklusflag: Nockenwellensteuerungsventil Endstufe (Bank 2)" UWORD B_TRUE 1 100 0 1 BIT_MASK 0x2 FUNCTION_LIST DFPM_DEKON IF_DATA DIM_X 0x3838F6 EXTERN BYTE IF_DATA MCMESS 0x3838F6 EXTERN /end MEASUREMENT
/begin MEASUREMENT Z_ph "Zyklusflag: Phasensensor" UWORD B_TRUE 1 100 0 1 BIT_MASK 0x2 FUNCTION_LIST DFPM_DPH IF_DATA DIM_X 0x3838F8 EXTERN BYTE IF_DATA MCMESS 0x3838F8 EXTERN /end MEASUREMENT
/begin MEASUREMENT Z_ph2 "Zyklusflag: Phasensensor 2" UWORD B_TRUE 1 100 0 1 BIT_MASK 0x2 FUNCTION_LIST DFPM_DPH IF_DATA DIM_X 0x3838FA EXTERN BYTE IF_DATA MCMESS 0x3838FA EXTERN /end MEASUREMENT
/begin MEASUREMENT Z_rkat "Zyklusflag:LR-Adaption additiv pro Zeit" UWORD B_TRUE 1 100 0 1 BIT_MASK 0x2 FUNCTION_LIST DFPM_DKVS IF_DATA DIM_X 0x3838FC EXTERN BYTE IF_DATA MCMESS 0x3838FC EXTERN /end MEASUREMENT
/begin MEASUREMENT Z_rkat2 "Zyklusflag:LR-Adaption additiv pro Zeit Bank 2" UWORD B_TRUE 1 100 0 1 BIT_MASK 0x2 FUNCTION_LIST DFPM_DKVS IF_DATA DIM_X 0x3838FE EXTERN BYTE IF_DATA MCMESS 0x3838FE EXTERN /end MEASUREMENT
/begin MEASUREMENT Z_rkaz "Zyklusflag:LR-Adaption additiv pro Einspritzung" UWORD B_TRUE 1 100 0 1 BIT_MASK 0x2 FUNCTION_LIST DFPM_DKVS IF_DATA DIM_X 0x383900 EXTERN BYTE IF_DATA MCMESS 0x383900 EXTERN /end MEASUREMENT
/begin MEASUREMENT Z_rkaz2 "Zyklusflag:LR-Adaption additiv pro Einspritzung Bank 2" UWORD B_TRUE 1 100 0 1 BIT_MASK 0x2 FUNCTION_LIST DFPM_DKVS IF_DATA DIM_X 0x383902 EXTERN BYTE IF_DATA MCMESS 0x383902 EXTERN /end MEASUREMENT
/begin MEASUREMENT Z_sgeep "Zyklusflag: Steuergerät defekt (EEPROM)" UWORD B_TRUE 1 100 0 1 BIT_MASK 0x2 FUNCTION_LIST DFPM_DSGEEP IF_DATA DIM_X 0x383904 EXTERN BYTE IF_DATA MCMESS 0x383904 EXTERN /end MEASUREMENT
/begin MEASUREMENT Z_slpe "Zyklusflag: Sekundärluftpumpe (Endstufe)" UWORD B_TRUE 1 100 0 1 BIT_MASK 0x2 FUNCTION_LIST DFPM_DEKON IF_DATA DIM_X 0x383906 EXTERN BYTE IF_DATA MCMESS 0x383906 EXTERN /end MEASUREMENT
/begin MEASUREMENT Z_sls "Zyklusflag: Sekundärluft-System" UWORD B_TRUE 1 100 0 1 BIT_MASK 0x2 FUNCTION_LIST DFPM_DSLSLRS IF_DATA DIM_X 0x383908 EXTERN BYTE IF_DATA MCMESS 0x383908 EXTERN /end MEASUREMENT
/begin MEASUREMENT Z_sls2 "Zyklusflag: Sekundärluft-System Bank 2" UWORD B_TRUE 1 100 0 1 BIT_MASK 0x2 FUNCTION_LIST DFPM_DSLSLRS IF_DATA DIM_X 0x38390A EXTERN BYTE IF_DATA MCMESS 0x38390A EXTERN /end MEASUREMENT
/begin MEASUREMENT Z_slv "Zyklusflag: Sekundärluftventil" UWORD B_TRUE 1 100 0 1 BIT_MASK 0x2 FUNCTION_LIST DFPM_DSLSLRS IF_DATA DIM_X 0x38390C EXTERN BYTE IF_DATA MCMESS 0x38390C EXTERN /end MEASUREMENT
/begin MEASUREMENT Z_slv2 "Zyklusflag: Sekundärluftventil, Bank 2" UWORD B_TRUE 1 100 0 1 BIT_MASK 0x2 FUNCTION_LIST DFPM_DSLSLRS IF_DATA DIM_X 0x38390E EXTERN BYTE IF_DATA MCMESS 0x38390E EXTERN /end MEASUREMENT
/begin MEASUREMENT Z_slve "Zyklusflag:	Sekundärluftventil (Endstufe)" UWORD B_TRUE 1 100 0 1 BIT_MASK 0x2 FUNCTION_LIST DFPM_DEKON IF_DATA DIM_X 0x383910 EXTERN BYTE IF_DATA MCMESS 0x383910 EXTERN /end MEASUREMENT
/begin MEASUREMENT Z_swe "Zyklusflag: Beschleunigungssensor der Schlechtwegeerkennung" UWORD B_TRUE 1 100 0 1 BIT_MASK 0x2 FUNCTION_LIST DFPM_BGRBS IF_DATA DIM_X 0x383912 EXTERN BYTE IF_DATA MCMESS 0x383912 EXTERN /end MEASUREMENT
/begin MEASUREMENT Z_ta "Zyklusflag: TANS" UWORD B_TRUE 1 100 0 1 BIT_MASK 0x2 FUNCTION_LIST DFPM_GGTFA IF_DATA DIM_X 0x383914 EXTERN BYTE IF_DATA MCMESS 0x383914 EXTERN /end MEASUREMENT
/begin MEASUREMENT Z_tes "Zyklusflag: Tankentlüftungssystem" UWORD B_TRUE 1 100 0 1 BIT_MASK 0x2 FUNCTION_LIST DFPM_DTEV IF_DATA DIM_X 0x383916 EXTERN BYTE IF_DATA MCMESS 0x383916 EXTERN /end MEASUREMENT
/begin MEASUREMENT Z_teve "Zyklusflag:	Tankentlüftungsventil Endstufe" UWORD B_TRUE 1 100 0 1 BIT_MASK 0x2 FUNCTION_LIST DFPM_DEKON IF_DATA DIM_X 0x383918 EXTERN BYTE IF_DATA MCMESS 0x383918 EXTERN /end MEASUREMENT
/begin MEASUREMENT Z_teve2 "Zyklusflag: Tankentlüftungsventil Endstufe 2" UWORD B_TRUE 1 100 0 1 BIT_MASK 0x2 FUNCTION_LIST DFPM_DUMMY043 IF_DATA DIM_X 0x38391A EXTERN BYTE IF_DATA MCMESS 0x38391A EXTERN /end MEASUREMENT
/begin MEASUREMENT Z_tget "Zyklusflag: Getriebetemperatur" UWORD B_TRUE 1 100 0 1 BIT_MASK 0x2 FUNCTION_LIST DFPM_GGTGET IF_DATA DIM_X 0x38391C EXTERN BYTE IF_DATA MCMESS 0x38391C EXTERN /end MEASUREMENT
/begin MEASUREMENT Z_thm "Zyklusflg Kühlwasser-Thermostat" UWORD B_TRUE 1 100 0 1 BIT_MASK 0x2 FUNCTION_LIST DFPM_GGTFM IF_DATA DIM_X 0x38391E EXTERN BYTE IF_DATA MCMESS 0x38391E EXTERN /end MEASUREMENT
/begin MEASUREMENT Z_tm "Zyklusflag:	TMOT" UWORD B_TRUE 1 100 0 1 BIT_MASK 0x2 FUNCTION_LIST DFPM_GGTFM IF_DATA DIM_X 0x383920 EXTERN BYTE IF_DATA MCMESS 0x383920 EXTERN /end MEASUREMENT
/begin MEASUREMENT Z_tmki "Zyklusflag: Motortemperatur aus Kombiinstrument" UWORD B_TRUE 1 100 0 1 BIT_MASK 0x2 FUNCTION_LIST DFPM_DUMMY043 IF_DATA DIM_X 0x383922 EXTERN BYTE IF_DATA MCMESS 0x383922 EXTERN /end MEASUREMENT
/begin MEASUREMENT Z_tmr "Zyklusflag: Motorraumtemperatur TMR" UWORD B_TRUE 1 100 0 1 BIT_MASK 0x2 FUNCTION_LIST DFPM_GGTFMR IF_DATA DIM_X 0x383924 EXTERN BYTE IF_DATA MCMESS 0x383924 EXTERN /end MEASUREMENT
/begin MEASUREMENT Z_tol "Zyklusflag: Öltemperatur" UWORD B_TRUE 1 100 0 1 BIT_MASK 0x2 FUNCTION_LIST DFPM_GGTFOL IF_DATA DIM_X 0x383926 EXTERN BYTE IF_DATA MCMESS 0x383926 EXTERN /end MEASUREMENT
/begin MEASUREMENT Z_tum "Zyklusflag: Umgebungstemperatur TUM" UWORD B_TRUE 1 100 0 1 BIT_MASK 0x2 FUNCTION_LIST DFPM_GGTFUMG IF_DATA DIM_X 0x383928 EXTERN BYTE IF_DATA MCMESS 0x383928 EXTERN /end MEASUREMENT
/begin MEASUREMENT Z_ub "Zyklusflag:	UB" UWORD B_TRUE 1 100 0 1 BIT_MASK 0x2 FUNCTION_LIST DFPM_GGUB IF_DATA DIM_X 0x38392A EXTERN BYTE IF_DATA MCMESS 0x38392A EXTERN /end MEASUREMENT
/begin MEASUREMENT Z_ufmv "Zyklusflag: Funktionsüberwachung: Momentenvergleich" UWORD B_TRUE 1 100 0 1 BIT_MASK 0x2 FUNCTION_LIST DFPM_DUF IF_DATA DIM_X 0x38392C EXTERN BYTE IF_DATA MCMESS 0x38392C EXTERN /end MEASUREMENT
/begin MEASUREMENT Z_ufska "Zyklusflag: Funktionsüberwachung: Sicherheits-Kraftstoff-Abschaltung" UWORD B_TRUE 1 100 0 1 BIT_MASK 0x2 FUNCTION_LIST DFPM_DUF IF_DATA DIM_X 0x38392E EXTERN BYTE IF_DATA MCMESS 0x38392E EXTERN /end MEASUREMENT
/begin MEASUREMENT Z_urram "Zyklusflag: Rechnerüberwachung: RAM" UWORD B_TRUE 1 100 0 1 BIT_MASK 0x2 FUNCTION_LIST DFPM_DUR IF_DATA DIM_X 0x383930 EXTERN BYTE IF_DATA MCMESS 0x383930 EXTERN /end MEASUREMENT
/begin MEASUREMENT Z_urrom "Zyklusflag: Rechnerüberwachung: ROM" UWORD B_TRUE 1 100 0 1 BIT_MASK 0x2 FUNCTION_LIST DFPM_DUR IF_DATA DIM_X 0x383932 EXTERN BYTE IF_DATA MCMESS 0x383932 EXTERN /end MEASUREMENT
/begin MEASUREMENT Z_urrst "Zyklusflag: Rechnerüberwachung: Reset" UWORD B_TRUE 1 100 0 1 BIT_MASK 0x2 FUNCTION_LIST DFPM_DUR IF_DATA DIM_X 0x383934 EXTERN BYTE IF_DATA MCMESS 0x383934 EXTERN /end MEASUREMENT
/begin MEASUREMENT Z_uvse "Zyklusflag: Endstufe Umluftventil Turbo" UWORD B_TRUE 1 100 0 1 BIT_MASK 0x2 FUNCTION_LIST DFPM_DEKON IF_DATA DIM_X 0x383936 EXTERN BYTE IF_DATA MCMESS 0x383936 EXTERN /end MEASUREMENT
/begin MEASUREMENT Z_vfz "Zyklusflag: Fahrzeug-Geschwindigkeit" UWORD B_TRUE 1 100 0 1 BIT_MASK 0x2 FUNCTION_LIST DFPM_DVFZ IF_DATA DIM_X 0x383938 EXTERN BYTE IF_DATA MCMESS 0x383938 EXTERN /end MEASUREMENT
/begin MEASUREMENT Z_vs01 "Zyklusflag: Ventilhubsteuerung Zdg.1" UWORD B_TRUE 1 100 0 1 BIT_MASK 0x2 FUNCTION_LIST DFPM_DVS IF_DATA DIM_X 0x38393A EXTERN BYTE IF_DATA MCMESS 0x38393A EXTERN /end MEASUREMENT
/begin MEASUREMENT Z_vs02 "Zyklusflag: Ventilhubsteuerung Zdg.2" UWORD B_TRUE 1 100 0 1 BIT_MASK 0x2 FUNCTION_LIST DFPM_DVS IF_DATA DIM_X 0x38393C EXTERN BYTE IF_DATA MCMESS 0x38393C EXTERN /end MEASUREMENT
/begin MEASUREMENT Z_vs03 "Zyklusflag: Ventilhubsteuerung Zdg.3" UWORD B_TRUE 1 100 0 1 BIT_MASK 0x2 FUNCTION_LIST DFPM_DVS IF_DATA DIM_X 0x38393E EXTERN BYTE IF_DATA MCMESS 0x38393E EXTERN /end MEASUREMENT
/begin MEASUREMENT Z_vs04 "Zyklusflag: Ventilhubsteuerung Zdg.4" UWORD B_TRUE 1 100 0 1 BIT_MASK 0x2 FUNCTION_LIST DFPM_DVS IF_DATA DIM_X 0x383940 EXTERN BYTE IF_DATA MCMESS 0x383940 EXTERN /end MEASUREMENT
/begin MEASUREMENT Z_vs05 "Zyklusflag: Ventilhubsteuerung Zdg.5" UWORD B_TRUE 1 100 0 1 BIT_MASK 0x2 FUNCTION_LIST DFPM_DVS IF_DATA DIM_X 0x383942 EXTERN BYTE IF_DATA MCMESS 0x383942 EXTERN /end MEASUREMENT
/begin MEASUREMENT Z_vs06 "Zyklusflag: Ventilhubsteuerung Zdg.6" UWORD B_TRUE 1 100 0 1 BIT_MASK 0x2 FUNCTION_LIST DFPM_DVS IF_DATA DIM_X 0x383944 EXTERN BYTE IF_DATA MCMESS 0x383944 EXTERN /end MEASUREMENT
/begin MEASUREMENT Z_vs1e "Zyklus Flag: Endstufe Ventilhubsteuerung 1" UWORD B_TRUE 1 100 0 1 BIT_MASK 0x2 FUNCTION_LIST DFPM_DEKON IF_DATA DIM_X 0x383946 EXTERN BYTE IF_DATA MCMESS 0x383946 EXTERN /end MEASUREMENT
/begin MEASUREMENT Z_vs2e "Zyklus Flag: Endstufe Ventilhubsteuerung 2" UWORD B_TRUE 1 100 0 1 BIT_MASK 0x2 FUNCTION_LIST DFPM_DEKON IF_DATA DIM_X 0x383948 EXTERN BYTE IF_DATA MCMESS 0x383948 EXTERN /end MEASUREMENT
/begin MEASUREMENT Z_vsb1 "Zyklusflag: Ventilhubsteuerung (Bankselektiv)" UWORD B_TRUE 1 100 0 1 BIT_MASK 0x2 FUNCTION_LIST DFPM_DVS IF_DATA DIM_X 0x38394A EXTERN BYTE IF_DATA MCMESS 0x38394A EXTERN /end MEASUREMENT
/begin MEASUREMENT Z_vsb2 "Zyklusflag: Ventilhubsteuerung (Bankselektiv)" UWORD B_TRUE 1 100 0 1 BIT_MASK 0x2 FUNCTION_LIST DFPM_DVS IF_DATA DIM_X 0x38394C EXTERN BYTE IF_DATA MCMESS 0x38394C EXTERN /end MEASUREMENT
/begin MEASUREMENT Z_vss "Zyklus Flag: Ventilhubsteuerung (Summenfehler)" UWORD B_TRUE 1 100 0 1 BIT_MASK 0x2 FUNCTION_LIST DFPM_DVS IF_DATA DIM_X 0x38394E EXTERN BYTE IF_DATA MCMESS 0x38394E EXTERN /end MEASUREMENT
/begin MEASUREMENT Z_wfs "Zyklusflag: Wegfahrsperre" UWORD B_TRUE 1 100 0 1 BIT_MASK 0x2 FUNCTION_LIST DFPM_WFS IF_DATA DIM_X 0x383950 EXTERN BYTE IF_DATA MCMESS 0x383950 EXTERN /end MEASUREMENT
/begin MEASUREMENT z_zwdykr "Zündungszähler bei gesetztem Bit B_zwkra=1 während der KR-Dynamik" UWORD dez 1 100 0 65535 FUNCTION_LIST KRDY IF_DATA DIM_X 0xFAEE INTERN WORD IF_DATA MCMESS 0xFAEE INTERN /end MEASUREMENT
/begin MEASUREMENT z_zwdymd "Zündungszähler bei nicht gesetztem Bit B_zwkra=0 während der KR-Dynamik" UWORD dez 1 100 0 65535 FUNCTION_LIST KRDY IF_DATA DIM_X 0xFAF0 INTERN WORD IF_DATA MCMESS 0xFAF0 INTERN /end MEASUREMENT
/begin COMPU_METHOD B_TRUE "boolsche Zustände, positive Logik" TAB_VERB "%6.3" "" COMPU_TAB_REF B_TRUE /end COMPU_METHOD
/begin COMPU_VTAB B_TRUE "boolsche Zustände, positive Logik" TAB_VERB 2 0 "----" 1 "TRUE" /end COMPU_VTAB
/begin COMPU_METHOD dez "1 : 1 Umrechnug (dez/hex)" RAT_FUNC "%6.2" "" COEFFS 0 1 0 0 0 1 /end COMPU_METHOD
/begin COMPU_METHOD dtsegn_b720divZyl "" RAT_FUNC "%6.4" "grad/KW" COEFFS 0 273.067 0 0 0 1 /end COMPU_METHOD
/begin COMPU_METHOD fak_sb_b1 "" RAT_FUNC "%6.4" "-" COEFFS 0 256 0 0 0 2 /end COMPU_METHOD
/begin COMPU_METHOD fak_ub_b0p125 "" RAT_FUNC "%6.5" "-" COEFFS 0 256 0 0 0 0.125 /end COMPU_METHOD
/begin COMPU_METHOD fak_ub_b1 "" RAT_FUNC "%6.4" "-" COEFFS 0 256 0 0 0 1 /end COMPU_METHOD
/begin COMPU_METHOD fak_ub_b16 "" RAT_FUNC "%6.4" "-" COEFFS 0 256 0 0 0 16 /end COMPU_METHOD
/begin COMPU_METHOD fak_ub_b1p25_o0p75 "" RAT_FUNC "%6.3" "-" COEFFS 0 1 -0.75 0 0 0.00195313 /end COMPU_METHOD
/begin COMPU_METHOD fak_ub_b2 "" RAT_FUNC "%6.4" "-" COEFFS 0 256 0 0 0 2 /end COMPU_METHOD
/begin COMPU_METHOD fak_ub_b4 "" RAT_FUNC "%6.4" "-" COEFFS 0 256 0 0 0 4 /end COMPU_METHOD
/begin COMPU_METHOD fak_uw_b16 "" RAT_FUNC "%6.5" "-" COEFFS 0 65536 0 0 0 16 /end COMPU_METHOD
/begin COMPU_METHOD fak_uw_b2 "" RAT_FUNC "%7.6" "-" COEFFS 0 65536 0 0 0 2 /end COMPU_METHOD
/begin COMPU_METHOD fak_uw_b4 "" RAT_FUNC "%7.6" "-" COEFFS 0 65536 0 0 0 4 /end COMPU_METHOD
/begin COMPU_METHOD kw_q0p0019 "" RAT_FUNC "%6.4" "°KW" COEFFS 0 512 0 0 0 1 /end COMPU_METHOD
/begin COMPU_METHOD kw_q0p0039 "" RAT_FUNC "%6.4" "°KW" COEFFS 0 256 0 0 0 1 /end COMPU_METHOD
/begin COMPU_METHOD kw_q0p0156 "" RAT_FUNC "%6.4" "°KW" COEFFS 0 64 0 0 0 1 /end COMPU_METHOD
/begin COMPU_METHOD kw_q2 "" RAT_FUNC "%6.2" "°KW" COEFFS 0 1 0 0 0 2 /end COMPU_METHOD
/begin COMPU_METHOD kw_q2p8125 "" RAT_FUNC "%6.2" "°KW" COEFFS 0 1 0 0 0 2.8125 /end COMPU_METHOD
/begin COMPU_METHOD kw_q6 "" RAT_FUNC "%6.2" "°KW" COEFFS 0 1 0 0 0 6 /end COMPU_METHOD
/begin COMPU_METHOD kw_sb_q1 "" RAT_FUNC "%6.2" "°KW" COEFFS 0 1 0 0 0 1 /end COMPU_METHOD
/begin COMPU_METHOD kw_sw_b128 "" RAT_FUNC "%6.4" "°KW" COEFFS 0 65536 0 0 0 256 /end COMPU_METHOD
/begin COMPU_METHOD kw_ub_q0p5 "" RAT_FUNC "%6.3" "°KW" COEFFS 0 256 0 0 0 128 /end COMPU_METHOD
/begin COMPU_METHOD m_ub_b1020 "" RAT_FUNC "%6.2" "kg/h" COEFFS 0 1 0 0 0 4 /end COMPU_METHOD
/begin COMPU_METHOD nmot_ub_q10 "" RAT_FUNC "%6.1" "U/min" COEFFS 0 1 0 0 0 10 /end COMPU_METHOD
/begin COMPU_METHOD nmot_ub_q40 "" RAT_FUNC "%6.1" "Upm" COEFFS 0 1 0 0 0 40 /end COMPU_METHOD
/begin COMPU_METHOD p_ub_q10 "" RAT_FUNC "%6.1" "hPa" COEFFS 0 1 0 0 0 10 /end COMPU_METHOD
/begin COMPU_METHOD relDK_q0p02441 "" RAT_FUNC "%6.4" "% DK" COEFFS 0 65536 0 0 0 1600 /end COMPU_METHOD
/begin COMPU_METHOD relDK_q0p3922 "" RAT_FUNC "%6.3" "% DK" COEFFS 0 255 0 0 0 100 /end COMPU_METHOD
/begin COMPU_METHOD relDK_q6p25 "" RAT_FUNC "%6.2" "% DK" COEFFS 0 256 0 0 0 1600 /end COMPU_METHOD
/begin COMPU_METHOD relDK_ub_b100 "" RAT_FUNC "%6.3" "% DK" COEFFS 0 255 0 0 0 100 /end COMPU_METHOD
/begin COMPU_METHOD relDK_uw_b100 "" RAT_FUNC "%6.4" "% DK" COEFFS 0 65535 0 0 0 100 /end COMPU_METHOD
/begin COMPU_METHOD relPED_ub_b100 "" RAT_FUNC "%6.3" "% PED" COEFFS 0 255 0 0 0 100 /end COMPU_METHOD
/begin COMPU_METHOD relPED_uw_b100 "" RAT_FUNC "%6.4" "% PED" COEFFS 0 65535 0 0 0 100 /end COMPU_METHOD
/begin COMPU_METHOD rel_sb_q0p75 "" RAT_FUNC "%6.3" "%" COEFFS 0 1 0 0 0 0.75 /end COMPU_METHOD
/begin COMPU_METHOD rel_sw_q0p1875 "" RAT_FUNC "%6.3" "%" COEFFS 0 65536 0 0 0 12288 /end COMPU_METHOD
/begin COMPU_METHOD rel_ub_b99p6 "" RAT_FUNC "%6.3" "%" COEFFS 0 256 0 0 0 100 /end COMPU_METHOD
/begin COMPU_METHOD rel_ub_q0p1875 "" RAT_FUNC "%6.3" "Grad KW/ms" COEFFS 0 256 0 0 0 48 /end COMPU_METHOD
/begin COMPU_METHOD rel_ub_q0p3906 "" RAT_FUNC "%6.3" "%" COEFFS 0 256 0 0 0 100 /end COMPU_METHOD
/begin COMPU_METHOD rel_ub_q0p75 "" RAT_FUNC "%6.3" "%" COEFFS 0 1 0 0 0 0.75 /end COMPU_METHOD
/begin COMPU_METHOD rel_uw_b100 "" RAT_FUNC "%6.4" "%" COEFFS 0 65536 0 0 0 100 /end COMPU_METHOD
/begin COMPU_METHOD spgg_q0p52 "" RAT_FUNC "%6.3" "mV/ms" COEFFS 0 1 0 0 0 0.52 /end COMPU_METHOD
/begin COMPU_METHOD spg_q0p00488 "" RAT_FUNC "%6.4" "V" COEFFS 0 1024 0 0 0 5 /end COMPU_METHOD
/begin COMPU_METHOD spg_ubatt "" RAT_FUNC "%6.4" "V" COEFFS 0 1 0 0 0 0.076 /end COMPU_METHOD
/begin COMPU_METHOD spg_ubatt_w "" RAT_FUNC "%6.4" "V" COEFFS 0 1 0 0 0 0.019 /end COMPU_METHOD
/begin COMPU_METHOD spg_ub_b1p33 "" RAT_FUNC "%6.4" "V" COEFFS 0 255 0 0 0 1.33 /end COMPU_METHOD
/begin COMPU_METHOD spg_ub_b5 "" RAT_FUNC "%6.4" "V" COEFFS 0 256 0 0 0 5 /end COMPU_METHOD
/begin COMPU_METHOD spg_ub_q0p0052_o0p2 "" RAT_FUNC "%6.3" "V" COEFFS 0 255 51 0 0 1.33 /end COMPU_METHOD
/begin COMPU_METHOD spg_uw_b1p33 "" RAT_FUNC "%7.6" "V" COEFFS 0 65535 0 0 0 1.33 /end COMPU_METHOD
/begin COMPU_METHOD spg_uw_b5 "" RAT_FUNC "%6.4" "V" COEFFS 0 1024 0 0 0 5 /end COMPU_METHOD
/begin COMPU_METHOD spg_uw_q0p00488 "" RAT_FUNC "%6.4" "V" COEFFS 0 1024 0 0 0 5 /end COMPU_METHOD
/begin COMPU_METHOD spg_uw_q0p00488_o1 "" RAT_FUNC "%6.3" "V" COEFFS 0 1024 1024 0 0 5 /end COMPU_METHOD
/begin COMPU_METHOD s_q1_km "" RAT_FUNC "%6.2" "km" COEFFS 0 1 0 0 0 1 /end COMPU_METHOD
/begin COMPU_METHOD s_q32_km "" RAT_FUNC "%6.1" "km" COEFFS 0 1 0 0 0 32 /end COMPU_METHOD
/begin COMPU_METHOD t100msxs_uw_b6553p5 "" RAT_FUNC "%6.3" "s" COEFFS 0 1 0 0 0 0.1 /end COMPU_METHOD
/begin COMPU_METHOD t100msxs_uw_b6553p6 "" RAT_FUNC "%6.3" "s" COEFFS 0 10 0 0 0 1 /end COMPU_METHOD
/begin COMPU_METHOD temp_ub_q0p75_o48 "" RAT_FUNC "%6.2" "Grad C" COEFFS 0 1 48 0 0 0.75 /end COMPU_METHOD
/begin COMPU_METHOD tsquant "Umrechnung Segmentzeit in DMD" RAT_FUNC "%6.3" "us" COEFFS 0 1.5 0 0 0 1 /end COMPU_METHOD
/begin COMPU_METHOD tv_ub_b100 "" RAT_FUNC "%6.3" "%" COEFFS 0 256 0 0 0 100 /end COMPU_METHOD
/begin COMPU_METHOD vfzg_q1p0 "" RAT_FUNC "%6.2" "km/h" COEFFS 0 1 0 0 0 1 /end COMPU_METHOD
/begin COMPU_METHOD vfzg_ub_q1p25 "" RAT_FUNC "%6.2" "km/h" COEFFS 0 1 0 0 0 1.25 /end COMPU_METHOD
/begin COMPU_METHOD vfzg_ub_q2 "" RAT_FUNC "%6.2" "km/h" COEFFS 0 1 0 0 0 2 /end COMPU_METHOD
/begin COMPU_METHOD vfzg_uw_b325 "" RAT_FUNC "%6.4" "km/h" COEFFS 0 65536 0 0 0 325 /end COMPU_METHOD
/begin COMPU_METHOD vfzg_uw_b512 "" RAT_FUNC "%6.4" "km/h" COEFFS 0 65536 0 0 0 512 /end COMPU_METHOD
/begin COMPU_METHOD vfzg_uw_q0p00781 "" RAT_FUNC "%6.4" "km/h" COEFFS 0 1 0 0 0 0.0078125 /end COMPU_METHOD
/begin COMPU_METHOD vs_uw_b25p6 "" RAT_FUNC "%6.5" "m^3/h" COEFFS 0 65536 0 0 0 25.6 /end COMPU_METHOD
/begin COMPU_METHOD wkw_ub_q0p25 "" RAT_FUNC "%6.3" "° KW" COEFFS 0 100 0 0 0 25 /end COMPU_METHOD
/begin COMPU_METHOD zk10msxs_ub_b2p55 "" RAT_FUNC "%6.4" "s" COEFFS 0 0 255 0 100 0 /end COMPU_METHOD
/begin COMPU_METHOD zk10msxs_uw_b655 "" RAT_FUNC "%10.4" "s" COEFFS 0 0 65536 0 100 0 /end COMPU_METHOD
/begin COMPU_METHOD zw_sb_q0p75 "" RAT_FUNC "%6.3" "grad KW" COEFFS 0 255 0 0 0 191.25 /end COMPU_METHOD
/begin COMPU_METHOD zw_sb_q6 "" RAT_FUNC "%6.2" "Grad KW" COEFFS 0 1 0 0 0 6 /end COMPU_METHOD
/begin COMPU_METHOD zw_ub_q0p75 "" RAT_FUNC "%6.3" "Grad KW" COEFFS 0 255 0 0 0 191.25 /end COMPU_METHOD
/begin COMPU_METHOD zw_ub_q6 "" RAT_FUNC "%6.2" "Grad KW" COEFFS 0 255 0 0 0 1530 /end COMPU_METHOD
/begin COMPU_METHOD zw_ub_qn0p75 "" RAT_FUNC "%6.4" "grad KW" COEFFS 0 1 0 0 0 -0.75 /end COMPU_METHOD
/begin COMPU_METHOD default "" RAT_FUNC "%6.2" "" COEFFS 0 1 0 0 0 1 /end COMPU_METHOD
/begin COMPU_METHOD defaultAscii "" RAT_FUNC "%6.2" "" COEFFS 0 1 0 0 0 1 /end COMPU_METHOD
/begin RECORD_LAYOUT SstAUbSstUb NO_AXIS_PTS_X 1 UBYTE AXIS_PTS_X 2 UBYTE INDEX_INCR DIRECT /end RECORD_LAYOUT
/end MODULE
/end PROJECT
