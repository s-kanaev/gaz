/begin PROJECT _7804367 "156"
/begin HEADER "" VERSION "_7804367" PROJECT_NO _7804367 /end HEADER
/begin MODULE DIM ""
/begin MOD_COMMON "" BYTE_ORDER BIG_ENDIAN S_REC_LAYOUT DAMOS /end MOD_COMMON
/begin MEASUREMENT E_vs2e "Error Flag: Endstufe Ventilhubsteuerung 2" UWORD B_TRUE 1 100 0 1 BIT_MASK 0x1 FUNCTION_LIST DFPM_DEKON IF_DATA DIM_X 0x383948 EXTERN BYTE IF_DATA MCMESS 0x383948 EXTERN /end MEASUREMENT
/begin MEASUREMENT E_vsb1 "Errorflag:  Ventilhubsteuerung Bank1" UWORD B_TRUE 1 100 0 1 BIT_MASK 0x1 FUNCTION_LIST DFPM_DVS IF_DATA DIM_X 0x38394A EXTERN BYTE IF_DATA MCMESS 0x38394A EXTERN /end MEASUREMENT
/begin MEASUREMENT E_vsb2 "Errorflag: Ventilhubsteuerung Bank2" UWORD B_TRUE 1 100 0 1 BIT_MASK 0x1 FUNCTION_LIST DFPM_DVS IF_DATA DIM_X 0x38394C EXTERN BYTE IF_DATA MCMESS 0x38394C EXTERN /end MEASUREMENT
/begin MEASUREMENT E_vss "Errorflag: Ventilhubsteuerung Summenfehler" UWORD B_TRUE 1 100 0 1 BIT_MASK 0x1 FUNCTION_LIST DFPM_DVS IF_DATA DIM_X 0x38394E EXTERN BYTE IF_DATA MCMESS 0x38394E EXTERN /end MEASUREMENT
/begin MEASUREMENT E_wfs "Errorflag: Wegfahrsperre" UWORD B_TRUE 1 100 0 1 BIT_MASK 0x1 FUNCTION_LIST DFPM_WFS IF_DATA DIM_X 0x383950 EXTERN BYTE IF_DATA MCMESS 0x383950 EXTERN /end MEASUREMENT
/begin MEASUREMENT fafte_w "Faktor Ausfluß Tankentlüftungsventil" UWORD fak_uw_b2 1 100 0 1.99997 FUNCTION_LIST BGTEV IF_DATA DIM_X 0x382B72 EXTERN WORD IF_DATA MCMESS 0x382B72 EXTERN /end MEASUREMENT
/begin MEASUREMENT famal "Faktor zur Absenkung des LUR-Wertes bei Mehrfachaussetzern, aus KFFAMALU" UBYTE fak_ub_b1 1 100 0 0.996094 FUNCTION_LIST DMDLU IF_DATA DIM_X 0x380987 EXTERN WORD IF_DATA MCMESS 0x380987 EXTERN /end MEASUREMENT
/begin MEASUREMENT fbakl_w "Faktor K- und L-Anteil der ÜK bei BA" SWORD fak_sw_b256 1 100 -256 255.992 FUNCTION_LIST ESUK IF_DATA DIM_X 0x382284 EXTERN WORD IF_DATA MCMESS 0x382284 EXTERN /end MEASUREMENT
/begin MEASUREMENT fbans "Nachstartfaktor der ÜK bei BA" UBYTE fak_ub_b8 1 100 0 7.96875 FUNCTION_LIST ESUK IF_DATA DIM_X 0x380B2A EXTERN WORD IF_DATA MCMESS 0x380B2A EXTERN /end MEASUREMENT
/begin MEASUREMENT fbans_w "Nachstartfaktor der ÜK bei BA" UWORD fak_uw_b8 1 100 0 7.99988 FUNCTION_LIST ESUK IF_DATA DIM_X 0x382286 EXTERN WORD IF_DATA MCMESS 0x382286 EXTERN /end MEASUREMENT
/begin MEASUREMENT fbavst_w "Faktor ÜK-Verstellung bei Beschleunigungsanreicherung" SWORD fak_sw_b256 1 100 -256 255.992 FUNCTION_LIST ESUK IF_DATA DIM_X 0x382288 EXTERN WORD IF_DATA MCMESS 0x382288 EXTERN /end MEASUREMENT
/begin MEASUREMENT fbetate "gewünschter Motorwirkungsgrad als f(nmot) bei TE zur Vermeidung von te <= TEMIN" UBYTE fak_ub_b1 1 100 0 0.996094 FUNCTION_LIST TEB IF_DATA DIM_X 0x380CB4 EXTERN WORD IF_DATA MCMESS 0x380CB4 EXTERN /end MEASUREMENT
/begin MEASUREMENT fbkate "Faktor Kraftstoffanteil Tankentlüftung abhängig von te / TEMIN" UBYTE fak_ub_b1 1 100 0 0.996094 FUNCTION_LIST TEB IF_DATA DIM_X 0x380CB5 EXTERN WORD IF_DATA MCMESS 0x380CB5 EXTERN /end MEASUREMENT
/begin MEASUREMENT fcmEnd "Anzahl Einträge im Fehlerspeicher" UBYTE dez 1 100 0 255 FUNCTION_LIST DFPM BGKMST DIMC DTIP KWPSTDA SCATT TCSORT IF_DATA DIM_X 0x382FCD EXTERN WORD IF_DATA MCMESS 0x382FCD EXTERN /end MEASUREMENT
/begin MEASUREMENT FCMTab "" UWORD dez 1 100 0 65535 FUNCTION_LIST DFPM BGKMST DTIP KWPSTDA TCSORT IF_DATA DIM_X 0x383544 EXTERN WORD IF_DATA MCMESS 0x383544 EXTERN /end MEASUREMENT
/begin MEASUREMENT fdar "Verstärkungsfaktor des AR-Eingriffs" UBYTE fak_ub_b3p125 1 100 0 3.11279 FUNCTION_LIST ARMD IF_DATA DIM_X 0x380C28 EXTERN WORD IF_DATA MCMESS 0x380C28 EXTERN /end MEASUREMENT
/begin MEASUREMENT fdmd_m "Statusflag diagnose misfire detection, Monitor, verzögerte Ausgabe" UBYTE DEZ 1 100 0 255 FUNCTION_LIST DMDDLU IF_DATA DIM_X 0xE3F0 INTERN WORD IF_DATA MCMESS 0xE3F0 INTERN /end MEASUREMENT
/begin MEASUREMENT fflutn "Filterfaktor über n für Filterung der Laufunruhe" UBYTE fak_ub_b1 1 100 0 0.996094 FUNCTION_LIST DMDLUA IF_DATA DIM_X 0x38099E EXTERN WORD IF_DATA MCMESS 0x38099E EXTERN /end MEASUREMENT
/begin MEASUREMENT ffon "Statusbyte Übersicht fuel-on Adaption" UBYTE dez 1 100 0 255 FUNCTION_LIST DMDFON IF_DATA DIM_X 0x382F12 EXTERN WORD IF_DATA MCMESS 0x382F12 EXTERN /end MEASUREMENT
/begin MEASUREMENT ffonn1 "Statusbyte fuel-on/-off Adaption (KF-Bereiche fertig gelernt)" UBYTE dez 1 100 0 255 FUNCTION_LIST DMDFON IF_DATA DIM_X 0x382F15 EXTERN WORD IF_DATA MCMESS 0x382F15 EXTERN /end MEASUREMENT
/begin MEASUREMENT ffonn2 "Statusbyte fuel-on/-off Adaption (KF-Bereiche fertig gelernt)" UBYTE dez 1 100 0 255 FUNCTION_LIST DMDFON IF_DATA DIM_X 0x382F16 EXTERN WORD IF_DATA MCMESS 0x382F16 EXTERN /end MEASUREMENT
/begin MEASUREMENT ffonn3 "Statusbyte fuel-on/-off Adaption (KF-Bereiche fertig gelernt)" UBYTE dez 1 100 0 255 FUNCTION_LIST DMDFON IF_DATA DIM_X 0x382F17 EXTERN WORD IF_DATA MCMESS 0x382F17 EXTERN /end MEASUREMENT
/begin MEASUREMENT fforn1 "Statusbyte fuel-on/-off Adaption (n-Bereiche fertig gelernt)" UBYTE dez 1 100 0 255 FUNCTION_LIST DMDFON IF_DATA DIM_X 0x382F13 EXTERN WORD IF_DATA MCMESS 0x382F13 EXTERN /end MEASUREMENT
/begin MEASUREMENT ffpl1 "Statusbyte der fuel-on/-off Adaption (FSE-Werte der Drz.-Bereiche plausibel I)" UBYTE dez 1 100 0 255 FUNCTION_LIST DMDFON IF_DATA DIM_X 0x382F14 EXTERN WORD IF_DATA MCMESS 0x382F14 EXTERN /end MEASUREMENT
/begin MEASUREMENT ffzdfp "Fehlerpfadidentifikationsnummer (dfp) zum Freeze-Frame Zero" UBYTE dez 1 100 0 255 FUNCTION_LIST DTIP CAN KWPSTDA TC2MOD TCSORT IF_DATA DIM_X 0x380A13 EXTERN WORD IF_DATA MCMESS 0x380A13 EXTERN /end MEASUREMENT
/begin MEASUREMENT fgezs0 "" UBYTE fak_ub_b2 1 100 0 1.99219 FUNCTION_LIST ACIFI IF_DATA DIM_X 0xFA4D INTERN WORD IF_DATA MCMESS 0xFA4D INTERN /end MEASUREMENT
/begin MEASUREMENT fgezs1 "" UBYTE fak_ub_b2 1 100 0 1.99219 FUNCTION_LIST ACIFI IF_DATA DIM_X 0xFA4E INTERN WORD IF_DATA MCMESS 0xFA4E INTERN /end MEASUREMENT
/begin MEASUREMENT fgezs2 "" UBYTE fak_ub_b2 1 100 0 1.99219 FUNCTION_LIST ACIFI IF_DATA DIM_X 0xFA4F INTERN WORD IF_DATA MCMESS 0xFA4F INTERN /end MEASUREMENT
/begin MEASUREMENT fgezs3 "" UBYTE fak_ub_b2 1 100 0 1.99219 FUNCTION_LIST ACIFI IF_DATA DIM_X 0xFA50 INTERN WORD IF_DATA MCMESS 0xFA50 INTERN /end MEASUREMENT
/begin MEASUREMENT fgezs4 "" UBYTE fak_ub_b2 1 100 0 1.99219 FUNCTION_LIST ACIFI IF_DATA DIM_X 0xFA51 INTERN WORD IF_DATA MCMESS 0xFA51 INTERN /end MEASUREMENT
/begin MEASUREMENT fgezs5 "" UBYTE fak_ub_b2 1 100 0 1.99219 FUNCTION_LIST ACIFI IF_DATA DIM_X 0xFA52 INTERN WORD IF_DATA MCMESS 0xFA52 INTERN /end MEASUREMENT
/begin MEASUREMENT fgezs6 "" UBYTE fak_ub_b2 1 100 0 1.99219 FUNCTION_LIST ACIFI IF_DATA DIM_X 0xFA53 INTERN WORD IF_DATA MCMESS 0xFA53 INTERN /end MEASUREMENT
/begin MEASUREMENT fgezs7 "" UBYTE fak_ub_b2 1 100 0 1.99219 FUNCTION_LIST ACIFI IF_DATA DIM_X 0xFA54 INTERN WORD IF_DATA MCMESS 0xFA54 INTERN /end MEASUREMENT
/begin MEASUREMENT FGRMDlokBits1 "" UBYTE dez 1 100 0 255 FUNCTION_LIST FGRMD IF_DATA DIM_X 0x380AD8 EXTERN WORD IF_DATA MCMESS 0x380AD8 EXTERN /end MEASUREMENT
/begin MEASUREMENT FGRMDlokBits2 "" UBYTE dez 1 100 0 255 FUNCTION_LIST FGRMD IF_DATA DIM_X 0x380AD9 EXTERN WORD IF_DATA MCMESS 0x380AD9 EXTERN /end MEASUREMENT
/begin MEASUREMENT FGRMDlokBits3 "" UBYTE dez 1 100 0 255 FUNCTION_LIST FGRMD IF_DATA DIM_X 0x380ADA EXTERN WORD IF_DATA MCMESS 0x380ADA EXTERN /end MEASUREMENT
/begin MEASUREMENT fgrstate "" UBYTE dez 1 100 0 255 FUNCTION_LIST GGFGRH IF_DATA DIM_X 0x380ADB EXTERN WORD IF_DATA MCMESS 0x380ADB EXTERN /end MEASUREMENT
/begin MEASUREMENT fgru "Faktor Grundvorsteuerung" UBYTE fak_ub_b2 1 100 0 1.99219 FUNCTION_LIST ESGRU GK IF_DATA DIM_X 0x380B1D EXTERN WORD IF_DATA MCMESS 0x380B1D EXTERN /end MEASUREMENT
/begin MEASUREMENT fgwrte "Eingriff Grenzwertregelung Tankentlüftung" SBYTE fak_sb_b16 1 100 -16 15.875 FUNCTION_LIST TEB IF_DATA DIM_X 0x380CB6 EXTERN WORD IF_DATA MCMESS 0x380CB6 EXTERN /end MEASUREMENT
/begin MEASUREMENT fho "Korrekturfaktor Höhe" UBYTE fak_ub_b4 1 100 0 3.98438 FUNCTION_LIST GGDSAS DLLR ESNST ESSTT MDFUE MDVER STADAP VS IF_DATA DIM_X 0x380AEF EXTERN WORD IF_DATA MCMESS 0x380AEF EXTERN /end MEASUREMENT
/begin MEASUREMENT fho_w "Korrekturfaktor Höhe (word)" UWORD fak_uw_b4 1 100 0 3.99994 FUNCTION_LIST GGDSAS BBKHZ BGSRM BGTEV DHFM DSLSLRS DTEV FE FUEDK KHMD LAKH STMD T2DFA T2LID IF_DATA DIM_X 0x382090 EXTERN WORD IF_DATA MCMESS 0x382090 EXTERN /end MEASUREMENT
/begin MEASUREMENT fivzabg "Intervallzähler abgasrelevante Aussetzer" UBYTE dez 1 100 0 255 FUNCTION_LIST DMDMIL IF_DATA DIM_X 0x3809D2 EXTERN WORD IF_DATA MCMESS 0x3809D2 EXTERN /end MEASUREMENT
/begin MEASUREMENT fkateapp "Faktor applizierter Krafstoffanteil Tankentlüftung" SBYTE fak_sb_b1 1 100 -1 0.992188 FUNCTION_LIST TEB IF_DATA DIM_X 0x380CB7 EXTERN WORD IF_DATA MCMESS 0x380CB7 EXTERN /end MEASUREMENT
/begin MEASUREMENT fkatefrg "Faktor Kraftstoffanteil Tankentlüftung bei Sollspülrate" SBYTE fak_sb_b1 1 100 -1 0.992188 FUNCTION_LIST TEB IF_DATA DIM_X 0x380CC0 EXTERN WORD IF_DATA MCMESS 0x380CC0 EXTERN /end MEASUREMENT
/begin MEASUREMENT fkatei "Faktor Kraftstoffanteil Tankentlüftung (aktueller Istwert)" SBYTE fak_sb_b1 1 100 -1 0.992188 FUNCTION_LIST TEB DTEV IF_DATA DIM_X 0x380CC1 EXTERN WORD IF_DATA MCMESS 0x380CC1 EXTERN /end MEASUREMENT
/begin MEASUREMENT fkates "Faktor Kraftstoffanteil Tankentlüftung (Sollwert)" SBYTE fak_sb_b1 1 100 -1 0.992188 FUNCTION_LIST TEB IF_DATA DIM_X 0x380CB8 EXTERN WORD IF_DATA MCMESS 0x380CB8 EXTERN /end MEASUREMENT
/begin MEASUREMENT fkbkvab "Faktor Reduzierung Reservemoment für Bremskraftverstärker" UBYTE fak_ub_b1 1 100 0 0.996094 FUNCTION_LIST KHMD IF_DATA DIM_X 0x380B74 EXTERN WORD IF_DATA MCMESS 0x380B74 EXTERN /end MEASUREMENT
/begin MEASUREMENT fkhab "Faktor Katheizen zur Abregelung" UBYTE fak_ub_b1 1 100 0 0.996094 FUNCTION_LIST BBKHZ IF_DATA DIM_X 0x380B6C EXTERN WORD IF_DATA MCMESS 0x380B6C EXTERN /end MEASUREMENT
/begin MEASUREMENT fkhfm "HFM-Korrekturfaktor" UBYTE fak_ub_b2 1 100 0 1.99219 FUNCTION_LIST GGHFM IF_DATA DIM_X 0x380AF4 EXTERN WORD IF_DATA MCMESS 0x380AF4 EXTERN /end MEASUREMENT
/begin MEASUREMENT fklafs_w "Faktor Ausfluß (KLAF) für wdks Bestimmung" UWORD fak_uw_b1 1 100 0 0.999985 FUNCTION_LIST FUEDK IF_DATA DIM_X 0x382134 EXTERN WORD IF_DATA MCMESS 0x382134 EXTERN /end MEASUREMENT
/begin MEASUREMENT fklaf_w "Faktor Ausfluß (KLAF)" UWORD fak_uw_b1 1 100 0 0.999985 FUNCTION_LIST BGMSZS DTEV IF_DATA DIM_X 0x3839B0 EXTERN WORD IF_DATA MCMESS 0x3839B0 EXTERN /end MEASUREMENT
/begin MEASUREMENT fkmsdks_w "Korrekturfaktor schneller Massenstromabgleich" UWORD fak_uw_b4 1 100 0 3.99994 FUNCTION_LIST BGMSZS IF_DATA DIM_X 0x381FF4 EXTERN WORD IF_DATA MCMESS 0x381FF4 EXTERN /end MEASUREMENT
/begin MEASUREMENT fkmsdk_w "Korrekturfaktor Massenstrom Nebenfüllungssignal" UWORD fak_uw_b4 1 100 0 3.99994 FUNCTION_LIST BGMSZS FUEDK IF_DATA DIM_X 0x381FF6 EXTERN WORD IF_DATA MCMESS 0x381FF6 EXTERN /end MEASUREMENT
/begin MEASUREMENT fkpvdk_w "Korrekturfaktor langsamer Massenstromabgleich" UWORD fak_uw_b4 1 100 0 3.99994 FUNCTION_LIST BGMSZS IF_DATA DIM_X 0x3839B2 EXTERN WORD IF_DATA MCMESS 0x3839B2 EXTERN /end MEASUREMENT
/begin MEASUREMENT fktns "Nachstartanhebung" UBYTE fak_ub_b4 1 100 0 3.98438 FUNCTION_LIST ESNST IF_DATA DIM_X 0x380B1E EXTERN WORD IF_DATA MCMESS 0x380B1E EXTERN /end MEASUREMENT
/begin MEASUREMENT fkukaba2_w "Korrekturfaktor ÜK-Adaption BA Bank 2" UWORD fak_uw_b4 1 100 0 3.99994 FUNCTION_LIST ESUKAS IF_DATA DIM_X 0x3822BC EXTERN WORD IF_DATA MCMESS 0x3822BC EXTERN /end MEASUREMENT
/begin MEASUREMENT fkukaba_w "Korrekturfaktor ÜK-Adaption BA" UWORD fak_uw_b4 1 100 0 3.99994 FUNCTION_LIST ESUKAS IF_DATA DIM_X 0x3822BE EXTERN WORD IF_DATA MCMESS 0x3822BE EXTERN /end MEASUREMENT
/begin MEASUREMENT fkukas2_w "Korrekturfaktor aufsummiert Bank 2 ÜK-Adaption" UWORD fak_q0p0625 1 100 0 4095.94 FUNCTION_LIST ESUKAS IF_DATA DIM_X 0x3822C0 EXTERN WORD IF_DATA MCMESS 0x3822C0 EXTERN /end MEASUREMENT
/begin MEASUREMENT fkukas_w "Korrekturfaktor aufsummiert ÜK-Adaption" UWORD fak_q0p0625 1 100 0 4095.94 FUNCTION_LIST ESUKAS IF_DATA DIM_X 0x3822C2 EXTERN WORD IF_DATA MCMESS 0x3822C2 EXTERN /end MEASUREMENT
/begin MEASUREMENT fkukava2_w "Korrekturfaktor ÜK-Adaption VA Bank 2" UWORD fak_uw_b4 1 100 0 3.99994 FUNCTION_LIST ESUKAS IF_DATA DIM_X 0x3822C4 EXTERN WORD IF_DATA MCMESS 0x3822C4 EXTERN /end MEASUREMENT
/begin MEASUREMENT fkukava_w "Korrekturfaktor ÜK-Adaption VA" UWORD fak_uw_b4 1 100 0 3.99994 FUNCTION_LIST ESUKAS IF_DATA DIM_X 0x3822C6 EXTERN WORD IF_DATA MCMESS 0x3822C6 EXTERN /end MEASUREMENT
/begin MEASUREMENT flakh "Faktor Lambda-Steuerung bei Katheizen" UBYTE fak_ub_b1 1 100 0 0.996094 FUNCTION_LIST BBKHZ LAKH IF_DATA DIM_X 0x380B6D EXTERN WORD IF_DATA MCMESS 0x380B6D EXTERN /end MEASUREMENT
/begin MEASUREMENT flamkh "Faktor Aufregelung Lambda-Motor-Soll bei Katheizen" UBYTE fak_ub_b1 1 100 0 0.996094 FUNCTION_LIST BBKHZ LAMKO IF_DATA DIM_X 0x380B6E EXTERN WORD IF_DATA MCMESS 0x380B6E EXTERN /end MEASUREMENT
/begin MEASUREMENT flamsl2_w "Faktor Lambdaänderung durch Sekundärluft, Bank 2" UWORD fak_uw_b16 1 100 0 15.9998 FUNCTION_LIST SLS LAKH LAMKO IF_DATA DIM_X 0x380E96 EXTERN WORD IF_DATA MCMESS 0x380E96 EXTERN /end MEASUREMENT
/begin MEASUREMENT flamsls "Faktor Lambdaänderung durch Sekundärluft" UBYTE fak_ub_b1p25_o0p75 1 100 0.75 1.24805 FUNCTION_LIST GGLSU IF_DATA DIM_X 0x380A8B EXTERN WORD IF_DATA MCMESS 0x380A8B EXTERN /end MEASUREMENT
/begin MEASUREMENT flamsl_w "Faktor Lambdaänderung durch Sekundärluft" UWORD fak_uw_b16 1 100 0 15.9998 FUNCTION_LIST SLS LAKH LAMKO IF_DATA DIM_X 0x380E98 EXTERN WORD IF_DATA MCMESS 0x380E98 EXTERN /end MEASUREMENT
/begin MEASUREMENT flaskh "Faktor Übergang zu Lambda-Abgas bei Sekundärluft" UBYTE fak_ub_b1 1 100 0 0.996094 FUNCTION_LIST LAKH IF_DATA DIM_X 0x380B76 EXTERN WORD IF_DATA MCMESS 0x380B76 EXTERN /end MEASUREMENT
/begin MEASUREMENT fldrrx_w "Korrekturfaktor Maximalfuellung aus Klopfregelung" UWORD fak_uw_b2 1 100 0 1.99997 FUNCTION_LIST LDRLMX T2LID IF_DATA DIM_X 0x3824B8 EXTERN WORD IF_DATA MCMESS 0x3824B8 EXTERN /end MEASUREMENT
/begin MEASUREMENT fldrxk "Faktor zur LDR rlmax-Korrektur durch den Kurzzeitanteil" UBYTE fak_ub_b2 1 100 0 1.99219 FUNCTION_LIST LDRLMX IF_DATA DIM_X 0x380BF3 EXTERN WORD IF_DATA MCMESS 0x380BF3 EXTERN /end MEASUREMENT
/begin MEASUREMENT fldrxl "Faktor zur LDR rlmax-Korrektur durch den Langzeitanteil" UBYTE fak_ub_b2 1 100 0 1.99219 FUNCTION_LIST LDRLMX IF_DATA DIM_X 0x380BF4 EXTERN WORD IF_DATA MCMESS 0x380BF4 EXTERN /end MEASUREMENT
/begin MEASUREMENT fldrxo "Faktor zur Ladedruckabsenkung des Overboostwertes (drlmaxo)" UBYTE fak_ub_b1 1 100 0 0.996094 FUNCTION_LIST LDRLMX IF_DATA DIM_X 0x380BF5 EXTERN WORD IF_DATA MCMESS 0x380BF5 EXTERN /end MEASUREMENT
/begin MEASUREMENT flgddg "" UBYTE dez 1 100 0 255 FUNCTION_LIST DDG IF_DATA DIM_X 0x380A1F EXTERN WORD IF_DATA MCMESS 0x380A1F EXTERN /end MEASUREMENT
/begin MEASUREMENT flgdkatlrs "" UBYTE dez 1 100 0 255 FUNCTION_LIST DKATLRS IF_DATA DIM_X 0x382FE9 EXTERN WORD IF_DATA MCMESS 0x382FE9 EXTERN /end MEASUREMENT
/begin MEASUREMENT flgkat_w "Statusflag kat.schädigende Aussetzerraten oder ti-Abschaltung" UWORD dez 1 100 0 65535 FUNCTION_LIST DMDMIL IF_DATA DIM_X 0x3819C2 EXTERN WORD IF_DATA MCMESS 0x3819C2 EXTERN /end MEASUREMENT
/begin MEASUREMENT flglrs "CARB FREEZE FRAME Byte, Bank 1, für LR" UBYTE dez 1 100 0 255 FUNCTION_LIST LRSEB DFFT TC1MOD IF_DATA DIM_X 0x380C8A EXTERN WORD IF_DATA MCMESS 0x380C8A EXTERN /end MEASUREMENT
/begin MEASUREMENT flglrs2 "CARB FREEZE FRAME Byte, Bank 2, für LR" UBYTE dez 1 100 0 255 FUNCTION_LIST LRSEB DFFT TC1MOD IF_DATA DIM_X 0x380C8B EXTERN WORD IF_DATA MCMESS 0x380C8B EXTERN /end MEASUREMENT
/begin MEASUREMENT flgtiab "Statusflag ti-Abschaltung bei kat.schädigenden Aussetzerraten" UBYTE dez 1 100 0 255 FUNCTION_LIST DMDMIL AEVAB BBLDR BGEVAB MDEX IF_DATA DIM_X 0x3809D3 EXTERN WORD IF_DATA MCMESS 0x3809D3 EXTERN /end MEASUREMENT
/begin MEASUREMENT flgttfa "Flagbyte: Anstoßbits Kurztestfunktionen" UBYTE dez 1 100 0 255 FUNCTION_LIST T2DFA IF_DATA DIM_X 0x380921 EXTERN WORD IF_DATA MCMESS 0x380921 EXTERN /end MEASUREMENT
/begin MEASUREMENT flgttfa2 "Flagbyte: Anstoßbits Kurztestfunktionen" UBYTE dez 1 100 0 255 FUNCTION_LIST T2DFA IF_DATA DIM_X 0x380922 EXTERN WORD IF_DATA MCMESS 0x380922 EXTERN /end MEASUREMENT
/begin MEASUREMENT flgttfa3 "Flagbyte: Anstoßbits Kurztestfunktionen" UBYTE dez 1 100 0 255 FUNCTION_LIST T2DFA IF_DATA DIM_X 0x380923 EXTERN WORD IF_DATA MCMESS 0x380923 EXTERN /end MEASUREMENT
/begin MEASUREMENT flg_m "Monitor Status Laufunruhe-Berechnung" UBYTE DEZ 1 100 0 255 FUNCTION_LIST DMDDLU IF_DATA DIM_X 0xE456 INTERN WORD IF_DATA MCMESS 0xE456 INTERN /end MEASUREMENT
/begin MEASUREMENT flmssl "Faktor Lambda-Motor-Soll-Sekundärluftanteil" UBYTE fak_ub_b1 1 100 0 0.996094 FUNCTION_LIST SLS LAKH IF_DATA DIM_X 0x380915 EXTERN WORD IF_DATA MCMESS 0x380915 EXTERN /end MEASUREMENT
/begin MEASUREMENT flmsslkh "Faktor Lambda-Motor-Soll-Sekundärluftanteil, resultierend" UBYTE fak_ub_b1 1 100 0 0.996094 FUNCTION_LIST LAKH IF_DATA DIM_X 0x380B77 EXTERN WORD IF_DATA MCMESS 0x380B77 EXTERN /end MEASUREMENT
/begin MEASUREMENT flmx "aktuell maximaler Lernfilterwert" SWORD dtsegn_b720divZyl 1 100 -120 119.996 FUNCTION_LIST DMDFON IF_DATA DIM_X 0x38164E EXTERN WORD IF_DATA MCMESS 0x38164E EXTERN /end MEASUREMENT
/begin MEASUREMENT flmxresz "Resetzähler Lernfilterwert weggelaufen" UWORD dez 1 100 0 65535 FUNCTION_LIST DMDFON IF_DATA DIM_X 0x383522 EXTERN WORD IF_DATA MCMESS 0x383522 EXTERN /end MEASUREMENT
/begin MEASUREMENT fln11_02 "Lernfilterwert, negativ, Betriebsbereich 11, Zylinder 2" SWORD dtsegn_b720divZyl 1 100 -120 119.996 FUNCTION_LIST DMDFON IF_DATA DIM_X 0x383130 EXTERN WORD IF_DATA MCMESS 0x383130 EXTERN /end MEASUREMENT
/begin MEASUREMENT fln11_03 "Lernfilterwert, negativ" SWORD dtsegn_b720divZyl 1 100 -120 119.996 FUNCTION_LIST DMDFON IF_DATA DIM_X 0x383160 EXTERN WORD IF_DATA MCMESS 0x383160 EXTERN /end MEASUREMENT
/begin MEASUREMENT fln11_04 "Lernfilterwert, negativ" SWORD dtsegn_b720divZyl 1 100 -120 119.996 FUNCTION_LIST DMDFON IF_DATA DIM_X 0x383190 EXTERN WORD IF_DATA MCMESS 0x383190 EXTERN /end MEASUREMENT
/begin MEASUREMENT fln11_05 "Lernfilterwert, negativ" SWORD dtsegn_b720divZyl 1 100 -120 119.996 FUNCTION_LIST DMDFON IF_DATA DIM_X 0x3831C0 EXTERN WORD IF_DATA MCMESS 0x3831C0 EXTERN /end MEASUREMENT
/begin MEASUREMENT fln11_06 "Lernfilterwert, negativ" SWORD dtsegn_b720divZyl 1 100 -120 119.996 FUNCTION_LIST DMDFON IF_DATA DIM_X 0x3831F0 EXTERN WORD IF_DATA MCMESS 0x3831F0 EXTERN /end MEASUREMENT
/begin MEASUREMENT fln11_07 "Lernfilterwert, negativ" SWORD dtsegn_b720divZyl 1 100 -120 119.996 FUNCTION_LIST DMDFON IF_DATA DIM_X 0x383220 EXTERN WORD IF_DATA MCMESS 0x383220 EXTERN /end MEASUREMENT
/begin MEASUREMENT fln11_08 "Lernfilterwert, negativ" SWORD dtsegn_b720divZyl 1 100 -120 119.996 FUNCTION_LIST DMDFON IF_DATA DIM_X 0x383250 EXTERN WORD IF_DATA MCMESS 0x383250 EXTERN /end MEASUREMENT
/begin MEASUREMENT fln12_02 "Lernfilterwert, negativ" SWORD dtsegn_b720divZyl 1 100 -120 119.996 FUNCTION_LIST DMDFON IF_DATA DIM_X 0x383140 EXTERN WORD IF_DATA MCMESS 0x383140 EXTERN /end MEASUREMENT
/begin MEASUREMENT fln12_03 "Lernfilterwert, negativ" SWORD dtsegn_b720divZyl 1 100 -120 119.996 FUNCTION_LIST DMDFON IF_DATA DIM_X 0x383170 EXTERN WORD IF_DATA MCMESS 0x383170 EXTERN /end MEASUREMENT
/begin MEASUREMENT fln12_04 "Lernfilterwert, negativ" SWORD dtsegn_b720divZyl 1 100 -120 119.996 FUNCTION_LIST DMDFON IF_DATA DIM_X 0x3831A0 EXTERN WORD IF_DATA MCMESS 0x3831A0 EXTERN /end MEASUREMENT
/begin MEASUREMENT fln12_05 "Lernfilterwert, negativ" SWORD dtsegn_b720divZyl 1 100 -120 119.996 FUNCTION_LIST DMDFON IF_DATA DIM_X 0x3831D0 EXTERN WORD IF_DATA MCMESS 0x3831D0 EXTERN /end MEASUREMENT
/begin MEASUREMENT fln12_06 "Lernfilterwert, negativ" SWORD dtsegn_b720divZyl 1 100 -120 119.996 FUNCTION_LIST DMDFON IF_DATA DIM_X 0x383200 EXTERN WORD IF_DATA MCMESS 0x383200 EXTERN /end MEASUREMENT
/begin MEASUREMENT fln12_07 "Lernfilterwert, negativ" SWORD dtsegn_b720divZyl 1 100 -120 119.996 FUNCTION_LIST DMDFON IF_DATA DIM_X 0x383230 EXTERN WORD IF_DATA MCMESS 0x383230 EXTERN /end MEASUREMENT
/begin MEASUREMENT fln12_08 "Lernfilterwert, negativ" SWORD dtsegn_b720divZyl 1 100 -120 119.996 FUNCTION_LIST DMDFON IF_DATA DIM_X 0x383260 EXTERN WORD IF_DATA MCMESS 0x383260 EXTERN /end MEASUREMENT
/begin MEASUREMENT fln13_02 "Lernfilterwert, negativ" SWORD dtsegn_b720divZyl 1 100 -120 119.996 FUNCTION_LIST DMDFON IF_DATA DIM_X 0x383150 EXTERN WORD IF_DATA MCMESS 0x383150 EXTERN /end MEASUREMENT
/begin MEASUREMENT fln13_03 "Lernfilterwert, negativ" SWORD dtsegn_b720divZyl 1 100 -120 119.996 FUNCTION_LIST DMDFON IF_DATA DIM_X 0x383180 EXTERN WORD IF_DATA MCMESS 0x383180 EXTERN /end MEASUREMENT
/begin MEASUREMENT fln13_04 "Lernfilterwert, negativ" SWORD dtsegn_b720divZyl 1 100 -120 119.996 FUNCTION_LIST DMDFON IF_DATA DIM_X 0x3831B0 EXTERN WORD IF_DATA MCMESS 0x3831B0 EXTERN /end MEASUREMENT
/begin MEASUREMENT fln13_05 "Lernfilterwert, negativ" SWORD dtsegn_b720divZyl 1 100 -120 119.996 FUNCTION_LIST DMDFON IF_DATA DIM_X 0x3831E0 EXTERN WORD IF_DATA MCMESS 0x3831E0 EXTERN /end MEASUREMENT
/begin MEASUREMENT fln13_06 "Lernfilterwert, negativ" SWORD dtsegn_b720divZyl 1 100 -120 119.996 FUNCTION_LIST DMDFON IF_DATA DIM_X 0x383210 EXTERN WORD IF_DATA MCMESS 0x383210 EXTERN /end MEASUREMENT
/begin MEASUREMENT fln13_07 "Lernfilterwert, negativ" SWORD dtsegn_b720divZyl 1 100 -120 119.996 FUNCTION_LIST DMDFON IF_DATA DIM_X 0x383240 EXTERN WORD IF_DATA MCMESS 0x383240 EXTERN /end MEASUREMENT
/begin MEASUREMENT fln13_08 "Lernfilterwert, negativ" SWORD dtsegn_b720divZyl 1 100 -120 119.996 FUNCTION_LIST DMDFON IF_DATA DIM_X 0x383270 EXTERN WORD IF_DATA MCMESS 0x383270 EXTERN /end MEASUREMENT
/begin MEASUREMENT fln21_02 "Lernfilterwert, negativ" SWORD dtsegn_b720divZyl 1 100 -120 119.996 FUNCTION_LIST DMDFON IF_DATA DIM_X 0x383132 EXTERN WORD IF_DATA MCMESS 0x383132 EXTERN /end MEASUREMENT
/begin MEASUREMENT fln21_03 "Lernfilterwert, negativ" SWORD dtsegn_b720divZyl 1 100 -120 119.996 FUNCTION_LIST DMDFON IF_DATA DIM_X 0x383162 EXTERN WORD IF_DATA MCMESS 0x383162 EXTERN /end MEASUREMENT
/begin MEASUREMENT fln21_04 "Lernfilterwert, negativ" SWORD dtsegn_b720divZyl 1 100 -120 119.996 FUNCTION_LIST DMDFON IF_DATA DIM_X 0x383192 EXTERN WORD IF_DATA MCMESS 0x383192 EXTERN /end MEASUREMENT
/begin MEASUREMENT fln21_05 "Lernfilterwert, negativ" SWORD dtsegn_b720divZyl 1 100 -120 119.996 FUNCTION_LIST DMDFON IF_DATA DIM_X 0x3831C2 EXTERN WORD IF_DATA MCMESS 0x3831C2 EXTERN /end MEASUREMENT
/begin MEASUREMENT fln21_06 "Lernfilterwert, negativ" SWORD dtsegn_b720divZyl 1 100 -120 119.996 FUNCTION_LIST DMDFON IF_DATA DIM_X 0x3831F2 EXTERN WORD IF_DATA MCMESS 0x3831F2 EXTERN /end MEASUREMENT
/begin MEASUREMENT fln21_07 "Lernfilterwert, negativ" SWORD dtsegn_b720divZyl 1 100 -120 119.996 FUNCTION_LIST DMDFON IF_DATA DIM_X 0x383222 EXTERN WORD IF_DATA MCMESS 0x383222 EXTERN /end MEASUREMENT
/begin MEASUREMENT fln21_08 "Lernfilterwert, negativ" SWORD dtsegn_b720divZyl 1 100 -120 119.996 FUNCTION_LIST DMDFON IF_DATA DIM_X 0x383252 EXTERN WORD IF_DATA MCMESS 0x383252 EXTERN /end MEASUREMENT
/begin MEASUREMENT fln22_02 "Lernfilterwert, negativ" SWORD dtsegn_b720divZyl 1 100 -120 119.996 FUNCTION_LIST DMDFON IF_DATA DIM_X 0x383142 EXTERN WORD IF_DATA MCMESS 0x383142 EXTERN /end MEASUREMENT
/begin MEASUREMENT fln22_03 "Lernfilterwert, negativ" SWORD dtsegn_b720divZyl 1 100 -120 119.996 FUNCTION_LIST DMDFON IF_DATA DIM_X 0x383172 EXTERN WORD IF_DATA MCMESS 0x383172 EXTERN /end MEASUREMENT
/begin MEASUREMENT fln22_04 "Lernfilterwert, negativ" SWORD dtsegn_b720divZyl 1 100 -120 119.996 FUNCTION_LIST DMDFON IF_DATA DIM_X 0x3831A2 EXTERN WORD IF_DATA MCMESS 0x3831A2 EXTERN /end MEASUREMENT
/begin MEASUREMENT fln22_05 "Lernfilterwert, negativ" SWORD dtsegn_b720divZyl 1 100 -120 119.996 FUNCTION_LIST DMDFON IF_DATA DIM_X 0x3831D2 EXTERN WORD IF_DATA MCMESS 0x3831D2 EXTERN /end MEASUREMENT
/begin MEASUREMENT fln22_06 "Lernfilterwert, negativ" SWORD dtsegn_b720divZyl 1 100 -120 119.996 FUNCTION_LIST DMDFON IF_DATA DIM_X 0x383202 EXTERN WORD IF_DATA MCMESS 0x383202 EXTERN /end MEASUREMENT
/begin MEASUREMENT fln22_07 "Lernfilterwert, negativ" SWORD dtsegn_b720divZyl 1 100 -120 119.996 FUNCTION_LIST DMDFON IF_DATA DIM_X 0x383232 EXTERN WORD IF_DATA MCMESS 0x383232 EXTERN /end MEASUREMENT
/begin MEASUREMENT fln22_08 "Lernfilterwert, negativ" SWORD dtsegn_b720divZyl 1 100 -120 119.996 FUNCTION_LIST DMDFON IF_DATA DIM_X 0x383262 EXTERN WORD IF_DATA MCMESS 0x383262 EXTERN /end MEASUREMENT
/begin MEASUREMENT fln23_02 "Lernfilterwert, negativ" SWORD dtsegn_b720divZyl 1 100 -120 119.996 FUNCTION_LIST DMDFON IF_DATA DIM_X 0x383152 EXTERN WORD IF_DATA MCMESS 0x383152 EXTERN /end MEASUREMENT
/begin MEASUREMENT fln23_03 "Lernfilterwert, negativ" SWORD dtsegn_b720divZyl 1 100 -120 119.996 FUNCTION_LIST DMDFON IF_DATA DIM_X 0x383182 EXTERN WORD IF_DATA MCMESS 0x383182 EXTERN /end MEASUREMENT
/begin MEASUREMENT fln23_04 "Lernfilterwert, negativ" SWORD dtsegn_b720divZyl 1 100 -120 119.996 FUNCTION_LIST DMDFON IF_DATA DIM_X 0x3831B2 EXTERN WORD IF_DATA MCMESS 0x3831B2 EXTERN /end MEASUREMENT
/begin MEASUREMENT fln23_05 "Lernfilterwert, negativ" SWORD dtsegn_b720divZyl 1 100 -120 119.996 FUNCTION_LIST DMDFON IF_DATA DIM_X 0x3831E2 EXTERN WORD IF_DATA MCMESS 0x3831E2 EXTERN /end MEASUREMENT
/begin MEASUREMENT fln23_06 "Lernfilterwert, negativ" SWORD dtsegn_b720divZyl 1 100 -120 119.996 FUNCTION_LIST DMDFON IF_DATA DIM_X 0x383212 EXTERN WORD IF_DATA MCMESS 0x383212 EXTERN /end MEASUREMENT
/begin MEASUREMENT fln23_07 "Lernfilterwert, negativ" SWORD dtsegn_b720divZyl 1 100 -120 119.996 FUNCTION_LIST DMDFON IF_DATA DIM_X 0x383242 EXTERN WORD IF_DATA MCMESS 0x383242 EXTERN /end MEASUREMENT
/begin MEASUREMENT fln23_08 "Lernfilterwert, negativ" SWORD dtsegn_b720divZyl 1 100 -120 119.996 FUNCTION_LIST DMDFON IF_DATA DIM_X 0x383272 EXTERN WORD IF_DATA MCMESS 0x383272 EXTERN /end MEASUREMENT
/begin MEASUREMENT fln31_02 "Lernfilterwert, negativ" SWORD dtsegn_b720divZyl 1 100 -120 119.996 FUNCTION_LIST DMDFON IF_DATA DIM_X 0x383134 EXTERN WORD IF_DATA MCMESS 0x383134 EXTERN /end MEASUREMENT
/begin MEASUREMENT fln31_03 "Lernfilterwert, negativ" SWORD dtsegn_b720divZyl 1 100 -120 119.996 FUNCTION_LIST DMDFON IF_DATA DIM_X 0x383164 EXTERN WORD IF_DATA MCMESS 0x383164 EXTERN /end MEASUREMENT
/begin MEASUREMENT fln31_04 "Lernfilterwert, negativ" SWORD dtsegn_b720divZyl 1 100 -120 119.996 FUNCTION_LIST DMDFON IF_DATA DIM_X 0x383194 EXTERN WORD IF_DATA MCMESS 0x383194 EXTERN /end MEASUREMENT
/begin MEASUREMENT fln31_05 "Lernfilterwert, negativ" SWORD dtsegn_b720divZyl 1 100 -120 119.996 FUNCTION_LIST DMDFON IF_DATA DIM_X 0x3831C4 EXTERN WORD IF_DATA MCMESS 0x3831C4 EXTERN /end MEASUREMENT
/begin MEASUREMENT fln31_06 "Lernfilterwert, negativ" SWORD dtsegn_b720divZyl 1 100 -120 119.996 FUNCTION_LIST DMDFON IF_DATA DIM_X 0x3831F4 EXTERN WORD IF_DATA MCMESS 0x3831F4 EXTERN /end MEASUREMENT
/begin MEASUREMENT fln31_07 "Lernfilterwert, negativ" SWORD dtsegn_b720divZyl 1 100 -120 119.996 FUNCTION_LIST DMDFON IF_DATA DIM_X 0x383224 EXTERN WORD IF_DATA MCMESS 0x383224 EXTERN /end MEASUREMENT
/begin MEASUREMENT fln31_08 "Lernfilterwert, negativ" SWORD dtsegn_b720divZyl 1 100 -120 119.996 FUNCTION_LIST DMDFON IF_DATA DIM_X 0x383254 EXTERN WORD IF_DATA MCMESS 0x383254 EXTERN /end MEASUREMENT
/begin MEASUREMENT fln32_02 "Lernfilterwert, negativ" SWORD dtsegn_b720divZyl 1 100 -120 119.996 FUNCTION_LIST DMDFON IF_DATA DIM_X 0x383144 EXTERN WORD IF_DATA MCMESS 0x383144 EXTERN /end MEASUREMENT
/begin MEASUREMENT fln32_03 "Lernfilterwert, negativ" SWORD dtsegn_b720divZyl 1 100 -120 119.996 FUNCTION_LIST DMDFON IF_DATA DIM_X 0x383174 EXTERN WORD IF_DATA MCMESS 0x383174 EXTERN /end MEASUREMENT
/begin MEASUREMENT fln32_04 "Lernfilterwert, negativ" SWORD dtsegn_b720divZyl 1 100 -120 119.996 FUNCTION_LIST DMDFON IF_DATA DIM_X 0x3831A4 EXTERN WORD IF_DATA MCMESS 0x3831A4 EXTERN /end MEASUREMENT
/begin MEASUREMENT fln32_05 "Lernfilterwert, negativ" SWORD dtsegn_b720divZyl 1 100 -120 119.996 FUNCTION_LIST DMDFON IF_DATA DIM_X 0x3831D4 EXTERN WORD IF_DATA MCMESS 0x3831D4 EXTERN /end MEASUREMENT
/begin MEASUREMENT fln32_06 "Lernfilterwert, negativ" SWORD dtsegn_b720divZyl 1 100 -120 119.996 FUNCTION_LIST DMDFON IF_DATA DIM_X 0x383204 EXTERN WORD IF_DATA MCMESS 0x383204 EXTERN /end MEASUREMENT
/begin MEASUREMENT fln32_07 "Lernfilterwert, negativ" SWORD dtsegn_b720divZyl 1 100 -120 119.996 FUNCTION_LIST DMDFON IF_DATA DIM_X 0x383234 EXTERN WORD IF_DATA MCMESS 0x383234 EXTERN /end MEASUREMENT
/begin MEASUREMENT fln32_08 "Lernfilterwert, negativ" SWORD dtsegn_b720divZyl 1 100 -120 119.996 FUNCTION_LIST DMDFON IF_DATA DIM_X 0x383264 EXTERN WORD IF_DATA MCMESS 0x383264 EXTERN /end MEASUREMENT
/begin MEASUREMENT fln33_02 "Lernfilterwert, negativ" SWORD dtsegn_b720divZyl 1 100 -120 119.996 FUNCTION_LIST DMDFON IF_DATA DIM_X 0x383154 EXTERN WORD IF_DATA MCMESS 0x383154 EXTERN /end MEASUREMENT
/begin MEASUREMENT fln33_03 "Lernfilterwert, negativ" SWORD dtsegn_b720divZyl 1 100 -120 119.996 FUNCTION_LIST DMDFON IF_DATA DIM_X 0x383184 EXTERN WORD IF_DATA MCMESS 0x383184 EXTERN /end MEASUREMENT
/begin MEASUREMENT fln33_04 "Lernfilterwert, negativ" SWORD dtsegn_b720divZyl 1 100 -120 119.996 FUNCTION_LIST DMDFON IF_DATA DIM_X 0x3831B4 EXTERN WORD IF_DATA MCMESS 0x3831B4 EXTERN /end MEASUREMENT
/begin MEASUREMENT fln33_05 "Lernfilterwert, negativ" SWORD dtsegn_b720divZyl 1 100 -120 119.996 FUNCTION_LIST DMDFON IF_DATA DIM_X 0x3831E4 EXTERN WORD IF_DATA MCMESS 0x3831E4 EXTERN /end MEASUREMENT
/begin MEASUREMENT fln33_06 "Lernfilterwert, negativ" SWORD dtsegn_b720divZyl 1 100 -120 119.996 FUNCTION_LIST DMDFON IF_DATA DIM_X 0x383214 EXTERN WORD IF_DATA MCMESS 0x383214 EXTERN /end MEASUREMENT
/begin MEASUREMENT fln33_07 "Lernfilterwert, negativ" SWORD dtsegn_b720divZyl 1 100 -120 119.996 FUNCTION_LIST DMDFON IF_DATA DIM_X 0x383244 EXTERN WORD IF_DATA MCMESS 0x383244 EXTERN /end MEASUREMENT
/begin MEASUREMENT fln33_08 "Lernfilterwert, negativ" SWORD dtsegn_b720divZyl 1 100 -120 119.996 FUNCTION_LIST DMDFON IF_DATA DIM_X 0x383274 EXTERN WORD IF_DATA MCMESS 0x383274 EXTERN /end MEASUREMENT
/begin MEASUREMENT fln41_02 "Lernfilterwert, negativ" SWORD dtsegn_b720divZyl 1 100 -120 119.996 FUNCTION_LIST DMDFON IF_DATA DIM_X 0x383136 EXTERN WORD IF_DATA MCMESS 0x383136 EXTERN /end MEASUREMENT
/begin MEASUREMENT fln41_03 "Lernfilterwert, negativ" SWORD dtsegn_b720divZyl 1 100 -120 119.996 FUNCTION_LIST DMDFON IF_DATA DIM_X 0x383166 EXTERN WORD IF_DATA MCMESS 0x383166 EXTERN /end MEASUREMENT
/begin MEASUREMENT fln41_04 "Lernfilterwert, negativ" SWORD dtsegn_b720divZyl 1 100 -120 119.996 FUNCTION_LIST DMDFON IF_DATA DIM_X 0x383196 EXTERN WORD IF_DATA MCMESS 0x383196 EXTERN /end MEASUREMENT
/begin MEASUREMENT fln41_05 "Lernfilterwert, negativ" SWORD dtsegn_b720divZyl 1 100 -120 119.996 FUNCTION_LIST DMDFON IF_DATA DIM_X 0x3831C6 EXTERN WORD IF_DATA MCMESS 0x3831C6 EXTERN /end MEASUREMENT
/begin MEASUREMENT fln41_06 "Lernfilterwert, negativ" SWORD dtsegn_b720divZyl 1 100 -120 119.996 FUNCTION_LIST DMDFON IF_DATA DIM_X 0x3831F6 EXTERN WORD IF_DATA MCMESS 0x3831F6 EXTERN /end MEASUREMENT
/begin MEASUREMENT fln41_07 "Lernfilterwert, negativ" SWORD dtsegn_b720divZyl 1 100 -120 119.996 FUNCTION_LIST DMDFON IF_DATA DIM_X 0x383226 EXTERN WORD IF_DATA MCMESS 0x383226 EXTERN /end MEASUREMENT
/begin MEASUREMENT fln41_08 "Lernfilterwert, negativ" SWORD dtsegn_b720divZyl 1 100 -120 119.996 FUNCTION_LIST DMDFON IF_DATA DIM_X 0x383256 EXTERN WORD IF_DATA MCMESS 0x383256 EXTERN /end MEASUREMENT
/begin MEASUREMENT fln42_02 "Lernfilterwert, negativ" SWORD dtsegn_b720divZyl 1 100 -120 119.996 FUNCTION_LIST DMDFON IF_DATA DIM_X 0x383146 EXTERN WORD IF_DATA MCMESS 0x383146 EXTERN /end MEASUREMENT
/begin MEASUREMENT fln42_03 "Lernfilterwert, negativ" SWORD dtsegn_b720divZyl 1 100 -120 119.996 FUNCTION_LIST DMDFON IF_DATA DIM_X 0x383176 EXTERN WORD IF_DATA MCMESS 0x383176 EXTERN /end MEASUREMENT
/begin MEASUREMENT fln42_04 "Lernfilterwert, negativ" SWORD dtsegn_b720divZyl 1 100 -120 119.996 FUNCTION_LIST DMDFON IF_DATA DIM_X 0x3831A6 EXTERN WORD IF_DATA MCMESS 0x3831A6 EXTERN /end MEASUREMENT
/begin MEASUREMENT fln42_05 "Lernfilterwert, negativ" SWORD dtsegn_b720divZyl 1 100 -120 119.996 FUNCTION_LIST DMDFON IF_DATA DIM_X 0x3831D6 EXTERN WORD IF_DATA MCMESS 0x3831D6 EXTERN /end MEASUREMENT
/begin MEASUREMENT fln42_06 "Lernfilterwert, negativ" SWORD dtsegn_b720divZyl 1 100 -120 119.996 FUNCTION_LIST DMDFON IF_DATA DIM_X 0x383206 EXTERN WORD IF_DATA MCMESS 0x383206 EXTERN /end MEASUREMENT
/begin MEASUREMENT fln42_07 "Lernfilterwert, negativ" SWORD dtsegn_b720divZyl 1 100 -120 119.996 FUNCTION_LIST DMDFON IF_DATA DIM_X 0x383236 EXTERN WORD IF_DATA MCMESS 0x383236 EXTERN /end MEASUREMENT
/begin MEASUREMENT fln42_08 "Lernfilterwert, negativ" SWORD dtsegn_b720divZyl 1 100 -120 119.996 FUNCTION_LIST DMDFON IF_DATA DIM_X 0x383266 EXTERN WORD IF_DATA MCMESS 0x383266 EXTERN /end MEASUREMENT
/begin MEASUREMENT fln43_02 "Lernfilterwert, negativ" SWORD dtsegn_b720divZyl 1 100 -120 119.996 FUNCTION_LIST DMDFON IF_DATA DIM_X 0x383156 EXTERN WORD IF_DATA MCMESS 0x383156 EXTERN /end MEASUREMENT
/begin MEASUREMENT fln43_03 "Lernfilterwert, negativ" SWORD dtsegn_b720divZyl 1 100 -120 119.996 FUNCTION_LIST DMDFON IF_DATA DIM_X 0x383186 EXTERN WORD IF_DATA MCMESS 0x383186 EXTERN /end MEASUREMENT
/begin MEASUREMENT fln43_04 "Lernfilterwert, negativ" SWORD dtsegn_b720divZyl 1 100 -120 119.996 FUNCTION_LIST DMDFON IF_DATA DIM_X 0x3831B6 EXTERN WORD IF_DATA MCMESS 0x3831B6 EXTERN /end MEASUREMENT
/begin MEASUREMENT fln43_05 "Lernfilterwert, negativ" SWORD dtsegn_b720divZyl 1 100 -120 119.996 FUNCTION_LIST DMDFON IF_DATA DIM_X 0x3831E6 EXTERN WORD IF_DATA MCMESS 0x3831E6 EXTERN /end MEASUREMENT
/begin MEASUREMENT fln43_06 "Lernfilterwert, negativ" SWORD dtsegn_b720divZyl 1 100 -120 119.996 FUNCTION_LIST DMDFON IF_DATA DIM_X 0x383216 EXTERN WORD IF_DATA MCMESS 0x383216 EXTERN /end MEASUREMENT
/begin MEASUREMENT fln43_07 "Lernfilterwert, negativ" SWORD dtsegn_b720divZyl 1 100 -120 119.996 FUNCTION_LIST DMDFON IF_DATA DIM_X 0x383246 EXTERN WORD IF_DATA MCMESS 0x383246 EXTERN /end MEASUREMENT
/begin MEASUREMENT fln43_08 "Lernfilterwert, negativ" SWORD dtsegn_b720divZyl 1 100 -120 119.996 FUNCTION_LIST DMDFON IF_DATA DIM_X 0x383276 EXTERN WORD IF_DATA MCMESS 0x383276 EXTERN /end MEASUREMENT
/begin MEASUREMENT fln51_02 "Lernfilterwert, negativ" SWORD dtsegn_b720divZyl 1 100 -120 119.996 FUNCTION_LIST DMDFON IF_DATA DIM_X 0x383138 EXTERN WORD IF_DATA MCMESS 0x383138 EXTERN /end MEASUREMENT
/begin MEASUREMENT fln51_03 "Lernfilterwert, negativ" SWORD dtsegn_b720divZyl 1 100 -120 119.996 FUNCTION_LIST DMDFON IF_DATA DIM_X 0x383168 EXTERN WORD IF_DATA MCMESS 0x383168 EXTERN /end MEASUREMENT
/begin MEASUREMENT fln51_04 "Lernfilterwert, negativ" SWORD dtsegn_b720divZyl 1 100 -120 119.996 FUNCTION_LIST DMDFON IF_DATA DIM_X 0x383198 EXTERN WORD IF_DATA MCMESS 0x383198 EXTERN /end MEASUREMENT
/begin MEASUREMENT fln51_05 "Lernfilterwert, negativ" SWORD dtsegn_b720divZyl 1 100 -120 119.996 FUNCTION_LIST DMDFON IF_DATA DIM_X 0x3831C8 EXTERN WORD IF_DATA MCMESS 0x3831C8 EXTERN /end MEASUREMENT
/begin MEASUREMENT fln51_06 "Lernfilterwert, negativ" SWORD dtsegn_b720divZyl 1 100 -120 119.996 FUNCTION_LIST DMDFON IF_DATA DIM_X 0x3831F8 EXTERN WORD IF_DATA MCMESS 0x3831F8 EXTERN /end MEASUREMENT
/begin MEASUREMENT fln51_07 "Lernfilterwert, negativ" SWORD dtsegn_b720divZyl 1 100 -120 119.996 FUNCTION_LIST DMDFON IF_DATA DIM_X 0x383228 EXTERN WORD IF_DATA MCMESS 0x383228 EXTERN /end MEASUREMENT
/begin MEASUREMENT fln51_08 "Lernfilterwert, negativ" SWORD dtsegn_b720divZyl 1 100 -120 119.996 FUNCTION_LIST DMDFON IF_DATA DIM_X 0x383258 EXTERN WORD IF_DATA MCMESS 0x383258 EXTERN /end MEASUREMENT
/begin MEASUREMENT fln52_02 "Lernfilterwert, negativ" SWORD dtsegn_b720divZyl 1 100 -120 119.996 FUNCTION_LIST DMDFON IF_DATA DIM_X 0x383148 EXTERN WORD IF_DATA MCMESS 0x383148 EXTERN /end MEASUREMENT
/begin MEASUREMENT fln52_03 "Lernfilterwert, negativ" SWORD dtsegn_b720divZyl 1 100 -120 119.996 FUNCTION_LIST DMDFON IF_DATA DIM_X 0x383178 EXTERN WORD IF_DATA MCMESS 0x383178 EXTERN /end MEASUREMENT
/begin MEASUREMENT fln52_04 "Lernfilterwert, negativ" SWORD dtsegn_b720divZyl 1 100 -120 119.996 FUNCTION_LIST DMDFON IF_DATA DIM_X 0x3831A8 EXTERN WORD IF_DATA MCMESS 0x3831A8 EXTERN /end MEASUREMENT
/begin MEASUREMENT fln52_05 "Lernfilterwert, negativ" SWORD dtsegn_b720divZyl 1 100 -120 119.996 FUNCTION_LIST DMDFON IF_DATA DIM_X 0x3831D8 EXTERN WORD IF_DATA MCMESS 0x3831D8 EXTERN /end MEASUREMENT
/begin MEASUREMENT fln52_06 "Lernfilterwert, negativ" SWORD dtsegn_b720divZyl 1 100 -120 119.996 FUNCTION_LIST DMDFON IF_DATA DIM_X 0x383208 EXTERN WORD IF_DATA MCMESS 0x383208 EXTERN /end MEASUREMENT
/begin MEASUREMENT fln52_07 "Lernfilterwert, negativ" SWORD dtsegn_b720divZyl 1 100 -120 119.996 FUNCTION_LIST DMDFON IF_DATA DIM_X 0x383238 EXTERN WORD IF_DATA MCMESS 0x383238 EXTERN /end MEASUREMENT
/begin MEASUREMENT fln52_08 "Lernfilterwert, negativ" SWORD dtsegn_b720divZyl 1 100 -120 119.996 FUNCTION_LIST DMDFON IF_DATA DIM_X 0x383268 EXTERN WORD IF_DATA MCMESS 0x383268 EXTERN /end MEASUREMENT
/begin MEASUREMENT fln53_02 "Lernfilterwert, negativ" SWORD dtsegn_b720divZyl 1 100 -120 119.996 FUNCTION_LIST DMDFON IF_DATA DIM_X 0x383158 EXTERN WORD IF_DATA MCMESS 0x383158 EXTERN /end MEASUREMENT
/begin MEASUREMENT fln53_03 "Lernfilterwert, negativ" SWORD dtsegn_b720divZyl 1 100 -120 119.996 FUNCTION_LIST DMDFON IF_DATA DIM_X 0x383188 EXTERN WORD IF_DATA MCMESS 0x383188 EXTERN /end MEASUREMENT
/begin MEASUREMENT fln53_04 "Lernfilterwert, negativ" SWORD dtsegn_b720divZyl 1 100 -120 119.996 FUNCTION_LIST DMDFON IF_DATA DIM_X 0x3831B8 EXTERN WORD IF_DATA MCMESS 0x3831B8 EXTERN /end MEASUREMENT
/begin MEASUREMENT fln53_05 "Lernfilterwert, negativ" SWORD dtsegn_b720divZyl 1 100 -120 119.996 FUNCTION_LIST DMDFON IF_DATA DIM_X 0x3831E8 EXTERN WORD IF_DATA MCMESS 0x3831E8 EXTERN /end MEASUREMENT
/begin MEASUREMENT fln53_06 "Lernfilterwert, negativ" SWORD dtsegn_b720divZyl 1 100 -120 119.996 FUNCTION_LIST DMDFON IF_DATA DIM_X 0x383218 EXTERN WORD IF_DATA MCMESS 0x383218 EXTERN /end MEASUREMENT
/begin MEASUREMENT fln53_07 "Lernfilterwert, negativ" SWORD dtsegn_b720divZyl 1 100 -120 119.996 FUNCTION_LIST DMDFON IF_DATA DIM_X 0x383248 EXTERN WORD IF_DATA MCMESS 0x383248 EXTERN /end MEASUREMENT
/begin MEASUREMENT fln53_08 "Lernfilterwert, negativ" SWORD dtsegn_b720divZyl 1 100 -120 119.996 FUNCTION_LIST DMDFON IF_DATA DIM_X 0x383278 EXTERN WORD IF_DATA MCMESS 0x383278 EXTERN /end MEASUREMENT
/begin MEASUREMENT fln61_02 "Lernfilterwert, negativ" SWORD dtsegn_b720divZyl 1 100 -120 119.996 FUNCTION_LIST DMDFON IF_DATA DIM_X 0x38313A EXTERN WORD IF_DATA MCMESS 0x38313A EXTERN /end MEASUREMENT
/begin MEASUREMENT fln61_03 "Lernfilterwert, negativ" SWORD dtsegn_b720divZyl 1 100 -120 119.996 FUNCTION_LIST DMDFON IF_DATA DIM_X 0x38316A EXTERN WORD IF_DATA MCMESS 0x38316A EXTERN /end MEASUREMENT
/begin MEASUREMENT fln61_04 "Lernfilterwert, negativ" SWORD dtsegn_b720divZyl 1 100 -120 119.996 FUNCTION_LIST DMDFON IF_DATA DIM_X 0x38319A EXTERN WORD IF_DATA MCMESS 0x38319A EXTERN /end MEASUREMENT
/begin MEASUREMENT fln61_05 "Lernfilterwert, negativ" SWORD dtsegn_b720divZyl 1 100 -120 119.996 FUNCTION_LIST DMDFON IF_DATA DIM_X 0x3831CA EXTERN WORD IF_DATA MCMESS 0x3831CA EXTERN /end MEASUREMENT
/begin MEASUREMENT fln61_06 "Lernfilterwert, negativ" SWORD dtsegn_b720divZyl 1 100 -120 119.996 FUNCTION_LIST DMDFON IF_DATA DIM_X 0x3831FA EXTERN WORD IF_DATA MCMESS 0x3831FA EXTERN /end MEASUREMENT
/begin MEASUREMENT fln61_07 "Lernfilterwert, negativ" SWORD dtsegn_b720divZyl 1 100 -120 119.996 FUNCTION_LIST DMDFON IF_DATA DIM_X 0x38322A EXTERN WORD IF_DATA MCMESS 0x38322A EXTERN /end MEASUREMENT
/begin MEASUREMENT fln61_08 "Lernfilterwert, negativ" SWORD dtsegn_b720divZyl 1 100 -120 119.996 FUNCTION_LIST DMDFON IF_DATA DIM_X 0x38325A EXTERN WORD IF_DATA MCMESS 0x38325A EXTERN /end MEASUREMENT
/begin MEASUREMENT fln62_02 "Lernfilterwert, negativ" SWORD dtsegn_b720divZyl 1 100 -120 119.996 FUNCTION_LIST DMDFON IF_DATA DIM_X 0x38314A EXTERN WORD IF_DATA MCMESS 0x38314A EXTERN /end MEASUREMENT
/begin MEASUREMENT fln62_03 "Lernfilterwert, negativ" SWORD dtsegn_b720divZyl 1 100 -120 119.996 FUNCTION_LIST DMDFON IF_DATA DIM_X 0x38317A EXTERN WORD IF_DATA MCMESS 0x38317A EXTERN /end MEASUREMENT
/begin MEASUREMENT fln62_04 "Lernfilterwert, negativ" SWORD dtsegn_b720divZyl 1 100 -120 119.996 FUNCTION_LIST DMDFON IF_DATA DIM_X 0x3831AA EXTERN WORD IF_DATA MCMESS 0x3831AA EXTERN /end MEASUREMENT
/begin MEASUREMENT fln62_05 "Lernfilterwert, negativ" SWORD dtsegn_b720divZyl 1 100 -120 119.996 FUNCTION_LIST DMDFON IF_DATA DIM_X 0x3831DA EXTERN WORD IF_DATA MCMESS 0x3831DA EXTERN /end MEASUREMENT
/begin MEASUREMENT fln62_06 "Lernfilterwert, negativ" SWORD dtsegn_b720divZyl 1 100 -120 119.996 FUNCTION_LIST DMDFON IF_DATA DIM_X 0x38320A EXTERN WORD IF_DATA MCMESS 0x38320A EXTERN /end MEASUREMENT
/begin MEASUREMENT fln62_07 "Lernfilterwert, negativ" SWORD dtsegn_b720divZyl 1 100 -120 119.996 FUNCTION_LIST DMDFON IF_DATA DIM_X 0x38323A EXTERN WORD IF_DATA MCMESS 0x38323A EXTERN /end MEASUREMENT
/begin MEASUREMENT fln62_08 "Lernfilterwert, negativ" SWORD dtsegn_b720divZyl 1 100 -120 119.996 FUNCTION_LIST DMDFON IF_DATA DIM_X 0x38326A EXTERN WORD IF_DATA MCMESS 0x38326A EXTERN /end MEASUREMENT
/begin MEASUREMENT fln63_02 "Lernfilterwert, negativ" SWORD dtsegn_b720divZyl 1 100 -120 119.996 FUNCTION_LIST DMDFON IF_DATA DIM_X 0x38315A EXTERN WORD IF_DATA MCMESS 0x38315A EXTERN /end MEASUREMENT
/begin MEASUREMENT fln63_03 "Lernfilterwert, negativ" SWORD dtsegn_b720divZyl 1 100 -120 119.996 FUNCTION_LIST DMDFON IF_DATA DIM_X 0x38318A EXTERN WORD IF_DATA MCMESS 0x38318A EXTERN /end MEASUREMENT
/begin MEASUREMENT fln63_04 "Lernfilterwert, negativ" SWORD dtsegn_b720divZyl 1 100 -120 119.996 FUNCTION_LIST DMDFON IF_DATA DIM_X 0x3831BA EXTERN WORD IF_DATA MCMESS 0x3831BA EXTERN /end MEASUREMENT
/begin MEASUREMENT fln63_05 "Lernfilterwert, negativ" SWORD dtsegn_b720divZyl 1 100 -120 119.996 FUNCTION_LIST DMDFON IF_DATA DIM_X 0x3831EA EXTERN WORD IF_DATA MCMESS 0x3831EA EXTERN /end MEASUREMENT
/begin MEASUREMENT fln63_06 "Lernfilterwert, negativ" SWORD dtsegn_b720divZyl 1 100 -120 119.996 FUNCTION_LIST DMDFON IF_DATA DIM_X 0x38321A EXTERN WORD IF_DATA MCMESS 0x38321A EXTERN /end MEASUREMENT
/begin MEASUREMENT fln63_07 "Lernfilterwert, negativ" SWORD dtsegn_b720divZyl 1 100 -120 119.996 FUNCTION_LIST DMDFON IF_DATA DIM_X 0x38324A EXTERN WORD IF_DATA MCMESS 0x38324A EXTERN /end MEASUREMENT
/begin MEASUREMENT fln63_08 "Lernfilterwert, negativ" SWORD dtsegn_b720divZyl 1 100 -120 119.996 FUNCTION_LIST DMDFON IF_DATA DIM_X 0x38327A EXTERN WORD IF_DATA MCMESS 0x38327A EXTERN /end MEASUREMENT
/begin MEASUREMENT fln71_02 "Lernfilterwert, negativ" SWORD dtsegn_b720divZyl 1 100 -120 119.996 FUNCTION_LIST DMDFON IF_DATA DIM_X 0x38313C EXTERN WORD IF_DATA MCMESS 0x38313C EXTERN /end MEASUREMENT
/begin MEASUREMENT fln71_03 "Lernfilterwert, negativ" SWORD dtsegn_b720divZyl 1 100 -120 119.996 FUNCTION_LIST DMDFON IF_DATA DIM_X 0x38316C EXTERN WORD IF_DATA MCMESS 0x38316C EXTERN /end MEASUREMENT
/begin MEASUREMENT fln71_04 "Lernfilterwert, negativ" SWORD dtsegn_b720divZyl 1 100 -120 119.996 FUNCTION_LIST DMDFON IF_DATA DIM_X 0x38319C EXTERN WORD IF_DATA MCMESS 0x38319C EXTERN /end MEASUREMENT
/begin MEASUREMENT fln71_05 "Lernfilterwert, negativ" SWORD dtsegn_b720divZyl 1 100 -120 119.996 FUNCTION_LIST DMDFON IF_DATA DIM_X 0x3831CC EXTERN WORD IF_DATA MCMESS 0x3831CC EXTERN /end MEASUREMENT
/begin MEASUREMENT fln71_06 "Lernfilterwert, negativ" SWORD dtsegn_b720divZyl 1 100 -120 119.996 FUNCTION_LIST DMDFON IF_DATA DIM_X 0x3831FC EXTERN WORD IF_DATA MCMESS 0x3831FC EXTERN /end MEASUREMENT
/begin MEASUREMENT fln71_07 "Lernfilterwert, negativ" SWORD dtsegn_b720divZyl 1 100 -120 119.996 FUNCTION_LIST DMDFON IF_DATA DIM_X 0x38322C EXTERN WORD IF_DATA MCMESS 0x38322C EXTERN /end MEASUREMENT
/begin MEASUREMENT fln71_08 "Lernfilterwert, negativ" SWORD dtsegn_b720divZyl 1 100 -120 119.996 FUNCTION_LIST DMDFON IF_DATA DIM_X 0x38325C EXTERN WORD IF_DATA MCMESS 0x38325C EXTERN /end MEASUREMENT
/begin MEASUREMENT fln72_02 "Lernfilterwert, negativ" SWORD dtsegn_b720divZyl 1 100 -120 119.996 FUNCTION_LIST DMDFON IF_DATA DIM_X 0x38314C EXTERN WORD IF_DATA MCMESS 0x38314C EXTERN /end MEASUREMENT
/begin MEASUREMENT fln72_03 "Lernfilterwert, negativ" SWORD dtsegn_b720divZyl 1 100 -120 119.996 FUNCTION_LIST DMDFON IF_DATA DIM_X 0x38317C EXTERN WORD IF_DATA MCMESS 0x38317C EXTERN /end MEASUREMENT
/begin MEASUREMENT fln72_04 "Lernfilterwert, negativ" SWORD dtsegn_b720divZyl 1 100 -120 119.996 FUNCTION_LIST DMDFON IF_DATA DIM_X 0x3831AC EXTERN WORD IF_DATA MCMESS 0x3831AC EXTERN /end MEASUREMENT
/begin MEASUREMENT fln72_05 "Lernfilterwert, negativ" SWORD dtsegn_b720divZyl 1 100 -120 119.996 FUNCTION_LIST DMDFON IF_DATA DIM_X 0x3831DC EXTERN WORD IF_DATA MCMESS 0x3831DC EXTERN /end MEASUREMENT
/begin MEASUREMENT fln72_06 "Lernfilterwert, negativ" SWORD dtsegn_b720divZyl 1 100 -120 119.996 FUNCTION_LIST DMDFON IF_DATA DIM_X 0x38320C EXTERN WORD IF_DATA MCMESS 0x38320C EXTERN /end MEASUREMENT
/begin MEASUREMENT fln72_07 "Lernfilterwert, negativ" SWORD dtsegn_b720divZyl 1 100 -120 119.996 FUNCTION_LIST DMDFON IF_DATA DIM_X 0x38323C EXTERN WORD IF_DATA MCMESS 0x38323C EXTERN /end MEASUREMENT
/begin MEASUREMENT fln72_08 "Lernfilterwert, negativ" SWORD dtsegn_b720divZyl 1 100 -120 119.996 FUNCTION_LIST DMDFON IF_DATA DIM_X 0x38326C EXTERN WORD IF_DATA MCMESS 0x38326C EXTERN /end MEASUREMENT
/begin MEASUREMENT fln73_02 "Lernfilterwert, negativ" SWORD dtsegn_b720divZyl 1 100 -120 119.996 FUNCTION_LIST DMDFON IF_DATA DIM_X 0x38315C EXTERN WORD IF_DATA MCMESS 0x38315C EXTERN /end MEASUREMENT
/begin MEASUREMENT fln73_03 "Lernfilterwert, negativ" SWORD dtsegn_b720divZyl 1 100 -120 119.996 FUNCTION_LIST DMDFON IF_DATA DIM_X 0x38318C EXTERN WORD IF_DATA MCMESS 0x38318C EXTERN /end MEASUREMENT
/begin MEASUREMENT fln73_04 "Lernfilterwert, negativ" SWORD dtsegn_b720divZyl 1 100 -120 119.996 FUNCTION_LIST DMDFON IF_DATA DIM_X 0x3831BC EXTERN WORD IF_DATA MCMESS 0x3831BC EXTERN /end MEASUREMENT
/begin MEASUREMENT fln73_05 "Lernfilterwert, negativ" SWORD dtsegn_b720divZyl 1 100 -120 119.996 FUNCTION_LIST DMDFON IF_DATA DIM_X 0x3831EC EXTERN WORD IF_DATA MCMESS 0x3831EC EXTERN /end MEASUREMENT
/begin MEASUREMENT fln73_06 "Lernfilterwert, negativ" SWORD dtsegn_b720divZyl 1 100 -120 119.996 FUNCTION_LIST DMDFON IF_DATA DIM_X 0x38321C EXTERN WORD IF_DATA MCMESS 0x38321C EXTERN /end MEASUREMENT
/begin MEASUREMENT fln73_07 "Lernfilterwert, negativ" SWORD dtsegn_b720divZyl 1 100 -120 119.996 FUNCTION_LIST DMDFON IF_DATA DIM_X 0x38324C EXTERN WORD IF_DATA MCMESS 0x38324C EXTERN /end MEASUREMENT
/begin MEASUREMENT fln73_08 "Lernfilterwert, negativ" SWORD dtsegn_b720divZyl 1 100 -120 119.996 FUNCTION_LIST DMDFON IF_DATA DIM_X 0x38327C EXTERN WORD IF_DATA MCMESS 0x38327C EXTERN /end MEASUREMENT
/begin MEASUREMENT fln81_02 "Lernfilterwert, negativ" SWORD dtsegn_b720divZyl 1 100 -120 119.996 FUNCTION_LIST DMDFON IF_DATA DIM_X 0x38313E EXTERN WORD IF_DATA MCMESS 0x38313E EXTERN /end MEASUREMENT
/begin MEASUREMENT fln81_03 "Lernfilterwert, negativ" SWORD dtsegn_b720divZyl 1 100 -120 119.996 FUNCTION_LIST DMDFON IF_DATA DIM_X 0x38316E EXTERN WORD IF_DATA MCMESS 0x38316E EXTERN /end MEASUREMENT
/begin MEASUREMENT fln81_04 "Lernfilterwert, negativ" SWORD dtsegn_b720divZyl 1 100 -120 119.996 FUNCTION_LIST DMDFON IF_DATA DIM_X 0x38319E EXTERN WORD IF_DATA MCMESS 0x38319E EXTERN /end MEASUREMENT
/begin MEASUREMENT fln81_05 "Lernfilterwert, negativ" SWORD dtsegn_b720divZyl 1 100 -120 119.996 FUNCTION_LIST DMDFON IF_DATA DIM_X 0x3831CE EXTERN WORD IF_DATA MCMESS 0x3831CE EXTERN /end MEASUREMENT
/begin MEASUREMENT fln81_06 "Lernfilterwert, negativ" SWORD dtsegn_b720divZyl 1 100 -120 119.996 FUNCTION_LIST DMDFON IF_DATA DIM_X 0x3831FE EXTERN WORD IF_DATA MCMESS 0x3831FE EXTERN /end MEASUREMENT
/begin MEASUREMENT fln81_07 "Lernfilterwert, negativ" SWORD dtsegn_b720divZyl 1 100 -120 119.996 FUNCTION_LIST DMDFON IF_DATA DIM_X 0x38322E EXTERN WORD IF_DATA MCMESS 0x38322E EXTERN /end MEASUREMENT
/begin MEASUREMENT fln81_08 "Lernfilterwert, negativ" SWORD dtsegn_b720divZyl 1 100 -120 119.996 FUNCTION_LIST DMDFON IF_DATA DIM_X 0x38325E EXTERN WORD IF_DATA MCMESS 0x38325E EXTERN /end MEASUREMENT
/begin MEASUREMENT fln82_02 "Lernfilterwert, negativ" SWORD dtsegn_b720divZyl 1 100 -120 119.996 FUNCTION_LIST DMDFON IF_DATA DIM_X 0x38314E EXTERN WORD IF_DATA MCMESS 0x38314E EXTERN /end MEASUREMENT
/begin MEASUREMENT fln82_03 "Lernfilterwert, negativ" SWORD dtsegn_b720divZyl 1 100 -120 119.996 FUNCTION_LIST DMDFON IF_DATA DIM_X 0x38317E EXTERN WORD IF_DATA MCMESS 0x38317E EXTERN /end MEASUREMENT
/begin MEASUREMENT fln82_04 "Lernfilterwert, negativ" SWORD dtsegn_b720divZyl 1 100 -120 119.996 FUNCTION_LIST DMDFON IF_DATA DIM_X 0x3831AE EXTERN WORD IF_DATA MCMESS 0x3831AE EXTERN /end MEASUREMENT
/begin MEASUREMENT fln82_05 "Lernfilterwert, negativ" SWORD dtsegn_b720divZyl 1 100 -120 119.996 FUNCTION_LIST DMDFON IF_DATA DIM_X 0x3831DE EXTERN WORD IF_DATA MCMESS 0x3831DE EXTERN /end MEASUREMENT
/begin MEASUREMENT fln82_06 "Lernfilterwert, negativ" SWORD dtsegn_b720divZyl 1 100 -120 119.996 FUNCTION_LIST DMDFON IF_DATA DIM_X 0x38320E EXTERN WORD IF_DATA MCMESS 0x38320E EXTERN /end MEASUREMENT
/begin MEASUREMENT fln82_07 "Lernfilterwert, negativ" SWORD dtsegn_b720divZyl 1 100 -120 119.996 FUNCTION_LIST DMDFON IF_DATA DIM_X 0x38323E EXTERN WORD IF_DATA MCMESS 0x38323E EXTERN /end MEASUREMENT
/begin MEASUREMENT fln82_08 "Lernfilterwert, negativ" SWORD dtsegn_b720divZyl 1 100 -120 119.996 FUNCTION_LIST DMDFON IF_DATA DIM_X 0x38326E EXTERN WORD IF_DATA MCMESS 0x38326E EXTERN /end MEASUREMENT
/begin MEASUREMENT fln83_02 "Lernfilterwert, negativ" SWORD dtsegn_b720divZyl 1 100 -120 119.996 FUNCTION_LIST DMDFON IF_DATA DIM_X 0x38315E EXTERN WORD IF_DATA MCMESS 0x38315E EXTERN /end MEASUREMENT
/begin MEASUREMENT fln83_03 "Lernfilterwert, negativ" SWORD dtsegn_b720divZyl 1 100 -120 119.996 FUNCTION_LIST DMDFON IF_DATA DIM_X 0x38318E EXTERN WORD IF_DATA MCMESS 0x38318E EXTERN /end MEASUREMENT
/begin MEASUREMENT fln83_04 "Lernfilterwert, negativ" SWORD dtsegn_b720divZyl 1 100 -120 119.996 FUNCTION_LIST DMDFON IF_DATA DIM_X 0x3831BE EXTERN WORD IF_DATA MCMESS 0x3831BE EXTERN /end MEASUREMENT
/begin MEASUREMENT fln83_05 "Lernfilterwert, negativ" SWORD dtsegn_b720divZyl 1 100 -120 119.996 FUNCTION_LIST DMDFON IF_DATA DIM_X 0x3831EE EXTERN WORD IF_DATA MCMESS 0x3831EE EXTERN /end MEASUREMENT
/begin MEASUREMENT fln83_06 "Lernfilterwert, negativ" SWORD dtsegn_b720divZyl 1 100 -120 119.996 FUNCTION_LIST DMDFON IF_DATA DIM_X 0x38321E EXTERN WORD IF_DATA MCMESS 0x38321E EXTERN /end MEASUREMENT
/begin MEASUREMENT fln83_07 "Lernfilterwert, negativ" SWORD dtsegn_b720divZyl 1 100 -120 119.996 FUNCTION_LIST DMDFON IF_DATA DIM_X 0x38324E EXTERN WORD IF_DATA MCMESS 0x38324E EXTERN /end MEASUREMENT
/begin MEASUREMENT fln83_08 "Lernfilterwert, negativ" SWORD dtsegn_b720divZyl 1 100 -120 119.996 FUNCTION_LIST DMDFON IF_DATA DIM_X 0x38327E EXTERN WORD IF_DATA MCMESS 0x38327E EXTERN /end MEASUREMENT
/begin MEASUREMENT flp11_02 "Lernfilterwert, positiv" SWORD dtsegn_b720divZyl 1 100 -120 119.996 FUNCTION_LIST DMDFON IF_DATA DIM_X 0x383280 EXTERN WORD IF_DATA MCMESS 0x383280 EXTERN /end MEASUREMENT
/begin MEASUREMENT flp11_03 "Lernfilterwert, positiv" SWORD dtsegn_b720divZyl 1 100 -120 119.996 FUNCTION_LIST DMDFON IF_DATA DIM_X 0x3832B0 EXTERN WORD IF_DATA MCMESS 0x3832B0 EXTERN /end MEASUREMENT
/begin MEASUREMENT flp11_04 "Lernfilterwert, positiv" SWORD dtsegn_b720divZyl 1 100 -120 119.996 FUNCTION_LIST DMDFON IF_DATA DIM_X 0x3832E0 EXTERN WORD IF_DATA MCMESS 0x3832E0 EXTERN /end MEASUREMENT
/begin MEASUREMENT flp11_05 "Lernfilterwert, positiv" SWORD dtsegn_b720divZyl 1 100 -120 119.996 FUNCTION_LIST DMDFON IF_DATA DIM_X 0x383310 EXTERN WORD IF_DATA MCMESS 0x383310 EXTERN /end MEASUREMENT
/begin MEASUREMENT flp11_06 "Lernfilterwert, positiv" SWORD dtsegn_b720divZyl 1 100 -120 119.996 FUNCTION_LIST DMDFON IF_DATA DIM_X 0x383340 EXTERN WORD IF_DATA MCMESS 0x383340 EXTERN /end MEASUREMENT
/begin MEASUREMENT flp11_07 "Lernfilterwert, positiv" SWORD dtsegn_b720divZyl 1 100 -120 119.996 FUNCTION_LIST DMDFON IF_DATA DIM_X 0x383370 EXTERN WORD IF_DATA MCMESS 0x383370 EXTERN /end MEASUREMENT
/begin MEASUREMENT flp11_08 "Lernfilterwert, positiv" SWORD dtsegn_b720divZyl 1 100 -120 119.996 FUNCTION_LIST DMDFON IF_DATA DIM_X 0x3833A0 EXTERN WORD IF_DATA MCMESS 0x3833A0 EXTERN /end MEASUREMENT
/begin MEASUREMENT flp12_02 "Lernfilterwert, positiv" SWORD dtsegn_b720divZyl 1 100 -120 119.996 FUNCTION_LIST DMDFON IF_DATA DIM_X 0x383290 EXTERN WORD IF_DATA MCMESS 0x383290 EXTERN /end MEASUREMENT
/begin MEASUREMENT flp12_03 "Lernfilterwert, positiv" SWORD dtsegn_b720divZyl 1 100 -120 119.996 FUNCTION_LIST DMDFON IF_DATA DIM_X 0x3832C0 EXTERN WORD IF_DATA MCMESS 0x3832C0 EXTERN /end MEASUREMENT
/begin MEASUREMENT flp12_04 "Lernfilterwert, positiv" SWORD dtsegn_b720divZyl 1 100 -120 119.996 FUNCTION_LIST DMDFON IF_DATA DIM_X 0x3832F0 EXTERN WORD IF_DATA MCMESS 0x3832F0 EXTERN /end MEASUREMENT
/begin MEASUREMENT flp12_05 "Lernfilterwert, positiv" SWORD dtsegn_b720divZyl 1 100 -120 119.996 FUNCTION_LIST DMDFON IF_DATA DIM_X 0x383320 EXTERN WORD IF_DATA MCMESS 0x383320 EXTERN /end MEASUREMENT
/begin MEASUREMENT flp12_06 "Lernfilterwert, positiv" SWORD dtsegn_b720divZyl 1 100 -120 119.996 FUNCTION_LIST DMDFON IF_DATA DIM_X 0x383350 EXTERN WORD IF_DATA MCMESS 0x383350 EXTERN /end MEASUREMENT
/begin MEASUREMENT flp12_07 "Lernfilterwert, positiv" SWORD dtsegn_b720divZyl 1 100 -120 119.996 FUNCTION_LIST DMDFON IF_DATA DIM_X 0x383380 EXTERN WORD IF_DATA MCMESS 0x383380 EXTERN /end MEASUREMENT
/begin MEASUREMENT flp12_08 "Lernfilterwert, positiv" SWORD dtsegn_b720divZyl 1 100 -120 119.996 FUNCTION_LIST DMDFON IF_DATA DIM_X 0x3833B0 EXTERN WORD IF_DATA MCMESS 0x3833B0 EXTERN /end MEASUREMENT
/begin MEASUREMENT flp13_02 "Lernfilterwert, positiv" SWORD dtsegn_b720divZyl 1 100 -120 119.996 FUNCTION_LIST DMDFON IF_DATA DIM_X 0x3832A0 EXTERN WORD IF_DATA MCMESS 0x3832A0 EXTERN /end MEASUREMENT
/begin MEASUREMENT flp13_03 "Lernfilterwert, positiv" SWORD dtsegn_b720divZyl 1 100 -120 119.996 FUNCTION_LIST DMDFON IF_DATA DIM_X 0x3832D0 EXTERN WORD IF_DATA MCMESS 0x3832D0 EXTERN /end MEASUREMENT
/begin MEASUREMENT flp13_04 "Lernfilterwert, positiv" SWORD dtsegn_b720divZyl 1 100 -120 119.996 FUNCTION_LIST DMDFON IF_DATA DIM_X 0x383300 EXTERN WORD IF_DATA MCMESS 0x383300 EXTERN /end MEASUREMENT
/begin MEASUREMENT flp13_05 "Lernfilterwert, positiv" SWORD dtsegn_b720divZyl 1 100 -120 119.996 FUNCTION_LIST DMDFON IF_DATA DIM_X 0x383330 EXTERN WORD IF_DATA MCMESS 0x383330 EXTERN /end MEASUREMENT
/begin MEASUREMENT flp13_06 "Lernfilterwert, positiv" SWORD dtsegn_b720divZyl 1 100 -120 119.996 FUNCTION_LIST DMDFON IF_DATA DIM_X 0x383360 EXTERN WORD IF_DATA MCMESS 0x383360 EXTERN /end MEASUREMENT
/begin MEASUREMENT flp13_07 "Lernfilterwert, positiv" SWORD dtsegn_b720divZyl 1 100 -120 119.996 FUNCTION_LIST DMDFON IF_DATA DIM_X 0x383390 EXTERN WORD IF_DATA MCMESS 0x383390 EXTERN /end MEASUREMENT
/begin MEASUREMENT flp13_08 "Lernfilterwert, positiv" SWORD dtsegn_b720divZyl 1 100 -120 119.996 FUNCTION_LIST DMDFON IF_DATA DIM_X 0x3833C0 EXTERN WORD IF_DATA MCMESS 0x3833C0 EXTERN /end MEASUREMENT
/begin MEASUREMENT flp21_02 "Lernfilterwert, positiv" SWORD dtsegn_b720divZyl 1 100 -120 119.996 FUNCTION_LIST DMDFON IF_DATA DIM_X 0x383282 EXTERN WORD IF_DATA MCMESS 0x383282 EXTERN /end MEASUREMENT
/begin MEASUREMENT flp21_03 "Lernfilterwert, positiv" SWORD dtsegn_b720divZyl 1 100 -120 119.996 FUNCTION_LIST DMDFON IF_DATA DIM_X 0x3832B2 EXTERN WORD IF_DATA MCMESS 0x3832B2 EXTERN /end MEASUREMENT
/begin MEASUREMENT flp21_04 "Lernfilterwert, positiv" SWORD dtsegn_b720divZyl 1 100 -120 119.996 FUNCTION_LIST DMDFON IF_DATA DIM_X 0x3832E2 EXTERN WORD IF_DATA MCMESS 0x3832E2 EXTERN /end MEASUREMENT
/begin MEASUREMENT flp21_05 "Lernfilterwert, positiv" SWORD dtsegn_b720divZyl 1 100 -120 119.996 FUNCTION_LIST DMDFON IF_DATA DIM_X 0x383312 EXTERN WORD IF_DATA MCMESS 0x383312 EXTERN /end MEASUREMENT
/begin MEASUREMENT flp21_06 "Lernfilterwert, positiv" SWORD dtsegn_b720divZyl 1 100 -120 119.996 FUNCTION_LIST DMDFON IF_DATA DIM_X 0x383342 EXTERN WORD IF_DATA MCMESS 0x383342 EXTERN /end MEASUREMENT
/begin MEASUREMENT flp21_07 "Lernfilterwert, positiv" SWORD dtsegn_b720divZyl 1 100 -120 119.996 FUNCTION_LIST DMDFON IF_DATA DIM_X 0x383372 EXTERN WORD IF_DATA MCMESS 0x383372 EXTERN /end MEASUREMENT
/begin MEASUREMENT flp21_08 "Lernfilterwert, positiv" SWORD dtsegn_b720divZyl 1 100 -120 119.996 FUNCTION_LIST DMDFON IF_DATA DIM_X 0x3833A2 EXTERN WORD IF_DATA MCMESS 0x3833A2 EXTERN /end MEASUREMENT
/begin MEASUREMENT flp22_02 "Lernfilterwert, positiv" SWORD dtsegn_b720divZyl 1 100 -120 119.996 FUNCTION_LIST DMDFON IF_DATA DIM_X 0x383292 EXTERN WORD IF_DATA MCMESS 0x383292 EXTERN /end MEASUREMENT
/begin MEASUREMENT flp22_03 "Lernfilterwert, positiv" SWORD dtsegn_b720divZyl 1 100 -120 119.996 FUNCTION_LIST DMDFON IF_DATA DIM_X 0x3832C2 EXTERN WORD IF_DATA MCMESS 0x3832C2 EXTERN /end MEASUREMENT
/begin MEASUREMENT flp22_04 "Lernfilterwert, positiv" SWORD dtsegn_b720divZyl 1 100 -120 119.996 FUNCTION_LIST DMDFON IF_DATA DIM_X 0x3832F2 EXTERN WORD IF_DATA MCMESS 0x3832F2 EXTERN /end MEASUREMENT
/begin MEASUREMENT flp22_05 "Lernfilterwert, positiv" SWORD dtsegn_b720divZyl 1 100 -120 119.996 FUNCTION_LIST DMDFON IF_DATA DIM_X 0x383322 EXTERN WORD IF_DATA MCMESS 0x383322 EXTERN /end MEASUREMENT
/begin MEASUREMENT flp22_06 "Lernfilterwert, positiv" SWORD dtsegn_b720divZyl 1 100 -120 119.996 FUNCTION_LIST DMDFON IF_DATA DIM_X 0x383352 EXTERN WORD IF_DATA MCMESS 0x383352 EXTERN /end MEASUREMENT
/begin MEASUREMENT flp22_07 "Lernfilterwert, positiv" SWORD dtsegn_b720divZyl 1 100 -120 119.996 FUNCTION_LIST DMDFON IF_DATA DIM_X 0x383382 EXTERN WORD IF_DATA MCMESS 0x383382 EXTERN /end MEASUREMENT
/begin MEASUREMENT flp22_08 "Lernfilterwert, positiv" SWORD dtsegn_b720divZyl 1 100 -120 119.996 FUNCTION_LIST DMDFON IF_DATA DIM_X 0x3833B2 EXTERN WORD IF_DATA MCMESS 0x3833B2 EXTERN /end MEASUREMENT
/begin MEASUREMENT flp23_02 "Lernfilterwert, positiv" SWORD dtsegn_b720divZyl 1 100 -120 119.996 FUNCTION_LIST DMDFON IF_DATA DIM_X 0x3832A2 EXTERN WORD IF_DATA MCMESS 0x3832A2 EXTERN /end MEASUREMENT
/begin MEASUREMENT flp23_03 "Lernfilterwert, positiv" SWORD dtsegn_b720divZyl 1 100 -120 119.996 FUNCTION_LIST DMDFON IF_DATA DIM_X 0x3832D2 EXTERN WORD IF_DATA MCMESS 0x3832D2 EXTERN /end MEASUREMENT
/begin MEASUREMENT flp23_04 "Lernfilterwert, positiv" SWORD dtsegn_b720divZyl 1 100 -120 119.996 FUNCTION_LIST DMDFON IF_DATA DIM_X 0x383302 EXTERN WORD IF_DATA MCMESS 0x383302 EXTERN /end MEASUREMENT
/begin MEASUREMENT flp23_05 "Lernfilterwert, positiv" SWORD dtsegn_b720divZyl 1 100 -120 119.996 FUNCTION_LIST DMDFON IF_DATA DIM_X 0x383332 EXTERN WORD IF_DATA MCMESS 0x383332 EXTERN /end MEASUREMENT
/begin MEASUREMENT flp23_06 "Lernfilterwert, positiv" SWORD dtsegn_b720divZyl 1 100 -120 119.996 FUNCTION_LIST DMDFON IF_DATA DIM_X 0x383362 EXTERN WORD IF_DATA MCMESS 0x383362 EXTERN /end MEASUREMENT
/begin MEASUREMENT flp23_07 "Lernfilterwert, positiv" SWORD dtsegn_b720divZyl 1 100 -120 119.996 FUNCTION_LIST DMDFON IF_DATA DIM_X 0x383392 EXTERN WORD IF_DATA MCMESS 0x383392 EXTERN /end MEASUREMENT
/begin MEASUREMENT flp23_08 "Lernfilterwert, positiv" SWORD dtsegn_b720divZyl 1 100 -120 119.996 FUNCTION_LIST DMDFON IF_DATA DIM_X 0x3833C2 EXTERN WORD IF_DATA MCMESS 0x3833C2 EXTERN /end MEASUREMENT
/begin MEASUREMENT flp31_02 "Lernfilterwert, positiv" SWORD dtsegn_b720divZyl 1 100 -120 119.996 FUNCTION_LIST DMDFON IF_DATA DIM_X 0x383284 EXTERN WORD IF_DATA MCMESS 0x383284 EXTERN /end MEASUREMENT
/begin MEASUREMENT flp31_03 "Lernfilterwert, positiv" SWORD dtsegn_b720divZyl 1 100 -120 119.996 FUNCTION_LIST DMDFON IF_DATA DIM_X 0x3832B4 EXTERN WORD IF_DATA MCMESS 0x3832B4 EXTERN /end MEASUREMENT
/begin MEASUREMENT flp31_04 "Lernfilterwert, positiv" SWORD dtsegn_b720divZyl 1 100 -120 119.996 FUNCTION_LIST DMDFON IF_DATA DIM_X 0x3832E4 EXTERN WORD IF_DATA MCMESS 0x3832E4 EXTERN /end MEASUREMENT
/begin MEASUREMENT flp31_05 "Lernfilterwert, positiv" SWORD dtsegn_b720divZyl 1 100 -120 119.996 FUNCTION_LIST DMDFON IF_DATA DIM_X 0x383314 EXTERN WORD IF_DATA MCMESS 0x383314 EXTERN /end MEASUREMENT
/begin MEASUREMENT flp31_06 "Lernfilterwert, positiv" SWORD dtsegn_b720divZyl 1 100 -120 119.996 FUNCTION_LIST DMDFON IF_DATA DIM_X 0x383344 EXTERN WORD IF_DATA MCMESS 0x383344 EXTERN /end MEASUREMENT
/begin MEASUREMENT flp31_07 "Lernfilterwert, positiv" SWORD dtsegn_b720divZyl 1 100 -120 119.996 FUNCTION_LIST DMDFON IF_DATA DIM_X 0x383374 EXTERN WORD IF_DATA MCMESS 0x383374 EXTERN /end MEASUREMENT
/begin MEASUREMENT flp31_08 "Lernfilterwert, positiv" SWORD dtsegn_b720divZyl 1 100 -120 119.996 FUNCTION_LIST DMDFON IF_DATA DIM_X 0x3833A4 EXTERN WORD IF_DATA MCMESS 0x3833A4 EXTERN /end MEASUREMENT
/begin MEASUREMENT flp32_02 "Lernfilterwert, positiv" SWORD dtsegn_b720divZyl 1 100 -120 119.996 FUNCTION_LIST DMDFON IF_DATA DIM_X 0x383294 EXTERN WORD IF_DATA MCMESS 0x383294 EXTERN /end MEASUREMENT
/begin MEASUREMENT flp32_03 "Lernfilterwert, positiv" SWORD dtsegn_b720divZyl 1 100 -120 119.996 FUNCTION_LIST DMDFON IF_DATA DIM_X 0x3832C4 EXTERN WORD IF_DATA MCMESS 0x3832C4 EXTERN /end MEASUREMENT
/begin MEASUREMENT flp32_04 "Lernfilterwert, positiv" SWORD dtsegn_b720divZyl 1 100 -120 119.996 FUNCTION_LIST DMDFON IF_DATA DIM_X 0x3832F4 EXTERN WORD IF_DATA MCMESS 0x3832F4 EXTERN /end MEASUREMENT
/begin MEASUREMENT flp32_05 "Lernfilterwert, positiv" SWORD dtsegn_b720divZyl 1 100 -120 119.996 FUNCTION_LIST DMDFON IF_DATA DIM_X 0x383324 EXTERN WORD IF_DATA MCMESS 0x383324 EXTERN /end MEASUREMENT
/begin MEASUREMENT flp32_06 "Lernfilterwert, positiv" SWORD dtsegn_b720divZyl 1 100 -120 119.996 FUNCTION_LIST DMDFON IF_DATA DIM_X 0x383354 EXTERN WORD IF_DATA MCMESS 0x383354 EXTERN /end MEASUREMENT
/begin MEASUREMENT flp32_07 "Lernfilterwert, positiv" SWORD dtsegn_b720divZyl 1 100 -120 119.996 FUNCTION_LIST DMDFON IF_DATA DIM_X 0x383384 EXTERN WORD IF_DATA MCMESS 0x383384 EXTERN /end MEASUREMENT
/begin MEASUREMENT flp32_08 "Lernfilterwert, positiv" SWORD dtsegn_b720divZyl 1 100 -120 119.996 FUNCTION_LIST DMDFON IF_DATA DIM_X 0x3833B4 EXTERN WORD IF_DATA MCMESS 0x3833B4 EXTERN /end MEASUREMENT
/begin MEASUREMENT flp33_02 "Lernfilterwert, positiv" SWORD dtsegn_b720divZyl 1 100 -120 119.996 FUNCTION_LIST DMDFON IF_DATA DIM_X 0x3832A4 EXTERN WORD IF_DATA MCMESS 0x3832A4 EXTERN /end MEASUREMENT
/begin MEASUREMENT flp33_03 "Lernfilterwert, positiv" SWORD dtsegn_b720divZyl 1 100 -120 119.996 FUNCTION_LIST DMDFON IF_DATA DIM_X 0x3832D4 EXTERN WORD IF_DATA MCMESS 0x3832D4 EXTERN /end MEASUREMENT
/begin MEASUREMENT flp33_04 "Lernfilterwert, positiv" SWORD dtsegn_b720divZyl 1 100 -120 119.996 FUNCTION_LIST DMDFON IF_DATA DIM_X 0x383304 EXTERN WORD IF_DATA MCMESS 0x383304 EXTERN /end MEASUREMENT
/begin MEASUREMENT flp33_05 "Lernfilterwert, positiv" SWORD dtsegn_b720divZyl 1 100 -120 119.996 FUNCTION_LIST DMDFON IF_DATA DIM_X 0x383334 EXTERN WORD IF_DATA MCMESS 0x383334 EXTERN /end MEASUREMENT
/begin MEASUREMENT flp33_06 "Lernfilterwert, positiv" SWORD dtsegn_b720divZyl 1 100 -120 119.996 FUNCTION_LIST DMDFON IF_DATA DIM_X 0x383364 EXTERN WORD IF_DATA MCMESS 0x383364 EXTERN /end MEASUREMENT
/begin MEASUREMENT flp33_07 "Lernfilterwert, positiv" SWORD dtsegn_b720divZyl 1 100 -120 119.996 FUNCTION_LIST DMDFON IF_DATA DIM_X 0x383394 EXTERN WORD IF_DATA MCMESS 0x383394 EXTERN /end MEASUREMENT
/begin MEASUREMENT flp33_08 "Lernfilterwert, positiv" SWORD dtsegn_b720divZyl 1 100 -120 119.996 FUNCTION_LIST DMDFON IF_DATA DIM_X 0x3833C4 EXTERN WORD IF_DATA MCMESS 0x3833C4 EXTERN /end MEASUREMENT
/begin MEASUREMENT flp41_02 "Lernfilterwert, positiv" SWORD dtsegn_b720divZyl 1 100 -120 119.996 FUNCTION_LIST DMDFON IF_DATA DIM_X 0x383286 EXTERN WORD IF_DATA MCMESS 0x383286 EXTERN /end MEASUREMENT
/begin MEASUREMENT flp41_03 "Lernfilterwert, positiv" SWORD dtsegn_b720divZyl 1 100 -120 119.996 FUNCTION_LIST DMDFON IF_DATA DIM_X 0x3832B6 EXTERN WORD IF_DATA MCMESS 0x3832B6 EXTERN /end MEASUREMENT
/begin MEASUREMENT flp41_04 "Lernfilterwert, positiv" SWORD dtsegn_b720divZyl 1 100 -120 119.996 FUNCTION_LIST DMDFON IF_DATA DIM_X 0x3832E6 EXTERN WORD IF_DATA MCMESS 0x3832E6 EXTERN /end MEASUREMENT
/begin MEASUREMENT flp41_05 "Lernfilterwert, positiv" SWORD dtsegn_b720divZyl 1 100 -120 119.996 FUNCTION_LIST DMDFON IF_DATA DIM_X 0x383316 EXTERN WORD IF_DATA MCMESS 0x383316 EXTERN /end MEASUREMENT
/begin MEASUREMENT flp41_06 "Lernfilterwert, positiv" SWORD dtsegn_b720divZyl 1 100 -120 119.996 FUNCTION_LIST DMDFON IF_DATA DIM_X 0x383346 EXTERN WORD IF_DATA MCMESS 0x383346 EXTERN /end MEASUREMENT
/begin MEASUREMENT flp41_07 "Lernfilterwert, positiv" SWORD dtsegn_b720divZyl 1 100 -120 119.996 FUNCTION_LIST DMDFON IF_DATA DIM_X 0x383376 EXTERN WORD IF_DATA MCMESS 0x383376 EXTERN /end MEASUREMENT
/begin MEASUREMENT flp41_08 "Lernfilterwert, positiv" SWORD dtsegn_b720divZyl 1 100 -120 119.996 FUNCTION_LIST DMDFON IF_DATA DIM_X 0x3833A6 EXTERN WORD IF_DATA MCMESS 0x3833A6 EXTERN /end MEASUREMENT
/begin MEASUREMENT flp42_02 "Lernfilterwert, positiv" SWORD dtsegn_b720divZyl 1 100 -120 119.996 FUNCTION_LIST DMDFON IF_DATA DIM_X 0x383296 EXTERN WORD IF_DATA MCMESS 0x383296 EXTERN /end MEASUREMENT
/begin MEASUREMENT flp42_03 "Lernfilterwert, positiv" SWORD dtsegn_b720divZyl 1 100 -120 119.996 FUNCTION_LIST DMDFON IF_DATA DIM_X 0x3832C6 EXTERN WORD IF_DATA MCMESS 0x3832C6 EXTERN /end MEASUREMENT
/begin MEASUREMENT flp42_04 "Lernfilterwert, positiv" SWORD dtsegn_b720divZyl 1 100 -120 119.996 FUNCTION_LIST DMDFON IF_DATA DIM_X 0x3832F6 EXTERN WORD IF_DATA MCMESS 0x3832F6 EXTERN /end MEASUREMENT
/begin MEASUREMENT flp42_05 "Lernfilterwert, positiv" SWORD dtsegn_b720divZyl 1 100 -120 119.996 FUNCTION_LIST DMDFON IF_DATA DIM_X 0x383326 EXTERN WORD IF_DATA MCMESS 0x383326 EXTERN /end MEASUREMENT
/begin MEASUREMENT flp42_06 "Lernfilterwert, positiv" SWORD dtsegn_b720divZyl 1 100 -120 119.996 FUNCTION_LIST DMDFON IF_DATA DIM_X 0x383356 EXTERN WORD IF_DATA MCMESS 0x383356 EXTERN /end MEASUREMENT
/begin MEASUREMENT flp42_07 "Lernfilterwert, positiv" SWORD dtsegn_b720divZyl 1 100 -120 119.996 FUNCTION_LIST DMDFON IF_DATA DIM_X 0x383386 EXTERN WORD IF_DATA MCMESS 0x383386 EXTERN /end MEASUREMENT
/begin MEASUREMENT flp42_08 "Lernfilterwert, positiv" SWORD dtsegn_b720divZyl 1 100 -120 119.996 FUNCTION_LIST DMDFON IF_DATA DIM_X 0x3833B6 EXTERN WORD IF_DATA MCMESS 0x3833B6 EXTERN /end MEASUREMENT
/begin MEASUREMENT flp43_02 "Lernfilterwert, positiv" SWORD dtsegn_b720divZyl 1 100 -120 119.996 FUNCTION_LIST DMDFON IF_DATA DIM_X 0x3832A6 EXTERN WORD IF_DATA MCMESS 0x3832A6 EXTERN /end MEASUREMENT
/begin MEASUREMENT flp43_03 "Lernfilterwert, positiv" SWORD dtsegn_b720divZyl 1 100 -120 119.996 FUNCTION_LIST DMDFON IF_DATA DIM_X 0x3832D6 EXTERN WORD IF_DATA MCMESS 0x3832D6 EXTERN /end MEASUREMENT
/begin MEASUREMENT flp43_04 "Lernfilterwert, positiv" SWORD dtsegn_b720divZyl 1 100 -120 119.996 FUNCTION_LIST DMDFON IF_DATA DIM_X 0x383306 EXTERN WORD IF_DATA MCMESS 0x383306 EXTERN /end MEASUREMENT
/begin MEASUREMENT flp43_05 "Lernfilterwert, positiv" SWORD dtsegn_b720divZyl 1 100 -120 119.996 FUNCTION_LIST DMDFON IF_DATA DIM_X 0x383336 EXTERN WORD IF_DATA MCMESS 0x383336 EXTERN /end MEASUREMENT
/begin MEASUREMENT flp43_06 "Lernfilterwert, positiv" SWORD dtsegn_b720divZyl 1 100 -120 119.996 FUNCTION_LIST DMDFON IF_DATA DIM_X 0x383366 EXTERN WORD IF_DATA MCMESS 0x383366 EXTERN /end MEASUREMENT
/begin MEASUREMENT flp43_07 "Lernfilterwert, positiv" SWORD dtsegn_b720divZyl 1 100 -120 119.996 FUNCTION_LIST DMDFON IF_DATA DIM_X 0x383396 EXTERN WORD IF_DATA MCMESS 0x383396 EXTERN /end MEASUREMENT
/begin MEASUREMENT flp43_08 "Lernfilterwert, positiv" SWORD dtsegn_b720divZyl 1 100 -120 119.996 FUNCTION_LIST DMDFON IF_DATA DIM_X 0x3833C6 EXTERN WORD IF_DATA MCMESS 0x3833C6 EXTERN /end MEASUREMENT
/begin MEASUREMENT flp51_02 "Lernfilterwert, positiv" SWORD dtsegn_b720divZyl 1 100 -120 119.996 FUNCTION_LIST DMDFON IF_DATA DIM_X 0x383288 EXTERN WORD IF_DATA MCMESS 0x383288 EXTERN /end MEASUREMENT
/begin MEASUREMENT flp51_03 "Lernfilterwert, positiv" SWORD dtsegn_b720divZyl 1 100 -120 119.996 FUNCTION_LIST DMDFON IF_DATA DIM_X 0x3832B8 EXTERN WORD IF_DATA MCMESS 0x3832B8 EXTERN /end MEASUREMENT
/begin MEASUREMENT flp51_04 "Lernfilterwert, positiv" SWORD dtsegn_b720divZyl 1 100 -120 119.996 FUNCTION_LIST DMDFON IF_DATA DIM_X 0x3832E8 EXTERN WORD IF_DATA MCMESS 0x3832E8 EXTERN /end MEASUREMENT
/begin MEASUREMENT flp51_05 "Lernfilterwert, positiv" SWORD dtsegn_b720divZyl 1 100 -120 119.996 FUNCTION_LIST DMDFON IF_DATA DIM_X 0x383318 EXTERN WORD IF_DATA MCMESS 0x383318 EXTERN /end MEASUREMENT
/begin MEASUREMENT flp51_06 "Lernfilterwert, positiv" SWORD dtsegn_b720divZyl 1 100 -120 119.996 FUNCTION_LIST DMDFON IF_DATA DIM_X 0x383348 EXTERN WORD IF_DATA MCMESS 0x383348 EXTERN /end MEASUREMENT
/begin MEASUREMENT flp51_07 "Lernfilterwert, positiv" SWORD dtsegn_b720divZyl 1 100 -120 119.996 FUNCTION_LIST DMDFON IF_DATA DIM_X 0x383378 EXTERN WORD IF_DATA MCMESS 0x383378 EXTERN /end MEASUREMENT
/begin MEASUREMENT flp51_08 "Lernfilterwert, positiv" SWORD dtsegn_b720divZyl 1 100 -120 119.996 FUNCTION_LIST DMDFON IF_DATA DIM_X 0x3833A8 EXTERN WORD IF_DATA MCMESS 0x3833A8 EXTERN /end MEASUREMENT
/begin MEASUREMENT flp52_02 "Lernfilterwert, positiv" SWORD dtsegn_b720divZyl 1 100 -120 119.996 FUNCTION_LIST DMDFON IF_DATA DIM_X 0x383298 EXTERN WORD IF_DATA MCMESS 0x383298 EXTERN /end MEASUREMENT
/begin MEASUREMENT flp52_03 "Lernfilterwert, positiv" SWORD dtsegn_b720divZyl 1 100 -120 119.996 FUNCTION_LIST DMDFON IF_DATA DIM_X 0x3832C8 EXTERN WORD IF_DATA MCMESS 0x3832C8 EXTERN /end MEASUREMENT
/begin MEASUREMENT flp52_04 "Lernfilterwert, positiv" SWORD dtsegn_b720divZyl 1 100 -120 119.996 FUNCTION_LIST DMDFON IF_DATA DIM_X 0x3832F8 EXTERN WORD IF_DATA MCMESS 0x3832F8 EXTERN /end MEASUREMENT
/begin MEASUREMENT flp52_05 "Lernfilterwert, positiv" SWORD dtsegn_b720divZyl 1 100 -120 119.996 FUNCTION_LIST DMDFON IF_DATA DIM_X 0x383328 EXTERN WORD IF_DATA MCMESS 0x383328 EXTERN /end MEASUREMENT
/begin MEASUREMENT flp52_06 "Lernfilterwert, positiv" SWORD dtsegn_b720divZyl 1 100 -120 119.996 FUNCTION_LIST DMDFON IF_DATA DIM_X 0x383358 EXTERN WORD IF_DATA MCMESS 0x383358 EXTERN /end MEASUREMENT
/begin MEASUREMENT flp52_07 "Lernfilterwert, positiv" SWORD dtsegn_b720divZyl 1 100 -120 119.996 FUNCTION_LIST DMDFON IF_DATA DIM_X 0x383388 EXTERN WORD IF_DATA MCMESS 0x383388 EXTERN /end MEASUREMENT
/begin MEASUREMENT flp52_08 "Lernfilterwert, positiv" SWORD dtsegn_b720divZyl 1 100 -120 119.996 FUNCTION_LIST DMDFON IF_DATA DIM_X 0x3833B8 EXTERN WORD IF_DATA MCMESS 0x3833B8 EXTERN /end MEASUREMENT
/begin MEASUREMENT flp53_02 "Lernfilterwert, positiv" SWORD dtsegn_b720divZyl 1 100 -120 119.996 FUNCTION_LIST DMDFON IF_DATA DIM_X 0x3832A8 EXTERN WORD IF_DATA MCMESS 0x3832A8 EXTERN /end MEASUREMENT
/begin MEASUREMENT flp53_03 "Lernfilterwert, positiv" SWORD dtsegn_b720divZyl 1 100 -120 119.996 FUNCTION_LIST DMDFON IF_DATA DIM_X 0x3832D8 EXTERN WORD IF_DATA MCMESS 0x3832D8 EXTERN /end MEASUREMENT
/begin MEASUREMENT flp53_04 "Lernfilterwert, positiv" SWORD dtsegn_b720divZyl 1 100 -120 119.996 FUNCTION_LIST DMDFON IF_DATA DIM_X 0x383308 EXTERN WORD IF_DATA MCMESS 0x383308 EXTERN /end MEASUREMENT
/begin MEASUREMENT flp53_05 "Lernfilterwert, positiv" SWORD dtsegn_b720divZyl 1 100 -120 119.996 FUNCTION_LIST DMDFON IF_DATA DIM_X 0x383338 EXTERN WORD IF_DATA MCMESS 0x383338 EXTERN /end MEASUREMENT
/begin MEASUREMENT flp53_06 "Lernfilterwert, positiv" SWORD dtsegn_b720divZyl 1 100 -120 119.996 FUNCTION_LIST DMDFON IF_DATA DIM_X 0x383368 EXTERN WORD IF_DATA MCMESS 0x383368 EXTERN /end MEASUREMENT
/begin MEASUREMENT flp53_07 "Lernfilterwert, positiv" SWORD dtsegn_b720divZyl 1 100 -120 119.996 FUNCTION_LIST DMDFON IF_DATA DIM_X 0x383398 EXTERN WORD IF_DATA MCMESS 0x383398 EXTERN /end MEASUREMENT
/begin MEASUREMENT flp53_08 "Lernfilterwert, positiv" SWORD dtsegn_b720divZyl 1 100 -120 119.996 FUNCTION_LIST DMDFON IF_DATA DIM_X 0x3833C8 EXTERN WORD IF_DATA MCMESS 0x3833C8 EXTERN /end MEASUREMENT
/begin MEASUREMENT flp61_02 "Lernfilterwert, positiv" SWORD dtsegn_b720divZyl 1 100 -120 119.996 FUNCTION_LIST DMDFON IF_DATA DIM_X 0x38328A EXTERN WORD IF_DATA MCMESS 0x38328A EXTERN /end MEASUREMENT
/begin MEASUREMENT flp61_03 "Lernfilterwert, positiv" SWORD dtsegn_b720divZyl 1 100 -120 119.996 FUNCTION_LIST DMDFON IF_DATA DIM_X 0x3832BA EXTERN WORD IF_DATA MCMESS 0x3832BA EXTERN /end MEASUREMENT
/begin MEASUREMENT flp61_04 "Lernfilterwert, positiv" SWORD dtsegn_b720divZyl 1 100 -120 119.996 FUNCTION_LIST DMDFON IF_DATA DIM_X 0x3832EA EXTERN WORD IF_DATA MCMESS 0x3832EA EXTERN /end MEASUREMENT
/begin MEASUREMENT flp61_05 "Lernfilterwert, positiv" SWORD dtsegn_b720divZyl 1 100 -120 119.996 FUNCTION_LIST DMDFON IF_DATA DIM_X 0x38331A EXTERN WORD IF_DATA MCMESS 0x38331A EXTERN /end MEASUREMENT
/begin MEASUREMENT flp61_06 "Lernfilterwert, positiv" SWORD dtsegn_b720divZyl 1 100 -120 119.996 FUNCTION_LIST DMDFON IF_DATA DIM_X 0x38334A EXTERN WORD IF_DATA MCMESS 0x38334A EXTERN /end MEASUREMENT
/begin MEASUREMENT flp61_07 "Lernfilterwert, positiv" SWORD dtsegn_b720divZyl 1 100 -120 119.996 FUNCTION_LIST DMDFON IF_DATA DIM_X 0x38337A EXTERN WORD IF_DATA MCMESS 0x38337A EXTERN /end MEASUREMENT
/begin MEASUREMENT flp61_08 "Lernfilterwert, positiv" SWORD dtsegn_b720divZyl 1 100 -120 119.996 FUNCTION_LIST DMDFON IF_DATA DIM_X 0x3833AA EXTERN WORD IF_DATA MCMESS 0x3833AA EXTERN /end MEASUREMENT
/begin MEASUREMENT flp62_02 "Lernfilterwert, positiv" SWORD dtsegn_b720divZyl 1 100 -120 119.996 FUNCTION_LIST DMDFON IF_DATA DIM_X 0x38329A EXTERN WORD IF_DATA MCMESS 0x38329A EXTERN /end MEASUREMENT
/begin MEASUREMENT flp62_03 "Lernfilterwert, positiv" SWORD dtsegn_b720divZyl 1 100 -120 119.996 FUNCTION_LIST DMDFON IF_DATA DIM_X 0x3832CA EXTERN WORD IF_DATA MCMESS 0x3832CA EXTERN /end MEASUREMENT
/begin MEASUREMENT flp62_04 "Lernfilterwert, positiv" SWORD dtsegn_b720divZyl 1 100 -120 119.996 FUNCTION_LIST DMDFON IF_DATA DIM_X 0x3832FA EXTERN WORD IF_DATA MCMESS 0x3832FA EXTERN /end MEASUREMENT
/begin MEASUREMENT flp62_05 "Lernfilterwert, positiv" SWORD dtsegn_b720divZyl 1 100 -120 119.996 FUNCTION_LIST DMDFON IF_DATA DIM_X 0x38332A EXTERN WORD IF_DATA MCMESS 0x38332A EXTERN /end MEASUREMENT
/begin MEASUREMENT flp62_06 "Lernfilterwert, positiv" SWORD dtsegn_b720divZyl 1 100 -120 119.996 FUNCTION_LIST DMDFON IF_DATA DIM_X 0x38335A EXTERN WORD IF_DATA MCMESS 0x38335A EXTERN /end MEASUREMENT
/begin MEASUREMENT flp62_07 "Lernfilterwert, positiv" SWORD dtsegn_b720divZyl 1 100 -120 119.996 FUNCTION_LIST DMDFON IF_DATA DIM_X 0x38338A EXTERN WORD IF_DATA MCMESS 0x38338A EXTERN /end MEASUREMENT
/begin MEASUREMENT flp62_08 "Lernfilterwert, positiv" SWORD dtsegn_b720divZyl 1 100 -120 119.996 FUNCTION_LIST DMDFON IF_DATA DIM_X 0x3833BA EXTERN WORD IF_DATA MCMESS 0x3833BA EXTERN /end MEASUREMENT
/begin MEASUREMENT flp63_02 "Lernfilterwert, positiv" SWORD dtsegn_b720divZyl 1 100 -120 119.996 FUNCTION_LIST DMDFON IF_DATA DIM_X 0x3832AA EXTERN WORD IF_DATA MCMESS 0x3832AA EXTERN /end MEASUREMENT
/begin MEASUREMENT flp63_03 "Lernfilterwert, positiv" SWORD dtsegn_b720divZyl 1 100 -120 119.996 FUNCTION_LIST DMDFON IF_DATA DIM_X 0x3832DA EXTERN WORD IF_DATA MCMESS 0x3832DA EXTERN /end MEASUREMENT
/begin MEASUREMENT flp63_04 "Lernfilterwert, positiv" SWORD dtsegn_b720divZyl 1 100 -120 119.996 FUNCTION_LIST DMDFON IF_DATA DIM_X 0x38330A EXTERN WORD IF_DATA MCMESS 0x38330A EXTERN /end MEASUREMENT
/begin MEASUREMENT flp63_05 "Lernfilterwert, positiv" SWORD dtsegn_b720divZyl 1 100 -120 119.996 FUNCTION_LIST DMDFON IF_DATA DIM_X 0x38333A EXTERN WORD IF_DATA MCMESS 0x38333A EXTERN /end MEASUREMENT
/begin MEASUREMENT flp63_06 "Lernfilterwert, positiv" SWORD dtsegn_b720divZyl 1 100 -120 119.996 FUNCTION_LIST DMDFON IF_DATA DIM_X 0x38336A EXTERN WORD IF_DATA MCMESS 0x38336A EXTERN /end MEASUREMENT
/begin MEASUREMENT flp63_07 "Lernfilterwert, positiv" SWORD dtsegn_b720divZyl 1 100 -120 119.996 FUNCTION_LIST DMDFON IF_DATA DIM_X 0x38339A EXTERN WORD IF_DATA MCMESS 0x38339A EXTERN /end MEASUREMENT
/begin MEASUREMENT flp63_08 "Lernfilterwert, positiv" SWORD dtsegn_b720divZyl 1 100 -120 119.996 FUNCTION_LIST DMDFON IF_DATA DIM_X 0x3833CA EXTERN WORD IF_DATA MCMESS 0x3833CA EXTERN /end MEASUREMENT
/begin MEASUREMENT flp71_02 "Lernfilterwert, positiv" SWORD dtsegn_b720divZyl 1 100 -120 119.996 FUNCTION_LIST DMDFON IF_DATA DIM_X 0x38328C EXTERN WORD IF_DATA MCMESS 0x38328C EXTERN /end MEASUREMENT
/begin MEASUREMENT flp71_03 "Lernfilterwert, positiv" SWORD dtsegn_b720divZyl 1 100 -120 119.996 FUNCTION_LIST DMDFON IF_DATA DIM_X 0x3832BC EXTERN WORD IF_DATA MCMESS 0x3832BC EXTERN /end MEASUREMENT
/begin MEASUREMENT flp71_04 "Lernfilterwert, positiv" SWORD dtsegn_b720divZyl 1 100 -120 119.996 FUNCTION_LIST DMDFON IF_DATA DIM_X 0x3832EC EXTERN WORD IF_DATA MCMESS 0x3832EC EXTERN /end MEASUREMENT
/begin MEASUREMENT flp71_05 "Lernfilterwert, positiv" SWORD dtsegn_b720divZyl 1 100 -120 119.996 FUNCTION_LIST DMDFON IF_DATA DIM_X 0x38331C EXTERN WORD IF_DATA MCMESS 0x38331C EXTERN /end MEASUREMENT
/begin MEASUREMENT flp71_06 "Lernfilterwert, positiv" SWORD dtsegn_b720divZyl 1 100 -120 119.996 FUNCTION_LIST DMDFON IF_DATA DIM_X 0x38334C EXTERN WORD IF_DATA MCMESS 0x38334C EXTERN /end MEASUREMENT
/begin MEASUREMENT flp71_07 "Lernfilterwert, positiv" SWORD dtsegn_b720divZyl 1 100 -120 119.996 FUNCTION_LIST DMDFON IF_DATA DIM_X 0x38337C EXTERN WORD IF_DATA MCMESS 0x38337C EXTERN /end MEASUREMENT
/begin MEASUREMENT flp71_08 "Lernfilterwert, positiv" SWORD dtsegn_b720divZyl 1 100 -120 119.996 FUNCTION_LIST DMDFON IF_DATA DIM_X 0x3833AC EXTERN WORD IF_DATA MCMESS 0x3833AC EXTERN /end MEASUREMENT
/begin MEASUREMENT flp72_02 "Lernfilterwert, positiv" SWORD dtsegn_b720divZyl 1 100 -120 119.996 FUNCTION_LIST DMDFON IF_DATA DIM_X 0x38329C EXTERN WORD IF_DATA MCMESS 0x38329C EXTERN /end MEASUREMENT
/begin MEASUREMENT flp72_03 "Lernfilterwert, positiv" SWORD dtsegn_b720divZyl 1 100 -120 119.996 FUNCTION_LIST DMDFON IF_DATA DIM_X 0x3832CC EXTERN WORD IF_DATA MCMESS 0x3832CC EXTERN /end MEASUREMENT
/begin MEASUREMENT flp72_04 "Lernfilterwert, positiv" SWORD dtsegn_b720divZyl 1 100 -120 119.996 FUNCTION_LIST DMDFON IF_DATA DIM_X 0x3832FC EXTERN WORD IF_DATA MCMESS 0x3832FC EXTERN /end MEASUREMENT
/begin MEASUREMENT flp72_05 "Lernfilterwert, positiv" SWORD dtsegn_b720divZyl 1 100 -120 119.996 FUNCTION_LIST DMDFON IF_DATA DIM_X 0x38332C EXTERN WORD IF_DATA MCMESS 0x38332C EXTERN /end MEASUREMENT
/begin MEASUREMENT flp72_06 "Lernfilterwert, positiv" SWORD dtsegn_b720divZyl 1 100 -120 119.996 FUNCTION_LIST DMDFON IF_DATA DIM_X 0x38335C EXTERN WORD IF_DATA MCMESS 0x38335C EXTERN /end MEASUREMENT
/begin MEASUREMENT flp72_07 "Lernfilterwert, positiv" SWORD dtsegn_b720divZyl 1 100 -120 119.996 FUNCTION_LIST DMDFON IF_DATA DIM_X 0x38338C EXTERN WORD IF_DATA MCMESS 0x38338C EXTERN /end MEASUREMENT
/begin MEASUREMENT flp72_08 "Lernfilterwert, positiv" SWORD dtsegn_b720divZyl 1 100 -120 119.996 FUNCTION_LIST DMDFON IF_DATA DIM_X 0x3833BC EXTERN WORD IF_DATA MCMESS 0x3833BC EXTERN /end MEASUREMENT
/begin MEASUREMENT flp73_02 "Lernfilterwert, positiv" SWORD dtsegn_b720divZyl 1 100 -120 119.996 FUNCTION_LIST DMDFON IF_DATA DIM_X 0x3832AC EXTERN WORD IF_DATA MCMESS 0x3832AC EXTERN /end MEASUREMENT
/begin MEASUREMENT flp73_03 "Lernfilterwert, positiv" SWORD dtsegn_b720divZyl 1 100 -120 119.996 FUNCTION_LIST DMDFON IF_DATA DIM_X 0x3832DC EXTERN WORD IF_DATA MCMESS 0x3832DC EXTERN /end MEASUREMENT
/begin MEASUREMENT flp73_04 "Lernfilterwert, positiv" SWORD dtsegn_b720divZyl 1 100 -120 119.996 FUNCTION_LIST DMDFON IF_DATA DIM_X 0x38330C EXTERN WORD IF_DATA MCMESS 0x38330C EXTERN /end MEASUREMENT
/begin MEASUREMENT flp73_05 "Lernfilterwert, positiv" SWORD dtsegn_b720divZyl 1 100 -120 119.996 FUNCTION_LIST DMDFON IF_DATA DIM_X 0x38333C EXTERN WORD IF_DATA MCMESS 0x38333C EXTERN /end MEASUREMENT
/begin MEASUREMENT flp73_06 "Lernfilterwert, positiv" SWORD dtsegn_b720divZyl 1 100 -120 119.996 FUNCTION_LIST DMDFON IF_DATA DIM_X 0x38336C EXTERN WORD IF_DATA MCMESS 0x38336C EXTERN /end MEASUREMENT
/begin MEASUREMENT flp73_07 "Lernfilterwert, positiv" SWORD dtsegn_b720divZyl 1 100 -120 119.996 FUNCTION_LIST DMDFON IF_DATA DIM_X 0x38339C EXTERN WORD IF_DATA MCMESS 0x38339C EXTERN /end MEASUREMENT
/begin MEASUREMENT flp73_08 "Lernfilterwert, positiv" SWORD dtsegn_b720divZyl 1 100 -120 119.996 FUNCTION_LIST DMDFON IF_DATA DIM_X 0x3833CC EXTERN WORD IF_DATA MCMESS 0x3833CC EXTERN /end MEASUREMENT
/begin MEASUREMENT flp81_02 "Lernfilterwert, positiv" SWORD dtsegn_b720divZyl 1 100 -120 119.996 FUNCTION_LIST DMDFON IF_DATA DIM_X 0x38328E EXTERN WORD IF_DATA MCMESS 0x38328E EXTERN /end MEASUREMENT
/begin MEASUREMENT flp81_03 "Lernfilterwert, positiv" SWORD dtsegn_b720divZyl 1 100 -120 119.996 FUNCTION_LIST DMDFON IF_DATA DIM_X 0x3832BE EXTERN WORD IF_DATA MCMESS 0x3832BE EXTERN /end MEASUREMENT
/begin MEASUREMENT flp81_04 "Lernfilterwert, positiv" SWORD dtsegn_b720divZyl 1 100 -120 119.996 FUNCTION_LIST DMDFON IF_DATA DIM_X 0x3832EE EXTERN WORD IF_DATA MCMESS 0x3832EE EXTERN /end MEASUREMENT
/begin MEASUREMENT flp81_05 "Lernfilterwert, positiv" SWORD dtsegn_b720divZyl 1 100 -120 119.996 FUNCTION_LIST DMDFON IF_DATA DIM_X 0x38331E EXTERN WORD IF_DATA MCMESS 0x38331E EXTERN /end MEASUREMENT
/begin MEASUREMENT flp81_06 "Lernfilterwert, positiv" SWORD dtsegn_b720divZyl 1 100 -120 119.996 FUNCTION_LIST DMDFON IF_DATA DIM_X 0x38334E EXTERN WORD IF_DATA MCMESS 0x38334E EXTERN /end MEASUREMENT
/begin MEASUREMENT flp81_07 "Lernfilterwert, positiv" SWORD dtsegn_b720divZyl 1 100 -120 119.996 FUNCTION_LIST DMDFON IF_DATA DIM_X 0x38337E EXTERN WORD IF_DATA MCMESS 0x38337E EXTERN /end MEASUREMENT
/begin MEASUREMENT flp81_08 "Lernfilterwert, positiv" SWORD dtsegn_b720divZyl 1 100 -120 119.996 FUNCTION_LIST DMDFON IF_DATA DIM_X 0x3833AE EXTERN WORD IF_DATA MCMESS 0x3833AE EXTERN /end MEASUREMENT
/begin MEASUREMENT flp82_02 "Lernfilterwert, positiv" SWORD dtsegn_b720divZyl 1 100 -120 119.996 FUNCTION_LIST DMDFON IF_DATA DIM_X 0x38329E EXTERN WORD IF_DATA MCMESS 0x38329E EXTERN /end MEASUREMENT
/begin MEASUREMENT flp82_03 "Lernfilterwert, positiv" SWORD dtsegn_b720divZyl 1 100 -120 119.996 FUNCTION_LIST DMDFON IF_DATA DIM_X 0x3832CE EXTERN WORD IF_DATA MCMESS 0x3832CE EXTERN /end MEASUREMENT
/begin MEASUREMENT flp82_04 "Lernfilterwert, positiv" SWORD dtsegn_b720divZyl 1 100 -120 119.996 FUNCTION_LIST DMDFON IF_DATA DIM_X 0x3832FE EXTERN WORD IF_DATA MCMESS 0x3832FE EXTERN /end MEASUREMENT
/begin MEASUREMENT flp82_05 "Lernfilterwert, positiv" SWORD dtsegn_b720divZyl 1 100 -120 119.996 FUNCTION_LIST DMDFON IF_DATA DIM_X 0x38332E EXTERN WORD IF_DATA MCMESS 0x38332E EXTERN /end MEASUREMENT
/begin MEASUREMENT flp82_06 "Lernfilterwert, positiv" SWORD dtsegn_b720divZyl 1 100 -120 119.996 FUNCTION_LIST DMDFON IF_DATA DIM_X 0x38335E EXTERN WORD IF_DATA MCMESS 0x38335E EXTERN /end MEASUREMENT
/begin MEASUREMENT flp82_07 "Lernfilterwert, positiv" SWORD dtsegn_b720divZyl 1 100 -120 119.996 FUNCTION_LIST DMDFON IF_DATA DIM_X 0x38338E EXTERN WORD IF_DATA MCMESS 0x38338E EXTERN /end MEASUREMENT
/begin MEASUREMENT flp82_08 "Lernfilterwert, positiv" SWORD dtsegn_b720divZyl 1 100 -120 119.996 FUNCTION_LIST DMDFON IF_DATA DIM_X 0x3833BE EXTERN WORD IF_DATA MCMESS 0x3833BE EXTERN /end MEASUREMENT
/begin MEASUREMENT flp83_02 "Lernfilterwert, positiv" SWORD dtsegn_b720divZyl 1 100 -120 119.996 FUNCTION_LIST DMDFON IF_DATA DIM_X 0x3832AE EXTERN WORD IF_DATA MCMESS 0x3832AE EXTERN /end MEASUREMENT
/begin MEASUREMENT flp83_03 "Lernfilterwert, positiv" SWORD dtsegn_b720divZyl 1 100 -120 119.996 FUNCTION_LIST DMDFON IF_DATA DIM_X 0x3832DE EXTERN WORD IF_DATA MCMESS 0x3832DE EXTERN /end MEASUREMENT
/begin MEASUREMENT flp83_04 "Lernfilterwert, positiv" SWORD dtsegn_b720divZyl 1 100 -120 119.996 FUNCTION_LIST DMDFON IF_DATA DIM_X 0x38330E EXTERN WORD IF_DATA MCMESS 0x38330E EXTERN /end MEASUREMENT
/begin MEASUREMENT flp83_05 "Lernfilterwert, positiv" SWORD dtsegn_b720divZyl 1 100 -120 119.996 FUNCTION_LIST DMDFON IF_DATA DIM_X 0x38333E EXTERN WORD IF_DATA MCMESS 0x38333E EXTERN /end MEASUREMENT
/begin MEASUREMENT flp83_06 "Lernfilterwert, positiv" SWORD dtsegn_b720divZyl 1 100 -120 119.996 FUNCTION_LIST DMDFON IF_DATA DIM_X 0x38336E EXTERN WORD IF_DATA MCMESS 0x38336E EXTERN /end MEASUREMENT
/begin MEASUREMENT flp83_07 "Lernfilterwert, positiv" SWORD dtsegn_b720divZyl 1 100 -120 119.996 FUNCTION_LIST DMDFON IF_DATA DIM_X 0x38339E EXTERN WORD IF_DATA MCMESS 0x38339E EXTERN /end MEASUREMENT
/begin MEASUREMENT flp83_08 "Lernfilterwert, positiv" SWORD dtsegn_b720divZyl 1 100 -120 119.996 FUNCTION_LIST DMDFON IF_DATA DIM_X 0x3833CE EXTERN WORD IF_DATA MCMESS 0x3833CE EXTERN /end MEASUREMENT
/begin MEASUREMENT flrar "Verstärkungsfaktor zum Nachbilden der externen Last" UBYTE fak_ub_b16 1 100 0 15.9375 FUNCTION_LIST ARMD IF_DATA DIM_X 0x380C29 EXTERN WORD IF_DATA MCMESS 0x380C29 EXTERN /end MEASUREMENT
/begin MEASUREMENT flurkh "Faktor zur Absenkung des LUR-Wertes bei Katheizen, aus KL LURKH" UBYTE fak_ub_b2 1 100 0 1.99219 FUNCTION_LIST DMDLU IF_DATA DIM_X 0x380970 EXTERN WORD IF_DATA MCMESS 0x380970 EXTERN /end MEASUREMENT
/begin MEASUREMENT fluts "Filter der Laufunruhe-Testgröße" SWORD luquant_w 1 100 -232.831 232.824 FUNCTION_LIST DMDLUA IF_DATA DIM_X 0x38161E EXTERN WORD IF_DATA MCMESS 0x38161E EXTERN /end MEASUREMENT
/begin MEASUREMENT fluts1 "Filter der Laufunruhe-Testgröße von Zylinder 1 bzw. Zündung 1, signed" SWORD luquant_w 1 100 -232.831 232.824 FUNCTION_LIST DMDLUA IF_DATA DIM_X 0x381620 EXTERN WORD IF_DATA MCMESS 0x381620 EXTERN /end MEASUREMENT
/begin MEASUREMENT fluts2 "Filter der Laufunruhe-Testgröße von Zylinder 2 bzw. Zündung 2, signed" SWORD luquant_w 1 100 -232.831 232.824 FUNCTION_LIST DMDLUA IF_DATA DIM_X 0x381622 EXTERN WORD IF_DATA MCMESS 0x381622 EXTERN /end MEASUREMENT
/begin MEASUREMENT fluts3 "Filter der Laufunruhe-Testgröße von Zylinder 3 bzw. Zündung 3, signed" SWORD luquant_w 1 100 -232.831 232.824 FUNCTION_LIST DMDLUA IF_DATA DIM_X 0x381624 EXTERN WORD IF_DATA MCMESS 0x381624 EXTERN /end MEASUREMENT
/begin MEASUREMENT fluts4 "Filter der Laufunruhe-Testgröße von Zylinder 4 bzw. Zündung 4, signed" SWORD luquant_w 1 100 -232.831 232.824 FUNCTION_LIST DMDLUA IF_DATA DIM_X 0x381626 EXTERN WORD IF_DATA MCMESS 0x381626 EXTERN /end MEASUREMENT
/begin MEASUREMENT fluts5 "Filter der Laufunruhe-Testgröße von Zylinder 5 bzw. Zündung 5, signed" SWORD luquant_w 1 100 -232.831 232.824 FUNCTION_LIST DMDLUA IF_DATA DIM_X 0x381628 EXTERN WORD IF_DATA MCMESS 0x381628 EXTERN /end MEASUREMENT
/begin MEASUREMENT fluts6 "Filter der Laufunruhe-Testgröße von Zylinder 6 bzw. Zündung 6, signed" SWORD luquant_w 1 100 -232.831 232.824 FUNCTION_LIST DMDLUA IF_DATA DIM_X 0x38162A EXTERN WORD IF_DATA MCMESS 0x38162A EXTERN /end MEASUREMENT
/begin MEASUREMENT fluts7 "Filter der Laufunruhe-Testgröße von Zylinder 7 bzw. Zündung 7, signed" SWORD luquant_w 1 100 -232.831 232.824 FUNCTION_LIST DMDLUA IF_DATA DIM_X 0x38162C EXTERN WORD IF_DATA MCMESS 0x38162C EXTERN /end MEASUREMENT
/begin MEASUREMENT fluts8 "Filter der Laufunruhe-Testgröße von Zylinder 8 bzw. Zündung 8, signed" SWORD luquant_w 1 100 -232.831 232.824 FUNCTION_LIST DMDLUA IF_DATA DIM_X 0x38162E EXTERN WORD IF_DATA MCMESS 0x38162E EXTERN /end MEASUREMENT
/begin MEASUREMENT fluts_m "Monitor, gefilterte Laufunruhetestgröße, signed, verzögerte Ausgabe" SWORD luquant_w 1 100 -232.831 232.824 FUNCTION_LIST DMDLUA IF_DATA DIM_X 0xE45E INTERN WORD IF_DATA MCMESS 0xE45E INTERN /end MEASUREMENT
/begin MEASUREMENT fmdkh "Faktor Steuerung Drehmomentreserve für Katheizen" UBYTE fak_ub_b1 1 100 0 0.996094 FUNCTION_LIST BBKHZ KHMD ZWMIN IF_DATA DIM_X 0x380B6F EXTERN WORD IF_DATA MCMESS 0x380B6F EXTERN /end MEASUREMENT
/begin MEASUREMENT fmkhfho_w "Höhenkorrektur der Drehmomentenreserve bei Katheizen" UWORD fak_uw_b2 1 100 0 1.99997 FUNCTION_LIST KHMD IF_DATA DIM_X 0x382406 EXTERN WORD IF_DATA MCMESS 0x382406 EXTERN /end MEASUREMENT
/begin MEASUREMENT fmkhtmst "tmst-Korrektur der Drehmomentreserve bei Katheizen" UBYTE fak_ub_b2 1 100 0 1.99219 FUNCTION_LIST KHMD IF_DATA DIM_X 0x380B75 EXTERN WORD IF_DATA MCMESS 0x380B75 EXTERN /end MEASUREMENT
/begin MEASUREMENT fmlkfho_w "Korrekturfaktor f. Schwellwertbildung zum Fehlereintrag LM." UWORD fak_uw_b1 1 100 0 0.999985 FUNCTION_LIST DHFM IF_DATA DIM_X 0x382070 EXTERN WORD IF_DATA MCMESS 0x382070 EXTERN /end MEASUREMENT
/begin MEASUREMENT fmsagd "Korrekturfaktor Abgasgegendruck der Sekundärluftmasse" UBYTE fak_ub_b2 1 100 0 1.99219 FUNCTION_LIST SLS IF_DATA DIM_X 0x380916 EXTERN WORD IF_DATA MCMESS 0x380916 EXTERN /end MEASUREMENT
/begin MEASUREMENT fmsla "Korrekturfaktor Sekundärluftmasse adaptiv" UBYTE fak_ub_b2 1 100 0 1.99219 FUNCTION_LIST DSLSLRS SLS IF_DATA DIM_X 0x380909 EXTERN WORD IF_DATA MCMESS 0x380909 EXTERN /end MEASUREMENT
/begin MEASUREMENT fmsla2 "Korrekturfaktor Sekundärluftmasse adaptiv Bank 2" UBYTE fak_ub_b2 1 100 0 1.99219 FUNCTION_LIST DSLSLRS SLS IF_DATA DIM_X 0x38090A EXTERN WORD IF_DATA MCMESS 0x38090A EXTERN /end MEASUREMENT
/begin MEASUREMENT fmslav "Adaptionsfaktor Sekundärluftmasse" UBYTE fak_ub_b2 1 100 0 1.99219 FUNCTION_LIST DSLSLRS IF_DATA DIM_X 0x382F08 EXTERN WORD IF_DATA MCMESS 0x382F08 EXTERN /end MEASUREMENT
/begin MEASUREMENT fmslav2 "Adaptionsfaktor Sekundärluftmasse, Bank 2" UBYTE fak_ub_b2 1 100 0 1.99219 FUNCTION_LIST DSLSLRS IF_DATA DIM_X 0x382F09 EXTERN WORD IF_DATA MCMESS 0x382F09 EXTERN /end MEASUREMENT
/begin MEASUREMENT fmsldyn "Faktor Dynamikbeschreibung Sekundärluft" UBYTE fak_ub_b1 1 100 0 0.996094 FUNCTION_LIST SLS LAKH IF_DATA DIM_X 0x380917 EXTERN WORD IF_DATA MCMESS 0x380917 EXTERN /end MEASUREMENT
/begin MEASUREMENT fmslrho "Dichtekorrektur der Sekundärluftmasse" UBYTE fak_ub_b2 1 100 0 1.99219 FUNCTION_LIST SLS IF_DATA DIM_X 0x380918 EXTERN WORD IF_DATA MCMESS 0x380918 EXTERN /end MEASUREMENT
/begin MEASUREMENT fmsltm "tmot- Korrektur der Sekundärluftmasse" UBYTE fak_ub_b2 1 100 0 1.99219 FUNCTION_LIST SLS IF_DATA DIM_X 0x380919 EXTERN WORD IF_DATA MCMESS 0x380919 EXTERN /end MEASUREMENT
/begin MEASUREMENT fmvp_w "Faktor für Mittelwertbildung Solldruckverhältnis DK" UWORD fak_uw_b2 1 100 0 1.99997 FUNCTION_LIST LDRPLS IF_DATA DIM_X 0x3824EE EXTERN WORD IF_DATA MCMESS 0x3824EE EXTERN /end MEASUREMENT
/begin MEASUREMENT fngwrte "Faktor Regelung Spülrate nach Grenzwertregeleingriff" SBYTE fak_sb_b16 1 100 -16 15.875 FUNCTION_LIST TEB IF_DATA DIM_X 0x380CC2 EXTERN WORD IF_DATA MCMESS 0x380CC2 EXTERN /end MEASUREMENT
/begin MEASUREMENT fns "Faktor Nachstart" UBYTE fak_ub_b4 1 100 0 3.98438 FUNCTION_LIST ESNST GK IF_DATA DIM_X 0x380B1F EXTERN WORD IF_DATA MCMESS 0x380B1F EXTERN /end MEASUREMENT
/begin MEASUREMENT fnstab_w "Faktor zur Stabilisierung mittels Drehzahlquotient" UWORD fak_uw_b8 1 100 0 7.99988 FUNCTION_LIST MDNSTAB MDMIN IF_DATA DIM_X 0x38256E EXTERN WORD IF_DATA MCMESS 0x38256E EXTERN /end MEASUREMENT
/begin MEASUREMENT fnvs "Gewichtungsfaktor Ventilhubsteuerung" UBYTE fak_ub_b1 1 100 0 0.996094 FUNCTION_LIST VS MDBAS ZWGRU IF_DATA DIM_X 0x380D02 EXTERN WORD IF_DATA MCMESS 0x380D02 EXTERN /end MEASUREMENT
/begin MEASUREMENT fnwhfm "HFM-Korrekturfaktor bei NWS" UBYTE fak_ub_b2 1 100 0 1.99219 FUNCTION_LIST GGHFM IF_DATA DIM_X 0x380AF5 EXTERN WORD IF_DATA MCMESS 0x380AF5 EXTERN /end MEASUREMENT
/begin MEASUREMENT fnwue "Gewichtungsfaktor Nockenwellenüberschneidung (Einlaß)" UBYTE fak_ub_b1 1 100 0 0.996094 FUNCTION_LIST NWS BGSRM BGTMPK MDBAS ZWGRU IF_DATA DIM_X 0x380B02 EXTERN WORD IF_DATA MCMESS 0x380B02 EXTERN /end MEASUREMENT
/begin MEASUREMENT fostat "Status der fuel-on/-off Adaption im aktuellen Betriebsbereich" UBYTE dez 1 100 0 255 FUNCTION_LIST DMDFON IF_DATA DIM_X 0x380988 EXTERN WORD IF_DATA MCMESS 0x380988 EXTERN /end MEASUREMENT
/begin MEASUREMENT fostat_m "Monitor, Status der Adpation im akt. Bereich, verzögerte Ausgabe" UBYTE dez 1 100 0 255 FUNCTION_LIST DMDFON IF_DATA DIM_X 0xE3F1 INTERN WORD IF_DATA MCMESS 0xE3F1 INTERN /end MEASUREMENT
/begin MEASUREMENT fpbrkds_w "Faktor zur Bestimmung des Brennraumdrucks" UWORD fak_uw_b2 1 100 0 1.99997 FUNCTION_LIST BGSRM BGRLP FUEDK IF_DATA DIM_X 0x3820CA EXTERN WORD IF_DATA MCMESS 0x3820CA EXTERN /end MEASUREMENT
/begin MEASUREMENT fprstep_c "Schrittzähler DK-Rückstellfeder-Prüfung" UBYTE dez 1 100 0 255 FUNCTION_LIST BGDVE DDVE T2DVE IF_DATA DIM_X 0x380AA7 EXTERN WORD IF_DATA MCMESS 0x380AA7 EXTERN /end MEASUREMENT
/begin MEASUREMENT fprtim_c "Zeitzähler DK-Rückstellfeder-Prüfung" UBYTE t10msxs_ub_b2p55 1 100 0 2.55 FUNCTION_LIST BGDVE IF_DATA DIM_X 0x380AA8 EXTERN WORD IF_DATA MCMESS 0x380AA8 EXTERN /end MEASUREMENT
/begin MEASUREMENT fpvdk "Korrekturfaktor Druck vor Drosselklappe" UBYTE fak_ub_b4 1 100 0 3.98438 FUNCTION_LIST BGMSZS IF_DATA DIM_X 0x380AEB EXTERN WORD IF_DATA MCMESS 0x380AEB EXTERN /end MEASUREMENT
/begin MEASUREMENT fpvdkds "Faktor Druck vor Drosselklappe von Drucksensor" UBYTE fak_ub_b4 1 100 0 3.98438 FUNCTION_LIST GGDSAS GGDVE IF_DATA DIM_X 0x380AF2 EXTERN WORD IF_DATA MCMESS 0x380AF2 EXTERN /end MEASUREMENT
/begin MEASUREMENT fpvdkdsl_w "Faktor Druck vor Drosselklappe von Ladedrucksensor (word)" UWORD fak_uw_b4 1 100 0 3.99994 FUNCTION_LIST GGDSAS IF_DATA DIM_X 0x38209C EXTERN WORD IF_DATA MCMESS 0x38209C EXTERN /end MEASUREMENT
/begin MEASUREMENT fpvdkdsu_w "Faktor Druck vor Drosselklappe von Umgebungsdrucksensor (word)" UWORD fak_uw_b4 1 100 0 3.99994 FUNCTION_LIST GGDSAS IF_DATA DIM_X 0x382092 EXTERN WORD IF_DATA MCMESS 0x382092 EXTERN /end MEASUREMENT
/begin MEASUREMENT fpvdkds_w "Faktor Druck vor Drosselklappe von Drucksensor (word)" UWORD fak_uw_b4 1 100 0 3.99994 FUNCTION_LIST GGDSAS BGMSZS IF_DATA DIM_X 0x38209E EXTERN WORD IF_DATA MCMESS 0x38209E EXTERN /end MEASUREMENT
/begin MEASUREMENT fpvdk_w "Korrekturfaktor Druck vor Drosselklappe 16-Bit" UWORD fak_uw_b4 1 100 0 3.99994 FUNCTION_LIST BGMSZS IF_DATA DIM_X 0x381FF8 EXTERN WORD IF_DATA MCMESS 0x381FF8 EXTERN /end MEASUREMENT
/begin MEASUREMENT fr2_u "Lambda-Regler-Ausgang; Bank2 (Byte)" UBYTE fak_ub_b2 1 100 0 1.99219 FUNCTION_LIST DFFTCNV DFFT IF_DATA DIM_X 0x3809E9 EXTERN WORD IF_DATA MCMESS 0x3809E9 EXTERN /end MEASUREMENT
/begin MEASUREMENT fr2_w "Lambda-Regler-Ausgang; Bank2 (Word)" UWORD fak_uw_b2 1 100 0 1.99997 FUNCTION_LIST LRS DFFTCNV GK T2LID TC1MOD IF_DATA DIM_X 0x38297E EXTERN WORD IF_DATA MCMESS 0x38297E EXTERN /end MEASUREMENT
/begin MEASUREMENT fra2_u "multiplikative Gemischkorrektur der Gemischadaption (Byte)" UBYTE fak_ub_b2 1 100 0 1.99219 FUNCTION_LIST DFFTCNV DFFT IF_DATA DIM_X 0x3809EA EXTERN WORD IF_DATA MCMESS 0x3809EA EXTERN /end MEASUREMENT
/begin MEASUREMENT fra2_w "multiplikative Gemischkorrektur der Gemischadaption (Word)" UWORD fak_uw_b2 1 100 0 1.99997 FUNCTION_LIST LRA DFFTCNV GK T2LID TC1MOD IF_DATA DIM_X 0x38234E EXTERN WORD IF_DATA MCMESS 0x38234E EXTERN /end MEASUREMENT
/begin MEASUREMENT frao2_u "multiplikativer Gemischadaptionsfaktor oberer Lastbereich (Byte) Bank2" UBYTE fak_ub_b2 1 100 0 1.99219 FUNCTION_LIST DFFTCNV DFFTK IF_DATA DIM_X 0x3809DC EXTERN WORD IF_DATA MCMESS 0x3809DC EXTERN /end MEASUREMENT
/begin MEASUREMENT frao2_w "multipl. Gemischadaptionsfaktor oberer Lastbereich Bank 2 (Word)" UWORD fak_uw_b2 1 100 0 1.99997 FUNCTION_LIST LRA DFFTCNV DKVS T2LID IF_DATA DIM_X 0x3839C6 EXTERN WORD IF_DATA MCMESS 0x3839C6 EXTERN /end MEASUREMENT
/begin MEASUREMENT frao_u "multiplikativer Gemischadaptionsfaktor oberer Lastbereich (Byte)" UBYTE fak_ub_b2 1 100 0 1.99219 FUNCTION_LIST DFFTCNV DFFTK IF_DATA DIM_X 0x3809DD EXTERN WORD IF_DATA MCMESS 0x3809DD EXTERN /end MEASUREMENT
/begin MEASUREMENT frao_w "multiplikativer Gemischadaptionsfaktor oberer Lastbereich (Word)" UWORD fak_uw_b2 1 100 0 1.99997 FUNCTION_LIST LRA DFFTCNV DKVS T2LID IF_DATA DIM_X 0x3839C8 EXTERN WORD IF_DATA MCMESS 0x3839C8 EXTERN /end MEASUREMENT
/begin MEASUREMENT frau2_u "multipl. Gemischadaptionsfaktor unterer mult. Bereich der Bank 2 (Byte)" UBYTE fak_ub_b2 1 100 0 1.99219 FUNCTION_LIST DFFTCNV DFFTK IF_DATA DIM_X 0x3809DE EXTERN WORD IF_DATA MCMESS 0x3809DE EXTERN /end MEASUREMENT
/begin MEASUREMENT frau2_w "multipl. Gemischadaptionsfaktor unterer mult. Bereich der Bank 2 (Word)" UWORD fak_uw_b2 1 100 0 1.99997 FUNCTION_LIST LRA DFFTCNV DKVS T2LID IF_DATA DIM_X 0x3839CA EXTERN WORD IF_DATA MCMESS 0x3839CA EXTERN /end MEASUREMENT
/begin MEASUREMENT frauzs2_w "multipl. Gemischadaptionsfaktor unterer mult. Bereich (Stereo)" UWORD fak_uw_b2 1 100 0 1.99997 FUNCTION_LIST DKVS IF_DATA DIM_X 0x382232 EXTERN WORD IF_DATA MCMESS 0x382232 EXTERN /end MEASUREMENT
/begin MEASUREMENT frauzs_w "multiplikativer Gemischadaptionsfaktor unterer mult. Bereich (alter Wert)" UWORD fak_uw_b2 1 100 0 1.99997 FUNCTION_LIST DKVS IF_DATA DIM_X 0x382234 EXTERN WORD IF_DATA MCMESS 0x382234 EXTERN /end MEASUREMENT
/begin MEASUREMENT frau_u "multiplikativer Gemischadaptionsfaktor unterer mult. Bereich (Byte)" UBYTE fak_ub_b2 1 100 0 1.99219 FUNCTION_LIST DFFTCNV DFFTK IF_DATA DIM_X 0x3809DF EXTERN WORD IF_DATA MCMESS 0x3809DF EXTERN /end MEASUREMENT
/begin MEASUREMENT frau_w "multiplikativer Gemischadaptionsfaktor unterer mult. Bereich (Word)" UWORD fak_uw_b2 1 100 0 1.99997 FUNCTION_LIST LRA DFFTCNV DKVS T2LID IF_DATA DIM_X 0x3839CC EXTERN WORD IF_DATA MCMESS 0x3839CC EXTERN /end MEASUREMENT
/begin MEASUREMENT fra_u "multiplikative Gemischkorrektur der Gemischadaption (Byte)" UBYTE fak_ub_b2 1 100 0 1.99219 FUNCTION_LIST DFFTCNV DFFT IF_DATA DIM_X 0x3809EB EXTERN WORD IF_DATA MCMESS 0x3809EB EXTERN /end MEASUREMENT
/begin MEASUREMENT fra_w "multiplikative Gemischkorrektur der Gemischadaption (Word)" UWORD fak_uw_b2 1 100 0 1.99997 FUNCTION_LIST LRA DFFTCNV GK T2LID TC1MOD IF_DATA DIM_X 0x382350 EXTERN WORD IF_DATA MCMESS 0x382350 EXTERN /end MEASUREMENT
/begin MEASUREMENT frdter_w "Faktor Regelung Referenz für TE-Diagnose" UWORD fak_uw_b2 1 100 0 1.99997 FUNCTION_LIST DTEV LRSINI IF_DATA DIM_X 0x382C38 EXTERN WORD IF_DATA MCMESS 0x382C38 EXTERN /end MEASUREMENT
/begin MEASUREMENT fregfte "Faktor Regelung Spülrate vor Grenzwertregeleingriff" SBYTE fak_sb_b16 1 100 -16 15.875 FUNCTION_LIST TEB IF_DATA DIM_X 0x380CC3 EXTERN WORD IF_DATA MCMESS 0x380CC3 EXTERN /end MEASUREMENT
/begin MEASUREMENT frhodkr_w "Faktor Luftdichtekorrektur für DK-Durchfluß korrigiert (word)" UWORD fak_uw_b2 1 100 0 1.99997 FUNCTION_LIST FUEDK IF_DATA DIM_X 0x382136 EXTERN WORD IF_DATA MCMESS 0x382136 EXTERN /end MEASUREMENT
/begin MEASUREMENT frhodk_w "Faktor Luftdichtekorrektur für DK-Durchfluß f(Ansauglufttemp.,Höhe) 16 Bit" UWORD fak_uw_b2 1 100 0 1.99997 FUNCTION_LIST BGMSZS BGRLP FUEDK IF_DATA DIM_X 0x381FFA EXTERN WORD IF_DATA MCMESS 0x381FFA EXTERN /end MEASUREMENT
/begin MEASUREMENT frhol_w "Faktor Luftdichte f(Ansauglufttemp., Höhe) 16-Bit" UWORD fak_uw_b2 1 100 0 1.99997 FUNCTION_LIST GGDSAS SLS IF_DATA DIM_X 0x382094 EXTERN WORD IF_DATA MCMESS 0x382094 EXTERN /end MEASUREMENT
/begin MEASUREMENT frini2_w "Initialisierungswert für Regelfaktor Lambdaregelung, Bank 2" UWORD fak_uw_b2 1 100 0 1.99997 FUNCTION_LIST LRSINI LRS IF_DATA DIM_X 0x382ABC EXTERN WORD IF_DATA MCMESS 0x382ABC EXTERN /end MEASUREMENT
/begin MEASUREMENT frini_w "Initialisierungswert für Regelfaktor Lambdaregelung" UWORD fak_uw_b2 1 100 0 1.99997 FUNCTION_LIST LRSINI LRS IF_DATA DIM_X 0x382ABE EXTERN WORD IF_DATA MCMESS 0x382ABE EXTERN /end MEASUREMENT
/begin MEASUREMENT frkte "Faktor Umrechnung rel. Kraftstoffmasse rk effekt. Einspritzzeit te" UBYTE rkti_sy 1 100 0 0.453333 FUNCTION_LIST AES KVA RKTI IF_DATA DIM_X 0x380B09 EXTERN WORD IF_DATA MCMESS 0x380B09 EXTERN /end MEASUREMENT
/begin MEASUREMENT frktesq "" UBYTE rkt_ub_b0p546 1 100 0 0.543967 FUNCTION_LIST KVA IF_DATA DIM_X 0x380D26 EXTERN WORD IF_DATA MCMESS 0x380D26 EXTERN /end MEASUREMENT
/begin MEASUREMENT frm2_w "schneller Mittelwert des Lambdaregelfaktors Bank 2(Word)" UWORD fak_uw_b2 1 100 0 1.99997 FUNCTION_LIST LRS DKVS DLSAHK DLSUV DSLSLRS DVS LRA LRSINI T2LID TEB IF_DATA DIM_X 0x382980 EXTERN WORD IF_DATA MCMESS 0x382980 EXTERN /end MEASUREMENT
/begin MEASUREMENT frmfdif_w "Diffrenzwert zwischen Probewert und Momentanwert" SWORD fak_sw_b1 1 100 -1 0.999969 FUNCTION_LIST DTEV IF_DATA DIM_X 0x382C3A EXTERN WORD IF_DATA MCMESS 0x382C3A EXTERN /end MEASUREMENT
/begin MEASUREMENT frmfref_w "gefilterter Referenzwert fr für DTEV Ausfsteuerprüfung" UWORD fak_uw_b2 1 100 0 1.99997 FUNCTION_LIST DTEV IF_DATA DIM_X 0x382C3C EXTERN WORD IF_DATA MCMESS 0x382C3C EXTERN /end MEASUREMENT
/begin MEASUREMENT frmit "Bei Stereo-LR: Mittelwert des fr,fr2 oder bei Ausfall einer Bank: fr der i.O. Bk" UBYTE fak_ub_b2 1 100 0 1.99219 FUNCTION_LIST TEB DFFTK SSTBER87 IF_DATA DIM_X 0x380CC4 EXTERN WORD IF_DATA MCMESS 0x380CC4 EXTERN /end MEASUREMENT
/begin MEASUREMENT frmitf_w "gefilterter Mittelwert fr für DTEV" UWORD fak_uw_b2 1 100 0 1.99997 FUNCTION_LIST DTEV IF_DATA DIM_X 0x382C3E EXTERN WORD IF_DATA MCMESS 0x382C3E EXTERN /end MEASUREMENT
/begin MEASUREMENT frmit_w "Mittelwert aus fr und fr2 (16 bit)" UWORD fak_uw_b2 1 100 0 1.99997 FUNCTION_LIST TEB DTEV IF_DATA DIM_X 0x382BA2 EXTERN WORD IF_DATA MCMESS 0x382BA2 EXTERN /end MEASUREMENT
/begin MEASUREMENT frmn_w "Lambda-Regler-Ausgang Minimalwert" UWORD fak_uw_b2 1 100 0 1.99997 FUNCTION_LIST LRS DTEV IF_DATA DIM_X 0x382982 EXTERN WORD IF_DATA MCMESS 0x382982 EXTERN /end MEASUREMENT
/begin MEASUREMENT frmtrip2_w "Mittelwert des Lambdaregelfaktors für Kurztrip Schwingungsprüfung h. KAT Bank2" UWORD fak_uw_b2 1 100 0 1.99997 FUNCTION_LIST DLSAHK IF_DATA DIM_X 0x381CB2 EXTERN WORD IF_DATA MCMESS 0x381CB2 EXTERN /end MEASUREMENT
/begin MEASUREMENT frmtrip_w "Mittelwert des Lambdaregelfaktors für Kurztrip Schwingungsprüfung hinter KAT" UWORD fak_uw_b2 1 100 0 1.99997 FUNCTION_LIST DLSAHK IF_DATA DIM_X 0x381CB4 EXTERN WORD IF_DATA MCMESS 0x381CB4 EXTERN /end MEASUREMENT
/begin MEASUREMENT frmxa "fr-Max-Auschlag: Bei Stereo-LR: der fr, der am weitesten von 1.0 entfernt" UBYTE fak_ub_b2 1 100 0 1.99219 FUNCTION_LIST TEB IF_DATA DIM_X 0x380CC5 EXTERN WORD IF_DATA MCMESS 0x380CC5 EXTERN /end MEASUREMENT
/begin MEASUREMENT frmxaf_w "fr-Max-Ausschlag: Bei Stereo LR der fr, der am weitesten von 1.0 weg (gefiltert)" UWORD fak_uw_b2 1 100 0 1.99997 FUNCTION_LIST DTEV IF_DATA DIM_X 0x382C40 EXTERN WORD IF_DATA MCMESS 0x382C40 EXTERN /end MEASUREMENT
/begin MEASUREMENT frmxaold_w "Mittelwert Lambdaregler - alter Wert (16 bit)" UWORD fak_uw_b2 1 100 0 1.99997 FUNCTION_LIST TEB IF_DATA DIM_X 0x382BA4 EXTERN WORD IF_DATA MCMESS 0x382BA4 EXTERN /end MEASUREMENT
/begin MEASUREMENT frmxa_w "fr-Max-Ausschlag: Bei Stereo LR der fr, der am weitesten von 1.0 weg (16 bit)" UWORD fak_uw_b2 1 100 0 1.99997 FUNCTION_LIST TEB DTEV IF_DATA DIM_X 0x382BA6 EXTERN WORD IF_DATA MCMESS 0x382BA6 EXTERN /end MEASUREMENT
/begin MEASUREMENT frmx_w "LR mit Integratorstop : Max. Begrenzung Integrator fr,; FRMAX / angehoben d.DSLS" UWORD fak_uw_b2 1 100 0 1.99997 FUNCTION_LIST LRS DTEV IF_DATA DIM_X 0x382984 EXTERN WORD IF_DATA MCMESS 0x382984 EXTERN /end MEASUREMENT
/begin MEASUREMENT frm_w "schneller Mittelwert des Lambdaregelfaktors (Word)" UWORD fak_uw_b2 1 100 0 1.99997 FUNCTION_LIST LRS DKVS DLSAHK DLSUV DSLSLRS DVS LRA LRSINI T2LID TEB IF_DATA DIM_X 0x382986 EXTERN WORD IF_DATA MCMESS 0x382986 EXTERN /end MEASUREMENT
/begin MEASUREMENT froza2_w "Lambda-Regler-Ausgang ohne Zwangsanregung; Bank2" UWORD fak_uw_b2 1 100 0 1.99997 FUNCTION_LIST LRS IF_DATA DIM_X 0x382988 EXTERN WORD IF_DATA MCMESS 0x382988 EXTERN /end MEASUREMENT
/begin MEASUREMENT froza_w "Lambda-Regler-Ausgang ohne Zwangsanregung" UWORD fak_uw_b2 1 100 0 1.99997 FUNCTION_LIST LRS IF_DATA DIM_X 0x38298A EXTERN WORD IF_DATA MCMESS 0x38298A EXTERN /end MEASUREMENT
/begin MEASUREMENT frxta "Faktor zur Korrektur rlmx als Funktion von tans" UBYTE fak_ub_b2 1 100 0 1.99219 FUNCTION_LIST LDRLMX T2LID IF_DATA DIM_X 0x380BF6 EXTERN WORD IF_DATA MCMESS 0x380BF6 EXTERN /end MEASUREMENT
/begin MEASUREMENT frxtm "Faktor zur Korrektur rlmx als Funktion von tmot (tmki)" UBYTE fak_ub_b2 1 100 0 1.99219 FUNCTION_LIST LDRLMX T2LID IF_DATA DIM_X 0x380BF7 EXTERN WORD IF_DATA MCMESS 0x380BF7 EXTERN /end MEASUREMENT
/begin MEASUREMENT fr_u "Lambda-Regler-Ausgang (Byte)" UBYTE fak_ub_b2 1 100 0 1.99219 FUNCTION_LIST DFFTCNV DFFT IF_DATA DIM_X 0x3809EC EXTERN WORD IF_DATA MCMESS 0x3809EC EXTERN /end MEASUREMENT
/begin MEASUREMENT fr_w "Lambda-Regler-Ausgang (Word)" UWORD fak_uw_b2 1 100 0 1.99997 FUNCTION_LIST LRS DFFTCNV GK T2LID TC1MOD IF_DATA DIM_X 0x38298C EXTERN WORD IF_DATA MCMESS 0x38298C EXTERN /end MEASUREMENT
/begin MEASUREMENT fs11_02 "Filterwert Segmentabweichung, Betriebsbereich 11, Zündung 2" UWORD dtsegn_b720divZylP5 1 100 -120 119.996 FUNCTION_LIST DMDFON IF_DATA DIM_X 0x3833D0 EXTERN WORD IF_DATA MCMESS 0x3833D0 EXTERN /end MEASUREMENT
/begin MEASUREMENT fs11_03 "Filterwert Segmentabweichung, Betriebsbereich 11, Zündung 3" UWORD dtsegn_b720divZylP5 1 100 -120 119.996 FUNCTION_LIST DMDFON IF_DATA DIM_X 0x383400 EXTERN WORD IF_DATA MCMESS 0x383400 EXTERN /end MEASUREMENT
/begin MEASUREMENT fs11_04 "Filterwert Segmentabweichung, Betriebsbereich 11, Zündung 4" UWORD dtsegn_b720divZylP5 1 100 -120 119.996 FUNCTION_LIST DMDFON IF_DATA DIM_X 0x383430 EXTERN WORD IF_DATA MCMESS 0x383430 EXTERN /end MEASUREMENT
/begin MEASUREMENT fs11_05 "Filterwert Segmentabweichung, Betriebsbereich 11, Zündung 5" UWORD dtsegn_b720divZylP5 1 100 -120 119.996 FUNCTION_LIST DMDFON IF_DATA DIM_X 0x383460 EXTERN WORD IF_DATA MCMESS 0x383460 EXTERN /end MEASUREMENT
/begin MEASUREMENT fs11_06 "Filterwert Segmentabweichung, Betriebsbereich 11, Zündung 6" UWORD dtsegn_b720divZylP5 1 100 -120 119.996 FUNCTION_LIST DMDFON IF_DATA DIM_X 0x383490 EXTERN WORD IF_DATA MCMESS 0x383490 EXTERN /end MEASUREMENT
/begin MEASUREMENT fs11_07 "Filterwert Segmentabweichung, Betriebsbereich 11, Zündung 7" UWORD dtsegn_b720divZylP5 1 100 -120 119.996 FUNCTION_LIST DMDFON IF_DATA DIM_X 0x3834C0 EXTERN WORD IF_DATA MCMESS 0x3834C0 EXTERN /end MEASUREMENT
/begin MEASUREMENT fs11_08 "Filterwert Segmentabweichung, Betriebsbereich 11, Zündung 8" UWORD dtsegn_b720divZylP5 1 100 -120 119.996 FUNCTION_LIST DMDFON IF_DATA DIM_X 0x3834F0 EXTERN WORD IF_DATA MCMESS 0x3834F0 EXTERN /end MEASUREMENT
/begin MEASUREMENT fs12_02 "Filterwert Segmentabweichung, Betriebsbereich 12, Zündung 2" UWORD dtsegn_b720divZylP5 1 100 -120 119.996 FUNCTION_LIST DMDFON IF_DATA DIM_X 0x3833E0 EXTERN WORD IF_DATA MCMESS 0x3833E0 EXTERN /end MEASUREMENT
/begin MEASUREMENT fs12_03 "Filterwert Segmentabweichung, Betriebsbereich 12, Zündung 3" UWORD dtsegn_b720divZylP5 1 100 -120 119.996 FUNCTION_LIST DMDFON IF_DATA DIM_X 0x383410 EXTERN WORD IF_DATA MCMESS 0x383410 EXTERN /end MEASUREMENT
/begin MEASUREMENT fs12_04 "Filterwert Segmentabweichung, Betriebsbereich 12, Zündung 4" UWORD dtsegn_b720divZylP5 1 100 -120 119.996 FUNCTION_LIST DMDFON IF_DATA DIM_X 0x383440 EXTERN WORD IF_DATA MCMESS 0x383440 EXTERN /end MEASUREMENT
/begin MEASUREMENT fs12_05 "Filterwert Segmentabweichung, Betriebsbereich 12, Zündung 5" UWORD dtsegn_b720divZylP5 1 100 -120 119.996 FUNCTION_LIST DMDFON IF_DATA DIM_X 0x383470 EXTERN WORD IF_DATA MCMESS 0x383470 EXTERN /end MEASUREMENT
/begin MEASUREMENT fs12_06 "Filterwert Segmentabweichung, Betriebsbereich 12, Zündung 6" UWORD dtsegn_b720divZylP5 1 100 -120 119.996 FUNCTION_LIST DMDFON IF_DATA DIM_X 0x3834A0 EXTERN WORD IF_DATA MCMESS 0x3834A0 EXTERN /end MEASUREMENT
/begin MEASUREMENT fs12_07 "Filterwert Segmentabweichung, Betriebsbereich 12, Zündung 7" UWORD dtsegn_b720divZylP5 1 100 -120 119.996 FUNCTION_LIST DMDFON IF_DATA DIM_X 0x3834D0 EXTERN WORD IF_DATA MCMESS 0x3834D0 EXTERN /end MEASUREMENT
/begin MEASUREMENT fs12_08 "Filterwert Segmentabweichung, Betriebsbereich 12, Zündung 8" UWORD dtsegn_b720divZylP5 1 100 -120 119.996 FUNCTION_LIST DMDFON IF_DATA DIM_X 0x383500 EXTERN WORD IF_DATA MCMESS 0x383500 EXTERN /end MEASUREMENT
/begin MEASUREMENT fs13_02 "Filterwert Segmentabweichung, Betriebsbereich 13, Zündung 2" UWORD dtsegn_b720divZylP5 1 100 -120 119.996 FUNCTION_LIST DMDFON IF_DATA DIM_X 0x3833F0 EXTERN WORD IF_DATA MCMESS 0x3833F0 EXTERN /end MEASUREMENT
/begin MEASUREMENT fs13_03 "Filterwert Segmentabweichung, Betriebsbereich 13, Zündung 3" UWORD dtsegn_b720divZylP5 1 100 -120 119.996 FUNCTION_LIST DMDFON IF_DATA DIM_X 0x383420 EXTERN WORD IF_DATA MCMESS 0x383420 EXTERN /end MEASUREMENT
/begin MEASUREMENT fs13_04 "Filterwert Segmentabweichung, Betriebsbereich 13, Zündung 4" UWORD dtsegn_b720divZylP5 1 100 -120 119.996 FUNCTION_LIST DMDFON IF_DATA DIM_X 0x383450 EXTERN WORD IF_DATA MCMESS 0x383450 EXTERN /end MEASUREMENT
/begin MEASUREMENT fs13_05 "Filterwert Segmentabweichung, Betriebsbereich 13, Zündung 5" UWORD dtsegn_b720divZylP5 1 100 -120 119.996 FUNCTION_LIST DMDFON IF_DATA DIM_X 0x383480 EXTERN WORD IF_DATA MCMESS 0x383480 EXTERN /end MEASUREMENT
/begin MEASUREMENT fs13_06 "Filterwert Segmentabweichung, Betriebsbereich 13, Zündung 6" UWORD dtsegn_b720divZylP5 1 100 -120 119.996 FUNCTION_LIST DMDFON IF_DATA DIM_X 0x3834B0 EXTERN WORD IF_DATA MCMESS 0x3834B0 EXTERN /end MEASUREMENT
/begin MEASUREMENT fs13_07 "Filterwert Segmentabweichung, Betriebsbereich 13, Zündung 7" UWORD dtsegn_b720divZylP5 1 100 -120 119.996 FUNCTION_LIST DMDFON IF_DATA DIM_X 0x3834E0 EXTERN WORD IF_DATA MCMESS 0x3834E0 EXTERN /end MEASUREMENT
/begin MEASUREMENT fs13_08 "Filterwert Segmentabweichung, Betriebsbereich 13, Zündung 8" UWORD dtsegn_b720divZylP5 1 100 -120 119.996 FUNCTION_LIST DMDFON IF_DATA DIM_X 0x383510 EXTERN WORD IF_DATA MCMESS 0x383510 EXTERN /end MEASUREMENT
/begin MEASUREMENT fs21_02 "Filterwert Segmentabweichung, Betriebsbereich 21, Zündung 2" UWORD dtsegn_b720divZylP5 1 100 -120 119.996 FUNCTION_LIST DMDFON IF_DATA DIM_X 0x3833D2 EXTERN WORD IF_DATA MCMESS 0x3833D2 EXTERN /end MEASUREMENT
/begin MEASUREMENT fs21_03 "Filterwert Segmentabweichung, Betriebsbereich 21, Zündung 3" UWORD dtsegn_b720divZylP5 1 100 -120 119.996 FUNCTION_LIST DMDFON IF_DATA DIM_X 0x383402 EXTERN WORD IF_DATA MCMESS 0x383402 EXTERN /end MEASUREMENT
/begin MEASUREMENT fs21_04 "Filterwert Segmentabweichung, Betriebsbereich 21, Zündung 4" UWORD dtsegn_b720divZylP5 1 100 -120 119.996 FUNCTION_LIST DMDFON IF_DATA DIM_X 0x383432 EXTERN WORD IF_DATA MCMESS 0x383432 EXTERN /end MEASUREMENT
/begin MEASUREMENT fs21_05 "Filterwert Segmentabweichung, Betriebsbereich 21, Zündung 5" UWORD dtsegn_b720divZylP5 1 100 -120 119.996 FUNCTION_LIST DMDFON IF_DATA DIM_X 0x383462 EXTERN WORD IF_DATA MCMESS 0x383462 EXTERN /end MEASUREMENT
/begin MEASUREMENT fs21_06 "Filterwert Segmentabweichung, Betriebsbereich 21, Zündung 6" UWORD dtsegn_b720divZylP5 1 100 -120 119.996 FUNCTION_LIST DMDFON IF_DATA DIM_X 0x383492 EXTERN WORD IF_DATA MCMESS 0x383492 EXTERN /end MEASUREMENT
/begin MEASUREMENT fs21_07 "Filterwert Segmentabweichung, Betriebsbereich 21, Zündung 7" UWORD dtsegn_b720divZylP5 1 100 -120 119.996 FUNCTION_LIST DMDFON IF_DATA DIM_X 0x3834C2 EXTERN WORD IF_DATA MCMESS 0x3834C2 EXTERN /end MEASUREMENT
/begin MEASUREMENT fs21_08 "Filterwert Segmentabweichung, Betriebsbereich 21, Zündung 8" UWORD dtsegn_b720divZylP5 1 100 -120 119.996 FUNCTION_LIST DMDFON IF_DATA DIM_X 0x3834F2 EXTERN WORD IF_DATA MCMESS 0x3834F2 EXTERN /end MEASUREMENT
/begin MEASUREMENT fs22_02 "Filterwert Segmentabweichung, Betriebsbereich 22, Zündung 2" UWORD dtsegn_b720divZylP5 1 100 -120 119.996 FUNCTION_LIST DMDFON IF_DATA DIM_X 0x3833E2 EXTERN WORD IF_DATA MCMESS 0x3833E2 EXTERN /end MEASUREMENT
/begin MEASUREMENT fs22_03 "Filterwert Segmentabweichung, Betriebsbereich 22, Zündung 3" UWORD dtsegn_b720divZylP5 1 100 -120 119.996 FUNCTION_LIST DMDFON IF_DATA DIM_X 0x383412 EXTERN WORD IF_DATA MCMESS 0x383412 EXTERN /end MEASUREMENT
/begin MEASUREMENT fs22_04 "Filterwert Segmentabweichung, Betriebsbereich 22, Zündung 4" UWORD dtsegn_b720divZylP5 1 100 -120 119.996 FUNCTION_LIST DMDFON IF_DATA DIM_X 0x383442 EXTERN WORD IF_DATA MCMESS 0x383442 EXTERN /end MEASUREMENT
/begin MEASUREMENT fs22_05 "Filterwert Segmentabweichung, Betriebsbereich 22, Zündung 5" UWORD dtsegn_b720divZylP5 1 100 -120 119.996 FUNCTION_LIST DMDFON IF_DATA DIM_X 0x383472 EXTERN WORD IF_DATA MCMESS 0x383472 EXTERN /end MEASUREMENT
/begin MEASUREMENT fs22_06 "Filterwert Segmentabweichung, Betriebsbereich 22, Zündung 6" UWORD dtsegn_b720divZylP5 1 100 -120 119.996 FUNCTION_LIST DMDFON IF_DATA DIM_X 0x3834A2 EXTERN WORD IF_DATA MCMESS 0x3834A2 EXTERN /end MEASUREMENT
/begin MEASUREMENT fs22_07 "Filterwert Segmentabweichung, Betriebsbereich 22, Zündung 7" UWORD dtsegn_b720divZylP5 1 100 -120 119.996 FUNCTION_LIST DMDFON IF_DATA DIM_X 0x3834D2 EXTERN WORD IF_DATA MCMESS 0x3834D2 EXTERN /end MEASUREMENT
/begin MEASUREMENT fs22_08 "Filterwert Segmentabweichung, Betriebsbereich 22, Zündung 8" UWORD dtsegn_b720divZylP5 1 100 -120 119.996 FUNCTION_LIST DMDFON IF_DATA DIM_X 0x383502 EXTERN WORD IF_DATA MCMESS 0x383502 EXTERN /end MEASUREMENT
/begin MEASUREMENT fs23_02 "Filterwert Segmentabweichung, Betriebsbereich 23, Zündung 2" UWORD dtsegn_b720divZylP5 1 100 -120 119.996 FUNCTION_LIST DMDFON IF_DATA DIM_X 0x3833F2 EXTERN WORD IF_DATA MCMESS 0x3833F2 EXTERN /end MEASUREMENT
/begin MEASUREMENT fs23_03 "Filterwert Segmentabweichung, Betriebsbereich 23, Zündung 3" UWORD dtsegn_b720divZylP5 1 100 -120 119.996 FUNCTION_LIST DMDFON IF_DATA DIM_X 0x383422 EXTERN WORD IF_DATA MCMESS 0x383422 EXTERN /end MEASUREMENT
/begin MEASUREMENT fs23_04 "Filterwert Segmentabweichung, Betriebsbereich 23, Zündung 4" UWORD dtsegn_b720divZylP5 1 100 -120 119.996 FUNCTION_LIST DMDFON IF_DATA DIM_X 0x383452 EXTERN WORD IF_DATA MCMESS 0x383452 EXTERN /end MEASUREMENT
/begin MEASUREMENT fs23_05 "Filterwert Segmentabweichung, Betriebsbereich 23, Zündung 5" UWORD dtsegn_b720divZylP5 1 100 -120 119.996 FUNCTION_LIST DMDFON IF_DATA DIM_X 0x383482 EXTERN WORD IF_DATA MCMESS 0x383482 EXTERN /end MEASUREMENT
/begin MEASUREMENT fs23_06 "Filterwert Segmentabweichung, Betriebsbereich 23, Zündung 6" UWORD dtsegn_b720divZylP5 1 100 -120 119.996 FUNCTION_LIST DMDFON IF_DATA DIM_X 0x3834B2 EXTERN WORD IF_DATA MCMESS 0x3834B2 EXTERN /end MEASUREMENT
/begin MEASUREMENT fs23_07 "Filterwert Segmentabweichung, Betriebsbereich 23, Zündung 7" UWORD dtsegn_b720divZylP5 1 100 -120 119.996 FUNCTION_LIST DMDFON IF_DATA DIM_X 0x3834E2 EXTERN WORD IF_DATA MCMESS 0x3834E2 EXTERN /end MEASUREMENT
/begin MEASUREMENT fs23_08 "Filterwert Segmentabweichung, Betriebsbereich 23, Zündung 8" UWORD dtsegn_b720divZylP5 1 100 -120 119.996 FUNCTION_LIST DMDFON IF_DATA DIM_X 0x383512 EXTERN WORD IF_DATA MCMESS 0x383512 EXTERN /end MEASUREMENT
/begin MEASUREMENT fs31_02 "Filterwert Segmentabweichung, Betriebsbereich 31, Zylinder 2" UWORD dtsegn_b720divZylP5 1 100 -120 119.996 FUNCTION_LIST DMDFON IF_DATA DIM_X 0x3833D4 EXTERN WORD IF_DATA MCMESS 0x3833D4 EXTERN /end MEASUREMENT
/begin MEASUREMENT fs31_03 "Filterwert Segmentabweichung, Betriebsbereich 31" UWORD dtsegn_b720divZylP5 1 100 -120 119.996 FUNCTION_LIST DMDFON IF_DATA DIM_X 0x383404 EXTERN WORD IF_DATA MCMESS 0x383404 EXTERN /end MEASUREMENT
/begin MEASUREMENT fs31_04 "Filterwert Segmentabweichung, Betriebsbereich 31" UWORD dtsegn_b720divZylP5 1 100 -120 119.996 FUNCTION_LIST DMDFON IF_DATA DIM_X 0x383434 EXTERN WORD IF_DATA MCMESS 0x383434 EXTERN /end MEASUREMENT
/begin MEASUREMENT fs31_05 "Filterwert Segmentabweichung, Betriebsbereich 31" UWORD dtsegn_b720divZylP5 1 100 -120 119.996 FUNCTION_LIST DMDFON IF_DATA DIM_X 0x383464 EXTERN WORD IF_DATA MCMESS 0x383464 EXTERN /end MEASUREMENT
/begin MEASUREMENT fs31_06 "Filterwert Segmentabweichung, Betriebsbereich 31" UWORD dtsegn_b720divZylP5 1 100 -120 119.996 FUNCTION_LIST DMDFON IF_DATA DIM_X 0x383494 EXTERN WORD IF_DATA MCMESS 0x383494 EXTERN /end MEASUREMENT
/begin MEASUREMENT fs31_07 "Filterwert Segmentabweichung, Betriebsbereich 31" UWORD dtsegn_b720divZylP5 1 100 -120 119.996 FUNCTION_LIST DMDFON IF_DATA DIM_X 0x3834C4 EXTERN WORD IF_DATA MCMESS 0x3834C4 EXTERN /end MEASUREMENT
/begin MEASUREMENT fs31_08 "Filterwert Segmentabweichung, Betriebsbereich 31" UWORD dtsegn_b720divZylP5 1 100 -120 119.996 FUNCTION_LIST DMDFON IF_DATA DIM_X 0x3834F4 EXTERN WORD IF_DATA MCMESS 0x3834F4 EXTERN /end MEASUREMENT
/begin MEASUREMENT fs32_02 "Filterwert Segmentabweichung, Betriebsbereich 32, Zylinder 2" UWORD dtsegn_b720divZylP5 1 100 -120 119.996 FUNCTION_LIST DMDFON IF_DATA DIM_X 0x3833E4 EXTERN WORD IF_DATA MCMESS 0x3833E4 EXTERN /end MEASUREMENT
/begin MEASUREMENT fs32_03 "Filterwert Segmentabweichung, Betriebsbereich 32" UWORD dtsegn_b720divZylP5 1 100 -120 119.996 FUNCTION_LIST DMDFON IF_DATA DIM_X 0x383414 EXTERN WORD IF_DATA MCMESS 0x383414 EXTERN /end MEASUREMENT
/begin MEASUREMENT fs32_04 "Filterwert Segmentabweichung, Betriebsbereich 32" UWORD dtsegn_b720divZylP5 1 100 -120 119.996 FUNCTION_LIST DMDFON IF_DATA DIM_X 0x383444 EXTERN WORD IF_DATA MCMESS 0x383444 EXTERN /end MEASUREMENT
/begin MEASUREMENT fs32_05 "Filterwert Segmentabweichung, Betriebsbereich 32" UWORD dtsegn_b720divZylP5 1 100 -120 119.996 FUNCTION_LIST DMDFON IF_DATA DIM_X 0x383474 EXTERN WORD IF_DATA MCMESS 0x383474 EXTERN /end MEASUREMENT
/begin MEASUREMENT fs32_06 "Filterwert Segmentabweichung, Betriebsbereich 32" UWORD dtsegn_b720divZylP5 1 100 -120 119.996 FUNCTION_LIST DMDFON IF_DATA DIM_X 0x3834A4 EXTERN WORD IF_DATA MCMESS 0x3834A4 EXTERN /end MEASUREMENT
/begin MEASUREMENT fs32_07 "Filterwert Segmentabweichung, Betriebsbereich 32" UWORD dtsegn_b720divZylP5 1 100 -120 119.996 FUNCTION_LIST DMDFON IF_DATA DIM_X 0x3834D4 EXTERN WORD IF_DATA MCMESS 0x3834D4 EXTERN /end MEASUREMENT
/begin MEASUREMENT fs32_08 "Filterwert Segmentabweichung, Betriebsbereich 32" UWORD dtsegn_b720divZylP5 1 100 -120 119.996 FUNCTION_LIST DMDFON IF_DATA DIM_X 0x383504 EXTERN WORD IF_DATA MCMESS 0x383504 EXTERN /end MEASUREMENT
/begin MEASUREMENT fs33_02 "Filterwert Segmentabweichung, Betriebsbereich 33, Zylinder 2" UWORD dtsegn_b720divZylP5 1 100 -120 119.996 FUNCTION_LIST DMDFON IF_DATA DIM_X 0x3833F4 EXTERN WORD IF_DATA MCMESS 0x3833F4 EXTERN /end MEASUREMENT
/begin MEASUREMENT fs33_03 "Filterwert Segmentabweichung, Betriebsbereich 33" UWORD dtsegn_b720divZylP5 1 100 -120 119.996 FUNCTION_LIST DMDFON IF_DATA DIM_X 0x383424 EXTERN WORD IF_DATA MCMESS 0x383424 EXTERN /end MEASUREMENT
/begin MEASUREMENT fs33_04 "Filterwert Segmentabweichung, Betriebsbereich 33" UWORD dtsegn_b720divZylP5 1 100 -120 119.996 FUNCTION_LIST DMDFON IF_DATA DIM_X 0x383454 EXTERN WORD IF_DATA MCMESS 0x383454 EXTERN /end MEASUREMENT
/begin MEASUREMENT fs33_05 "Filterwert Segmentabweichung, Betriebsbereich 33" UWORD dtsegn_b720divZylP5 1 100 -120 119.996 FUNCTION_LIST DMDFON IF_DATA DIM_X 0x383484 EXTERN WORD IF_DATA MCMESS 0x383484 EXTERN /end MEASUREMENT
/begin MEASUREMENT fs33_06 "Filterwert Segmentabweichung, Betriebsbereich 33" UWORD dtsegn_b720divZylP5 1 100 -120 119.996 FUNCTION_LIST DMDFON IF_DATA DIM_X 0x3834B4 EXTERN WORD IF_DATA MCMESS 0x3834B4 EXTERN /end MEASUREMENT
/begin MEASUREMENT fs33_07 "Filterwert Segmentabweichung, Betriebsbereich 33" UWORD dtsegn_b720divZylP5 1 100 -120 119.996 FUNCTION_LIST DMDFON IF_DATA DIM_X 0x3834E4 EXTERN WORD IF_DATA MCMESS 0x3834E4 EXTERN /end MEASUREMENT
/begin MEASUREMENT fs33_08 "Filterwert Segmentabweichung, Betriebsbereich 33" UWORD dtsegn_b720divZylP5 1 100 -120 119.996 FUNCTION_LIST DMDFON IF_DATA DIM_X 0x383514 EXTERN WORD IF_DATA MCMESS 0x383514 EXTERN /end MEASUREMENT
/begin MEASUREMENT fs41_02 "Filterwert Segmentabweichung, Betriebsbereich 41, Zylinder 2" UWORD dtsegn_b720divZylP5 1 100 -120 119.996 FUNCTION_LIST DMDFON IF_DATA DIM_X 0x3833D6 EXTERN WORD IF_DATA MCMESS 0x3833D6 EXTERN /end MEASUREMENT
/begin MEASUREMENT fs41_03 "Filterwert Segmentabweichung, Betriebsbereich 41" UWORD dtsegn_b720divZylP5 1 100 -120 119.996 FUNCTION_LIST DMDFON IF_DATA DIM_X 0x383406 EXTERN WORD IF_DATA MCMESS 0x383406 EXTERN /end MEASUREMENT
/begin MEASUREMENT fs41_04 "Filterwert Segmentabweichung, Betriebsbereich 41" UWORD dtsegn_b720divZylP5 1 100 -120 119.996 FUNCTION_LIST DMDFON IF_DATA DIM_X 0x383436 EXTERN WORD IF_DATA MCMESS 0x383436 EXTERN /end MEASUREMENT
/begin MEASUREMENT fs41_05 "Filterwert Segmentabweichung, Betriebsbereich 41" UWORD dtsegn_b720divZylP5 1 100 -120 119.996 FUNCTION_LIST DMDFON IF_DATA DIM_X 0x383466 EXTERN WORD IF_DATA MCMESS 0x383466 EXTERN /end MEASUREMENT
/begin MEASUREMENT fs41_06 "Filterwert Segmentabweichung, Betriebsbereich 41" UWORD dtsegn_b720divZylP5 1 100 -120 119.996 FUNCTION_LIST DMDFON IF_DATA DIM_X 0x383496 EXTERN WORD IF_DATA MCMESS 0x383496 EXTERN /end MEASUREMENT
/begin MEASUREMENT fs41_07 "Filterwert Segmentabweichung, Betriebsbereich 41" UWORD dtsegn_b720divZylP5 1 100 -120 119.996 FUNCTION_LIST DMDFON IF_DATA DIM_X 0x3834C6 EXTERN WORD IF_DATA MCMESS 0x3834C6 EXTERN /end MEASUREMENT
/begin MEASUREMENT fs41_08 "Filterwert Segmentabweichung, Betriebsbereich 41" UWORD dtsegn_b720divZylP5 1 100 -120 119.996 FUNCTION_LIST DMDFON IF_DATA DIM_X 0x3834F6 EXTERN WORD IF_DATA MCMESS 0x3834F6 EXTERN /end MEASUREMENT
/begin MEASUREMENT fs42_02 "Filterwert Segmentabweichung, Betriebsbereich 42, Zylinder 2" UWORD dtsegn_b720divZylP5 1 100 -120 119.996 FUNCTION_LIST DMDFON IF_DATA DIM_X 0x3833E6 EXTERN WORD IF_DATA MCMESS 0x3833E6 EXTERN /end MEASUREMENT
/begin MEASUREMENT fs42_03 "Filterwert Segmentabweichung, Betriebsbereich 42" UWORD dtsegn_b720divZylP5 1 100 -120 119.996 FUNCTION_LIST DMDFON IF_DATA DIM_X 0x383416 EXTERN WORD IF_DATA MCMESS 0x383416 EXTERN /end MEASUREMENT
/begin MEASUREMENT fs42_04 "Filterwert Segmentabweichung, Betriebsbereich 42" UWORD dtsegn_b720divZylP5 1 100 -120 119.996 FUNCTION_LIST DMDFON IF_DATA DIM_X 0x383446 EXTERN WORD IF_DATA MCMESS 0x383446 EXTERN /end MEASUREMENT
/begin MEASUREMENT fs42_05 "Filterwert Segmentabweichung, Betriebsbereich 42" UWORD dtsegn_b720divZylP5 1 100 -120 119.996 FUNCTION_LIST DMDFON IF_DATA DIM_X 0x383476 EXTERN WORD IF_DATA MCMESS 0x383476 EXTERN /end MEASUREMENT
/begin MEASUREMENT fs42_06 "Filterwert Segmentabweichung, Betriebsbereich 42" UWORD dtsegn_b720divZylP5 1 100 -120 119.996 FUNCTION_LIST DMDFON IF_DATA DIM_X 0x3834A6 EXTERN WORD IF_DATA MCMESS 0x3834A6 EXTERN /end MEASUREMENT
/begin MEASUREMENT fs42_07 "Filterwert Segmentabweichung, Betriebsbereich 42" UWORD dtsegn_b720divZylP5 1 100 -120 119.996 FUNCTION_LIST DMDFON IF_DATA DIM_X 0x3834D6 EXTERN WORD IF_DATA MCMESS 0x3834D6 EXTERN /end MEASUREMENT
/begin MEASUREMENT fs42_08 "Filterwert Segmentabweichung, Betriebsbereich 42" UWORD dtsegn_b720divZylP5 1 100 -120 119.996 FUNCTION_LIST DMDFON IF_DATA DIM_X 0x383506 EXTERN WORD IF_DATA MCMESS 0x383506 EXTERN /end MEASUREMENT
/begin MEASUREMENT fs43_02 "Filterwert Segmentabweichung, Betriebsbereich 43, Zylinder 2" UWORD dtsegn_b720divZylP5 1 100 -120 119.996 FUNCTION_LIST DMDFON IF_DATA DIM_X 0x3833F6 EXTERN WORD IF_DATA MCMESS 0x3833F6 EXTERN /end MEASUREMENT
/begin MEASUREMENT fs43_03 "Filterwert Segmentabweichung, Betriebsbereich 43" UWORD dtsegn_b720divZylP5 1 100 -120 119.996 FUNCTION_LIST DMDFON IF_DATA DIM_X 0x383426 EXTERN WORD IF_DATA MCMESS 0x383426 EXTERN /end MEASUREMENT
/begin MEASUREMENT fs43_04 "Filterwert Segmentabweichung, Betriebsbereich 43" UWORD dtsegn_b720divZylP5 1 100 -120 119.996 FUNCTION_LIST DMDFON IF_DATA DIM_X 0x383456 EXTERN WORD IF_DATA MCMESS 0x383456 EXTERN /end MEASUREMENT
/begin MEASUREMENT fs43_05 "Filterwert Segmentabweichung, Betriebsbereich 43" UWORD dtsegn_b720divZylP5 1 100 -120 119.996 FUNCTION_LIST DMDFON IF_DATA DIM_X 0x383486 EXTERN WORD IF_DATA MCMESS 0x383486 EXTERN /end MEASUREMENT
/begin MEASUREMENT fs43_06 "Filterwert Segmentabweichung, Betriebsbereich 43" UWORD dtsegn_b720divZylP5 1 100 -120 119.996 FUNCTION_LIST DMDFON IF_DATA DIM_X 0x3834B6 EXTERN WORD IF_DATA MCMESS 0x3834B6 EXTERN /end MEASUREMENT
/begin MEASUREMENT fs43_07 "Filterwert Segmentabweichung, Betriebsbereich 43" UWORD dtsegn_b720divZylP5 1 100 -120 119.996 FUNCTION_LIST DMDFON IF_DATA DIM_X 0x3834E6 EXTERN WORD IF_DATA MCMESS 0x3834E6 EXTERN /end MEASUREMENT
/begin MEASUREMENT fs43_08 "Filterwert Segmentabweichung, Betriebsbereich 43" UWORD dtsegn_b720divZylP5 1 100 -120 119.996 FUNCTION_LIST DMDFON IF_DATA DIM_X 0x383516 EXTERN WORD IF_DATA MCMESS 0x383516 EXTERN /end MEASUREMENT
/begin MEASUREMENT fs51_02 "Filterwert Segmentabweichung, Betriebsbereich 51, Zylinder 2" UWORD dtsegn_b720divZylP5 1 100 -120 119.996 FUNCTION_LIST DMDFON IF_DATA DIM_X 0x3833D8 EXTERN WORD IF_DATA MCMESS 0x3833D8 EXTERN /end MEASUREMENT
/begin MEASUREMENT fs51_03 "Filterwert Segmentabweichung, Betriebsbereich 51" UWORD dtsegn_b720divZylP5 1 100 -120 119.996 FUNCTION_LIST DMDFON IF_DATA DIM_X 0x383408 EXTERN WORD IF_DATA MCMESS 0x383408 EXTERN /end MEASUREMENT
/begin MEASUREMENT fs51_04 "Filterwert Segmentabweichung, Betriebsbereich 51" UWORD dtsegn_b720divZylP5 1 100 -120 119.996 FUNCTION_LIST DMDFON IF_DATA DIM_X 0x383438 EXTERN WORD IF_DATA MCMESS 0x383438 EXTERN /end MEASUREMENT
/begin MEASUREMENT fs51_05 "Filterwert Segmentabweichung, Betriebsbereich 51" UWORD dtsegn_b720divZylP5 1 100 -120 119.996 FUNCTION_LIST DMDFON IF_DATA DIM_X 0x383468 EXTERN WORD IF_DATA MCMESS 0x383468 EXTERN /end MEASUREMENT
/begin MEASUREMENT fs51_06 "Filterwert Segmentabweichung, Betriebsbereich 51" UWORD dtsegn_b720divZylP5 1 100 -120 119.996 FUNCTION_LIST DMDFON IF_DATA DIM_X 0x383498 EXTERN WORD IF_DATA MCMESS 0x383498 EXTERN /end MEASUREMENT
/begin MEASUREMENT fs51_07 "Filterwert Segmentabweichung, Betriebsbereich 51" UWORD dtsegn_b720divZylP5 1 100 -120 119.996 FUNCTION_LIST DMDFON IF_DATA DIM_X 0x3834C8 EXTERN WORD IF_DATA MCMESS 0x3834C8 EXTERN /end MEASUREMENT
/begin MEASUREMENT fs51_08 "Filterwert Segmentabweichung, Betriebsbereich 51" UWORD dtsegn_b720divZylP5 1 100 -120 119.996 FUNCTION_LIST DMDFON IF_DATA DIM_X 0x3834F8 EXTERN WORD IF_DATA MCMESS 0x3834F8 EXTERN /end MEASUREMENT
/begin MEASUREMENT fs52_02 "Filterwert Segmentabweichung, Betriebsbereich 52, Zylinder 2" UWORD dtsegn_b720divZylP5 1 100 -120 119.996 FUNCTION_LIST DMDFON IF_DATA DIM_X 0x3833E8 EXTERN WORD IF_DATA MCMESS 0x3833E8 EXTERN /end MEASUREMENT
/begin MEASUREMENT fs52_03 "Filterwert Segmentabweichung, Betriebsbereich 52" UWORD dtsegn_b720divZylP5 1 100 -120 119.996 FUNCTION_LIST DMDFON IF_DATA DIM_X 0x383418 EXTERN WORD IF_DATA MCMESS 0x383418 EXTERN /end MEASUREMENT
/begin MEASUREMENT fs52_04 "Filterwert Segmentabweichung, Betriebsbereich 52" UWORD dtsegn_b720divZylP5 1 100 -120 119.996 FUNCTION_LIST DMDFON IF_DATA DIM_X 0x383448 EXTERN WORD IF_DATA MCMESS 0x383448 EXTERN /end MEASUREMENT
/begin MEASUREMENT fs52_05 "Filterwert Segmentabweichung, Betriebsbereich 52" UWORD dtsegn_b720divZylP5 1 100 -120 119.996 FUNCTION_LIST DMDFON IF_DATA DIM_X 0x383478 EXTERN WORD IF_DATA MCMESS 0x383478 EXTERN /end MEASUREMENT
/begin MEASUREMENT fs52_06 "Filterwert Segmentabweichung, Betriebsbereich 52" UWORD dtsegn_b720divZylP5 1 100 -120 119.996 FUNCTION_LIST DMDFON IF_DATA DIM_X 0x3834A8 EXTERN WORD IF_DATA MCMESS 0x3834A8 EXTERN /end MEASUREMENT
/begin MEASUREMENT fs52_07 "Filterwert Segmentabweichung, Betriebsbereich 52" UWORD dtsegn_b720divZylP5 1 100 -120 119.996 FUNCTION_LIST DMDFON IF_DATA DIM_X 0x3834D8 EXTERN WORD IF_DATA MCMESS 0x3834D8 EXTERN /end MEASUREMENT
/begin MEASUREMENT fs52_08 "Filterwert Segmentabweichung, Betriebsbereich 52" UWORD dtsegn_b720divZylP5 1 100 -120 119.996 FUNCTION_LIST DMDFON IF_DATA DIM_X 0x383508 EXTERN WORD IF_DATA MCMESS 0x383508 EXTERN /end MEASUREMENT
/begin MEASUREMENT fs53_02 "Filterwert Segmentabweichung, Betriebsbereich 53, Zylinder 2" UWORD dtsegn_b720divZylP5 1 100 -120 119.996 FUNCTION_LIST DMDFON IF_DATA DIM_X 0x3833F8 EXTERN WORD IF_DATA MCMESS 0x3833F8 EXTERN /end MEASUREMENT
/begin MEASUREMENT fs53_03 "Filterwert Segmentabweichung, Betriebsbereich 53" UWORD dtsegn_b720divZylP5 1 100 -120 119.996 FUNCTION_LIST DMDFON IF_DATA DIM_X 0x383428 EXTERN WORD IF_DATA MCMESS 0x383428 EXTERN /end MEASUREMENT
/begin MEASUREMENT fs53_04 "Filterwert Segmentabweichung, Betriebsbereich 53" UWORD dtsegn_b720divZylP5 1 100 -120 119.996 FUNCTION_LIST DMDFON IF_DATA DIM_X 0x383458 EXTERN WORD IF_DATA MCMESS 0x383458 EXTERN /end MEASUREMENT
/begin MEASUREMENT fs53_05 "Filterwert Segmentabweichung, Betriebsbereich 53" UWORD dtsegn_b720divZylP5 1 100 -120 119.996 FUNCTION_LIST DMDFON IF_DATA DIM_X 0x383488 EXTERN WORD IF_DATA MCMESS 0x383488 EXTERN /end MEASUREMENT
/begin MEASUREMENT fs53_06 "Filterwert Segmentabweichung, Betriebsbereich 53" UWORD dtsegn_b720divZylP5 1 100 -120 119.996 FUNCTION_LIST DMDFON IF_DATA DIM_X 0x3834B8 EXTERN WORD IF_DATA MCMESS 0x3834B8 EXTERN /end MEASUREMENT
/begin MEASUREMENT fs53_07 "Filterwert Segmentabweichung, Betriebsbereich 53" UWORD dtsegn_b720divZylP5 1 100 -120 119.996 FUNCTION_LIST DMDFON IF_DATA DIM_X 0x3834E8 EXTERN WORD IF_DATA MCMESS 0x3834E8 EXTERN /end MEASUREMENT
/begin MEASUREMENT fs53_08 "Filterwert Segmentabweichung, Betriebsbereich 53" UWORD dtsegn_b720divZylP5 1 100 -120 119.996 FUNCTION_LIST DMDFON IF_DATA DIM_X 0x383518 EXTERN WORD IF_DATA MCMESS 0x383518 EXTERN /end MEASUREMENT
/begin MEASUREMENT fs61_02 "Filterwert Segmentabweichung, Betriebsbereich 61, Zylinder 2" UWORD dtsegn_b720divZylP5 1 100 -120 119.996 FUNCTION_LIST DMDFON IF_DATA DIM_X 0x3833DA EXTERN WORD IF_DATA MCMESS 0x3833DA EXTERN /end MEASUREMENT
/begin MEASUREMENT fs61_03 "Filterwert Segmentabweichung, Betriebsbereich 61" UWORD dtsegn_b720divZylP5 1 100 -120 119.996 FUNCTION_LIST DMDFON IF_DATA DIM_X 0x38340A EXTERN WORD IF_DATA MCMESS 0x38340A EXTERN /end MEASUREMENT
/begin MEASUREMENT fs61_04 "Filterwert Segmentabweichung, Betriebsbereich 61" UWORD dtsegn_b720divZylP5 1 100 -120 119.996 FUNCTION_LIST DMDFON IF_DATA DIM_X 0x38343A EXTERN WORD IF_DATA MCMESS 0x38343A EXTERN /end MEASUREMENT
/begin MEASUREMENT fs61_05 "Filterwert Segmentabweichung, Betriebsbereich 61" UWORD dtsegn_b720divZylP5 1 100 -120 119.996 FUNCTION_LIST DMDFON IF_DATA DIM_X 0x38346A EXTERN WORD IF_DATA MCMESS 0x38346A EXTERN /end MEASUREMENT
/begin MEASUREMENT fs61_06 "Filterwert Segmentabweichung, Betriebsbereich 61" UWORD dtsegn_b720divZylP5 1 100 -120 119.996 FUNCTION_LIST DMDFON IF_DATA DIM_X 0x38349A EXTERN WORD IF_DATA MCMESS 0x38349A EXTERN /end MEASUREMENT
/begin MEASUREMENT fs61_07 "Filterwert Segmentabweichung, Betriebsbereich 61" UWORD dtsegn_b720divZylP5 1 100 -120 119.996 FUNCTION_LIST DMDFON IF_DATA DIM_X 0x3834CA EXTERN WORD IF_DATA MCMESS 0x3834CA EXTERN /end MEASUREMENT
/begin MEASUREMENT fs61_08 "Filterwert Segmentabweichung, Betriebsbereich 61" UWORD dtsegn_b720divZylP5 1 100 -120 119.996 FUNCTION_LIST DMDFON IF_DATA DIM_X 0x3834FA EXTERN WORD IF_DATA MCMESS 0x3834FA EXTERN /end MEASUREMENT
/begin MEASUREMENT fs62_02 "Filterwert Segmentabweichung, Betriebsbereich 62, Zylinder 2" UWORD dtsegn_b720divZylP5 1 100 -120 119.996 FUNCTION_LIST DMDFON IF_DATA DIM_X 0x3833EA EXTERN WORD IF_DATA MCMESS 0x3833EA EXTERN /end MEASUREMENT
/begin MEASUREMENT fs62_03 "Filterwert Segmentabweichung, Betriebsbereich 62" UWORD dtsegn_b720divZylP5 1 100 -120 119.996 FUNCTION_LIST DMDFON IF_DATA DIM_X 0x38341A EXTERN WORD IF_DATA MCMESS 0x38341A EXTERN /end MEASUREMENT
/begin MEASUREMENT fs62_04 "Filterwert Segmentabweichung, Betriebsbereich 62" UWORD dtsegn_b720divZylP5 1 100 -120 119.996 FUNCTION_LIST DMDFON IF_DATA DIM_X 0x38344A EXTERN WORD IF_DATA MCMESS 0x38344A EXTERN /end MEASUREMENT
/begin MEASUREMENT fs62_05 "Filterwert Segmentabweichung, Betriebsbereich 62" UWORD dtsegn_b720divZylP5 1 100 -120 119.996 FUNCTION_LIST DMDFON IF_DATA DIM_X 0x38347A EXTERN WORD IF_DATA MCMESS 0x38347A EXTERN /end MEASUREMENT
/begin MEASUREMENT fs62_06 "Filterwert Segmentabweichung, Betriebsbereich 62" UWORD dtsegn_b720divZylP5 1 100 -120 119.996 FUNCTION_LIST DMDFON IF_DATA DIM_X 0x3834AA EXTERN WORD IF_DATA MCMESS 0x3834AA EXTERN /end MEASUREMENT
/begin MEASUREMENT fs62_07 "Filterwert Segmentabweichung, Betriebsbereich 62" UWORD dtsegn_b720divZylP5 1 100 -120 119.996 FUNCTION_LIST DMDFON IF_DATA DIM_X 0x3834DA EXTERN WORD IF_DATA MCMESS 0x3834DA EXTERN /end MEASUREMENT
/begin MEASUREMENT fs62_08 "Filterwert Segmentabweichung, Betriebsbereich 62" UWORD dtsegn_b720divZylP5 1 100 -120 119.996 FUNCTION_LIST DMDFON IF_DATA DIM_X 0x38350A EXTERN WORD IF_DATA MCMESS 0x38350A EXTERN /end MEASUREMENT
/begin MEASUREMENT fs63_02 "Filterwert Segmentabweichung, Betriebsbereich 63, Zylinder 2" UWORD dtsegn_b720divZylP5 1 100 -120 119.996 FUNCTION_LIST DMDFON IF_DATA DIM_X 0x3833FA EXTERN WORD IF_DATA MCMESS 0x3833FA EXTERN /end MEASUREMENT
/begin MEASUREMENT fs63_03 "Filterwert Segmentabweichung, Betriebsbereich 63" UWORD dtsegn_b720divZylP5 1 100 -120 119.996 FUNCTION_LIST DMDFON IF_DATA DIM_X 0x38342A EXTERN WORD IF_DATA MCMESS 0x38342A EXTERN /end MEASUREMENT
/begin MEASUREMENT fs63_04 "Filterwert Segmentabweichung, Betriebsbereich 63" UWORD dtsegn_b720divZylP5 1 100 -120 119.996 FUNCTION_LIST DMDFON IF_DATA DIM_X 0x38345A EXTERN WORD IF_DATA MCMESS 0x38345A EXTERN /end MEASUREMENT
/begin MEASUREMENT fs63_05 "Filterwert Segmentabweichung, Betriebsbereich 63" UWORD dtsegn_b720divZylP5 1 100 -120 119.996 FUNCTION_LIST DMDFON IF_DATA DIM_X 0x38348A EXTERN WORD IF_DATA MCMESS 0x38348A EXTERN /end MEASUREMENT
/begin MEASUREMENT fs63_06 "Filterwert Segmentabweichung, Betriebsbereich 63" UWORD dtsegn_b720divZylP5 1 100 -120 119.996 FUNCTION_LIST DMDFON IF_DATA DIM_X 0x3834BA EXTERN WORD IF_DATA MCMESS 0x3834BA EXTERN /end MEASUREMENT
/begin MEASUREMENT fs63_07 "Filterwert Segmentabweichung, Betriebsbereich 63" UWORD dtsegn_b720divZylP5 1 100 -120 119.996 FUNCTION_LIST DMDFON IF_DATA DIM_X 0x3834EA EXTERN WORD IF_DATA MCMESS 0x3834EA EXTERN /end MEASUREMENT
/begin MEASUREMENT fs63_08 "Filterwert Segmentabweichung, Betriebsbereich 63" UWORD dtsegn_b720divZylP5 1 100 -120 119.996 FUNCTION_LIST DMDFON IF_DATA DIM_X 0x38351A EXTERN WORD IF_DATA MCMESS 0x38351A EXTERN /end MEASUREMENT
/begin MEASUREMENT fs71_02 "Filterwert Segmentabweichung, Betriebsbereich 71, Zylinder 2" UWORD dtsegn_b720divZylP5 1 100 -120 119.996 FUNCTION_LIST DMDFON IF_DATA DIM_X 0x3833DC EXTERN WORD IF_DATA MCMESS 0x3833DC EXTERN /end MEASUREMENT
/begin MEASUREMENT fs71_03 "Filterwert Segmentabweichung, Betriebsbereich 71, Zylinder 3" UWORD dtsegn_b720divZylP5 1 100 -120 119.996 FUNCTION_LIST DMDFON IF_DATA DIM_X 0x38340C EXTERN WORD IF_DATA MCMESS 0x38340C EXTERN /end MEASUREMENT
/begin MEASUREMENT fs71_04 "Filterwert Segmentabweichung, Betriebsbereich 71, Zylinder 4" UWORD dtsegn_b720divZylP5 1 100 -120 119.996 FUNCTION_LIST DMDFON IF_DATA DIM_X 0x38343C EXTERN WORD IF_DATA MCMESS 0x38343C EXTERN /end MEASUREMENT
/begin MEASUREMENT fs71_05 "Filterwert Segmentabweichung, Betriebsbereich 71, Zylinder 5" UWORD dtsegn_b720divZylP5 1 100 -120 119.996 FUNCTION_LIST DMDFON IF_DATA DIM_X 0x38346C EXTERN WORD IF_DATA MCMESS 0x38346C EXTERN /end MEASUREMENT
/begin MEASUREMENT fs71_06 "Filterwert Segmentabweichung, Betriebsbereich 71, Zylinder 6" UWORD dtsegn_b720divZylP5 1 100 -120 119.996 FUNCTION_LIST DMDFON IF_DATA DIM_X 0x38349C EXTERN WORD IF_DATA MCMESS 0x38349C EXTERN /end MEASUREMENT
/begin MEASUREMENT fs71_07 "Filterwert Segmentabweichung, Betriebsbereich 71, Zylinder 7" UWORD dtsegn_b720divZylP5 1 100 -120 119.996 FUNCTION_LIST DMDFON IF_DATA DIM_X 0x3834CC EXTERN WORD IF_DATA MCMESS 0x3834CC EXTERN /end MEASUREMENT
/begin MEASUREMENT fs71_08 "Filterwert Segmentabweichung, Betriebsbereich 71, Zylinder 8" UWORD dtsegn_b720divZylP5 1 100 -120 119.996 FUNCTION_LIST DMDFON IF_DATA DIM_X 0x3834FC EXTERN WORD IF_DATA MCMESS 0x3834FC EXTERN /end MEASUREMENT
/begin MEASUREMENT fs72_02 "Filterwert Segmentabweichung, Betriebsbereich 72, Zylinder 2" UWORD dtsegn_b720divZylP5 1 100 -120 119.996 FUNCTION_LIST DMDFON IF_DATA DIM_X 0x3833EC EXTERN WORD IF_DATA MCMESS 0x3833EC EXTERN /end MEASUREMENT
/begin MEASUREMENT fs72_03 "Filterwert Segmentabweichung, Betriebsbereich 72, Zylinder 3" UWORD dtsegn_b720divZylP5 1 100 -120 119.996 FUNCTION_LIST DMDFON IF_DATA DIM_X 0x38341C EXTERN WORD IF_DATA MCMESS 0x38341C EXTERN /end MEASUREMENT
/begin MEASUREMENT fs72_04 "Filterwert Segmentabweichung, Betriebsbereich 72, Zylinder 4" UWORD dtsegn_b720divZylP5 1 100 -120 119.996 FUNCTION_LIST DMDFON IF_DATA DIM_X 0x38344C EXTERN WORD IF_DATA MCMESS 0x38344C EXTERN /end MEASUREMENT
/begin MEASUREMENT fs72_05 "Filterwert Segmentabweichung, Betriebsbereich 72, Zylinder 5" UWORD dtsegn_b720divZylP5 1 100 -120 119.996 FUNCTION_LIST DMDFON IF_DATA DIM_X 0x38347C EXTERN WORD IF_DATA MCMESS 0x38347C EXTERN /end MEASUREMENT
/begin MEASUREMENT fs72_06 "Filterwert Segmentabweichung, Betriebsbereich 72, Zylinder 6" UWORD dtsegn_b720divZylP5 1 100 -120 119.996 FUNCTION_LIST DMDFON IF_DATA DIM_X 0x3834AC EXTERN WORD IF_DATA MCMESS 0x3834AC EXTERN /end MEASUREMENT
/begin MEASUREMENT fs72_07 "Filterwert Segmentabweichung, Betriebsbereich 72, Zylinder 7" UWORD dtsegn_b720divZylP5 1 100 -120 119.996 FUNCTION_LIST DMDFON IF_DATA DIM_X 0x3834DC EXTERN WORD IF_DATA MCMESS 0x3834DC EXTERN /end MEASUREMENT
/begin MEASUREMENT fs72_08 "Filterwert Segmentabweichung, Betriebsbereich 72, Zylinder 8" UWORD dtsegn_b720divZylP5 1 100 -120 119.996 FUNCTION_LIST DMDFON IF_DATA DIM_X 0x38350C EXTERN WORD IF_DATA MCMESS 0x38350C EXTERN /end MEASUREMENT
/begin MEASUREMENT fs73_02 "Filterwert Segmentabweichung, Betriebsbereich 73, Zylinder 2" UWORD dtsegn_b720divZylP5 1 100 -120 119.996 FUNCTION_LIST DMDFON IF_DATA DIM_X 0x3833FC EXTERN WORD IF_DATA MCMESS 0x3833FC EXTERN /end MEASUREMENT
/begin MEASUREMENT fs73_03 "Filterwert Segmentabweichung, Betriebsbereich 73, Zylinder 3" UWORD dtsegn_b720divZylP5 1 100 -120 119.996 FUNCTION_LIST DMDFON IF_DATA DIM_X 0x38342C EXTERN WORD IF_DATA MCMESS 0x38342C EXTERN /end MEASUREMENT
/begin MEASUREMENT fs73_04 "Filterwert Segmentabweichung, Betriebsbereich 73, Zylinder 4" UWORD dtsegn_b720divZylP5 1 100 -120 119.996 FUNCTION_LIST DMDFON IF_DATA DIM_X 0x38345C EXTERN WORD IF_DATA MCMESS 0x38345C EXTERN /end MEASUREMENT
/begin MEASUREMENT fs73_05 "Filterwert Segmentabweichung, Betriebsbereich 73, Zylinder 5" UWORD dtsegn_b720divZylP5 1 100 -120 119.996 FUNCTION_LIST DMDFON IF_DATA DIM_X 0x38348C EXTERN WORD IF_DATA MCMESS 0x38348C EXTERN /end MEASUREMENT
/begin MEASUREMENT fs73_06 "Filterwert Segmentabweichung, Betriebsbereich 73, Zylinder 6" UWORD dtsegn_b720divZylP5 1 100 -120 119.996 FUNCTION_LIST DMDFON IF_DATA DIM_X 0x3834BC EXTERN WORD IF_DATA MCMESS 0x3834BC EXTERN /end MEASUREMENT
/begin MEASUREMENT fs73_07 "Filterwert Segmentabweichung, Betriebsbereich 73, Zylinder 7" UWORD dtsegn_b720divZylP5 1 100 -120 119.996 FUNCTION_LIST DMDFON IF_DATA DIM_X 0x3834EC EXTERN WORD IF_DATA MCMESS 0x3834EC EXTERN /end MEASUREMENT
/begin MEASUREMENT fs73_08 "Filterwert Segmentabweichung, Betriebsbereich 73, Zylinder 8" UWORD dtsegn_b720divZylP5 1 100 -120 119.996 FUNCTION_LIST DMDFON IF_DATA DIM_X 0x38351C EXTERN WORD IF_DATA MCMESS 0x38351C EXTERN /end MEASUREMENT
/begin MEASUREMENT fs81_02 "Filterwert Segmentabweichung, Betriebsbereich 81, Zylinder 2" UWORD dtsegn_b720divZylP5 1 100 -120 119.996 FUNCTION_LIST DMDFON IF_DATA DIM_X 0x3833DE EXTERN WORD IF_DATA MCMESS 0x3833DE EXTERN /end MEASUREMENT
/begin MEASUREMENT fs81_03 "Filterwert Segmentabweichung, Betriebsbereich 81, Zylinder 3" UWORD dtsegn_b720divZylP5 1 100 -120 119.996 FUNCTION_LIST DMDFON IF_DATA DIM_X 0x38340E EXTERN WORD IF_DATA MCMESS 0x38340E EXTERN /end MEASUREMENT
/begin MEASUREMENT fs81_04 "Filterwert Segmentabweichung, Betriebsbereich 81, Zylinder 4" UWORD dtsegn_b720divZylP5 1 100 -120 119.996 FUNCTION_LIST DMDFON IF_DATA DIM_X 0x38343E EXTERN WORD IF_DATA MCMESS 0x38343E EXTERN /end MEASUREMENT
/begin MEASUREMENT fs81_05 "Filterwert Segmentabweichung, Betriebsbereich 81, Zylinder 5" UWORD dtsegn_b720divZylP5 1 100 -120 119.996 FUNCTION_LIST DMDFON IF_DATA DIM_X 0x38346E EXTERN WORD IF_DATA MCMESS 0x38346E EXTERN /end MEASUREMENT
/begin MEASUREMENT fs81_06 "Filterwert Segmentabweichung, Betriebsbereich 81, Zylinder 6" UWORD dtsegn_b720divZylP5 1 100 -120 119.996 FUNCTION_LIST DMDFON IF_DATA DIM_X 0x38349E EXTERN WORD IF_DATA MCMESS 0x38349E EXTERN /end MEASUREMENT
/begin MEASUREMENT fs81_07 "Filterwert Segmentabweichung, Betriebsbereich 81, Zylinder 7" UWORD dtsegn_b720divZylP5 1 100 -120 119.996 FUNCTION_LIST DMDFON IF_DATA DIM_X 0x3834CE EXTERN WORD IF_DATA MCMESS 0x3834CE EXTERN /end MEASUREMENT
/begin MEASUREMENT fs81_08 "Filterwert Segmentabweichung, Betriebsbereich 81, Zylinder 8" UWORD dtsegn_b720divZylP5 1 100 -120 119.996 FUNCTION_LIST DMDFON IF_DATA DIM_X 0x3834FE EXTERN WORD IF_DATA MCMESS 0x3834FE EXTERN /end MEASUREMENT
/begin MEASUREMENT fs82_02 "Filterwert Segmentabweichung, Betriebsbereich 82, Zylinder 2" UWORD dtsegn_b720divZylP5 1 100 -120 119.996 FUNCTION_LIST DMDFON IF_DATA DIM_X 0x3833EE EXTERN WORD IF_DATA MCMESS 0x3833EE EXTERN /end MEASUREMENT
/begin MEASUREMENT fs82_03 "Filterwert Segmentabweichung, Betriebsbereich 82, Zylinder 3" UWORD dtsegn_b720divZylP5 1 100 -120 119.996 FUNCTION_LIST DMDFON IF_DATA DIM_X 0x38341E EXTERN WORD IF_DATA MCMESS 0x38341E EXTERN /end MEASUREMENT
/begin MEASUREMENT fs82_04 "Filterwert Segmentabweichung, Betriebsbereich 82, Zylinder 4" UWORD dtsegn_b720divZylP5 1 100 -120 119.996 FUNCTION_LIST DMDFON IF_DATA DIM_X 0x38344E EXTERN WORD IF_DATA MCMESS 0x38344E EXTERN /end MEASUREMENT
/begin MEASUREMENT fs82_05 "Filterwert Segmentabweichung, Betriebsbereich 82, Zylinder 5" UWORD dtsegn_b720divZylP5 1 100 -120 119.996 FUNCTION_LIST DMDFON IF_DATA DIM_X 0x38347E EXTERN WORD IF_DATA MCMESS 0x38347E EXTERN /end MEASUREMENT
/begin MEASUREMENT fs82_06 "Filterwert Segmentabweichung, Betriebsbereich 82, Zylinder 6" UWORD dtsegn_b720divZylP5 1 100 -120 119.996 FUNCTION_LIST DMDFON IF_DATA DIM_X 0x3834AE EXTERN WORD IF_DATA MCMESS 0x3834AE EXTERN /end MEASUREMENT
/begin MEASUREMENT fs82_07 "Filterwert Segmentabweichung, Betriebsbereich 82, Zylinder 7" UWORD dtsegn_b720divZylP5 1 100 -120 119.996 FUNCTION_LIST DMDFON IF_DATA DIM_X 0x3834DE EXTERN WORD IF_DATA MCMESS 0x3834DE EXTERN /end MEASUREMENT
/begin MEASUREMENT fs82_08 "Filterwert Segmentabweichung, Betriebsbereich 82, Zylinder 8" UWORD dtsegn_b720divZylP5 1 100 -120 119.996 FUNCTION_LIST DMDFON IF_DATA DIM_X 0x38350E EXTERN WORD IF_DATA MCMESS 0x38350E EXTERN /end MEASUREMENT
/begin MEASUREMENT fs83_02 "Filterwert Segmentabweichung, Betriebsbereich 83, Zylinder 2" UWORD dtsegn_b720divZylP5 1 100 -120 119.996 FUNCTION_LIST DMDFON IF_DATA DIM_X 0x3833FE EXTERN WORD IF_DATA MCMESS 0x3833FE EXTERN /end MEASUREMENT
/begin MEASUREMENT fs83_03 "Filterwert Segmentabweichung, Betriebsbereich 83, Zylinder 3" UWORD dtsegn_b720divZylP5 1 100 -120 119.996 FUNCTION_LIST DMDFON IF_DATA DIM_X 0x38342E EXTERN WORD IF_DATA MCMESS 0x38342E EXTERN /end MEASUREMENT
/begin MEASUREMENT fs83_04 "Filterwert Segmentabweichung, Betriebsbereich 83, Zylinder 4" UWORD dtsegn_b720divZylP5 1 100 -120 119.996 FUNCTION_LIST DMDFON IF_DATA DIM_X 0x38345E EXTERN WORD IF_DATA MCMESS 0x38345E EXTERN /end MEASUREMENT
/begin MEASUREMENT fs83_05 "Filterwert Segmentabweichung, Betriebsbereich 83, Zylinder 5" UWORD dtsegn_b720divZylP5 1 100 -120 119.996 FUNCTION_LIST DMDFON IF_DATA DIM_X 0x38348E EXTERN WORD IF_DATA MCMESS 0x38348E EXTERN /end MEASUREMENT
/begin MEASUREMENT fs83_06 "Filterwert Segmentabweichung, Betriebsbereich 83, Zylinder 6" UWORD dtsegn_b720divZylP5 1 100 -120 119.996 FUNCTION_LIST DMDFON IF_DATA DIM_X 0x3834BE EXTERN WORD IF_DATA MCMESS 0x3834BE EXTERN /end MEASUREMENT
/begin MEASUREMENT fs83_07 "Filterwert Segmentabweichung, Betriebsbereich 83, Zylinder 7" UWORD dtsegn_b720divZylP5 1 100 -120 119.996 FUNCTION_LIST DMDFON IF_DATA DIM_X 0x3834EE EXTERN WORD IF_DATA MCMESS 0x3834EE EXTERN /end MEASUREMENT
/begin MEASUREMENT fs83_08 "Filterwert Segmentabweichung, Betriebsbereich 83, Zylinder 8" UWORD dtsegn_b720divZylP5 1 100 -120 119.996 FUNCTION_LIST DMDFON IF_DATA DIM_X 0x38351E EXTERN WORD IF_DATA MCMESS 0x38351E EXTERN /end MEASUREMENT
/begin MEASUREMENT fsalunkh "Faktor Korrektur Nullastausblendung bei Katheizen" UBYTE fak_ub_b2 1 100 0 1.99219 FUNCTION_LIST DMDSTP IF_DATA DIM_X 0x38096F EXTERN WORD IF_DATA MCMESS 0x38096F EXTERN /end MEASUREMENT
/begin MEASUREMENT fse "aktueller Filterwert Segmentabweichung, zur Segmentzeit-Korrektur" SBYTE dtsegn_b11p25divZyl 1 100 -1.875 1.86035 FUNCTION_LIST DMDFON IF_DATA DIM_X 0x3809AB EXTERN WORD IF_DATA MCMESS 0x3809AB EXTERN /end MEASUREMENT
/begin MEASUREMENT fse11_02 "Filterwert Segmentabweichung, eingerechnet" UBYTE dtsegno_b11p25divZyl 1 100 -1.875 1.86035 FUNCTION_LIST DMDFON IF_DATA DIM_X 0x382F18 EXTERN WORD IF_DATA MCMESS 0x382F18 EXTERN /end MEASUREMENT
/begin MEASUREMENT fse11_03 "Filterwert Segmentabweichung, eingerechnet" UBYTE dtsegno_b11p25divZyl 1 100 -1.875 1.86035 FUNCTION_LIST DMDFON IF_DATA DIM_X 0x382F30 EXTERN WORD IF_DATA MCMESS 0x382F30 EXTERN /end MEASUREMENT
/begin MEASUREMENT fse11_04 "Filterwert Segmentabweichung, eingerechnet" UBYTE dtsegno_b11p25divZyl 1 100 -1.875 1.86035 FUNCTION_LIST DMDFON IF_DATA DIM_X 0x382F48 EXTERN WORD IF_DATA MCMESS 0x382F48 EXTERN /end MEASUREMENT
/begin MEASUREMENT fse11_05 "Filterwert Segmentabweichung, eingerechnet" UBYTE dtsegno_b11p25divZyl 1 100 -1.875 1.86035 FUNCTION_LIST DMDFON IF_DATA DIM_X 0x382F60 EXTERN WORD IF_DATA MCMESS 0x382F60 EXTERN /end MEASUREMENT
/begin MEASUREMENT fse11_06 "Filterwert Segmentabweichung, eingerechnet" UBYTE dtsegno_b11p25divZyl 1 100 -1.875 1.86035 FUNCTION_LIST DMDFON IF_DATA DIM_X 0x382F78 EXTERN WORD IF_DATA MCMESS 0x382F78 EXTERN /end MEASUREMENT
/begin MEASUREMENT fse11_07 "Filterwert Segmentabweichung, eingerechnet" UBYTE dtsegno_b11p25divZyl 1 100 -1.875 1.86035 FUNCTION_LIST DMDFON IF_DATA DIM_X 0x382F90 EXTERN WORD IF_DATA MCMESS 0x382F90 EXTERN /end MEASUREMENT
/begin MEASUREMENT fse11_08 "Filterwert Segmentabweichung, eingerechnet" UBYTE dtsegno_b11p25divZyl 1 100 -1.875 1.86035 FUNCTION_LIST DMDFON IF_DATA DIM_X 0x382FA8 EXTERN WORD IF_DATA MCMESS 0x382FA8 EXTERN /end MEASUREMENT
/begin MEASUREMENT fse12_02 "Filterwert Segmentabweichung, eingerechnet" UBYTE dtsegno_b11p25divZyl 1 100 -1.875 1.86035 FUNCTION_LIST DMDFON IF_DATA DIM_X 0x382F20 EXTERN WORD IF_DATA MCMESS 0x382F20 EXTERN /end MEASUREMENT
/begin MEASUREMENT fse12_03 "Filterwert Segmentabweichung, eingerechnet" UBYTE dtsegno_b11p25divZyl 1 100 -1.875 1.86035 FUNCTION_LIST DMDFON IF_DATA DIM_X 0x382F38 EXTERN WORD IF_DATA MCMESS 0x382F38 EXTERN /end MEASUREMENT
/begin MEASUREMENT fse12_04 "Filterwert Segmentabweichung, eingerechnet" UBYTE dtsegno_b11p25divZyl 1 100 -1.875 1.86035 FUNCTION_LIST DMDFON IF_DATA DIM_X 0x382F50 EXTERN WORD IF_DATA MCMESS 0x382F50 EXTERN /end MEASUREMENT
/begin MEASUREMENT fse12_05 "Filterwert Segmentabweichung, eingerechnet" UBYTE dtsegno_b11p25divZyl 1 100 -1.875 1.86035 FUNCTION_LIST DMDFON IF_DATA DIM_X 0x382F68 EXTERN WORD IF_DATA MCMESS 0x382F68 EXTERN /end MEASUREMENT
/begin MEASUREMENT fse12_06 "Filterwert Segmentabweichung, eingerechnet" UBYTE dtsegno_b11p25divZyl 1 100 -1.875 1.86035 FUNCTION_LIST DMDFON IF_DATA DIM_X 0x382F80 EXTERN WORD IF_DATA MCMESS 0x382F80 EXTERN /end MEASUREMENT
/begin MEASUREMENT fse12_07 "Filterwert Segmentabweichung, eingerechnet" UBYTE dtsegno_b11p25divZyl 1 100 -1.875 1.86035 FUNCTION_LIST DMDFON IF_DATA DIM_X 0x382F98 EXTERN WORD IF_DATA MCMESS 0x382F98 EXTERN /end MEASUREMENT
/begin MEASUREMENT fse12_08 "Filterwert Segmentabweichung, eingerechnet" UBYTE dtsegno_b11p25divZyl 1 100 -1.875 1.86035 FUNCTION_LIST DMDFON IF_DATA DIM_X 0x382FB0 EXTERN WORD IF_DATA MCMESS 0x382FB0 EXTERN /end MEASUREMENT
/begin MEASUREMENT fse13_02 "Filterwert Segmentabweichung, eingerechnet" UBYTE dtsegno_b11p25divZyl 1 100 -1.875 1.86035 FUNCTION_LIST DMDFON IF_DATA DIM_X 0x382F28 EXTERN WORD IF_DATA MCMESS 0x382F28 EXTERN /end MEASUREMENT
/begin MEASUREMENT fse13_03 "Filterwert Segmentabweichung, eingerechnet" UBYTE dtsegno_b11p25divZyl 1 100 -1.875 1.86035 FUNCTION_LIST DMDFON IF_DATA DIM_X 0x382F40 EXTERN WORD IF_DATA MCMESS 0x382F40 EXTERN /end MEASUREMENT
/begin MEASUREMENT fse13_04 "Filterwert Segmentabweichung, eingerechnet" UBYTE dtsegno_b11p25divZyl 1 100 -1.875 1.86035 FUNCTION_LIST DMDFON IF_DATA DIM_X 0x382F58 EXTERN WORD IF_DATA MCMESS 0x382F58 EXTERN /end MEASUREMENT
/begin MEASUREMENT fse13_05 "Filterwert Segmentabweichung, eingerechnet" UBYTE dtsegno_b11p25divZyl 1 100 -1.875 1.86035 FUNCTION_LIST DMDFON IF_DATA DIM_X 0x382F70 EXTERN WORD IF_DATA MCMESS 0x382F70 EXTERN /end MEASUREMENT
/begin MEASUREMENT fse13_06 "Filterwert Segmentabweichung, eingerechnet" UBYTE dtsegno_b11p25divZyl 1 100 -1.875 1.86035 FUNCTION_LIST DMDFON IF_DATA DIM_X 0x382F88 EXTERN WORD IF_DATA MCMESS 0x382F88 EXTERN /end MEASUREMENT
/begin MEASUREMENT fse13_07 "Filterwert Segmentabweichung, eingerechnet" UBYTE dtsegno_b11p25divZyl 1 100 -1.875 1.86035 FUNCTION_LIST DMDFON IF_DATA DIM_X 0x382FA0 EXTERN WORD IF_DATA MCMESS 0x382FA0 EXTERN /end MEASUREMENT
/begin MEASUREMENT fse13_08 "Filterwert Segmentabweichung, eingerechnet" UBYTE dtsegno_b11p25divZyl 1 100 -1.875 1.86035 FUNCTION_LIST DMDFON IF_DATA DIM_X 0x382FB8 EXTERN WORD IF_DATA MCMESS 0x382FB8 EXTERN /end MEASUREMENT
/begin MEASUREMENT fse21_02 "Filterwert Segmentabweichung, eingerechnet" UBYTE dtsegno_b11p25divZyl 1 100 -1.875 1.86035 FUNCTION_LIST DMDFON IF_DATA DIM_X 0x382F19 EXTERN WORD IF_DATA MCMESS 0x382F19 EXTERN /end MEASUREMENT
/begin MEASUREMENT fse21_03 "Filterwert Segmentabweichung, eingerechnet" UBYTE dtsegno_b11p25divZyl 1 100 -1.875 1.86035 FUNCTION_LIST DMDFON IF_DATA DIM_X 0x382F31 EXTERN WORD IF_DATA MCMESS 0x382F31 EXTERN /end MEASUREMENT
/begin MEASUREMENT fse21_04 "Filterwert Segmentabweichung, eingerechnet" UBYTE dtsegno_b11p25divZyl 1 100 -1.875 1.86035 FUNCTION_LIST DMDFON IF_DATA DIM_X 0x382F49 EXTERN WORD IF_DATA MCMESS 0x382F49 EXTERN /end MEASUREMENT
/begin MEASUREMENT fse21_05 "Filterwert Segmentabweichung, eingerechnet" UBYTE dtsegno_b11p25divZyl 1 100 -1.875 1.86035 FUNCTION_LIST DMDFON IF_DATA DIM_X 0x382F61 EXTERN WORD IF_DATA MCMESS 0x382F61 EXTERN /end MEASUREMENT
/begin MEASUREMENT fse21_06 "Filterwert Segmentabweichung, eingerechnet" UBYTE dtsegno_b11p25divZyl 1 100 -1.875 1.86035 FUNCTION_LIST DMDFON IF_DATA DIM_X 0x382F79 EXTERN WORD IF_DATA MCMESS 0x382F79 EXTERN /end MEASUREMENT
/begin MEASUREMENT fse21_07 "Filterwert Segmentabweichung, eingerechnet" UBYTE dtsegno_b11p25divZyl 1 100 -1.875 1.86035 FUNCTION_LIST DMDFON IF_DATA DIM_X 0x382F91 EXTERN WORD IF_DATA MCMESS 0x382F91 EXTERN /end MEASUREMENT
/begin MEASUREMENT fse21_08 "Filterwert Segmentabweichung, eingerechnet" UBYTE dtsegno_b11p25divZyl 1 100 -1.875 1.86035 FUNCTION_LIST DMDFON IF_DATA DIM_X 0x382FA9 EXTERN WORD IF_DATA MCMESS 0x382FA9 EXTERN /end MEASUREMENT
/begin MEASUREMENT fse22_02 "Filterwert Segmentabweichung, eingerechnet" UBYTE dtsegno_b11p25divZyl 1 100 -1.875 1.86035 FUNCTION_LIST DMDFON IF_DATA DIM_X 0x382F21 EXTERN WORD IF_DATA MCMESS 0x382F21 EXTERN /end MEASUREMENT
/begin MEASUREMENT fse22_03 "Filterwert Segmentabweichung, eingerechnet" UBYTE dtsegno_b11p25divZyl 1 100 -1.875 1.86035 FUNCTION_LIST DMDFON IF_DATA DIM_X 0x382F39 EXTERN WORD IF_DATA MCMESS 0x382F39 EXTERN /end MEASUREMENT
/begin MEASUREMENT fse22_04 "Filterwert Segmentabweichung, eingerechnet" UBYTE dtsegno_b11p25divZyl 1 100 -1.875 1.86035 FUNCTION_LIST DMDFON IF_DATA DIM_X 0x382F51 EXTERN WORD IF_DATA MCMESS 0x382F51 EXTERN /end MEASUREMENT
/begin MEASUREMENT fse22_05 "Filterwert Segmentabweichung, eingerechnet" UBYTE dtsegno_b11p25divZyl 1 100 -1.875 1.86035 FUNCTION_LIST DMDFON IF_DATA DIM_X 0x382F69 EXTERN WORD IF_DATA MCMESS 0x382F69 EXTERN /end MEASUREMENT
/begin MEASUREMENT fse22_06 "Filterwert Segmentabweichung, eingerechnet" UBYTE dtsegno_b11p25divZyl 1 100 -1.875 1.86035 FUNCTION_LIST DMDFON IF_DATA DIM_X 0x382F81 EXTERN WORD IF_DATA MCMESS 0x382F81 EXTERN /end MEASUREMENT
/begin MEASUREMENT fse22_07 "Filterwert Segmentabweichung, eingerechnet" UBYTE dtsegno_b11p25divZyl 1 100 -1.875 1.86035 FUNCTION_LIST DMDFON IF_DATA DIM_X 0x382F99 EXTERN WORD IF_DATA MCMESS 0x382F99 EXTERN /end MEASUREMENT
/begin MEASUREMENT fse22_08 "Filterwert Segmentabweichung, eingerechnet" UBYTE dtsegno_b11p25divZyl 1 100 -1.875 1.86035 FUNCTION_LIST DMDFON IF_DATA DIM_X 0x382FB1 EXTERN WORD IF_DATA MCMESS 0x382FB1 EXTERN /end MEASUREMENT
/begin MEASUREMENT fse23_02 "Filterwert Segmentabweichung, eingerechnet" UBYTE dtsegno_b11p25divZyl 1 100 -1.875 1.86035 FUNCTION_LIST DMDFON IF_DATA DIM_X 0x382F29 EXTERN WORD IF_DATA MCMESS 0x382F29 EXTERN /end MEASUREMENT
/begin MEASUREMENT fse23_03 "Filterwert Segmentabweichung, eingerechnet" UBYTE dtsegno_b11p25divZyl 1 100 -1.875 1.86035 FUNCTION_LIST DMDFON IF_DATA DIM_X 0x382F41 EXTERN WORD IF_DATA MCMESS 0x382F41 EXTERN /end MEASUREMENT
/begin MEASUREMENT fse23_04 "Filterwert Segmentabweichung, eingerechnet" UBYTE dtsegno_b11p25divZyl 1 100 -1.875 1.86035 FUNCTION_LIST DMDFON IF_DATA DIM_X 0x382F59 EXTERN WORD IF_DATA MCMESS 0x382F59 EXTERN /end MEASUREMENT
/begin MEASUREMENT fse23_05 "Filterwert Segmentabweichung, eingerechnet" UBYTE dtsegno_b11p25divZyl 1 100 -1.875 1.86035 FUNCTION_LIST DMDFON IF_DATA DIM_X 0x382F71 EXTERN WORD IF_DATA MCMESS 0x382F71 EXTERN /end MEASUREMENT
/begin MEASUREMENT fse23_06 "Filterwert Segmentabweichung, eingerechnet" UBYTE dtsegno_b11p25divZyl 1 100 -1.875 1.86035 FUNCTION_LIST DMDFON IF_DATA DIM_X 0x382F89 EXTERN WORD IF_DATA MCMESS 0x382F89 EXTERN /end MEASUREMENT
/begin MEASUREMENT fse23_07 "Filterwert Segmentabweichung, eingerechnet" UBYTE dtsegno_b11p25divZyl 1 100 -1.875 1.86035 FUNCTION_LIST DMDFON IF_DATA DIM_X 0x382FA1 EXTERN WORD IF_DATA MCMESS 0x382FA1 EXTERN /end MEASUREMENT
/begin MEASUREMENT fse23_08 "Filterwert Segmentabweichung, eingerechnet" UBYTE dtsegno_b11p25divZyl 1 100 -1.875 1.86035 FUNCTION_LIST DMDFON IF_DATA DIM_X 0x382FB9 EXTERN WORD IF_DATA MCMESS 0x382FB9 EXTERN /end MEASUREMENT
/begin MEASUREMENT fse31_02 "Filterwert Segmentabweichung, eingerechnet" UBYTE dtsegno_b11p25divZyl 1 100 -1.875 1.86035 FUNCTION_LIST DMDFON IF_DATA DIM_X 0x382F1A EXTERN WORD IF_DATA MCMESS 0x382F1A EXTERN /end MEASUREMENT
/begin MEASUREMENT fse31_03 "Filterwert Segmentabweichung, eingerechnet" UBYTE dtsegno_b11p25divZyl 1 100 -1.875 1.86035 FUNCTION_LIST DMDFON IF_DATA DIM_X 0x382F32 EXTERN WORD IF_DATA MCMESS 0x382F32 EXTERN /end MEASUREMENT
/begin MEASUREMENT fse31_04 "Filterwert Segmentabweichung, eingerechnet" UBYTE dtsegno_b11p25divZyl 1 100 -1.875 1.86035 FUNCTION_LIST DMDFON IF_DATA DIM_X 0x382F4A EXTERN WORD IF_DATA MCMESS 0x382F4A EXTERN /end MEASUREMENT
/begin MEASUREMENT fse31_05 "Filterwert Segmentabweichung, eingerechnet" UBYTE dtsegno_b11p25divZyl 1 100 -1.875 1.86035 FUNCTION_LIST DMDFON IF_DATA DIM_X 0x382F62 EXTERN WORD IF_DATA MCMESS 0x382F62 EXTERN /end MEASUREMENT
/begin MEASUREMENT fse31_06 "Filterwert Segmentabweichung, eingerechnet" UBYTE dtsegno_b11p25divZyl 1 100 -1.875 1.86035 FUNCTION_LIST DMDFON IF_DATA DIM_X 0x382F7A EXTERN WORD IF_DATA MCMESS 0x382F7A EXTERN /end MEASUREMENT
/begin MEASUREMENT fse31_07 "Filterwert Segmentabweichung, eingerechnet" UBYTE dtsegno_b11p25divZyl 1 100 -1.875 1.86035 FUNCTION_LIST DMDFON IF_DATA DIM_X 0x382F92 EXTERN WORD IF_DATA MCMESS 0x382F92 EXTERN /end MEASUREMENT
/begin MEASUREMENT fse31_08 "Filterwert Segmentabweichung, eingerechnet" UBYTE dtsegno_b11p25divZyl 1 100 -1.875 1.86035 FUNCTION_LIST DMDFON IF_DATA DIM_X 0x382FAA EXTERN WORD IF_DATA MCMESS 0x382FAA EXTERN /end MEASUREMENT
/begin MEASUREMENT fse32_02 "Filterwert Segmentabweichung, eingerechnet" UBYTE dtsegno_b11p25divZyl 1 100 -1.875 1.86035 FUNCTION_LIST DMDFON IF_DATA DIM_X 0x382F22 EXTERN WORD IF_DATA MCMESS 0x382F22 EXTERN /end MEASUREMENT
/begin MEASUREMENT fse32_03 "Filterwert Segmentabweichung, eingerechnet" UBYTE dtsegno_b11p25divZyl 1 100 -1.875 1.86035 FUNCTION_LIST DMDFON IF_DATA DIM_X 0x382F3A EXTERN WORD IF_DATA MCMESS 0x382F3A EXTERN /end MEASUREMENT
/begin MEASUREMENT fse32_04 "Filterwert Segmentabweichung, eingerechnet" UBYTE dtsegno_b11p25divZyl 1 100 -1.875 1.86035 FUNCTION_LIST DMDFON IF_DATA DIM_X 0x382F52 EXTERN WORD IF_DATA MCMESS 0x382F52 EXTERN /end MEASUREMENT
/begin MEASUREMENT fse32_05 "Filterwert Segmentabweichung, eingerechnet" UBYTE dtsegno_b11p25divZyl 1 100 -1.875 1.86035 FUNCTION_LIST DMDFON IF_DATA DIM_X 0x382F6A EXTERN WORD IF_DATA MCMESS 0x382F6A EXTERN /end MEASUREMENT
/begin MEASUREMENT fse32_06 "Filterwert Segmentabweichung, eingerechnet" UBYTE dtsegno_b11p25divZyl 1 100 -1.875 1.86035 FUNCTION_LIST DMDFON IF_DATA DIM_X 0x382F82 EXTERN WORD IF_DATA MCMESS 0x382F82 EXTERN /end MEASUREMENT
/begin MEASUREMENT fse32_07 "Filterwert Segmentabweichung, eingerechnet" UBYTE dtsegno_b11p25divZyl 1 100 -1.875 1.86035 FUNCTION_LIST DMDFON IF_DATA DIM_X 0x382F9A EXTERN WORD IF_DATA MCMESS 0x382F9A EXTERN /end MEASUREMENT
/begin MEASUREMENT fse32_08 "Filterwert Segmentabweichung, eingerechnet" UBYTE dtsegno_b11p25divZyl 1 100 -1.875 1.86035 FUNCTION_LIST DMDFON IF_DATA DIM_X 0x382FB2 EXTERN WORD IF_DATA MCMESS 0x382FB2 EXTERN /end MEASUREMENT
/begin MEASUREMENT fse33_02 "Filterwert Segmentabweichung, eingerechnet" UBYTE dtsegno_b11p25divZyl 1 100 -1.875 1.86035 FUNCTION_LIST DMDFON IF_DATA DIM_X 0x382F2A EXTERN WORD IF_DATA MCMESS 0x382F2A EXTERN /end MEASUREMENT
/begin MEASUREMENT fse33_03 "Filterwert Segmentabweichung, eingerechnet" UBYTE dtsegno_b11p25divZyl 1 100 -1.875 1.86035 FUNCTION_LIST DMDFON IF_DATA DIM_X 0x382F42 EXTERN WORD IF_DATA MCMESS 0x382F42 EXTERN /end MEASUREMENT
/begin MEASUREMENT fse33_04 "Filterwert Segmentabweichung, eingerechnet" UBYTE dtsegno_b11p25divZyl 1 100 -1.875 1.86035 FUNCTION_LIST DMDFON IF_DATA DIM_X 0x382F5A EXTERN WORD IF_DATA MCMESS 0x382F5A EXTERN /end MEASUREMENT
/begin MEASUREMENT fse33_05 "Filterwert Segmentabweichung, eingerechnet" UBYTE dtsegno_b11p25divZyl 1 100 -1.875 1.86035 FUNCTION_LIST DMDFON IF_DATA DIM_X 0x382F72 EXTERN WORD IF_DATA MCMESS 0x382F72 EXTERN /end MEASUREMENT
/begin MEASUREMENT fse33_06 "Filterwert Segmentabweichung, eingerechnet" UBYTE dtsegno_b11p25divZyl 1 100 -1.875 1.86035 FUNCTION_LIST DMDFON IF_DATA DIM_X 0x382F8A EXTERN WORD IF_DATA MCMESS 0x382F8A EXTERN /end MEASUREMENT
/begin MEASUREMENT fse33_07 "Filterwert Segmentabweichung, eingerechnet" UBYTE dtsegno_b11p25divZyl 1 100 -1.875 1.86035 FUNCTION_LIST DMDFON IF_DATA DIM_X 0x382FA2 EXTERN WORD IF_DATA MCMESS 0x382FA2 EXTERN /end MEASUREMENT
/begin MEASUREMENT fse33_08 "Filterwert Segmentabweichung, eingerechnet" UBYTE dtsegno_b11p25divZyl 1 100 -1.875 1.86035 FUNCTION_LIST DMDFON IF_DATA DIM_X 0x382FBA EXTERN WORD IF_DATA MCMESS 0x382FBA EXTERN /end MEASUREMENT
/begin MEASUREMENT fse41_02 "Filterwert Segmentabweichung, eingerechnet" UBYTE dtsegno_b11p25divZyl 1 100 -1.875 1.86035 FUNCTION_LIST DMDFON IF_DATA DIM_X 0x382F1B EXTERN WORD IF_DATA MCMESS 0x382F1B EXTERN /end MEASUREMENT
/begin MEASUREMENT fse41_03 "Filterwert Segmentabweichung, eingerechnet" UBYTE dtsegno_b11p25divZyl 1 100 -1.875 1.86035 FUNCTION_LIST DMDFON IF_DATA DIM_X 0x382F33 EXTERN WORD IF_DATA MCMESS 0x382F33 EXTERN /end MEASUREMENT
/begin MEASUREMENT fse41_04 "Filterwert Segmentabweichung, eingerechnet" UBYTE dtsegno_b11p25divZyl 1 100 -1.875 1.86035 FUNCTION_LIST DMDFON IF_DATA DIM_X 0x382F4B EXTERN WORD IF_DATA MCMESS 0x382F4B EXTERN /end MEASUREMENT
/begin MEASUREMENT fse41_05 "Filterwert Segmentabweichung, eingerechnet" UBYTE dtsegno_b11p25divZyl 1 100 -1.875 1.86035 FUNCTION_LIST DMDFON IF_DATA DIM_X 0x382F63 EXTERN WORD IF_DATA MCMESS 0x382F63 EXTERN /end MEASUREMENT
/begin MEASUREMENT fse41_06 "Filterwert Segmentabweichung, eingerechnet" UBYTE dtsegno_b11p25divZyl 1 100 -1.875 1.86035 FUNCTION_LIST DMDFON IF_DATA DIM_X 0x382F7B EXTERN WORD IF_DATA MCMESS 0x382F7B EXTERN /end MEASUREMENT
/begin MEASUREMENT fse41_07 "Filterwert Segmentabweichung, eingerechnet" UBYTE dtsegno_b11p25divZyl 1 100 -1.875 1.86035 FUNCTION_LIST DMDFON IF_DATA DIM_X 0x382F93 EXTERN WORD IF_DATA MCMESS 0x382F93 EXTERN /end MEASUREMENT
/begin MEASUREMENT fse41_08 "Filterwert Segmentabweichung, eingerechnet" UBYTE dtsegno_b11p25divZyl 1 100 -1.875 1.86035 FUNCTION_LIST DMDFON IF_DATA DIM_X 0x382FAB EXTERN WORD IF_DATA MCMESS 0x382FAB EXTERN /end MEASUREMENT
/begin MEASUREMENT fse42_02 "Filterwert Segmentabweichung, eingerechnet" UBYTE dtsegno_b11p25divZyl 1 100 -1.875 1.86035 FUNCTION_LIST DMDFON IF_DATA DIM_X 0x382F23 EXTERN WORD IF_DATA MCMESS 0x382F23 EXTERN /end MEASUREMENT
/begin MEASUREMENT fse42_03 "Filterwert Segmentabweichung, eingerechnet" UBYTE dtsegno_b11p25divZyl 1 100 -1.875 1.86035 FUNCTION_LIST DMDFON IF_DATA DIM_X 0x382F3B EXTERN WORD IF_DATA MCMESS 0x382F3B EXTERN /end MEASUREMENT
/begin MEASUREMENT fse42_04 "Filterwert Segmentabweichung, eingerechnet" UBYTE dtsegno_b11p25divZyl 1 100 -1.875 1.86035 FUNCTION_LIST DMDFON IF_DATA DIM_X 0x382F53 EXTERN WORD IF_DATA MCMESS 0x382F53 EXTERN /end MEASUREMENT
/begin MEASUREMENT fse42_05 "Filterwert Segmentabweichung, eingerechnet" UBYTE dtsegno_b11p25divZyl 1 100 -1.875 1.86035 FUNCTION_LIST DMDFON IF_DATA DIM_X 0x382F6B EXTERN WORD IF_DATA MCMESS 0x382F6B EXTERN /end MEASUREMENT
/begin MEASUREMENT fse42_06 "Filterwert Segmentabweichung, eingerechnet" UBYTE dtsegno_b11p25divZyl 1 100 -1.875 1.86035 FUNCTION_LIST DMDFON IF_DATA DIM_X 0x382F83 EXTERN WORD IF_DATA MCMESS 0x382F83 EXTERN /end MEASUREMENT
/begin MEASUREMENT fse42_07 "Filterwert Segmentabweichung, eingerechnet" UBYTE dtsegno_b11p25divZyl 1 100 -1.875 1.86035 FUNCTION_LIST DMDFON IF_DATA DIM_X 0x382F9B EXTERN WORD IF_DATA MCMESS 0x382F9B EXTERN /end MEASUREMENT
/begin MEASUREMENT fse42_08 "Filterwert Segmentabweichung, eingerechnet" UBYTE dtsegno_b11p25divZyl 1 100 -1.875 1.86035 FUNCTION_LIST DMDFON IF_DATA DIM_X 0x382FB3 EXTERN WORD IF_DATA MCMESS 0x382FB3 EXTERN /end MEASUREMENT
/begin MEASUREMENT fse43_02 "Filterwert Segmentabweichung, eingerechnet" UBYTE dtsegno_b11p25divZyl 1 100 -1.875 1.86035 FUNCTION_LIST DMDFON IF_DATA DIM_X 0x382F2B EXTERN WORD IF_DATA MCMESS 0x382F2B EXTERN /end MEASUREMENT
/begin MEASUREMENT fse43_03 "Filterwert Segmentabweichung, eingerechnet" UBYTE dtsegno_b11p25divZyl 1 100 -1.875 1.86035 FUNCTION_LIST DMDFON IF_DATA DIM_X 0x382F43 EXTERN WORD IF_DATA MCMESS 0x382F43 EXTERN /end MEASUREMENT
/begin MEASUREMENT fse43_04 "Filterwert Segmentabweichung, eingerechnet" UBYTE dtsegno_b11p25divZyl 1 100 -1.875 1.86035 FUNCTION_LIST DMDFON IF_DATA DIM_X 0x382F5B EXTERN WORD IF_DATA MCMESS 0x382F5B EXTERN /end MEASUREMENT
/begin MEASUREMENT fse43_05 "Filterwert Segmentabweichung, eingerechnet" UBYTE dtsegno_b11p25divZyl 1 100 -1.875 1.86035 FUNCTION_LIST DMDFON IF_DATA DIM_X 0x382F73 EXTERN WORD IF_DATA MCMESS 0x382F73 EXTERN /end MEASUREMENT
/begin MEASUREMENT fse43_06 "Filterwert Segmentabweichung, eingerechnet" UBYTE dtsegno_b11p25divZyl 1 100 -1.875 1.86035 FUNCTION_LIST DMDFON IF_DATA DIM_X 0x382F8B EXTERN WORD IF_DATA MCMESS 0x382F8B EXTERN /end MEASUREMENT
/begin MEASUREMENT fse43_07 "Filterwert Segmentabweichung, eingerechnet" UBYTE dtsegno_b11p25divZyl 1 100 -1.875 1.86035 FUNCTION_LIST DMDFON IF_DATA DIM_X 0x382FA3 EXTERN WORD IF_DATA MCMESS 0x382FA3 EXTERN /end MEASUREMENT
/begin MEASUREMENT fse43_08 "Filterwert Segmentabweichung, eingerechnet" UBYTE dtsegno_b11p25divZyl 1 100 -1.875 1.86035 FUNCTION_LIST DMDFON IF_DATA DIM_X 0x382FBB EXTERN WORD IF_DATA MCMESS 0x382FBB EXTERN /end MEASUREMENT
/begin MEASUREMENT fse51_02 "Filterwert Segmentabweichung, eingerechnet" UBYTE dtsegno_b11p25divZyl 1 100 -1.875 1.86035 FUNCTION_LIST DMDFON IF_DATA DIM_X 0x382F1C EXTERN WORD IF_DATA MCMESS 0x382F1C EXTERN /end MEASUREMENT
/begin MEASUREMENT fse51_03 "Filterwert Segmentabweichung, eingerechnet" UBYTE dtsegno_b11p25divZyl 1 100 -1.875 1.86035 FUNCTION_LIST DMDFON IF_DATA DIM_X 0x382F34 EXTERN WORD IF_DATA MCMESS 0x382F34 EXTERN /end MEASUREMENT
/begin MEASUREMENT fse51_04 "Filterwert Segmentabweichung, eingerechnet" UBYTE dtsegno_b11p25divZyl 1 100 -1.875 1.86035 FUNCTION_LIST DMDFON IF_DATA DIM_X 0x382F4C EXTERN WORD IF_DATA MCMESS 0x382F4C EXTERN /end MEASUREMENT
/begin MEASUREMENT fse51_05 "Filterwert Segmentabweichung, eingerechnet" UBYTE dtsegno_b11p25divZyl 1 100 -1.875 1.86035 FUNCTION_LIST DMDFON IF_DATA DIM_X 0x382F64 EXTERN WORD IF_DATA MCMESS 0x382F64 EXTERN /end MEASUREMENT
/begin MEASUREMENT fse51_06 "Filterwert Segmentabweichung, eingerechnet" UBYTE dtsegno_b11p25divZyl 1 100 -1.875 1.86035 FUNCTION_LIST DMDFON IF_DATA DIM_X 0x382F7C EXTERN WORD IF_DATA MCMESS 0x382F7C EXTERN /end MEASUREMENT
/begin MEASUREMENT fse51_07 "Filterwert Segmentabweichung, eingerechnet" UBYTE dtsegno_b11p25divZyl 1 100 -1.875 1.86035 FUNCTION_LIST DMDFON IF_DATA DIM_X 0x382F94 EXTERN WORD IF_DATA MCMESS 0x382F94 EXTERN /end MEASUREMENT
/begin MEASUREMENT fse51_08 "Filterwert Segmentabweichung, eingerechnet" UBYTE dtsegno_b11p25divZyl 1 100 -1.875 1.86035 FUNCTION_LIST DMDFON IF_DATA DIM_X 0x382FAC EXTERN WORD IF_DATA MCMESS 0x382FAC EXTERN /end MEASUREMENT
/begin MEASUREMENT fse52_02 "Filterwert Segmentabweichung, eingerechnet" UBYTE dtsegno_b11p25divZyl 1 100 -1.875 1.86035 FUNCTION_LIST DMDFON IF_DATA DIM_X 0x382F24 EXTERN WORD IF_DATA MCMESS 0x382F24 EXTERN /end MEASUREMENT
/begin MEASUREMENT fse52_03 "Filterwert Segmentabweichung, eingerechnet" UBYTE dtsegno_b11p25divZyl 1 100 -1.875 1.86035 FUNCTION_LIST DMDFON IF_DATA DIM_X 0x382F3C EXTERN WORD IF_DATA MCMESS 0x382F3C EXTERN /end MEASUREMENT
/begin MEASUREMENT fse52_04 "Filterwert Segmentabweichung, eingerechnet" UBYTE dtsegno_b11p25divZyl 1 100 -1.875 1.86035 FUNCTION_LIST DMDFON IF_DATA DIM_X 0x382F54 EXTERN WORD IF_DATA MCMESS 0x382F54 EXTERN /end MEASUREMENT
/begin MEASUREMENT fse52_05 "Filterwert Segmentabweichung, eingerechnet" UBYTE dtsegno_b11p25divZyl 1 100 -1.875 1.86035 FUNCTION_LIST DMDFON IF_DATA DIM_X 0x382F6C EXTERN WORD IF_DATA MCMESS 0x382F6C EXTERN /end MEASUREMENT
/begin MEASUREMENT fse52_06 "Filterwert Segmentabweichung, eingerechnet" UBYTE dtsegno_b11p25divZyl 1 100 -1.875 1.86035 FUNCTION_LIST DMDFON IF_DATA DIM_X 0x382F84 EXTERN WORD IF_DATA MCMESS 0x382F84 EXTERN /end MEASUREMENT
/begin MEASUREMENT fse52_07 "Filterwert Segmentabweichung, eingerechnet" UBYTE dtsegno_b11p25divZyl 1 100 -1.875 1.86035 FUNCTION_LIST DMDFON IF_DATA DIM_X 0x382F9C EXTERN WORD IF_DATA MCMESS 0x382F9C EXTERN /end MEASUREMENT
/begin MEASUREMENT fse52_08 "Filterwert Segmentabweichung, eingerechnet" UBYTE dtsegno_b11p25divZyl 1 100 -1.875 1.86035 FUNCTION_LIST DMDFON IF_DATA DIM_X 0x382FB4 EXTERN WORD IF_DATA MCMESS 0x382FB4 EXTERN /end MEASUREMENT
/begin MEASUREMENT fse53_02 "Filterwert Segmentabweichung, eingerechnet" UBYTE dtsegno_b11p25divZyl 1 100 -1.875 1.86035 FUNCTION_LIST DMDFON IF_DATA DIM_X 0x382F2C EXTERN WORD IF_DATA MCMESS 0x382F2C EXTERN /end MEASUREMENT
/begin MEASUREMENT fse53_03 "Filterwert Segmentabweichung, eingerechnet" UBYTE dtsegno_b11p25divZyl 1 100 -1.875 1.86035 FUNCTION_LIST DMDFON IF_DATA DIM_X 0x382F44 EXTERN WORD IF_DATA MCMESS 0x382F44 EXTERN /end MEASUREMENT
/begin MEASUREMENT fse53_04 "Filterwert Segmentabweichung, eingerechnet" UBYTE dtsegno_b11p25divZyl 1 100 -1.875 1.86035 FUNCTION_LIST DMDFON IF_DATA DIM_X 0x382F5C EXTERN WORD IF_DATA MCMESS 0x382F5C EXTERN /end MEASUREMENT
/begin MEASUREMENT fse53_05 "Filterwert Segmentabweichung, eingerechnet" UBYTE dtsegno_b11p25divZyl 1 100 -1.875 1.86035 FUNCTION_LIST DMDFON IF_DATA DIM_X 0x382F74 EXTERN WORD IF_DATA MCMESS 0x382F74 EXTERN /end MEASUREMENT
/begin MEASUREMENT fse53_06 "Filterwert Segmentabweichung, eingerechnet" UBYTE dtsegno_b11p25divZyl 1 100 -1.875 1.86035 FUNCTION_LIST DMDFON IF_DATA DIM_X 0x382F8C EXTERN WORD IF_DATA MCMESS 0x382F8C EXTERN /end MEASUREMENT
/begin MEASUREMENT fse53_07 "Filterwert Segmentabweichung, eingerechnet" UBYTE dtsegno_b11p25divZyl 1 100 -1.875 1.86035 FUNCTION_LIST DMDFON IF_DATA DIM_X 0x382FA4 EXTERN WORD IF_DATA MCMESS 0x382FA4 EXTERN /end MEASUREMENT
/begin MEASUREMENT fse53_08 "Filterwert Segmentabweichung, eingerechnet" UBYTE dtsegno_b11p25divZyl 1 100 -1.875 1.86035 FUNCTION_LIST DMDFON IF_DATA DIM_X 0x382FBC EXTERN WORD IF_DATA MCMESS 0x382FBC EXTERN /end MEASUREMENT
/begin MEASUREMENT fse61_02 "Filterwert Segmentabweichung, eingerechnet" UBYTE dtsegno_b11p25divZyl 1 100 -1.875 1.86035 FUNCTION_LIST DMDFON IF_DATA DIM_X 0x382F1D EXTERN WORD IF_DATA MCMESS 0x382F1D EXTERN /end MEASUREMENT
/begin MEASUREMENT fse61_03 "Filterwert Segmentabweichung, eingerechnet" UBYTE dtsegno_b11p25divZyl 1 100 -1.875 1.86035 FUNCTION_LIST DMDFON IF_DATA DIM_X 0x382F35 EXTERN WORD IF_DATA MCMESS 0x382F35 EXTERN /end MEASUREMENT
/begin MEASUREMENT fse61_04 "Filterwert Segmentabweichung, eingerechnet" UBYTE dtsegno_b11p25divZyl 1 100 -1.875 1.86035 FUNCTION_LIST DMDFON IF_DATA DIM_X 0x382F4D EXTERN WORD IF_DATA MCMESS 0x382F4D EXTERN /end MEASUREMENT
/begin MEASUREMENT fse61_05 "Filterwert Segmentabweichung, eingerechnet" UBYTE dtsegno_b11p25divZyl 1 100 -1.875 1.86035 FUNCTION_LIST DMDFON IF_DATA DIM_X 0x382F65 EXTERN WORD IF_DATA MCMESS 0x382F65 EXTERN /end MEASUREMENT
/begin MEASUREMENT fse61_06 "Filterwert Segmentabweichung, eingerechnet" UBYTE dtsegno_b11p25divZyl 1 100 -1.875 1.86035 FUNCTION_LIST DMDFON IF_DATA DIM_X 0x382F7D EXTERN WORD IF_DATA MCMESS 0x382F7D EXTERN /end MEASUREMENT
/begin MEASUREMENT fse61_07 "Filterwert Segmentabweichung, eingerechnet" UBYTE dtsegno_b11p25divZyl 1 100 -1.875 1.86035 FUNCTION_LIST DMDFON IF_DATA DIM_X 0x382F95 EXTERN WORD IF_DATA MCMESS 0x382F95 EXTERN /end MEASUREMENT
/begin MEASUREMENT fse61_08 "Filterwert Segmentabweichung, eingerechnet" UBYTE dtsegno_b11p25divZyl 1 100 -1.875 1.86035 FUNCTION_LIST DMDFON IF_DATA DIM_X 0x382FAD EXTERN WORD IF_DATA MCMESS 0x382FAD EXTERN /end MEASUREMENT
/begin MEASUREMENT fse62_02 "Filterwert Segmentabweichung, eingerechnet" UBYTE dtsegno_b11p25divZyl 1 100 -1.875 1.86035 FUNCTION_LIST DMDFON IF_DATA DIM_X 0x382F25 EXTERN WORD IF_DATA MCMESS 0x382F25 EXTERN /end MEASUREMENT
/begin MEASUREMENT fse62_03 "Filterwert Segmentabweichung, eingerechnet" UBYTE dtsegno_b11p25divZyl 1 100 -1.875 1.86035 FUNCTION_LIST DMDFON IF_DATA DIM_X 0x382F3D EXTERN WORD IF_DATA MCMESS 0x382F3D EXTERN /end MEASUREMENT
/begin MEASUREMENT fse62_04 "Filterwert Segmentabweichung, eingerechnet" UBYTE dtsegno_b11p25divZyl 1 100 -1.875 1.86035 FUNCTION_LIST DMDFON IF_DATA DIM_X 0x382F55 EXTERN WORD IF_DATA MCMESS 0x382F55 EXTERN /end MEASUREMENT
/begin MEASUREMENT fse62_05 "Filterwert Segmentabweichung, eingerechnet" UBYTE dtsegno_b11p25divZyl 1 100 -1.875 1.86035 FUNCTION_LIST DMDFON IF_DATA DIM_X 0x382F6D EXTERN WORD IF_DATA MCMESS 0x382F6D EXTERN /end MEASUREMENT
/begin MEASUREMENT fse62_06 "Filterwert Segmentabweichung, eingerechnet" UBYTE dtsegno_b11p25divZyl 1 100 -1.875 1.86035 FUNCTION_LIST DMDFON IF_DATA DIM_X 0x382F85 EXTERN WORD IF_DATA MCMESS 0x382F85 EXTERN /end MEASUREMENT
/begin MEASUREMENT fse62_07 "Filterwert Segmentabweichung, eingerechnet" UBYTE dtsegno_b11p25divZyl 1 100 -1.875 1.86035 FUNCTION_LIST DMDFON IF_DATA DIM_X 0x382F9D EXTERN WORD IF_DATA MCMESS 0x382F9D EXTERN /end MEASUREMENT
/begin MEASUREMENT fse62_08 "Filterwert Segmentabweichung, eingerechnet" UBYTE dtsegno_b11p25divZyl 1 100 -1.875 1.86035 FUNCTION_LIST DMDFON IF_DATA DIM_X 0x382FB5 EXTERN WORD IF_DATA MCMESS 0x382FB5 EXTERN /end MEASUREMENT
/begin MEASUREMENT fse63_02 "Filterwert Segmentabweichung, eingerechnet" UBYTE dtsegno_b11p25divZyl 1 100 -1.875 1.86035 FUNCTION_LIST DMDFON IF_DATA DIM_X 0x382F2D EXTERN WORD IF_DATA MCMESS 0x382F2D EXTERN /end MEASUREMENT
/begin MEASUREMENT fse63_03 "Filterwert Segmentabweichung, eingerechnet" UBYTE dtsegno_b11p25divZyl 1 100 -1.875 1.86035 FUNCTION_LIST DMDFON IF_DATA DIM_X 0x382F45 EXTERN WORD IF_DATA MCMESS 0x382F45 EXTERN /end MEASUREMENT
/begin MEASUREMENT fse63_04 "Filterwert Segmentabweichung, eingerechnet" UBYTE dtsegno_b11p25divZyl 1 100 -1.875 1.86035 FUNCTION_LIST DMDFON IF_DATA DIM_X 0x382F5D EXTERN WORD IF_DATA MCMESS 0x382F5D EXTERN /end MEASUREMENT
/begin MEASUREMENT fse63_05 "Filterwert Segmentabweichung, eingerechnet" UBYTE dtsegno_b11p25divZyl 1 100 -1.875 1.86035 FUNCTION_LIST DMDFON IF_DATA DIM_X 0x382F75 EXTERN WORD IF_DATA MCMESS 0x382F75 EXTERN /end MEASUREMENT
/begin MEASUREMENT fse63_06 "Filterwert Segmentabweichung, eingerechnet" UBYTE dtsegno_b11p25divZyl 1 100 -1.875 1.86035 FUNCTION_LIST DMDFON IF_DATA DIM_X 0x382F8D EXTERN WORD IF_DATA MCMESS 0x382F8D EXTERN /end MEASUREMENT
/begin MEASUREMENT fse63_07 "Filterwert Segmentabweichung, eingerechnet" UBYTE dtsegno_b11p25divZyl 1 100 -1.875 1.86035 FUNCTION_LIST DMDFON IF_DATA DIM_X 0x382FA5 EXTERN WORD IF_DATA MCMESS 0x382FA5 EXTERN /end MEASUREMENT
/begin MEASUREMENT fse63_08 "Filterwert Segmentabweichung, eingerechnet" UBYTE dtsegno_b11p25divZyl 1 100 -1.875 1.86035 FUNCTION_LIST DMDFON IF_DATA DIM_X 0x382FBD EXTERN WORD IF_DATA MCMESS 0x382FBD EXTERN /end MEASUREMENT
/begin MEASUREMENT fse71_02 "Filterwert Segmentabweichung, eingerechnet" UBYTE dtsegno_b11p25divZyl 1 100 -1.875 1.86035 FUNCTION_LIST DMDFON IF_DATA DIM_X 0x382F1E EXTERN WORD IF_DATA MCMESS 0x382F1E EXTERN /end MEASUREMENT
/begin MEASUREMENT fse71_03 "Filterwert Segmentabweichung, eingerechnet" UBYTE dtsegno_b11p25divZyl 1 100 -1.875 1.86035 FUNCTION_LIST DMDFON IF_DATA DIM_X 0x382F36 EXTERN WORD IF_DATA MCMESS 0x382F36 EXTERN /end MEASUREMENT
/begin MEASUREMENT fse71_04 "Filterwert Segmentabweichung, eingerechnet" UBYTE dtsegno_b11p25divZyl 1 100 -1.875 1.86035 FUNCTION_LIST DMDFON IF_DATA DIM_X 0x382F4E EXTERN WORD IF_DATA MCMESS 0x382F4E EXTERN /end MEASUREMENT
/begin MEASUREMENT fse71_05 "Filterwert Segmentabweichung, eingerechnet" UBYTE dtsegno_b11p25divZyl 1 100 -1.875 1.86035 FUNCTION_LIST DMDFON IF_DATA DIM_X 0x382F66 EXTERN WORD IF_DATA MCMESS 0x382F66 EXTERN /end MEASUREMENT
/begin MEASUREMENT fse71_06 "Filterwert Segmentabweichung, eingerechnet" UBYTE dtsegno_b11p25divZyl 1 100 -1.875 1.86035 FUNCTION_LIST DMDFON IF_DATA DIM_X 0x382F7E EXTERN WORD IF_DATA MCMESS 0x382F7E EXTERN /end MEASUREMENT
/begin MEASUREMENT fse71_07 "Filterwert Segmentabweichung, eingerechnet" UBYTE dtsegno_b11p25divZyl 1 100 -1.875 1.86035 FUNCTION_LIST DMDFON IF_DATA DIM_X 0x382F96 EXTERN WORD IF_DATA MCMESS 0x382F96 EXTERN /end MEASUREMENT
/begin MEASUREMENT fse71_08 "Filterwert Segmentabweichung, eingerechnet" UBYTE dtsegno_b11p25divZyl 1 100 -1.875 1.86035 FUNCTION_LIST DMDFON IF_DATA DIM_X 0x382FAE EXTERN WORD IF_DATA MCMESS 0x382FAE EXTERN /end MEASUREMENT
/begin MEASUREMENT fse72_02 "Filterwert Segmentabweichung, eingerechnet" UBYTE dtsegno_b11p25divZyl 1 100 -1.875 1.86035 FUNCTION_LIST DMDFON IF_DATA DIM_X 0x382F26 EXTERN WORD IF_DATA MCMESS 0x382F26 EXTERN /end MEASUREMENT
/begin MEASUREMENT fse72_03 "Filterwert Segmentabweichung, eingerechnet" UBYTE dtsegno_b11p25divZyl 1 100 -1.875 1.86035 FUNCTION_LIST DMDFON IF_DATA DIM_X 0x382F3E EXTERN WORD IF_DATA MCMESS 0x382F3E EXTERN /end MEASUREMENT
/begin MEASUREMENT fse72_04 "Filterwert Segmentabweichung, eingerechnet" UBYTE dtsegno_b11p25divZyl 1 100 -1.875 1.86035 FUNCTION_LIST DMDFON IF_DATA DIM_X 0x382F56 EXTERN WORD IF_DATA MCMESS 0x382F56 EXTERN /end MEASUREMENT
/begin MEASUREMENT fse72_05 "Filterwert Segmentabweichung, eingerechnet" UBYTE dtsegno_b11p25divZyl 1 100 -1.875 1.86035 FUNCTION_LIST DMDFON IF_DATA DIM_X 0x382F6E EXTERN WORD IF_DATA MCMESS 0x382F6E EXTERN /end MEASUREMENT
/begin MEASUREMENT fse72_06 "Filterwert Segmentabweichung, eingerechnet" UBYTE dtsegno_b11p25divZyl 1 100 -1.875 1.86035 FUNCTION_LIST DMDFON IF_DATA DIM_X 0x382F86 EXTERN WORD IF_DATA MCMESS 0x382F86 EXTERN /end MEASUREMENT
/begin MEASUREMENT fse72_07 "Filterwert Segmentabweichung, eingerechnet" UBYTE dtsegno_b11p25divZyl 1 100 -1.875 1.86035 FUNCTION_LIST DMDFON IF_DATA DIM_X 0x382F9E EXTERN WORD IF_DATA MCMESS 0x382F9E EXTERN /end MEASUREMENT
/begin MEASUREMENT fse72_08 "Filterwert Segmentabweichung, eingerechnet" UBYTE dtsegno_b11p25divZyl 1 100 -1.875 1.86035 FUNCTION_LIST DMDFON IF_DATA DIM_X 0x382FB6 EXTERN WORD IF_DATA MCMESS 0x382FB6 EXTERN /end MEASUREMENT
/begin MEASUREMENT fse73_02 "Filterwert Segmentabweichung, eingerechnet" UBYTE dtsegno_b11p25divZyl 1 100 -1.875 1.86035 FUNCTION_LIST DMDFON IF_DATA DIM_X 0x382F2E EXTERN WORD IF_DATA MCMESS 0x382F2E EXTERN /end MEASUREMENT
/begin MEASUREMENT fse73_03 "Filterwert Segmentabweichung, eingerechnet" UBYTE dtsegno_b11p25divZyl 1 100 -1.875 1.86035 FUNCTION_LIST DMDFON IF_DATA DIM_X 0x382F46 EXTERN WORD IF_DATA MCMESS 0x382F46 EXTERN /end MEASUREMENT
/begin MEASUREMENT fse73_04 "Filterwert Segmentabweichung, eingerechnet" UBYTE dtsegno_b11p25divZyl 1 100 -1.875 1.86035 FUNCTION_LIST DMDFON IF_DATA DIM_X 0x382F5E EXTERN WORD IF_DATA MCMESS 0x382F5E EXTERN /end MEASUREMENT
/begin MEASUREMENT fse73_05 "Filterwert Segmentabweichung, eingerechnet" UBYTE dtsegno_b11p25divZyl 1 100 -1.875 1.86035 FUNCTION_LIST DMDFON IF_DATA DIM_X 0x382F76 EXTERN WORD IF_DATA MCMESS 0x382F76 EXTERN /end MEASUREMENT
/begin MEASUREMENT fse73_06 "Filterwert Segmentabweichung, eingerechnet" UBYTE dtsegno_b11p25divZyl 1 100 -1.875 1.86035 FUNCTION_LIST DMDFON IF_DATA DIM_X 0x382F8E EXTERN WORD IF_DATA MCMESS 0x382F8E EXTERN /end MEASUREMENT
/begin MEASUREMENT fse73_07 "Filterwert Segmentabweichung, eingerechnet" UBYTE dtsegno_b11p25divZyl 1 100 -1.875 1.86035 FUNCTION_LIST DMDFON IF_DATA DIM_X 0x382FA6 EXTERN WORD IF_DATA MCMESS 0x382FA6 EXTERN /end MEASUREMENT
/begin MEASUREMENT fse73_08 "Filterwert Segmentabweichung, eingerechnet" UBYTE dtsegno_b11p25divZyl 1 100 -1.875 1.86035 FUNCTION_LIST DMDFON IF_DATA DIM_X 0x382FBE EXTERN WORD IF_DATA MCMESS 0x382FBE EXTERN /end MEASUREMENT
/begin MEASUREMENT fse81_02 "Filterwert Segmentabweichung, eingerechnet" UBYTE dtsegno_b11p25divZyl 1 100 -1.875 1.86035 FUNCTION_LIST DMDFON IF_DATA DIM_X 0x382F1F EXTERN WORD IF_DATA MCMESS 0x382F1F EXTERN /end MEASUREMENT
/begin MEASUREMENT fse81_03 "Filterwert Segmentabweichung, eingerechnet" UBYTE dtsegno_b11p25divZyl 1 100 -1.875 1.86035 FUNCTION_LIST DMDFON IF_DATA DIM_X 0x382F37 EXTERN WORD IF_DATA MCMESS 0x382F37 EXTERN /end MEASUREMENT
/begin MEASUREMENT fse81_04 "Filterwert Segmentabweichung, eingerechnet" UBYTE dtsegno_b11p25divZyl 1 100 -1.875 1.86035 FUNCTION_LIST DMDFON IF_DATA DIM_X 0x382F4F EXTERN WORD IF_DATA MCMESS 0x382F4F EXTERN /end MEASUREMENT
/begin MEASUREMENT fse81_05 "Filterwert Segmentabweichung, eingerechnet" UBYTE dtsegno_b11p25divZyl 1 100 -1.875 1.86035 FUNCTION_LIST DMDFON IF_DATA DIM_X 0x382F67 EXTERN WORD IF_DATA MCMESS 0x382F67 EXTERN /end MEASUREMENT
/begin MEASUREMENT fse81_06 "Filterwert Segmentabweichung, eingerechnet" UBYTE dtsegno_b11p25divZyl 1 100 -1.875 1.86035 FUNCTION_LIST DMDFON IF_DATA DIM_X 0x382F7F EXTERN WORD IF_DATA MCMESS 0x382F7F EXTERN /end MEASUREMENT
/begin MEASUREMENT fse81_07 "Filterwert Segmentabweichung, eingerechnet" UBYTE dtsegno_b11p25divZyl 1 100 -1.875 1.86035 FUNCTION_LIST DMDFON IF_DATA DIM_X 0x382F97 EXTERN WORD IF_DATA MCMESS 0x382F97 EXTERN /end MEASUREMENT
/begin MEASUREMENT fse81_08 "Filterwert Segmentabweichung, eingerechnet" UBYTE dtsegno_b11p25divZyl 1 100 -1.875 1.86035 FUNCTION_LIST DMDFON IF_DATA DIM_X 0x382FAF EXTERN WORD IF_DATA MCMESS 0x382FAF EXTERN /end MEASUREMENT
/begin MEASUREMENT fse82_02 "Filterwert Segmentabweichung, eingerechnet" UBYTE dtsegno_b11p25divZyl 1 100 -1.875 1.86035 FUNCTION_LIST DMDFON IF_DATA DIM_X 0x382F27 EXTERN WORD IF_DATA MCMESS 0x382F27 EXTERN /end MEASUREMENT
/begin MEASUREMENT fse82_03 "Filterwert Segmentabweichung, eingerechnet" UBYTE dtsegno_b11p25divZyl 1 100 -1.875 1.86035 FUNCTION_LIST DMDFON IF_DATA DIM_X 0x382F3F EXTERN WORD IF_DATA MCMESS 0x382F3F EXTERN /end MEASUREMENT
/begin MEASUREMENT fse82_04 "Filterwert Segmentabweichung, eingerechnet" UBYTE dtsegno_b11p25divZyl 1 100 -1.875 1.86035 FUNCTION_LIST DMDFON IF_DATA DIM_X 0x382F57 EXTERN WORD IF_DATA MCMESS 0x382F57 EXTERN /end MEASUREMENT
/begin MEASUREMENT fse82_05 "Filterwert Segmentabweichung, eingerechnet" UBYTE dtsegno_b11p25divZyl 1 100 -1.875 1.86035 FUNCTION_LIST DMDFON IF_DATA DIM_X 0x382F6F EXTERN WORD IF_DATA MCMESS 0x382F6F EXTERN /end MEASUREMENT
/begin MEASUREMENT fse82_06 "Filterwert Segmentabweichung, eingerechnet" UBYTE dtsegno_b11p25divZyl 1 100 -1.875 1.86035 FUNCTION_LIST DMDFON IF_DATA DIM_X 0x382F87 EXTERN WORD IF_DATA MCMESS 0x382F87 EXTERN /end MEASUREMENT
/begin MEASUREMENT fse82_07 "Filterwert Segmentabweichung, eingerechnet" UBYTE dtsegno_b11p25divZyl 1 100 -1.875 1.86035 FUNCTION_LIST DMDFON IF_DATA DIM_X 0x382F9F EXTERN WORD IF_DATA MCMESS 0x382F9F EXTERN /end MEASUREMENT
/begin MEASUREMENT fse82_08 "Filterwert Segmentabweichung, eingerechnet" UBYTE dtsegno_b11p25divZyl 1 100 -1.875 1.86035 FUNCTION_LIST DMDFON IF_DATA DIM_X 0x382FB7 EXTERN WORD IF_DATA MCMESS 0x382FB7 EXTERN /end MEASUREMENT
/begin MEASUREMENT fse83_02 "Filterwert Segmentabweichung, eingerechnet" UBYTE dtsegno_b11p25divZyl 1 100 -1.875 1.86035 FUNCTION_LIST DMDFON IF_DATA DIM_X 0x382F2F EXTERN WORD IF_DATA MCMESS 0x382F2F EXTERN /end MEASUREMENT
/begin MEASUREMENT fse83_03 "Filterwert Segmentabweichung, eingerechnet" UBYTE dtsegno_b11p25divZyl 1 100 -1.875 1.86035 FUNCTION_LIST DMDFON IF_DATA DIM_X 0x382F47 EXTERN WORD IF_DATA MCMESS 0x382F47 EXTERN /end MEASUREMENT
/begin MEASUREMENT fse83_04 "Filterwert Segmentabweichung, eingerechnet" UBYTE dtsegno_b11p25divZyl 1 100 -1.875 1.86035 FUNCTION_LIST DMDFON IF_DATA DIM_X 0x382F5F EXTERN WORD IF_DATA MCMESS 0x382F5F EXTERN /end MEASUREMENT
/begin MEASUREMENT fse83_05 "Filterwert Segmentabweichung, eingerechnet" UBYTE dtsegno_b11p25divZyl 1 100 -1.875 1.86035 FUNCTION_LIST DMDFON IF_DATA DIM_X 0x382F77 EXTERN WORD IF_DATA MCMESS 0x382F77 EXTERN /end MEASUREMENT
/begin MEASUREMENT fse83_06 "Filterwert Segmentabweichung, eingerechnet" UBYTE dtsegno_b11p25divZyl 1 100 -1.875 1.86035 FUNCTION_LIST DMDFON IF_DATA DIM_X 0x382F8F EXTERN WORD IF_DATA MCMESS 0x382F8F EXTERN /end MEASUREMENT
/begin MEASUREMENT fse83_07 "Filterwert Segmentabweichung, eingerechnet" UBYTE dtsegno_b11p25divZyl 1 100 -1.875 1.86035 FUNCTION_LIST DMDFON IF_DATA DIM_X 0x382FA7 EXTERN WORD IF_DATA MCMESS 0x382FA7 EXTERN /end MEASUREMENT
/begin MEASUREMENT fse83_08 "Filterwert Segmentabweichung, eingerechnet" UBYTE dtsegno_b11p25divZyl 1 100 -1.875 1.86035 FUNCTION_LIST DMDFON IF_DATA DIM_X 0x382FBF EXTERN WORD IF_DATA MCMESS 0x382FBF EXTERN /end MEASUREMENT
/begin MEASUREMENT fslpdyn "Faktor Dynamikbeschreibung Sekundärluftpumpe" UBYTE fak_ub_b1 1 100 0 0.996094 FUNCTION_LIST SLS LAKH IF_DATA DIM_X 0x38091A EXTERN WORD IF_DATA MCMESS 0x38091A EXTERN /end MEASUREMENT
/begin MEASUREMENT fslsdyn "Faktor Dynamikbeschreibung Sekundärluftsystem" UBYTE fak_ub_b1 1 100 0 0.996094 FUNCTION_LIST LAKH IF_DATA DIM_X 0x380B78 EXTERN WORD IF_DATA MCMESS 0x380B78 EXTERN /end MEASUREMENT
/begin MEASUREMENT fst0_w "Vorgesteuerter Startfaktor 16 Bit" UWORD fak_uw_b64 1 100 0 63.999 FUNCTION_LIST ESSTT IF_DATA DIM_X 0x38227E EXTERN WORD IF_DATA MCMESS 0x38227E EXTERN /end MEASUREMENT
/begin MEASUREMENT fst_w "Faktor Starteinspritzung" UWORD fak_uw_b64 1 100 0 63.999 FUNCTION_LIST ESSTT GK IF_DATA DIM_X 0x382280 EXTERN WORD IF_DATA MCMESS 0x382280 EXTERN /end MEASUREMENT
/begin MEASUREMENT fswares "Erkennungsschwellwert Schlechtwegstrecke (aus einer KL)" UBYTE acc_ub_b55p55 1 100 0 55.335 FUNCTION_LIST DSWEC IF_DATA DIM_X 0x380CA7 EXTERN WORD IF_DATA MCMESS 0x380CA7 EXTERN /end MEASUREMENT
/begin MEASUREMENT ftadmste "Bewrtungsfaktor für Absteuern des TEV bei dynamischer Vorgänge" UBYTE fak_ub_b2 1 100 0 1.99219 FUNCTION_LIST TEB IF_DATA DIM_X 0x380CC6 EXTERN WORD IF_DATA MCMESS 0x380CC6 EXTERN /end MEASUREMENT
/begin MEASUREMENT ftbr "Faktor Temperaturkorrektur im Brennraum" UBYTE fak_ub_b2 1 100 0 1.99219 FUNCTION_LIST BGTMPK IF_DATA DIM_X 0x380AF7 EXTERN WORD IF_DATA MCMESS 0x380AF7 EXTERN /end MEASUREMENT
/begin MEASUREMENT ftbr_w "Faktor Temperaturkorrektur im Brennraum" UWORD fak_uw_b2 1 100 0 1.99997 FUNCTION_LIST BGTMPK BGSRM IF_DATA DIM_X 0x382104 EXTERN WORD IF_DATA MCMESS 0x382104 EXTERN /end MEASUREMENT
/begin MEASUREMENT fteadf "gefilteter Faktor Beladung Spülstrom bei Tankentlüftung" SBYTE fak_sb_q0p5 1 100 -64 63.5 FUNCTION_LIST TEB T2DFA IF_DATA DIM_X 0x380CB9 EXTERN WORD IF_DATA MCMESS 0x380CB9 EXTERN /end MEASUREMENT
/begin MEASUREMENT fteadf_w "gefilteter Faktor Beladung Spülstrom bei Tankentlüftung (16 Bit)" SWORD fak_q0p00195 1 100 -64 63.998 FUNCTION_LIST TEB IF_DATA DIM_X 0x382B98 EXTERN WORD IF_DATA MCMESS 0x382B98 EXTERN /end MEASUREMENT
/begin MEASUREMENT ftead_w "Beladung des Aktivkohlefilters" SWORD fak_sw_b64 1 100 -64 63.998 FUNCTION_LIST TEB BBTEGA DTEV T2LID IF_DATA DIM_X 0x382B9A EXTERN WORD IF_DATA MCMESS 0x382B9A EXTERN /end MEASUREMENT
/begin MEASUREMENT ftefsold_w "Letzter Sollwert der Spülrate Tankentlüftung vor Absteuerung" UWORD fak_uw_b0p5 1 100 0 0.499992 FUNCTION_LIST TEB IF_DATA DIM_X 0x382BA8 EXTERN WORD IF_DATA MCMESS 0x382BA8 EXTERN /end MEASUREMENT
/begin MEASUREMENT ftefsoll_w "Sollwert der Spülrate Tankentlüftung" UWORD fak_uw_b0p5 1 100 0 0.499992 FUNCTION_LIST TEB DTEV IF_DATA DIM_X 0x382BAA EXTERN WORD IF_DATA MCMESS 0x382BAA EXTERN /end MEASUREMENT
/begin MEASUREMENT ftefva "Spülrate der Tankentlüftung" UBYTE fak_ub_b0p5 1 100 0 0.498047 FUNCTION_LIST TEB IF_DATA DIM_X 0x380CC7 EXTERN WORD IF_DATA MCMESS 0x380CC7 EXTERN /end MEASUREMENT
/begin MEASUREMENT ftefvab "Begrenzungswert der Spülrate Tankentlüftung" UBYTE fak_ub_b0p03125 1 100 0 0.0311279 FUNCTION_LIST TEB IF_DATA DIM_X 0x380CBA EXTERN WORD IF_DATA MCMESS 0x380CBA EXTERN /end MEASUREMENT
/begin MEASUREMENT ftefvamx_w "max. Spülrate (Begrenzung absolut, 16 bit)" UWORD fak_uw_b0p5 1 100 0 0.499992 FUNCTION_LIST TEB IF_DATA DIM_X 0x382BAC EXTERN WORD IF_DATA MCMESS 0x382BAC EXTERN /end MEASUREMENT
/begin MEASUREMENT ftefva_w "Spülrate Tankentlüftung" UWORD fak_uw_b0p5 1 100 0 0.499992 FUNCTION_LIST TEB IF_DATA DIM_X 0x382BAE EXTERN WORD IF_DATA MCMESS 0x382BAE EXTERN /end MEASUREMENT
/begin MEASUREMENT ftek2_w "Korrekturfaktor für effektive Einspritzzeit" UWORD fak_uw_b2 1 100 0 1.99997 FUNCTION_LIST RKTI IF_DATA DIM_X 0x38235A EXTERN WORD IF_DATA MCMESS 0x38235A EXTERN /end MEASUREMENT
/begin MEASUREMENT ftek_w "Korrekturfaktor für effektive Einspritzzeit" UWORD fak_uw_b2 1 100 0 1.99997 FUNCTION_LIST RKTI IF_DATA DIM_X 0x38235C EXTERN WORD IF_DATA MCMESS 0x38235C EXTERN /end MEASUREMENT
/begin MEASUREMENT fteml "Aufsteuergeschwindigkeit der Spülrate und des Massenstroms TEV" UBYTE perio_ub_b0p012207 1 100 0 0.0121593 FUNCTION_LIST TEB IF_DATA DIM_X 0x380CBB EXTERN WORD IF_DATA MCMESS 0x380CBB EXTERN /end MEASUREMENT
/begin MEASUREMENT fthozs_w "Faktor Korrektur Höhe und Temperatur" UWORD fak_uw_b2 1 100 0 1.99997 FUNCTION_LIST DTEV IF_DATA DIM_X 0x382C42 EXTERN WORD IF_DATA MCMESS 0x382C42 EXTERN /end MEASUREMENT
/begin MEASUREMENT ftho_w "Faktor Korrektur Höhe und Temperatur" UWORD fak_uw_b2 1 100 0 1.99997 FUNCTION_LIST BGTEV IF_DATA DIM_X 0x382B6C EXTERN WORD IF_DATA MCMESS 0x382B6C EXTERN /end MEASUREMENT
/begin MEASUREMENT ftsr "Korrekturfaktor Lufttemperatur im Saugrohr" UBYTE fak_ub_b2 1 100 0 1.99219 FUNCTION_LIST BGTMPK BGSRM IF_DATA DIM_X 0x380AF8 EXTERN WORD IF_DATA MCMESS 0x380AF8 EXTERN /end MEASUREMENT
/begin MEASUREMENT ftu "Faktor Temperatur Umgebung" UBYTE fak_ub_b2 1 100 0 1.99219 FUNCTION_LIST BGTMPK GGDSAS IF_DATA DIM_X 0x380AF9 EXTERN WORD IF_DATA MCMESS 0x380AF9 EXTERN /end MEASUREMENT
/begin MEASUREMENT ftvdk "Korrekturfaktor Temperatur vor Drosselklappe" UBYTE fak_ub_b2 1 100 0 1.99219 FUNCTION_LIST BGTMPK BGMSZS BGTEV DTEV FUEDK GGDVE IF_DATA DIM_X 0x380AFB EXTERN WORD IF_DATA MCMESS 0x380AFB EXTERN /end MEASUREMENT
/begin MEASUREMENT ftvsv "Faktor Schaltzeitverkürzung bei schnellem Drehmomentenanstieg" UBYTE fak_ub_b1 1 100 0 0.996094 FUNCTION_LIST VS esvs ESWL IF_DATA DIM_X 0x380D03 EXTERN WORD IF_DATA MCMESS 0x380D03 EXTERN /end MEASUREMENT
/begin MEASUREMENT ftw "Faktor Temperaturgewichtung tmot, tans" UBYTE fak_ub_b1 1 100 0 0.996094 FUNCTION_LIST BGTMPK IF_DATA DIM_X 0x380AFA EXTERN WORD IF_DATA MCMESS 0x380AFA EXTERN /end MEASUREMENT
/begin MEASUREMENT fubaanz "Anzahl der Funkenpakete Funkenbandzündung" UBYTE dez 1 100 0 255 FUNCTION_LIST ZUESZ AZUE IF_DATA DIM_X 0xFB44 INTERN WORD IF_DATA MCMESS 0xFB44 INTERN /end MEASUREMENT
/begin MEASUREMENT fubaanz_i "" UBYTE dez 1 100 0 255 FUNCTION_LIST AZUE IF_DATA DIM_X 0xF8E3 INTERN WORD IF_DATA MCMESS 0xF8E3 INTERN /end MEASUREMENT
/begin MEASUREMENT fuedkLocalBits "" UBYTE dez 1 100 0 255 FUNCTION_LIST FUEDK IF_DATA DIM_X 0x380AFD EXTERN WORD IF_DATA MCMESS 0x380AFD EXTERN /end MEASUREMENT
/begin MEASUREMENT fuepmld_w "faktor für gleitenden Übergang Druckmittelwert (Referenzdruck) bei Turbo" UWORD fak_uw_b1 1 100 0 0.999985 FUNCTION_LIST FUEDK IF_DATA DIM_X 0x38212C EXTERN WORD IF_DATA MCMESS 0x38212C EXTERN /end MEASUREMENT
/begin MEASUREMENT fukabak_w "ÜK-Adaptionsfaktor (kalter Motor) BA" UWORD fak_uw_b4 1 100 0 3.99994 FUNCTION_LIST ESUKAS IF_DATA DIM_X 0x3839BE EXTERN WORD IF_DATA MCMESS 0x3839BE EXTERN /end MEASUREMENT
/begin MEASUREMENT fukabaw_w "ÜK-Adaptionsfaktor (warmer Motor) BA" UWORD fak_uw_b4 1 100 0 3.99994 FUNCTION_LIST ESUKAS IF_DATA DIM_X 0x3839C0 EXTERN WORD IF_DATA MCMESS 0x3839C0 EXTERN /end MEASUREMENT
/begin MEASUREMENT fukaba_w "ÜK-Adaptions-Faktor BA" UWORD fak_uw_b4 1 100 0 3.99994 FUNCTION_LIST ESUKAS ESUK IF_DATA DIM_X 0x3822B8 EXTERN WORD IF_DATA MCMESS 0x3822B8 EXTERN /end MEASUREMENT
/begin MEASUREMENT fukavak_w "ÜK-Adaptionsfaktor (kalter Motor) VA" UWORD fak_uw_b4 1 100 0 3.99994 FUNCTION_LIST ESUKAS IF_DATA DIM_X 0x3839C2 EXTERN WORD IF_DATA MCMESS 0x3839C2 EXTERN /end MEASUREMENT
/begin MEASUREMENT fukavaw_w "ÜK-Adaptionsfaktor (warmer Motor) VA" UWORD fak_uw_b4 1 100 0 3.99994 FUNCTION_LIST ESUKAS IF_DATA DIM_X 0x3839C4 EXTERN WORD IF_DATA MCMESS 0x3839C4 EXTERN /end MEASUREMENT
/begin MEASUREMENT fukava_w "ÜK-Adaptions-Faktor VA" UWORD fak_uw_b4 1 100 0 3.99994 FUNCTION_LIST ESUKAS ESUK IF_DATA DIM_X 0x3822BA EXTERN WORD IF_DATA MCMESS 0x3822BA EXTERN /end MEASUREMENT
/begin MEASUREMENT fupsrl_w "Faktor systembezogene Umrechnung Druck auf Füllung (16-Bit)" UWORD rel_uw_b0p3 1 100 0 0.299995 FUNCTION_LIST BGSRM BGRLP IF_DATA DIM_X 0x3820E2 EXTERN WORD IF_DATA MCMESS 0x3820E2 EXTERN /end MEASUREMENT
/begin MEASUREMENT fvakl_w "Faktor K- und L-Anteil der ÜK bei VA" SWORD fak_sw_b256 1 100 -256 255.992 FUNCTION_LIST ESUK IF_DATA DIM_X 0x38228A EXTERN WORD IF_DATA MCMESS 0x38228A EXTERN /end MEASUREMENT
/begin MEASUREMENT fvans "Nachstartfaktor der ÜK bei VA" UBYTE fak_ub_b8 1 100 0 7.96875 FUNCTION_LIST ESUK IF_DATA DIM_X 0x380B2B EXTERN WORD IF_DATA MCMESS 0x380B2B EXTERN /end MEASUREMENT
/begin MEASUREMENT fvavst_w "Faktor ÜK-Verstellung bei Verzögerungsabmagerung" SWORD fak_sw_b256 1 100 -256 255.992 FUNCTION_LIST ESUK IF_DATA DIM_X 0x38228C EXTERN WORD IF_DATA MCMESS 0x38228C EXTERN /end MEASUREMENT
/begin MEASUREMENT fvermte_w "Faktor Vermischung Regeneriergas im Saugrohr" UWORD fak_uw_b1 1 100 0 0.999985 FUNCTION_LIST TEB IF_DATA DIM_X 0x382BB0 EXTERN WORD IF_DATA MCMESS 0x382BB0 EXTERN /end MEASUREMENT
/begin MEASUREMENT fvisrm_w "Faktor Verstärkung Integrator Saugrohrmodell" UWORD p_uw_b32 1 100 0 31.9995 FUNCTION_LIST BGSRM BGRLP IF_DATA DIM_X 0x3820CC EXTERN WORD IF_DATA MCMESS 0x3820CC EXTERN /end MEASUREMENT
/begin MEASUREMENT fvst_w "Faktor Vorsteuerung" UWORD fak_uw_b64 1 100 0 63.999 FUNCTION_LIST GK IF_DATA DIM_X 0x382310 EXTERN WORD IF_DATA MCMESS 0x382310 EXTERN /end MEASUREMENT
/begin MEASUREMENT fwe "Faktor Wiedereinsetzen" UBYTE fak_ub_b2 1 100 0 1.99219 FUNCTION_LIST ESWE GK IF_DATA DIM_X 0x380B3E EXTERN WORD IF_DATA MCMESS 0x380B3E EXTERN /end MEASUREMENT
/begin MEASUREMENT fweg "maximaler Faktor Wiedereinsetzmehrmenge" UBYTE fak_ub_b2 1 100 0 1.99219 FUNCTION_LIST ACIFI IF_DATA DIM_X 0xFA55 INTERN WORD IF_DATA MCMESS 0xFA55 INTERN /end MEASUREMENT
/begin MEASUREMENT fwez0 "Faktor Wiedereinsetzmenge zylinderindividuell Zyl. 1" UBYTE fak_ub_b2 1 100 0 1.99219 FUNCTION_LIST ACIFI IF_DATA DIM_X 0xFA56 INTERN WORD IF_DATA MCMESS 0xFA56 INTERN /end MEASUREMENT
/begin MEASUREMENT fwez1 "Faktor Wiedereinsetzmenge zylinderindividuell Zyl. 2" UBYTE fak_ub_b2 1 100 0 1.99219 FUNCTION_LIST ACIFI IF_DATA DIM_X 0xFA57 INTERN WORD IF_DATA MCMESS 0xFA57 INTERN /end MEASUREMENT
/begin MEASUREMENT fwez2 "Faktor Wiedereinsetzmenge zylinderindividuell Zyl. 3" UBYTE fak_ub_b2 1 100 0 1.99219 FUNCTION_LIST ACIFI IF_DATA DIM_X 0xFA58 INTERN WORD IF_DATA MCMESS 0xFA58 INTERN /end MEASUREMENT
/begin MEASUREMENT fwez3 "Faktor Wiedereinsetzmenge zylinderindividuell Zyl. 4" UBYTE fak_ub_b2 1 100 0 1.99219 FUNCTION_LIST ACIFI IF_DATA DIM_X 0xFA59 INTERN WORD IF_DATA MCMESS 0xFA59 INTERN /end MEASUREMENT
/begin MEASUREMENT fwez4 "Faktor Wiedereinsetzmenge zylinderindividuell Zyl. 5" UBYTE fak_ub_b2 1 100 0 1.99219 FUNCTION_LIST ACIFI IF_DATA DIM_X 0xFA5A INTERN WORD IF_DATA MCMESS 0xFA5A INTERN /end MEASUREMENT
/begin MEASUREMENT fwez5 "Faktor Wiedereinsetzmenge zylinderindividuell Zyl. 6" UBYTE fak_ub_b2 1 100 0 1.99219 FUNCTION_LIST ACIFI IF_DATA DIM_X 0xFA5B INTERN WORD IF_DATA MCMESS 0xFA5B INTERN /end MEASUREMENT
/begin MEASUREMENT fwez6 "Faktor Wiedereinsetzmenge zylinderindividuell Zyl. 7" UBYTE fak_ub_b2 1 100 0 1.99219 FUNCTION_LIST ACIFI IF_DATA DIM_X 0xFA5C INTERN WORD IF_DATA MCMESS 0xFA5C INTERN /end MEASUREMENT
/begin COMPU_METHOD acc_ub_b55p55 "" RAT_FUNC "%6.3" "m/(s^2)" COEFFS 0 1 0 0 0 0.217 /end COMPU_METHOD
/begin COMPU_METHOD B_TRUE "boolsche Zustände, positive Logik" TAB_VERB "%6.3" "" COMPU_TAB_REF B_TRUE /end COMPU_METHOD
/begin COMPU_VTAB B_TRUE "boolsche Zustände, positive Logik" TAB_VERB 2 0 "----" 1 "TRUE" /end COMPU_VTAB
/begin COMPU_METHOD DEZ "1 : 1 Umrechnug (dez/hex)" RAT_FUNC "%6.2" "" COEFFS 0 1 0 0 0 1 /end COMPU_METHOD
/begin COMPU_METHOD dez "1 : 1 Umrechnug (dez/hex)" RAT_FUNC "%6.2" "" COEFFS 0 1 0 0 0 1 /end COMPU_METHOD
/begin COMPU_METHOD dtsegno_b11p25divZyl "" RAT_FUNC "%6.5" "grad/KW" COEFFS 0 68.2667 128 0 0 1 /end COMPU_METHOD
/begin COMPU_METHOD dtsegn_b11p25divZyl "" RAT_FUNC "%6.4" "grad/KW" COEFFS 0 68.2667 0 0 0 1 /end COMPU_METHOD
/begin COMPU_METHOD dtsegn_b720divZyl "" RAT_FUNC "%6.4" "grad/KW" COEFFS 0 273.067 0 0 0 1 /end COMPU_METHOD
/begin COMPU_METHOD dtsegn_b720divZylP5 "" RAT_FUNC "%6.1" "grad/KW" COEFFS 0 273.067 32768 0 0 1 /end COMPU_METHOD
/begin COMPU_METHOD fak_q0p00195 "" RAT_FUNC "%6.4" "-" COEFFS 0 65536 0 0 0 128 /end COMPU_METHOD
/begin COMPU_METHOD fak_q0p0625 "" RAT_FUNC "%6.4" "-" COEFFS 0 16 0 0 0 1 /end COMPU_METHOD
/begin COMPU_METHOD fak_sb_b1 "" RAT_FUNC "%6.4" "-" COEFFS 0 256 0 0 0 2 /end COMPU_METHOD
/begin COMPU_METHOD fak_sb_b16 "" RAT_FUNC "%6.3" "-" COEFFS 0 256 0 0 0 32 /end COMPU_METHOD
/begin COMPU_METHOD fak_sb_q0p5 "" RAT_FUNC "%6.3" "-" COEFFS 0 256 0 0 0 128 /end COMPU_METHOD
/begin COMPU_METHOD fak_sw_b1 "" RAT_FUNC "%7.6" "-" COEFFS 0 65536 0 0 0 2 /end COMPU_METHOD
/begin COMPU_METHOD fak_sw_b256 "" RAT_FUNC "%6.4" "-" COEFFS 0 65536 0 0 0 512 /end COMPU_METHOD
/begin COMPU_METHOD fak_sw_b64 "" RAT_FUNC "%6.4" "-" COEFFS 0 65536 0 0 0 128 /end COMPU_METHOD
/begin COMPU_METHOD fak_ub_b0p03125 "" RAT_FUNC "%6.5" "-" COEFFS 0 256 0 0 0 0.03125 /end COMPU_METHOD
/begin COMPU_METHOD fak_ub_b0p5 "" RAT_FUNC "%6.4" "-" COEFFS 0 256 0 0 0 0.5 /end COMPU_METHOD
/begin COMPU_METHOD fak_ub_b1 "" RAT_FUNC "%6.4" "-" COEFFS 0 256 0 0 0 1 /end COMPU_METHOD
/begin COMPU_METHOD fak_ub_b16 "" RAT_FUNC "%6.4" "-" COEFFS 0 256 0 0 0 16 /end COMPU_METHOD
/begin COMPU_METHOD fak_ub_b1p25_o0p75 "" RAT_FUNC "%6.3" "-" COEFFS 0 1 -0.75 0 0 0.00195313 /end COMPU_METHOD
/begin COMPU_METHOD fak_ub_b2 "" RAT_FUNC "%6.4" "-" COEFFS 0 256 0 0 0 2 /end COMPU_METHOD
/begin COMPU_METHOD fak_ub_b3p125 "" RAT_FUNC "%6.4" "%/Upm" COEFFS 0 2048 0 0 0 25 /end COMPU_METHOD
/begin COMPU_METHOD fak_ub_b4 "" RAT_FUNC "%6.4" "-" COEFFS 0 256 0 0 0 4 /end COMPU_METHOD
/begin COMPU_METHOD fak_ub_b8 "" RAT_FUNC "%6.4" "-" COEFFS 0 256 0 0 0 8 /end COMPU_METHOD
/begin COMPU_METHOD fak_uw_b0p5 "" RAT_FUNC "%8.7" "-" COEFFS 0 65536 0 0 0 0.5 /end COMPU_METHOD
/begin COMPU_METHOD fak_uw_b1 "" RAT_FUNC "%7.6" "-" COEFFS 0 65536 0 0 0 1 /end COMPU_METHOD
/begin COMPU_METHOD fak_uw_b16 "" RAT_FUNC "%6.5" "-" COEFFS 0 65536 0 0 0 16 /end COMPU_METHOD
/begin COMPU_METHOD fak_uw_b2 "" RAT_FUNC "%7.6" "-" COEFFS 0 65536 0 0 0 2 /end COMPU_METHOD
/begin COMPU_METHOD fak_uw_b4 "" RAT_FUNC "%7.6" "-" COEFFS 0 65536 0 0 0 4 /end COMPU_METHOD
/begin COMPU_METHOD fak_uw_b64 "" RAT_FUNC "%6.5" "-" COEFFS 0 65536 0 0 0 64 /end COMPU_METHOD
/begin COMPU_METHOD fak_uw_b8 "" RAT_FUNC "%6.5" "-" COEFFS 0 65536 0 0 0 8 /end COMPU_METHOD
/begin COMPU_METHOD luquant_w "Umrechnung Laufunruhe Word-Größen in DMD" RAT_FUNC "%6.4" "(Umdr./sec)^2" COEFFS 0 140.737 0 0 0 1 /end COMPU_METHOD
/begin COMPU_METHOD perio_ub_b0p012207 "" RAT_FUNC "%10.8" "1/s" COEFFS 0 256 0 0 0 0.012207 /end COMPU_METHOD
/begin COMPU_METHOD p_uw_b32 "" RAT_FUNC "%6.5" "hPa/%" COEFFS 0 65536 0 0 0 32 /end COMPU_METHOD
/begin COMPU_METHOD rel_uw_b0p3 "" RAT_FUNC "%8.7" "%/hPa" COEFFS 0 65536 0 0 0 0.3 /end COMPU_METHOD
/begin COMPU_METHOD rkti_sy "" RAT_FUNC "%6.4" "ms/%" COEFFS 0 562.5 0 0 0 1 /end COMPU_METHOD
/begin COMPU_METHOD rkt_ub_b0p546 "" RAT_FUNC "%6.4" "ms/%" COEFFS 0 256 0 0 0 0.5461 /end COMPU_METHOD
/begin COMPU_METHOD t10msxs_ub_b2p55 "" RAT_FUNC "%6.4" "s" COEFFS 0 1 0 0 0 0.01 /end COMPU_METHOD
/end MODULE
/end PROJECT
