/begin PROJECT _7804367 "156"
/begin HEADER "" VERSION "_7804367" PROJECT_NO _7804367 /end HEADER
/begin MODULE DIM ""
/begin MOD_COMMON "" BYTE_ORDER BIG_ENDIAN S_REC_LAYOUT DAMOS /end MOD_COMMON
/begin AXIS_PTS STM06LLUB "Stützstellenverteilung Motortemperatur, 6 Sst." 0x8180C1 tmot SstAUbSstUb 191.3 temp_ub_q0p75_o48 6 -48.00 143.3 FUNCTION_LIST SSTBER87 LLRNS LLRRM DEPOSIT ABSOLUT IF_DATA DIM_X DIRECT 0x8180C1 /end AXIS_PTS
/begin AXIS_PTS STM09ESUB "Stützstellenverteilung Motortemperatur, 9 Sst." 0x8180D8 tmot SstAUbSstUb 191.3 temp_ub_q0p75_o48 9 -48.00 143.3 FUNCTION_LIST SSTBER87 ESUK DEPOSIT ABSOLUT IF_DATA DIM_X DIRECT 0x8180D8 /end AXIS_PTS
/begin CHARACTERISTIC ZMDNSM "Zeitkonstante zur Abrgelung des Nachstart-Momentenoffset" CURVE 0x8197DE KlAUbSstUbWUb 50.8000 zk200msxs_ub_b51p2 0.200000 51.0000 FUNCTION_LIST MDVER IF_DATA DIM_X DIRECT 0x8197DE
 /begin AXIS_DESCR STD_AXIS tmot temp_ub_q0p75_o48 8 -48.00 143.3 DEPOSIT ABSOLUT /end AXIS_DESCR
/end CHARACTERISTIC
/begin CHARACTERISTIC ZMFTV1 "1. Zeitkonstante Filterung Momentenwunsch" VALUE 0x819D83 KwUb 5.08000 zk20msxs_ub_b5p1 0.0200000 5.10000 FUNCTION_LIST VS IF_DATA DIM_X DIRECT 0x819D83 /end CHARACTERISTIC
/begin CHARACTERISTIC ZMFTV2 "2. Zeitkonstante Filterung Momentenwunsch" VALUE 0x819D84 KwUb 5.08000 zk20msxs_ub_b5p1 0.0200000 5.10000 FUNCTION_LIST VS IF_DATA DIM_X DIRECT 0x819D84 /end CHARACTERISTIC
/begin CHARACTERISTIC ZMLETAN "Zeitkonstante für Filterung zur Berechnung des Leerlaufenergiebedarf für DTEV" VALUE 0x81E334 KwUw 9.90549466 zk100msxs_uw_b6553 0.100001526 10.0054962 FUNCTION_LIST DTEV IF_DATA DIM_X DIRECT 0x81E334 /end CHARACTERISTIC
/begin CHARACTERISTIC ZMLRO "Zeitkonstante mlroh-Tiefpaß bei Diagnose HFM/HLM" VALUE 0x810F5A KwUb 2.54000 zk10msxs_ub_b2p55 0.0100000 2.55000 FUNCTION_LIST DHFM IF_DATA DIM_X DIRECT 0x810F5A /end CHARACTERISTIC
/begin CHARACTERISTIC ZMLTE "Zeitkonstante für ml-Filter in beladungsabh. Tankentlüftung" VALUE 0x81E2F0 KwUw 6553.4999985 zk100msxs_uw_b655 0.10000152590 6553.6000000 FUNCTION_LIST TEB IF_DATA DIM_X DIRECT 0x81E2F0 /end CHARACTERISTIC
/begin CHARACTERISTIC ZMRFABN "berechnet aktuelle Zeitkonstante des Tiefpaß (Dauerhochlast) mrfabnf_w" CURVE 0x81C720 KlAUwSstSwWUw 6553.50000 zk100msxs_uw_b6553 0.100001526 6553.60000 FUNCTION_LIST BBTEGA IF_DATA DIM_X DIRECT 0x81C720
 /begin AXIS_DESCR STD_AXIS dmrfabn_w rel_sw_b100 5 -100.0000 99.99695 DEPOSIT ABSOLUT /end AXIS_DESCR
/end CHARACTERISTIC
/begin CHARACTERISTIC ZMSSGIN "Filterzeitkonstante für Berechnung der relativen Änderung von mssgin_w" VALUE 0x819B34 KwUb 25.4996 zk100msxs_ub_b25p5 0.100392 25.6000 FUNCTION_LIST TEB IF_DATA DIM_X DIRECT 0x819B34 /end CHARACTERISTIC
/begin CHARACTERISTIC ZMSTEDTE "Zeitkonstante für Filterung des berechneten Massenstrom TEV" VALUE 0x81E336 KwUw 14.9311911 zk100msxs_uw_b6553 0.100001526 15.0311927 FUNCTION_LIST DTEV IF_DATA DIM_X DIRECT 0x81E336 /end CHARACTERISTIC
/begin CHARACTERISTIC ZNFNGLL "Filterzeitkonstante für Drehzahlgradient auf Luftpfad (LLR)" VALUE 0x811652 KwUb 5.08000 zk20msxs_ub_b5p1 0.0200000 5.10000 FUNCTION_LIST LLRRM IF_DATA DIM_X DIRECT 0x811652 /end CHARACTERISTIC
/begin CHARACTERISTIC ZNGFIL "Zeitkonstante für Drehzahlgradient-Filter" VALUE 0x813B4A KwUw 655.350000 zk10msxs_uw_b655 0.0100001526 655.360000 FUNCTION_LIST BGNG IF_DATA DIM_X DIRECT 0x813B4A /end CHARACTERISTIC
/begin CHARACTERISTIC ZNGKR "Zeitkonstante Tiefpaß für Drehzahlgradient" VALUE 0x813FF4 KwUw 655.350000 zk10msxs_uw_b655 0.0100001526 655.360000 FUNCTION_LIST KRDY IF_DATA DIM_X DIRECT 0x813FF4 /end CHARACTERISTIC
/begin CHARACTERISTIC ZNOSTMX "Anzahl Zündung=ein ohne Erreichen von Startende für kein EKP-Vorlauf" VALUE 0x812B51 KwUb 255.0 dez 0.00 255.0 FUNCTION_LIST AEKP IF_DATA DIM_X DIRECT 0x812B51 /end CHARACTERISTIC
/begin CHARACTERISTIC ZNSM "Zeitkonstante für Solldrehzahlabregelung" CURVE 0x8115D8 GklWUb 5.08000 zk20msxs_ub_b5p1 0.0200000 5.10000 FUNCTION_LIST LLRNS IF_DATA DIM_X DIRECT 0x8115D8
 /begin AXIS_DESCR COM_AXIS tmot temp_ub_q0p75_o48 6 -48.00 143.3 AXIS_PTS_REF STM06LLUB /end AXIS_DESCR
/end CHARACTERISTIC
/begin CHARACTERISTIC ZNSUB "Zeitkonstante für Mindestsolldrehzahl bei Unterspannung" VALUE 0x819737 KwUb 50.8000 zk200msxs_ub_b51p2 0.200000 51.0000 FUNCTION_LIST LLRNS IF_DATA DIM_X DIRECT 0x819737 /end CHARACTERISTIC
/begin CHARACTERISTIC ZNWSH "Zeitkonstante Filter Gemischkorrektur bei Wechsel NWS spät nach früh" CURVE 0x813FB7 KlAUbSstUbWUb 2.54000 zk10msxs_ub_b2p55 0.0100000 2.55000 FUNCTION_LIST ESNWS IF_DATA DIM_X DIRECT 0x813FB7 /begin AXIS_DESCR STD_AXIS nmot nmot_ub_q40 8 0.00 10200. DEPOSIT ABSOLUT /end AXIS_DESCR /end CHARACTERISTIC
/begin CHARACTERISTIC ZNWSL "Zeitkonstante Filter Gemischkorrektur bei Wechel NWS früh nach spät" CURVE 0x813FC8 KlAUbSstUbWUb 2.54000 zk10msxs_ub_b2p55 0.0100000 2.55000 FUNCTION_LIST ESNWS IF_DATA DIM_X DIRECT 0x813FC8 /begin AXIS_DESCR STD_AXIS nmot nmot_ub_q40 8 0.00 10200. DEPOSIT ABSOLUT /end AXIS_DESCR /end CHARACTERISTIC
/begin CHARACTERISTIC ZNWSP "Zeitkonstante für Adaption-Spätanschlagposition" VALUE 0x810C5F KwUb 99.61 rel_ub_b99p6 0.00 99.61 FUNCTION_LIST WANWKW IF_DATA DIM_X DIRECT 0x810C5F /end CHARACTERISTIC
/begin CHARACTERISTIC ZPRDVS "Prüfzeit für Diagnose Ventilhub" VALUE 0x817694 KwUw 1310.700 t20msxs_uw_q0p02 0.00 1310.700 FUNCTION_LIST DVS IF_DATA DIM_X DIRECT 0x817694 /end CHARACTERISTIC
/begin CHARACTERISTIC ZPVDKR "Zeitkonstante für pvdkr-Filterung" CURVE 0x8152FA KlAUwSstUwWUw 655.350000 zk10msxs_uw_b655 0.0100001526 655.360000 FUNCTION_LIST FUEDK IF_DATA DIM_X DIRECT 0x8152FA
 /begin AXIS_DESCR STD_AXIS vpsspu_w fak_uw_b4 6 0.00 3.999939 DEPOSIT ABSOLUT /end AXIS_DESCR
/end CHARACTERISTIC
/begin CHARACTERISTIC ZRLTEDTE "Zeitkonstante für Filterung der berechneten Füllung TEV" VALUE 0x81E338 KwUw 6553.50000 zk100msxs_uw_b6553 0.100001526 6553.60000 FUNCTION_LIST DTEV IF_DATA DIM_X DIRECT 0x81E338 /end CHARACTERISTIC
/begin CHARACTERISTIC ZSYNABR "Zündungsanzahl für Entscheidung Adaptionsabbruch" VALUE 0x81146D KwUb 255.0 dez 0.00 255.0 FUNCTION_LIST STADAP IF_DATA DIM_X DIRECT 0x81146D /end CHARACTERISTIC
/begin CHARACTERISTIC ZSYNAUSW "Anzahl Zündungen (Synchros) bis Auswerten" VALUE 0x81146E KwUb 255.0 dez 0.00 255.0 FUNCTION_LIST STADAP IF_DATA DIM_X DIRECT 0x81146E /end CHARACTERISTIC
/begin CHARACTERISTIC ZTDAGR "Zeitkonstante Temperaturdynamik bei AGR Auf- Abschaltung" VALUE 0x81BF9A KwUw 6553.50000 zk100msxs_uw_b6553 0.100001526 6553.60000 FUNCTION_LIST BGTMPK IF_DATA DIM_X DIRECT 0x81BF9A /end CHARACTERISTIC
/begin CHARACTERISTIC ZTMMBR "Zeitkonstante Motortemperatur für Brennraumtempmodell" VALUE 0x81BF9C KwUw 6553.50000 zk100msxs_uw_b6553 0.100001526 6553.60000 FUNCTION_LIST BGTMPK IF_DATA DIM_X DIRECT 0x81BF9C /end CHARACTERISTIC
/begin CHARACTERISTIC ZTPREL "Anzahl Zähne während der Starterkennung" VALUE 0x810C07 KwUb 255.0 dez 0.00 255.0 FUNCTION_LIST GGDPG IF_DATA DIM_X DIRECT 0x810C07 /end CHARACTERISTIC
/begin CHARACTERISTIC ZUKE "Zeitkonstante ÜK-Ersatzwert" VALUE 0x81570A KwUw 655.350000 zk10msxs_uw_b655 0.0100001526 655.360000 FUNCTION_LIST ESUK IF_DATA DIM_X DIRECT 0x81570A /end CHARACTERISTIC
/begin CHARACTERISTIC ZUKK "Abregelfaktor Kurzzeitanteil" VALUE 0x811335 KwUb 0.9961 fak_ub_b1 0.00 0.9961 FUNCTION_LIST ESUK IF_DATA DIM_X DIRECT 0x811335 /end CHARACTERISTIC
/begin CHARACTERISTIC ZUKNST "Abregelzeitkonstante ÜK-Faktor im Nachstart" VALUE 0x81570C KwUw 6553.50000 zk100msxs_uw_b6553 0.100001526 6553.60000 FUNCTION_LIST ESUK IF_DATA DIM_X DIRECT 0x81570C /end CHARACTERISTIC
/begin CHARACTERISTIC ZVALM "Abregelfaktor L-Speicher (tmot) VA" CURVE 0x818B58 GklWUb 0.1245 fak_ub_b0p125 0.00 0.1245 FUNCTION_LIST ESUK IF_DATA DIM_X DIRECT 0x818B58
 /begin AXIS_DESCR COM_AXIS tmot temp_ub_q0p75_o48 9 -48.00 143.3 AXIS_PTS_REF STM09ESUB /end AXIS_DESCR
/end CHARACTERISTIC
/begin CHARACTERISTIC ZVSGK "Zeitkonstante Filter Gemischkorrektur bei Wechsel Ventilhub groß nach klein" CURVE 0x8122D1 KlAUbSstUbWUb 2.54000 zk10msxs_ub_b2p55 0.0100000 2.55000 FUNCTION_LIST esvs IF_DATA DIM_X DIRECT 0x8122D1 /begin AXIS_DESCR STD_AXIS nmot nmot_ub_q40 8 0.00 10200. DEPOSIT ABSOLUT /end AXIS_DESCR /end CHARACTERISTIC
/begin CHARACTERISTIC ZVSKG "Zeitkonstante Filter Gemischkorrektur bei Wechsel Ventilhub klein nach groß" CURVE 0x8122E2 KlAUbSstUbWUb 2.54000 zk10msxs_ub_b2p55 0.0100000 2.55000 FUNCTION_LIST esvs IF_DATA DIM_X DIRECT 0x8122E2 /begin AXIS_DESCR STD_AXIS nmot nmot_ub_q40 8 0.00 10200. DEPOSIT ABSOLUT /end AXIS_DESCR /end CHARACTERISTIC
/begin CHARACTERISTIC ZVTPRGOS "Zeitkonstante Tiefpassfilterung ohne Saugrohr und Ventilhubumschaltung" VALUE 0x813F52 KwUw 655.350000 zk10msxs_uw_b655 0.0100001526 655.360000 FUNCTION_LIST BGSRM IF_DATA DIM_X DIRECT 0x813F52 /end CHARACTERISTIC
/begin CHARACTERISTIC ZVTPRGSU "Zeitkonstante Tiefpaßfilterung bei Saugrohrklappendynamik" VALUE 0x813F54 KwUw 655.350000 zk10msxs_uw_b655 0.0100001526 655.360000 FUNCTION_LIST BGSRM IF_DATA DIM_X DIRECT 0x813F54 /end CHARACTERISTIC
/begin CHARACTERISTIC ZVTPRGVS "Zeitkonstante Tiefpaßfilter bei Ventilhubumschaltung" CURVE 0x81C5A2 KlAUwSstUwWUw 655.350000 zk10msxs_uw_b655 0.0100001526 655.360000 FUNCTION_LIST BGSRM IF_DATA DIM_X DIRECT 0x81C5A2
 /begin AXIS_DESCR STD_AXIS nmot_w nmot_uw_q0p25 6 0.00 16383.75 DEPOSIT ABSOLUT /end AXIS_DESCR
/end CHARACTERISTIC
/begin CHARACTERISTIC ZWAPPL "Applikationsschnittstelle Zündwinkelverstellung" VALUE 0x8123D2 KwSb 191.3 zw_sb_q0p75 -96.00 95.25 FUNCTION_LIST ZUE IF_DATA DIM_X DIRECT 0x8123D2 /end CHARACTERISTIC
/begin CHARACTERISTIC ZWC_T_UM "Fehlertoleranzzeit der Zündwinkelüberwachung in der Funktionsüberw." VALUE 0x817D11 KwUb 255.0 dez 0.00 255.0 FUNCTION_LIST UFZWC IF_DATA DIM_X DIRECT 0x817D11 /end CHARACTERISTIC
/begin CHARACTERISTIC ZWDKM1 "1. Zeitkonstante Dk-Modell" VALUE 0x813FA2 KwUw 2.550000 zk10msxs_uw_b2p55T 0.00 2.550000 FUNCTION_LIST BGWDKM IF_DATA DIM_X DIRECT 0x813FA2 /end CHARACTERISTIC
/begin CHARACTERISTIC ZWDKM2 "2. Zeitkonstante Dk-Modell" VALUE 0x813FA4 KwUw 2.550000 zk10msxs_uw_b2p55T 0.00 2.550000 FUNCTION_LIST BGWDKM IF_DATA DIM_X DIRECT 0x813FA4 /end CHARACTERISTIC
/begin CHARACTERISTIC ZWOUT_DAT_UC "" VAL_BLK 0x811E3C KwbUb 191.3 zw_sb_q0p75 0.00 191.3 NUMBER 16 FUNCTION_LIST URCEIN IF_DATA DIM_X DIRECT 0x811E3C /end CHARACTERISTIC
/begin CHARACTERISTIC ZWSWVS1 "Intergratorsteigung bei Einschaltung ZW-Eingriff durch Ventilhubsteuerung" VALUE 0x812B4B KwSb 191.3 zw_sb_q0p75 -96.00 95.25 FUNCTION_LIST ZWVS IF_DATA DIM_X DIRECT 0x812B4B /end CHARACTERISTIC
/begin CHARACTERISTIC ZWSWVS2 "Integratorsteigung nach Ausschalten ZW-Eingriff durch Ventilhubsteuerung" VALUE 0x812B4C KwSb 191.3 zw_sb_q0p75 -96.00 95.25 FUNCTION_LIST ZWVS IF_DATA DIM_X DIRECT 0x812B4C /end CHARACTERISTIC
/begin CHARACTERISTIC ZYLANZ_UM "Zylinderzahl für die Zündwinkelüberwachung in der Funktionsüberw." VALUE 0x817D12 KwUb 255.0 dez 0.00 255.0 FUNCTION_LIST UFZWC IF_DATA DIM_X DIRECT 0x817D12 /end CHARACTERISTIC
/begin CHARACTERISTIC ZYLEAUS "auszublendender Zylinder" VALUE 0x810C59 KwUb 255.0 dez 0.00 255.0 FUNCTION_LIST NLPH IF_DATA DIM_X DIRECT 0x810C59 /end CHARACTERISTIC
/begin CHARACTERISTIC ZYLKOR "Wert zur Zylinderkorrektur (tsroh zu zzyldmd)" VALUE 0x810895 KwUb 5.000 dez 0.00 5.000 FUNCTION_LIST DMDTSB IF_DATA DIM_X DIRECT 0x810895 /end CHARACTERISTIC
/begin CHARACTERISTIC ZYRKR "Zylinderzuordnung für maximale Referenzpegelbegrenzung Klopfregelung" VALUE 0x81928B KwUb 255.0 dez 0.00 255.0 FUNCTION_LIST KRKE IF_DATA DIM_X DIRECT 0x81928B /end CHARACTERISTIC
/begin CHARACTERISTIC ZZWEETM "Umschaltschwelle Vorlagerungswinkel" CURVE 0x818C2F KlAUbSstUbWUb 255.0 dez 0.00 255.0 FUNCTION_LIST ESVW IF_DATA DIM_X DIRECT 0x818C2F
 /begin AXIS_DESCR STD_AXIS tmst temp_ub_q0p75_o48 8 -48.00 143.3 DEPOSIT ABSOLUT /end AXIS_DESCR
/end CHARACTERISTIC
/begin MEASUREMENT abak "Aufteilungsfaktor Wandfilm bei BA" UBYTE fak_ub_b1 1 100 0 0.996094 FUNCTION_LIST ESUK IF_DATA DIM_X 0x380B28 EXTERN WORD IF_DATA MCMESS 0x380B28 EXTERN /end MEASUREMENT
/begin MEASUREMENT abmf "Festeinspritzausblendmuster" UBYTE dez 1 100 0 255 FUNCTION_LIST AEVAB BGEVAB IF_DATA DIM_X 0x380B0A EXTERN WORD IF_DATA MCMESS 0x380B0A EXTERN /end MEASUREMENT
/begin MEASUREMENT adastep "Adaptionsschritt für STADAP-Faktor" SBYTE fak_sb_b1 1 100 -1 0.992188 FUNCTION_LIST STADAP IF_DATA DIM_X 0x380B46 EXTERN WORD IF_DATA MCMESS 0x380B46 EXTERN /end MEASUREMENT
/begin MEASUREMENT adcc_c_um "Fehlerzähler bei zueinander unplausiblen ADC-Werten für sp1s" UBYTE t10msxs_ub_b2p55 1 100 0 2.55 FUNCTION_LIST URADCC IF_DATA DIM_X 0x382E82 EXTERN WORD IF_DATA MCMESS 0x382E82 EXTERN /end MEASUREMENT
/begin MEASUREMENT ADC_Urefsp1_w "" UWORD spg_uw_b5 1 100 0 319.995 FUNCTION_LIST ADC GGPEDV VHW IF_DATA DIM_X 0x380F54 EXTERN WORD IF_DATA MCMESS 0x380F54 EXTERN /end MEASUREMENT
/begin MEASUREMENT ADC_Urefsp2_w "" UWORD spg_uw_b5 1 100 0 319.995 FUNCTION_LIST ADC GGPEDV VHW IF_DATA DIM_X 0x380F56 EXTERN WORD IF_DATA MCMESS 0x380F56 EXTERN /end MEASUREMENT
/begin MEASUREMENT ADC_Uspoti1_w "" UWORD spg_uw_b5 1 100 0 319.995 FUNCTION_LIST ADC GGPEDV VHW IF_DATA DIM_X 0x380F58 EXTERN WORD IF_DATA MCMESS 0x380F58 EXTERN /end MEASUREMENT
/begin MEASUREMENT ADC_Uspoti2_w "" UWORD spg_uw_b5 1 100 0 319.995 FUNCTION_LIST ADC GGPEDV VHW IF_DATA DIM_X 0x380F5A EXTERN WORD IF_DATA MCMESS 0x380F5A EXTERN /end MEASUREMENT
/begin MEASUREMENT AEKPintbits "" UBYTE dez 1 100 0 255 FUNCTION_LIST AEKP IF_DATA DIM_X 0x38311D EXTERN WORD IF_DATA MCMESS 0x38311D EXTERN /end MEASUREMENT
/begin MEASUREMENT afnmn "Bereichsfenster Aussetzer, minimale Drehzahl" UBYTE nmot_ub_q40 1 100 0 10200 FUNCTION_LIST DMDMIL T2LID IF_DATA DIM_X 0x382FC0 EXTERN WORD IF_DATA MCMESS 0x382FC0 EXTERN /end MEASUREMENT
/begin MEASUREMENT afnmx "Bereichsfenster Aussetzer, maximale Drehzahl" UBYTE nmot_ub_q40 1 100 0 10200 FUNCTION_LIST DMDMIL T2LID IF_DATA DIM_X 0x382FC1 EXTERN WORD IF_DATA MCMESS 0x382FC1 EXTERN /end MEASUREMENT
/begin MEASUREMENT afrlmn "Bereichsfenster Aussetzer, minimale Last" UBYTE rel_ub_q0p75 1 100 0 191.25 FUNCTION_LIST DMDMIL T2LID IF_DATA DIM_X 0x382FC2 EXTERN WORD IF_DATA MCMESS 0x382FC2 EXTERN /end MEASUREMENT
/begin MEASUREMENT afrlmx "Bereichsfenster Aussetzer, maximale Last" UBYTE rel_ub_q0p75 1 100 0 191.25 FUNCTION_LIST DMDMIL T2LID IF_DATA DIM_X 0x382FC3 EXTERN WORD IF_DATA MCMESS 0x382FC3 EXTERN /end MEASUREMENT
/begin MEASUREMENT aftnmn "Bereichsfenster Aussetzer, minimale Drehzahl, temporär" UBYTE nmot_ub_q40 1 100 0 10200 FUNCTION_LIST DMDMIL IF_DATA DIM_X 0x3809C1 EXTERN WORD IF_DATA MCMESS 0x3809C1 EXTERN /end MEASUREMENT
/begin MEASUREMENT aftnmx "Bereichsfenster Aussetzer, maximale Drehzahl, temporär" UBYTE nmot_ub_q40 1 100 0 10200 FUNCTION_LIST DMDMIL IF_DATA DIM_X 0x3809C2 EXTERN WORD IF_DATA MCMESS 0x3809C2 EXTERN /end MEASUREMENT
/begin MEASUREMENT aftrlmn "Bereichsfenster Aussetzer, minimale Last, temporär" UBYTE rel_ub_q0p75 1 100 0 191.25 FUNCTION_LIST DMDMIL IF_DATA DIM_X 0x3809C3 EXTERN WORD IF_DATA MCMESS 0x3809C3 EXTERN /end MEASUREMENT
/begin MEASUREMENT aftrlmx "Bereichsfenster Aussetzer, maximale Last, temporär" UBYTE rel_ub_q0p75 1 100 0 191.25 FUNCTION_LIST DMDMIL IF_DATA DIM_X 0x3809C4 EXTERN WORD IF_DATA MCMESS 0x3809C4 EXTERN /end MEASUREMENT
/begin MEASUREMENT agrr "Abgasrückführrate" UBYTE rel_ub_b99p6 1 100 0 99.6094 FUNCTION_LIST BGSRM MDBAS IF_DATA DIM_X 0x380AF6 EXTERN WORD IF_DATA MCMESS 0x380AF6 EXTERN /end MEASUREMENT
/begin MEASUREMENT agrr_w "Abgasrückführrate word" UWORD rel_uw_b100 1 100 0 99.9985 FUNCTION_LIST BGSRM BGTMPK IF_DATA DIM_X 0x3820C8 EXTERN WORD IF_DATA MCMESS 0x3820C8 EXTERN /end MEASUREMENT
/begin MEASUREMENT ahearv_w "Aussetzerhäufigkeit zum Erreichen der Ausblendung anderer Funktionen (aus AHEARV" UWORD dez 1 100 0 65535 FUNCTION_LIST DMDMIL IF_DATA DIM_X 0x3819C0 EXTERN WORD IF_DATA MCMESS 0x3819C0 EXTERN /end MEASUREMENT
/begin MEASUREMENT ahkat "Mittelwert der Amplitude Sondensignal hinter Kat. korrigiert mit KB" UBYTE fak_ub_b1 1 100 0 0.996094 FUNCTION_LIST DKATLRS DFFTK T2LID IF_DATA DIM_X 0x380A60 EXTERN WORD IF_DATA MCMESS 0x380A60 EXTERN /end MEASUREMENT
/begin MEASUREMENT ahkat2 "Mittelwert der Amplitude Sondensignal hinter Kat. korrigiert mit KB (2.Bank)" UBYTE fak_ub_b1 1 100 0 0.996094 FUNCTION_LIST DKATLRS DFFTK T2LID IF_DATA DIM_X 0x380A61 EXTERN WORD IF_DATA MCMESS 0x380A61 EXTERN /end MEASUREMENT
/begin MEASUREMENT ahkatn "Amplitude Sondensignal hinter Katalysator normiert" UBYTE fak_ub_b1 1 100 0 0.996094 FUNCTION_LIST DKATLRS T2LID IF_DATA DIM_X 0x380A62 EXTERN WORD IF_DATA MCMESS 0x380A62 EXTERN /end MEASUREMENT
/begin MEASUREMENT ahkatn2 "Amplitude Sondensignal hinter Katalysator normiert (Stereo 2.Bank)" UBYTE fak_ub_b1 1 100 0 0.996094 FUNCTION_LIST DKATLRS T2LID IF_DATA DIM_X 0x380A63 EXTERN WORD IF_DATA MCMESS 0x380A63 EXTERN /end MEASUREMENT
/begin MEASUREMENT ahktki2_w "Amplitude Sondensignal hinter Kat. korrigiert und integiert" UWORD t50msxs_uw_b819p2 1 100 0 819.188 FUNCTION_LIST DKATLRS IF_DATA DIM_X 0x381C4C EXTERN WORD IF_DATA MCMESS 0x381C4C EXTERN /end MEASUREMENT
/begin MEASUREMENT ahktki_w "Amplitude Sondensignal hinter Katalysator korrigiert und integiert" UWORD t50msxs_uw_b819p2 1 100 0 819.188 FUNCTION_LIST DKATLRS IF_DATA DIM_X 0x381C4E EXTERN WORD IF_DATA MCMESS 0x381C4E EXTERN /end MEASUREMENT
/begin MEASUREMENT ahktnk "Korrigierte Sondensignal-Amplitude normiert" UBYTE fak_ub_b1 1 100 0 0.996094 FUNCTION_LIST DKATLRS IF_DATA DIM_X 0x380A64 EXTERN WORD IF_DATA MCMESS 0x380A64 EXTERN /end MEASUREMENT
/begin MEASUREMENT ahktnk2 "korrigierte Sondensignal-Amplitude normiert (Stereo 2.Bank)" UBYTE fak_ub_b1 1 100 0 0.996094 FUNCTION_LIST DKATLRS IF_DATA DIM_X 0x380A65 EXTERN WORD IF_DATA MCMESS 0x380A65 EXTERN /end MEASUREMENT
/begin MEASUREMENT aint_0_A "" UBYTE dez 1 100 0 255 FUNCTION_LIST DMDMIL IF_DATA DIM_X 0x3809C5 EXTERN WORD IF_DATA MCMESS 0x3809C5 EXTERN /end MEASUREMENT
/begin MEASUREMENT aint_1_A "" UBYTE dez 1 100 0 255 FUNCTION_LIST DMDMIL IF_DATA DIM_X 0x3809C6 EXTERN WORD IF_DATA MCMESS 0x3809C6 EXTERN /end MEASUREMENT
/begin MEASUREMENT aint_2_A "" UBYTE dez 1 100 0 255 FUNCTION_LIST DMDMIL IF_DATA DIM_X 0x3809C7 EXTERN WORD IF_DATA MCMESS 0x3809C7 EXTERN /end MEASUREMENT
/begin MEASUREMENT aint_3_A "" UBYTE dez 1 100 0 255 FUNCTION_LIST DMDMIL IF_DATA DIM_X 0x3809C8 EXTERN WORD IF_DATA MCMESS 0x3809C8 EXTERN /end MEASUREMENT
/begin MEASUREMENT aint_4_A "" UBYTE dez 1 100 0 255 FUNCTION_LIST DMDMIL IF_DATA DIM_X 0x3809C9 EXTERN WORD IF_DATA MCMESS 0x3809C9 EXTERN /end MEASUREMENT
/begin MEASUREMENT aint_5_A "" UBYTE dez 1 100 0 255 FUNCTION_LIST DMDMIL IF_DATA DIM_X 0x3809CA EXTERN WORD IF_DATA MCMESS 0x3809CA EXTERN /end MEASUREMENT
/begin MEASUREMENT aintkamin "Anzahl Intervalle mit Katschädigung für Ti-Abschaltung, Minimalwert" UBYTE dez 1 100 0 255 FUNCTION_LIST DMDMIL IF_DATA DIM_X 0x3809BF EXTERN WORD IF_DATA MCMESS 0x3809BF EXTERN /end MEASUREMENT
/begin MEASUREMENT akatbn "Amplitude der Katalysatorbelastungssignal" UBYTE fak_ub_b1 1 100 0 0.996094 FUNCTION_LIST DKATLRS T2LID IF_DATA DIM_X 0x380A66 EXTERN WORD IF_DATA MCMESS 0x380A66 EXTERN /end MEASUREMENT
/begin MEASUREMENT akatbn2 "Amplitude des Katalysatorbelastungssignals (Stereo 2.Bank)" UBYTE fak_ub_b1 1 100 0 0.996094 FUNCTION_LIST DKATLRS T2LID IF_DATA DIM_X 0x380A67 EXTERN WORD IF_DATA MCMESS 0x380A67 EXTERN /end MEASUREMENT
/begin MEASUREMENT akatbnk "korrigierte Amplitude der Katalysatorbelastungssignal" UBYTE fak_ub_b1 1 100 0 0.996094 FUNCTION_LIST DKATLRS IF_DATA DIM_X 0x380A58 EXTERN WORD IF_DATA MCMESS 0x380A58 EXTERN /end MEASUREMENT
/begin MEASUREMENT akatbnk2 "korrigierte Amplitude der Katalysatorbelastungssignal, Bank2" UBYTE fak_ub_b1 1 100 0 0.996094 FUNCTION_LIST DKATLRS IF_DATA DIM_X 0x380A59 EXTERN WORD IF_DATA MCMESS 0x380A59 EXTERN /end MEASUREMENT
/begin MEASUREMENT aleNvBits "" UBYTE dez 1 100 0 255 FUNCTION_LIST ALE IF_DATA DIM_X 0x382FD8 EXTERN WORD IF_DATA MCMESS 0x382FD8 EXTERN /end MEASUREMENT
/begin MEASUREMENT anwfoh "zählt Anzahl der NW-Umdr. für Heilung der fuel-on/-off Adaption" UBYTE dez 1 100 0 255 FUNCTION_LIST DMDFON IF_DATA DIM_X 0x3809AD EXTERN WORD IF_DATA MCMESS 0x3809AD EXTERN /end MEASUREMENT
/begin MEASUREMENT anwfos "zählt Anzahl der NW-Umdr. von Bedingungen für Adaption erfüllt bis Lernbeginn" UBYTE dez 1 100 0 255 FUNCTION_LIST DMDFON IF_DATA DIM_X 0x3809AC EXTERN WORD IF_DATA MCMESS 0x3809AC EXTERN /end MEASUREMENT
/begin MEASUREMENT anzainten "Anzahl Intervalle nach Start für Freigabe Ti-Abschaltung (200 KWU)" UBYTE dez 1 100 0 255 FUNCTION_LIST DMDMIL IF_DATA DIM_X 0x3809C0 EXTERN WORD IF_DATA MCMESS 0x3809C0 EXTERN /end MEASUREMENT
/begin MEASUREMENT anzdyn "Anzahl der Dynamikmessungen LSU" UBYTE dez 1 100 0 255 FUNCTION_LIST DLSU T2LID IF_DATA DIM_X 0x380A83 EXTERN WORD IF_DATA MCMESS 0x380A83 EXTERN /end MEASUREMENT
/begin MEASUREMENT anzdyn2 "Anzahl der Dynamikmessungen LSU2" UBYTE dez 1 100 0 255 FUNCTION_LIST DLSU T2LID IF_DATA DIM_X 0x380A84 EXTERN WORD IF_DATA MCMESS 0x380A84 EXTERN /end MEASUREMENT
/begin MEASUREMENT anzeab "Anzahl Segmente Ev-Abschaltung für Notlauf Phasensuche" UBYTE dez 1 100 0 255 FUNCTION_LIST AEVAB IF_DATA DIM_X 0x380B0B EXTERN WORD IF_DATA MCMESS 0x380B0B EXTERN /end MEASUREMENT
/begin MEASUREMENT anzeausb "Anzahl der auszublendenen Einspritzungen; begrenzt zwischen 4 und 7" UBYTE dez 1 100 0 255 FUNCTION_LIST NLPH AEVAB IF_DATA DIM_X 0x380A35 EXTERN WORD IF_DATA MCMESS 0x380A35 EXTERN /end MEASUREMENT
/begin MEASUREMENT anzfkuka "Anzahl berechnete Korrekturfaktoren während ÜK-Eingriff (ÜK-Adaption)" UBYTE dez 1 100 0 255 FUNCTION_LIST ESUKAS IF_DATA DIM_X 0x380B31 EXTERN WORD IF_DATA MCMESS 0x380B31 EXTERN /end MEASUREMENT
/begin MEASUREMENT anzfkuka2 "Anzahl berechnete Korrekturfaktoren während ÜK-Eingriff Bank 2 (ÜK-Adaption)" UBYTE dez 1 100 0 255 FUNCTION_LIST ESUKAS IF_DATA DIM_X 0x380B32 EXTERN WORD IF_DATA MCMESS 0x380B32 EXTERN /end MEASUREMENT
/begin MEASUREMENT anzgangw "Anzahl erkannter Gangwechsel" UBYTE dez 1 100 0 255 FUNCTION_LIST DKUPPL IF_DATA DIM_X 0x380A97 EXTERN WORD IF_DATA MCMESS 0x380A97 EXTERN /end MEASUREMENT
/begin MEASUREMENT anzhfma_w "Anzahl der HFM-Abtastungen über ein Synchro" UWORD dez 1 100 0 65535 FUNCTION_LIST GGHFM IF_DATA DIM_X 0xFAC4 INTERN WORD IF_DATA MCMESS 0xFAC4 INTERN /end MEASUREMENT
/begin MEASUREMENT anzkupplb "Anzahl erkannter Kupplungsbetätigungen" UBYTE dez 1 100 0 255 FUNCTION_LIST DKUPPL DFFTK IF_DATA DIM_X 0x380A98 EXTERN WORD IF_DATA MCMESS 0x380A98 EXTERN /end MEASUREMENT
/begin MEASUREMENT anzti "ti-Einspritzzähler" UBYTE dez 1 100 0 255 FUNCTION_LIST ACIFI ESUK ESWE KVA IF_DATA DIM_X 0xFA4C INTERN WORD IF_DATA MCMESS 0xFA4C INTERN /end MEASUREMENT
/begin MEASUREMENT anztib "Einspritzzähler begrenzt" UBYTE dez 1 100 0 255 FUNCTION_LIST ESVW IF_DATA DIM_X 0x380B37 EXTERN WORD IF_DATA MCMESS 0x380B37 EXTERN /end MEASUREMENT
/begin MEASUREMENT anztib_w "ti-Einspritzzähler mit Begrenzung" UWORD dez 1 100 0 65535 FUNCTION_LIST ESNST ESVW ESWL LAKH SSTBER87 IF_DATA DIM_X 0x38225A EXTERN WORD IF_DATA MCMESS 0x38225A EXTERN /end MEASUREMENT
/begin MEASUREMENT anztis "Anzahl vom CIFI initialisierter ti's (Synchro-Abtastung)" UBYTE dez 1 100 0 255 FUNCTION_LIST ESUK IF_DATA DIM_X 0x380B2E EXTERN WORD IF_DATA MCMESS 0x380B2E EXTERN /end MEASUREMENT
/begin MEASUREMENT anztist "ti-Einspritzzähler im Start" UBYTE dez 1 100 0 255 FUNCTION_LIST ESSTT IF_DATA DIM_X 0x380B26 EXTERN WORD IF_DATA MCMESS 0x380B26 EXTERN /end MEASUREMENT
/begin MEASUREMENT anzti_w "ti-Einspritzzähler" UWORD dez 1 100 0 65535 FUNCTION_LIST ACIFI ESNST ESSTT IF_DATA DIM_X 0xFA7C INTERN WORD IF_DATA MCMESS 0xFA7C INTERN /end MEASUREMENT
/begin MEASUREMENT anztpdn "Anzahl der hintereinander erfolgten Tip-Downs" UBYTE dez 1 100 0 255 FUNCTION_LIST FGRMD IF_DATA DIM_X 0x380AD6 EXTERN WORD IF_DATA MCMESS 0x380AD6 EXTERN /end MEASUREMENT
/begin MEASUREMENT anztpup "Anzahl der hintereinander erfolgten Tip-Ups" UBYTE dez 1 100 0 255 FUNCTION_LIST FGRMD IF_DATA DIM_X 0x380AD7 EXTERN WORD IF_DATA MCMESS 0x380AD7 EXTERN /end MEASUREMENT
/begin MEASUREMENT anzudsl_w "Anzahl Abtastungen Drucksensor Ladedruck über einem Segment(word)" UWORD dez 1 100 0 65535 FUNCTION_LIST GGDSAS IF_DATA DIM_X 0xFAB6 INTERN WORD IF_DATA MCMESS 0xFAB6 INTERN /end MEASUREMENT
/begin MEASUREMENT anzumrl_w "Anzahl der Umschaltungen auf rl aus DK-Signal berechnet" UWORD dez 1 100 0 65535 FUNCTION_LIST BGMSZS IF_DATA DIM_X 0x3839AE EXTERN WORD IF_DATA MCMESS 0x3839AE EXTERN /end MEASUREMENT
/begin MEASUREMENT anzwefim "Anzahl der abgearbeiteten Wiedereinsetzfaktoren" UBYTE dez 1 100 0 255 FUNCTION_LIST ESWE IF_DATA DIM_X 0x380B3C EXTERN WORD IF_DATA MCMESS 0x380B3C EXTERN /end MEASUREMENT
/begin MEASUREMENT apdtev "Anzahl der erfolgreichen DTEV Prüfungen" UBYTE dez 1 100 0 255 FUNCTION_LIST DTEV IF_DATA DIM_X 0x380CCB EXTERN WORD IF_DATA MCMESS 0x380CCB EXTERN /end MEASUREMENT
/begin MEASUREMENT apedkt "Anzahl der Prüfungen mit Fehlerergebnis bei Katdiagnose" UBYTE dez 1 100 0 255 FUNCTION_LIST DKATLRS IF_DATA DIM_X 0x380A68 EXTERN WORD IF_DATA MCMESS 0x380A68 EXTERN /end MEASUREMENT
/begin MEASUREMENT apedkt2 "Anzahl der Prüfungen mit Fehlerergebnis bei Katdiagnose (Bank2)" UBYTE dez 1 100 0 255 FUNCTION_LIST DKATLRS IF_DATA DIM_X 0x380A69 EXTERN WORD IF_DATA MCMESS 0x380A69 EXTERN /end MEASUREMENT
/begin MEASUREMENT ATMbits "" UBYTE dez 1 100 0 255 FUNCTION_LIST ATM SLS IF_DATA DIM_X 0x382FDD EXTERN WORD IF_DATA MCMESS 0x382FDD EXTERN /end MEASUREMENT
/begin MEASUREMENT ausgh_c_um "Heilungszähler für Fehler in der zyklischen RAM-Prüfung der Funktionsüberwachung" UBYTE t40ms_ub_b10200 1 100 0 10200 FUNCTION_LIST URAUSG IF_DATA DIM_X 0x382E87 EXTERN WORD IF_DATA MCMESS 0x382E87 EXTERN /end MEASUREMENT
/begin MEASUREMENT ausg_c_um "Fehlerzähler für zyklische RAM-Prüfung in der Funktionsüberwachung" UBYTE dezsub1 1 100 1 256 FUNCTION_LIST URAUSG IF_DATA DIM_X 0x382E88 EXTERN WORD IF_DATA MCMESS 0x382E88 EXTERN /end MEASUREMENT
/begin MEASUREMENT auszh_c_um "Heilungszähler für Fehler in der zyklischen ROM-Prüfung der Funktionsüberwachung" UBYTE t40ms_ub_b10200 1 100 0 10200 FUNCTION_LIST URAUSG IF_DATA DIM_X 0x382E89 EXTERN WORD IF_DATA MCMESS 0x382E89 EXTERN /end MEASUREMENT
/begin MEASUREMENT ausz_c_um "Fehlerzähler für zyklische ROM-Prüfung in der Funktionsüberwachung" UBYTE dezsub1 1 100 1 256 FUNCTION_LIST URAUSG IF_DATA DIM_X 0x382E8A EXTERN WORD IF_DATA MCMESS 0x382E8A EXTERN /end MEASUREMENT
/begin MEASUREMENT avak "Aufteilungsfaktor Wandfilm bei VA" UBYTE fak_ub_b1 1 100 0 0.996094 FUNCTION_LIST ESUK IF_DATA DIM_X 0x380B29 EXTERN WORD IF_DATA MCMESS 0x380B29 EXTERN /end MEASUREMENT
/begin MEASUREMENT avdtev "Anzahl der nicht erfolgreichen DTEV Prüfversuche" UBYTE dez 1 100 0 255 FUNCTION_LIST DTEV IF_DATA DIM_X 0x380CCC EXTERN WORD IF_DATA MCMESS 0x380CCC EXTERN /end MEASUREMENT
/begin MEASUREMENT avkatf "AmplitudenVerhältnis laafh/laafv gefiltert" UBYTE fak_ub_b1 1 100 0 0.996094 FUNCTION_LIST DKATLRS LRSHK T2LID IF_DATA DIM_X 0x382FE7 EXTERN WORD IF_DATA MCMESS 0x382FE7 EXTERN /end MEASUREMENT
/begin MEASUREMENT avkatf2 "Amplitudenverhältnis laafh/laafv gefiltert Bank2" UBYTE fak_ub_b1 1 100 0 0.996094 FUNCTION_LIST DKATLRS LRSHK T2LID IF_DATA DIM_X 0x382FE8 EXTERN WORD IF_DATA MCMESS 0x382FE8 EXTERN /end MEASUREMENT
/begin MEASUREMENT azlrdkt "Lambdaregler-Zwangsamplitude aus Kat-Diagnose" UBYTE fak_ub_b0p25 1 100 0 0.249023 FUNCTION_LIST DKATLRS LRS IF_DATA DIM_X 0x380A6A EXTERN WORD IF_DATA MCMESS 0x380A6A EXTERN /end MEASUREMENT
/begin MEASUREMENT azpdtefre "Anzahl Prüfungen Faktor Lambdaregelung auf eingeschwungen" UBYTE dez 1 100 0 255 FUNCTION_LIST DTEV IF_DATA DIM_X 0x380CCD EXTERN WORD IF_DATA MCMESS 0x380CCD EXTERN /end MEASUREMENT
/begin MEASUREMENT azycnt "Anzahl der wg. katschädigender Aussetzer abgeschalteten Zylinder" UBYTE dez 1 100 0 255 FUNCTION_LIST DMDMIL IF_DATA DIM_X 0x3809CB EXTERN WORD IF_DATA MCMESS 0x3809CB EXTERN /end MEASUREMENT
/begin MEASUREMENT azylwe "Anzahl wiedereingesetzter Zylinder" UBYTE dez 1 100 0 255 FUNCTION_LIST ESWE IF_DATA DIM_X 0x380B3D EXTERN WORD IF_DATA MCMESS 0x380B3D EXTERN /end MEASUREMENT
/begin MEASUREMENT bbdcy "Byte für Bedingung B_dcy als Triggerevent in DCLA" UBYTE dez 1 100 0 255 FUNCTION_LIST DDCY DMDMIL DTRIG IF_DATA DIM_X 0x3809D7 EXTERN WORD IF_DATA MCMESS 0x3809D7 EXTERN /end MEASUREMENT
/begin MEASUREMENT bbdmdmil "" UBYTE dez 1 100 0 255 FUNCTION_LIST DMDMIL IF_DATA DIM_X 0x382FC4 EXTERN WORD IF_DATA MCMESS 0x382FC4 EXTERN /end MEASUREMENT
/begin MEASUREMENT BBFGRlokBits "" UBYTE dez 1 100 0 255 FUNCTION_LIST BBFGR IF_DATA DIM_X 0x380AD4 EXTERN WORD IF_DATA MCMESS 0x380AD4 EXTERN /end MEASUREMENT
/begin MEASUREMENT bbno "Byte für Bedingung B_no  als Triggerevent in DCLA" UBYTE dez 1 100 0 255 FUNCTION_LIST DFPM DTRIG IF_DATA DIM_X 0x382FC7 EXTERN WORD IF_DATA MCMESS 0x382FC7 EXTERN /end MEASUREMENT
/begin MEASUREMENT BBSAWElokbits "" UBYTE dez 1 100 0 255 FUNCTION_LIST BBSAWE IF_DATA DIM_X 0x380BFF EXTERN WORD IF_DATA MCMESS 0x380BFF EXTERN /end MEASUREMENT
/begin MEASUREMENT bbsp1 "Byte für Bedingung B_sp1 als Triggerevent in DCLA" UBYTE dez 1 100 0 255 FUNCTION_LIST DMDMIL DTRIG IF_DATA DIM_X 0x3809CC EXTERN WORD IF_DATA MCMESS 0x3809CC EXTERN /end MEASUREMENT
/begin MEASUREMENT bbsp2 "Byte für Bedingung B_sp2 als Triggerevent in DCLA" UBYTE dez 1 100 0 255 FUNCTION_LIST DMDMIL DTRIG IF_DATA DIM_X 0x3809CD EXTERN WORD IF_DATA MCMESS 0x3809CD EXTERN /end MEASUREMENT
/begin MEASUREMENT bbsp3 "Byte für Bedingung B_sp3 als Triggerevent in DCLA" UBYTE dez 1 100 0 255 FUNCTION_LIST DFPM DTRIG IF_DATA DIM_X 0x382FC8 EXTERN WORD IF_DATA MCMESS 0x382FC8 EXTERN /end MEASUREMENT
/begin MEASUREMENT bbtim "Byte für Bedingung B_tim als Triggerevent in DCLA" UBYTE dez 1 100 0 255 FUNCTION_LIST DFPM DTRIG IF_DATA DIM_X 0x3809D8 EXTERN WORD IF_DATA MCMESS 0x3809D8 EXTERN /end MEASUREMENT
/begin MEASUREMENT bbwuc "Byte für Bedingung B_wuc als Triggerevent in DCLA" UBYTE dez 1 100 0 255 FUNCTION_LIST DWUC DFPM DTRIG IF_DATA DIM_X 0x380A15 EXTERN WORD IF_DATA MCMESS 0x380A15 EXTERN /end MEASUREMENT
/begin MEASUREMENT bfnmn "Bereichsfenster Motorbetrieb, minimale Drehzahl" UBYTE nmot_ub_q40 1 100 0 10200 FUNCTION_LIST DMDMIL IF_DATA DIM_X 0x3809CE EXTERN WORD IF_DATA MCMESS 0x3809CE EXTERN /end MEASUREMENT
/begin MEASUREMENT bfnmx "Bereichsfenster Motorbetrieb, maximale Drehzahl" UBYTE nmot_ub_q40 1 100 0 10200 FUNCTION_LIST DMDMIL IF_DATA DIM_X 0x3809CF EXTERN WORD IF_DATA MCMESS 0x3809CF EXTERN /end MEASUREMENT
/begin MEASUREMENT bfrlmn "Bereichsfenster Motorbetrieb, minimale Last" UBYTE rel_ub_q0p75 1 100 0 191.25 FUNCTION_LIST DMDMIL IF_DATA DIM_X 0x3809D0 EXTERN WORD IF_DATA MCMESS 0x3809D0 EXTERN /end MEASUREMENT
/begin MEASUREMENT bfrlmx "Bereichsfenster Motorbetrieb, maximale Last" UBYTE rel_ub_q0p75 1 100 0 191.25 FUNCTION_LIST DMDMIL IF_DATA DIM_X 0x3809D1 EXTERN WORD IF_DATA MCMESS 0x3809D1 EXTERN /end MEASUREMENT
/begin MEASUREMENT bfzglf "Fahrzeuglängsbeschleunigung gefiltert" SBYTE bfzg_sb_q0p217 1 100 -27.776 27.559 FUNCTION_LIST VMAXMD IF_DATA DIM_X 0x380C45 EXTERN WORD IF_DATA MCMESS 0x380C45 EXTERN /end MEASUREMENT
/begin MEASUREMENT bfzgl_b "Fahrzeuglängsbeschleunigung" SBYTE bfzg_sb_q0p217 1 100 -27.776 27.559 FUNCTION_LIST GGVFZG BBFGR DFFTK VMAXMD IF_DATA DIM_X 0x380A9B EXTERN WORD IF_DATA MCMESS 0x380A9B EXTERN /end MEASUREMENT
/begin MEASUREMENT bgCtr "" UWORD dez 1 100 0 65535 FUNCTION_LIST V7804X_T IF_DATA DIM_X 0x380D28 EXTERN WORD IF_DATA MCMESS 0x380D28 EXTERN /end MEASUREMENT
/begin MEASUREMENT bgcvn_bits "" UBYTE dez 1 100 0 255 FUNCTION_LIST BGCVN IF_DATA DIM_X 0x3809D5 EXTERN WORD IF_DATA MCMESS 0x3809D5 EXTERN /end MEASUREMENT
/begin MEASUREMENT BGDVEintbits "" UBYTE dez 1 100 0 255 FUNCTION_LIST BGDVE T2DVE IF_DATA DIM_X 0x382FF7 EXTERN WORD IF_DATA MCMESS 0x382FF7 EXTERN /end MEASUREMENT
/begin MEASUREMENT bmLosCtr_w "Zähler (Word) Neusynchronisationen durch Lückenverlust" UWORD dez 1 100 0 65535 FUNCTION_LIST GGDPG DDG IF_DATA DIM_X 0x383964 EXTERN WORD IF_DATA MCMESS 0x383964 EXTERN /end MEASUREMENT
/begin MEASUREMENT bmzzyl "Initialisierungswert Zylinderzähler nach erster Bezugsmarke" UBYTE dez 1 100 0 255 FUNCTION_LIST GGDPG IF_DATA DIM_X 0x380A27 EXTERN WORD IF_DATA MCMESS 0x380A27 EXTERN /end MEASUREMENT
/begin MEASUREMENT brems_c_um "Entprellzähler für betätigte Bremse in der Funktionsüberwachung" UBYTE t40ms_ub_b10200 1 100 0 10200 FUNCTION_LIST UFFGRE IF_DATA DIM_X 0x382E4A EXTERN WORD IF_DATA MCMESS 0x382E4A EXTERN /end MEASUREMENT
/begin MEASUREMENT bsc "Radbeschleunigungssignal aus ABS-Sensorsignal berechnet" UBYTE acc_ub_b55p55 1 100 0 55.335 FUNCTION_LIST BGRBS DSWEC IF_DATA DIM_X 0x380CA6 EXTERN WORD IF_DATA MCMESS 0x380CA6 EXTERN /end MEASUREMENT
/begin MEASUREMENT bsc_w "" UWORD acc_ub_b55p55 1 100 0 14221.1 FUNCTION_LIST BGRBS IF_DATA DIM_X 0x382B3E EXTERN WORD IF_DATA MCMESS 0x382B3E EXTERN /end MEASUREMENT
/begin MEASUREMENT bssp "Speicherwert Signal Beschleunigungssensor" UWORD acc_uw_b55p55 1 100 0 55.5547 FUNCTION_LIST DSWEC IF_DATA DIM_X 0x382B56 EXTERN WORD IF_DATA MCMESS 0x382B56 EXTERN /end MEASUREMENT
/begin MEASUREMENT bzmsr_a_uc "" UBYTE dez 1 100 0 255 FUNCTION_LIST URCEIN URCMSRC IF_DATA DIM_X 0x380C58 EXTERN WORD IF_DATA MCMESS 0x380C58 EXTERN /end MEASUREMENT
/begin MEASUREMENT bzmsr_a_um "alter MSR-Botschaftszähler" UBYTE dez 1 100 0 255 FUNCTION_LIST UFMSRC IF_DATA DIM_X 0x382E6A EXTERN WORD IF_DATA MCMESS 0x382E6A EXTERN /end MEASUREMENT
/begin MEASUREMENT bz_msr "MSR-Botschaftszähler" UBYTE dez 1 100 0 255 FUNCTION_LIST UFMSRC IF_DATA DIM_X 0x382E6B EXTERN WORD IF_DATA MCMESS 0x382E6B EXTERN /end MEASUREMENT
/begin MEASUREMENT bz_msr_uc "" UBYTE dez 1 100 0 255 FUNCTION_LIST URCMSRC IF_DATA DIM_X 0x380C63 EXTERN WORD IF_DATA MCMESS 0x380C63 EXTERN /end MEASUREMENT
/begin MEASUREMENT B_1dvs "Diagnose grosser Ventilhub" UWORD B_TRUE 1 100 0 1 BIT_MASK 0x1000 FUNCTION_LIST DVS VS IF_DATA DIM_X 0xFD8C INTERN BYTE IF_DATA MCMESS 0xFD8C INTERN /end MEASUREMENT
/begin MEASUREMENT B_2dvs "Diagnose kleiner Ventilhub" UWORD B_TRUE 1 100 0 1 BIT_MASK 0x2000 FUNCTION_LIST DVS VS IF_DATA DIM_X 0xFD8C INTERN BYTE IF_DATA MCMESS 0xFD8C INTERN /end MEASUREMENT
/begin MEASUREMENT B_2ph "Bedingung, daß zweite Phasenflankeninformation vorliegt" UWORD B_TRUE 1 100 0 1 BIT_MASK 0x800 FUNCTION_LIST NLDG IF_DATA DIM_X 0xFD16 INTERN BYTE IF_DATA MCMESS 0xFD16 INTERN /end MEASUREMENT
/begin MEASUREMENT B_3ph "Bedingung, daß dritte Phasenflankeninformation vorliegt" UWORD B_TRUE 1 100 0 1 BIT_MASK 0x1000 FUNCTION_LIST NLDG IF_DATA DIM_X 0xFD16 INTERN BYTE IF_DATA MCMESS 0xFD16 INTERN /end MEASUREMENT
/begin MEASUREMENT B_4wd "Bedingung Allrad-Antrieb" UWORD B_TRUE 1 100 0 1 BIT_MASK 0x100 FUNCTION_LIST PROKON IF_DATA DIM_X 0xFD72 INTERN BYTE IF_DATA MCMESS 0xFD72 INTERN /end MEASUREMENT
/begin MEASUREMENT B_abgle "Bedingung: Fehler beim Verstärkerabgleich" UWORD B_TRUE 1 100 0 1 BIT_MASK 0x100 FUNCTION_LIST BGDVE DDVE T2DVE IF_DATA DIM_X 0xFD34 INTERN BYTE IF_DATA MCMESS 0xFD34 INTERN /end MEASUREMENT
/begin MEASUREMENT B_abgstg "Bedingung Modelltemperatur (tkatm od. tanhkm_w) hinter KAT ist oberhalb Schwelle" UBYTE B_TRUE 1 100 0 1 BIT_MASK 0x2 FUNCTION_LIST DLSAHK IF_DATA DIM_X 0x380A7B EXTERN BYTE IF_DATA MCMESS 0x380A7B EXTERN /end MEASUREMENT
/begin MEASUREMENT B_abgstg2 "Bedingung Modelltemp. (tkatm od. tanhkm_w) liegt oberhalb Schwelle Bank2" UBYTE B_TRUE 1 100 0 1 BIT_MASK 0x4 FUNCTION_LIST DLSAHK IF_DATA DIM_X 0x380A7B EXTERN BYTE IF_DATA MCMESS 0x380A7B EXTERN /end MEASUREMENT
/begin MEASUREMENT B_abll "Bedingung Abgleich im Leerlauf" UBYTE B_TRUE 1 100 0 1 BIT_MASK 0x1 FUNCTION_LIST GGLSU IF_DATA DIM_X 0x380A8C EXTERN BYTE IF_DATA MCMESS 0x380A8C EXTERN /end MEASUREMENT
/begin MEASUREMENT B_abll2 "Bedingung Abgleich im Leerlauf, Bank2" UBYTE B_TRUE 1 100 0 1 BIT_MASK 0x2 FUNCTION_LIST GGLSU IF_DATA DIM_X 0x380A8C EXTERN BYTE IF_DATA MCMESS 0x380A8C EXTERN /end MEASUREMENT
/begin MEASUREMENT B_abstgp "Bedingung Abstellzeitermittlung gültig und plausibel" UWORD B_TRUE 1 100 0 1 BIT_MASK 0x2000 FUNCTION_LIST BGTABS GGTFM IF_DATA DIM_X 0xFD4E INTERN BYTE IF_DATA MCMESS 0xFD4E INTERN /end MEASUREMENT
/begin MEASUREMENT B_abstnl "Bedingung Abstellzeitermittlung über SG-Nachlauf" UWORD B_TRUE 1 100 0 1 BIT_MASK 0x200 FUNCTION_LIST PROKON BGTABS IF_DATA DIM_X 0xFD72 INTERN BYTE IF_DATA MCMESS 0xFD72 INTERN /end MEASUREMENT
/begin MEASUREMENT B_abstnlgp "Bedingung Abstellzeitermittlung über SG-Nachlauf gültig und plausibel" UWORD B_TRUE 1 100 0 1 BIT_MASK 0x1 FUNCTION_LIST BGTABS GGTFM IF_DATA DIM_X 0xFDE8 INTERN BYTE IF_DATA MCMESS 0xFDE8 INTERN /end MEASUREMENT
/begin MEASUREMENT B_acc "Bedingung: ACC-Steuergerät vorhanden" UWORD B_TRUE 1 100 0 1 BIT_MASK 0x4 FUNCTION_LIST SWADP BBFGR FGRMD FGRUE IF_DATA DIM_X 0xFD82 INTERN BYTE IF_DATA MCMESS 0xFD82 INTERN /end MEASUREMENT
/begin MEASUREMENT B_acres "Bedingung für Aufbau einer Drehmomentenreserve bei Klimabereitschaft" UWORD B_TRUE 1 100 0 1 BIT_MASK 0x100 FUNCTION_LIST KOS MDVERB IF_DATA DIM_X 0xFD90 INTERN BYTE IF_DATA MCMESS 0xFD90 INTERN /end MEASUREMENT
/begin MEASUREMENT B_acsdh "Bedingung für Prüfung Adernschluß und CSD hinter Kat" UWORD B_TRUE 1 100 0 1 BIT_MASK 0x20 FUNCTION_LIST DLSH IF_DATA DIM_X 0xFD28 INTERN BYTE IF_DATA MCMESS 0xFD28 INTERN /end MEASUREMENT
/begin MEASUREMENT B_acsdh2 "Bedingung für Prüfung Adernschluß und CSD hinter Kat" UWORD B_TRUE 1 100 0 1 BIT_MASK 0x40 FUNCTION_LIST DLSH IF_DATA DIM_X 0xFD28 INTERN BYTE IF_DATA MCMESS 0xFD28 INTERN /end MEASUREMENT
/begin MEASUREMENT B_ad "Bedingung Adaption erlaubt" UWORD B_TRUE 1 100 0 1 BIT_MASK 0x1 FUNCTION_LIST STADAP IF_DATA DIM_X 0x382370 EXTERN BYTE IF_DATA MCMESS 0x382370 EXTERN /end MEASUREMENT
/begin MEASUREMENT B_adb0 "Bedingung Adaptionsbereich 0" UWORD B_TRUE 1 100 0 1 BIT_MASK 0x2 FUNCTION_LIST STADAP IF_DATA DIM_X 0x382370 EXTERN BYTE IF_DATA MCMESS 0x382370 EXTERN /end MEASUREMENT
/begin MEASUREMENT B_adb1 "Bedingung Adaptionsbereich 1" UWORD B_TRUE 1 100 0 1 BIT_MASK 0x4 FUNCTION_LIST STADAP IF_DATA DIM_X 0x382370 EXTERN BYTE IF_DATA MCMESS 0x382370 EXTERN /end MEASUREMENT
/begin MEASUREMENT B_adb2 "Bedingung Adaptionsbereich 2" UWORD B_TRUE 1 100 0 1 BIT_MASK 0x8 FUNCTION_LIST STADAP IF_DATA DIM_X 0x382370 EXTERN BYTE IF_DATA MCMESS 0x382370 EXTERN /end MEASUREMENT
/begin MEASUREMENT B_adlck "Richtungsabhängige Startadaptionssperre" UWORD B_TRUE 1 100 0 1 BIT_MASK 0x10 FUNCTION_LIST STADAP IF_DATA DIM_X 0x382370 EXTERN BYTE IF_DATA MCMESS 0x382370 EXTERN /end MEASUREMENT
/begin MEASUREMENT B_adsh "Bedingung Adernschluß bei Lambdasonden hinter Kat" UBYTE B_TRUE 1 100 0 1 BIT_MASK 0x1 FUNCTION_LIST DLSH T2DFA IF_DATA DIM_X 0x380A82 EXTERN BYTE IF_DATA MCMESS 0x380A82 EXTERN /end MEASUREMENT
/begin MEASUREMENT B_adsh2 "Bedingung Adernschluß bei Lambdasonden hinter Kat Bank2" UBYTE B_TRUE 1 100 0 1 BIT_MASK 0x2 FUNCTION_LIST DLSH T2DFA IF_DATA DIM_X 0x380A82 EXTERN BYTE IF_DATA MCMESS 0x380A82 EXTERN /end MEASUREMENT
/begin MEASUREMENT B_adshs "Bedingung Adernschluß ""setzen"" bei Lambdasonden hinter Kat" UBYTE B_TRUE 1 100 0 1 BIT_MASK 0x10 FUNCTION_LIST DLSH IF_DATA DIM_X 0x380A81 EXTERN BYTE IF_DATA MCMESS 0x380A81 EXTERN /end MEASUREMENT
/begin MEASUREMENT B_adshs2 "Bedingung Adernschluß ""setzen"" bei Lambdasonden hinter Kat Bank2" UBYTE B_TRUE 1 100 0 1 BIT_MASK 0x20 FUNCTION_LIST DLSH IF_DATA DIM_X 0x380A81 EXTERN BYTE IF_DATA MCMESS 0x380A81 EXTERN /end MEASUREMENT
/begin MEASUREMENT B_adwfk "Bedingung Adaptionswert Fahrstufe und Kompressor ein verwenden" UWORD B_TRUE 1 100 0 1 BIT_MASK 0x8 FUNCTION_LIST MDVERAD IF_DATA DIM_X 0xFD6A INTERN BYTE IF_DATA MCMESS 0xFD6A INTERN /end MEASUREMENT
/begin MEASUREMENT B_adwfs "Bedingung Adaptionswert Fahrstufe ein verwenden" UWORD B_TRUE 1 100 0 1 BIT_MASK 0x10 FUNCTION_LIST MDVERAD IF_DATA DIM_X 0xFD6A INTERN BYTE IF_DATA MCMESS 0xFD6A INTERN /end MEASUREMENT
/begin MEASUREMENT B_adwko "Bedingung Adaptionswert Klimakompressor ein verwenden" UWORD B_TRUE 1 100 0 1 BIT_MASK 0x20 FUNCTION_LIST MDVERAD IF_DATA DIM_X 0xFD6A INTERN BYTE IF_DATA MCMESS 0xFD6A INTERN /end MEASUREMENT
/begin MEASUREMENT B_afklt "Bereichsfenster Aussetzer, Bedingung kalt, TMOT<TMWUC" UBYTE B_TRUE 1 100 0 1 BIT_MASK 0x2 FUNCTION_LIST DMDMIL IF_DATA DIM_X 0x382FC4 EXTERN BYTE IF_DATA MCMESS 0x382FC4 EXTERN /end MEASUREMENT
/begin MEASUREMENT B_aftklt "Bereichsfenster Aussetzer, temporär, Bedingung kalt, TMOT<TMWUC" UBYTE B_TRUE 1 100 0 1 BIT_MASK 0x8 FUNCTION_LIST DMDMIL IF_DATA DIM_X 0x382FC4 EXTERN BYTE IF_DATA MCMESS 0x382FC4 EXTERN /end MEASUREMENT
/begin MEASUREMENT B_aftwrm "Bereichsfenster Aussetzer, temporär, Bedingung warm, TMOT>TMWUC" UBYTE B_TRUE 1 100 0 1 BIT_MASK 0x4 FUNCTION_LIST DMDMIL IF_DATA DIM_X 0x382FC4 EXTERN BYTE IF_DATA MCMESS 0x382FC4 EXTERN /end MEASUREMENT
/begin MEASUREMENT B_afwe "Bedingung Anzahl der Wiedereinsetzfaktoren" UWORD B_TRUE 1 100 0 1 BIT_MASK 0x20 FUNCTION_LIST ESWE IF_DATA DIM_X 0xFD58 INTERN BYTE IF_DATA MCMESS 0xFD58 INTERN /end MEASUREMENT
/begin MEASUREMENT B_afwrm "Bereichsfenster Aussetzer, Bedingung warm, TMOT>TMWUC" UBYTE B_TRUE 1 100 0 1 BIT_MASK 0x1 FUNCTION_LIST DMDMIL IF_DATA DIM_X 0x382FC4 EXTERN BYTE IF_DATA MCMESS 0x382FC4 EXTERN /end MEASUREMENT
/begin MEASUREMENT B_agrrdy "Bedingung AGR geprüft für 'ready-Byte'" UBYTE B_TRUE 1 100 0 1 BIT_MASK 0x80 FUNCTION_LIST DIMC IF_DATA DIM_X 0x382FD0 EXTERN BYTE IF_DATA MCMESS 0x382FD0 EXTERN /end MEASUREMENT
/begin MEASUREMENT B_airbag "Bedingung Airbag ausgelöst" UWORD B_TRUE 1 100 0 1 BIT_MASK 0x20 FUNCTION_LIST GGAIRB AEKP MOTAUS IF_DATA DIM_X 0xFD90 INTERN BYTE IF_DATA MCMESS 0xFD90 INTERN /end MEASUREMENT
/begin MEASUREMENT B_aktfkt "Bedingung für Funktionsaktivierung über Tester" UWORD B_TRUE 1 100 0 1 BIT_MASK 0x20 FUNCTION_LIST T2DFA SGAAU T2AU IF_DATA DIM_X 0xFD04 INTERN BYTE IF_DATA MCMESS 0xFD04 INTERN /end MEASUREMENT
/begin MEASUREMENT B_ale "Bedingung Motorabstellposition erkannt" UBYTE B_TRUE 1 100 0 1 BIT_MASK 0x1 FUNCTION_LIST ALE GGDPG IF_DATA DIM_X 0x382FD8 EXTERN BYTE IF_DATA MCMESS 0x382FD8 EXTERN /end MEASUREMENT
/begin MEASUREMENT B_analu_m "Monitor, Ausblendung nach dem ersten erkannten Aussetzer" UBYTE B_TRUE 1 100 0 1 BIT_MASK 0x4 FUNCTION_LIST DMDLU IF_DATA DIM_X 0xE3F0 INTERN WORD IF_DATA MCMESS 0xE3F0 INTERN /end MEASUREMENT
/begin MEASUREMENT B_anfsk "Bedingung: Anfahren mit schleifender Kupplung" UWORD B_TRUE 1 100 0 1 BIT_MASK 0x1 FUNCTION_LIST VS IF_DATA DIM_X 0x382CBC EXTERN BYTE IF_DATA MCMESS 0x382CBC EXTERN /end MEASUREMENT
/begin MEASUREMENT B_anschlag "" UWORD B_TRUE 1 100 0 1 BIT_MASK 0x1 FUNCTION_LIST TNOT IF_DATA DIM_X 0xFD00 INTERN BYTE IF_DATA MCMESS 0xFD00 INTERN /end MEASUREMENT
/begin MEASUREMENT B_apnoluv "Verriegelungsbit: Applikationshilfe DK-Notluftfahren" UWORD B_TRUE 1 100 0 1 BIT_MASK 0x4000 FUNCTION_LIST ADVE IF_DATA DIM_X 0xFD30 INTERN BYTE IF_DATA MCMESS 0xFD30 INTERN /end MEASUREMENT
/begin MEASUREMENT B_appnolu "Bedingung: DK-Notluftfahren durch Applikation angefordert" UWORD B_TRUE 1 100 0 1 BIT_MASK 0x8000 FUNCTION_LIST ADVE SREAKT IF_DATA DIM_X 0xFD30 INTERN BYTE IF_DATA MCMESS 0xFD30 INTERN /end MEASUREMENT
/begin MEASUREMENT B_ar "Antiruckeleingriff aktiv" UWORD B_TRUE 1 100 0 1 BIT_MASK 0x40 FUNCTION_LIST ARMD IF_DATA DIM_X 0xFD6C INTERN BYTE IF_DATA MCMESS 0xFD6C INTERN /end MEASUREMENT
/begin MEASUREMENT B_asc1new "Bedingung CAN-ASC1-Botschaft empfangen" UWORD B_TRUE 1 100 0 1 BIT_MASK 0x800 FUNCTION_LIST CAN DCAS IF_DATA DIM_X 0xFD06 INTERN BYTE IF_DATA MCMESS 0xFD06 INTERN /end MEASUREMENT
/begin MEASUREMENT B_asc2new "Bedingung CAN-ASC2-Botschaft empfangen" UWORD B_TRUE 1 100 0 1 BIT_MASK 0x1000 FUNCTION_LIST CAN DCAS IF_DATA DIM_X 0xFD06 INTERN BYTE IF_DATA MCMESS 0xFD06 INTERN /end MEASUREMENT
/begin MEASUREMENT B_asr "Bedingung für ASR aktiv" UWORD B_TRUE 1 100 0 1 BIT_MASK 0x8 FUNCTION_LIST MDKOG BBFGR DMDSTP LDRPLS MDRED1 IF_DATA DIM_X 0xFD6E INTERN BYTE IF_DATA MCMESS 0xFD6E INTERN /end MEASUREMENT
/begin MEASUREMENT B_asrfz "Bedingung für ASR im Fahrzeug" UWORD B_TRUE 1 100 0 1 BIT_MASK 0x400 FUNCTION_LIST PROKON DCAS IF_DATA DIM_X 0xFD72 INTERN BYTE IF_DATA MCMESS 0xFD72 INTERN /end MEASUREMENT
/begin MEASUREMENT B_atev "Bedingung Endstufendiagnose TEV auf" UWORD B_TRUE 1 100 0 1 BIT_MASK 0x2000 FUNCTION_LIST DTEVE IF_DATA DIM_X 0xFD42 INTERN BYTE IF_DATA MCMESS 0xFD42 INTERN /end MEASUREMENT
/begin MEASUREMENT B_atmst "Bedingung Startwert tabgmst,tkatmst berechnet" UWORD B_TRUE 1 100 0 1 BIT_MASK 0x1 FUNCTION_LIST ATM IF_DATA DIM_X 0xFD1C INTERN BYTE IF_DATA MCMESS 0xFD1C INTERN /end MEASUREMENT
/begin MEASUREMENT B_atmst2 "Bedingung Startwert tabgmst, tkatmst berechnet Bank2" UWORD B_TRUE 1 100 0 1 BIT_MASK 0x2 FUNCTION_LIST ATM IF_DATA DIM_X 0xFD1C INTERN BYTE IF_DATA MCMESS 0xFD1C INTERN /end MEASUREMENT
/begin MEASUREMENT B_atmtpa "Bedingung Taupunkt vor Kat ueberschritten" UWORD B_TRUE 1 100 0 1 BIT_MASK 0x4 FUNCTION_LIST ATM HLSU TEBEB IF_DATA DIM_X 0xFD1C INTERN BYTE IF_DATA MCMESS 0xFD1C INTERN /end MEASUREMENT
/begin MEASUREMENT B_atmtpa2 "Bedingung Taupunkt2 vor Kat ueberschritten" UWORD B_TRUE 1 100 0 1 BIT_MASK 0x8 FUNCTION_LIST ATM HLSU IF_DATA DIM_X 0xFD1C INTERN BYTE IF_DATA MCMESS 0xFD1C INTERN /end MEASUREMENT
/begin MEASUREMENT B_atmtpf "Bedingung Taupunkt vor Kat überschritten (last trip)" UBYTE B_TRUE 1 100 0 1 BIT_MASK 0x4 FUNCTION_LIST ATM IF_DATA DIM_X 0x382FDD EXTERN BYTE IF_DATA MCMESS 0x382FDD EXTERN /end MEASUREMENT
/begin MEASUREMENT B_atmtpf2 "Bedingung Taupunkt vor Kat überschritten (last trip) Bank2" UBYTE B_TRUE 1 100 0 1 BIT_MASK 0x8 FUNCTION_LIST ATM IF_DATA DIM_X 0x382FDD EXTERN BYTE IF_DATA MCMESS 0x382FDD EXTERN /end MEASUREMENT
/begin MEASUREMENT B_atmtpk "Bedingung Taupunkt hinter Kat ueberschritten" UWORD B_TRUE 1 100 0 1 BIT_MASK 0x10 FUNCTION_LIST ATM DHLSHK HLSHK T2DFA IF_DATA DIM_X 0xFD1C INTERN BYTE IF_DATA MCMESS 0xFD1C INTERN /end MEASUREMENT
/begin MEASUREMENT B_atmtpk2 "Bedingung Taupunkt2 hinter Kat ueberschritten" UWORD B_TRUE 1 100 0 1 BIT_MASK 0x20 FUNCTION_LIST ATM DHLSHK HLSHK T2DFA IF_DATA DIM_X 0xFD1C INTERN BYTE IF_DATA MCMESS 0xFD1C INTERN /end MEASUREMENT
/begin MEASUREMENT B_atmtpl "Bedingung Taupunkt hinter Kat überschritten (last trip)" UBYTE B_TRUE 1 100 0 1 BIT_MASK 0x1 FUNCTION_LIST ATM HLSHK SLS IF_DATA DIM_X 0x382FDD EXTERN BYTE IF_DATA MCMESS 0x382FDD EXTERN /end MEASUREMENT
/begin MEASUREMENT B_atmtpl2 "Bedingung Taupunkt hinter Kat überschritten (last trip) Bank2" UBYTE B_TRUE 1 100 0 1 BIT_MASK 0x2 FUNCTION_LIST ATM HLSHK IF_DATA DIM_X 0x382FDD EXTERN BYTE IF_DATA MCMESS 0x382FDD EXTERN /end MEASUREMENT
/begin MEASUREMENT B_atrf "Bedingung Fehler Abgastemperaturregelung" UWORD B_TRUE 1 100 0 1 BIT_MASK 0x8 FUNCTION_LIST SWADP IF_DATA DIM_X 0xFD82 INTERN BYTE IF_DATA MCMESS 0xFD82 INTERN /end MEASUREMENT
/begin MEASUREMENT B_atsb "Bedingung: Abgastemperatursensor betriebsbereit" UWORD B_TRUE 1 100 0 1 BIT_MASK 0x10 FUNCTION_LIST SWADP IF_DATA DIM_X 0xFD82 INTERN BYTE IF_DATA MCMESS 0xFD82 INTERN /end MEASUREMENT
/begin MEASUREMENT B_auakt "Bedingung Abgasuntersuchung aktiv" UWORD B_TRUE 1 100 0 1 BIT_MASK 0x200 FUNCTION_LIST SGAAU DMDSTP GGTFM LRAEB T2DFA IF_DATA DIM_X 0xFD02 INTERN BYTE IF_DATA MCMESS 0xFD02 INTERN /end MEASUREMENT
/begin MEASUREMENT B_aunote "Bedingung Unterdrückung Tankentlüftung zur Durchführung Abgasuntersuchung" UWORD B_TRUE 1 100 0 1 BIT_MASK 0x400 FUNCTION_LIST SGAAU T2DFA IF_DATA DIM_X 0xFD02 INTERN BYTE IF_DATA MCMESS 0xFD02 INTERN /end MEASUREMENT
/begin MEASUREMENT B_ausw "Bedingung Auswerten nach Verbrennungen" UWORD B_TRUE 1 100 0 1 BIT_MASK 0x20 FUNCTION_LIST STADAP IF_DATA DIM_X 0x382370 EXTERN BYTE IF_DATA MCMESS 0x382370 EXTERN /end MEASUREMENT
/begin MEASUREMENT B_autget "Bedingung Automatikgetriebe" UWORD B_TRUE 1 100 0 1 BIT_MASK 0x800 FUNCTION_LIST PROKON ARMD BBGANG CAN DCG DCGE DKUPPL DMDFON DMDSTP GGEGAS LLRNS NMAXMD VHW IF_DATA DIM_X 0xFD72 INTERN BYTE IF_DATA MCMESS 0xFD72 INTERN /end MEASUREMENT
/begin MEASUREMENT B_avhshe "" UWORD B_TRUE 1 100 0 1 BIT_MASK 0x1000 FUNCTION_LIST DFPM_DEKON IF_DATA DIM_X 0x383892 EXTERN BYTE IF_DATA MCMESS 0x383892 EXTERN /end MEASUREMENT
/begin MEASUREMENT B_avhshe2 "" UWORD B_TRUE 1 100 0 1 BIT_MASK 0x1000 FUNCTION_LIST DFPM_DEKON IF_DATA DIM_X 0x383894 EXTERN BYTE IF_DATA MCMESS 0x383894 EXTERN /end MEASUREMENT
/begin MEASUREMENT B_avkwave "" UWORD B_TRUE 1 100 0 1 BIT_MASK 0x1000 FUNCTION_LIST DFPM_DEKON IF_DATA DIM_X 0x3838B6 EXTERN BYTE IF_DATA MCMESS 0x3838B6 EXTERN /end MEASUREMENT
/begin MEASUREMENT B_avlde "" UWORD B_TRUE 1 100 0 1 BIT_MASK 0x1000 FUNCTION_LIST DFPM_DEKON IF_DATA DIM_X 0x3838BC EXTERN BYTE IF_DATA MCMESS 0x3838BC EXTERN /end MEASUREMENT
/begin MEASUREMENT B_avnwse "" UWORD B_TRUE 1 100 0 1 BIT_MASK 0x1000 FUNCTION_LIST DFPM_DEKON IF_DATA DIM_X 0x3838F4 EXTERN BYTE IF_DATA MCMESS 0x3838F4 EXTERN /end MEASUREMENT
/begin MEASUREMENT B_avnwse2 "" UWORD B_TRUE 1 100 0 1 BIT_MASK 0x1000 FUNCTION_LIST DFPM_DEKON IF_DATA DIM_X 0x3838F6 EXTERN BYTE IF_DATA MCMESS 0x3838F6 EXTERN /end MEASUREMENT
/begin MEASUREMENT B_avtes "Leckdiagnose ist aktiv" UWORD B_TRUE 1 100 0 1 BIT_MASK 0x1000 FUNCTION_LIST DFPM_DTEV IF_DATA DIM_X 0x383916 EXTERN BYTE IF_DATA MCMESS 0x383916 EXTERN /end MEASUREMENT
/begin MEASUREMENT B_ba "Bedingung Beschleunigungsanreicherung (Anzeige)" UWORD B_TRUE 1 100 0 1 BIT_MASK 0x10 FUNCTION_LIST ESUK IF_DATA DIM_X 0xFD54 INTERN BYTE IF_DATA MCMESS 0xFD54 INTERN /end MEASUREMENT
/begin MEASUREMENT B_bag "Bedingung starke Beschleunigungsanreicherung" UWORD B_TRUE 1 100 0 1 BIT_MASK 0x20 FUNCTION_LIST ESUK DSLSLRS LRSEB T2DFA IF_DATA DIM_X 0xFD54 INTERN BYTE IF_DATA MCMESS 0xFD54 INTERN /end MEASUREMENT
/begin MEASUREMENT B_beaave "Bedingung Bandendeanforderung setzt Fehler Absperrventil Aktivkohlefilt Endstufe" UWORD B_TRUE 1 100 0 1 BIT_MASK 0x20 FUNCTION_LIST DFPM_DEKON IF_DATA DIM_X 0x383816 EXTERN BYTE IF_DATA MCMESS 0x383816 EXTERN /end MEASUREMENT
/begin MEASUREMENT B_beagre "Bedingung Bandende-Funktionsanforderung AGR-Endstufendiagnose" UWORD B_TRUE 1 100 0 1 BIT_MASK 0x20 FUNCTION_LIST DFPM_DUMMY043 IF_DATA DIM_X 0x383818 EXTERN BYTE IF_DATA MCMESS 0x383818 EXTERN /end MEASUREMENT
/begin MEASUREMENT B_bebm "Bedingung Bandende-Funktionsanforderung Bezugsmarke erkannt" UWORD B_TRUE 1 100 0 1 BIT_MASK 0x20 FUNCTION_LIST DFPM_DDG IF_DATA DIM_X 0x38381C EXTERN BYTE IF_DATA MCMESS 0x38381C EXTERN /end MEASUREMENT
/begin MEASUREMENT B_bebrems "Bedingung Bandende-Funktionsanforderung Bremsschalter" UWORD B_TRUE 1 100 0 1 BIT_MASK 0x20 FUNCTION_LIST DFPM_GGEGAS IF_DATA DIM_X 0x38381E EXTERN BYTE IF_DATA MCMESS 0x38381E EXTERN /end MEASUREMENT
/begin MEASUREMENT B_bebwf "Bedingung Bandendeanford. für Bewegungsfehler FPM" UWORD B_TRUE 1 100 0 1 BIT_MASK 0x20 FUNCTION_LIST DFPM_GGPED IF_DATA DIM_X 0x383820 EXTERN BYTE IF_DATA MCMESS 0x383820 EXTERN /end MEASUREMENT
/begin MEASUREMENT B_becas "Bedingung Bandende-Funktionsanforderung: CAN-Schnittstelle ABS" UWORD B_TRUE 1 100 0 1 BIT_MASK 0x20 FUNCTION_LIST DFPM_DCAS IF_DATA DIM_X 0x383822 EXTERN BYTE IF_DATA MCMESS 0x383822 EXTERN /end MEASUREMENT
/begin MEASUREMENT B_becge "Bedingung Bandende-Funktionsanforderung: CAN-Schnittstelle TCM" UWORD B_TRUE 1 100 0 1 BIT_MASK 0x20 FUNCTION_LIST DFPM_DCGE IF_DATA DIM_X 0x383824 EXTERN BYTE IF_DATA MCMESS 0x383824 EXTERN /end MEASUREMENT
/begin MEASUREMENT B_becgegs "" UWORD B_TRUE 1 100 0 1 BIT_MASK 0x20 FUNCTION_LIST DFPM_DCG IF_DATA DIM_X 0x383826 EXTERN BYTE IF_DATA MCMESS 0x383826 EXTERN /end MEASUREMENT
/begin MEASUREMENT B_becgggp "" UWORD B_TRUE 1 100 0 1 BIT_MASK 0x20 FUNCTION_LIST DFPM_DCG IF_DATA DIM_X 0x383828 EXTERN BYTE IF_DATA MCMESS 0x383828 EXTERN /end MEASUREMENT
/begin MEASUREMENT B_becgggv "" UWORD B_TRUE 1 100 0 1 BIT_MASK 0x20 FUNCTION_LIST DFPM_DCG IF_DATA DIM_X 0x38382A EXTERN BYTE IF_DATA MCMESS 0x38382A EXTERN /end MEASUREMENT
/begin MEASUREMENT B_becgm1v "" UWORD B_TRUE 1 100 0 1 BIT_MASK 0x20 FUNCTION_LIST DFPM_DCG IF_DATA DIM_X 0x38382C EXTERN BYTE IF_DATA MCMESS 0x38382C EXTERN /end MEASUREMENT
/begin MEASUREMENT B_becgm2v "" UWORD B_TRUE 1 100 0 1 BIT_MASK 0x20 FUNCTION_LIST DFPM_DCG IF_DATA DIM_X 0x38382E EXTERN BYTE IF_DATA MCMESS 0x38382E EXTERN /end MEASUREMENT
/begin MEASUREMENT B_becgm3v "" UWORD B_TRUE 1 100 0 1 BIT_MASK 0x20 FUNCTION_LIST DFPM_DCG IF_DATA DIM_X 0x383830 EXTERN BYTE IF_DATA MCMESS 0x383830 EXTERN /end MEASUREMENT
/begin MEASUREMENT B_becgmvk "" UWORD B_TRUE 1 100 0 1 BIT_MASK 0x20 FUNCTION_LIST DFPM_DCG IF_DATA DIM_X 0x383832 EXTERN BYTE IF_DATA MCMESS 0x383832 EXTERN /end MEASUREMENT
/begin MEASUREMENT B_becgrmm "" UWORD B_TRUE 1 100 0 1 BIT_MASK 0x20 FUNCTION_LIST DFPM_DCG IF_DATA DIM_X 0x383834 EXTERN BYTE IF_DATA MCMESS 0x383834 EXTERN /end MEASUREMENT
/begin MEASUREMENT B_becgrms "" UWORD B_TRUE 1 100 0 1 BIT_MASK 0x20 FUNCTION_LIST DFPM_DCG IF_DATA DIM_X 0x383836 EXTERN BYTE IF_DATA MCMESS 0x383836 EXTERN /end MEASUREMENT
/begin MEASUREMENT B_becgudg "" UWORD B_TRUE 1 100 0 1 BIT_MASK 0x20 FUNCTION_LIST DFPM_DCG IF_DATA DIM_X 0x383838 EXTERN BYTE IF_DATA MCMESS 0x383838 EXTERN /end MEASUREMENT
/begin MEASUREMENT B_becgumv "" UWORD B_TRUE 1 100 0 1 BIT_MASK 0x20 FUNCTION_LIST DFPM_DCG IF_DATA DIM_X 0x38383A EXTERN BYTE IF_DATA MCMESS 0x38383A EXTERN /end MEASUREMENT
/begin MEASUREMENT B_becgvgc "" UWORD B_TRUE 1 100 0 1 BIT_MASK 0x20 FUNCTION_LIST DFPM_DCG IF_DATA DIM_X 0x38383C EXTERN BYTE IF_DATA MCMESS 0x38383C EXTERN /end MEASUREMENT
/begin MEASUREMENT B_becgvrc "" UWORD B_TRUE 1 100 0 1 BIT_MASK 0x20 FUNCTION_LIST DFPM_DCG IF_DATA DIM_X 0x38383E EXTERN BYTE IF_DATA MCMESS 0x38383E EXTERN /end MEASUREMENT
/begin MEASUREMENT B_becgwk "" UWORD B_TRUE 1 100 0 1 BIT_MASK 0x20 FUNCTION_LIST DFPM_DCG IF_DATA DIM_X 0x383840 EXTERN BYTE IF_DATA MCMESS 0x383840 EXTERN /end MEASUREMENT
/begin MEASUREMENT B_beckbi "" UWORD B_TRUE 1 100 0 1 BIT_MASK 0x20 FUNCTION_LIST DFPM_DCKBI IF_DATA DIM_X 0x383842 EXTERN BYTE IF_DATA MCMESS 0x383842 EXTERN /end MEASUREMENT
/begin MEASUREMENT B_becmil "" UWORD B_TRUE 1 100 0 1 BIT_MASK 0x20 FUNCTION_LIST DFPM_DCMIL IF_DATA DIM_X 0x383844 EXTERN BYTE IF_DATA MCMESS 0x383844 EXTERN /end MEASUREMENT
/begin MEASUREMENT B_becra "" UWORD B_TRUE 1 100 0 1 BIT_MASK 0x20 FUNCTION_LIST DFPM_GGAIRBAG IF_DATA DIM_X 0x383846 EXTERN BYTE IF_DATA MCMESS 0x383846 EXTERN /end MEASUREMENT
/begin MEASUREMENT B_bedk "Bedingung Bandende-Funktionsanforderung Drosselklappe" UWORD B_TRUE 1 100 0 1 BIT_MASK 0x20 FUNCTION_LIST DFPM_DDVE IF_DATA DIM_X 0x383848 EXTERN BYTE IF_DATA MCMESS 0x383848 EXTERN /end MEASUREMENT
/begin MEASUREMENT B_bedk1p "" UWORD B_TRUE 1 100 0 1 BIT_MASK 0x20 FUNCTION_LIST DFPM_DDVE IF_DATA DIM_X 0x38384A EXTERN BYTE IF_DATA MCMESS 0x38384A EXTERN /end MEASUREMENT
/begin MEASUREMENT B_bedk2p "" UWORD B_TRUE 1 100 0 1 BIT_MASK 0x20 FUNCTION_LIST DFPM_DDVE IF_DATA DIM_X 0x38384C EXTERN BYTE IF_DATA MCMESS 0x38384C EXTERN /end MEASUREMENT
/begin MEASUREMENT B_bedsl "Bedingung: Bandende-Funktionsanforderung DSL" UWORD B_TRUE 1 100 0 1 BIT_MASK 0x20 FUNCTION_LIST DFPM_GGDSAS IF_DATA DIM_X 0x383850 EXTERN BYTE IF_DATA MCMESS 0x383850 EXTERN /end MEASUREMENT
/begin MEASUREMENT B_bedsu "Bedingung: Bandende-Funktionsanforderung DSU" UWORD B_TRUE 1 100 0 1 BIT_MASK 0x20 FUNCTION_LIST DFPM_GGDSAS IF_DATA DIM_X 0x383852 EXTERN BYTE IF_DATA MCMESS 0x383852 EXTERN /end MEASUREMENT
/begin MEASUREMENT B_bedsvlu "Bedingung: Bandende-Funktionsanforderung DSVLU" UWORD B_TRUE 1 100 0 1 BIT_MASK 0x20 FUNCTION_LIST DFPM_GGDSAS IF_DATA DIM_X 0x383854 EXTERN BYTE IF_DATA MCMESS 0x383854 EXTERN /end MEASUREMENT
/begin MEASUREMENT B_bedvee "" UWORD B_TRUE 1 100 0 1 BIT_MASK 0x20 FUNCTION_LIST DFPM_DDVE IF_DATA DIM_X 0x383856 EXTERN BYTE IF_DATA MCMESS 0x383856 EXTERN /end MEASUREMENT
/begin MEASUREMENT B_bedvef "" UWORD B_TRUE 1 100 0 1 BIT_MASK 0x20 FUNCTION_LIST DFPM_DDVE IF_DATA DIM_X 0x383858 EXTERN BYTE IF_DATA MCMESS 0x383858 EXTERN /end MEASUREMENT
/begin MEASUREMENT B_bedvefo "" UWORD B_TRUE 1 100 0 1 BIT_MASK 0x20 FUNCTION_LIST DFPM_DDVE IF_DATA DIM_X 0x38385A EXTERN BYTE IF_DATA MCMESS 0x38385A EXTERN /end MEASUREMENT
/begin MEASUREMENT B_bedvel "" UWORD B_TRUE 1 100 0 1 BIT_MASK 0x20 FUNCTION_LIST DFPM_DDVE IF_DATA DIM_X 0x38385C EXTERN BYTE IF_DATA MCMESS 0x38385C EXTERN /end MEASUREMENT
/begin MEASUREMENT B_bedven "" UWORD B_TRUE 1 100 0 1 BIT_MASK 0x20 FUNCTION_LIST DFPM_DDVE IF_DATA DIM_X 0x38385E EXTERN BYTE IF_DATA MCMESS 0x38385E EXTERN /end MEASUREMENT
/begin MEASUREMENT B_bedver "" UWORD B_TRUE 1 100 0 1 BIT_MASK 0x20 FUNCTION_LIST DFPM_DDVE IF_DATA DIM_X 0x383860 EXTERN BYTE IF_DATA MCMESS 0x383860 EXTERN /end MEASUREMENT
/begin MEASUREMENT B_bedvet "" UWORD B_TRUE 1 100 0 1 BIT_MASK 0x20 FUNCTION_LIST DFPM_DDVE IF_DATA DIM_X 0x383862 EXTERN BYTE IF_DATA MCMESS 0x383862 EXTERN /end MEASUREMENT
/begin MEASUREMENT B_bedveu "" UWORD B_TRUE 1 100 0 1 BIT_MASK 0x20 FUNCTION_LIST DFPM_DDVE IF_DATA DIM_X 0x383864 EXTERN BYTE IF_DATA MCMESS 0x383864 EXTERN /end MEASUREMENT
/begin MEASUREMENT B_bedveub "" UWORD B_TRUE 1 100 0 1 BIT_MASK 0x20 FUNCTION_LIST DFPM_DDVE IF_DATA DIM_X 0x383866 EXTERN BYTE IF_DATA MCMESS 0x383866 EXTERN /end MEASUREMENT
/begin MEASUREMENT B_bedveuw "" UWORD B_TRUE 1 100 0 1 BIT_MASK 0x20 FUNCTION_LIST DFPM_DDVE IF_DATA DIM_X 0x383868 EXTERN BYTE IF_DATA MCMESS 0x383868 EXTERN /end MEASUREMENT
/begin MEASUREMENT B_bedvev "" UWORD B_TRUE 1 100 0 1 BIT_MASK 0x20 FUNCTION_LIST DFPM_DDVE IF_DATA DIM_X 0x38386A EXTERN BYTE IF_DATA MCMESS 0x38386A EXTERN /end MEASUREMENT
/begin MEASUREMENT B_beegfe "Bedingung: Bandende-Anforderung bei Eingangsgrößen der Füllungserfassung" UWORD B_TRUE 1 100 0 1 BIT_MASK 0x20 FUNCTION_LIST DFPM_EGFE IF_DATA DIM_X 0x38386C EXTERN BYTE IF_DATA MCMESS 0x38386C EXTERN /end MEASUREMENT
/begin MEASUREMENT B_beev1 "Bedingung Bandendeanforderung  für Fehler Endstufe EV1" UWORD B_TRUE 1 100 0 1 BIT_MASK 0x20 FUNCTION_LIST DFPM_DEKON IF_DATA DIM_X 0x38386E EXTERN BYTE IF_DATA MCMESS 0x38386E EXTERN /end MEASUREMENT
/begin MEASUREMENT B_beev2 "Bedingung Bandendeanforderung  für Fehler Endstufe EV2" UWORD B_TRUE 1 100 0 1 BIT_MASK 0x20 FUNCTION_LIST DFPM_DEKON IF_DATA DIM_X 0x383870 EXTERN BYTE IF_DATA MCMESS 0x383870 EXTERN /end MEASUREMENT
/begin MEASUREMENT B_beev3 "Bedingung Bandendeanforderung  für Fehler Endstufe EV3" UWORD B_TRUE 1 100 0 1 BIT_MASK 0x20 FUNCTION_LIST DFPM_DEKON IF_DATA DIM_X 0x383872 EXTERN BYTE IF_DATA MCMESS 0x383872 EXTERN /end MEASUREMENT
/begin MEASUREMENT B_beev4 "Bedingung Bandendeanforderung  für Fehler Endstufe EV4" UWORD B_TRUE 1 100 0 1 BIT_MASK 0x20 FUNCTION_LIST DFPM_DEKON IF_DATA DIM_X 0x383874 EXTERN BYTE IF_DATA MCMESS 0x383874 EXTERN /end MEASUREMENT
/begin MEASUREMENT B_beev5 "Bedingung Bandendeanforderung  für Fehler Endstufe EV5" UWORD B_TRUE 1 100 0 1 BIT_MASK 0x20 FUNCTION_LIST DFPM_DEKON IF_DATA DIM_X 0x383876 EXTERN BYTE IF_DATA MCMESS 0x383876 EXTERN /end MEASUREMENT
/begin MEASUREMENT B_beev6 "Bedingung Bandendeanforderung  für Fehler Endstufe EV6" UWORD B_TRUE 1 100 0 1 BIT_MASK 0x20 FUNCTION_LIST DFPM_DEKON IF_DATA DIM_X 0x383878 EXTERN BYTE IF_DATA MCMESS 0x383878 EXTERN /end MEASUREMENT
/begin MEASUREMENT B_befgrl "" UWORD B_TRUE 1 100 0 1 BIT_MASK 0x20 FUNCTION_LIST DFPM_DCFGRL IF_DATA DIM_X 0x38387A EXTERN BYTE IF_DATA MCMESS 0x38387A EXTERN /end MEASUREMENT
/begin MEASUREMENT B_befp1p "Bedingung Bandendeanford. für Fehler Poti1 FPM" UWORD B_TRUE 1 100 0 1 BIT_MASK 0x20 FUNCTION_LIST DFPM_GGPED IF_DATA DIM_X 0x38387C EXTERN BYTE IF_DATA MCMESS 0x38387C EXTERN /end MEASUREMENT
/begin MEASUREMENT B_befp2p "Bedingung Bandendeanford. für Fehler Poti2 FPM" UWORD B_TRUE 1 100 0 1 BIT_MASK 0x20 FUNCTION_LIST DFPM_GGPED IF_DATA DIM_X 0x38387E EXTERN BYTE IF_DATA MCMESS 0x38387E EXTERN /end MEASUREMENT
/begin MEASUREMENT B_befpp "Bedingung Bandendeanford. für Fehler FPM" UWORD B_TRUE 1 100 0 1 BIT_MASK 0x20 FUNCTION_LIST DFPM_GGPED IF_DATA DIM_X 0x383880 EXTERN BYTE IF_DATA MCMESS 0x383880 EXTERN /end MEASUREMENT
/begin MEASUREMENT B_befrao "Bedingung: Bandendefunktionanford. für FRAO" UWORD B_TRUE 1 100 0 1 BIT_MASK 0x20 FUNCTION_LIST DFPM_DKVS IF_DATA DIM_X 0x383882 EXTERN BYTE IF_DATA MCMESS 0x383882 EXTERN /end MEASUREMENT
/begin MEASUREMENT B_befrao2 "Bedingung: Bandendefunktionanford. für FRAO2" UWORD B_TRUE 1 100 0 1 BIT_MASK 0x20 FUNCTION_LIST DFPM_DKVS IF_DATA DIM_X 0x383884 EXTERN BYTE IF_DATA MCMESS 0x383884 EXTERN /end MEASUREMENT
/begin MEASUREMENT B_befrau "Bedingung: Bandendefunktionanford. für FRAU" UWORD B_TRUE 1 100 0 1 BIT_MASK 0x20 FUNCTION_LIST DFPM_DKVS IF_DATA DIM_X 0x383886 EXTERN BYTE IF_DATA MCMESS 0x383886 EXTERN /end MEASUREMENT
/begin MEASUREMENT B_befrau2 "Bedingung: Bandendefunktionanford. für FRAU2" UWORD B_TRUE 1 100 0 1 BIT_MASK 0x20 FUNCTION_LIST DFPM_DKVS IF_DATA DIM_X 0x383888 EXTERN BYTE IF_DATA MCMESS 0x383888 EXTERN /end MEASUREMENT
/begin MEASUREMENT B_befrst "Bedingung: Bandendefunktionanford. für LR- Kurztest" UWORD B_TRUE 1 100 0 1 BIT_MASK 0x20 FUNCTION_LIST DFPM_DKVS IF_DATA DIM_X 0x38388A EXTERN BYTE IF_DATA MCMESS 0x38388A EXTERN /end MEASUREMENT
/begin MEASUREMENT B_befrst2 "Bedingung: Bandendefunktionanford. für LR- Kurztest (Bank 2)" UWORD B_TRUE 1 100 0 1 BIT_MASK 0x20 FUNCTION_LIST DFPM_DKVS IF_DATA DIM_X 0x38388C EXTERN BYTE IF_DATA MCMESS 0x38388C EXTERN /end MEASUREMENT
/begin MEASUREMENT B_behsh "Bedingung: Bandendefunktionanford. für %DHLS" UWORD B_TRUE 1 100 0 1 BIT_MASK 0x20 FUNCTION_LIST DFPM_DHLSHK IF_DATA DIM_X 0x38388E EXTERN BYTE IF_DATA MCMESS 0x38388E EXTERN /end MEASUREMENT
/begin MEASUREMENT B_behsh2 "Bedingung: Bandendefunktionanford. für %DHLS Bank 2" UWORD B_TRUE 1 100 0 1 BIT_MASK 0x20 FUNCTION_LIST DFPM_DHLSHK IF_DATA DIM_X 0x383890 EXTERN BYTE IF_DATA MCMESS 0x383890 EXTERN /end MEASUREMENT
/begin MEASUREMENT B_behshe "Bedingung Bandende-Funktionsanforderung Endstufe Sondenheizung nach Kat" UWORD B_TRUE 1 100 0 1 BIT_MASK 0x20 FUNCTION_LIST DFPM_DEKON IF_DATA DIM_X 0x383892 EXTERN BYTE IF_DATA MCMESS 0x383892 EXTERN /end MEASUREMENT
/begin MEASUREMENT B_behshe2 "Bedingung Bandende-Funktionsanforderung Endstufe Sondenheizung nach Kat Bank 2" UWORD B_TRUE 1 100 0 1 BIT_MASK 0x20 FUNCTION_LIST DFPM_DEKON IF_DATA DIM_X 0x383894 EXTERN BYTE IF_DATA MCMESS 0x383894 EXTERN /end MEASUREMENT
/begin MEASUREMENT B_behsv "Bedingung: Bandendefunktionanford. für %DHRLSU" UWORD B_TRUE 1 100 0 1 BIT_MASK 0x20 FUNCTION_LIST DFPM_DHLSU IF_DATA DIM_X 0x383896 EXTERN BYTE IF_DATA MCMESS 0x383896 EXTERN /end MEASUREMENT
/begin MEASUREMENT B_behsv2 "Bedingung: Bandendefunktionanford. für %DHRLSU, Bank 2" UWORD B_TRUE 1 100 0 1 BIT_MASK 0x20 FUNCTION_LIST DFPM_DHLSU IF_DATA DIM_X 0x383898 EXTERN BYTE IF_DATA MCMESS 0x383898 EXTERN /end MEASUREMENT
/begin MEASUREMENT B_behsvsa "Bedingung: Bandendefunktionanford. für %DHLSU" UWORD B_TRUE 1 100 0 1 BIT_MASK 0x20 FUNCTION_LIST DFPM_DHLSU IF_DATA DIM_X 0x38389A EXTERN BYTE IF_DATA MCMESS 0x38389A EXTERN /end MEASUREMENT
/begin MEASUREMENT B_behsvsa2 "Bedingung: Bandendefunktionanford. für %DHLSU, Bank 2" UWORD B_TRUE 1 100 0 1 BIT_MASK 0x20 FUNCTION_LIST DFPM_DHLSU IF_DATA DIM_X 0x38389C EXTERN BYTE IF_DATA MCMESS 0x38389C EXTERN /end MEASUREMENT
/begin MEASUREMENT B_bekat "Bedingung Bandende-Funktionsanforderung Katalysatordiagnose" UWORD B_TRUE 1 100 0 1 BIT_MASK 0x20 FUNCTION_LIST DFPM_DKAT IF_DATA DIM_X 0x38389E EXTERN BYTE IF_DATA MCMESS 0x38389E EXTERN /end MEASUREMENT
/begin MEASUREMENT B_bekat2 "Bedingung Bandende-Funktionsanforderung Katalysatordiagnose, Bank2" UWORD B_TRUE 1 100 0 1 BIT_MASK 0x20 FUNCTION_LIST DFPM_DKAT IF_DATA DIM_X 0x3838A0 EXTERN BYTE IF_DATA MCMESS 0x3838A0 EXTERN /end MEASUREMENT
/begin MEASUREMENT B_bekos "" UWORD B_TRUE 1 100 0 1 BIT_MASK 0x20 FUNCTION_LIST DFPM_DEKON IF_DATA DIM_X 0x3838A2 EXTERN BYTE IF_DATA MCMESS 0x3838A2 EXTERN /end MEASUREMENT
/begin MEASUREMENT B_bekpe "Bedingung Bandendeanforderung für Fehler Endstufe EKP" UWORD B_TRUE 1 100 0 1 BIT_MASK 0x20 FUNCTION_LIST DFPM_DEKON IF_DATA DIM_X 0x3838A4 EXTERN BYTE IF_DATA MCMESS 0x3838A4 EXTERN /end MEASUREMENT
/begin MEASUREMENT B_bekrnt "Bedingung Bandende-Funktionsanforderung Klopfregelung Diagnose Nulltest" UWORD B_TRUE 1 100 0 1 BIT_MASK 0x20 FUNCTION_LIST DFPM_DKRNT IF_DATA DIM_X 0x3838A6 EXTERN BYTE IF_DATA MCMESS 0x3838A6 EXTERN /end MEASUREMENT
/begin MEASUREMENT B_bekrof "Bedingung Bandende-Funktionsanforderung Klopfregelung Diagnose Integrator Offset" UWORD B_TRUE 1 100 0 1 BIT_MASK 0x20 FUNCTION_LIST DFPM_DKRNT IF_DATA DIM_X 0x3838A8 EXTERN BYTE IF_DATA MCMESS 0x3838A8 EXTERN /end MEASUREMENT
/begin MEASUREMENT B_bekrtp "Bedingung Bandende-Funktionsanforderung Klopfregelung Diagnose Testpuls" UWORD B_TRUE 1 100 0 1 BIT_MASK 0x20 FUNCTION_LIST DFPM_DKRTP IF_DATA DIM_X 0x3838AA EXTERN BYTE IF_DATA MCMESS 0x3838AA EXTERN /end MEASUREMENT
/begin MEASUREMENT B_beks1 "Bedingung Bandende-Funktionsanforderung Diagnose Klopfsensor 1" UWORD B_TRUE 1 100 0 1 BIT_MASK 0x20 FUNCTION_LIST DFPM_DKRS IF_DATA DIM_X 0x3838AC EXTERN BYTE IF_DATA MCMESS 0x3838AC EXTERN /end MEASUREMENT
/begin MEASUREMENT B_beks2 "Bedingung Bandende-Funktionsanforderung Diagnose Klopfsensor 2" UWORD B_TRUE 1 100 0 1 BIT_MASK 0x20 FUNCTION_LIST DFPM_DKRS IF_DATA DIM_X 0x3838AE EXTERN BYTE IF_DATA MCMESS 0x3838AE EXTERN /end MEASUREMENT
/begin MEASUREMENT B_beks3 "Bedingung Bandende-Funktionsanforderung Diagnose Klopfsensor 3" UWORD B_TRUE 1 100 0 1 BIT_MASK 0x20 FUNCTION_LIST DFPM_DKRS IF_DATA DIM_X 0x3838B0 EXTERN BYTE IF_DATA MCMESS 0x3838B0 EXTERN /end MEASUREMENT
/begin MEASUREMENT B_beks4 "Bedingung Bandende-Funktionsanforderung Diagnose Klopfsensor 1" UWORD B_TRUE 1 100 0 1 BIT_MASK 0x20 FUNCTION_LIST DFPM_DKRS IF_DATA DIM_X 0x3838B2 EXTERN BYTE IF_DATA MCMESS 0x3838B2 EXTERN /end MEASUREMENT
/begin MEASUREMENT B_bekuppl "" UWORD B_TRUE 1 100 0 1 BIT_MASK 0x20 FUNCTION_LIST DFPM_DKUPPL IF_DATA DIM_X 0x3838B4 EXTERN BYTE IF_DATA MCMESS 0x3838B4 EXTERN /end MEASUREMENT
/begin MEASUREMENT B_bekwave "" UWORD B_TRUE 1 100 0 1 BIT_MASK 0x20 FUNCTION_LIST DFPM_DEKON IF_DATA DIM_X 0x3838B6 EXTERN BYTE IF_DATA MCMESS 0x3838B6 EXTERN /end MEASUREMENT
/begin MEASUREMENT B_belash "Bedingung Bandende-Funktionsanforderung Schwingungsprüfung hinter KAT" UWORD B_TRUE 1 100 0 1 BIT_MASK 0x20 FUNCTION_LIST DFPM_DLSAHK IF_DATA DIM_X 0x3838B8 EXTERN BYTE IF_DATA MCMESS 0x3838B8 EXTERN /end MEASUREMENT
/begin MEASUREMENT B_belash2 "Bedingung Bandende-Funktionsanforderung Schwingungsprüfung hinter KAT Bank2" UWORD B_TRUE 1 100 0 1 BIT_MASK 0x20 FUNCTION_LIST DFPM_DLSAHK IF_DATA DIM_X 0x3838BA EXTERN BYTE IF_DATA MCMESS 0x3838BA EXTERN /end MEASUREMENT
/begin MEASUREMENT B_belde "Bedingung: Fehlereintrag  LDR-Taktventil (Bandende)" UWORD B_TRUE 1 100 0 1 BIT_MASK 0x20 FUNCTION_LIST DFPM_DEKON IF_DATA DIM_X 0x3838BC EXTERN BYTE IF_DATA MCMESS 0x3838BC EXTERN /end MEASUREMENT
/begin MEASUREMENT B_beldo "Bedingung Bandende-Funktionsanforderung LDO" UWORD B_TRUE 1 100 0 1 BIT_MASK 0x20 FUNCTION_LIST DFPM_DLDR IF_DATA DIM_X 0x3838BE EXTERN BYTE IF_DATA MCMESS 0x3838BE EXTERN /end MEASUREMENT
/begin MEASUREMENT B_beldra "Bedingung Bandende-Funktionsanforderung LDRA" UWORD B_TRUE 1 100 0 1 BIT_MASK 0x20 FUNCTION_LIST DFPM_DLDR IF_DATA DIM_X 0x3838C0 EXTERN BYTE IF_DATA MCMESS 0x3838C0 EXTERN /end MEASUREMENT
/begin MEASUREMENT B_belf1e "" UWORD B_TRUE 1 100 0 1 BIT_MASK 0x20 FUNCTION_LIST DFPM_DEKON IF_DATA DIM_X 0x3838C2 EXTERN BYTE IF_DATA MCMESS 0x3838C2 EXTERN /end MEASUREMENT
/begin MEASUREMENT B_belf2e "" UWORD B_TRUE 1 100 0 1 BIT_MASK 0x20 FUNCTION_LIST DFPM_DEKON IF_DATA DIM_X 0x3838C4 EXTERN BYTE IF_DATA MCMESS 0x3838C4 EXTERN /end MEASUREMENT
/begin MEASUREMENT B_belf3e "" UWORD B_TRUE 1 100 0 1 BIT_MASK 0x20 FUNCTION_LIST DFPM_DEKON IF_DATA DIM_X 0x3838C6 EXTERN BYTE IF_DATA MCMESS 0x3838C6 EXTERN /end MEASUREMENT
/begin MEASUREMENT B_bellr "Bedingung Bandende-Funktionsanforderung Leerlaufregelung" UWORD B_TRUE 1 100 0 1 BIT_MASK 0x20 FUNCTION_LIST DFPM_DLLR IF_DATA DIM_X 0x3838C8 EXTERN BYTE IF_DATA MCMESS 0x3838C8 EXTERN /end MEASUREMENT
/begin MEASUREMENT B_belm "Bedingung Bandende-Funktionsanforderung Luftmassensensor (HFM/DSS)" UWORD B_TRUE 1 100 0 1 BIT_MASK 0x20 FUNCTION_LIST DFPM_DHFM IF_DATA DIM_X 0x3838CA EXTERN BYTE IF_DATA MCMESS 0x3838CA EXTERN /end MEASUREMENT
/begin MEASUREMENT B_belsh "Bedingung Bandende-Funktionsanforderung elktr. Diag. Lambda-Sonde hinter KAT" UWORD B_TRUE 1 100 0 1 BIT_MASK 0x20 FUNCTION_LIST DFPM_DLSH IF_DATA DIM_X 0x3838CC EXTERN BYTE IF_DATA MCMESS 0x3838CC EXTERN /end MEASUREMENT
/begin MEASUREMENT B_belsh2 "Bedingung Bandende-Funktionsanford. elktr. Diag. Lambda-Sonde hinter KAT Bank2" UWORD B_TRUE 1 100 0 1 BIT_MASK 0x20 FUNCTION_LIST DFPM_DLSH IF_DATA DIM_X 0x3838CE EXTERN BYTE IF_DATA MCMESS 0x3838CE EXTERN /end MEASUREMENT
/begin MEASUREMENT B_belsv "Bedingung Bandende-Funktionsanforderung elktr. Diag. Lambda-Sonde vor KAT" UWORD B_TRUE 1 100 0 1 BIT_MASK 0x20 FUNCTION_LIST DFPM_DLSU IF_DATA DIM_X 0x3838D0 EXTERN BYTE IF_DATA MCMESS 0x3838D0 EXTERN /end MEASUREMENT
/begin MEASUREMENT B_belsv2 "Bedingung Bandende-Funktionsanforderung elktr. Diag. Lambda-Sonde vor KAT Bank2" UWORD B_TRUE 1 100 0 1 BIT_MASK 0x20 FUNCTION_LIST DFPM_DLSU IF_DATA DIM_X 0x3838D2 EXTERN BYTE IF_DATA MCMESS 0x3838D2 EXTERN /end MEASUREMENT
/begin MEASUREMENT B_belsvv "Bedingung Bandende-Funktionsanforderung vertauschte Lambda-Sonde vor KAT" UWORD B_TRUE 1 100 0 1 BIT_MASK 0x20 FUNCTION_LIST DFPM_LSVV IF_DATA DIM_X 0x3838D4 EXTERN BYTE IF_DATA MCMESS 0x3838D4 EXTERN /end MEASUREMENT
/begin MEASUREMENT B_bemd "Bedingung Bandende-Funktionsanforderung Erkennung mehrfacher Aussetzer" UWORD B_TRUE 1 100 0 1 BIT_MASK 0x20 FUNCTION_LIST DFPM_DMDMIL IF_DATA DIM_X 0x3838D6 EXTERN BYTE IF_DATA MCMESS 0x3838D6 EXTERN /end MEASUREMENT
/begin MEASUREMENT B_bemd00 "Bedingung Bandende-Funktionsanforderung" UWORD B_TRUE 1 100 0 1 BIT_MASK 0x20 FUNCTION_LIST DFPM_DMDMIL IF_DATA DIM_X 0x3838D8 EXTERN BYTE IF_DATA MCMESS 0x3838D8 EXTERN /end MEASUREMENT
/begin MEASUREMENT B_bemd01 "Bedingung Bandende-Funktionsanforderung" UWORD B_TRUE 1 100 0 1 BIT_MASK 0x20 FUNCTION_LIST DFPM_DMDMIL IF_DATA DIM_X 0x3838DA EXTERN BYTE IF_DATA MCMESS 0x3838DA EXTERN /end MEASUREMENT
/begin MEASUREMENT B_bemd02 "Bedingung Bandende-Funktionsanforderung" UWORD B_TRUE 1 100 0 1 BIT_MASK 0x20 FUNCTION_LIST DFPM_DMDMIL IF_DATA DIM_X 0x3838DC EXTERN BYTE IF_DATA MCMESS 0x3838DC EXTERN /end MEASUREMENT
/begin MEASUREMENT B_bemd03 "Bedingung Bandende-Funktionsanforderung" UWORD B_TRUE 1 100 0 1 BIT_MASK 0x20 FUNCTION_LIST DFPM_DMDMIL IF_DATA DIM_X 0x3838DE EXTERN BYTE IF_DATA MCMESS 0x3838DE EXTERN /end MEASUREMENT
/begin MEASUREMENT B_bemd04 "" UWORD B_TRUE 1 100 0 1 BIT_MASK 0x20 FUNCTION_LIST DFPM_DMDMIL IF_DATA DIM_X 0x3838E0 EXTERN BYTE IF_DATA MCMESS 0x3838E0 EXTERN /end MEASUREMENT
/begin MEASUREMENT B_bemd05 "" UWORD B_TRUE 1 100 0 1 BIT_MASK 0x20 FUNCTION_LIST DFPM_DMDMIL IF_DATA DIM_X 0x3838E2 EXTERN BYTE IF_DATA MCMESS 0x3838E2 EXTERN /end MEASUREMENT
/begin MEASUREMENT B_bemdb "Bedingung Bandende-Funktionsanforderung MDB" UWORD B_TRUE 1 100 0 1 BIT_MASK 0x20 FUNCTION_LIST DFPM_MDKOG IF_DATA DIM_X 0x3838E4 EXTERN BYTE IF_DATA MCMESS 0x3838E4 EXTERN /end MEASUREMENT
/begin MEASUREMENT B_bemsg "" UWORD B_TRUE 1 100 0 1 BIT_MASK 0x20 FUNCTION_LIST DFPM_MLS IF_DATA DIM_X 0x3838E6 EXTERN BYTE IF_DATA MCMESS 0x3838E6 EXTERN /end MEASUREMENT
/begin MEASUREMENT B_bemsge "" UWORD B_TRUE 1 100 0 1 BIT_MASK 0x20 FUNCTION_LIST DFPM_DEKON IF_DATA DIM_X 0x3838E8 EXTERN BYTE IF_DATA MCMESS 0x3838E8 EXTERN /end MEASUREMENT
/begin MEASUREMENT B_ben "" UWORD B_TRUE 1 100 0 1 BIT_MASK 0x20 FUNCTION_LIST DFPM_DDG IF_DATA DIM_X 0x3838EA EXTERN BYTE IF_DATA MCMESS 0x3838EA EXTERN /end MEASUREMENT
/begin MEASUREMENT B_benwkw "Bedingung Bandende-Funktionsanforderung Zuordnung Nockenwelle zu Kurbelwelle" UWORD B_TRUE 1 100 0 1 BIT_MASK 0x20 FUNCTION_LIST DFPM_DNWKW IF_DATA DIM_X 0x3838EC EXTERN BYTE IF_DATA MCMESS 0x3838EC EXTERN /end MEASUREMENT
/begin MEASUREMENT B_benwkw2 "" UWORD B_TRUE 1 100 0 1 BIT_MASK 0x20 FUNCTION_LIST DFPM_DNWKW IF_DATA DIM_X 0x3838EE EXTERN BYTE IF_DATA MCMESS 0x3838EE EXTERN /end MEASUREMENT
/begin MEASUREMENT B_benws "" UWORD B_TRUE 1 100 0 1 BIT_MASK 0x20 FUNCTION_LIST DFPM_DNWS IF_DATA DIM_X 0x3838F0 EXTERN BYTE IF_DATA MCMESS 0x3838F0 EXTERN /end MEASUREMENT
/begin MEASUREMENT B_benws2 "" UWORD B_TRUE 1 100 0 1 BIT_MASK 0x20 FUNCTION_LIST DFPM_DNWS IF_DATA DIM_X 0x3838F2 EXTERN BYTE IF_DATA MCMESS 0x3838F2 EXTERN /end MEASUREMENT
/begin MEASUREMENT B_benwse "Bedingung Bandende-Funktionsanforderung NWS" UWORD B_TRUE 1 100 0 1 BIT_MASK 0x20 FUNCTION_LIST DFPM_DEKON IF_DATA DIM_X 0x3838F4 EXTERN BYTE IF_DATA MCMESS 0x3838F4 EXTERN /end MEASUREMENT
/begin MEASUREMENT B_benwse2 "" UWORD B_TRUE 1 100 0 1 BIT_MASK 0x20 FUNCTION_LIST DFPM_DEKON IF_DATA DIM_X 0x3838F6 EXTERN BYTE IF_DATA MCMESS 0x3838F6 EXTERN /end MEASUREMENT
/begin MEASUREMENT B_beph "Bedingung: Bandendefunktionanford. für Phasengeber" UWORD B_TRUE 1 100 0 1 BIT_MASK 0x20 FUNCTION_LIST DFPM_DPH IF_DATA DIM_X 0x3838F8 EXTERN BYTE IF_DATA MCMESS 0x3838F8 EXTERN /end MEASUREMENT
/begin MEASUREMENT B_beph2 "Bedingung: Bandendefunktionanford. für Phasengeber 2" UWORD B_TRUE 1 100 0 1 BIT_MASK 0x20 FUNCTION_LIST DFPM_DPH IF_DATA DIM_X 0x3838FA EXTERN BYTE IF_DATA MCMESS 0x3838FA EXTERN /end MEASUREMENT
/begin MEASUREMENT B_berkat "Bedingung: Bandendefunktionanford. für RKAT" UWORD B_TRUE 1 100 0 1 BIT_MASK 0x20 FUNCTION_LIST DFPM_DKVS IF_DATA DIM_X 0x3838FC EXTERN BYTE IF_DATA MCMESS 0x3838FC EXTERN /end MEASUREMENT
/begin MEASUREMENT B_berkat2 "Bedingung: Bandendefunktionanford. für RKAT2" UWORD B_TRUE 1 100 0 1 BIT_MASK 0x20 FUNCTION_LIST DFPM_DKVS IF_DATA DIM_X 0x3838FE EXTERN BYTE IF_DATA MCMESS 0x3838FE EXTERN /end MEASUREMENT
/begin MEASUREMENT B_berkaz "Bedingung: Bandendefunktionanford. für RKAZ" UWORD B_TRUE 1 100 0 1 BIT_MASK 0x20 FUNCTION_LIST DFPM_DKVS IF_DATA DIM_X 0x383900 EXTERN BYTE IF_DATA MCMESS 0x383900 EXTERN /end MEASUREMENT
/begin MEASUREMENT B_berkaz2 "Bedingung: Bandendefunktionanford. für RKAZ2" UWORD B_TRUE 1 100 0 1 BIT_MASK 0x20 FUNCTION_LIST DFPM_DKVS IF_DATA DIM_X 0x383902 EXTERN BYTE IF_DATA MCMESS 0x383902 EXTERN /end MEASUREMENT
/begin MEASUREMENT B_besch "Bedingung FGR im Zustand Beschleunigen" UBYTE B_TRUE 1 100 0 1 BIT_MASK 0x1 FUNCTION_LIST FGRMD IF_DATA DIM_X 0x380AD8 EXTERN BYTE IF_DATA MCMESS 0x380AD8 EXTERN /end MEASUREMENT
/begin MEASUREMENT B_besgeep "" UWORD B_TRUE 1 100 0 1 BIT_MASK 0x20 FUNCTION_LIST DFPM_DSGEEP IF_DATA DIM_X 0x383904 EXTERN BYTE IF_DATA MCMESS 0x383904 EXTERN /end MEASUREMENT
/begin MEASUREMENT B_beslpe "Bedingung Bandendeanforderung setzt Fehler Sekundärluftpumpe Endstufe" UWORD B_TRUE 1 100 0 1 BIT_MASK 0x20 FUNCTION_LIST DFPM_DEKON IF_DATA DIM_X 0x383906 EXTERN BYTE IF_DATA MCMESS 0x383906 EXTERN /end MEASUREMENT
/begin MEASUREMENT B_besls "Bedingung Bandende-Funktionsanforderung Sekundärluftsystem" UWORD B_TRUE 1 100 0 1 BIT_MASK 0x20 FUNCTION_LIST DFPM_DSLSLRS IF_DATA DIM_X 0x383908 EXTERN BYTE IF_DATA MCMESS 0x383908 EXTERN /end MEASUREMENT
/begin MEASUREMENT B_besls2 "Bedingung Bandende-Funktionsanforderung Sekundärluftsystem, Bank2" UWORD B_TRUE 1 100 0 1 BIT_MASK 0x20 FUNCTION_LIST DFPM_DSLSLRS IF_DATA DIM_X 0x38390A EXTERN BYTE IF_DATA MCMESS 0x38390A EXTERN /end MEASUREMENT
/begin MEASUREMENT B_beslv "Bedingung Bandende-Funktionsanforderung SLS" UWORD B_TRUE 1 100 0 1 BIT_MASK 0x20 FUNCTION_LIST DFPM_DSLSLRS IF_DATA DIM_X 0x38390C EXTERN BYTE IF_DATA MCMESS 0x38390C EXTERN /end MEASUREMENT
/begin MEASUREMENT B_beslv2 "Bedingung Bandende-Funktionsanforderung SLS, Bank2" UWORD B_TRUE 1 100 0 1 BIT_MASK 0x20 FUNCTION_LIST DFPM_DSLSLRS IF_DATA DIM_X 0x38390E EXTERN BYTE IF_DATA MCMESS 0x38390E EXTERN /end MEASUREMENT
/begin MEASUREMENT B_beslve "Bedingung Bandendeanforderung setzt Fehler Sekundärluftventil Endstufe" UWORD B_TRUE 1 100 0 1 BIT_MASK 0x20 FUNCTION_LIST DFPM_DEKON IF_DATA DIM_X 0x383910 EXTERN BYTE IF_DATA MCMESS 0x383910 EXTERN /end MEASUREMENT
/begin MEASUREMENT B_beswe "Bedingung Bandende-Funktionsanforderung Beschleunigungss. f Schlechtwegerkennung" UWORD B_TRUE 1 100 0 1 BIT_MASK 0x20 FUNCTION_LIST DFPM_BGRBS IF_DATA DIM_X 0x383912 EXTERN BYTE IF_DATA MCMESS 0x383912 EXTERN /end MEASUREMENT
/begin MEASUREMENT B_beta "Bedingung Bandende-Funktionsanforderung Ansauglufttemperaturfühler" UWORD B_TRUE 1 100 0 1 BIT_MASK 0x20 FUNCTION_LIST DFPM_GGTFA IF_DATA DIM_X 0x383914 EXTERN BYTE IF_DATA MCMESS 0x383914 EXTERN /end MEASUREMENT
/begin MEASUREMENT B_betes "Bedingung Bandende-Funktionsanforderung Tankentlüftungssystem" UWORD B_TRUE 1 100 0 1 BIT_MASK 0x20 FUNCTION_LIST DFPM_DTEV IF_DATA DIM_X 0x383916 EXTERN BYTE IF_DATA MCMESS 0x383916 EXTERN /end MEASUREMENT
/begin MEASUREMENT B_beteve "Bedingung Bandendeanford. für Fehler Tanentlüftungsventil Endstufe" UWORD B_TRUE 1 100 0 1 BIT_MASK 0x20 FUNCTION_LIST DFPM_DEKON IF_DATA DIM_X 0x383918 EXTERN BYTE IF_DATA MCMESS 0x383918 EXTERN /end MEASUREMENT
/begin MEASUREMENT B_betget "" UWORD B_TRUE 1 100 0 1 BIT_MASK 0x20 FUNCTION_LIST DFPM_GGTGET IF_DATA DIM_X 0x38391C EXTERN BYTE IF_DATA MCMESS 0x38391C EXTERN /end MEASUREMENT
/begin MEASUREMENT B_bethm "Bedingung Bandendeanforderung für Thermostatdiagnose" UWORD B_TRUE 1 100 0 1 BIT_MASK 0x20 FUNCTION_LIST DFPM_GGTFM IF_DATA DIM_X 0x38391E EXTERN BYTE IF_DATA MCMESS 0x38391E EXTERN /end MEASUREMENT
/begin MEASUREMENT B_betm "Bedingung Bandende-Funktionsanforderung Motortemperaturfühler" UWORD B_TRUE 1 100 0 1 BIT_MASK 0x20 FUNCTION_LIST DFPM_GGTFM IF_DATA DIM_X 0x383920 EXTERN BYTE IF_DATA MCMESS 0x383920 EXTERN /end MEASUREMENT
/begin MEASUREMENT B_betmki "" UWORD B_TRUE 1 100 0 1 BIT_MASK 0x20 FUNCTION_LIST DFPM_DUMMY043 IF_DATA DIM_X 0x383922 EXTERN BYTE IF_DATA MCMESS 0x383922 EXTERN /end MEASUREMENT
/begin MEASUREMENT B_betmr "" UWORD B_TRUE 1 100 0 1 BIT_MASK 0x20 FUNCTION_LIST DFPM_GGTFMR IF_DATA DIM_X 0x383924 EXTERN BYTE IF_DATA MCMESS 0x383924 EXTERN /end MEASUREMENT
/begin MEASUREMENT B_betol "Bedingung Bandende-Funktionsanforderung" UWORD B_TRUE 1 100 0 1 BIT_MASK 0x20 FUNCTION_LIST DFPM_GGTFOL IF_DATA DIM_X 0x383926 EXTERN BYTE IF_DATA MCMESS 0x383926 EXTERN /end MEASUREMENT
/begin MEASUREMENT B_betum "Bedingung Bandende-Funktionsanforderung" UWORD B_TRUE 1 100 0 1 BIT_MASK 0x20 FUNCTION_LIST DFPM_GGTFUMG IF_DATA DIM_X 0x383928 EXTERN BYTE IF_DATA MCMESS 0x383928 EXTERN /end MEASUREMENT
/begin MEASUREMENT B_beub "Bedingung: Bandendefunktionanford. für Batteriespannung (Bordnetz)" UWORD B_TRUE 1 100 0 1 BIT_MASK 0x20 FUNCTION_LIST DFPM_GGUB IF_DATA DIM_X 0x38392A EXTERN BYTE IF_DATA MCMESS 0x38392A EXTERN /end MEASUREMENT
/begin MEASUREMENT B_beufmv "Bedingung Bandende:Fktüberwachung-Anforderung" UWORD B_TRUE 1 100 0 1 BIT_MASK 0x20 FUNCTION_LIST DFPM_DUF IF_DATA DIM_X 0x38392C EXTERN BYTE IF_DATA MCMESS 0x38392C EXTERN /end MEASUREMENT
/begin MEASUREMENT B_beufska "Bedingung Bandende:Fktüberwachung-Anforderung" UWORD B_TRUE 1 100 0 1 BIT_MASK 0x20 FUNCTION_LIST DFPM_DUF IF_DATA DIM_X 0x38392E EXTERN BYTE IF_DATA MCMESS 0x38392E EXTERN /end MEASUREMENT
/begin MEASUREMENT B_beurram "" UWORD B_TRUE 1 100 0 1 BIT_MASK 0x20 FUNCTION_LIST DFPM_DUR IF_DATA DIM_X 0x383930 EXTERN BYTE IF_DATA MCMESS 0x383930 EXTERN /end MEASUREMENT
/begin MEASUREMENT B_beurrom "" UWORD B_TRUE 1 100 0 1 BIT_MASK 0x20 FUNCTION_LIST DFPM_DUR IF_DATA DIM_X 0x383932 EXTERN BYTE IF_DATA MCMESS 0x383932 EXTERN /end MEASUREMENT
/begin MEASUREMENT B_beurrst "" UWORD B_TRUE 1 100 0 1 BIT_MASK 0x20 FUNCTION_LIST DFPM_DUR IF_DATA DIM_X 0x383934 EXTERN BYTE IF_DATA MCMESS 0x383934 EXTERN /end MEASUREMENT
/begin MEASUREMENT B_beuvse "Bedingung: Fehlereintrag  Umluftventil turbo (Bandende)" UWORD B_TRUE 1 100 0 1 BIT_MASK 0x20 FUNCTION_LIST DFPM_DEKON IF_DATA DIM_X 0x383936 EXTERN BYTE IF_DATA MCMESS 0x383936 EXTERN /end MEASUREMENT
/begin MEASUREMENT B_bevab "Bedingung EV-Abschaltung auf Bank/Bank1" UWORD B_TRUE 1 100 0 1 BIT_MASK 0x1 FUNCTION_LIST BGEVAB LAMKO LRSKA IF_DATA DIM_X 0xFD50 INTERN BYTE IF_DATA MCMESS 0xFD50 INTERN /end MEASUREMENT
/begin MEASUREMENT B_bevab2 "Bedingung EV-Abschaltung auf Bank2" UWORD B_TRUE 1 100 0 1 BIT_MASK 0x2 FUNCTION_LIST BGEVAB LAMKO LRSKA IF_DATA DIM_X 0xFD50 INTERN BYTE IF_DATA MCMESS 0xFD50 INTERN /end MEASUREMENT
/begin MEASUREMENT B_bevfz "Bedingung Bandende-Funktionsanforderung für Fehlerpfad Fahrzeuggeschwindigkeit" UWORD B_TRUE 1 100 0 1 BIT_MASK 0x20 FUNCTION_LIST DFPM_DVFZ IF_DATA DIM_X 0x383938 EXTERN BYTE IF_DATA MCMESS 0x383938 EXTERN /end MEASUREMENT
/begin MEASUREMENT B_bevs01 "" UWORD B_TRUE 1 100 0 1 BIT_MASK 0x20 FUNCTION_LIST DFPM_DVS IF_DATA DIM_X 0x38393A EXTERN BYTE IF_DATA MCMESS 0x38393A EXTERN /end MEASUREMENT
/begin MEASUREMENT B_bevs02 "" UWORD B_TRUE 1 100 0 1 BIT_MASK 0x20 FUNCTION_LIST DFPM_DVS IF_DATA DIM_X 0x38393C EXTERN BYTE IF_DATA MCMESS 0x38393C EXTERN /end MEASUREMENT
/begin MEASUREMENT B_bevs03 "" UWORD B_TRUE 1 100 0 1 BIT_MASK 0x20 FUNCTION_LIST DFPM_DVS IF_DATA DIM_X 0x38393E EXTERN BYTE IF_DATA MCMESS 0x38393E EXTERN /end MEASUREMENT
/begin MEASUREMENT B_bevs04 "" UWORD B_TRUE 1 100 0 1 BIT_MASK 0x20 FUNCTION_LIST DFPM_DVS IF_DATA DIM_X 0x383940 EXTERN BYTE IF_DATA MCMESS 0x383940 EXTERN /end MEASUREMENT
/begin MEASUREMENT B_bevs05 "" UWORD B_TRUE 1 100 0 1 BIT_MASK 0x20 FUNCTION_LIST DFPM_DVS IF_DATA DIM_X 0x383942 EXTERN BYTE IF_DATA MCMESS 0x383942 EXTERN /end MEASUREMENT
/begin MEASUREMENT B_bevs06 "" UWORD B_TRUE 1 100 0 1 BIT_MASK 0x20 FUNCTION_LIST DFPM_DVS IF_DATA DIM_X 0x383944 EXTERN BYTE IF_DATA MCMESS 0x383944 EXTERN /end MEASUREMENT
/begin MEASUREMENT B_bevs1e "" UWORD B_TRUE 1 100 0 1 BIT_MASK 0x20 FUNCTION_LIST DFPM_DEKON IF_DATA DIM_X 0x383946 EXTERN BYTE IF_DATA MCMESS 0x383946 EXTERN /end MEASUREMENT
/begin MEASUREMENT B_bevs2e "" UWORD B_TRUE 1 100 0 1 BIT_MASK 0x20 FUNCTION_LIST DFPM_DEKON IF_DATA DIM_X 0x383948 EXTERN BYTE IF_DATA MCMESS 0x383948 EXTERN /end MEASUREMENT
/begin MEASUREMENT B_bevsb1 "" UWORD B_TRUE 1 100 0 1 BIT_MASK 0x20 FUNCTION_LIST DFPM_DVS IF_DATA DIM_X 0x38394A EXTERN BYTE IF_DATA MCMESS 0x38394A EXTERN /end MEASUREMENT
/begin MEASUREMENT B_bevsb2 "" UWORD B_TRUE 1 100 0 1 BIT_MASK 0x20 FUNCTION_LIST DFPM_DVS IF_DATA DIM_X 0x38394C EXTERN BYTE IF_DATA MCMESS 0x38394C EXTERN /end MEASUREMENT
/begin MEASUREMENT B_bevss "" UWORD B_TRUE 1 100 0 1 BIT_MASK 0x20 FUNCTION_LIST DFPM_DVS IF_DATA DIM_X 0x38394E EXTERN BYTE IF_DATA MCMESS 0x38394E EXTERN /end MEASUREMENT
/begin MEASUREMENT B_bewfs "" UWORD B_TRUE 1 100 0 1 BIT_MASK 0x20 FUNCTION_LIST DFPM_WFS IF_DATA DIM_X 0x383950 EXTERN BYTE IF_DATA MCMESS 0x383950 EXTERN /end MEASUREMENT
/begin MEASUREMENT B_bfgruo "Bedingung zul. obere o. untere Beschleunigungsschwelle im FGR-Betrieb verletzt" UBYTE B_TRUE 1 100 0 1 BIT_MASK 0x8 FUNCTION_LIST BBFGR IF_DATA DIM_X 0x380AD4 EXTERN BYTE IF_DATA MCMESS 0x380AD4 EXTERN /end MEASUREMENT
/begin MEASUREMENT B_bfklt "Bereichsfenster Motorbetrieb, Bedingung kalt, TMOT<TMWUC" UBYTE B_TRUE 1 100 0 1 BIT_MASK 0x20 FUNCTION_LIST DMDMIL IF_DATA DIM_X 0x382FC4 EXTERN BYTE IF_DATA MCMESS 0x382FC4 EXTERN /end MEASUREMENT
/begin MEASUREMENT B_bfwrm "Bereichsfenster Motorbetrieb, Bedingung warm, TMOT>TMWUC" UBYTE B_TRUE 1 100 0 1 BIT_MASK 0x10 FUNCTION_LIST DMDMIL IF_DATA DIM_X 0x382FC4 EXTERN BYTE IF_DATA MCMESS 0x382FC4 EXTERN /end MEASUREMENT
/begin MEASUREMENT B_bkaave "Bedingung Ersatzwert aktiv Tankdiagnose, AAVE-Ventil Endstufe" UWORD B_TRUE 1 100 0 1 BIT_MASK 0x40 FUNCTION_LIST DFPM_DEKON IF_DATA DIM_X 0x383816 EXTERN BYTE IF_DATA MCMESS 0x383816 EXTERN /end MEASUREMENT
/begin MEASUREMENT B_bkagre "Bedingung: Abgasrückführungsventil Endstufe" UWORD B_TRUE 1 100 0 1 BIT_MASK 0x40 FUNCTION_LIST DFPM_DUMMY043 IF_DATA DIM_X 0x383818 EXTERN BYTE IF_DATA MCMESS 0x383818 EXTERN /end MEASUREMENT
/begin MEASUREMENT B_bkbm "Bedingung Ersatzwert aktiv: Bezugsmarke" UWORD B_TRUE 1 100 0 1 BIT_MASK 0x40 FUNCTION_LIST DFPM_DDG IF_DATA DIM_X 0x38381C EXTERN BYTE IF_DATA MCMESS 0x38381C EXTERN /end MEASUREMENT
/begin MEASUREMENT B_bkbrems "Bedingung Ersatzwert aktiv: BREMS (Bremsschalter)" UWORD B_TRUE 1 100 0 1 BIT_MASK 0x40 FUNCTION_LIST DFPM_GGEGAS IF_DATA DIM_X 0x38381E EXTERN BYTE IF_DATA MCMESS 0x38381E EXTERN /end MEASUREMENT
/begin MEASUREMENT B_bkbwf "Flag für Ersatzwert: PWG Bewegung" UWORD B_TRUE 1 100 0 1 BIT_MASK 0x40 FUNCTION_LIST DFPM_GGPED IF_DATA DIM_X 0x383820 EXTERN BYTE IF_DATA MCMESS 0x383820 EXTERN /end MEASUREMENT
/begin MEASUREMENT B_bkcas "Bedingung: CAN-Schnittstelle, Timeout ASC" UWORD B_TRUE 1 100 0 1 BIT_MASK 0x40 FUNCTION_LIST DFPM_DCAS IF_DATA DIM_X 0x383822 EXTERN BYTE IF_DATA MCMESS 0x383822 EXTERN /end MEASUREMENT
/begin MEASUREMENT B_bkcge "Bedingung: CAN-Schnittstelle, Timeout EGS" UWORD B_TRUE 1 100 0 1 BIT_MASK 0x40 FUNCTION_LIST DFPM_DCGE IF_DATA DIM_X 0x383824 EXTERN BYTE IF_DATA MCMESS 0x383824 EXTERN /end MEASUREMENT
/begin MEASUREMENT B_bkcgegs "" UWORD B_TRUE 1 100 0 1 BIT_MASK 0x40 FUNCTION_LIST DFPM_DCG IF_DATA DIM_X 0x383826 EXTERN BYTE IF_DATA MCMESS 0x383826 EXTERN /end MEASUREMENT
/begin MEASUREMENT B_bkcgggp "" UWORD B_TRUE 1 100 0 1 BIT_MASK 0x40 FUNCTION_LIST DFPM_DCG IF_DATA DIM_X 0x383828 EXTERN BYTE IF_DATA MCMESS 0x383828 EXTERN /end MEASUREMENT
/begin MEASUREMENT B_bkcgggv "" UWORD B_TRUE 1 100 0 1 BIT_MASK 0x40 FUNCTION_LIST DFPM_DCG IF_DATA DIM_X 0x38382A EXTERN BYTE IF_DATA MCMESS 0x38382A EXTERN /end MEASUREMENT
/begin MEASUREMENT B_bkcgm1v "" UWORD B_TRUE 1 100 0 1 BIT_MASK 0x40 FUNCTION_LIST DFPM_DCG IF_DATA DIM_X 0x38382C EXTERN BYTE IF_DATA MCMESS 0x38382C EXTERN /end MEASUREMENT
/begin MEASUREMENT B_bkcgm2v "" UWORD B_TRUE 1 100 0 1 BIT_MASK 0x40 FUNCTION_LIST DFPM_DCG IF_DATA DIM_X 0x38382E EXTERN BYTE IF_DATA MCMESS 0x38382E EXTERN /end MEASUREMENT
/begin MEASUREMENT B_bkcgm3v "" UWORD B_TRUE 1 100 0 1 BIT_MASK 0x40 FUNCTION_LIST DFPM_DCG IF_DATA DIM_X 0x383830 EXTERN BYTE IF_DATA MCMESS 0x383830 EXTERN /end MEASUREMENT
/begin MEASUREMENT B_bkcgmvk "" UWORD B_TRUE 1 100 0 1 BIT_MASK 0x40 FUNCTION_LIST DFPM_DCG IF_DATA DIM_X 0x383832 EXTERN BYTE IF_DATA MCMESS 0x383832 EXTERN /end MEASUREMENT
/begin MEASUREMENT B_bkcgrmm "" UWORD B_TRUE 1 100 0 1 BIT_MASK 0x40 FUNCTION_LIST DFPM_DCG IF_DATA DIM_X 0x383834 EXTERN BYTE IF_DATA MCMESS 0x383834 EXTERN /end MEASUREMENT
/begin MEASUREMENT B_bkcgrms "" UWORD B_TRUE 1 100 0 1 BIT_MASK 0x40 FUNCTION_LIST DFPM_DCG IF_DATA DIM_X 0x383836 EXTERN BYTE IF_DATA MCMESS 0x383836 EXTERN /end MEASUREMENT
/begin MEASUREMENT B_bkcgudg "" UWORD B_TRUE 1 100 0 1 BIT_MASK 0x40 FUNCTION_LIST DFPM_DCG IF_DATA DIM_X 0x383838 EXTERN BYTE IF_DATA MCMESS 0x383838 EXTERN /end MEASUREMENT
/begin MEASUREMENT B_bkcgumv "" UWORD B_TRUE 1 100 0 1 BIT_MASK 0x40 FUNCTION_LIST DFPM_DCG IF_DATA DIM_X 0x38383A EXTERN BYTE IF_DATA MCMESS 0x38383A EXTERN /end MEASUREMENT
/begin MEASUREMENT B_bkcgvgc "" UWORD B_TRUE 1 100 0 1 BIT_MASK 0x40 FUNCTION_LIST DFPM_DCG IF_DATA DIM_X 0x38383C EXTERN BYTE IF_DATA MCMESS 0x38383C EXTERN /end MEASUREMENT
/begin MEASUREMENT B_bkcgvrc "" UWORD B_TRUE 1 100 0 1 BIT_MASK 0x40 FUNCTION_LIST DFPM_DCG IF_DATA DIM_X 0x38383E EXTERN BYTE IF_DATA MCMESS 0x38383E EXTERN /end MEASUREMENT
/begin MEASUREMENT B_bkcgwk "" UWORD B_TRUE 1 100 0 1 BIT_MASK 0x40 FUNCTION_LIST DFPM_DCG IF_DATA DIM_X 0x383840 EXTERN BYTE IF_DATA MCMESS 0x383840 EXTERN /end MEASUREMENT
/begin MEASUREMENT B_bkckbi "" UWORD B_TRUE 1 100 0 1 BIT_MASK 0x40 FUNCTION_LIST DFPM_DCKBI IF_DATA DIM_X 0x383842 EXTERN BYTE IF_DATA MCMESS 0x383842 EXTERN /end MEASUREMENT
/begin MEASUREMENT B_bkcmil "" UWORD B_TRUE 1 100 0 1 BIT_MASK 0x40 FUNCTION_LIST DFPM_DCMIL IF_DATA DIM_X 0x383844 EXTERN BYTE IF_DATA MCMESS 0x383844 EXTERN /end MEASUREMENT
/begin MEASUREMENT B_bkcra "" UWORD B_TRUE 1 100 0 1 BIT_MASK 0x40 FUNCTION_LIST DFPM_GGAIRBAG IF_DATA DIM_X 0x383846 EXTERN BYTE IF_DATA MCMESS 0x383846 EXTERN /end MEASUREMENT
/begin MEASUREMENT B_bkdk "Bedingung Eratzwert aktiv: Fehler Drosselklappenpoti löschen" UWORD B_TRUE 1 100 0 1 BIT_MASK 0x40 FUNCTION_LIST DFPM_DDVE IF_DATA DIM_X 0x383848 EXTERN BYTE IF_DATA MCMESS 0x383848 EXTERN /end MEASUREMENT
/begin MEASUREMENT B_bkdk1p "Bedingung Ersatzwert aktiv: Drosselklappe 1.Poti" UWORD B_TRUE 1 100 0 1 BIT_MASK 0x40 FUNCTION_LIST DFPM_DDVE IF_DATA DIM_X 0x38384A EXTERN BYTE IF_DATA MCMESS 0x38384A EXTERN /end MEASUREMENT
/begin MEASUREMENT B_bkdk2p "Bedingung Ersatzwert aktiv: Drosselklappe 2.Poti" UWORD B_TRUE 1 100 0 1 BIT_MASK 0x40 FUNCTION_LIST DFPM_DDVE IF_DATA DIM_X 0x38384C EXTERN BYTE IF_DATA MCMESS 0x38384C EXTERN /end MEASUREMENT
/begin MEASUREMENT B_bkdsl "Bedingung: DSL aktiv" UWORD B_TRUE 1 100 0 1 BIT_MASK 0x40 FUNCTION_LIST DFPM_GGDSAS IF_DATA DIM_X 0x383850 EXTERN BYTE IF_DATA MCMESS 0x383850 EXTERN /end MEASUREMENT
/begin MEASUREMENT B_bkdsu "Bedingung: Umgebungsdrucksensor" UWORD B_TRUE 1 100 0 1 BIT_MASK 0x40 FUNCTION_LIST DFPM_GGDSAS IF_DATA DIM_X 0x383852 EXTERN BYTE IF_DATA MCMESS 0x383852 EXTERN /end MEASUREMENT
/begin MEASUREMENT B_bkdsvlu "Bedingung: Drucksensorsingnalvergleich (DS-L DS-U)" UWORD B_TRUE 1 100 0 1 BIT_MASK 0x40 FUNCTION_LIST DFPM_GGDSAS IF_DATA DIM_X 0x383854 EXTERN BYTE IF_DATA MCMESS 0x383854 EXTERN /end MEASUREMENT
/begin MEASUREMENT B_bkdvee "Bedingung: DV-E Endstufe" UWORD B_TRUE 1 100 0 1 BIT_MASK 0x40 FUNCTION_LIST DFPM_DDVE IF_DATA DIM_X 0x383856 EXTERN BYTE IF_DATA MCMESS 0x383856 EXTERN /end MEASUREMENT
/begin MEASUREMENT B_bkdvef "Bedingung: DV-E Fehler bei Federprüfung" UWORD B_TRUE 1 100 0 1 BIT_MASK 0x40 FUNCTION_LIST DFPM_DDVE IF_DATA DIM_X 0x383858 EXTERN BYTE IF_DATA MCMESS 0x383858 EXTERN /end MEASUREMENT
/begin MEASUREMENT B_bkdvefo "" UWORD B_TRUE 1 100 0 1 BIT_MASK 0x40 FUNCTION_LIST DFPM_DDVE IF_DATA DIM_X 0x38385A EXTERN BYTE IF_DATA MCMESS 0x38385A EXTERN /end MEASUREMENT
/begin MEASUREMENT B_bkdvel "Bedingung: DV-E Lageabweichung" UWORD B_TRUE 1 100 0 1 BIT_MASK 0x40 FUNCTION_LIST DFPM_DDVE IF_DATA DIM_X 0x38385C EXTERN BYTE IF_DATA MCMESS 0x38385C EXTERN /end MEASUREMENT
/begin MEASUREMENT B_bkdven "Ersatzwert aktiv: DV-E Notluftposition" UWORD B_TRUE 1 100 0 1 BIT_MASK 0x40 FUNCTION_LIST DFPM_DDVE IF_DATA DIM_X 0x38385E EXTERN BYTE IF_DATA MCMESS 0x38385E EXTERN /end MEASUREMENT
/begin MEASUREMENT B_bkdver "Bedingung: DV-E Regelbereich" UWORD B_TRUE 1 100 0 1 BIT_MASK 0x40 FUNCTION_LIST DFPM_DDVE IF_DATA DIM_X 0x383860 EXTERN BYTE IF_DATA MCMESS 0x383860 EXTERN /end MEASUREMENT
/begin MEASUREMENT B_bkdvet "" UWORD B_TRUE 1 100 0 1 BIT_MASK 0x40 FUNCTION_LIST DFPM_DDVE IF_DATA DIM_X 0x383862 EXTERN BYTE IF_DATA MCMESS 0x383862 EXTERN /end MEASUREMENT
/begin MEASUREMENT B_bkdveu "Ersatzwert aktiv: DV-E UMA-Lernen" UWORD B_TRUE 1 100 0 1 BIT_MASK 0x40 FUNCTION_LIST DFPM_DDVE IF_DATA DIM_X 0x383864 EXTERN BYTE IF_DATA MCMESS 0x383864 EXTERN /end MEASUREMENT
/begin MEASUREMENT B_bkdveub "" UWORD B_TRUE 1 100 0 1 BIT_MASK 0x40 FUNCTION_LIST DFPM_DDVE IF_DATA DIM_X 0x383866 EXTERN BYTE IF_DATA MCMESS 0x383866 EXTERN /end MEASUREMENT
/begin MEASUREMENT B_bkdveuw "Bedingung Ersatzwert aktiv: Fehler bei UMA-Wiederlernen" UWORD B_TRUE 1 100 0 1 BIT_MASK 0x40 FUNCTION_LIST DFPM_DDVE IF_DATA DIM_X 0x383868 EXTERN BYTE IF_DATA MCMESS 0x383868 EXTERN /end MEASUREMENT
/begin MEASUREMENT B_bkdvev "Ersatzwert aktiv: DV-E Verstärkerabgleich" UWORD B_TRUE 1 100 0 1 BIT_MASK 0x40 FUNCTION_LIST DFPM_DDVE IF_DATA DIM_X 0x38386A EXTERN BYTE IF_DATA MCMESS 0x38386A EXTERN /end MEASUREMENT
/begin MEASUREMENT B_bkegfe "Bedingung: Ersatzwert aktiv bei Eingangsgrößen der Füllungserfassung" UWORD B_TRUE 1 100 0 1 BIT_MASK 0x40 FUNCTION_LIST DFPM_EGFE IF_DATA DIM_X 0x38386C EXTERN BYTE IF_DATA MCMESS 0x38386C EXTERN /end MEASUREMENT
/begin MEASUREMENT B_bkev1 "Bedingung: Einspritzventil 1 aktiv" UWORD B_TRUE 1 100 0 1 BIT_MASK 0x40 FUNCTION_LIST DFPM_DEKON IF_DATA DIM_X 0x38386E EXTERN BYTE IF_DATA MCMESS 0x38386E EXTERN /end MEASUREMENT
/begin MEASUREMENT B_bkev2 "Bedingung: Einspritzventil 2 aktiv" UWORD B_TRUE 1 100 0 1 BIT_MASK 0x40 FUNCTION_LIST DFPM_DEKON IF_DATA DIM_X 0x383870 EXTERN BYTE IF_DATA MCMESS 0x383870 EXTERN /end MEASUREMENT
/begin MEASUREMENT B_bkev3 "Bedingung: Einspritzventil 3 aktiv" UWORD B_TRUE 1 100 0 1 BIT_MASK 0x40 FUNCTION_LIST DFPM_DEKON IF_DATA DIM_X 0x383872 EXTERN BYTE IF_DATA MCMESS 0x383872 EXTERN /end MEASUREMENT
/begin MEASUREMENT B_bkev4 "Bedingung: Einspritzventil 4 aktiv" UWORD B_TRUE 1 100 0 1 BIT_MASK 0x40 FUNCTION_LIST DFPM_DEKON IF_DATA DIM_X 0x383874 EXTERN BYTE IF_DATA MCMESS 0x383874 EXTERN /end MEASUREMENT
/begin MEASUREMENT B_bkev5 "Bedingung: Einspritzventil 5 aktiv" UWORD B_TRUE 1 100 0 1 BIT_MASK 0x40 FUNCTION_LIST DFPM_DEKON IF_DATA DIM_X 0x383876 EXTERN BYTE IF_DATA MCMESS 0x383876 EXTERN /end MEASUREMENT
/begin MEASUREMENT B_bkev6 "Bedingung: Einspritzventil 6 aktiv" UWORD B_TRUE 1 100 0 1 BIT_MASK 0x40 FUNCTION_LIST DFPM_DEKON IF_DATA DIM_X 0x383878 EXTERN BYTE IF_DATA MCMESS 0x383878 EXTERN /end MEASUREMENT
/begin MEASUREMENT B_bkfgrl "" UWORD B_TRUE 1 100 0 1 BIT_MASK 0x40 FUNCTION_LIST DFPM_DCFGRL IF_DATA DIM_X 0x38387A EXTERN BYTE IF_DATA MCMESS 0x38387A EXTERN /end MEASUREMENT
/begin MEASUREMENT B_bkfp1p "Bedingung: Fahrpedal 1.Potentiometer aktiv" UWORD B_TRUE 1 100 0 1 BIT_MASK 0x40 FUNCTION_LIST DFPM_GGPED IF_DATA DIM_X 0x38387C EXTERN BYTE IF_DATA MCMESS 0x38387C EXTERN /end MEASUREMENT
/begin MEASUREMENT B_bkfp2p "Bedingung: Fahrpedal 2.Potentiometer aktiv" UWORD B_TRUE 1 100 0 1 BIT_MASK 0x40 FUNCTION_LIST DFPM_GGPED IF_DATA DIM_X 0x38387E EXTERN BYTE IF_DATA MCMESS 0x38387E EXTERN /end MEASUREMENT
/begin MEASUREMENT B_bkfpp "Bedingung: Fahrpedal Potentiometer aktiv" UWORD B_TRUE 1 100 0 1 BIT_MASK 0x40 FUNCTION_LIST DFPM_GGPED IF_DATA DIM_X 0x383880 EXTERN BYTE IF_DATA MCMESS 0x383880 EXTERN /end MEASUREMENT
/begin MEASUREMENT B_bkfrao "Ersatzwert für FRAO aktiv" UWORD B_TRUE 1 100 0 1 BIT_MASK 0x40 FUNCTION_LIST DFPM_DKVS IF_DATA DIM_X 0x383882 EXTERN BYTE IF_DATA MCMESS 0x383882 EXTERN /end MEASUREMENT
/begin MEASUREMENT B_bkfrao2 "Ersatzwert für FRAO aktiv Bank 2" UWORD B_TRUE 1 100 0 1 BIT_MASK 0x40 FUNCTION_LIST DFPM_DKVS IF_DATA DIM_X 0x383884 EXTERN BYTE IF_DATA MCMESS 0x383884 EXTERN /end MEASUREMENT
/begin MEASUREMENT B_bkfrau "Ersatzwert für FRAU aktiv" UWORD B_TRUE 1 100 0 1 BIT_MASK 0x40 FUNCTION_LIST DFPM_DKVS IF_DATA DIM_X 0x383886 EXTERN BYTE IF_DATA MCMESS 0x383886 EXTERN /end MEASUREMENT
/begin MEASUREMENT B_bkfrau2 "Ersatzwert für FRAU aktiv Bank 2" UWORD B_TRUE 1 100 0 1 BIT_MASK 0x40 FUNCTION_LIST DFPM_DKVS IF_DATA DIM_X 0x383888 EXTERN BYTE IF_DATA MCMESS 0x383888 EXTERN /end MEASUREMENT
/begin MEASUREMENT B_bkfrst "Bedingung: LR-Abweichung" UWORD B_TRUE 1 100 0 1 BIT_MASK 0x40 FUNCTION_LIST DFPM_DKVS IF_DATA DIM_X 0x38388A EXTERN BYTE IF_DATA MCMESS 0x38388A EXTERN /end MEASUREMENT
/begin MEASUREMENT B_bkfrst2 "Bedingung: LR-Abweichung Bank 2" UWORD B_TRUE 1 100 0 1 BIT_MASK 0x40 FUNCTION_LIST DFPM_DKVS IF_DATA DIM_X 0x38388C EXTERN BYTE IF_DATA MCMESS 0x38388C EXTERN /end MEASUREMENT
/begin MEASUREMENT B_bkhsh "Bedingung: Lambdasondenheizung hinter Kat. aktiv" UWORD B_TRUE 1 100 0 1 BIT_MASK 0x40 FUNCTION_LIST DFPM_DHLSHK IF_DATA DIM_X 0x38388E EXTERN BYTE IF_DATA MCMESS 0x38388E EXTERN /end MEASUREMENT
/begin MEASUREMENT B_bkhsh2 "Bedingung: Lambdasondenheizung hinter Kat. aktiv, Bank 2" UWORD B_TRUE 1 100 0 1 BIT_MASK 0x40 FUNCTION_LIST DFPM_DHLSHK IF_DATA DIM_X 0x383890 EXTERN BYTE IF_DATA MCMESS 0x383890 EXTERN /end MEASUREMENT
/begin MEASUREMENT B_bkhshe "Bedingung: Lambdasondenheizung hinter Kat. Endstufe" UWORD B_TRUE 1 100 0 1 BIT_MASK 0x40 FUNCTION_LIST DFPM_DEKON IF_DATA DIM_X 0x383892 EXTERN BYTE IF_DATA MCMESS 0x383892 EXTERN /end MEASUREMENT
/begin MEASUREMENT B_bkhshe2 "Bedingung: Lambdasondenheizung hinter Kat. Bank 2 Endstufe" UWORD B_TRUE 1 100 0 1 BIT_MASK 0x40 FUNCTION_LIST DFPM_DEKON IF_DATA DIM_X 0x383894 EXTERN BYTE IF_DATA MCMESS 0x383894 EXTERN /end MEASUREMENT
/begin MEASUREMENT B_bkhsv "Bedingung:Lambdasondenheizung vor Kat. aktiv" UWORD B_TRUE 1 100 0 1 BIT_MASK 0x40 FUNCTION_LIST DFPM_DHLSU IF_DATA DIM_X 0x383896 EXTERN BYTE IF_DATA MCMESS 0x383896 EXTERN /end MEASUREMENT
/begin MEASUREMENT B_bkhsv2 "Bedingung:Lambdasondenheizung vor Kat. aktiv, Bank 2" UWORD B_TRUE 1 100 0 1 BIT_MASK 0x40 FUNCTION_LIST DFPM_DHLSU IF_DATA DIM_X 0x383898 EXTERN BYTE IF_DATA MCMESS 0x383898 EXTERN /end MEASUREMENT
/begin MEASUREMENT B_bkhsvsa "Bedingung:Lambdasondenheizung vor Kat. aktiv" UWORD B_TRUE 1 100 0 1 BIT_MASK 0x40 FUNCTION_LIST DFPM_DHLSU IF_DATA DIM_X 0x38389A EXTERN BYTE IF_DATA MCMESS 0x38389A EXTERN /end MEASUREMENT
/begin MEASUREMENT B_bkhsvsa2 "Bedingung:Lambdasondenheizung vor Kat. aktiv, Bank 2" UWORD B_TRUE 1 100 0 1 BIT_MASK 0x40 FUNCTION_LIST DFPM_DHLSU IF_DATA DIM_X 0x38389C EXTERN BYTE IF_DATA MCMESS 0x38389C EXTERN /end MEASUREMENT
/begin MEASUREMENT B_bkkat "Bedingung Ersatzwert für Katalysator" UWORD B_TRUE 1 100 0 1 BIT_MASK 0x40 FUNCTION_LIST DFPM_DKAT IF_DATA DIM_X 0x38389E EXTERN BYTE IF_DATA MCMESS 0x38389E EXTERN /end MEASUREMENT
/begin MEASUREMENT B_bkkat2 "Bedingung Ersatzwert für Katalysator, Bank2" UWORD B_TRUE 1 100 0 1 BIT_MASK 0x40 FUNCTION_LIST DFPM_DKAT IF_DATA DIM_X 0x3838A0 EXTERN BYTE IF_DATA MCMESS 0x3838A0 EXTERN /end MEASUREMENT
/begin MEASUREMENT B_bkkos "" UWORD B_TRUE 1 100 0 1 BIT_MASK 0x40 FUNCTION_LIST DFPM_DEKON IF_DATA DIM_X 0x3838A2 EXTERN BYTE IF_DATA MCMESS 0x3838A2 EXTERN /end MEASUREMENT
/begin MEASUREMENT B_bkkpe "Bedingung Ersatzwert für EKP-Relais Endstufe" UWORD B_TRUE 1 100 0 1 BIT_MASK 0x40 FUNCTION_LIST DFPM_DEKON IF_DATA DIM_X 0x3838A4 EXTERN BYTE IF_DATA MCMESS 0x3838A4 EXTERN /end MEASUREMENT
/begin MEASUREMENT B_bkkrnt "Bedingung: Klopfregelung Nulltest aktiv" UWORD B_TRUE 1 100 0 1 BIT_MASK 0x40 FUNCTION_LIST DFPM_DKRNT IF_DATA DIM_X 0x3838A6 EXTERN BYTE IF_DATA MCMESS 0x3838A6 EXTERN /end MEASUREMENT
/begin MEASUREMENT B_bkkrof "Bedingung: Klopfregelung Offset aktiv" UWORD B_TRUE 1 100 0 1 BIT_MASK 0x40 FUNCTION_LIST DFPM_DKRNT IF_DATA DIM_X 0x3838A8 EXTERN BYTE IF_DATA MCMESS 0x3838A8 EXTERN /end MEASUREMENT
/begin MEASUREMENT B_bkkrtp "Bedingung: Klopfregelung Testimpuls aktiv" UWORD B_TRUE 1 100 0 1 BIT_MASK 0x40 FUNCTION_LIST DFPM_DKRTP IF_DATA DIM_X 0x3838AA EXTERN BYTE IF_DATA MCMESS 0x3838AA EXTERN /end MEASUREMENT
/begin MEASUREMENT B_bkks1 "Bedingung: Klopfsensor 1 aktiv" UWORD B_TRUE 1 100 0 1 BIT_MASK 0x40 FUNCTION_LIST DFPM_DKRS IF_DATA DIM_X 0x3838AC EXTERN BYTE IF_DATA MCMESS 0x3838AC EXTERN /end MEASUREMENT
/begin MEASUREMENT B_bkks2 "Bedingung: Klopfsensor 2 aktiv" UWORD B_TRUE 1 100 0 1 BIT_MASK 0x40 FUNCTION_LIST DFPM_DKRS IF_DATA DIM_X 0x3838AE EXTERN BYTE IF_DATA MCMESS 0x3838AE EXTERN /end MEASUREMENT
/begin MEASUREMENT B_bkks3 "Bedingung: Klopfsensor 3 aktiv" UWORD B_TRUE 1 100 0 1 BIT_MASK 0x40 FUNCTION_LIST DFPM_DKRS IF_DATA DIM_X 0x3838B0 EXTERN BYTE IF_DATA MCMESS 0x3838B0 EXTERN /end MEASUREMENT
/begin MEASUREMENT B_bkks4 "Bedingung: Klopfsensor 4 aktiv" UWORD B_TRUE 1 100 0 1 BIT_MASK 0x40 FUNCTION_LIST DFPM_DKRS IF_DATA DIM_X 0x3838B2 EXTERN BYTE IF_DATA MCMESS 0x3838B2 EXTERN /end MEASUREMENT
/begin MEASUREMENT B_bkkuppl "Ersatzwert aktiv" UWORD B_TRUE 1 100 0 1 BIT_MASK 0x40 FUNCTION_LIST DFPM_DKUPPL IF_DATA DIM_X 0x3838B4 EXTERN BYTE IF_DATA MCMESS 0x3838B4 EXTERN /end MEASUREMENT
/begin MEASUREMENT B_bkkwave "" UWORD B_TRUE 1 100 0 1 BIT_MASK 0x40 FUNCTION_LIST DFPM_DEKON IF_DATA DIM_X 0x3838B6 EXTERN BYTE IF_DATA MCMESS 0x3838B6 EXTERN /end MEASUREMENT
/begin MEASUREMENT B_bklash "Bedingung: Lambdasondenalterung hinter Kat." UWORD B_TRUE 1 100 0 1 BIT_MASK 0x40 FUNCTION_LIST DFPM_DLSAHK IF_DATA DIM_X 0x3838B8 EXTERN BYTE IF_DATA MCMESS 0x3838B8 EXTERN /end MEASUREMENT
/begin MEASUREMENT B_bklash2 "Bedingung: Lambdasondenalterung hinter Kat. Bank2" UWORD B_TRUE 1 100 0 1 BIT_MASK 0x40 FUNCTION_LIST DFPM_DLSAHK IF_DATA DIM_X 0x3838BA EXTERN BYTE IF_DATA MCMESS 0x3838BA EXTERN /end MEASUREMENT
/begin MEASUREMENT B_bklde "Bedingung: Ladedrucksteuerventil Endstufe aktiv" UWORD B_TRUE 1 100 0 1 BIT_MASK 0x40 FUNCTION_LIST DFPM_DEKON IF_DATA DIM_X 0x3838BC EXTERN BYTE IF_DATA MCMESS 0x3838BC EXTERN /end MEASUREMENT
/begin MEASUREMENT B_bkldo "Bedingung Ersatzwert aktiv: LDO" UWORD B_TRUE 1 100 0 1 BIT_MASK 0x40 FUNCTION_LIST DFPM_DLDR IF_DATA DIM_X 0x3838BE EXTERN BYTE IF_DATA MCMESS 0x3838BE EXTERN /end MEASUREMENT
/begin MEASUREMENT B_bkldra "Bedingung Ersatzwert aktiv: LDRA" UWORD B_TRUE 1 100 0 1 BIT_MASK 0x40 FUNCTION_LIST DFPM_DLDR IF_DATA DIM_X 0x3838C0 EXTERN BYTE IF_DATA MCMESS 0x3838C0 EXTERN /end MEASUREMENT
/begin MEASUREMENT B_bklf1e "" UWORD B_TRUE 1 100 0 1 BIT_MASK 0x40 FUNCTION_LIST DFPM_DEKON IF_DATA DIM_X 0x3838C2 EXTERN BYTE IF_DATA MCMESS 0x3838C2 EXTERN /end MEASUREMENT
/begin MEASUREMENT B_bklf2e "" UWORD B_TRUE 1 100 0 1 BIT_MASK 0x40 FUNCTION_LIST DFPM_DEKON IF_DATA DIM_X 0x3838C4 EXTERN BYTE IF_DATA MCMESS 0x3838C4 EXTERN /end MEASUREMENT
/begin MEASUREMENT B_bklf3e "" UWORD B_TRUE 1 100 0 1 BIT_MASK 0x40 FUNCTION_LIST DFPM_DEKON IF_DATA DIM_X 0x3838C6 EXTERN BYTE IF_DATA MCMESS 0x3838C6 EXTERN /end MEASUREMENT
/begin MEASUREMENT B_bkllr "Bedingung: Leerlaufregelung aktiv" UWORD B_TRUE 1 100 0 1 BIT_MASK 0x40 FUNCTION_LIST DFPM_DLLR IF_DATA DIM_X 0x3838C8 EXTERN BYTE IF_DATA MCMESS 0x3838C8 EXTERN /end MEASUREMENT
/begin MEASUREMENT B_bklm "Bedingung: Hauptlastsensor aktiv" UWORD B_TRUE 1 100 0 1 BIT_MASK 0x40 FUNCTION_LIST DFPM_DHFM IF_DATA DIM_X 0x3838CA EXTERN BYTE IF_DATA MCMESS 0x3838CA EXTERN /end MEASUREMENT
/begin MEASUREMENT B_bklsh "Bedingung: Lambdasonde hinter Kat. aktiv" UWORD B_TRUE 1 100 0 1 BIT_MASK 0x40 FUNCTION_LIST DFPM_DLSH IF_DATA DIM_X 0x3838CC EXTERN BYTE IF_DATA MCMESS 0x3838CC EXTERN /end MEASUREMENT
/begin MEASUREMENT B_bklsh2 "Bedingung: Lambdasonde hinter Kat. aktiv Bank2" UWORD B_TRUE 1 100 0 1 BIT_MASK 0x40 FUNCTION_LIST DFPM_DLSH IF_DATA DIM_X 0x3838CE EXTERN BYTE IF_DATA MCMESS 0x3838CE EXTERN /end MEASUREMENT
/begin MEASUREMENT B_bklsv "Bedingung: Lambdasonde vor Kat. aktiv" UWORD B_TRUE 1 100 0 1 BIT_MASK 0x40 FUNCTION_LIST DFPM_DLSU IF_DATA DIM_X 0x3838D0 EXTERN BYTE IF_DATA MCMESS 0x3838D0 EXTERN /end MEASUREMENT
/begin MEASUREMENT B_bklsv2 "Bedingung: Lambdasonde vor Kat. aktiv Bank2" UWORD B_TRUE 1 100 0 1 BIT_MASK 0x40 FUNCTION_LIST DFPM_DLSU IF_DATA DIM_X 0x3838D2 EXTERN BYTE IF_DATA MCMESS 0x3838D2 EXTERN /end MEASUREMENT
/begin MEASUREMENT B_bklsvv "Bedingung: vertauschte Lambdasonde vor Kat. aktiv" UWORD B_TRUE 1 100 0 1 BIT_MASK 0x40 FUNCTION_LIST DFPM_LSVV IF_DATA DIM_X 0x3838D4 EXTERN BYTE IF_DATA MCMESS 0x3838D4 EXTERN /end MEASUREMENT
/begin MEASUREMENT B_bkmd "Flag für Ersatzwert: Aussetzer, Summenfehler (multiple)" UWORD B_TRUE 1 100 0 1 BIT_MASK 0x40 FUNCTION_LIST DFPM_DMDMIL IF_DATA DIM_X 0x3838D6 EXTERN BYTE IF_DATA MCMESS 0x3838D6 EXTERN /end MEASUREMENT
/begin MEASUREMENT B_bkmd00 "Flag für Ersatzwert: Aussetzer Zündung 0" UWORD B_TRUE 1 100 0 1 BIT_MASK 0x40 FUNCTION_LIST DFPM_DMDMIL IF_DATA DIM_X 0x3838D8 EXTERN BYTE IF_DATA MCMESS 0x3838D8 EXTERN /end MEASUREMENT
/begin MEASUREMENT B_bkmd01 "Flag für Ersatzwert: Aussetzer Zündung 1" UWORD B_TRUE 1 100 0 1 BIT_MASK 0x40 FUNCTION_LIST DFPM_DMDMIL IF_DATA DIM_X 0x3838DA EXTERN BYTE IF_DATA MCMESS 0x3838DA EXTERN /end MEASUREMENT
/begin MEASUREMENT B_bkmd02 "Flag für Ersatzwert: Aussetzer Zündung 2" UWORD B_TRUE 1 100 0 1 BIT_MASK 0x40 FUNCTION_LIST DFPM_DMDMIL IF_DATA DIM_X 0x3838DC EXTERN BYTE IF_DATA MCMESS 0x3838DC EXTERN /end MEASUREMENT
/begin MEASUREMENT B_bkmd03 "Flag für Ersatzwert: Aussetzer Zündung 3" UWORD B_TRUE 1 100 0 1 BIT_MASK 0x40 FUNCTION_LIST DFPM_DMDMIL IF_DATA DIM_X 0x3838DE EXTERN BYTE IF_DATA MCMESS 0x3838DE EXTERN /end MEASUREMENT
/begin MEASUREMENT B_bkmd04 "Flag für Ersatzwert: Aussetzer Zündung 4" UWORD B_TRUE 1 100 0 1 BIT_MASK 0x40 FUNCTION_LIST DFPM_DMDMIL IF_DATA DIM_X 0x3838E0 EXTERN BYTE IF_DATA MCMESS 0x3838E0 EXTERN /end MEASUREMENT
/begin MEASUREMENT B_bkmd05 "Flag für Ersatzwert: Aussetzer Zündung 5" UWORD B_TRUE 1 100 0 1 BIT_MASK 0x40 FUNCTION_LIST DFPM_DMDMIL IF_DATA DIM_X 0x3838E2 EXTERN BYTE IF_DATA MCMESS 0x3838E2 EXTERN /end MEASUREMENT
/begin MEASUREMENT B_bkmdb "Bedingung: Momentanüberwachung (bergrenzt dauerhaft) aktiv" UWORD B_TRUE 1 100 0 1 BIT_MASK 0x40 FUNCTION_LIST DFPM_MDKOG IF_DATA DIM_X 0x3838E4 EXTERN BYTE IF_DATA MCMESS 0x3838E4 EXTERN /end MEASUREMENT
/begin MEASUREMENT B_bkmsg "" UWORD B_TRUE 1 100 0 1 BIT_MASK 0x40 FUNCTION_LIST DFPM_MLS IF_DATA DIM_X 0x3838E6 EXTERN BYTE IF_DATA MCMESS 0x3838E6 EXTERN /end MEASUREMENT
/begin MEASUREMENT B_bkmsge "" UWORD B_TRUE 1 100 0 1 BIT_MASK 0x40 FUNCTION_LIST DFPM_DEKON IF_DATA DIM_X 0x3838E8 EXTERN BYTE IF_DATA MCMESS 0x3838E8 EXTERN /end MEASUREMENT
/begin MEASUREMENT B_bkn "Bedingung: Drehzahlsignalgeber aktiv" UWORD B_TRUE 1 100 0 1 BIT_MASK 0x40 FUNCTION_LIST DFPM_DDG IF_DATA DIM_X 0x3838EA EXTERN BYTE IF_DATA MCMESS 0x3838EA EXTERN /end MEASUREMENT
/begin MEASUREMENT B_bknwkw "Bedingung: Zuordnung Nockenwelle zu Kurbelwelle aktiv" UWORD B_TRUE 1 100 0 1 BIT_MASK 0x40 FUNCTION_LIST DFPM_DNWKW IF_DATA DIM_X 0x3838EC EXTERN BYTE IF_DATA MCMESS 0x3838EC EXTERN /end MEASUREMENT
/begin MEASUREMENT B_bknwkw2 "Bedingung: Zuordnung Nockenwelle 2 zu Kurbelwelle aktiv" UWORD B_TRUE 1 100 0 1 BIT_MASK 0x40 FUNCTION_LIST DFPM_DNWKW IF_DATA DIM_X 0x3838EE EXTERN BYTE IF_DATA MCMESS 0x3838EE EXTERN /end MEASUREMENT
/begin MEASUREMENT B_bknws "Bedingung: Nockenwellensteuerung aktiv" UWORD B_TRUE 1 100 0 1 BIT_MASK 0x40 FUNCTION_LIST DFPM_DNWS IF_DATA DIM_X 0x3838F0 EXTERN BYTE IF_DATA MCMESS 0x3838F0 EXTERN /end MEASUREMENT
/begin MEASUREMENT B_bknws2 "Bedingung: Nockenwellensteuerung Bank 2 aktiv" UWORD B_TRUE 1 100 0 1 BIT_MASK 0x40 FUNCTION_LIST DFPM_DNWS IF_DATA DIM_X 0x3838F2 EXTERN BYTE IF_DATA MCMESS 0x3838F2 EXTERN /end MEASUREMENT
/begin MEASUREMENT B_bknwse "Bedingung: Nockenwellensteuerung Endstufe aktiv" UWORD B_TRUE 1 100 0 1 BIT_MASK 0x40 FUNCTION_LIST DFPM_DEKON IF_DATA DIM_X 0x3838F4 EXTERN BYTE IF_DATA MCMESS 0x3838F4 EXTERN /end MEASUREMENT
/begin MEASUREMENT B_bknwse2 "" UWORD B_TRUE 1 100 0 1 BIT_MASK 0x40 FUNCTION_LIST DFPM_DEKON IF_DATA DIM_X 0x3838F6 EXTERN BYTE IF_DATA MCMESS 0x3838F6 EXTERN /end MEASUREMENT
/begin MEASUREMENT B_bkph "Bedingung: Phasengeber aktiv" UWORD B_TRUE 1 100 0 1 BIT_MASK 0x40 FUNCTION_LIST DFPM_DPH IF_DATA DIM_X 0x3838F8 EXTERN BYTE IF_DATA MCMESS 0x3838F8 EXTERN /end MEASUREMENT
/begin MEASUREMENT B_bkph2 "Bedingung: Phasengeber Bank 2 aktiv" UWORD B_TRUE 1 100 0 1 BIT_MASK 0x40 FUNCTION_LIST DFPM_DPH IF_DATA DIM_X 0x3838FA EXTERN BYTE IF_DATA MCMESS 0x3838FA EXTERN /end MEASUREMENT
/begin MEASUREMENT B_bkrkat "Ersatzwert für RKAT aktiv" UWORD B_TRUE 1 100 0 1 BIT_MASK 0x40 FUNCTION_LIST DFPM_DKVS IF_DATA DIM_X 0x3838FC EXTERN BYTE IF_DATA MCMESS 0x3838FC EXTERN /end MEASUREMENT
/begin MEASUREMENT B_bkrkat2 "Ersatzwert für RKAT aktiv Bank 2" UWORD B_TRUE 1 100 0 1 BIT_MASK 0x40 FUNCTION_LIST DFPM_DKVS IF_DATA DIM_X 0x3838FE EXTERN BYTE IF_DATA MCMESS 0x3838FE EXTERN /end MEASUREMENT
/begin MEASUREMENT B_bkrkaz "Ersatzwert für RKAZ aktiv" UWORD B_TRUE 1 100 0 1 BIT_MASK 0x40 FUNCTION_LIST DFPM_DKVS IF_DATA DIM_X 0x383900 EXTERN BYTE IF_DATA MCMESS 0x383900 EXTERN /end MEASUREMENT
/begin MEASUREMENT B_bkrkaz2 "Ersatzwert für RKAZ aktiv Bank 2" UWORD B_TRUE 1 100 0 1 BIT_MASK 0x40 FUNCTION_LIST DFPM_DKVS IF_DATA DIM_X 0x383902 EXTERN BYTE IF_DATA MCMESS 0x383902 EXTERN /end MEASUREMENT
/begin MEASUREMENT B_bksgeep "" UWORD B_TRUE 1 100 0 1 BIT_MASK 0x40 FUNCTION_LIST DFPM_DSGEEP IF_DATA DIM_X 0x383904 EXTERN BYTE IF_DATA MCMESS 0x383904 EXTERN /end MEASUREMENT
/begin MEASUREMENT B_bkslpe "Bedingung: Sekundärluftpumpe ( Endstufe) aktiv" UWORD B_TRUE 1 100 0 1 BIT_MASK 0x40 FUNCTION_LIST DFPM_DEKON IF_DATA DIM_X 0x383906 EXTERN BYTE IF_DATA MCMESS 0x383906 EXTERN /end MEASUREMENT
/begin MEASUREMENT B_bksls "Bedingung: Sekundärluftsystem aktiv" UWORD B_TRUE 1 100 0 1 BIT_MASK 0x40 FUNCTION_LIST DFPM_DSLSLRS IF_DATA DIM_X 0x383908 EXTERN BYTE IF_DATA MCMESS 0x383908 EXTERN /end MEASUREMENT
/begin MEASUREMENT B_bksls2 "Bedingung: Sekundärluftsystem Bank 2 aktiv" UWORD B_TRUE 1 100 0 1 BIT_MASK 0x40 FUNCTION_LIST DFPM_DSLSLRS IF_DATA DIM_X 0x38390A EXTERN BYTE IF_DATA MCMESS 0x38390A EXTERN /end MEASUREMENT
/begin MEASUREMENT B_bkslv "Bedingung: Sekundärluftventil aktiv" UWORD B_TRUE 1 100 0 1 BIT_MASK 0x40 FUNCTION_LIST DFPM_DSLSLRS IF_DATA DIM_X 0x38390C EXTERN BYTE IF_DATA MCMESS 0x38390C EXTERN /end MEASUREMENT
/begin MEASUREMENT B_bkslv2 "Bedingung: Sekundärluftventil Bank 2 aktiv" UWORD B_TRUE 1 100 0 1 BIT_MASK 0x40 FUNCTION_LIST DFPM_DSLSLRS IF_DATA DIM_X 0x38390E EXTERN BYTE IF_DATA MCMESS 0x38390E EXTERN /end MEASUREMENT
/begin MEASUREMENT B_bkslve "Bedingung: Sekundärluftventil Endstufe" UWORD B_TRUE 1 100 0 1 BIT_MASK 0x40 FUNCTION_LIST DFPM_DEKON IF_DATA DIM_X 0x383910 EXTERN BYTE IF_DATA MCMESS 0x383910 EXTERN /end MEASUREMENT
/begin MEASUREMENT B_bkswe "" UWORD B_TRUE 1 100 0 1 BIT_MASK 0x40 FUNCTION_LIST DFPM_BGRBS IF_DATA DIM_X 0x383912 EXTERN BYTE IF_DATA MCMESS 0x383912 EXTERN /end MEASUREMENT
/begin MEASUREMENT B_bkta "Bedingung Ersatzwert für Ansauglufttemperatur (/Ladelufttemp.)" UWORD B_TRUE 1 100 0 1 BIT_MASK 0x40 FUNCTION_LIST DFPM_GGTFA IF_DATA DIM_X 0x383914 EXTERN BYTE IF_DATA MCMESS 0x383914 EXTERN /end MEASUREMENT
/begin MEASUREMENT B_bktes "Bedingung Ersatzwert aktiv Tankdiagnose Tankentlüftungsventil offen" UWORD B_TRUE 1 100 0 1 BIT_MASK 0x40 FUNCTION_LIST DFPM_DTEV IF_DATA DIM_X 0x383916 EXTERN BYTE IF_DATA MCMESS 0x383916 EXTERN /end MEASUREMENT
/begin MEASUREMENT B_bkteve "Bedingung: Tankentlüftungsventil Endstufe aktiv" UWORD B_TRUE 1 100 0 1 BIT_MASK 0x40 FUNCTION_LIST DFPM_DEKON IF_DATA DIM_X 0x383918 EXTERN BYTE IF_DATA MCMESS 0x383918 EXTERN /end MEASUREMENT
/begin MEASUREMENT B_bktget "Bedingung Ersatzwert für Getriebetemperatur" UWORD B_TRUE 1 100 0 1 BIT_MASK 0x40 FUNCTION_LIST DFPM_GGTGET IF_DATA DIM_X 0x38391C EXTERN BYTE IF_DATA MCMESS 0x38391C EXTERN /end MEASUREMENT
/begin MEASUREMENT B_bkthm "Bedingung Ersatzwert für Thermostatfehler" UWORD B_TRUE 1 100 0 1 BIT_MASK 0x40 FUNCTION_LIST DFPM_GGTFM IF_DATA DIM_X 0x38391E EXTERN BYTE IF_DATA MCMESS 0x38391E EXTERN /end MEASUREMENT
/begin MEASUREMENT B_bktm "Bedingung Ersatzwert für Motortemperatur" UWORD B_TRUE 1 100 0 1 BIT_MASK 0x40 FUNCTION_LIST DFPM_GGTFM IF_DATA DIM_X 0x383920 EXTERN BYTE IF_DATA MCMESS 0x383920 EXTERN /end MEASUREMENT
/begin MEASUREMENT B_bktmki "Bedingung Ersatzwert für Motortemperatur aus Kombiinstrument" UWORD B_TRUE 1 100 0 1 BIT_MASK 0x40 FUNCTION_LIST DFPM_DUMMY043 IF_DATA DIM_X 0x383922 EXTERN BYTE IF_DATA MCMESS 0x383922 EXTERN /end MEASUREMENT
/begin MEASUREMENT B_bktmr "" UWORD B_TRUE 1 100 0 1 BIT_MASK 0x40 FUNCTION_LIST DFPM_GGTFMR IF_DATA DIM_X 0x383924 EXTERN BYTE IF_DATA MCMESS 0x383924 EXTERN /end MEASUREMENT
/begin MEASUREMENT B_bktol "Bedingung Ersatzwert für (Motor-)Oel-Temperatur" UWORD B_TRUE 1 100 0 1 BIT_MASK 0x40 FUNCTION_LIST DFPM_GGTFOL IF_DATA DIM_X 0x383926 EXTERN BYTE IF_DATA MCMESS 0x383926 EXTERN /end MEASUREMENT
/begin MEASUREMENT B_bktum "Bedingung Ersatzwert für Umgebumgstemperatur" UWORD B_TRUE 1 100 0 1 BIT_MASK 0x40 FUNCTION_LIST DFPM_GGTFUMG IF_DATA DIM_X 0x383928 EXTERN BYTE IF_DATA MCMESS 0x383928 EXTERN /end MEASUREMENT
/begin MEASUREMENT B_bkub "Bedingung Ersatzwert für Batteriespannung (Bordnetz)" UWORD B_TRUE 1 100 0 1 BIT_MASK 0x40 FUNCTION_LIST DFPM_GGUB IF_DATA DIM_X 0x38392A EXTERN BYTE IF_DATA MCMESS 0x38392A EXTERN /end MEASUREMENT
/begin MEASUREMENT B_bkufmv "Bedingung: Funktiosüberwachung Momentanvergleich aktiv" UWORD B_TRUE 1 100 0 1 BIT_MASK 0x40 FUNCTION_LIST DFPM_DUF IF_DATA DIM_X 0x38392C EXTERN BYTE IF_DATA MCMESS 0x38392C EXTERN /end MEASUREMENT
/begin MEASUREMENT B_bkufska "Bedingung: Funktionsüberwachung: Sicherheits-Kraftstoff-Abschaltung aktiv" UWORD B_TRUE 1 100 0 1 BIT_MASK 0x40 FUNCTION_LIST DFPM_DUF IF_DATA DIM_X 0x38392E EXTERN BYTE IF_DATA MCMESS 0x38392E EXTERN /end MEASUREMENT
/begin MEASUREMENT B_bkurram "Bedingung: Rechnerüberwachung: RAM" UWORD B_TRUE 1 100 0 1 BIT_MASK 0x40 FUNCTION_LIST DFPM_DUR IF_DATA DIM_X 0x383930 EXTERN BYTE IF_DATA MCMESS 0x383930 EXTERN /end MEASUREMENT
/begin MEASUREMENT B_bkurrom "Bedingung: Rechnerüberwachung: ROM" UWORD B_TRUE 1 100 0 1 BIT_MASK 0x40 FUNCTION_LIST DFPM_DUR IF_DATA DIM_X 0x383932 EXTERN BYTE IF_DATA MCMESS 0x383932 EXTERN /end MEASUREMENT
/begin MEASUREMENT B_bkurrst "Bedingung: Rechnerüberwachung: RESET" UWORD B_TRUE 1 100 0 1 BIT_MASK 0x40 FUNCTION_LIST DFPM_DUR IF_DATA DIM_X 0x383934 EXTERN BYTE IF_DATA MCMESS 0x383934 EXTERN /end MEASUREMENT
/begin MEASUREMENT B_bkuvse "Bedingung: Endstufe Umluftventil Turbo aktiv" UWORD B_TRUE 1 100 0 1 BIT_MASK 0x40 FUNCTION_LIST DFPM_DEKON IF_DATA DIM_X 0x383936 EXTERN BYTE IF_DATA MCMESS 0x383936 EXTERN /end MEASUREMENT
/begin MEASUREMENT B_bkva "Bedingung BKV angesteuert" UWORD B_TRUE 1 100 0 1 BIT_MASK 0x20 FUNCTION_LIST SWADP GGPED IF_DATA DIM_X 0xFD82 INTERN BYTE IF_DATA MCMESS 0xFD82 INTERN /end MEASUREMENT
/begin MEASUREMENT B_bkvfz "Bedingung Ersatzwert aktiv: Fahrzeuggeschwindigkeitssignal" UWORD B_TRUE 1 100 0 1 BIT_MASK 0x40 FUNCTION_LIST DFPM_DVFZ IF_DATA DIM_X 0x383938 EXTERN BYTE IF_DATA MCMESS 0x383938 EXTERN /end MEASUREMENT
/begin MEASUREMENT B_bkvleer "Bedingung Bremskraftverstärker ohne ausreichenden Unterdruck" UWORD B_TRUE 1 100 0 1 BIT_MASK 0x40 FUNCTION_LIST SWADP DSLSLRS KHMD IF_DATA DIM_X 0xFD82 INTERN BYTE IF_DATA MCMESS 0xFD82 INTERN /end MEASUREMENT
/begin MEASUREMENT B_bkvs01 "" UWORD B_TRUE 1 100 0 1 BIT_MASK 0x40 FUNCTION_LIST DFPM_DVS IF_DATA DIM_X 0x38393A EXTERN BYTE IF_DATA MCMESS 0x38393A EXTERN /end MEASUREMENT
/begin MEASUREMENT B_bkvs02 "" UWORD B_TRUE 1 100 0 1 BIT_MASK 0x40 FUNCTION_LIST DFPM_DVS IF_DATA DIM_X 0x38393C EXTERN BYTE IF_DATA MCMESS 0x38393C EXTERN /end MEASUREMENT
/begin MEASUREMENT B_bkvs03 "" UWORD B_TRUE 1 100 0 1 BIT_MASK 0x40 FUNCTION_LIST DFPM_DVS IF_DATA DIM_X 0x38393E EXTERN BYTE IF_DATA MCMESS 0x38393E EXTERN /end MEASUREMENT
/begin MEASUREMENT B_bkvs04 "" UWORD B_TRUE 1 100 0 1 BIT_MASK 0x40 FUNCTION_LIST DFPM_DVS IF_DATA DIM_X 0x383940 EXTERN BYTE IF_DATA MCMESS 0x383940 EXTERN /end MEASUREMENT
/begin MEASUREMENT B_bkvs05 "" UWORD B_TRUE 1 100 0 1 BIT_MASK 0x40 FUNCTION_LIST DFPM_DVS IF_DATA DIM_X 0x383942 EXTERN BYTE IF_DATA MCMESS 0x383942 EXTERN /end MEASUREMENT
/begin MEASUREMENT B_bkvs06 "" UWORD B_TRUE 1 100 0 1 BIT_MASK 0x40 FUNCTION_LIST DFPM_DVS IF_DATA DIM_X 0x383944 EXTERN BYTE IF_DATA MCMESS 0x383944 EXTERN /end MEASUREMENT
/begin MEASUREMENT B_bkvs1e "" UWORD B_TRUE 1 100 0 1 BIT_MASK 0x40 FUNCTION_LIST DFPM_DEKON IF_DATA DIM_X 0x383946 EXTERN BYTE IF_DATA MCMESS 0x383946 EXTERN /end MEASUREMENT
/begin MEASUREMENT B_bkvs2e "" UWORD B_TRUE 1 100 0 1 BIT_MASK 0x40 FUNCTION_LIST DFPM_DEKON IF_DATA DIM_X 0x383948 EXTERN BYTE IF_DATA MCMESS 0x383948 EXTERN /end MEASUREMENT
/begin MEASUREMENT B_bkvsb1 "" UWORD B_TRUE 1 100 0 1 BIT_MASK 0x40 FUNCTION_LIST DFPM_DVS IF_DATA DIM_X 0x38394A EXTERN BYTE IF_DATA MCMESS 0x38394A EXTERN /end MEASUREMENT
/begin MEASUREMENT B_bkvsb2 "" UWORD B_TRUE 1 100 0 1 BIT_MASK 0x40 FUNCTION_LIST DFPM_DVS IF_DATA DIM_X 0x38394C EXTERN BYTE IF_DATA MCMESS 0x38394C EXTERN /end MEASUREMENT
/begin MEASUREMENT B_bkvss "" UWORD B_TRUE 1 100 0 1 BIT_MASK 0x40 FUNCTION_LIST DFPM_DVS IF_DATA DIM_X 0x38394E EXTERN BYTE IF_DATA MCMESS 0x38394E EXTERN /end MEASUREMENT
/begin MEASUREMENT B_bkvv "Bedingung BKV verbaut (für Auswertung Bremse)" UWORD B_TRUE 1 100 0 1 BIT_MASK 0x80 FUNCTION_LIST SWADP GGPED IF_DATA DIM_X 0xFD82 INTERN BYTE IF_DATA MCMESS 0xFD82 INTERN /end MEASUREMENT
/begin MEASUREMENT B_bkwfs "Bedingung: Wegfahrsperre" UWORD B_TRUE 1 100 0 1 BIT_MASK 0x40 FUNCTION_LIST DFPM_WFS IF_DATA DIM_X 0x383950 EXTERN BYTE IF_DATA MCMESS 0x383950 EXTERN /end MEASUREMENT
/begin MEASUREMENT B_bl "Bedingung Bremslichtschalter betätigt" UWORD B_TRUE 1 100 0 1 BIT_MASK 0x800 FUNCTION_LIST GGEGAS T2LID IF_DATA DIM_X 0xFD3A INTERN BYTE IF_DATA MCMESS 0xFD3A INTERN /end MEASUREMENT
/begin MEASUREMENT B_bldrff "" UWORD B_TRUE 1 100 0 1 BIT_MASK 0x1 FUNCTION_LIST BBLDR IF_DATA DIM_X 0xFD66 INTERN BYTE IF_DATA MCMESS 0xFD66 INTERN /end MEASUREMENT
/begin MEASUREMENT B_bldsff "" UWORD B_TRUE 1 100 0 1 BIT_MASK 0x2 FUNCTION_LIST BBLDR IF_DATA DIM_X 0xFD66 INTERN BYTE IF_DATA MCMESS 0xFD66 INTERN /end MEASUREMENT
/begin MEASUREMENT B_blduff "" UWORD B_TRUE 1 100 0 1 BIT_MASK 0x4 FUNCTION_LIST BBLDR IF_DATA DIM_X 0xFD66 INTERN BYTE IF_DATA MCMESS 0xFD66 INTERN /end MEASUREMENT
/begin MEASUREMENT B_blkau "MIL-Ansteuerung blinkend, durch aktive Störgrößenaufschaltung für AU" UWORD B_TRUE 1 100 0 1 BIT_MASK 0x800 FUNCTION_LIST SGAAU DMIL IF_DATA DIM_X 0xFD02 INTERN BYTE IF_DATA MCMESS 0xFD02 INTERN /end MEASUREMENT
/begin MEASUREMENT B_blkeb "MIL-Ansteuerung blinkend eigenbestimmt" UBYTE B_TRUE 1 100 0 1 BIT_MASK 0x4 FUNCTION_LIST DMIL IF_DATA DIM_X 0x380A11 EXTERN BYTE IF_DATA MCMESS 0x380A11 EXTERN /end MEASUREMENT
/begin MEASUREMENT B_blkfb "MIL-Ansteuerung blinkend fremdbestimmt durch externes SG" UWORD B_TRUE 1 100 0 1 BIT_MASK 0x100 FUNCTION_LIST SWADP IF_DATA DIM_X 0xFD82 INTERN BYTE IF_DATA MCMESS 0xFD82 INTERN /end MEASUREMENT
/begin MEASUREMENT B_blkmd "MIL-Ansteuerung blinkend durch Aussetzererkennung" UWORD B_TRUE 1 100 0 1 BIT_MASK 0x1000 FUNCTION_LIST DMDMIL DMIL IF_DATA DIM_X 0xFD0E INTERN BYTE IF_DATA MCMESS 0xFD0E INTERN /end MEASUREMENT
/begin MEASUREMENT B_blrka "Bedingung gesteuertes Katalysator-Ausräumen angefordert" UWORD B_TRUE 1 100 0 1 BIT_MASK 0x4 FUNCTION_LIST LRSKA IF_DATA DIM_X 0xFD7A INTERN BYTE IF_DATA MCMESS 0xFD7A INTERN /end MEASUREMENT
/begin MEASUREMENT B_blrka2 "Bedingung gesteuertes Katalysator-Ausräumen angefordert, Bank 2" UWORD B_TRUE 1 100 0 1 BIT_MASK 0x8 FUNCTION_LIST LRSKA IF_DATA DIM_X 0xFD7A INTERN BYTE IF_DATA MCMESS 0xFD7A INTERN /end MEASUREMENT
/begin MEASUREMENT B_bm "Bedingung Bezugsmarke erkannt" UWORD B_TRUE 1 100 0 1 BIT_MASK 0x80 FUNCTION_LIST GGDPG BGNMOT DDG NLPH WANWKW IF_DATA DIM_X 0xFD12 INTERN BYTE IF_DATA MCMESS 0xFD12 INTERN /end MEASUREMENT
/begin MEASUREMENT B_bmvst1 "Bedingung grosser Ventilhub im Toel-Bereich 1" UWORD B_TRUE 1 100 0 1 BIT_MASK 0x2 FUNCTION_LIST VS IF_DATA DIM_X 0x382CBC EXTERN BYTE IF_DATA MCMESS 0x382CBC EXTERN /end MEASUREMENT
/begin MEASUREMENT B_bmvst2 "Bedingung grosser Ventilhub im Toel-Bereich 2" UWORD B_TRUE 1 100 0 1 BIT_MASK 0x4 FUNCTION_LIST VS IF_DATA DIM_X 0x382CBC EXTERN BYTE IF_DATA MCMESS 0x382CBC EXTERN /end MEASUREMENT
/begin MEASUREMENT B_bmvst3 "Bedingung grosser Ventilhub im Toel-Bereich 3" UWORD B_TRUE 1 100 0 1 BIT_MASK 0x8 FUNCTION_LIST VS IF_DATA DIM_X 0x382CBC EXTERN BYTE IF_DATA MCMESS 0x382CBC EXTERN /end MEASUREMENT
/begin MEASUREMENT B_br "Bedingung Bremstestschalter betätigt" UWORD B_TRUE 1 100 0 1 BIT_MASK 0x1000 FUNCTION_LIST GGEGAS T2LID IF_DATA DIM_X 0xFD3A INTERN BYTE IF_DATA MCMESS 0xFD3A INTERN /end MEASUREMENT
/begin MEASUREMENT B_br2k "Bedingung Bremse betätigt 2-kanalig erkannt" UWORD B_TRUE 1 100 0 1 BIT_MASK 0x2000 FUNCTION_LIST GGEGAS DMDSTP GGPED IF_DATA DIM_X 0xFD3A INTERN BYTE IF_DATA MCMESS 0xFD3A INTERN /end MEASUREMENT
/begin MEASUREMENT B_brems "Bedingung Bremse betätigt" UWORD B_TRUE 1 100 0 1 BIT_MASK 0x4000 FUNCTION_LIST GGEGAS ARMD BBFGR CAN DKUPPL GGPED LRAEB SLS T2DFA T2LID IF_DATA DIM_X 0xFD3A INTERN BYTE IF_DATA MCMESS 0xFD3A INTERN /end MEASUREMENT
/begin MEASUREMENT B_brems_um "Bedingung Bremse getreten für die Funktionsüberwachung" UBYTE B_TRUE 1 100 0 1 BIT_MASK 0x1 FUNCTION_LIST UFURAM IF_DATA DIM_X 0x382E43 EXTERN WORD IF_DATA MCMESS 0x382E43 EXTERN /end MEASUREMENT
/begin MEASUREMENT B_brlmx "Bedingung LDR Begrenzung der Maximalfuellung" UWORD B_TRUE 1 100 0 1 BIT_MASK 0x1000 FUNCTION_LIST LDRLMX IF_DATA DIM_X 0xFD66 INTERN BYTE IF_DATA MCMESS 0xFD66 INTERN /end MEASUREMENT
/begin MEASUREMENT B_bsl_um "erkannter Low-Pegel am FGR-Bedienhebelschalter Beschleunigen in Funktionsüberw." UBYTE B_TRUE 1 100 0 1 BIT_MASK 0x10 FUNCTION_LIST UFURAM IF_DATA DIM_X 0x382E43 EXTERN WORD IF_DATA MCMESS 0x382E43 EXTERN /end MEASUREMENT
/begin MEASUREMENT B_bwf "Bedingung: Bewegungserkennung hat Fehler erkannt" UWORD B_TRUE 1 100 0 1 BIT_MASK 0x1 FUNCTION_LIST GGPED IF_DATA DIM_X 0x381EBC EXTERN BYTE IF_DATA MCMESS 0x381EBC EXTERN /end MEASUREMENT
/begin MEASUREMENT B_bwunpl "Bedingung Unplausibilität bei Bewegungserkennung" UWORD B_TRUE 1 100 0 1 BIT_MASK 0x2 FUNCTION_LIST GGPED IF_DATA DIM_X 0x381EBC EXTERN BYTE IF_DATA MCMESS 0x381EBC EXTERN /end MEASUREMENT
/begin MEASUREMENT B_bzsync "" UWORD B_TRUE 1 100 0 1 BIT_MASK 0x800 FUNCTION_LIST SYNC71 IF_DATA DIM_X 0xFD86 INTERN BYTE IF_DATA MCMESS 0xFD86 INTERN /end MEASUREMENT
/begin MEASUREMENT B_c95bf0 "Ansteuersignal zum Einstellen der Filtermittenfrequenz des CC195 (Pin BF0)" UWORD B_TRUE 1 100 0 1 BIT_MASK 0x200 FUNCTION_LIST GGKS IF_DATA DIM_X 0xFD60 INTERN BYTE IF_DATA MCMESS 0xFD60 INTERN /end MEASUREMENT
/begin MEASUREMENT B_c95bf1 "Ansteuersignal zum Einstellen der Filtermittenfrequenz des CC195 (Pin BF1)" UWORD B_TRUE 1 100 0 1 BIT_MASK 0x400 FUNCTION_LIST GGKS IF_DATA DIM_X 0xFD60 INTERN BYTE IF_DATA MCMESS 0xFD60 INTERN /end MEASUREMENT
/begin MEASUREMENT B_c95bf2 "Ansteuersignal zum Einstellen der Filtermittenfrequenz des CC195 (Pin BF2)" UWORD B_TRUE 1 100 0 1 BIT_MASK 0x800 FUNCTION_LIST GGKS IF_DATA DIM_X 0xFD60 INTERN BYTE IF_DATA MCMESS 0xFD60 INTERN /end MEASUREMENT
/begin MEASUREMENT B_c95bf3 "Ansteuersignal zum Eintstellen der Filtermittenfrequenz des CC195 (Pin BF3)" UWORD B_TRUE 1 100 0 1 BIT_MASK 0x1000 FUNCTION_LIST GGKS IF_DATA DIM_X 0xFD60 INTERN BYTE IF_DATA MCMESS 0xFD60 INTERN /end MEASUREMENT
/begin MEASUREMENT B_c95ks3 "Ansteuersignal für den Nulltest des CC195" UWORD B_TRUE 1 100 0 1 BIT_MASK 0x2000 FUNCTION_LIST GGKS KRKE IF_DATA DIM_X 0xFD60 INTERN BYTE IF_DATA MCMESS 0xFD60 INTERN /end MEASUREMENT
/begin MEASUREMENT B_c95_g0 "Ansteuerung der Verstärkerstufe des CC195 (PIN G0)" UWORD B_TRUE 1 100 0 1 BIT_MASK 0x1 FUNCTION_LIST KRKE IF_DATA DIM_X 0xFD64 INTERN BYTE IF_DATA MCMESS 0xFD64 INTERN /end MEASUREMENT
/begin MEASUREMENT B_c95_g1 "Ansteuerung der Verstärkerstufe des CC195 (Pin G1)" UWORD B_TRUE 1 100 0 1 BIT_MASK 0x2 FUNCTION_LIST KRKE IF_DATA DIM_X 0xFD64 INTERN BYTE IF_DATA MCMESS 0xFD64 INTERN /end MEASUREMENT
/begin MEASUREMENT B_c95_g2 "Ansteuerung der Verstärkerstufe des CC195 (Pin G2)" UWORD B_TRUE 1 100 0 1 BIT_MASK 0x4 FUNCTION_LIST KRKE IF_DATA DIM_X 0xFD64 INTERN BYTE IF_DATA MCMESS 0xFD64 INTERN /end MEASUREMENT
/begin MEASUREMENT B_cdagr "Funktion über Codewort CDAGR freigegeben" UWORD B_TRUE 1 100 0 1 BIT_MASK 0x8000 FUNCTION_LIST PROKON DIMC TC6MOD IF_DATA DIM_X 0x38283E EXTERN BYTE IF_DATA MCMESS 0x38283E EXTERN /end MEASUREMENT
/begin MEASUREMENT B_cdatr "Bedingung: Diagnose Abgastemperaturregelung freigegeben" UWORD B_TRUE 1 100 0 1 BIT_MASK 0x400 FUNCTION_LIST PROKON IF_DATA DIM_X 0x38283E EXTERN BYTE IF_DATA MCMESS 0x38283E EXTERN /end MEASUREMENT
/begin MEASUREMENT B_cdats "Bedingung Diagnose Abgastemperatursensor freigegeben" UWORD B_TRUE 1 100 0 1 BIT_MASK 0x200 FUNCTION_LIST PROKON IF_DATA DIM_X 0x38283E EXTERN BYTE IF_DATA MCMESS 0x38283E EXTERN /end MEASUREMENT
/begin MEASUREMENT B_cddst "Funktion über Codewort CDDST freigegeben" UWORD B_TRUE 1 100 0 1 BIT_MASK 0x1000 FUNCTION_LIST PROKON IF_DATA DIM_X 0x38283E EXTERN BYTE IF_DATA MCMESS 0x38283E EXTERN /end MEASUREMENT
/begin MEASUREMENT B_cdhdvsf "Bedingung Heilungsfreigabe Ventilhub bei i.O.-Prüfung" UWORD B_TRUE 1 100 0 1 BIT_MASK 0x1000 FUNCTION_LIST PROKON DVS IF_DATA DIM_X 0x382840 EXTERN BYTE IF_DATA MCMESS 0x382840 EXTERN /end MEASUREMENT
/begin MEASUREMENT B_cdhsh "Funktion über Codewort CDHSH freigegeben" UWORD B_TRUE 1 100 0 1 BIT_MASK 0x80 FUNCTION_LIST PROKON DHLSHK IF_DATA DIM_X 0x38283E EXTERN BYTE IF_DATA MCMESS 0x38283E EXTERN /end MEASUREMENT
/begin MEASUREMENT B_cdhshe "Funktion über Codewort CDHSHE freigegeben" UWORD B_TRUE 1 100 0 1 BIT_MASK 0x80 FUNCTION_LIST PROKON DHLSHKE IF_DATA DIM_X 0x382840 EXTERN BYTE IF_DATA MCMESS 0x382840 EXTERN /end MEASUREMENT
/begin MEASUREMENT B_cdhsv "Funktion über Codewort CDHSV freigegeben" UWORD B_TRUE 1 100 0 1 BIT_MASK 0x40 FUNCTION_LIST PROKON DHLSU DIMC IF_DATA DIM_X 0x38283E EXTERN BYTE IF_DATA MCMESS 0x38283E EXTERN /end MEASUREMENT
/begin MEASUREMENT B_cdhsve "Funktion über Codewort CDHSVE freigegeben" UWORD B_TRUE 1 100 0 1 BIT_MASK 0x100 FUNCTION_LIST PROKON IF_DATA DIM_X 0x382840 EXTERN BYTE IF_DATA MCMESS 0x382840 EXTERN /end MEASUREMENT
/begin MEASUREMENT B_cdhsvsa "Funktion über Codewort CDHSVSA freigegeben" UWORD B_TRUE 1 100 0 1 BIT_MASK 0x4000 FUNCTION_LIST PROKON DHLSU IF_DATA DIM_X 0x382840 EXTERN BYTE IF_DATA MCMESS 0x382840 EXTERN /end MEASUREMENT
/begin MEASUREMENT B_cdkat "Funktion über Codewort CDKAT freigegeben" UWORD B_TRUE 1 100 0 1 BIT_MASK 0x100 FUNCTION_LIST PROKON DIMC DKATLRS TC6MOD IF_DATA DIM_X 0x38283E EXTERN BYTE IF_DATA MCMESS 0x38283E EXTERN /end MEASUREMENT
/begin MEASUREMENT B_cdkvs "Funktion über Codewort CDKVS freigegeben" UWORD B_TRUE 1 100 0 1 BIT_MASK 0x800 FUNCTION_LIST PROKON DKVS TC1MOD IF_DATA DIM_X 0x38283E EXTERN BYTE IF_DATA MCMESS 0x38283E EXTERN /end MEASUREMENT
/begin MEASUREMENT B_cdlash "Funktion über Codewort CDLASH freigegeben" UWORD B_TRUE 1 100 0 1 BIT_MASK 0x40 FUNCTION_LIST PROKON DLSAHK IF_DATA DIM_X 0x382840 EXTERN BYTE IF_DATA MCMESS 0x382840 EXTERN /end MEASUREMENT
/begin MEASUREMENT B_cdlatp "Funktion über Codewort CDLATP freigegeben" UWORD B_TRUE 1 100 0 1 BIT_MASK 0x10 FUNCTION_LIST PROKON IF_DATA DIM_X 0x382840 EXTERN BYTE IF_DATA MCMESS 0x382840 EXTERN /end MEASUREMENT
/begin MEASUREMENT B_cdlatv "Funktion über Codewort CDLATV freigeben" UWORD B_TRUE 1 100 0 1 BIT_MASK 0x20 FUNCTION_LIST PROKON IF_DATA DIM_X 0x382840 EXTERN BYTE IF_DATA MCMESS 0x382840 EXTERN /end MEASUREMENT
/begin MEASUREMENT B_cdldp "Funktion über Codewort CDLDP freigegeben" UWORD B_TRUE 1 100 0 1 BIT_MASK 0x4000 FUNCTION_LIST PROKON IF_DATA DIM_X 0x38283E EXTERN BYTE IF_DATA MCMESS 0x38283E EXTERN /end MEASUREMENT
/begin MEASUREMENT B_cdllr "Funktion über Codewort CDLLR freigegeben" UWORD B_TRUE 1 100 0 1 BIT_MASK 0x8 FUNCTION_LIST PROKON DLLR IF_DATA DIM_X 0x382840 EXTERN BYTE IF_DATA MCMESS 0x382840 EXTERN /end MEASUREMENT
/begin MEASUREMENT B_cdlsa "Funktion über Codewort CDLSA freigegeben" UWORD B_TRUE 1 100 0 1 BIT_MASK 0x20 FUNCTION_LIST PROKON IF_DATA DIM_X 0x38283E EXTERN BYTE IF_DATA MCMESS 0x38283E EXTERN /end MEASUREMENT
/begin MEASUREMENT B_cdlsh "Funktion über Codewort CDLSH freigegeben" UWORD B_TRUE 1 100 0 1 BIT_MASK 0x10 FUNCTION_LIST PROKON DLSH IF_DATA DIM_X 0x38283E EXTERN BYTE IF_DATA MCMESS 0x38283E EXTERN /end MEASUREMENT
/begin MEASUREMENT B_cdlsv "Funktion über Codewort CDLSV freigegeben" UWORD B_TRUE 1 100 0 1 BIT_MASK 0x8 FUNCTION_LIST PROKON DIMC DLSU IF_DATA DIM_X 0x38283E EXTERN BYTE IF_DATA MCMESS 0x38283E EXTERN /end MEASUREMENT
/begin MEASUREMENT B_cdlsvv "Funktion über Codewort CDLSVV freigegeben" UWORD B_TRUE 1 100 0 1 BIT_MASK 0x2000 FUNCTION_LIST PROKON DLSUV IF_DATA DIM_X 0x382840 EXTERN BYTE IF_DATA MCMESS 0x382840 EXTERN /end MEASUREMENT
/begin MEASUREMENT B_cdmd "Funktion über Codewort CDMD freigegeben" UWORD B_TRUE 1 100 0 1 BIT_MASK 0x1 FUNCTION_LIST PROKON DMDLU DMDMIL DMDSTP TC1MOD IF_DATA DIM_X 0x38283E EXTERN BYTE IF_DATA MCMESS 0x38283E EXTERN /end MEASUREMENT
/begin MEASUREMENT B_cdnws "Funktion über Codewort CDNWS freigegeben" UWORD B_TRUE 1 100 0 1 BIT_MASK 0x4 FUNCTION_LIST PROKON DNWS IF_DATA DIM_X 0x382840 EXTERN BYTE IF_DATA MCMESS 0x382840 EXTERN /end MEASUREMENT
/begin MEASUREMENT B_cdsls "Funktion über Codewort CDSLS freigegeben" UWORD B_TRUE 1 100 0 1 BIT_MASK 0x1 FUNCTION_LIST PROKON DIMC DSLSLRS T2DFA TC6MOD IF_DATA DIM_X 0x382840 EXTERN BYTE IF_DATA MCMESS 0x382840 EXTERN /end MEASUREMENT
/begin MEASUREMENT B_cdslse "Funktion über Codewort CDSLSE freigegeben" UWORD B_TRUE 1 100 0 1 BIT_MASK 0x2 FUNCTION_LIST PROKON IF_DATA DIM_X 0x382840 EXTERN BYTE IF_DATA MCMESS 0x382840 EXTERN /end MEASUREMENT
/begin MEASUREMENT B_cdswe "Funktion über Codewort CDSWE freigegeben" UWORD B_TRUE 1 100 0 1 BIT_MASK 0x2 FUNCTION_LIST PROKON BGRBS DSWEC IF_DATA DIM_X 0x38283E EXTERN BYTE IF_DATA MCMESS 0x38283E EXTERN /end MEASUREMENT
/begin MEASUREMENT B_cdtankl "Funktion über Codewort CDTANKL freigegeben" UWORD B_TRUE 1 100 0 1 BIT_MASK 0x4 FUNCTION_LIST PROKON IF_DATA DIM_X 0x38283E EXTERN BYTE IF_DATA MCMESS 0x38283E EXTERN /end MEASUREMENT
/begin MEASUREMENT B_cdtes "Funktion über Codewort CDTES freigegeben" UWORD B_TRUE 1 100 0 1 BIT_MASK 0x2000 FUNCTION_LIST PROKON DIMC DTEV TC6MOD IF_DATA DIM_X 0x38283E EXTERN BYTE IF_DATA MCMESS 0x38283E EXTERN /end MEASUREMENT
/begin MEASUREMENT B_cdvski "Bedingung Fehleranzeige im Kombi aktiv bei Ventilhubfehler ""kleiner Hub""" UWORD B_TRUE 1 100 0 1 BIT_MASK 0x800 FUNCTION_LIST PROKON VS IF_DATA DIM_X 0x382840 EXTERN BYTE IF_DATA MCMESS 0x382840 EXTERN /end MEASUREMENT
/begin MEASUREMENT B_cdvss "Funktion über Codewort CDVSS freigeben" UWORD B_TRUE 1 100 0 1 BIT_MASK 0x200 FUNCTION_LIST PROKON DVS VS IF_DATA DIM_X 0x382840 EXTERN BYTE IF_DATA MCMESS 0x382840 EXTERN /end MEASUREMENT
/begin MEASUREMENT B_cdvssfg "Bedingung Zwangsverstellung nach grossem Hub freigegeben bei Summenfehler MAX" UWORD B_TRUE 1 100 0 1 BIT_MASK 0x400 FUNCTION_LIST PROKON VS IF_DATA DIM_X 0x382840 EXTERN BYTE IF_DATA MCMESS 0x382840 EXTERN /end MEASUREMENT
/begin MEASUREMENT B_cfkuka "Bedingung Berechnung Korrekturfaktor UK-Adaption" UWORD B_TRUE 1 100 0 1 BIT_MASK 0x4 FUNCTION_LIST ESUKAS IF_DATA DIM_X 0xFD56 INTERN BYTE IF_DATA MCMESS 0xFD56 INTERN /end MEASUREMENT
/begin MEASUREMENT B_cfkuka2 "Bedingung Berechnung Korrekturfaktor UK-Adaption Bank 2" UWORD B_TRUE 1 100 0 1 BIT_MASK 0x8 FUNCTION_LIST ESUKAS IF_DATA DIM_X 0xFD56 INTERN BYTE IF_DATA MCMESS 0xFD56 INTERN /end MEASUREMENT
/begin MEASUREMENT B_cfuka "Bedingung UK-Adaptionsfaktor berechnen" UWORD B_TRUE 1 100 0 1 BIT_MASK 0x10 FUNCTION_LIST ESUKAS IF_DATA DIM_X 0xFD56 INTERN BYTE IF_DATA MCMESS 0xFD56 INTERN /end MEASUREMENT
/begin MEASUREMENT B_cfuka2 "Bedingung UK-Adaptionsfaktor berechnen (Bank 2)" UWORD B_TRUE 1 100 0 1 BIT_MASK 0x20 FUNCTION_LIST ESUKAS IF_DATA DIM_X 0xFD56 INTERN BYTE IF_DATA MCMESS 0xFD56 INTERN /end MEASUREMENT
/begin MEASUREMENT B_cksbrdy "Checksummemberechnung ist fertig (ready)" UBYTE B_TRUE 1 100 0 1 BIT_MASK 0x1 FUNCTION_LIST BGCVN TC9MOD IF_DATA DIM_X 0x3809D5 EXTERN BYTE IF_DATA MCMESS 0x3809D5 EXTERN /end MEASUREMENT
/begin MEASUREMENT B_claave "Bedingung Fehlerpfad AAVE löschen" UWORD B_TRUE 1 100 0 1 BIT_MASK 0x80 FUNCTION_LIST DFPM_DEKON IF_DATA DIM_X 0x383816 EXTERN BYTE IF_DATA MCMESS 0x383816 EXTERN /end MEASUREMENT
/begin MEASUREMENT B_clagre "Bedingung Fehlerpfad AGR-Endstufe löschen" UWORD B_TRUE 1 100 0 1 BIT_MASK 0x80 FUNCTION_LIST DFPM_DUMMY043 IF_DATA DIM_X 0x383818 EXTERN BYTE IF_DATA MCMESS 0x383818 EXTERN /end MEASUREMENT
/begin MEASUREMENT B_clbm "Bedingung Fehlerpfad Bezugsmarkengeber löschen" UWORD B_TRUE 1 100 0 1 BIT_MASK 0x80 FUNCTION_LIST DFPM_DDG IF_DATA DIM_X 0x38381C EXTERN BYTE IF_DATA MCMESS 0x38381C EXTERN /end MEASUREMENT
/begin MEASUREMENT B_clbrems "Bedingung Fehlerpfad BREMS (Bremsschalter) löschen" UWORD B_TRUE 1 100 0 1 BIT_MASK 0x80 FUNCTION_LIST DFPM_GGEGAS IF_DATA DIM_X 0x38381E EXTERN BYTE IF_DATA MCMESS 0x38381E EXTERN /end MEASUREMENT
/begin MEASUREMENT B_clbwf "Flag für Löschung: PWG Bewegung" UWORD B_TRUE 1 100 0 1 BIT_MASK 0x80 FUNCTION_LIST DFPM_GGPED IF_DATA DIM_X 0x383820 EXTERN BYTE IF_DATA MCMESS 0x383820 EXTERN /end MEASUREMENT
/begin MEASUREMENT B_clcas "Bedingung Fehlerpfad CAS löschen" UWORD B_TRUE 1 100 0 1 BIT_MASK 0x80 FUNCTION_LIST DFPM_DCAS IF_DATA DIM_X 0x383822 EXTERN BYTE IF_DATA MCMESS 0x383822 EXTERN /end MEASUREMENT
/begin MEASUREMENT B_clcge "Bedingung Fehlerpfad CGE löschen" UWORD B_TRUE 1 100 0 1 BIT_MASK 0x80 FUNCTION_LIST DFPM_DCGE IF_DATA DIM_X 0x383824 EXTERN BYTE IF_DATA MCMESS 0x383824 EXTERN /end MEASUREMENT
/begin MEASUREMENT B_clcgegs "Bedingung Fehlerpfad löschen: EGS; Steuergerät" UWORD B_TRUE 1 100 0 1 BIT_MASK 0x80 FUNCTION_LIST DFPM_DCG IF_DATA DIM_X 0x383826 EXTERN BYTE IF_DATA MCMESS 0x383826 EXTERN /end MEASUREMENT
/begin MEASUREMENT B_clcgggp "Bedingung: Fehlerpfad löschen EGS; Gang unplausibel" UWORD B_TRUE 1 100 0 1 BIT_MASK 0x80 FUNCTION_LIST DFPM_DCG IF_DATA DIM_X 0x383828 EXTERN BYTE IF_DATA MCMESS 0x383828 EXTERN /end MEASUREMENT
/begin MEASUREMENT B_clcgggv "Bedingung: Fehlerpfad löschen EGS; Gangvergleich negativ" UWORD B_TRUE 1 100 0 1 BIT_MASK 0x80 FUNCTION_LIST DFPM_DCG IF_DATA DIM_X 0x38382A EXTERN BYTE IF_DATA MCMESS 0x38382A EXTERN /end MEASUREMENT
/begin MEASUREMENT B_clcgm1v "Bedingung: Fehlerpfad löschen EGS; Magnetventil 1-2/4-5 Schaltung" UWORD B_TRUE 1 100 0 1 BIT_MASK 0x80 FUNCTION_LIST DFPM_DCG IF_DATA DIM_X 0x38382C EXTERN BYTE IF_DATA MCMESS 0x38382C EXTERN /end MEASUREMENT
/begin MEASUREMENT B_clcgm2v "Bedingung: Fehlerpfad löschen EGS; Magnetventil 2-3 Schaltung" UWORD B_TRUE 1 100 0 1 BIT_MASK 0x80 FUNCTION_LIST DFPM_DCG IF_DATA DIM_X 0x38382E EXTERN BYTE IF_DATA MCMESS 0x38382E EXTERN /end MEASUREMENT
/begin MEASUREMENT B_clcgm3v "Bedingung: Fehlerpfad löschen EGS; Magnetventil 3-4 Schaltung" UWORD B_TRUE 1 100 0 1 BIT_MASK 0x80 FUNCTION_LIST DFPM_DCG IF_DATA DIM_X 0x383830 EXTERN BYTE IF_DATA MCMESS 0x383830 EXTERN /end MEASUREMENT
/begin MEASUREMENT B_clcgmvk "Bedingung: Fehlerpfad löschen EGS; Magnetventil Wandlerkupplung" UWORD B_TRUE 1 100 0 1 BIT_MASK 0x80 FUNCTION_LIST DFPM_DCG IF_DATA DIM_X 0x383832 EXTERN BYTE IF_DATA MCMESS 0x383832 EXTERN /end MEASUREMENT
/begin MEASUREMENT B_clcgrmm "Bedingung: Fehlerpfad löschen EGS; Regelmagnetventil Modulierdruck" UWORD B_TRUE 1 100 0 1 BIT_MASK 0x80 FUNCTION_LIST DFPM_DCG IF_DATA DIM_X 0x383834 EXTERN BYTE IF_DATA MCMESS 0x383834 EXTERN /end MEASUREMENT
/begin MEASUREMENT B_clcgrms "Bedingung: Fehlerpfad löschen EGS; Regelmagnetventil Schaltdruck" UWORD B_TRUE 1 100 0 1 BIT_MASK 0x80 FUNCTION_LIST DFPM_DCG IF_DATA DIM_X 0x383836 EXTERN BYTE IF_DATA MCMESS 0x383836 EXTERN /end MEASUREMENT
/begin MEASUREMENT B_clcgudg "Bedingung: Fehlerpfad löschen EGS; Versorgungsspannung Drehzahlsensoren" UWORD B_TRUE 1 100 0 1 BIT_MASK 0x80 FUNCTION_LIST DFPM_DCG IF_DATA DIM_X 0x383838 EXTERN BYTE IF_DATA MCMESS 0x383838 EXTERN /end MEASUREMENT
/begin MEASUREMENT B_clcgumv "Bedingung: Fehlerpfad löschen EGS; Versorgungsspannung Magnetventile" UWORD B_TRUE 1 100 0 1 BIT_MASK 0x80 FUNCTION_LIST DFPM_DCG IF_DATA DIM_X 0x38383A EXTERN BYTE IF_DATA MCMESS 0x38383A EXTERN /end MEASUREMENT
/begin MEASUREMENT B_clcgvgc "Bedingung: Fehlerpfad löschen EGS; Verteilergetr.-Stellung unplaus." UWORD B_TRUE 1 100 0 1 BIT_MASK 0x80 FUNCTION_LIST DFPM_DCG IF_DATA DIM_X 0x38383C EXTERN BYTE IF_DATA MCMESS 0x38383C EXTERN /end MEASUREMENT
/begin MEASUREMENT B_clcgvrc "Bedingung: Fehlerpfad löschen EGS; Raddrehzahl hinten unplausibel" UWORD B_TRUE 1 100 0 1 BIT_MASK 0x80 FUNCTION_LIST DFPM_DCG IF_DATA DIM_X 0x38383E EXTERN BYTE IF_DATA MCMESS 0x38383E EXTERN /end MEASUREMENT
/begin MEASUREMENT B_clcgwk "Bedingung: Fehlerpfad löschen EGS; Wandlerkupplung" UWORD B_TRUE 1 100 0 1 BIT_MASK 0x80 FUNCTION_LIST DFPM_DCG IF_DATA DIM_X 0x383840 EXTERN BYTE IF_DATA MCMESS 0x383840 EXTERN /end MEASUREMENT
/begin MEASUREMENT B_clckbi "Bedingung Fehlerpfad KBI lösche" UWORD B_TRUE 1 100 0 1 BIT_MASK 0x80 FUNCTION_LIST DFPM_DCKBI IF_DATA DIM_X 0x383842 EXTERN BYTE IF_DATA MCMESS 0x383842 EXTERN /end MEASUREMENT
/begin MEASUREMENT B_clcmil "Bedingung Fehlerpfad CMIL löschen" UWORD B_TRUE 1 100 0 1 BIT_MASK 0x80 FUNCTION_LIST DFPM_DCMIL IF_DATA DIM_X 0x383844 EXTERN BYTE IF_DATA MCMESS 0x383844 EXTERN /end MEASUREMENT
/begin MEASUREMENT B_clcra "Bedingung Fehlerpfad Crashsignal löschen" UWORD B_TRUE 1 100 0 1 BIT_MASK 0x80 FUNCTION_LIST DFPM_GGAIRBAG IF_DATA DIM_X 0x383846 EXTERN BYTE IF_DATA MCMESS 0x383846 EXTERN /end MEASUREMENT
/begin MEASUREMENT B_cldk "Bedingung Fehlerpfad DK (Drosselklappen-Poti) löschen" UWORD B_TRUE 1 100 0 1 BIT_MASK 0x80 FUNCTION_LIST DFPM_DDVE IF_DATA DIM_X 0x383848 EXTERN BYTE IF_DATA MCMESS 0x383848 EXTERN /end MEASUREMENT
/begin MEASUREMENT B_cldk1p "Bedingung Fehlerpfad DK1P (Drosselklappen-Poti 1) löschen" UWORD B_TRUE 1 100 0 1 BIT_MASK 0x80 FUNCTION_LIST DFPM_DDVE IF_DATA DIM_X 0x38384A EXTERN BYTE IF_DATA MCMESS 0x38384A EXTERN /end MEASUREMENT
/begin MEASUREMENT B_cldk2p "Bedingung Fehlerpfad DK2P (Drosselklappen-Poti 2) löschen" UWORD B_TRUE 1 100 0 1 BIT_MASK 0x80 FUNCTION_LIST DFPM_DDVE IF_DATA DIM_X 0x38384C EXTERN BYTE IF_DATA MCMESS 0x38384C EXTERN /end MEASUREMENT
/begin MEASUREMENT B_cldsl "Bedingung: Fehlerpfad Ladedrucksensor löschen" UWORD B_TRUE 1 100 0 1 BIT_MASK 0x80 FUNCTION_LIST DFPM_GGDSAS IF_DATA DIM_X 0x383850 EXTERN BYTE IF_DATA MCMESS 0x383850 EXTERN /end MEASUREMENT
/begin MEASUREMENT B_cldsu "Bedingung: Fehlerpfad Umgebungsdrucksensor löschen" UWORD B_TRUE 1 100 0 1 BIT_MASK 0x80 FUNCTION_LIST DFPM_GGDSAS IF_DATA DIM_X 0x383852 EXTERN BYTE IF_DATA MCMESS 0x383852 EXTERN /end MEASUREMENT
/begin MEASUREMENT B_cldsvlu "Bedingung: Fehlerpfad Drucksensorvergleich DS-L DS-U" UWORD B_TRUE 1 100 0 1 BIT_MASK 0x80 FUNCTION_LIST DFPM_GGDSAS IF_DATA DIM_X 0x383854 EXTERN BYTE IF_DATA MCMESS 0x383854 EXTERN /end MEASUREMENT
/begin MEASUREMENT B_cldvee "Flag für Löschmaßnahmen: DV-E Endstufe" UWORD B_TRUE 1 100 0 1 BIT_MASK 0x80 FUNCTION_LIST DFPM_DDVE IF_DATA DIM_X 0x383856 EXTERN BYTE IF_DATA MCMESS 0x383856 EXTERN /end MEASUREMENT
/begin MEASUREMENT B_cldvef "Flag für Löschung: DV-E Fehler bei Federprüfung" UWORD B_TRUE 1 100 0 1 BIT_MASK 0x80 FUNCTION_LIST DFPM_DDVE IF_DATA DIM_X 0x383858 EXTERN BYTE IF_DATA MCMESS 0x383858 EXTERN /end MEASUREMENT
/begin MEASUREMENT B_cldvefo "Flag für Löschung: Fehler bei Federprüfung ""Öffnen""" UWORD B_TRUE 1 100 0 1 BIT_MASK 0x80 FUNCTION_LIST DFPM_DDVE IF_DATA DIM_X 0x38385A EXTERN BYTE IF_DATA MCMESS 0x38385A EXTERN /end MEASUREMENT
/begin MEASUREMENT B_cldvel "Flag für Löschmaßnahmen: DV-E Lageabweichung" UWORD B_TRUE 1 100 0 1 BIT_MASK 0x80 FUNCTION_LIST DFPM_DDVE IF_DATA DIM_X 0x38385C EXTERN BYTE IF_DATA MCMESS 0x38385C EXTERN /end MEASUREMENT
/begin MEASUREMENT B_cldven "Flag für Löschung: DV-E Fehler bei Prüfung Notluftposition" UWORD B_TRUE 1 100 0 1 BIT_MASK 0x80 FUNCTION_LIST DFPM_DDVE IF_DATA DIM_X 0x38385E EXTERN BYTE IF_DATA MCMESS 0x38385E EXTERN /end MEASUREMENT
/begin MEASUREMENT B_cldver "Flag für Löschmaßnahmen: DV-E Regelabweichung" UWORD B_TRUE 1 100 0 1 BIT_MASK 0x80 FUNCTION_LIST DFPM_DDVE IF_DATA DIM_X 0x383860 EXTERN BYTE IF_DATA MCMESS 0x383860 EXTERN /end MEASUREMENT
/begin MEASUREMENT B_cldvet "Flag für Löschung: DV-E-Tauscherkennung ohne Adaption" UWORD B_TRUE 1 100 0 1 BIT_MASK 0x80 FUNCTION_LIST DFPM_DDVE IF_DATA DIM_X 0x383862 EXTERN BYTE IF_DATA MCMESS 0x383862 EXTERN /end MEASUREMENT
/begin MEASUREMENT B_cldveu "Flag für Löschung: DV-E Fehler beim UMA-Lernen" UWORD B_TRUE 1 100 0 1 BIT_MASK 0x80 FUNCTION_LIST DFPM_DDVE IF_DATA DIM_X 0x383864 EXTERN BYTE IF_DATA MCMESS 0x383864 EXTERN /end MEASUREMENT
/begin MEASUREMENT B_cldveub "Flag für Löschung: DV-E-Adaption Abbruch wg. Umweltbedingung" UWORD B_TRUE 1 100 0 1 BIT_MASK 0x80 FUNCTION_LIST DFPM_DDVE IF_DATA DIM_X 0x383866 EXTERN BYTE IF_DATA MCMESS 0x383866 EXTERN /end MEASUREMENT
/begin MEASUREMENT B_cldveuw "Flag für Löschung: Fehler bei UMA-Wiederlernen" UWORD B_TRUE 1 100 0 1 BIT_MASK 0x80 FUNCTION_LIST DFPM_DDVE IF_DATA DIM_X 0x383868 EXTERN BYTE IF_DATA MCMESS 0x383868 EXTERN /end MEASUREMENT
/begin MEASUREMENT B_cldvev "Flag für Löschung: DV-E Fehler bei Verstärkerabgleich" UWORD B_TRUE 1 100 0 1 BIT_MASK 0x80 FUNCTION_LIST DFPM_DDVE IF_DATA DIM_X 0x38386A EXTERN BYTE IF_DATA MCMESS 0x38386A EXTERN /end MEASUREMENT
/begin MEASUREMENT B_clegfe "Bedingung Fehlerpfad EGFE löschen" UWORD B_TRUE 1 100 0 1 BIT_MASK 0x80 FUNCTION_LIST DFPM_EGFE IF_DATA DIM_X 0x38386C EXTERN BYTE IF_DATA MCMESS 0x38386C EXTERN /end MEASUREMENT
/begin MEASUREMENT B_clev1 "Bedingung Fehlerpfad EV 1 löschen" UWORD B_TRUE 1 100 0 1 BIT_MASK 0x80 FUNCTION_LIST DFPM_DEKON IF_DATA DIM_X 0x38386E EXTERN BYTE IF_DATA MCMESS 0x38386E EXTERN /end MEASUREMENT
/begin MEASUREMENT B_clev2 "Bedingung Fehlerpfad EV 2 löschen" UWORD B_TRUE 1 100 0 1 BIT_MASK 0x80 FUNCTION_LIST DFPM_DEKON IF_DATA DIM_X 0x383870 EXTERN BYTE IF_DATA MCMESS 0x383870 EXTERN /end MEASUREMENT
/begin MEASUREMENT B_clev3 "Bedingung Fehlerpfad EV 3 löschen" UWORD B_TRUE 1 100 0 1 BIT_MASK 0x80 FUNCTION_LIST DFPM_DEKON IF_DATA DIM_X 0x383872 EXTERN BYTE IF_DATA MCMESS 0x383872 EXTERN /end MEASUREMENT
/begin MEASUREMENT B_clev4 "Bedingung Fehlerpfad EV 4 löschen" UWORD B_TRUE 1 100 0 1 BIT_MASK 0x80 FUNCTION_LIST DFPM_DEKON IF_DATA DIM_X 0x383874 EXTERN BYTE IF_DATA MCMESS 0x383874 EXTERN /end MEASUREMENT
/begin MEASUREMENT B_clev5 "Bedingung Fehlerpfad EV 5 löschen" UWORD B_TRUE 1 100 0 1 BIT_MASK 0x80 FUNCTION_LIST DFPM_DEKON IF_DATA DIM_X 0x383876 EXTERN BYTE IF_DATA MCMESS 0x383876 EXTERN /end MEASUREMENT
/begin MEASUREMENT B_clev6 "Bedingung Fehlerpfad EV 6 löschen" UWORD B_TRUE 1 100 0 1 BIT_MASK 0x80 FUNCTION_LIST DFPM_DEKON IF_DATA DIM_X 0x383878 EXTERN BYTE IF_DATA MCMESS 0x383878 EXTERN /end MEASUREMENT
/begin MEASUREMENT B_clfgrl "Bedingung Fehlerpfad FGR-Lampe über CAN löschen" UWORD B_TRUE 1 100 0 1 BIT_MASK 0x80 FUNCTION_LIST DFPM_DCFGRL IF_DATA DIM_X 0x38387A EXTERN BYTE IF_DATA MCMESS 0x38387A EXTERN /end MEASUREMENT
/begin MEASUREMENT B_clfp1p "Flag für Löschmaßnahmen: Fahrpedal 1. Poti" UWORD B_TRUE 1 100 0 1 BIT_MASK 0x80 FUNCTION_LIST DFPM_GGPED IF_DATA DIM_X 0x38387C EXTERN BYTE IF_DATA MCMESS 0x38387C EXTERN /end MEASUREMENT
/begin MEASUREMENT B_clfp2p "Flag für Löschmaßnahmen: Fahrpedal 2. Poti" UWORD B_TRUE 1 100 0 1 BIT_MASK 0x80 FUNCTION_LIST DFPM_GGPED IF_DATA DIM_X 0x38387E EXTERN BYTE IF_DATA MCMESS 0x38387E EXTERN /end MEASUREMENT
/begin MEASUREMENT B_clfpp "Bedingung Fehlerpfad FPP (Fahrpedal-Poti) löschen" UWORD B_TRUE 1 100 0 1 BIT_MASK 0x80 FUNCTION_LIST DFPM_GGPED IF_DATA DIM_X 0x383880 EXTERN BYTE IF_DATA MCMESS 0x383880 EXTERN /end MEASUREMENT
/begin MEASUREMENT B_clfrao "Bedingung Fehlerpfad FRAO löschen (obere Multipl. Bereich)" UWORD B_TRUE 1 100 0 1 BIT_MASK 0x80 FUNCTION_LIST DFPM_DKVS IF_DATA DIM_X 0x383882 EXTERN BYTE IF_DATA MCMESS 0x383882 EXTERN /end MEASUREMENT
/begin MEASUREMENT B_clfrao2 "Bedingung Fehlerpfad FRAO2 löschen (Stereo)" UWORD B_TRUE 1 100 0 1 BIT_MASK 0x80 FUNCTION_LIST DFPM_DKVS IF_DATA DIM_X 0x383884 EXTERN BYTE IF_DATA MCMESS 0x383884 EXTERN /end MEASUREMENT
/begin MEASUREMENT B_clfrau "Bedingung Fehlerpfad FRAU löschen (untere Multipl. Bereich)" UWORD B_TRUE 1 100 0 1 BIT_MASK 0x80 FUNCTION_LIST DFPM_DKVS IF_DATA DIM_X 0x383886 EXTERN BYTE IF_DATA MCMESS 0x383886 EXTERN /end MEASUREMENT
/begin MEASUREMENT B_clfrau2 "Bedingung Fehlerpfad FRAU2 löschen (Stereo)" UWORD B_TRUE 1 100 0 1 BIT_MASK 0x80 FUNCTION_LIST DFPM_DKVS IF_DATA DIM_X 0x383888 EXTERN BYTE IF_DATA MCMESS 0x383888 EXTERN /end MEASUREMENT
/begin MEASUREMENT B_clfrst "Bedingung Fehlerpfad FRST löschen (Kurztest)" UWORD B_TRUE 1 100 0 1 BIT_MASK 0x80 FUNCTION_LIST DFPM_DKVS IF_DATA DIM_X 0x38388A EXTERN BYTE IF_DATA MCMESS 0x38388A EXTERN /end MEASUREMENT
/begin MEASUREMENT B_clfrst2 "Bedingung Fehlerpfad FRST löschen (Kurztest Bank 2)" UWORD B_TRUE 1 100 0 1 BIT_MASK 0x80 FUNCTION_LIST DFPM_DKVS IF_DATA DIM_X 0x38388C EXTERN BYTE IF_DATA MCMESS 0x38388C EXTERN /end MEASUREMENT
/begin MEASUREMENT B_clhsh "Bedingung Fehlerpfad DHLSHK löschen" UWORD B_TRUE 1 100 0 1 BIT_MASK 0x80 FUNCTION_LIST DFPM_DHLSHK IF_DATA DIM_X 0x38388E EXTERN BYTE IF_DATA MCMESS 0x38388E EXTERN /end MEASUREMENT
/begin MEASUREMENT B_clhsh2 "Bedingung Fehlerpfad DHLSHK2 löschen" UWORD B_TRUE 1 100 0 1 BIT_MASK 0x80 FUNCTION_LIST DFPM_DHLSHK IF_DATA DIM_X 0x383890 EXTERN BYTE IF_DATA MCMESS 0x383890 EXTERN /end MEASUREMENT
/begin MEASUREMENT B_clhshe "Bedingung Fehlerpfad DHLSHK löschen (Endstufe)" UWORD B_TRUE 1 100 0 1 BIT_MASK 0x80 FUNCTION_LIST DFPM_DEKON IF_DATA DIM_X 0x383892 EXTERN BYTE IF_DATA MCMESS 0x383892 EXTERN /end MEASUREMENT
/begin MEASUREMENT B_clhshe2 "Bedingung Fehlerpfad DHLSHK2 löschen (Endstufe)" UWORD B_TRUE 1 100 0 1 BIT_MASK 0x80 FUNCTION_LIST DFPM_DEKON IF_DATA DIM_X 0x383894 EXTERN BYTE IF_DATA MCMESS 0x383894 EXTERN /end MEASUREMENT
/begin MEASUREMENT B_clhsv "Bedingung Fehlerpfad DHLSVK löschen" UWORD B_TRUE 1 100 0 1 BIT_MASK 0x80 FUNCTION_LIST DFPM_DHLSU IF_DATA DIM_X 0x383896 EXTERN BYTE IF_DATA MCMESS 0x383896 EXTERN /end MEASUREMENT
/begin MEASUREMENT B_clhsv2 "Bedingung Fehlerpfad DHLSVK2 löschen" UWORD B_TRUE 1 100 0 1 BIT_MASK 0x80 FUNCTION_LIST DFPM_DHLSU IF_DATA DIM_X 0x383898 EXTERN BYTE IF_DATA MCMESS 0x383898 EXTERN /end MEASUREMENT
/begin MEASUREMENT B_clhsvsa "Bedingung Fehlerpfad DHLSUSA löschen" UWORD B_TRUE 1 100 0 1 BIT_MASK 0x80 FUNCTION_LIST DFPM_DHLSU IF_DATA DIM_X 0x38389A EXTERN BYTE IF_DATA MCMESS 0x38389A EXTERN /end MEASUREMENT
/begin MEASUREMENT B_clhsvsa2 "Bedingung Fehlerpfad DHLSUSA2 löschen" UWORD B_TRUE 1 100 0 1 BIT_MASK 0x80 FUNCTION_LIST DFPM_DHLSU IF_DATA DIM_X 0x38389C EXTERN BYTE IF_DATA MCMESS 0x38389C EXTERN /end MEASUREMENT
/begin MEASUREMENT B_clkat "Bedingung Fehlerpfad DKAT löschen" UWORD B_TRUE 1 100 0 1 BIT_MASK 0x80 FUNCTION_LIST DFPM_DKAT IF_DATA DIM_X 0x38389E EXTERN BYTE IF_DATA MCMESS 0x38389E EXTERN /end MEASUREMENT
/begin MEASUREMENT B_clkat2 "Bedingung Fehlerpfad Dkat löschen (Stereo)" UWORD B_TRUE 1 100 0 1 BIT_MASK 0x80 FUNCTION_LIST DFPM_DKAT IF_DATA DIM_X 0x3838A0 EXTERN BYTE IF_DATA MCMESS 0x3838A0 EXTERN /end MEASUREMENT
/begin MEASUREMENT B_clkos "Bedingung: Fehlerpfad Endstufe Klimakompressor löschen" UWORD B_TRUE 1 100 0 1 BIT_MASK 0x80 FUNCTION_LIST DFPM_DEKON IF_DATA DIM_X 0x3838A2 EXTERN BYTE IF_DATA MCMESS 0x3838A2 EXTERN /end MEASUREMENT
/begin MEASUREMENT B_clkpe "Bedingung Fehlerpfad EKP-Relais Endstufe löschen" UWORD B_TRUE 1 100 0 1 BIT_MASK 0x80 FUNCTION_LIST DFPM_DEKON IF_DATA DIM_X 0x3838A4 EXTERN BYTE IF_DATA MCMESS 0x3838A4 EXTERN /end MEASUREMENT
/begin MEASUREMENT B_clkrnt "Bedingung Fehlerpfad KR-Diagnose Integratorsteigung löschen" UWORD B_TRUE 1 100 0 1 BIT_MASK 0x80 FUNCTION_LIST DFPM_DKRNT IF_DATA DIM_X 0x3838A6 EXTERN BYTE IF_DATA MCMESS 0x3838A6 EXTERN /end MEASUREMENT
/begin MEASUREMENT B_clkrof "Bedingung Fehlerpfad KR-Diagnose Resetwert löschen" UWORD B_TRUE 1 100 0 1 BIT_MASK 0x80 FUNCTION_LIST DFPM_DKRNT IF_DATA DIM_X 0x3838A8 EXTERN BYTE IF_DATA MCMESS 0x3838A8 EXTERN /end MEASUREMENT
/begin MEASUREMENT B_clkrtp "Bedingung Fehlerpfad KR-Diagnose Testimpuls löschen" UWORD B_TRUE 1 100 0 1 BIT_MASK 0x80 FUNCTION_LIST DFPM_DKRTP IF_DATA DIM_X 0x3838AA EXTERN BYTE IF_DATA MCMESS 0x3838AA EXTERN /end MEASUREMENT
/begin MEASUREMENT B_clks1 "Bedingung Fehlerpfad Klopfsensor 1 löschen" UWORD B_TRUE 1 100 0 1 BIT_MASK 0x80 FUNCTION_LIST DFPM_DKRS IF_DATA DIM_X 0x3838AC EXTERN BYTE IF_DATA MCMESS 0x3838AC EXTERN /end MEASUREMENT
/begin MEASUREMENT B_clks2 "Bedingung Fehlerpfad Klopfsensor 2 löschen" UWORD B_TRUE 1 100 0 1 BIT_MASK 0x80 FUNCTION_LIST DFPM_DKRS IF_DATA DIM_X 0x3838AE EXTERN BYTE IF_DATA MCMESS 0x3838AE EXTERN /end MEASUREMENT
/begin MEASUREMENT B_clks3 "Bedingung Fehlerpfad Klopfsensor 3 löschen" UWORD B_TRUE 1 100 0 1 BIT_MASK 0x80 FUNCTION_LIST DFPM_DKRS IF_DATA DIM_X 0x3838B0 EXTERN BYTE IF_DATA MCMESS 0x3838B0 EXTERN /end MEASUREMENT
/begin MEASUREMENT B_clks4 "Bedingung Fehlerpfad Klopfsensor 4 löschen" UWORD B_TRUE 1 100 0 1 BIT_MASK 0x80 FUNCTION_LIST DFPM_DKRS IF_DATA DIM_X 0x3838B2 EXTERN BYTE IF_DATA MCMESS 0x3838B2 EXTERN /end MEASUREMENT
/begin MEASUREMENT B_clkuppl "Bedingung: Fehlerpfad KUPPL (Gebergröße Kupplung) löschen" UWORD B_TRUE 1 100 0 1 BIT_MASK 0x80 FUNCTION_LIST DFPM_DKUPPL IF_DATA DIM_X 0x3838B4 EXTERN BYTE IF_DATA MCMESS 0x3838B4 EXTERN /end MEASUREMENT
/begin MEASUREMENT B_clkwave "Bedingung Fehlerpfad Kühlwasserabsperrventil Endstufe löschen" UWORD B_TRUE 1 100 0 1 BIT_MASK 0x80 FUNCTION_LIST DFPM_DEKON IF_DATA DIM_X 0x3838B6 EXTERN BYTE IF_DATA MCMESS 0x3838B6 EXTERN /end MEASUREMENT
/begin MEASUREMENT B_cllash "Fehlerpfad in DLSAHK löschen." UWORD B_TRUE 1 100 0 1 BIT_MASK 0x80 FUNCTION_LIST DFPM_DLSAHK IF_DATA DIM_X 0x3838B8 EXTERN BYTE IF_DATA MCMESS 0x3838B8 EXTERN /end MEASUREMENT
/begin MEASUREMENT B_cllash2 "Fehlerpfad in DLSAHK löschen Bank2" UWORD B_TRUE 1 100 0 1 BIT_MASK 0x80 FUNCTION_LIST DFPM_DLSAHK IF_DATA DIM_X 0x3838BA EXTERN BYTE IF_DATA MCMESS 0x3838BA EXTERN /end MEASUREMENT
/begin MEASUREMENT B_cllde "Bedingung Fehlerpfad LDE löschen" UWORD B_TRUE 1 100 0 1 BIT_MASK 0x80 FUNCTION_LIST DFPM_DEKON IF_DATA DIM_X 0x3838BC EXTERN BYTE IF_DATA MCMESS 0x3838BC EXTERN /end MEASUREMENT
/begin MEASUREMENT B_clldo "Bedingung: Fehlereintrag Überladefehler löschen" UWORD B_TRUE 1 100 0 1 BIT_MASK 0x80 FUNCTION_LIST DFPM_DLDR IF_DATA DIM_X 0x3838BE EXTERN BYTE IF_DATA MCMESS 0x3838BE EXTERN /end MEASUREMENT
/begin MEASUREMENT B_clldra "Bedingung: Fehlereintrag LDR Regelabweichungsfehler löschen" UWORD B_TRUE 1 100 0 1 BIT_MASK 0x80 FUNCTION_LIST DFPM_DLDR IF_DATA DIM_X 0x3838C0 EXTERN BYTE IF_DATA MCMESS 0x3838C0 EXTERN /end MEASUREMENT
/begin MEASUREMENT B_cllf1e "Bedingung: Fehlerpfad Endstufe Lüfter1 löschen" UWORD B_TRUE 1 100 0 1 BIT_MASK 0x80 FUNCTION_LIST DFPM_DEKON IF_DATA DIM_X 0x3838C2 EXTERN BYTE IF_DATA MCMESS 0x3838C2 EXTERN /end MEASUREMENT
/begin MEASUREMENT B_cllf2e "Bedingung: Fehlerpfad Endstufe Lüfter2 löschen" UWORD B_TRUE 1 100 0 1 BIT_MASK 0x80 FUNCTION_LIST DFPM_DEKON IF_DATA DIM_X 0x3838C4 EXTERN BYTE IF_DATA MCMESS 0x3838C4 EXTERN /end MEASUREMENT
/begin MEASUREMENT B_cllf3e "Bedingung: Fehlerpfad Endstufe Lüfter3 löschen" UWORD B_TRUE 1 100 0 1 BIT_MASK 0x80 FUNCTION_LIST DFPM_DEKON IF_DATA DIM_X 0x3838C6 EXTERN BYTE IF_DATA MCMESS 0x3838C6 EXTERN /end MEASUREMENT
/begin MEASUREMENT B_clllr "Bedingung Fehlerpfad DLLR löschen" UWORD B_TRUE 1 100 0 1 BIT_MASK 0x80 FUNCTION_LIST DFPM_DLLR IF_DATA DIM_X 0x3838C8 EXTERN BYTE IF_DATA MCMESS 0x3838C8 EXTERN /end MEASUREMENT
/begin MEASUREMENT B_cllm "Bedingung: Fehlerpfad Hauptfüllungssensor löschen" UWORD B_TRUE 1 100 0 1 BIT_MASK 0x80 FUNCTION_LIST DFPM_DHFM IF_DATA DIM_X 0x3838CA EXTERN BYTE IF_DATA MCMESS 0x3838CA EXTERN /end MEASUREMENT
/begin MEASUREMENT B_cllsh "Fehlerpfad in DLSH löschen" UWORD B_TRUE 1 100 0 1 BIT_MASK 0x80 FUNCTION_LIST DFPM_DLSH IF_DATA DIM_X 0x3838CC EXTERN BYTE IF_DATA MCMESS 0x3838CC EXTERN /end MEASUREMENT
/begin MEASUREMENT B_cllsh2 "Fehlerpfad in DLSH löschen.  Bank 2" UWORD B_TRUE 1 100 0 1 BIT_MASK 0x80 FUNCTION_LIST DFPM_DLSH IF_DATA DIM_X 0x3838CE EXTERN BYTE IF_DATA MCMESS 0x3838CE EXTERN /end MEASUREMENT
/begin MEASUREMENT B_cllsv "Fehlerpfad in DLSV löschen." UWORD B_TRUE 1 100 0 1 BIT_MASK 0x80 FUNCTION_LIST DFPM_DLSU IF_DATA DIM_X 0x3838D0 EXTERN BYTE IF_DATA MCMESS 0x3838D0 EXTERN /end MEASUREMENT
/begin MEASUREMENT B_cllsv2 "Fehlerpfad in DLSV löschen.  Bank2" UWORD B_TRUE 1 100 0 1 BIT_MASK 0x80 FUNCTION_LIST DFPM_DLSU IF_DATA DIM_X 0x3838D2 EXTERN BYTE IF_DATA MCMESS 0x3838D2 EXTERN /end MEASUREMENT
/begin MEASUREMENT B_cllsvv "Bedingung Fehlerpfad Vertauschte Sonden löschen" UWORD B_TRUE 1 100 0 1 BIT_MASK 0x80 FUNCTION_LIST DFPM_LSVV IF_DATA DIM_X 0x3838D4 EXTERN BYTE IF_DATA MCMESS 0x3838D4 EXTERN /end MEASUREMENT
/begin MEASUREMENT B_clmd "Flag für Löschung: Aussetzer, Summenfehler (multiple)" UWORD B_TRUE 1 100 0 1 BIT_MASK 0x80 FUNCTION_LIST DFPM_DMDMIL IF_DATA DIM_X 0x3838D6 EXTERN BYTE IF_DATA MCMESS 0x3838D6 EXTERN /end MEASUREMENT
/begin MEASUREMENT B_clmd00 "Flag für Löschung: Aussetzer Zündung 0" UWORD B_TRUE 1 100 0 1 BIT_MASK 0x80 FUNCTION_LIST DFPM_DMDMIL IF_DATA DIM_X 0x3838D8 EXTERN BYTE IF_DATA MCMESS 0x3838D8 EXTERN /end MEASUREMENT
/begin MEASUREMENT B_clmd01 "Flag für Löschung: Aussetzer Zündung 1" UWORD B_TRUE 1 100 0 1 BIT_MASK 0x80 FUNCTION_LIST DFPM_DMDMIL IF_DATA DIM_X 0x3838DA EXTERN BYTE IF_DATA MCMESS 0x3838DA EXTERN /end MEASUREMENT
/begin MEASUREMENT B_clmd02 "Flag für Löschung: Aussetzer Zündung 2" UWORD B_TRUE 1 100 0 1 BIT_MASK 0x80 FUNCTION_LIST DFPM_DMDMIL IF_DATA DIM_X 0x3838DC EXTERN BYTE IF_DATA MCMESS 0x3838DC EXTERN /end MEASUREMENT
/begin MEASUREMENT B_clmd03 "Flag für Löschung: Aussetzer Zündung 3" UWORD B_TRUE 1 100 0 1 BIT_MASK 0x80 FUNCTION_LIST DFPM_DMDMIL IF_DATA DIM_X 0x3838DE EXTERN BYTE IF_DATA MCMESS 0x3838DE EXTERN /end MEASUREMENT
/begin MEASUREMENT B_clmd04 "Flag für Löschung: Aussetzer Zündung 4" UWORD B_TRUE 1 100 0 1 BIT_MASK 0x80 FUNCTION_LIST DFPM_DMDMIL IF_DATA DIM_X 0x3838E0 EXTERN BYTE IF_DATA MCMESS 0x3838E0 EXTERN /end MEASUREMENT
/begin MEASUREMENT B_clmd05 "Flag für Löschung: Aussetzer Zündung 5" UWORD B_TRUE 1 100 0 1 BIT_MASK 0x80 FUNCTION_LIST DFPM_DMDMIL IF_DATA DIM_X 0x3838E2 EXTERN BYTE IF_DATA MCMESS 0x3838E2 EXTERN /end MEASUREMENT
/begin MEASUREMENT B_clmdb "Flag für Löschung: Momentenbegrenzung begrenzt dauerhaft" UWORD B_TRUE 1 100 0 1 BIT_MASK 0x80 FUNCTION_LIST DFPM_MDKOG IF_DATA DIM_X 0x3838E4 EXTERN BYTE IF_DATA MCMESS 0x3838E4 EXTERN /end MEASUREMENT
/begin MEASUREMENT B_clmsg "Bedingung: Fehlerpfad Motorraumspülgebläse löschen" UWORD B_TRUE 1 100 0 1 BIT_MASK 0x80 FUNCTION_LIST DFPM_MLS IF_DATA DIM_X 0x3838E6 EXTERN BYTE IF_DATA MCMESS 0x3838E6 EXTERN /end MEASUREMENT
/begin MEASUREMENT B_clmsge "Bedingung: Fehlerpfad Endstufe Motorraumspülgebläse löschen" UWORD B_TRUE 1 100 0 1 BIT_MASK 0x80 FUNCTION_LIST DFPM_DEKON IF_DATA DIM_X 0x3838E8 EXTERN BYTE IF_DATA MCMESS 0x3838E8 EXTERN /end MEASUREMENT
/begin MEASUREMENT B_cln "Bedingung Fehlerpfad Drehzahlgeber löschen" UWORD B_TRUE 1 100 0 1 BIT_MASK 0x80 FUNCTION_LIST DFPM_DDG IF_DATA DIM_X 0x3838EA EXTERN BYTE IF_DATA MCMESS 0x3838EA EXTERN /end MEASUREMENT
/begin MEASUREMENT B_clnwkw "Bedingung Fehlerpfad Zuordnung Nockenwelle zu Kurbelwelle löschen" UWORD B_TRUE 1 100 0 1 BIT_MASK 0x80 FUNCTION_LIST DFPM_DNWKW IF_DATA DIM_X 0x3838EC EXTERN BYTE IF_DATA MCMESS 0x3838EC EXTERN /end MEASUREMENT
/begin MEASUREMENT B_clnwkw2 "Bedingung Fehlerpfad Zuordnung Nockenwelle 2 zu Kurbelwelle löschen" UWORD B_TRUE 1 100 0 1 BIT_MASK 0x80 FUNCTION_LIST DFPM_DNWKW IF_DATA DIM_X 0x3838EE EXTERN BYTE IF_DATA MCMESS 0x3838EE EXTERN /end MEASUREMENT
/begin MEASUREMENT B_clnws "Bedingung Fehlerpfad Nockenwellensteuerung löschen" UWORD B_TRUE 1 100 0 1 BIT_MASK 0x80 FUNCTION_LIST DFPM_DNWS IF_DATA DIM_X 0x3838F0 EXTERN BYTE IF_DATA MCMESS 0x3838F0 EXTERN /end MEASUREMENT
/begin MEASUREMENT B_clnws2 "Bedingung Fehlerphad Nockenwellensteuerung 2 löschen" UWORD B_TRUE 1 100 0 1 BIT_MASK 0x80 FUNCTION_LIST DFPM_DNWS IF_DATA DIM_X 0x3838F2 EXTERN BYTE IF_DATA MCMESS 0x3838F2 EXTERN /end MEASUREMENT
/begin MEASUREMENT B_clnwse "Bedingung Fehlerpfad Nockenwellensteuerung Endstufe löschen" UWORD B_TRUE 1 100 0 1 BIT_MASK 0x80 FUNCTION_LIST DFPM_DEKON IF_DATA DIM_X 0x3838F4 EXTERN BYTE IF_DATA MCMESS 0x3838F4 EXTERN /end MEASUREMENT
/begin MEASUREMENT B_clnwse2 "Bedingung Fehlerpfad Nockenwellensteuerung Bank2 Endstufe löschen" UWORD B_TRUE 1 100 0 1 BIT_MASK 0x80 FUNCTION_LIST DFPM_DEKON IF_DATA DIM_X 0x3838F6 EXTERN BYTE IF_DATA MCMESS 0x3838F6 EXTERN /end MEASUREMENT
/begin MEASUREMENT B_clph "Bedingung Fehlerpfad PH löschen" UWORD B_TRUE 1 100 0 1 BIT_MASK 0x80 FUNCTION_LIST DFPM_DPH IF_DATA DIM_X 0x3838F8 EXTERN BYTE IF_DATA MCMESS 0x3838F8 EXTERN /end MEASUREMENT
/begin MEASUREMENT B_clph2 "Bedingung Fehlerpfad Phasengeber 2 löschen" UWORD B_TRUE 1 100 0 1 BIT_MASK 0x80 FUNCTION_LIST DFPM_DPH IF_DATA DIM_X 0x3838FA EXTERN BYTE IF_DATA MCMESS 0x3838FA EXTERN /end MEASUREMENT
/begin MEASUREMENT B_clrkat "Bedingung Fehlerpfad RKAT löschen (add. pro Zeit)" UWORD B_TRUE 1 100 0 1 BIT_MASK 0x80 FUNCTION_LIST DFPM_DKVS IF_DATA DIM_X 0x3838FC EXTERN BYTE IF_DATA MCMESS 0x3838FC EXTERN /end MEASUREMENT
/begin MEASUREMENT B_clrkat2 "Bedingung Fehlerpfad RKAT2 löschen (Stereo)" UWORD B_TRUE 1 100 0 1 BIT_MASK 0x80 FUNCTION_LIST DFPM_DKVS IF_DATA DIM_X 0x3838FE EXTERN BYTE IF_DATA MCMESS 0x3838FE EXTERN /end MEASUREMENT
/begin MEASUREMENT B_clrkaz "Bedingung Fehlerpfad RKAZ löschen (add. pro Zündung)" UWORD B_TRUE 1 100 0 1 BIT_MASK 0x80 FUNCTION_LIST DFPM_DKVS IF_DATA DIM_X 0x383900 EXTERN BYTE IF_DATA MCMESS 0x383900 EXTERN /end MEASUREMENT
/begin MEASUREMENT B_clrkaz2 "Bedingung Fehlerpfad RKAZ2 löschen (Stereo)" UWORD B_TRUE 1 100 0 1 BIT_MASK 0x80 FUNCTION_LIST DFPM_DKVS IF_DATA DIM_X 0x383902 EXTERN BYTE IF_DATA MCMESS 0x383902 EXTERN /end MEASUREMENT
/begin MEASUREMENT B_clsgeep "" UWORD B_TRUE 1 100 0 1 BIT_MASK 0x80 FUNCTION_LIST DFPM_DSGEEP IF_DATA DIM_X 0x383904 EXTERN BYTE IF_DATA MCMESS 0x383904 EXTERN /end MEASUREMENT
/begin MEASUREMENT B_clslpe "Bedingung: Fehlerpfad Endstufe Sekundärluftpumpe löschen" UWORD B_TRUE 1 100 0 1 BIT_MASK 0x80 FUNCTION_LIST DFPM_DEKON IF_DATA DIM_X 0x383906 EXTERN BYTE IF_DATA MCMESS 0x383906 EXTERN /end MEASUREMENT
/begin MEASUREMENT B_clsls "Bedingung: Fehler Sekundärluftsystem löschen" UWORD B_TRUE 1 100 0 1 BIT_MASK 0x80 FUNCTION_LIST DFPM_DSLSLRS IF_DATA DIM_X 0x383908 EXTERN BYTE IF_DATA MCMESS 0x383908 EXTERN /end MEASUREMENT
/begin MEASUREMENT B_clsls2 "Bedingung: Fehler Sekundärluftsystem löschen (Bank 2)" UWORD B_TRUE 1 100 0 1 BIT_MASK 0x80 FUNCTION_LIST DFPM_DSLSLRS IF_DATA DIM_X 0x38390A EXTERN BYTE IF_DATA MCMESS 0x38390A EXTERN /end MEASUREMENT
/begin MEASUREMENT B_clslv "Bedingung: Fehler Sekundärluftventil löschen" UWORD B_TRUE 1 100 0 1 BIT_MASK 0x80 FUNCTION_LIST DFPM_DSLSLRS IF_DATA DIM_X 0x38390C EXTERN BYTE IF_DATA MCMESS 0x38390C EXTERN /end MEASUREMENT
/begin MEASUREMENT B_clslv2 "Bedingung: Fehler Sekundärluftventil löschen (Bank 2)" UWORD B_TRUE 1 100 0 1 BIT_MASK 0x80 FUNCTION_LIST DFPM_DSLSLRS IF_DATA DIM_X 0x38390E EXTERN BYTE IF_DATA MCMESS 0x38390E EXTERN /end MEASUREMENT
/begin MEASUREMENT B_clslve "Bedingung: Fehlerpfad Endstufe Sekundärluftventil löschen" UWORD B_TRUE 1 100 0 1 BIT_MASK 0x80 FUNCTION_LIST DFPM_DEKON IF_DATA DIM_X 0x383910 EXTERN BYTE IF_DATA MCMESS 0x383910 EXTERN /end MEASUREMENT
/begin MEASUREMENT B_clswe "Flag : Fehlerpfad Diagnose Beschleunigungssensor löschen" UWORD B_TRUE 1 100 0 1 BIT_MASK 0x80 FUNCTION_LIST DFPM_BGRBS IF_DATA DIM_X 0x383912 EXTERN BYTE IF_DATA MCMESS 0x383912 EXTERN /end MEASUREMENT
/begin MEASUREMENT B_clta "Bedingung Fehlerpfad Ansauglufttemperatur (/Ladeluft-) TANS löschen" UWORD B_TRUE 1 100 0 1 BIT_MASK 0x80 FUNCTION_LIST DFPM_GGTFA IF_DATA DIM_X 0x383914 EXTERN BYTE IF_DATA MCMESS 0x383914 EXTERN /end MEASUREMENT
/begin MEASUREMENT B_cltes "Bedingung Fehlerflag ""Tankentlüftungssystem offen"" löschen" UWORD B_TRUE 1 100 0 1 BIT_MASK 0x80 FUNCTION_LIST DFPM_DTEV IF_DATA DIM_X 0x383916 EXTERN BYTE IF_DATA MCMESS 0x383916 EXTERN /end MEASUREMENT
/begin MEASUREMENT B_clteve "Bedingung Fehlerphad TEVE löschen" UWORD B_TRUE 1 100 0 1 BIT_MASK 0x80 FUNCTION_LIST DFPM_DEKON IF_DATA DIM_X 0x383918 EXTERN BYTE IF_DATA MCMESS 0x383918 EXTERN /end MEASUREMENT
/begin MEASUREMENT B_cltget "Bedingung Fehlerpfad Getriebetemperatur TGET löschen" UWORD B_TRUE 1 100 0 1 BIT_MASK 0x80 FUNCTION_LIST DFPM_GGTGET IF_DATA DIM_X 0x38391C EXTERN BYTE IF_DATA MCMESS 0x38391C EXTERN /end MEASUREMENT
/begin MEASUREMENT B_clthm "Bedingung Fehlerpfad Kühlwasserthermostat löschen" UWORD B_TRUE 1 100 0 1 BIT_MASK 0x80 FUNCTION_LIST DFPM_GGTFM IF_DATA DIM_X 0x38391E EXTERN BYTE IF_DATA MCMESS 0x38391E EXTERN /end MEASUREMENT
/begin MEASUREMENT B_cltm "Bedingung Fehlerpfad Motortemperatur TMOT löschen" UWORD B_TRUE 1 100 0 1 BIT_MASK 0x80 FUNCTION_LIST DFPM_GGTFM IF_DATA DIM_X 0x383920 EXTERN BYTE IF_DATA MCMESS 0x383920 EXTERN /end MEASUREMENT
/begin MEASUREMENT B_cltmki "Bedingung: Fehler Motortemperatur aus Kombiinstrument löschen" UWORD B_TRUE 1 100 0 1 BIT_MASK 0x80 FUNCTION_LIST DFPM_DUMMY043 IF_DATA DIM_X 0x383922 EXTERN BYTE IF_DATA MCMESS 0x383922 EXTERN /end MEASUREMENT
/begin MEASUREMENT B_cltmr "Bedingung Fehlerpfad (Motor-)Oeltemperatur TOL löschen" UWORD B_TRUE 1 100 0 1 BIT_MASK 0x80 FUNCTION_LIST DFPM_GGTFMR IF_DATA DIM_X 0x383924 EXTERN BYTE IF_DATA MCMESS 0x383924 EXTERN /end MEASUREMENT
/begin MEASUREMENT B_cltol "Bedingung Fehlerpfad (Motor-)Oeltemperatur TOL löschen" UWORD B_TRUE 1 100 0 1 BIT_MASK 0x80 FUNCTION_LIST DFPM_GGTFOL IF_DATA DIM_X 0x383926 EXTERN BYTE IF_DATA MCMESS 0x383926 EXTERN /end MEASUREMENT
/begin MEASUREMENT B_cltum "Bedingung Fehlerpfad Umgebungstemperatur TUM  löschen" UWORD B_TRUE 1 100 0 1 BIT_MASK 0x80 FUNCTION_LIST DFPM_GGTFUMG IF_DATA DIM_X 0x383928 EXTERN BYTE IF_DATA MCMESS 0x383928 EXTERN /end MEASUREMENT
/begin MEASUREMENT B_club "Bedingung Fehlerpfad Batteriespannung (Bordnetz) löschen" UWORD B_TRUE 1 100 0 1 BIT_MASK 0x80 FUNCTION_LIST DFPM_GGUB IF_DATA DIM_X 0x38392A EXTERN BYTE IF_DATA MCMESS 0x38392A EXTERN /end MEASUREMENT
/begin MEASUREMENT B_clufmv "Flag für Löschung: Funktionsüberwachung: Momentenvergleich" UWORD B_TRUE 1 100 0 1 BIT_MASK 0x80 FUNCTION_LIST DFPM_DUF IF_DATA DIM_X 0x38392C EXTERN BYTE IF_DATA MCMESS 0x38392C EXTERN /end MEASUREMENT
/begin MEASUREMENT B_clufska "Flag für Löschung: Funktionsüberwachung: Sicherheits-Kraftstoff-Abschaltung" UWORD B_TRUE 1 100 0 1 BIT_MASK 0x80 FUNCTION_LIST DFPM_DUF IF_DATA DIM_X 0x38392E EXTERN BYTE IF_DATA MCMESS 0x38392E EXTERN /end MEASUREMENT
/begin MEASUREMENT B_clurram "Flag für Löschung: Rechnerüberwachung: RAM" UWORD B_TRUE 1 100 0 1 BIT_MASK 0x80 FUNCTION_LIST DFPM_DUR IF_DATA DIM_X 0x383930 EXTERN BYTE IF_DATA MCMESS 0x383930 EXTERN /end MEASUREMENT
/begin MEASUREMENT B_clurrom "Flag für Löschung: Rechnerüberwachung: ROM" UWORD B_TRUE 1 100 0 1 BIT_MASK 0x80 FUNCTION_LIST DFPM_DUR IF_DATA DIM_X 0x383932 EXTERN BYTE IF_DATA MCMESS 0x383932 EXTERN /end MEASUREMENT
/begin MEASUREMENT B_clurrst "Flag für Löschung: Rechnerüberwachung: Reset" UWORD B_TRUE 1 100 0 1 BIT_MASK 0x80 FUNCTION_LIST DFPM_DUR IF_DATA DIM_X 0x383934 EXTERN BYTE IF_DATA MCMESS 0x383934 EXTERN /end MEASUREMENT
/begin MEASUREMENT B_cluvse "Bedingung Fehlerpfad UVSE löschen" UWORD B_TRUE 1 100 0 1 BIT_MASK 0x80 FUNCTION_LIST DFPM_DEKON IF_DATA DIM_X 0x383936 EXTERN BYTE IF_DATA MCMESS 0x383936 EXTERN /end MEASUREMENT
/begin MEASUREMENT B_clvfz "Bedingung Fehlerpfad VFZ (Fahrzeuggeschwindigkeit) löschen" UWORD B_TRUE 1 100 0 1 BIT_MASK 0x80 FUNCTION_LIST DFPM_DVFZ IF_DATA DIM_X 0x383938 EXTERN BYTE IF_DATA MCMESS 0x383938 EXTERN /end MEASUREMENT
/begin MEASUREMENT B_clvs01 "" UWORD B_TRUE 1 100 0 1 BIT_MASK 0x80 FUNCTION_LIST DFPM_DVS IF_DATA DIM_X 0x38393A EXTERN BYTE IF_DATA MCMESS 0x38393A EXTERN /end MEASUREMENT
/begin MEASUREMENT B_clvs02 "" UWORD B_TRUE 1 100 0 1 BIT_MASK 0x80 FUNCTION_LIST DFPM_DVS IF_DATA DIM_X 0x38393C EXTERN BYTE IF_DATA MCMESS 0x38393C EXTERN /end MEASUREMENT
/begin MEASUREMENT B_clvs03 "" UWORD B_TRUE 1 100 0 1 BIT_MASK 0x80 FUNCTION_LIST DFPM_DVS IF_DATA DIM_X 0x38393E EXTERN BYTE IF_DATA MCMESS 0x38393E EXTERN /end MEASUREMENT
/begin MEASUREMENT B_clvs04 "" UWORD B_TRUE 1 100 0 1 BIT_MASK 0x80 FUNCTION_LIST DFPM_DVS IF_DATA DIM_X 0x383940 EXTERN BYTE IF_DATA MCMESS 0x383940 EXTERN /end MEASUREMENT
/begin MEASUREMENT B_clvs05 "" UWORD B_TRUE 1 100 0 1 BIT_MASK 0x80 FUNCTION_LIST DFPM_DVS IF_DATA DIM_X 0x383942 EXTERN BYTE IF_DATA MCMESS 0x383942 EXTERN /end MEASUREMENT
/begin MEASUREMENT B_clvs06 "" UWORD B_TRUE 1 100 0 1 BIT_MASK 0x80 FUNCTION_LIST DFPM_DVS IF_DATA DIM_X 0x383944 EXTERN BYTE IF_DATA MCMESS 0x383944 EXTERN /end MEASUREMENT
/begin MEASUREMENT B_clvs1e "Bedingung: Fehlerpfad Endstufe Ventilhubsteuerung 1 löschen" UWORD B_TRUE 1 100 0 1 BIT_MASK 0x80 FUNCTION_LIST DFPM_DEKON IF_DATA DIM_X 0x383946 EXTERN BYTE IF_DATA MCMESS 0x383946 EXTERN /end MEASUREMENT
/begin MEASUREMENT B_clvs2e "Bedingung: Fehlerpfad Endstufe Ventilhubsteuerung 2 löschen" UWORD B_TRUE 1 100 0 1 BIT_MASK 0x80 FUNCTION_LIST DFPM_DEKON IF_DATA DIM_X 0x383948 EXTERN BYTE IF_DATA MCMESS 0x383948 EXTERN /end MEASUREMENT
/begin MEASUREMENT B_clvsb1 "" UWORD B_TRUE 1 100 0 1 BIT_MASK 0x80 FUNCTION_LIST DFPM_DVS IF_DATA DIM_X 0x38394A EXTERN BYTE IF_DATA MCMESS 0x38394A EXTERN /end MEASUREMENT
/begin MEASUREMENT B_clvsb2 "" UWORD B_TRUE 1 100 0 1 BIT_MASK 0x80 FUNCTION_LIST DFPM_DVS IF_DATA DIM_X 0x38394C EXTERN BYTE IF_DATA MCMESS 0x38394C EXTERN /end MEASUREMENT
/begin MEASUREMENT B_clvss "Bedingung Fehlerpfad Ventilhubstuerung löschen" UWORD B_TRUE 1 100 0 1 BIT_MASK 0x80 FUNCTION_LIST DFPM_DVS IF_DATA DIM_X 0x38394E EXTERN BYTE IF_DATA MCMESS 0x38394E EXTERN /end MEASUREMENT
/begin MEASUREMENT B_clwfs "Bedingung Wegfahrsperre löschen" UWORD B_TRUE 1 100 0 1 BIT_MASK 0x80 FUNCTION_LIST DFPM_WFS IF_DATA DIM_X 0x383950 EXTERN BYTE IF_DATA MCMESS 0x383950 EXTERN /end MEASUREMENT
/begin MEASUREMENT B_cra "Bedingung: Crashsignal aktiv" UBYTE B_TRUE 1 100 0 1 BIT_MASK 0x1 FUNCTION_LIST GGAIRB IF_DATA DIM_X 0x380D21 EXTERN BYTE IF_DATA MCMESS 0x380D21 EXTERN /end MEASUREMENT
/begin MEASUREMENT B_craus "Ausgewertet durch LREB: Werkstattbit zum Stillegen LR" UWORD DEZ 1 100 0 1 BIT_MASK 0x200 FUNCTION_LIST SWADP LRSEB IF_DATA DIM_X 0xFD82 INTERN BYTE IF_DATA MCMESS 0xFD82 INTERN /end MEASUREMENT
/begin MEASUREMENT B_crerk "Bedingung: Tastverhältnis für Crash erkannt" UBYTE B_TRUE 1 100 0 1 BIT_MASK 0x2 FUNCTION_LIST GGAIRB IF_DATA DIM_X 0x380D21 EXTERN BYTE IF_DATA MCMESS 0x380D21 EXTERN /end MEASUREMENT
/begin MEASUREMENT B_crerr "Bedingung: Signalfehler wurde erkannt" UBYTE B_TRUE 1 100 0 1 BIT_MASK 0x4 FUNCTION_LIST GGAIRB IF_DATA DIM_X 0x380D21 EXTERN BYTE IF_DATA MCMESS 0x380D21 EXTERN /end MEASUREMENT
/begin MEASUREMENT B_crfr "Bedingung: Frequenz des PWM-Signal korrekt" UBYTE B_TRUE 1 100 0 1 BIT_MASK 0x8 FUNCTION_LIST GGAIRB IF_DATA DIM_X 0x380D21 EXTERN BYTE IF_DATA MCMESS 0x380D21 EXTERN /end MEASUREMENT
/begin MEASUREMENT B_crhl "Bedingung Signal lang genug mit richtiger Frequenz angelegen" UBYTE B_TRUE 1 100 0 1 BIT_MASK 0x10 FUNCTION_LIST GGAIRB IF_DATA DIM_X 0x380D21 EXTERN BYTE IF_DATA MCMESS 0x380D21 EXTERN /end MEASUREMENT
/begin MEASUREMENT B_crmes "Bedingung Start der Auswertung des PWM-Signales" UBYTE B_TRUE 1 100 0 1 BIT_MASK 0x20 FUNCTION_LIST GGAIRB IF_DATA DIM_X 0x380D21 EXTERN BYTE IF_DATA MCMESS 0x380D21 EXTERN /end MEASUREMENT
/begin MEASUREMENT B_crtv "Bedingung: Tastverhältnis des PWM-Signals korrekt" UBYTE B_TRUE 1 100 0 1 BIT_MASK 0x40 FUNCTION_LIST GGAIRB IF_DATA DIM_X 0x380D21 EXTERN BYTE IF_DATA MCMESS 0x380D21 EXTERN /end MEASUREMENT
/begin MEASUREMENT B_cvt "Bedingung continuously variable transmission" UWORD B_TRUE 1 100 0 1 BIT_MASK 0x1000 FUNCTION_LIST PROKON BBSAWE IF_DATA DIM_X 0xFD72 INTERN BYTE IF_DATA MCMESS 0xFD72 INTERN /end MEASUREMENT
/begin MEASUREMENT B_cwdslt "Bedingung: Freigabe Ventildichtheitsprüfung" UBYTE B_TRUE 1 100 0 1 BIT_MASK 0x1 FUNCTION_LIST DSLSLRS TC6MOD IF_DATA DIM_X 0x380900 EXTERN BYTE IF_DATA MCMESS 0x380900 EXTERN /end MEASUREMENT
/begin MEASUREMENT B_cwdslty "Bedingung rdy-Flag ohne Z_slp bei aktiver Prüfung" UWORD B_TRUE 1 100 0 1 BIT_MASK 0x1000 FUNCTION_LIST DSLSLRS IF_DATA DIM_X 0xFD00 INTERN BYTE IF_DATA MCMESS 0xFD00 INTERN /end MEASUREMENT
/begin MEASUREMENT B_cwdthm "Bedingung: Diagnose Thermostat Motor-Kühlmittel eingeschaltet" UBYTE B_TRUE 1 100 0 1 BIT_MASK 0x1 FUNCTION_LIST GGTFM TC6MOD IF_DATA DIM_X 0x380B54 EXTERN BYTE IF_DATA MCMESS 0x380B54 EXTERN /end MEASUREMENT
/begin MEASUREMENT B_cwesakt "Codewort CWESWEZ Bit 3 gesetzt" UWORD B_TRUE 1 100 0 1 BIT_MASK 0x8 FUNCTION_LIST ACIFI IF_DATA DIM_X 0xFD3E INTERN BYTE IF_DATA MCMESS 0xFD3E INTERN /end MEASUREMENT
/begin MEASUREMENT B_cwfgrla "Kodierung Fahrgeschwindigkeitsreglerlampe, Bit-Info" UWORD B_TRUE 1 100 0 1 BIT_MASK 0x800 FUNCTION_LIST DEKON2 IF_DATA DIM_X 0xFD42 INTERN BYTE IF_DATA MCMESS 0xFD42 INTERN /end MEASUREMENT
/begin MEASUREMENT B_cwkos "Kodierung Klimakompressor, Bit-Info" UWORD B_TRUE 1 100 0 1 BIT_MASK 0x1000 FUNCTION_LIST DEKON2 IF_DATA DIM_X 0xFD42 INTERN BYTE IF_DATA MCMESS 0xFD42 INTERN /end MEASUREMENT
/begin MEASUREMENT B_cwsla "Bedingung: Freigabe der Adaptionsphase/Zusatzdiagnose" UBYTE B_TRUE 1 100 0 1 BIT_MASK 0x1 FUNCTION_LIST DSLSLRS IF_DATA DIM_X 0x380902 EXTERN BYTE IF_DATA MCMESS 0x380902 EXTERN /end MEASUREMENT
/begin MEASUREMENT B_dash "Bedingung: Dashpot-Änderungsbegrenzung aktiv" UWORD B_TRUE 1 100 0 1 BIT_MASK 0x1000 FUNCTION_LIST MDFAW BBSAWE LLRBB MDAUTG MDKOG MDKOL RUNTIME IF_DATA DIM_X 0xFD6C INTERN BYTE IF_DATA MCMESS 0xFD6C INTERN /end MEASUREMENT
/begin MEASUREMENT B_dcdisfr "Bedingung: Disable DV-E-Endstufe durch den Funktionsrechner" UWORD B_TRUE 1 100 0 1 BIT_MASK 0x1 FUNCTION_LIST ADVE BGDVE VHW IF_DATA DIM_X 0xFD32 INTERN BYTE IF_DATA MCMESS 0xFD32 INTERN /end MEASUREMENT
/begin MEASUREMENT B_dcdisr "Bedingung: DV-E-Endstufenabschaltung wird angefordert" UWORD B_TRUE 1 100 0 1 BIT_MASK 0x200 FUNCTION_LIST BGDVE ADVE IF_DATA DIM_X 0xFD34 INTERN BYTE IF_DATA MCMESS 0xFD34 INTERN /end MEASUREMENT
/begin MEASUREMENT b_dcdis_c "Bedingung Fehlerreaktion der Funktionsüberwachung im anderen ME-SG" UBYTE B_TRUE 1 100 0 1 BIT_MASK 0x1 FUNCTION_LIST UFURAM IF_DATA DIM_X 0x382E44 EXTERN WORD IF_DATA MCMESS 0x382E44 EXTERN /end MEASUREMENT
/begin MEASUREMENT B_dcdis_um "Fehlerreaktions-Info der Funktionsüberwachung (Abschaltung der DK-Steller-ES)" UBYTE B_TRUE 1 100 0 1 BIT_MASK 0x1 FUNCTION_LIST UFURAM IF_DATA DIM_X 0x382E42 EXTERN WORD IF_DATA MCMESS 0x382E42 EXTERN /end MEASUREMENT
/begin MEASUREMENT B_dcy "Bedingung 'driving cycle' erkannt" UBYTE B_TRUE 1 100 0 1 BIT_MASK 0x1 FUNCTION_LIST DDCY IF_DATA DIM_X 0x3809D7 EXTERN BYTE IF_DATA MCMESS 0x3809D7 EXTERN /end MEASUREMENT
/begin MEASUREMENT B_ddylash "Bedingung Sonde hinter KAT dynamisch langsam" UWORD B_TRUE 1 100 0 1 BIT_MASK 0x1000 FUNCTION_LIST DLSAHK IF_DATA DIM_X 0xFD22 INTERN BYTE IF_DATA MCMESS 0xFD22 INTERN /end MEASUREMENT
/begin MEASUREMENT B_ddylash2 "Bedingung Sonde hinter KAT dynamisch langsam `dynamisch` Bank2" UWORD B_TRUE 1 100 0 1 BIT_MASK 0x2000 FUNCTION_LIST DLSAHK IF_DATA DIM_X 0xFD22 INTERN BYTE IF_DATA MCMESS 0xFD22 INTERN /end MEASUREMENT
/begin MEASUREMENT B_deckelof "Bedingung Motorraum- oder Kofferraumdeckel offen" UWORD B_TRUE 1 100 0 1 BIT_MASK 0x2000 FUNCTION_LIST CAN MLS IF_DATA DIM_X 0xFD06 INTERN BYTE IF_DATA MCMESS 0xFD06 INTERN /end MEASUREMENT
/begin MEASUREMENT B_decr "Bedingung Dekrementierung Startadaptionsfaktor" UWORD B_TRUE 1 100 0 1 BIT_MASK 0x40 FUNCTION_LIST STADAP IF_DATA DIM_X 0x382370 EXTERN BYTE IF_DATA MCMESS 0x382370 EXTERN /end MEASUREMENT
/begin MEASUREMENT B_delaysyn "Flag für eine Verzögerung um 1 Lücke zur Neusynchronisierung" UWORD B_TRUE 1 100 0 1 BIT_MASK 0x4000 FUNCTION_LIST NLPH IF_DATA DIM_X 0xFD18 INTERN BYTE IF_DATA MCMESS 0xFD18 INTERN /end MEASUREMENT
/begin MEASUREMENT B_desee "Diagnose Endstufe: Eingangsbedingungen erfüllt" UWORD B_TRUE 1 100 0 1 BIT_MASK 0x200 FUNCTION_LIST DECJ DEKPE DEVE DHLSHKE DKOSE DKWAVE DLDE DLDUVSE DMLSE DNWSE DSLPE DSLVE DTEVE DVSE IF_DATA DIM_X 0xFD42 INTERN BYTE IF_DATA MCMESS 0xFD42 INTERN /end MEASUREMENT
/begin MEASUREMENT B_dfrmoe "Bedingung Messung und Bewertung frm-Offset läuft (dfrmoff_w, B_dfrmoff)" UBYTE B_TRUE 1 100 0 1 BIT_MASK 0x1 FUNCTION_LIST DSLSLRS IF_DATA DIM_X 0x380908 EXTERN BYTE IF_DATA MCMESS 0x380908 EXTERN /end MEASUREMENT
/begin MEASUREMENT B_dfrmoe2 "Bedingung Messung und Bewertung frm-Offset läuft (dfrmoff_w, B_dfrmoff); Bank2)" UBYTE B_TRUE 1 100 0 1 BIT_MASK 0x2 FUNCTION_LIST DSLSLRS IF_DATA DIM_X 0x380907 EXTERN BYTE IF_DATA MCMESS 0x380907 EXTERN /end MEASUREMENT
/begin MEASUREMENT B_dfrmoff "frm-Offset-Schwelle überschritten: zeigt Vorsteuerproblem" UBYTE B_TRUE 1 100 0 1 BIT_MASK 0x80 FUNCTION_LIST DSLSLRS IF_DATA DIM_X 0x380904 EXTERN BYTE IF_DATA MCMESS 0x380904 EXTERN /end MEASUREMENT
/begin MEASUREMENT B_dfrmoff2 "frm-Offset-Schwelle überschritten: zeigt Vorsteuerproblem Bank 2" UBYTE B_TRUE 1 100 0 1 BIT_MASK 0x1 FUNCTION_LIST DSLSLRS IF_DATA DIM_X 0x380905 EXTERN BYTE IF_DATA MCMESS 0x380905 EXTERN /end MEASUREMENT
/begin MEASUREMENT B_dkaden "Bedingung: DK-Sollwert aus DK-Adaption und -Prüfung verwenden" UWORD B_TRUE 1 100 0 1 BIT_MASK 0x400 FUNCTION_LIST BGDVE ADVE DDVE IF_DATA DIM_X 0xFD34 INTERN BYTE IF_DATA MCMESS 0xFD34 INTERN /end MEASUREMENT
/begin MEASUREMENT B_dkbew "Bedingung: DK hat sich bewegt" UWORD B_TRUE 1 100 0 1 BIT_MASK 0x2 FUNCTION_LIST ADVE IF_DATA DIM_X 0xFD32 INTERN BYTE IF_DATA MCMESS 0xFD32 INTERN /end MEASUREMENT
/begin MEASUREMENT B_dkini "Bedingung für DKAT-Funktion initialisieren" UWORD B_TRUE 1 100 0 1 BIT_MASK 0x80 FUNCTION_LIST DKATLRS IF_DATA DIM_X 0xFD1E INTERN BYTE IF_DATA MCMESS 0xFD1E INTERN /end MEASUREMENT
/begin MEASUREMENT B_dkini2 "Bedingung für DKAT-Funktion initialisieren (Stereo 2.Bank)" UWORD B_TRUE 1 100 0 1 BIT_MASK 0x100 FUNCTION_LIST DKATLRS IF_DATA DIM_X 0xFD1E INTERN BYTE IF_DATA MCMESS 0xFD1E INTERN /end MEASUREMENT
/begin MEASUREMENT B_dklpi "interne Umschaltung d. Lambdregelungsparameter angefordert" UWORD B_TRUE 1 100 0 1 BIT_MASK 0x200 FUNCTION_LIST DKATLRS IF_DATA DIM_X 0xFD1E INTERN BYTE IF_DATA MCMESS 0xFD1E INTERN /end MEASUREMENT
/begin MEASUREMENT B_dklpi2 "interne Umschaltung d. Lambdregelungsparameter angefordert, Bank2" UWORD B_TRUE 1 100 0 1 BIT_MASK 0x400 FUNCTION_LIST DKATLRS IF_DATA DIM_X 0xFD1E INTERN BYTE IF_DATA MCMESS 0xFD1E INTERN /end MEASUREMENT
/begin MEASUREMENT B_dknach "Dauer-RAM, Bedingung: DK im Nachlauf stromlos und in NLP" UBYTE B_TRUE 1 100 0 1 BIT_MASK 0x10 FUNCTION_LIST BGDVE IF_DATA DIM_X 0x382FF7 EXTERN BYTE IF_DATA MCMESS 0x382FF7 EXTERN /end MEASUREMENT
/begin MEASUREMENT B_dknolu "Bedingung Drosselklappensteller stromlos" UWORD B_TRUE 1 100 0 1 BIT_MASK 0x800 FUNCTION_LIST SREAKT ADVE AEVABU BBFGR BBLDR BGDVE BGRLP DLLR FUEDKSA LLRNS MDRED1 NMAXMD NWS IF_DATA DIM_X 0xFD3C INTERN BYTE IF_DATA MCMESS 0xFD3C INTERN /end MEASUREMENT
/begin MEASUREMENT B_dknot "Bedingung DK-Poti-Notfahren aktiv" UWORD B_TRUE 1 100 0 1 BIT_MASK 0x1000 FUNCTION_LIST SREAKT ADVE BGDVE GGPED MDEX T2LID IF_DATA DIM_X 0xFD3C INTERN BYTE IF_DATA MCMESS 0xFD3C INTERN /end MEASUREMENT
/begin MEASUREMENT B_dkp1e "Bedingung Fehler DK-Poti 1" UWORD B_TRUE 1 100 0 1 BIT_MASK 0x40 FUNCTION_LIST GGDVE ADVE DDVE SREAKT T2LID IF_DATA DIM_X 0xFD38 INTERN BYTE IF_DATA MCMESS 0xFD38 INTERN /end MEASUREMENT
/begin MEASUREMENT B_dkp1ev "Bedingung Vorläufige Bereichsverletzung DK-Poti 1" UWORD B_TRUE 1 100 0 1 BIT_MASK 0x80 FUNCTION_LIST GGDVE IF_DATA DIM_X 0xFD38 INTERN BYTE IF_DATA MCMESS 0xFD38 INTERN /end MEASUREMENT
/begin MEASUREMENT B_dkp1mn "Bedingung Bereichsverletzung DK-Poti 1 nach unten" UWORD B_TRUE 1 100 0 1 BIT_MASK 0x100 FUNCTION_LIST GGDVE DDVE IF_DATA DIM_X 0xFD38 INTERN BYTE IF_DATA MCMESS 0xFD38 INTERN /end MEASUREMENT
/begin MEASUREMENT B_dkp1mx "Bedingung Bereichsverletzung DK-Poti 1 nach oben" UWORD B_TRUE 1 100 0 1 BIT_MASK 0x200 FUNCTION_LIST GGDVE DDVE IF_DATA DIM_X 0xFD38 INTERN BYTE IF_DATA MCMESS 0xFD38 INTERN /end MEASUREMENT
/begin MEASUREMENT B_dkp1np "Bedingung DK-Poti 1 unplausibel zu Ersatzwert aus Füllung" UWORD B_TRUE 1 100 0 1 BIT_MASK 0x400 FUNCTION_LIST GGDVE DDVE IF_DATA DIM_X 0xFD38 INTERN BYTE IF_DATA MCMESS 0xFD38 INTERN /end MEASUREMENT
/begin MEASUREMENT B_dkp2e "Bedingung Fehler DK-Poti 2" UWORD B_TRUE 1 100 0 1 BIT_MASK 0x800 FUNCTION_LIST GGDVE ADVE DDVE SREAKT T2LID IF_DATA DIM_X 0xFD38 INTERN BYTE IF_DATA MCMESS 0xFD38 INTERN /end MEASUREMENT
/begin MEASUREMENT B_dkp2ev "Bedingung Vorläufige Bereichsverletzung DK-Poti 2" UWORD B_TRUE 1 100 0 1 BIT_MASK 0x1000 FUNCTION_LIST GGDVE IF_DATA DIM_X 0xFD38 INTERN BYTE IF_DATA MCMESS 0xFD38 INTERN /end MEASUREMENT
/begin MEASUREMENT B_dkp2mn "Bedingung Bereichsverletzung DK-Poti 2 nach unten" UWORD B_TRUE 1 100 0 1 BIT_MASK 0x2000 FUNCTION_LIST GGDVE DDVE IF_DATA DIM_X 0xFD38 INTERN BYTE IF_DATA MCMESS 0xFD38 INTERN /end MEASUREMENT
/begin MEASUREMENT B_dkp2mx "Bedingung Bereichsverletzung DK-Poti 2 nach oben" UWORD B_TRUE 1 100 0 1 BIT_MASK 0x4000 FUNCTION_LIST GGDVE DDVE IF_DATA DIM_X 0xFD38 INTERN BYTE IF_DATA MCMESS 0xFD38 INTERN /end MEASUREMENT
/begin MEASUREMENT B_dkp2np "Bedingung DK-Poti 2 unplausibel zu Ersatzwert aus Füllung" UWORD B_TRUE 1 100 0 1 BIT_MASK 0x8000 FUNCTION_LIST GGDVE DDVE IF_DATA DIM_X 0xFD38 INTERN BYTE IF_DATA MCMESS 0xFD38 INTERN /end MEASUREMENT
/begin MEASUREMENT B_dkpaw "Bedingung DK-Poti-Auswahl für DK-Sensor-Ersatzbetrieb" UWORD B_TRUE 1 100 0 1 BIT_MASK 0x1 FUNCTION_LIST GGDVE SREAKT IF_DATA DIM_X 0xFD3A INTERN BYTE IF_DATA MCMESS 0xFD3A INTERN /end MEASUREMENT
/begin MEASUREMENT B_dkpiu "Bedingung: irreversible SKA" UWORD B_TRUE 1 100 0 1 BIT_MASK 0x2000 FUNCTION_LIST SREAKT ADVE BGDVE FUEDKSA IF_DATA DIM_X 0xFD3C INTERN BYTE IF_DATA MCMESS 0xFD3C INTERN /end MEASUREMENT
/begin MEASUREMENT B_dkpru "Bedingung: reversible SKA" UWORD B_TRUE 1 100 0 1 BIT_MASK 0x4000 FUNCTION_LIST SREAKT IF_DATA DIM_X 0xFD3C INTERN BYTE IF_DATA MCMESS 0xFD3C INTERN /end MEASUREMENT
/begin MEASUREMENT B_dkpu "Bedingung Sicherheitskraftstoffabschaltung (SKA)" UWORD B_TRUE 1 100 0 1 BIT_MASK 0x8000 FUNCTION_LIST SREAKT AEVABU BBFGR BBLDR DLLR DMDSTP GGDVE LLRNS MDRED1 NMAXMD NWS IF_DATA DIM_X 0xFD3C INTERN BYTE IF_DATA MCMESS 0xFD3C INTERN /end MEASUREMENT
/begin MEASUREMENT B_dksbeg "Bedingung DK-Sollwertbegrenzung" UWORD B_TRUE 1 100 0 1 BIT_MASK 0x2 FUNCTION_LIST GGDVE BBFGR FUEDKSA IF_DATA DIM_X 0xFD3A INTERN BYTE IF_DATA MCMESS 0xFD3A INTERN /end MEASUREMENT
/begin MEASUREMENT B_dktakt "DKAT-Funktion aktiv" UWORD B_TRUE 1 100 0 1 BIT_MASK 0x800 FUNCTION_LIST DKATLRS IF_DATA DIM_X 0xFD1E INTERN BYTE IF_DATA MCMESS 0xFD1E INTERN /end MEASUREMENT
/begin MEASUREMENT B_dktakt2 "DKAT-Funktion aktiv (Bank2)" UWORD B_TRUE 1 100 0 1 BIT_MASK 0x1000 FUNCTION_LIST DKATLRS IF_DATA DIM_X 0xFD1E INTERN BYTE IF_DATA MCMESS 0xFD1E INTERN /end MEASUREMENT
/begin MEASUREMENT B_dkten "DKAT für diesen Trip nicht mehr aktiv" UWORD B_TRUE 1 100 0 1 BIT_MASK 0x2000 FUNCTION_LIST DKATLRS IF_DATA DIM_X 0xFD1E INTERN BYTE IF_DATA MCMESS 0xFD1E INTERN /end MEASUREMENT
/begin MEASUREMENT B_dkten2 "DKAT für diesen Trip nicht mehr aktiv (Bank2)" UWORD B_TRUE 1 100 0 1 BIT_MASK 0x4000 FUNCTION_LIST DKATLRS IF_DATA DIM_X 0xFD1E INTERN BYTE IF_DATA MCMESS 0xFD1E INTERN /end MEASUREMENT
/begin MEASUREMENT B_dktlp "Umschaltung der Lambdaregelungsparameter angefordert" UWORD B_TRUE 1 100 0 1 BIT_MASK 0x8000 FUNCTION_LIST DKATLRS DLSU ESUKAS LRS T2DFA IF_DATA DIM_X 0xFD1E INTERN BYTE IF_DATA MCMESS 0xFD1E INTERN /end MEASUREMENT
/begin MEASUREMENT B_dktnr "DKAT: n/rl-Bereich verlassen" UWORD B_TRUE 1 100 0 1 BIT_MASK 0x1 FUNCTION_LIST DKATLRS IF_DATA DIM_X 0xFD20 INTERN BYTE IF_DATA MCMESS 0xFD20 INTERN /end MEASUREMENT
/begin MEASUREMENT B_dktnr2 "DKAT: n/rl-Bereich verlassen, Bank2" UWORD B_TRUE 1 100 0 1 BIT_MASK 0x2 FUNCTION_LIST DKATLRS IF_DATA DIM_X 0xFD20 INTERN BYTE IF_DATA MCMESS 0xFD20 INTERN /end MEASUREMENT
/begin MEASUREMENT B_dktpb "DKAT Prüfung beendet" UWORD B_TRUE 1 100 0 1 BIT_MASK 0x4 FUNCTION_LIST DKATLRS IF_DATA DIM_X 0xFD20 INTERN BYTE IF_DATA MCMESS 0xFD20 INTERN /end MEASUREMENT
/begin MEASUREMENT B_dktpb2 "DKAT Prüfung beendet, Bank2" UWORD B_TRUE 1 100 0 1 BIT_MASK 0x8 FUNCTION_LIST DKATLRS IF_DATA DIM_X 0xFD20 INTERN BYTE IF_DATA MCMESS 0xFD20 INTERN /end MEASUREMENT
/begin MEASUREMENT B_dktsb "Bankspezifische Stoppbedingung" UWORD B_TRUE 1 100 0 1 BIT_MASK 0x10 FUNCTION_LIST DKATLRS IF_DATA DIM_X 0xFD20 INTERN BYTE IF_DATA MCMESS 0xFD20 INTERN /end MEASUREMENT
/begin MEASUREMENT B_dktsb2 "Bankspezifische Stoppbedingung (Stereo 2.Bank)" UWORD B_TRUE 1 100 0 1 BIT_MASK 0x20 FUNCTION_LIST DKATLRS IF_DATA DIM_X 0xFD20 INTERN BYTE IF_DATA MCMESS 0xFD20 INTERN /end MEASUREMENT
/begin MEASUREMENT B_dktsp "physikalische Stoppbedingung" UWORD B_TRUE 1 100 0 1 BIT_MASK 0x40 FUNCTION_LIST DKATLRS IF_DATA DIM_X 0xFD20 INTERN BYTE IF_DATA MCMESS 0xFD20 INTERN /end MEASUREMENT
/begin MEASUREMENT B_dktsp2 "physikalische Stoppbedingung (Stereo 2.Bank)" UWORD B_TRUE 1 100 0 1 BIT_MASK 0x80 FUNCTION_LIST DKATLRS IF_DATA DIM_X 0xFD20 INTERN BYTE IF_DATA MCMESS 0xFD20 INTERN /end MEASUREMENT
/begin MEASUREMENT B_dktst "DKAT-Funktion ist gestoppt (B_dktst=FALSE)" UWORD B_TRUE 1 100 0 1 BIT_MASK 0x100 FUNCTION_LIST DKATLRS T2DFA IF_DATA DIM_X 0xFD20 INTERN BYTE IF_DATA MCMESS 0xFD20 INTERN /end MEASUREMENT
/begin MEASUREMENT B_dktst2 "DKAT-Funktion ist gestoppt (B_dktst=FALSE, Stereo 2.Bank)" UWORD B_TRUE 1 100 0 1 BIT_MASK 0x200 FUNCTION_LIST DKATLRS T2DFA IF_DATA DIM_X 0xFD20 INTERN BYTE IF_DATA MCMESS 0xFD20 INTERN /end MEASUREMENT
/begin MEASUREMENT B_dktt "DKAT-Aktiv-Zeit abgelaufen" UWORD B_TRUE 1 100 0 1 BIT_MASK 0x400 FUNCTION_LIST DKATLRS IF_DATA DIM_X 0xFD20 INTERN BYTE IF_DATA MCMESS 0xFD20 INTERN /end MEASUREMENT
/begin MEASUREMENT B_dktt2 "DKAT-Aktiv-Zeit abgelaufen, Bank2" UWORD B_TRUE 1 100 0 1 BIT_MASK 0x800 FUNCTION_LIST DKATLRS IF_DATA DIM_X 0xFD20 INTERN BYTE IF_DATA MCMESS 0xFD20 INTERN /end MEASUREMENT
/begin MEASUREMENT B_dkttk "Katdiagnose temperaturbedingt gesperrt (Kat-Temperatur)" UWORD B_TRUE 1 100 0 1 BIT_MASK 0x1000 FUNCTION_LIST DKATLRS IF_DATA DIM_X 0xFD20 INTERN BYTE IF_DATA MCMESS 0xFD20 INTERN /end MEASUREMENT
/begin MEASUREMENT B_dkttk2 "Katdiagnose temperaturbedingt gesperrt (Kat-Temperatur)" UWORD B_TRUE 1 100 0 1 BIT_MASK 0x2000 FUNCTION_LIST DKATLRS IF_DATA DIM_X 0xFD20 INTERN BYTE IF_DATA MCMESS 0xFD20 INTERN /end MEASUREMENT
/begin MEASUREMENT B_dkuevab "Bedingung Ev-Abschaltung bei unplausibler DK" UWORD B_TRUE 1 100 0 1 BIT_MASK 0x800 FUNCTION_LIST AEVABU AEVAB IF_DATA DIM_X 0xFD4C INTERN BYTE IF_DATA MCMESS 0xFD4C INTERN /end MEASUREMENT
/begin MEASUREMENT B_dkunb "Bedingung: Drosselklappenposition unbekannt" UWORD B_TRUE 1 100 0 1 BIT_MASK 0x1 FUNCTION_LIST SREAKT T2LID IF_DATA DIM_X 0xFD3E INTERN BYTE IF_DATA MCMESS 0xFD3E INTERN /end MEASUREMENT
/begin MEASUREMENT B_dkvsf "Bedingung: Freigabe des Fehlers" UWORD B_TRUE 1 100 0 1 BIT_MASK 0x8 FUNCTION_LIST DKVS IF_DATA DIM_X 0xFD50 INTERN BYTE IF_DATA MCMESS 0xFD50 INTERN /end MEASUREMENT
/begin MEASUREMENT B_dkvsfm "Bedingung: Freigabe des Fehlers (Flipflop Ausgang)" UBYTE B_TRUE 1 100 0 1 BIT_MASK 0x1 FUNCTION_LIST DKVS IF_DATA DIM_X 0x383001 EXTERN BYTE IF_DATA MCMESS 0x383001 EXTERN /end MEASUREMENT
/begin MEASUREMENT B_dkvstr "Bedingung: Integrator bei Tankleer zurücksetzen" UWORD B_TRUE 1 100 0 1 BIT_MASK 0x10 FUNCTION_LIST DKVS IF_DATA DIM_X 0xFD50 INTERN BYTE IF_DATA MCMESS 0xFD50 INTERN /end MEASUREMENT
/begin MEASUREMENT B_dlahini "Bedingung Intiliasierung Integralanteil LRSHK" UWORD B_TRUE 1 100 0 1 BIT_MASK 0x100 FUNCTION_LIST LRSHK IF_DATA DIM_X 0xFD7E INTERN BYTE IF_DATA MCMESS 0xFD7E INTERN /end MEASUREMENT
/begin MEASUREMENT B_dlahini2 "Bedingung Intiliasierung Integralanteil LRSHK, Bank2" UWORD B_TRUE 1 100 0 1 BIT_MASK 0x200 FUNCTION_LIST LRSHK IF_DATA DIM_X 0xFD7E INTERN BYTE IF_DATA MCMESS 0xFD7E INTERN /end MEASUREMENT
/begin MEASUREMENT B_dlash "Aktive Diagnose:	Lambda-Sondenalterung hinter Kat." UWORD B_TRUE 1 100 0 1 BIT_MASK 0x4000 FUNCTION_LIST DLSAHK T2DFA IF_DATA DIM_X 0xFD22 INTERN BYTE IF_DATA MCMESS 0xFD22 INTERN /end MEASUREMENT
/begin MEASUREMENT B_dlash2 "Aktive Diagnose:	Lambda-Sondenalterung hinter Kat. (Bank 2)" UWORD B_TRUE 1 100 0 1 BIT_MASK 0x8000 FUNCTION_LIST DLSAHK T2DFA IF_DATA DIM_X 0xFD22 INTERN BYTE IF_DATA MCMESS 0xFD22 INTERN /end MEASUREMENT
/begin MEASUREMENT B_dldpte "Anforderung TEV schließen aus Tankentlüftungsdiagnose" UWORD B_TRUE 1 100 0 1 BIT_MASK 0x400 FUNCTION_LIST SWADP BBTEGA DTEV TEBEB IF_DATA DIM_X 0xFD82 INTERN BYTE IF_DATA MCMESS 0xFD82 INTERN /end MEASUREMENT
/begin MEASUREMENT B_dllr "Aktive diagnose: Leerlaufstellerdiagnose" UWORD B_TRUE 1 100 0 1 BIT_MASK 0x10 FUNCTION_LIST DLLR LLRRM IF_DATA DIM_X 0xFD68 INTERN BYTE IF_DATA MCMESS 0xFD68 INTERN /end MEASUREMENT
/begin MEASUREMENT B_dllra "Bedingung DLLR Anforderung" UWORD B_TRUE 1 100 0 1 BIT_MASK 0x20 FUNCTION_LIST DLLR DTEV T2DFA TEBEB IF_DATA DIM_X 0xFD68 INTERN BYTE IF_DATA MCMESS 0xFD68 INTERN /end MEASUREMENT
/begin MEASUREMENT B_dlrbe "Bedingung: DLR-Stellbereich wurde überschritten" UWORD B_TRUE 1 100 0 1 BIT_MASK 0x4 FUNCTION_LIST ADVE DDVE SREAKT IF_DATA DIM_X 0xFD32 INTERN BYTE IF_DATA MCMESS 0xFD32 INTERN /end MEASUREMENT
/begin MEASUREMENT B_dlrien "Bedingung: keine temp. Begrenzung des I-Anteils im DLR durchführen" UWORD B_TRUE 1 100 0 1 BIT_MASK 0x800 FUNCTION_LIST BGDVE ADVE IF_DATA DIM_X 0xFD34 INTERN BYTE IF_DATA MCMESS 0xFD34 INTERN /end MEASUREMENT
/begin MEASUREMENT B_dlrikla "Bedingung: DLR, I-Klein aktiv" UWORD B_TRUE 1 100 0 1 BIT_MASK 0x8 FUNCTION_LIST ADVE IF_DATA DIM_X 0xFD32 INTERN BYTE IF_DATA MCMESS 0xFD32 INTERN /end MEASUREMENT
/begin MEASUREMENT B_dlriklst "Bedingung: Erster Durchlauf I-Klein nach Start" UWORD B_TRUE 1 100 0 1 BIT_MASK 0x10 FUNCTION_LIST ADVE IF_DATA DIM_X 0xFD32 INTERN BYTE IF_DATA MCMESS 0xFD32 INTERN /end MEASUREMENT
/begin MEASUREMENT B_dlrparc "Bedingung: Sollgrößensprung steht an" UWORD B_TRUE 1 100 0 1 BIT_MASK 0x20 FUNCTION_LIST ADVE IF_DATA DIM_X 0xFD32 INTERN BYTE IF_DATA MCMESS 0xFD32 INTERN /end MEASUREMENT
/begin MEASUREMENT B_dlrpide "Bedingung: Fehler, DLR-Stellbereich am Anschlag" UWORD B_TRUE 1 100 0 1 BIT_MASK 0x40 FUNCTION_LIST ADVE DDVE SREAKT IF_DATA DIM_X 0xFD32 INTERN BYTE IF_DATA MCMESS 0xFD32 INTERN /end MEASUREMENT
/begin MEASUREMENT B_dlrspid "Bedingung: DLR, Vorzeichen der Summe der PID-Anteile, =1: positiv, =0: negativ" UWORD B_TRUE 1 100 0 1 BIT_MASK 0x80 FUNCTION_LIST ADVE BGDVE IF_DATA DIM_X 0xFD32 INTERN BYTE IF_DATA MCMESS 0xFD32 INTERN /end MEASUREMENT
/begin MEASUREMENT B_dlrumzu "Bedingung: NLP-Umladen zugelassen" UWORD B_TRUE 1 100 0 1 BIT_MASK 0x100 FUNCTION_LIST ADVE IF_DATA DIM_X 0xFD32 INTERN BYTE IF_DATA MCMESS 0xFD32 INTERN /end MEASUREMENT
/begin MEASUREMENT B_dluerk_m "Monitor, Aussetzer erkannt in DMDDLU" UBYTE B_TRUE 1 100 0 1 BIT_MASK 0x1 FUNCTION_LIST DMDDLU NLPH IF_DATA DIM_X 0xE3F0 INTERN WORD IF_DATA MCMESS 0xE3F0 INTERN /end MEASUREMENT
/begin MEASUREMENT B_dmd_reset "" UWORD B_TRUE 1 100 0 1 BIT_MASK 0x10 FUNCTION_LIST DMDFON IF_DATA DIM_X 0xFD98 INTERN WORD IF_DATA MCMESS 0xFD98 INTERN /end MEASUREMENT
/begin MEASUREMENT B_dmtltz "Bedingung TEV soll geschlossen werden" UWORD B_TRUE 1 100 0 1 BIT_MASK 0x800 FUNCTION_LIST SWADP BBTEGA DTEV IF_DATA DIM_X 0xFD82 INTERN BYTE IF_DATA MCMESS 0xFD82 INTERN /end MEASUREMENT
/begin MEASUREMENT B_dnsll "Bedingung SA-Drehzahl-Hysterese DNSLL" UBYTE B_TRUE 1 100 0 1 BIT_MASK 0x1 FUNCTION_LIST BBSAWE IF_DATA DIM_X 0x380BFF EXTERN BYTE IF_DATA MCMESS 0x380BFF EXTERN /end MEASUREMENT
/begin MEASUREMENT B_dnt "Aktive Diagnose: Klopfregelung Nulltest" UWORD B_TRUE 1 100 0 1 BIT_MASK 0x4000 FUNCTION_LIST GGKS DKRNT KRKE IF_DATA DIM_X 0xFD60 INTERN BYTE IF_DATA MCMESS 0xFD60 INTERN /end MEASUREMENT
/begin MEASUREMENT B_dntb "Bedingung Diagnose: Bereitschaft zum Nulltest (Nulltest im nächsten MF)" UWORD B_TRUE 1 100 0 1 BIT_MASK 0x8000 FUNCTION_LIST GGKS KRKE IF_DATA DIM_X 0xFD60 INTERN BYTE IF_DATA MCMESS 0xFD60 INTERN /end MEASUREMENT
/begin MEASUREMENT B_dnws "Aktive Diagnose: Nockenwellensteuerung" UWORD B_TRUE 1 100 0 1 BIT_MASK 0x2 FUNCTION_LIST DNWS IF_DATA DIM_X 0xFD4A INTERN BYTE IF_DATA MCMESS 0xFD4A INTERN /end MEASUREMENT
/begin MEASUREMENT B_dopzue "Bedingung doppelte Zündausgabe" UWORD B_TRUE 1 100 0 1 BIT_MASK 0x8000 FUNCTION_LIST NLPH AZUE DKRS NMAXMD IF_DATA DIM_X 0xFD18 INTERN BYTE IF_DATA MCMESS 0xFD18 INTERN /end MEASUREMENT
/begin MEASUREMENT B_dopzue_i "Bedingung doppelte Zündausgabe : interner puffer" UWORD B_TRUE 1 100 0 1 BIT_MASK 0x2 FUNCTION_LIST AZUE IF_DATA DIM_X 0xFD00 INTERN BYTE IF_DATA MCMESS 0xFD00 INTERN /end MEASUREMENT
/begin MEASUREMENT B_dp "Bedingung: Dashpotwert größer Fahrerwunsch (=1)" UBYTE B_TRUE 1 100 0 1 BIT_MASK 0x8 FUNCTION_LIST MDFAW IF_DATA DIM_X 0x380C37 EXTERN BYTE IF_DATA MCMESS 0x380C37 EXTERN /end MEASUREMENT
/begin MEASUREMENT B_drlkrdy "Flag für n > NKRUM" UWORD B_TRUE 1 100 0 1 BIT_MASK 0x20 FUNCTION_LIST KRDY IF_DATA DIM_X 0xFD62 INTERN BYTE IF_DATA MCMESS 0xFD62 INTERN /end MEASUREMENT
/begin MEASUREMENT B_drlmx "Laständerung unterhalb Schwellwert" UWORD B_TRUE 1 100 0 1 BIT_MASK 0x4 FUNCTION_LIST DLSU IF_DATA DIM_X 0xFD2A INTERN BYTE IF_DATA MCMESS 0xFD2A INTERN /end MEASUREMENT
/begin MEASUREMENT B_ds "KR: Sensordiagnose aktiv" UWORD B_TRUE 1 100 0 1 BIT_MASK 0x20 FUNCTION_LIST DKRS IF_DATA DIM_X 0xFD60 INTERN BYTE IF_DATA MCMESS 0xFD60 INTERN /end MEASUREMENT
/begin MEASUREMENT B_dshen "Bedingung Freigabe Sondendiagnose hinter KAT" UWORD B_TRUE 1 100 0 1 BIT_MASK 0x80 FUNCTION_LIST DLSH T2DFA IF_DATA DIM_X 0xFD28 INTERN BYTE IF_DATA MCMESS 0xFD28 INTERN /end MEASUREMENT
/begin MEASUREMENT B_dshen2 "Bedingung Freigabe Sondendiagnose hinter KAT Bank2" UWORD B_TRUE 1 100 0 1 BIT_MASK 0x100 FUNCTION_LIST DLSH T2DFA IF_DATA DIM_X 0xFD28 INTERN BYTE IF_DATA MCMESS 0xFD28 INTERN /end MEASUREMENT
/begin MEASUREMENT B_dshk "Bedingung Diagnosefunktion in %DLSH und %DHLS mit i.O.-Meldung h. KAT beendet." UWORD B_TRUE 1 100 0 1 BIT_MASK 0x1 FUNCTION_LIST DLSAHK IF_DATA DIM_X 0xFD24 INTERN BYTE IF_DATA MCMESS 0xFD24 INTERN /end MEASUREMENT
/begin MEASUREMENT B_dshk2 "Bed. Diagnosefunktion in %DLSH u.%DHLS mit i.O.-Meldung h. KAT beendet. Bank2" UWORD B_TRUE 1 100 0 1 BIT_MASK 0x2 FUNCTION_LIST DLSAHK IF_DATA DIM_X 0xFD24 INTERN BYTE IF_DATA MCMESS 0xFD24 INTERN /end MEASUREMENT
/begin MEASUREMENT B_dsl "Bedingung Diagnoseanforderung" UBYTE B_TRUE 1 100 0 1 BIT_MASK 0x20 FUNCTION_LIST DSLSLRS IF_DATA DIM_X 0x380901 EXTERN BYTE IF_DATA MCMESS 0x380901 EXTERN /end MEASUREMENT
/begin MEASUREMENT B_dsl1 "Diagnose Phase 1: Bestimmung Sekundärluftmasse" UWORD B_TRUE 1 100 0 1 BIT_MASK 0x2000 FUNCTION_LIST DSLSLRS IF_DATA DIM_X 0xFD00 INTERN BYTE IF_DATA MCMESS 0xFD00 INTERN /end MEASUREMENT
/begin MEASUREMENT B_dsl1ab "Diagnose Phase 1: Abbruch Phase 1" UBYTE B_TRUE 1 100 0 1 BIT_MASK 0x20 FUNCTION_LIST DSLSLRS IF_DATA DIM_X 0x380902 EXTERN BYTE IF_DATA MCMESS 0x380902 EXTERN /end MEASUREMENT
/begin MEASUREMENT B_dsl1e "Diagnose Phase 1, Meßfreigabe Sekundärluftmasse" UBYTE B_TRUE 1 100 0 1 BIT_MASK 0x40 FUNCTION_LIST DSLSLRS IF_DATA DIM_X 0x380902 EXTERN BYTE IF_DATA MCMESS 0x380902 EXTERN /end MEASUREMENT
/begin MEASUREMENT B_dsl2 "Diagnose Phase 2: Ventildichtheit" UBYTE B_TRUE 1 100 0 1 BIT_MASK 0x80 FUNCTION_LIST DSLSLRS IF_DATA DIM_X 0x380902 EXTERN BYTE IF_DATA MCMESS 0x380902 EXTERN /end MEASUREMENT
/begin MEASUREMENT B_dsl2ab "Diagnose Phase 2: Abbruch Phase 2" UBYTE B_TRUE 1 100 0 1 BIT_MASK 0x1 FUNCTION_LIST DSLSLRS IF_DATA DIM_X 0x380903 EXTERN BYTE IF_DATA MCMESS 0x380903 EXTERN /end MEASUREMENT
/begin MEASUREMENT B_dsl2e "Diagnose Phase 2: Freigabe Messung" UBYTE B_TRUE 1 100 0 1 BIT_MASK 0x2 FUNCTION_LIST DSLSLRS IF_DATA DIM_X 0x380903 EXTERN BYTE IF_DATA MCMESS 0x380903 EXTERN /end MEASUREMENT
/begin MEASUREMENT B_dsl3 "Diagnose Phase3: Offset Sekundärluftmasse" UBYTE B_TRUE 1 100 0 1 BIT_MASK 0x4 FUNCTION_LIST DSLSLRS IF_DATA DIM_X 0x380903 EXTERN BYTE IF_DATA MCMESS 0x380903 EXTERN /end MEASUREMENT
/begin MEASUREMENT B_dsl3ab "Diagnose Phase 3: Abbruch" UBYTE B_TRUE 1 100 0 1 BIT_MASK 0x8 FUNCTION_LIST DSLSLRS IF_DATA DIM_X 0x380903 EXTERN BYTE IF_DATA MCMESS 0x380903 EXTERN /end MEASUREMENT
/begin MEASUREMENT B_dsl3e "Diagnose Phase 3: Freigabe Messung" UBYTE B_TRUE 1 100 0 1 BIT_MASK 0x10 FUNCTION_LIST DSLSLRS IF_DATA DIM_X 0x380903 EXTERN BYTE IF_DATA MCMESS 0x380903 EXTERN /end MEASUREMENT
/begin MEASUREMENT B_dsl4 "Bedingung Phase 4: Sekundärluftmasse aus Adaption/Zusatzdiagnose" UWORD B_TRUE 1 100 0 1 BIT_MASK 0x4000 FUNCTION_LIST DSLSLRS IF_DATA DIM_X 0xFD00 INTERN BYTE IF_DATA MCMESS 0xFD00 INTERN /end MEASUREMENT
/begin MEASUREMENT B_dsl45 "Diagnose Phase 4 oder Phase 5 aktiv" UBYTE B_TRUE 1 100 0 1 BIT_MASK 0x4 FUNCTION_LIST DSLSLRS IF_DATA DIM_X 0x380905 EXTERN BYTE IF_DATA MCMESS 0x380905 EXTERN /end MEASUREMENT
/begin MEASUREMENT B_dsl4ab "Bedingung: Abbruch Phase 4" UBYTE B_TRUE 1 100 0 1 BIT_MASK 0x80 FUNCTION_LIST DSLSLRS IF_DATA DIM_X 0x380903 EXTERN BYTE IF_DATA MCMESS 0x380903 EXTERN /end MEASUREMENT
/begin MEASUREMENT B_dsl4e "Bedingung: Phase 4 Freigabe Messung" UBYTE B_TRUE 1 100 0 1 BIT_MASK 0x1 FUNCTION_LIST DSLSLRS IF_DATA DIM_X 0x380904 EXTERN BYTE IF_DATA MCMESS 0x380904 EXTERN /end MEASUREMENT
/begin MEASUREMENT B_dsl5 "Diagnose Phase 5: Offset Sekundärluftmasse" UBYTE B_TRUE 1 100 0 1 BIT_MASK 0x2 FUNCTION_LIST DSLSLRS IF_DATA DIM_X 0x380904 EXTERN BYTE IF_DATA MCMESS 0x380904 EXTERN /end MEASUREMENT
/begin MEASUREMENT B_dsl5ab "Diagnose Phase 5: Abbruch" UBYTE B_TRUE 1 100 0 1 BIT_MASK 0x4 FUNCTION_LIST DSLSLRS IF_DATA DIM_X 0x380904 EXTERN BYTE IF_DATA MCMESS 0x380904 EXTERN /end MEASUREMENT
/begin MEASUREMENT B_dsl5dly "Verzögerung nach Diagnose Phase 5" UBYTE B_TRUE 1 100 0 1 BIT_MASK 0x2 FUNCTION_LIST DSLSLRS IF_DATA DIM_X 0x380905 EXTERN BYTE IF_DATA MCMESS 0x380905 EXTERN /end MEASUREMENT
/begin COMPU_METHOD acc_ub_b55p55 "" RAT_FUNC "%6.3" "m/(s^2)" COEFFS 0 1 0 0 0 0.217 /end COMPU_METHOD
/begin COMPU_METHOD acc_uw_b55p55 "" RAT_FUNC "%6.5" "m/(s^2)" COEFFS 0 147456 0 0 0 125 /end COMPU_METHOD
/begin COMPU_METHOD bfzg_sb_q0p217 "" RAT_FUNC "%6.3" "m/s^2" COEFFS 0 1 0 0 0 0.217 /end COMPU_METHOD
/begin COMPU_METHOD B_TRUE "boolsche Zustände, positive Logik" TAB_VERB "%6.3" "" COMPU_TAB_REF B_TRUE /end COMPU_METHOD
/begin COMPU_VTAB B_TRUE "boolsche Zustände, positive Logik" TAB_VERB 2 0 "----" 1 "TRUE" /end COMPU_VTAB
/begin COMPU_METHOD DEZ "1 : 1 Umrechnug (dez/hex)" RAT_FUNC "%6.2" "" COEFFS 0 1 0 0 0 1 /end COMPU_METHOD
/begin COMPU_METHOD dez "1 : 1 Umrechnug (dez/hex)" RAT_FUNC "%6.2" "" COEFFS 0 1 0 0 0 1 /end COMPU_METHOD
/begin COMPU_METHOD dezsub1 "" RAT_FUNC "%6.2" "-" COEFFS 0 1 -1 0 0 1 /end COMPU_METHOD
/begin COMPU_METHOD fak_sb_b1 "" RAT_FUNC "%6.4" "-" COEFFS 0 256 0 0 0 2 /end COMPU_METHOD
/begin COMPU_METHOD fak_ub_b0p125 "" RAT_FUNC "%6.5" "-" COEFFS 0 256 0 0 0 0.125 /end COMPU_METHOD
/begin COMPU_METHOD fak_ub_b0p25 "" RAT_FUNC "%10.7" "-" COEFFS 0 256 0 0 0 0.25 /end COMPU_METHOD
/begin COMPU_METHOD fak_ub_b1 "" RAT_FUNC "%6.4" "-" COEFFS 0 256 0 0 0 1 /end COMPU_METHOD
/begin COMPU_METHOD fak_uw_b4 "" RAT_FUNC "%7.6" "-" COEFFS 0 65536 0 0 0 4 /end COMPU_METHOD
/begin COMPU_METHOD nmot_ub_q40 "" RAT_FUNC "%6.1" "Upm" COEFFS 0 1 0 0 0 40 /end COMPU_METHOD
/begin COMPU_METHOD nmot_uw_q0p25 "" RAT_FUNC "%6.3" "U/min" COEFFS 0 1 0 0 0 0.25 /end COMPU_METHOD
/begin COMPU_METHOD rel_sw_b100 "" RAT_FUNC "%6.4" "%" COEFFS 0 32768 0 0 0 100 /end COMPU_METHOD
/begin COMPU_METHOD rel_ub_b99p6 "" RAT_FUNC "%6.3" "%" COEFFS 0 256 0 0 0 100 /end COMPU_METHOD
/begin COMPU_METHOD rel_ub_q0p75 "" RAT_FUNC "%6.3" "%" COEFFS 0 1 0 0 0 0.75 /end COMPU_METHOD
/begin COMPU_METHOD rel_uw_b100 "" RAT_FUNC "%6.4" "%" COEFFS 0 65536 0 0 0 100 /end COMPU_METHOD
/begin COMPU_METHOD spg_uw_b5 "" RAT_FUNC "%6.4" "V" COEFFS 0 1024 0 0 0 5 /end COMPU_METHOD
/begin COMPU_METHOD t10msxs_ub_b2p55 "" RAT_FUNC "%6.4" "s" COEFFS 0 1 0 0 0 0.01 /end COMPU_METHOD
/begin COMPU_METHOD t20msxs_uw_q0p02 "" RAT_FUNC "%6.4" "s" COEFFS 0 1 0 0 0 0.02 /end COMPU_METHOD
/begin COMPU_METHOD t40ms_ub_b10200 "" RAT_FUNC "%7.2" "ms" COEFFS 0 1 0 0 0 40 /end COMPU_METHOD
/begin COMPU_METHOD t50msxs_uw_b819p2 "" RAT_FUNC "%6.4" "s" COEFFS 0 1 0 0 0 0.0125 /end COMPU_METHOD
/begin COMPU_METHOD temp_ub_q0p75_o48 "" RAT_FUNC "%6.2" "Grad C" COEFFS 0 1 48 0 0 0.75 /end COMPU_METHOD
/begin COMPU_METHOD zk100msxs_ub_b25p5 "" RAT_FUNC "%6.3" "s" COEFFS 0 0 256 0 10 0 /end COMPU_METHOD
/begin COMPU_METHOD zk100msxs_uw_b655 "" RAT_FUNC "%6.1" "s" COEFFS 0 0 65536 0 10 0 /end COMPU_METHOD
/begin COMPU_METHOD zk100msxs_uw_b6553 "" RAT_FUNC "%10.3" "s" COEFFS 0 0 65536 0 10 0 /end COMPU_METHOD
/begin COMPU_METHOD zk10msxs_ub_b2p55 "" RAT_FUNC "%6.4" "s" COEFFS 0 0 255 0 100 0 /end COMPU_METHOD
/begin COMPU_METHOD zk10msxs_uw_b2p55T "" TAB_INTP "%6.3" "s" COMPU_TAB_REF zk10msxs_uw_b2p55T /end COMPU_METHOD
/begin COMPU_TAB zk10msxs_uw_b2p55T "" TAB_INTP 35 128 2.55 145 2.25 163 2 186 1.75 217 1.5 251 1.3 283 1.15 326 1 362 0.9 407 0.8 465 0.7 541 0.6 649 0.5 720 0.45 809 0.4 923 0.35 1074 0.3 1285 0.25 1524 0.21 1872 0.17 2259 0.14 2426 0.13 2620 0.12 2847 0.11 3118 0.1 3446 0.09 3850 0.08 4362 0.07 5030 0.06 5939 0.05 7248 0.04 9288 0.03 12893 0.02 20713 0.01 32767 0 /end COMPU_TAB
/begin COMPU_METHOD zk10msxs_uw_b655 "" RAT_FUNC "%10.4" "s" COEFFS 0 0 65536 0 100 0 /end COMPU_METHOD
/begin COMPU_METHOD zk200msxs_ub_b51p2 "" RAT_FUNC "%6.3" "s" COEFFS 0 0 255 0 5 0 /end COMPU_METHOD
/begin COMPU_METHOD zk20msxs_ub_b5p1 "" RAT_FUNC "%6.4" "s" COEFFS 0 0 5.1 0 1 0 /end COMPU_METHOD
/begin COMPU_METHOD zw_sb_q0p75 "" RAT_FUNC "%6.3" "grad KW" COEFFS 0 255 0 0 0 191.25 /end COMPU_METHOD
/begin RECORD_LAYOUT GklWUb FNC_VALUES 1 UBYTE COLUMN_DIR DIRECT /end RECORD_LAYOUT
/begin RECORD_LAYOUT KlAUbSstUbWUb NO_AXIS_PTS_X 1 UBYTE AXIS_PTS_X 2 UBYTE INDEX_INCR DIRECT FNC_VALUES 3 UBYTE COLUMN_DIR DIRECT /end RECORD_LAYOUT
/begin RECORD_LAYOUT KlAUwSstSwWUw NO_AXIS_PTS_X 1 UWORD AXIS_PTS_X 2 SWORD INDEX_INCR DIRECT FNC_VALUES 3 UWORD COLUMN_DIR DIRECT /end RECORD_LAYOUT
/begin RECORD_LAYOUT KlAUwSstUwWUw NO_AXIS_PTS_X 1 UWORD AXIS_PTS_X 2 UWORD INDEX_INCR DIRECT FNC_VALUES 3 UWORD COLUMN_DIR DIRECT /end RECORD_LAYOUT
/begin RECORD_LAYOUT KwbUb FNC_VALUES 1 UBYTE COLUMN_DIR DIRECT /end RECORD_LAYOUT
/begin RECORD_LAYOUT KwSb FNC_VALUES 1 SBYTE COLUMN_DIR DIRECT /end RECORD_LAYOUT
/begin RECORD_LAYOUT KwUb FNC_VALUES 1 UBYTE COLUMN_DIR DIRECT /end RECORD_LAYOUT
/begin RECORD_LAYOUT KwUw FNC_VALUES 1 UWORD COLUMN_DIR DIRECT /end RECORD_LAYOUT
/begin RECORD_LAYOUT SstAUbSstUb NO_AXIS_PTS_X 1 UBYTE AXIS_PTS_X 2 UBYTE INDEX_INCR DIRECT /end RECORD_LAYOUT
/end MODULE
/end PROJECT
