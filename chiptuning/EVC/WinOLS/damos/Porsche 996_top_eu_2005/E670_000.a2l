/begin PROJECT _7804367 "156"
/begin HEADER "" VERSION "_7804367" PROJECT_NO _7804367 /end HEADER
/begin MODULE DIM ""
/begin MOD_COMMON "" BYTE_ORDER BIG_ENDIAN S_REC_LAYOUT DAMOS /end MOD_COMMON
/begin MEASUREMENT B_tabgs "Bedingung Abgleich stetige Lambda-Sonde LSU nach Start" UBYTE B_TRUE 1 100 0 1 BIT_MASK 0x4 FUNCTION_LIST GGLSU IF_DATA DIM_X 0x380A8C EXTERN BYTE IF_DATA MCMESS 0x380A8C EXTERN /end MEASUREMENT
/begin MEASUREMENT B_tabunpl "Bedingung Abstellzeit unplausibel" UWORD B_TRUE 1 100 0 1 BIT_MASK 0x8000 FUNCTION_LIST BGTABS IF_DATA DIM_X 0xFD4E INTERN BYTE IF_DATA MCMESS 0xFD4E INTERN /end MEASUREMENT
/begin MEASUREMENT B_tal "Bedingung Tank leer bzw. Reserve" UBYTE B_TRUE 1 100 0 1 BIT_MASK 0x1 FUNCTION_LIST GGFST DKVS DLSH IF_DATA DIM_X 0x382FF6 EXTERN BYTE IF_DATA MCMESS 0x382FF6 EXTERN /end MEASUREMENT
/begin MEASUREMENT B_talval "Bedingung : Bit Tank leer gültig" UBYTE B_TRUE 1 100 0 1 BIT_MASK 0x1 FUNCTION_LIST GGFST DKVS DLSH IF_DATA DIM_X 0x382FF5 EXTERN BYTE IF_DATA MCMESS 0x382FF5 EXTERN /end MEASUREMENT
/begin MEASUREMENT B_tarau "LREB: Bedingung Start bei niedrigen Ansauglufttemperaturen" UWORD B_TRUE 1 100 0 1 BIT_MASK 0x40 FUNCTION_LIST LRSEB IF_DATA DIM_X 0xFD7E INTERN BYTE IF_DATA MCMESS 0xFD7E INTERN /end MEASUREMENT
/begin MEASUREMENT B_tauhlt "Einfrieren Lambdaregler wegen Abgasuntersuchung aktiv" UWORD B_TRUE 1 100 0 1 BIT_MASK 0x2000 FUNCTION_LIST SGAAU LRSINI IF_DATA DIM_X 0xFD02 INTERN BYTE IF_DATA MCMESS 0xFD02 INTERN /end MEASUREMENT
/begin MEASUREMENT B_tben "Bedingung Taste Beschleunigen negative Flanke" UBYTE B_TRUE 1 100 0 1 BIT_MASK 0x1 FUNCTION_LIST FGRMD IF_DATA DIM_X 0x380AD9 EXTERN BYTE IF_DATA MCMESS 0x380AD9 EXTERN /end MEASUREMENT
/begin MEASUREMENT B_tbep "Bedingung Taste Beschleunigen positive Flanke" UBYTE B_TRUE 1 100 0 1 BIT_MASK 0x2 FUNCTION_LIST FGRMD IF_DATA DIM_X 0x380AD9 EXTERN BYTE IF_DATA MCMESS 0x380AD9 EXTERN /end MEASUREMENT
/begin MEASUREMENT B_tbeph "Bedingung Taste Beschleunigen positive Flanke Halten" UBYTE B_TRUE 1 100 0 1 BIT_MASK 0x4 FUNCTION_LIST FGRMD IF_DATA DIM_X 0x380AD9 EXTERN BYTE IF_DATA MCMESS 0x380AD9 EXTERN /end MEASUREMENT
/begin MEASUREMENT B_te "Bedingung Tankentlüftung" UWORD B_TRUE 1 100 0 1 BIT_MASK 0x80 FUNCTION_LIST TEBEB BBTEGA DKVS DSLSLRS ESUKAS LRAEB T2DFA TEB IF_DATA DIM_X 0xFD88 INTERN BYTE IF_DATA MCMESS 0xFD88 INTERN /end MEASUREMENT
/begin MEASUREMENT B_teabb "Bedingung Tankentlüftung abbruchbereit" UWORD B_TRUE 1 100 0 1 BIT_MASK 0x4 FUNCTION_LIST TEB BBTEGA IF_DATA DIM_X 0xFD88 INTERN BYTE IF_DATA MCMESS 0xFD88 INTERN /end MEASUREMENT
/begin MEASUREMENT B_teakt "Bedingung Tankentlüftung aktiv (normaler Betrieb oder Notlauf)" UWORD B_TRUE 1 100 0 1 BIT_MASK 0x8 FUNCTION_LIST TEB IF_DATA DIM_X 0xFD88 INTERN BYTE IF_DATA MCMESS 0xFD88 INTERN /end MEASUREMENT
/begin MEASUREMENT B_tef "Bedingung Tankentlüftung prinzipiell freigegeben" UWORD B_TRUE 1 100 0 1 BIT_MASK 0x100 FUNCTION_LIST TEBEB TEB IF_DATA DIM_X 0xFD88 INTERN BYTE IF_DATA MCMESS 0xFD88 INTERN /end MEASUREMENT
/begin MEASUREMENT B_tehb "Bedingung Tankentlüftung mit hoher Beladung" UWORD B_TRUE 1 100 0 1 BIT_MASK 0x10 FUNCTION_LIST TEB DKATLRS DLLR DLSAHK DLSU DMDSTP ESUKAS LRSHK T2DFA IF_DATA DIM_X 0xFD88 INTERN BYTE IF_DATA MCMESS 0xFD88 INTERN /end MEASUREMENT
/begin MEASUREMENT B_tehbx "Bedingung Beladungsintegrator ftead am Maximalanschlag" UWORD B_TRUE 1 100 0 1 BIT_MASK 0x20 FUNCTION_LIST TEB BBTEGA IF_DATA DIM_X 0xFD88 INTERN BYTE IF_DATA MCMESS 0xFD88 INTERN /end MEASUREMENT
/begin MEASUREMENT B_tehbxf "Bedingung Beladungsintegrator ftead am Maximalanschlag, gefiltert" UWORD B_TRUE 1 100 0 1 BIT_MASK 0x1 FUNCTION_LIST BBTEGA IF_DATA DIM_X 0xFD4E INTERN BYTE IF_DATA MCMESS 0xFD4E INTERN /end MEASUREMENT
/begin MEASUREMENT B_tei "Bedingung Tankentlüftung funktionsintern" UWORD B_TRUE 1 100 0 1 BIT_MASK 0x200 FUNCTION_LIST TEBEB TEB IF_DATA DIM_X 0xFD88 INTERN BYTE IF_DATA MCMESS 0xFD88 INTERN /end MEASUREMENT
/begin MEASUREMENT B_temin "Bedingung TEMIN-Begrenzung aktiv, Bank 1" UWORD B_TRUE 1 100 0 1 BIT_MASK 0x200 FUNCTION_LIST RKTI LRSEB IF_DATA DIM_X 0xFD5C INTERN BYTE IF_DATA MCMESS 0xFD5C INTERN /end MEASUREMENT
/begin MEASUREMENT B_temin2 "Bedingung TEMIN-Begrenzung aktiv, Bank 2" UWORD B_TRUE 1 100 0 1 BIT_MASK 0x400 FUNCTION_LIST RKTI LRSEB IF_DATA DIM_X 0xFD5C INTERN BYTE IF_DATA MCMESS 0xFD5C INTERN /end MEASUREMENT
/begin MEASUREMENT B_ten "Bedingung Tankentlüftung im Notlaufbetrieb (ohne Lambdaregelung)" UWORD B_TRUE 1 100 0 1 BIT_MASK 0x400 FUNCTION_LIST TEBEB TEB IF_DATA DIM_X 0xFD88 INTERN BYTE IF_DATA MCMESS 0xFD88 INTERN /end MEASUREMENT
/begin MEASUREMENT B_tep "Bedingung Tankentlüftungsphase" UWORD B_TRUE 1 100 0 1 BIT_MASK 0x2 FUNCTION_LIST BBTEGA TEB TEBEB IF_DATA DIM_X 0xFD4E INTERN BYTE IF_DATA MCMESS 0xFD4E INTERN /end MEASUREMENT
/begin MEASUREMENT B_tepi "Bedingung TE-Phase intern aktiv" UWORD B_TRUE 1 100 0 1 BIT_MASK 0x4 FUNCTION_LIST BBTEGA IF_DATA DIM_X 0xFD4E INTERN BYTE IF_DATA MCMESS 0xFD4E INTERN /end MEASUREMENT
/begin MEASUREMENT B_tepzhl "Bedingung Tankentlüftungphase zusätzlich wegen Dauerhochlast" UWORD B_TRUE 1 100 0 1 BIT_MASK 0x8 FUNCTION_LIST BBTEGA IF_DATA DIM_X 0xFD4E INTERN BYTE IF_DATA MCMESS 0xFD4E INTERN /end MEASUREMENT
/begin MEASUREMENT B_tepzus "Bedingung zusätzliche Tankentlüftungsphase" UWORD B_TRUE 1 100 0 1 BIT_MASK 0x10 FUNCTION_LIST BBTEGA IF_DATA DIM_X 0xFD4E INTERN BYTE IF_DATA MCMESS 0xFD4E INTERN /end MEASUREMENT
/begin MEASUREMENT B_teslash "Bedingung Test ausführen für Überprüfung Sonde hinter KAT" UWORD B_TRUE 1 100 0 1 BIT_MASK 0x2000 FUNCTION_LIST DLSAHK IF_DATA DIM_X 0xFD26 INTERN BYTE IF_DATA MCMESS 0xFD26 INTERN /end MEASUREMENT
/begin MEASUREMENT B_teslash2 "Bedingung Test ausführen für Überprüfung Sonde hinter KAT Bank2" UWORD B_TRUE 1 100 0 1 BIT_MASK 0x4000 FUNCTION_LIST DLSAHK IF_DATA DIM_X 0xFD26 INTERN BYTE IF_DATA MCMESS 0xFD26 INTERN /end MEASUREMENT
/begin MEASUREMENT B_tesrdy "Bedingung TES geprüft für 'ready-Byte'" UBYTE B_TRUE 1 100 0 1 BIT_MASK 0x4 FUNCTION_LIST DIMC IF_DATA DIM_X 0x382FD0 EXTERN BYTE IF_DATA MCMESS 0x382FD0 EXTERN /end MEASUREMENT
/begin MEASUREMENT B_tesstp "Bedingung Tankentlüftung schnell stoppen" UWORD B_TRUE 1 100 0 1 BIT_MASK 0x20 FUNCTION_LIST BBTEGA IF_DATA DIM_X 0xFD4E INTERN BYTE IF_DATA MCMESS 0xFD4E INTERN /end MEASUREMENT
/begin MEASUREMENT B_teviol "Bedingung TEV aus der Reaktion der Leerlaufregelung als i.O. erkannt" UWORD B_TRUE 1 100 0 1 BIT_MASK 0x40 FUNCTION_LIST DTEV IF_DATA DIM_X 0xFD8C INTERN BYTE IF_DATA MCMESS 0xFD8C INTERN /end MEASUREMENT
/begin MEASUREMENT B_teviolm "Bedingung i.O-Aussage TEV über Leerlaufluftprüfung möglich" UWORD B_TRUE 1 100 0 1 BIT_MASK 0x80 FUNCTION_LIST DTEV IF_DATA DIM_X 0xFD8C INTERN BYTE IF_DATA MCMESS 0xFD8C INTERN /end MEASUREMENT
/begin MEASUREMENT B_teviop "Bedingung TEV in passiver Prüfung als i.O. erkannt." UWORD B_TRUE 1 100 0 1 BIT_MASK 0x100 FUNCTION_LIST DTEV IF_DATA DIM_X 0xFD8C INTERN BYTE IF_DATA MCMESS 0xFD8C INTERN /end MEASUREMENT
/begin MEASUREMENT B_tevior "Bedingung TEV aus fr-Abweichung als i.O. erkannt." UWORD B_TRUE 1 100 0 1 BIT_MASK 0x200 FUNCTION_LIST DTEV IF_DATA DIM_X 0xFD8C INTERN BYTE IF_DATA MCMESS 0xFD8C INTERN /end MEASUREMENT
/begin MEASUREMENT B_tevnio "Bedingung TEV in aktiver Prüfung als defekt erkannt" UWORD B_TRUE 1 100 0 1 BIT_MASK 0x400 FUNCTION_LIST DTEV IF_DATA DIM_X 0xFD8C INTERN BYTE IF_DATA MCMESS 0xFD8C INTERN /end MEASUREMENT
/begin MEASUREMENT B_tevniom "Bedingung i.O-Aussage TEV über Leerlaufprüfung nicht möglich" UWORD B_TRUE 1 100 0 1 BIT_MASK 0x800 FUNCTION_LIST DTEV IF_DATA DIM_X 0xFD8C INTERN BYTE IF_DATA MCMESS 0xFD8C INTERN /end MEASUREMENT
/begin MEASUREMENT B_tevtini "TEV timer wurde neu initialisiert" UWORD B_TRUE 1 100 0 1 BIT_MASK 0x40 FUNCTION_LIST PROKON ATEV IF_DATA DIM_X 0xFD76 INTERN BYTE IF_DATA MCMESS 0xFD76 INTERN /end MEASUREMENT
/begin MEASUREMENT B_tevtstp "Bedingung Stop für TEV Timer" UWORD B_TRUE 1 100 0 1 BIT_MASK 0x8000 FUNCTION_LIST ATEV IF_DATA DIM_X 0xFD86 INTERN BYTE IF_DATA MCMESS 0xFD86 INTERN /end MEASUREMENT
/begin MEASUREMENT B_teza "Bedingung Tankentlüftung zwangsaktiv" UWORD B_TRUE 1 100 0 1 BIT_MASK 0x40 FUNCTION_LIST SWADP BBTEGA IF_DATA DIM_X 0xFD86 INTERN BYTE IF_DATA MCMESS 0xFD86 INTERN /end MEASUREMENT
/begin MEASUREMENT B_tezstp "Bedingung Tankentlüftung zwang stoppen" UWORD B_TRUE 1 100 0 1 BIT_MASK 0x40 FUNCTION_LIST BBTEGA IF_DATA DIM_X 0xFD4E INTERN BYTE IF_DATA MCMESS 0xFD4E INTERN /end MEASUREMENT
/begin MEASUREMENT B_tfu "Bedingung Temperaturfühler Umgebung vorhanden" UWORD B_TRUE 1 100 0 1 BIT_MASK 0x80 FUNCTION_LIST PROKON ATM BGTABS GGTFUMG IF_DATA DIM_X 0xFD76 INTERN BYTE IF_DATA MCMESS 0xFD76 INTERN /end MEASUREMENT
/begin MEASUREMENT B_tfwdksom "Zeitkonstante für Filterung Drosselklappenwinkel ohne Momentenstruktur aktiv" UWORD B_TRUE 1 100 0 1 BIT_MASK 0x80 FUNCTION_LIST SWADP FUEDK IF_DATA DIM_X 0xFD86 INTERN BYTE IF_DATA MCMESS 0xFD86 INTERN /end MEASUREMENT
/begin MEASUREMENT B_tiab0 "ti-Abschaltung bei kat.schädigenden Aussetzerraten, Zyl/Zündung 0" UBYTE B_TRUE 1 100 0 1 BIT_MASK 0x1 FUNCTION_LIST DMDMIL IF_DATA DIM_X 0x3809D3 EXTERN BYTE IF_DATA MCMESS 0x3809D3 EXTERN /end MEASUREMENT
/begin MEASUREMENT B_tiab1 "ti-Abschaltung bei kat.schädigenden Aussetzerraten, Zyl/Zündung 1" UBYTE B_TRUE 1 100 0 1 BIT_MASK 0x2 FUNCTION_LIST DMDMIL IF_DATA DIM_X 0x3809D3 EXTERN BYTE IF_DATA MCMESS 0x3809D3 EXTERN /end MEASUREMENT
/begin MEASUREMENT B_tiab2 "ti-Abschaltung bei kat.schädigenden Aussetzerraten, Zyl/Zündung 2" UBYTE B_TRUE 1 100 0 1 BIT_MASK 0x4 FUNCTION_LIST DMDMIL IF_DATA DIM_X 0x3809D3 EXTERN BYTE IF_DATA MCMESS 0x3809D3 EXTERN /end MEASUREMENT
/begin MEASUREMENT B_tiab3 "ti-Abschaltung bei kat.schädigenden Aussetzerraten, Zyl/Zündung 3" UBYTE B_TRUE 1 100 0 1 BIT_MASK 0x8 FUNCTION_LIST DMDMIL IF_DATA DIM_X 0x3809D3 EXTERN BYTE IF_DATA MCMESS 0x3809D3 EXTERN /end MEASUREMENT
/begin MEASUREMENT B_tiab4 "ti-Abschaltung bei kat.schädigenden Aussetzerraten, Zyl/Zündung 4" UBYTE B_TRUE 1 100 0 1 BIT_MASK 0x10 FUNCTION_LIST DMDMIL IF_DATA DIM_X 0x3809D3 EXTERN BYTE IF_DATA MCMESS 0x3809D3 EXTERN /end MEASUREMENT
/begin MEASUREMENT B_tiab5 "ti-Abschaltung bei kat.schädigenden Aussetzerraten, Zyl/Zündung 5" UBYTE B_TRUE 1 100 0 1 BIT_MASK 0x20 FUNCTION_LIST DMDMIL IF_DATA DIM_X 0x3809D3 EXTERN BYTE IF_DATA MCMESS 0x3809D3 EXTERN /end MEASUREMENT
/begin MEASUREMENT B_tim "Zeit-Trigger für Fehlerpfadmanagement" UBYTE B_TRUE 1 100 0 1 BIT_MASK 0x1 FUNCTION_LIST DFPM IF_DATA DIM_X 0x3809D8 EXTERN WORD IF_DATA MCMESS 0x3809D8 EXTERN /end MEASUREMENT
/begin MEASUREMENT B_timfast "EGAS: DFH Geschwindigkeit; Timer läuft schnell" UWORD B_TRUE 1 100 0 1 BIT_MASK 0x100 FUNCTION_LIST TIMU IF_DATA DIM_X 0xFD42 INTERN BYTE IF_DATA MCMESS 0xFD42 INTERN /end MEASUREMENT
/begin MEASUREMENT B_tired "Bedingung ti-Reduktion" UWORD B_TRUE 1 100 0 1 BIT_MASK 0x800 FUNCTION_LIST BGRLP IF_DATA DIM_X 0xFD4E INTERN BYTE IF_DATA MCMESS 0xFD4E INTERN /end MEASUREMENT
/begin MEASUREMENT B_ti_cha0 "" UWORD B_TRUE 1 100 0 1 BIT_MASK 0x1 FUNCTION_LIST ACIFI EVI TIMU IF_DATA DIM_X 0xFD40 INTERN BYTE IF_DATA MCMESS 0xFD40 INTERN /end MEASUREMENT
/begin MEASUREMENT B_ti_cha1 "" UWORD B_TRUE 1 100 0 1 BIT_MASK 0x2 FUNCTION_LIST ACIFI EVI TIMU IF_DATA DIM_X 0xFD40 INTERN BYTE IF_DATA MCMESS 0xFD40 INTERN /end MEASUREMENT
/begin MEASUREMENT B_ti_cha2 "" UWORD B_TRUE 1 100 0 1 BIT_MASK 0x4 FUNCTION_LIST ACIFI EVI TIMU IF_DATA DIM_X 0xFD40 INTERN BYTE IF_DATA MCMESS 0xFD40 INTERN /end MEASUREMENT
/begin MEASUREMENT B_ti_cha3 "" UWORD B_TRUE 1 100 0 1 BIT_MASK 0x8 FUNCTION_LIST ACIFI EVI TIMU IF_DATA DIM_X 0xFD40 INTERN BYTE IF_DATA MCMESS 0xFD40 INTERN /end MEASUREMENT
/begin MEASUREMENT B_ti_cha4 "" UWORD B_TRUE 1 100 0 1 BIT_MASK 0x10 FUNCTION_LIST ACIFI EVI TIMU IF_DATA DIM_X 0xFD40 INTERN BYTE IF_DATA MCMESS 0xFD40 INTERN /end MEASUREMENT
/begin MEASUREMENT B_ti_cha5 "" UWORD B_TRUE 1 100 0 1 BIT_MASK 0x20 FUNCTION_LIST ACIFI EVI TIMU IF_DATA DIM_X 0xFD40 INTERN BYTE IF_DATA MCMESS 0xFD40 INTERN /end MEASUREMENT
/begin MEASUREMENT B_ti_cha6 "" UWORD B_TRUE 1 100 0 1 BIT_MASK 0x40 FUNCTION_LIST ACIFI IF_DATA DIM_X 0xFD40 INTERN BYTE IF_DATA MCMESS 0xFD40 INTERN /end MEASUREMENT
/begin MEASUREMENT B_ti_cha7 "" UWORD B_TRUE 1 100 0 1 BIT_MASK 0x80 FUNCTION_LIST ACIFI IF_DATA DIM_X 0xFD40 INTERN BYTE IF_DATA MCMESS 0xFD40 INTERN /end MEASUREMENT
/begin MEASUREMENT B_ti_out0 "" UWORD B_TRUE 1 100 0 1 BIT_MASK 0x100 FUNCTION_LIST ACIFI EVI TIMU IF_DATA DIM_X 0xFD40 INTERN BYTE IF_DATA MCMESS 0xFD40 INTERN /end MEASUREMENT
/begin MEASUREMENT B_ti_out1 "" UWORD B_TRUE 1 100 0 1 BIT_MASK 0x200 FUNCTION_LIST ACIFI EVI TIMU IF_DATA DIM_X 0xFD40 INTERN BYTE IF_DATA MCMESS 0xFD40 INTERN /end MEASUREMENT
/begin MEASUREMENT B_ti_out2 "" UWORD B_TRUE 1 100 0 1 BIT_MASK 0x400 FUNCTION_LIST ACIFI EVI TIMU IF_DATA DIM_X 0xFD40 INTERN BYTE IF_DATA MCMESS 0xFD40 INTERN /end MEASUREMENT
/begin MEASUREMENT B_ti_out3 "" UWORD B_TRUE 1 100 0 1 BIT_MASK 0x800 FUNCTION_LIST ACIFI EVI TIMU IF_DATA DIM_X 0xFD40 INTERN BYTE IF_DATA MCMESS 0xFD40 INTERN /end MEASUREMENT
/begin MEASUREMENT B_ti_out4 "" UWORD B_TRUE 1 100 0 1 BIT_MASK 0x1000 FUNCTION_LIST ACIFI EVI TIMU IF_DATA DIM_X 0xFD40 INTERN BYTE IF_DATA MCMESS 0xFD40 INTERN /end MEASUREMENT
/begin MEASUREMENT B_ti_out5 "" UWORD B_TRUE 1 100 0 1 BIT_MASK 0x2000 FUNCTION_LIST ACIFI EVI TIMU IF_DATA DIM_X 0xFD40 INTERN BYTE IF_DATA MCMESS 0xFD40 INTERN /end MEASUREMENT
/begin MEASUREMENT B_ti_out6 "" UWORD B_TRUE 1 100 0 1 BIT_MASK 0x4000 FUNCTION_LIST ACIFI IF_DATA DIM_X 0xFD40 INTERN BYTE IF_DATA MCMESS 0xFD40 INTERN /end MEASUREMENT
/begin MEASUREMENT B_ti_out7 "" UWORD B_TRUE 1 100 0 1 BIT_MASK 0x8000 FUNCTION_LIST ACIFI IF_DATA DIM_X 0xFD40 INTERN BYTE IF_DATA MCMESS 0xFD40 INTERN /end MEASUREMENT
/begin MEASUREMENT B_ti_wai0 "" UWORD B_TRUE 1 100 0 1 BIT_MASK 0x1 FUNCTION_LIST ACIFI EVI TIMU IF_DATA DIM_X 0xFD42 INTERN BYTE IF_DATA MCMESS 0xFD42 INTERN /end MEASUREMENT
/begin MEASUREMENT B_ti_wai1 "" UWORD B_TRUE 1 100 0 1 BIT_MASK 0x2 FUNCTION_LIST ACIFI EVI TIMU IF_DATA DIM_X 0xFD42 INTERN BYTE IF_DATA MCMESS 0xFD42 INTERN /end MEASUREMENT
/begin MEASUREMENT B_ti_wai2 "" UWORD B_TRUE 1 100 0 1 BIT_MASK 0x4 FUNCTION_LIST ACIFI EVI TIMU IF_DATA DIM_X 0xFD42 INTERN BYTE IF_DATA MCMESS 0xFD42 INTERN /end MEASUREMENT
/begin MEASUREMENT B_ti_wai3 "" UWORD B_TRUE 1 100 0 1 BIT_MASK 0x8 FUNCTION_LIST ACIFI EVI TIMU IF_DATA DIM_X 0xFD42 INTERN BYTE IF_DATA MCMESS 0xFD42 INTERN /end MEASUREMENT
/begin MEASUREMENT B_ti_wai4 "" UWORD B_TRUE 1 100 0 1 BIT_MASK 0x10 FUNCTION_LIST ACIFI EVI TIMU IF_DATA DIM_X 0xFD42 INTERN BYTE IF_DATA MCMESS 0xFD42 INTERN /end MEASUREMENT
/begin MEASUREMENT B_ti_wai5 "" UWORD B_TRUE 1 100 0 1 BIT_MASK 0x20 FUNCTION_LIST ACIFI EVI TIMU IF_DATA DIM_X 0xFD42 INTERN BYTE IF_DATA MCMESS 0xFD42 INTERN /end MEASUREMENT
/begin MEASUREMENT B_ti_wai6 "" UWORD B_TRUE 1 100 0 1 BIT_MASK 0x40 FUNCTION_LIST ACIFI IF_DATA DIM_X 0xFD42 INTERN BYTE IF_DATA MCMESS 0xFD42 INTERN /end MEASUREMENT
/begin MEASUREMENT B_ti_wai7 "" UWORD B_TRUE 1 100 0 1 BIT_MASK 0x80 FUNCTION_LIST ACIFI IF_DATA DIM_X 0xFD42 INTERN BYTE IF_DATA MCMESS 0xFD42 INTERN /end MEASUREMENT
/begin MEASUREMENT B_tkatbts "Bedingung Katalysatortemperatur für Bauteileschutz überschritten" UWORD B_TRUE 1 100 0 1 BIT_MASK 0x200 FUNCTION_LIST LAMBTS IF_DATA DIM_X 0xFD58 INTERN BYTE IF_DATA MCMESS 0xFD58 INTERN /end MEASUREMENT
/begin MEASUREMENT B_tmkom "Bedingung Kombi-Warnleuchte ansteuern wegen tmot-Übertemperatur" UWORD B_TRUE 1 100 0 1 BIT_MASK 0x20 FUNCTION_LIST MLS CAN IF_DATA DIM_X 0xFD6C INTERN BYTE IF_DATA MCMESS 0xFD6C INTERN /end MEASUREMENT
/begin MEASUREMENT B_tmkr "Bedingung Temperatur (tmot) fuer KR aktiv erreicht" UWORD B_TRUE 1 100 0 1 BIT_MASK 0x100 FUNCTION_LIST KRRA DKRS GGKS KRDY IF_DATA DIM_X 0xFD64 INTERN BYTE IF_DATA MCMESS 0xFD64 INTERN /end MEASUREMENT
/begin MEASUREMENT B_tmlr "LREB: Von Motortemp. abhängige Bedingungen Lambdaregelung (vor Kat)" UWORD B_TRUE 1 100 0 1 BIT_MASK 0x80 FUNCTION_LIST LRSEB IF_DATA DIM_X 0xFD7E INTERN BYTE IF_DATA MCMESS 0xFD7E INTERN /end MEASUREMENT
/begin MEASUREMENT B_tmmn "Bedingung: Blockheater erkannt" UWORD B_TRUE 1 100 0 1 BIT_MASK 0x2000 FUNCTION_LIST GGTFM IF_DATA DIM_X 0xFD5C INTERN BYTE IF_DATA MCMESS 0xFD5C INTERN /end MEASUREMENT
/begin MEASUREMENT B_tmnuka "Bedingung: Minimalzeit zwischen 2 Adaptionsvorgänge läuft" UWORD B_TRUE 1 100 0 1 BIT_MASK 0x400 FUNCTION_LIST ESUKAS IF_DATA DIM_X 0xFD56 INTERN BYTE IF_DATA MCMESS 0xFD56 INTERN /end MEASUREMENT
/begin MEASUREMENT B_tmsrt "Bedingung Retriggerung Motortemperaturmodell nach Start" UWORD B_TRUE 1 100 0 1 BIT_MASK 0x4000 FUNCTION_LIST GGTFM IF_DATA DIM_X 0xFD5C INTERN BYTE IF_DATA MCMESS 0xFD5C INTERN /end MEASUREMENT
/begin MEASUREMENT B_tnalu_m "Monitor, Testphase nach erkanntem Aussetzer" UBYTE B_TRUE 1 100 0 1 BIT_MASK 0x8 FUNCTION_LIST DMDLU IF_DATA DIM_X 0xE3F0 INTERN WORD IF_DATA MCMESS 0xE3F0 INTERN /end MEASUREMENT
/begin MEASUREMENT B_tol1 "Bereich Öltemperatur (normale Ventilhubumschaltung)" UWORD B_TRUE 1 100 0 1 BIT_MASK 0x100 FUNCTION_LIST VS IF_DATA DIM_X 0x382CBC EXTERN BYTE IF_DATA MCMESS 0x382CBC EXTERN /end MEASUREMENT
/begin MEASUREMENT B_tol2 "Bereich Öltemperatur (großer Ventilhub wenn LL verlassen)" UWORD B_TRUE 1 100 0 1 BIT_MASK 0x200 FUNCTION_LIST VS IF_DATA DIM_X 0x382CBC EXTERN BYTE IF_DATA MCMESS 0x382CBC EXTERN /end MEASUREMENT
/begin MEASUREMENT B_tol3 "Bereich Öltemperatur (immer großer Ventilhub)" UWORD B_TRUE 1 100 0 1 BIT_MASK 0x400 FUNCTION_LIST VS IF_DATA DIM_X 0x382CBC EXTERN BYTE IF_DATA MCMESS 0x382CBC EXTERN /end MEASUREMENT
/begin MEASUREMENT B_tol3vsa "Verzögerung Einschaltbedinung durch Toel-Bereich 3" UWORD B_TRUE 1 100 0 1 BIT_MASK 0x800 FUNCTION_LIST VS IF_DATA DIM_X 0x382CBC EXTERN BYTE IF_DATA MCMESS 0x382CBC EXTERN /end MEASUREMENT
/begin MEASUREMENT B_tpderl "Bedingung Tip-Down erlaubt" UBYTE B_TRUE 1 100 0 1 BIT_MASK 0x8 FUNCTION_LIST FGRMD IF_DATA DIM_X 0x380AD9 EXTERN BYTE IF_DATA MCMESS 0x380AD9 EXTERN /end MEASUREMENT
/begin MEASUREMENT B_tpdn "Bedingung FGR im Zustand Tip-Down" UBYTE B_TRUE 1 100 0 1 BIT_MASK 0x10 FUNCTION_LIST FGRMD IF_DATA DIM_X 0x380AD9 EXTERN BYTE IF_DATA MCMESS 0x380AD9 EXTERN /end MEASUREMENT
/begin MEASUREMENT B_tpnmot "Bedingung Tiefpunkt Drehzahlschwingung" UBYTE B_TRUE 1 100 0 1 BIT_MASK 0x10 FUNCTION_LIST ARMD IF_DATA DIM_X 0x380C27 EXTERN BYTE IF_DATA MCMESS 0x380C27 EXTERN /end MEASUREMENT
/begin MEASUREMENT B_tpnt_aw "KR: Auswahl Nulltest oder Testimpuls" UWORD B_TRUE 1 100 0 1 BIT_MASK 0x8 FUNCTION_LIST GGKS IF_DATA DIM_X 0xFD62 INTERN BYTE IF_DATA MCMESS 0xFD62 INTERN /end MEASUREMENT
/begin MEASUREMENT B_tpnt_e "KR: Nulltest/Testimpuls freigegeben" UWORD B_TRUE 1 100 0 1 BIT_MASK 0x10 FUNCTION_LIST GGKS IF_DATA DIM_X 0xFD62 INTERN BYTE IF_DATA MCMESS 0xFD62 INTERN /end MEASUREMENT
/begin MEASUREMENT B_tpuerl "Bedingung Tip-Up erlaubt" UBYTE B_TRUE 1 100 0 1 BIT_MASK 0x20 FUNCTION_LIST FGRMD IF_DATA DIM_X 0x380AD9 EXTERN BYTE IF_DATA MCMESS 0x380AD9 EXTERN /end MEASUREMENT
/begin MEASUREMENT B_tpup "Bedingung FGR im Zustand Tip-Up" UBYTE B_TRUE 1 100 0 1 BIT_MASK 0x40 FUNCTION_LIST FGRMD IF_DATA DIM_X 0x380AD9 EXTERN BYTE IF_DATA MCMESS 0x380AD9 EXTERN /end MEASUREMENT
/begin MEASUREMENT B_tpvl "Bedingung Pumpenvorlauf der Länge TPVL Sekunden" UBYTE B_TRUE 1 100 0 1 BIT_MASK 0x4 FUNCTION_LIST AEKP IF_DATA DIM_X 0x380D1F EXTERN BYTE IF_DATA MCMESS 0x380D1F EXTERN /end MEASUREMENT
/begin MEASUREMENT B_trev_inc "" UWORD B_TRUE 1 100 0 1 BIT_MASK 0x200 FUNCTION_LIST TREV_OV DMDTSB IF_DATA DIM_X 0xFD1A INTERN BYTE IF_DATA MCMESS 0xFD1A INTERN /end MEASUREMENT
/begin MEASUREMENT B_trfash "Bedingung Kurztrip einleiten für Schwingungsprüfung Sonde hinter KAT" UWORD B_TRUE 1 100 0 1 BIT_MASK 0x8000 FUNCTION_LIST DLSAHK IF_DATA DIM_X 0xFD26 INTERN BYTE IF_DATA MCMESS 0xFD26 INTERN /end MEASUREMENT
/begin MEASUREMENT B_trfash2 "Bedingung Kurztrip einleiten für Schwingungsprüfung Sonde hinter KAT Bank2" UWORD B_TRUE 1 100 0 1 BIT_MASK 0x1 FUNCTION_LIST DLSAHK IF_DATA DIM_X 0xFD28 INTERN BYTE IF_DATA MCMESS 0xFD28 INTERN /end MEASUREMENT
/begin MEASUREMENT B_trig "Bedingung für Umschaltung der Verstärkerstufen und Skalierung des Referenzpegels" UWORD B_TRUE 1 100 0 1 BIT_MASK 0x10 FUNCTION_LIST DKATLRS IF_DATA DIM_X 0xFD22 INTERN BYTE IF_DATA MCMESS 0xFD22 INTERN /end MEASUREMENT
/begin MEASUREMENT B_trig2 "" UWORD B_TRUE 1 100 0 1 BIT_MASK 0x20 FUNCTION_LIST DKATLRS IF_DATA DIM_X 0xFD22 INTERN BYTE IF_DATA MCMESS 0xFD22 INTERN /end MEASUREMENT
/begin MEASUREMENT B_trkh "Bedingung Katheizen, Thermoreaktor wirksam" UWORD B_TRUE 1 100 0 1 BIT_MASK 0x8 FUNCTION_LIST BBKHZ ATM HLSU IF_DATA DIM_X 0xFD60 INTERN BYTE IF_DATA MCMESS 0xFD60 INTERN /end MEASUREMENT
/begin MEASUREMENT B_trsah "Bedingung Kabelbruch für Sonde hinter KAT" UBYTE B_TRUE 1 100 0 1 BIT_MASK 0x4 FUNCTION_LIST DLSH IF_DATA DIM_X 0x380A81 EXTERN BYTE IF_DATA MCMESS 0x380A81 EXTERN /end MEASUREMENT
/begin MEASUREMENT B_trsah2 "Bedingung Kabelbruch für Sonde hinter KAT, Bank 2" UBYTE B_TRUE 1 100 0 1 BIT_MASK 0x8 FUNCTION_LIST DLSH IF_DATA DIM_X 0x380A81 EXTERN BYTE IF_DATA MCMESS 0x380A81 EXTERN /end MEASUREMENT
/begin MEASUREMENT B_tsep "Bedingung Taste Setzen positive Flanke" UBYTE B_TRUE 1 100 0 1 BIT_MASK 0x80 FUNCTION_LIST FGRMD IF_DATA DIM_X 0x380AD9 EXTERN BYTE IF_DATA MCMESS 0x380AD9 EXTERN /end MEASUREMENT
/begin MEASUREMENT B_tsroov "Bedingung Segmentzeit-Wordoverflow" UWORD B_TRUE 1 100 0 1 BIT_MASK 0x400 FUNCTION_LIST DMDTSB IF_DATA DIM_X 0xFD0E INTERN BYTE IF_DATA MCMESS 0xFD0E INTERN /end MEASUREMENT
/begin MEASUREMENT B_tsroov_m "Monitor, Bedingung Segmentzeit-Wordoverflow" UBYTE B_TRUE 1 100 0 1 BIT_MASK 0x20 FUNCTION_LIST DMDFON IF_DATA DIM_X 0xE456 INTERN WORD IF_DATA MCMESS 0xE456 INTERN /end MEASUREMENT
/begin MEASUREMENT B_ttbmhh "Bedingung theoretische Sondenbetriebsbereitschaft hinter KAT mit Heizung" UWORD B_TRUE 1 100 0 1 BIT_MASK 0x1 FUNCTION_LIST DLSH GGLSH IF_DATA DIM_X 0xFD2A INTERN BYTE IF_DATA MCMESS 0xFD2A INTERN /end MEASUREMENT
/begin MEASUREMENT B_ttbmhh2 "Bedingung theoretische Sondenbetriebsbereitschaft hinter KAT mit Heizung Bank2" UWORD B_TRUE 1 100 0 1 BIT_MASK 0x2 FUNCTION_LIST DLSH GGLSH IF_DATA DIM_X 0xFD2A INTERN BYTE IF_DATA MCMESS 0xFD2A INTERN /end MEASUREMENT
/begin MEASUREMENT B_tteae "Bedingung Umschaltung auf lange TE-Phase" UWORD B_TRUE 1 100 0 1 BIT_MASK 0x80 FUNCTION_LIST BBTEGA IF_DATA DIM_X 0xFD4E INTERN BYTE IF_DATA MCMESS 0xFD4E INTERN /end MEASUREMENT
/begin MEASUREMENT B_tven "Bedingung Taste Verzögern negative Flanke" UBYTE B_TRUE 1 100 0 1 BIT_MASK 0x1 FUNCTION_LIST FGRMD IF_DATA DIM_X 0x380ADA EXTERN BYTE IF_DATA MCMESS 0x380ADA EXTERN /end MEASUREMENT
/begin MEASUREMENT B_tvep "Bedingung Taste Verzögern positive Flanke" UBYTE B_TRUE 1 100 0 1 BIT_MASK 0x2 FUNCTION_LIST FGRMD IF_DATA DIM_X 0x380ADA EXTERN BYTE IF_DATA MCMESS 0x380ADA EXTERN /end MEASUREMENT
/begin MEASUREMENT B_tveph "Bedingung Taste Verzögern positive Flanke Halten" UBYTE B_TRUE 1 100 0 1 BIT_MASK 0x4 FUNCTION_LIST FGRMD IF_DATA DIM_X 0x380ADA EXTERN BYTE IF_DATA MCMESS 0x380ADA EXTERN /end MEASUREMENT
/begin MEASUREMENT B_twap "Bedingung Taste Wiederaufnahme positive Fanke" UBYTE B_TRUE 1 100 0 1 BIT_MASK 0x8 FUNCTION_LIST FGRMD IF_DATA DIM_X 0x380ADA EXTERN BYTE IF_DATA MCMESS 0x380ADA EXTERN /end MEASUREMENT
/begin MEASUREMENT B_ubdve "Bedingung: Batteriespannung für DV-E-Ansteuerung i.O." UWORD B_TRUE 1 100 0 1 BIT_MASK 0x1 FUNCTION_LIST ADVE BGDVE SREAKT IF_DATA DIM_X 0xFD34 INTERN BYTE IF_DATA MCMESS 0xFD34 INTERN /end MEASUREMENT
/begin MEASUREMENT B_ubpvg "Bedingung Batteriespannung ausreichend für 5V-Potiversorgung" UWORD B_TRUE 1 100 0 1 BIT_MASK 0x2 FUNCTION_LIST ADVE GGDVE GGPED IF_DATA DIM_X 0xFD34 INTERN BYTE IF_DATA MCMESS 0xFD34 INTERN /end MEASUREMENT
/begin MEASUREMENT B_ubvdkp "Bedingung Batteriespannung ausreichend für Verstärkung von DK-Poti 1" UWORD B_TRUE 1 100 0 1 BIT_MASK 0x8 FUNCTION_LIST GGDVE IF_DATA DIM_X 0xFD3A INTERN BYTE IF_DATA MCMESS 0xFD3A INTERN /end MEASUREMENT
/begin MEASUREMENT B_ub_ok "Batteriespannung o.k." UWORD B_TRUE 1 100 0 1 BIT_MASK 0x4 FUNCTION_LIST ADVE DUF SREAKT UFEING IF_DATA DIM_X 0xFD34 INTERN BYTE IF_DATA MCMESS 0xFD34 INTERN /end MEASUREMENT
/begin MEASUREMENT B_ub_ska "Batteriespannung nicht o.k., Unterspannungsabschaltung aktiv" UBYTE B_TRUE 1 100 0 1 BIT_MASK 0x2 FUNCTION_LIST UFURAM IF_DATA DIM_X 0x382E42 EXTERN WORD IF_DATA MCMESS 0x382E42 EXTERN /end MEASUREMENT
/begin MEASUREMENT b_ub_ska_c "Bedingung Unterspannungsabschaltung des DV-E im Master-SG aktiv (über CAN)" UBYTE B_TRUE 1 100 0 1 BIT_MASK 0x10 FUNCTION_LIST UFURAM IF_DATA DIM_X 0x382E44 EXTERN WORD IF_DATA MCMESS 0x382E44 EXTERN /end MEASUREMENT
/begin MEASUREMENT B_udk1nv "Bedingung Spannung DK-Poti 1 oberhalb des Verstärkungsbereichs" UWORD B_TRUE 1 100 0 1 BIT_MASK 0x10 FUNCTION_LIST GGDVE IF_DATA DIM_X 0xFD3A INTERN BYTE IF_DATA MCMESS 0xFD3A INTERN /end MEASUREMENT
/begin MEASUREMENT B_uebrkf "Bedingung Übergang von begrenzter Rampe nach Konstantfahrt erfolgt" UBYTE B_TRUE 1 100 0 1 BIT_MASK 0x10 FUNCTION_LIST FGRMD IF_DATA DIM_X 0x380ADA EXTERN BYTE IF_DATA MCMESS 0x380ADA EXTERN /end MEASUREMENT
/begin MEASUREMENT B_uebvau "Bedingung Übergang von Beschleunigen oder Verzögern nach Aus erfolgt" UBYTE B_TRUE 1 100 0 1 BIT_MASK 0x20 FUNCTION_LIST FGRMD IF_DATA DIM_X 0x380ADA EXTERN BYTE IF_DATA MCMESS 0x380ADA EXTERN /end MEASUREMENT
/begin MEASUREMENT B_ugd "Bedingung: DK-Winkel größer als für 95% der max. rel. Füllung erforderlich" UWORD B_TRUE 1 100 0 1 BIT_MASK 0x1 FUNCTION_LIST BGMSZS ZWBTSK IF_DATA DIM_X 0xFD48 INTERN BYTE IF_DATA MCMESS 0xFD48 INTERN /end MEASUREMENT
/begin MEASUREMENT B_ugds "DK-Sollwinkel im ungedrosselten Bereich" UBYTE B_TRUE 1 100 0 1 BIT_MASK 0x10 FUNCTION_LIST FUEDK IF_DATA DIM_X 0x380AFD EXTERN BYTE IF_DATA MCMESS 0x380AFD EXTERN /end MEASUREMENT
/begin MEASUREMENT B_ugdsp "Bedingung praedizierter DK-Sollwinkel im ungedrosselten Bereich" UWORD B_TRUE 1 100 0 1 BIT_MASK 0x1000 FUNCTION_LIST BGRLP IF_DATA DIM_X 0xFD4E INTERN BYTE IF_DATA MCMESS 0xFD4E INTERN /end MEASUREMENT
/begin MEASUREMENT B_uhrrmin "Bedingung Uhr mit relativem Minutenzähler" UWORD B_TRUE 1 100 0 1 BIT_MASK 0x100 FUNCTION_LIST PROKON ATM BGTABS IF_DATA DIM_X 0xFD76 INTERN BYTE IF_DATA MCMESS 0xFD76 INTERN /end MEASUREMENT
/begin MEASUREMENT B_uhrrsec "Bedingung Uhr mit relativem Sekundenzähler" UWORD B_TRUE 1 100 0 1 BIT_MASK 0x200 FUNCTION_LIST PROKON AEKP ATM IF_DATA DIM_X 0xFD76 INTERN BYTE IF_DATA MCMESS 0xFD76 INTERN /end MEASUREMENT
/begin MEASUREMENT B_uhsig "Bedingung Sondenspannung hinter KAT im Spannungsband für Signalunterbrechung" UBYTE B_TRUE 1 100 0 1 BIT_MASK 0x1 FUNCTION_LIST DLSH IF_DATA DIM_X 0x380A81 EXTERN BYTE IF_DATA MCMESS 0x380A81 EXTERN /end MEASUREMENT
/begin MEASUREMENT B_uhsig2 "Bedingung Sondenspg. hinter KAT im Spannungsband für Signalunterbrechung Bank2" UBYTE B_TRUE 1 100 0 1 BIT_MASK 0x2 FUNCTION_LIST DLSH IF_DATA DIM_X 0x380A81 EXTERN BYTE IF_DATA MCMESS 0x380A81 EXTERN /end MEASUREMENT
/begin MEASUREMENT B_uk1 "Einschaltbedingung Übergangskompensation" UWORD B_TRUE 1 100 0 1 BIT_MASK 0x80 FUNCTION_LIST ESUK IF_DATA DIM_X 0xFD54 INTERN BYTE IF_DATA MCMESS 0xFD54 INTERN /end MEASUREMENT
/begin MEASUREMENT B_uka "Freigabebedingung ÜK-Adaption" UWORD B_TRUE 1 100 0 1 BIT_MASK 0x800 FUNCTION_LIST ESUKAS IF_DATA DIM_X 0xFD56 INTERN BYTE IF_DATA MCMESS 0xFD56 INTERN /end MEASUREMENT
/begin MEASUREMENT B_uka2 "Freigabebedingung ÜK-Adaption Zylinderbank 2" UWORD B_TRUE 1 100 0 1 BIT_MASK 0x1000 FUNCTION_LIST ESUKAS IF_DATA DIM_X 0xFD56 INTERN BYTE IF_DATA MCMESS 0xFD56 INTERN /end MEASUREMENT
/begin MEASUREMENT B_ukab "Bedingung gültiger Betriebsbereich für adaptive ÜK" UWORD B_TRUE 1 100 0 1 BIT_MASK 0x2000 FUNCTION_LIST ESUKAS IF_DATA DIM_X 0xFD56 INTERN BYTE IF_DATA MCMESS 0xFD56 INTERN /end MEASUREMENT
/begin MEASUREMENT B_ukabat "Bedingung Beschleunigung totzeitverschoben (ÜK-Adaption)" UWORD B_TRUE 1 100 0 1 BIT_MASK 0x4000 FUNCTION_LIST ESUKAS IF_DATA DIM_X 0xFD56 INTERN BYTE IF_DATA MCMESS 0xFD56 INTERN /end MEASUREMENT
/begin MEASUREMENT B_ukaukat "Bedingung:UK-Aktivität Anfang totzeitverschoben" UWORD B_TRUE 1 100 0 1 BIT_MASK 0x8000 FUNCTION_LIST ESUKAS IF_DATA DIM_X 0xFD56 INTERN BYTE IF_DATA MCMESS 0xFD56 INTERN /end MEASUREMENT
/begin MEASUREMENT B_ukauket "Bedingung: UK-Aktivität Ende totzeitverschoben" UWORD B_TRUE 1 100 0 1 BIT_MASK 0x1 FUNCTION_LIST ESUKAS IF_DATA DIM_X 0xFD58 INTERN BYTE IF_DATA MCMESS 0xFD58 INTERN /end MEASUREMENT
/begin MEASUREMENT B_ukava "Bedingung Verzögerung (ÜK-Adaption)" UWORD B_TRUE 1 100 0 1 BIT_MASK 0x2 FUNCTION_LIST ESUKAS IF_DATA DIM_X 0xFD58 INTERN BYTE IF_DATA MCMESS 0xFD58 INTERN /end MEASUREMENT
/begin MEASUREMENT B_ukavat "Bedingung Verzögerung totzeitverschoben (ÜK-Adaption)" UWORD B_TRUE 1 100 0 1 BIT_MASK 0x4 FUNCTION_LIST ESUKAS IF_DATA DIM_X 0xFD58 INTERN BYTE IF_DATA MCMESS 0xFD58 INTERN /end MEASUREMENT
/begin MEASUREMENT B_uke "Einschaltbedingung ÜK-Ersatzwert" UWORD B_TRUE 1 100 0 1 BIT_MASK 0x100 FUNCTION_LIST ESUK IF_DATA DIM_X 0xFD54 INTERN BYTE IF_DATA MCMESS 0xFD54 INTERN /end MEASUREMENT
/begin MEASUREMENT B_ukg "Bedingung Ük wirkt stark" UWORD B_TRUE 1 100 0 1 BIT_MASK 0x200 FUNCTION_LIST ESUK DKATLRS LRAEB T2DFA IF_DATA DIM_X 0xFD54 INTERN BYTE IF_DATA MCMESS 0xFD54 INTERN /end MEASUREMENT
/begin MEASUREMENT B_ukk "Einschaltbedingung ÜK Kurzzeit-Anteil" UWORD B_TRUE 1 100 0 1 BIT_MASK 0x400 FUNCTION_LIST ESUK IF_DATA DIM_X 0xFD54 INTERN BYTE IF_DATA MCMESS 0xFD54 INTERN /end MEASUREMENT
/begin MEASUREMENT B_ukns "Einschaltbedingung ÜK nach Start" UWORD B_TRUE 1 100 0 1 BIT_MASK 0x800 FUNCTION_LIST ESUK IF_DATA DIM_X 0xFD54 INTERN BYTE IF_DATA MCMESS 0xFD54 INTERN /end MEASUREMENT
/begin MEASUREMENT B_umae "Bedingung: Fehler beim UMA-Lernen" UWORD B_TRUE 1 100 0 1 BIT_MASK 0x4 FUNCTION_LIST BGDVE DDVE T2DVE IF_DATA DIM_X 0xFD38 INTERN BYTE IF_DATA MCMESS 0xFD38 INTERN /end MEASUREMENT
/begin MEASUREMENT B_umauab "Bedingung: UMA-Lernen während Urinitialisierung abgebrochen (SKA)" UWORD B_TRUE 1 100 0 1 BIT_MASK 0x8 FUNCTION_LIST BGDVE DDVE SREAKT IF_DATA DIM_X 0xFD38 INTERN BYTE IF_DATA MCMESS 0xFD38 INTERN /end MEASUREMENT
/begin MEASUREMENT B_update "B_update = false    kein Update der Zustandsgroessen in der LRS" UWORD B_TRUE 1 100 0 1 BIT_MASK 0x8000 FUNCTION_LIST LRS IF_DATA DIM_X 0xFD7A INTERN BYTE IF_DATA MCMESS 0xFD7A INTERN /end MEASUREMENT
/begin MEASUREMENT B_update2 "B_update2= false    kein Update der Zustandsgroessen in der LRS, Bank2" UWORD B_TRUE 1 100 0 1 BIT_MASK 0x1 FUNCTION_LIST LRS IF_DATA DIM_X 0xFD7C INTERN BYTE IF_DATA MCMESS 0xFD7C INTERN /end MEASUREMENT
/begin MEASUREMENT B_upw12e "Bedingung: Fehler bei Vergleich der beiden normierten PWG-Poti-Spannungen" UBYTE B_TRUE 1 100 0 1 BIT_MASK 0x4 FUNCTION_LIST GGPED IF_DATA DIM_X 0x380AC2 EXTERN BYTE IF_DATA MCMESS 0x380AC2 EXTERN /end MEASUREMENT
/begin MEASUREMENT B_upw1mn "Bedingung: Spannung PWG-Poti 1 unterhalb Minimalwert" UBYTE B_TRUE 1 100 0 1 BIT_MASK 0x8 FUNCTION_LIST GGPED IF_DATA DIM_X 0x380AC2 EXTERN BYTE IF_DATA MCMESS 0x380AC2 EXTERN /end MEASUREMENT
/begin MEASUREMENT B_upw1mx "Bedingung: Spannung PWG-Poti 1 oberhalb Maximalwert" UBYTE B_TRUE 1 100 0 1 BIT_MASK 0x10 FUNCTION_LIST GGPED IF_DATA DIM_X 0x380AC2 EXTERN BYTE IF_DATA MCMESS 0x380AC2 EXTERN /end MEASUREMENT
/begin MEASUREMENT B_upw2mn "Bedingung: Spannung PWG-Poti 2 unterhalb Minimalwert" UBYTE B_TRUE 1 100 0 1 BIT_MASK 0x20 FUNCTION_LIST GGPED IF_DATA DIM_X 0x380AC2 EXTERN BYTE IF_DATA MCMESS 0x380AC2 EXTERN /end MEASUREMENT
/begin MEASUREMENT B_upw2mx "Bedingung: Spannung PWG-Poti 2 oberhalb Maximalwert" UBYTE B_TRUE 1 100 0 1 BIT_MASK 0x40 FUNCTION_LIST GGPED IF_DATA DIM_X 0x380AC2 EXTERN BYTE IF_DATA MCMESS 0x380AC2 EXTERN /end MEASUREMENT
/begin MEASUREMENT B_upwbwf "Bewegungserkennung hat im aktuellen Fahrzyklus einen Fehler erkannt" UWORD B_TRUE 1 100 0 1 BIT_MASK 0x100 FUNCTION_LIST GGPED IF_DATA DIM_X 0xFD3C INTERN BYTE IF_DATA MCMESS 0xFD3C INTERN /end MEASUREMENT
/begin MEASUREMENT B_upwg1o "Bedingung Bereichsverletzung an PWG-Poti 1 nach oben" UWORD B_TRUE 1 100 0 1 BIT_MASK 0x800 FUNCTION_LIST GGPED IF_DATA DIM_X 0x381EBC EXTERN BYTE IF_DATA MCMESS 0x381EBC EXTERN /end MEASUREMENT
/begin MEASUREMENT B_upwg1u "Bedingung Bereichsverletzung an PWG-Poti 1 nach unten" UWORD B_TRUE 1 100 0 1 BIT_MASK 0x1000 FUNCTION_LIST GGPED IF_DATA DIM_X 0x381EBC EXTERN BYTE IF_DATA MCMESS 0x381EBC EXTERN /end MEASUREMENT
/begin MEASUREMENT B_upwg2o "Bedingung Bereichsverletzung an PWG-Poti 2 nach oben" UBYTE B_TRUE 1 100 0 1 BIT_MASK 0x1 FUNCTION_LIST GGPED IF_DATA DIM_X 0x380AC2 EXTERN BYTE IF_DATA MCMESS 0x380AC2 EXTERN /end MEASUREMENT
/begin MEASUREMENT B_upwg2u "Bedingung Bereichsverletzung an PWG-Poti 2 nach unten" UBYTE B_TRUE 1 100 0 1 BIT_MASK 0x2 FUNCTION_LIST GGPED IF_DATA DIM_X 0x380AC2 EXTERN BYTE IF_DATA MCMESS 0x380AC2 EXTERN /end MEASUREMENT
/begin MEASUREMENT B_usbeh "Bedingung für Zeitzähler zur Ausblendung der Sondenbelastung hinter KAT" UWORD B_TRUE 1 100 0 1 BIT_MASK 0x1000 FUNCTION_LIST GGLSH IF_DATA DIM_X 0xFD2E INTERN BYTE IF_DATA MCMESS 0xFD2E INTERN /end MEASUREMENT
/begin MEASUREMENT B_usbeh2 "Bedingung für Zeitzähler zur Ausblendung der Sondenbelastung hinter KAT Bank2" UWORD B_TRUE 1 100 0 1 BIT_MASK 0x2000 FUNCTION_LIST GGLSH IF_DATA DIM_X 0xFD2E INTERN BYTE IF_DATA MCMESS 0xFD2E INTERN /end MEASUREMENT
/begin MEASUREMENT B_ushkf "Bedingung Sondenspannung hinter Kat ""Fett"" (Sollwert überschritten)" UWORD B_TRUE 1 100 0 1 BIT_MASK 0x2 FUNCTION_LIST DLSAHK IF_DATA DIM_X 0xFD28 INTERN BYTE IF_DATA MCMESS 0xFD28 INTERN /end MEASUREMENT
/begin MEASUREMENT B_ushkf2 "Bedingung Sondenspannung hinter KAT ""Fett"" (Sollwert überschritten) Bank2" UWORD B_TRUE 1 100 0 1 BIT_MASK 0x4 FUNCTION_LIST DLSAHK IF_DATA DIM_X 0xFD28 INTERN BYTE IF_DATA MCMESS 0xFD28 INTERN /end MEASUREMENT
/begin MEASUREMENT B_ushkm "Bedingung Sondenspannung hinter KAT ""Mager"" (Sollwert unterschritten)" UWORD B_TRUE 1 100 0 1 BIT_MASK 0x8 FUNCTION_LIST DLSAHK IF_DATA DIM_X 0xFD28 INTERN BYTE IF_DATA MCMESS 0xFD28 INTERN /end MEASUREMENT
/begin MEASUREMENT B_ushkm2 "Bedingung Sondenspannung hinter KAT ""Mager"" (Sollwert unterschritten) Bank2" UWORD B_TRUE 1 100 0 1 BIT_MASK 0x10 FUNCTION_LIST DLSAHK IF_DATA DIM_X 0xFD28 INTERN BYTE IF_DATA MCMESS 0xFD28 INTERN /end MEASUREMENT
/begin MEASUREMENT B_ushsch "Bed. Schwelle für Sonde h. KAT im Schub nicht unterschritten `statichisch`" UBYTE B_TRUE 1 100 0 1 BIT_MASK 0x4 FUNCTION_LIST DLSAHK IF_DATA DIM_X 0x382FF1 EXTERN BYTE IF_DATA MCMESS 0x382FF1 EXTERN /end MEASUREMENT
/begin MEASUREMENT B_ushsch2 "Bed. Schwelle für Sonde h. KAT im Schub nicht unterschritten `statisch` Bank2" UBYTE B_TRUE 1 100 0 1 BIT_MASK 0x8 FUNCTION_LIST DLSAHK IF_DATA DIM_X 0x382FF1 EXTERN BYTE IF_DATA MCMESS 0x382FF1 EXTERN /end MEASUREMENT
/begin MEASUREMENT B_va "Bedingung Verzögerungsabmagerung (Anzeige)" UWORD B_TRUE 1 100 0 1 BIT_MASK 0x1000 FUNCTION_LIST ESUK IF_DATA DIM_X 0xFD54 INTERN BYTE IF_DATA MCMESS 0xFD54 INTERN /end MEASUREMENT
/begin MEASUREMENT B_vaau "Bedingung Verzögerungsabmagerung Aufteilung" UWORD B_TRUE 1 100 0 1 BIT_MASK 0x2000 FUNCTION_LIST ESUK IF_DATA DIM_X 0xFD54 INTERN BYTE IF_DATA MCMESS 0xFD54 INTERN /end MEASUREMENT
/begin MEASUREMENT B_vag "Bedingung starke Verzögerungsabmagerung" UWORD B_TRUE 1 100 0 1 BIT_MASK 0x4000 FUNCTION_LIST ESUK DSLSLRS LRSEB T2DFA IF_DATA DIM_X 0xFD54 INTERN BYTE IF_DATA MCMESS 0xFD54 INTERN /end MEASUREMENT
/begin MEASUREMENT B_vakl "Bedingung Verzögerungsabmagerung L- und K-Anteil" UWORD B_TRUE 1 100 0 1 BIT_MASK 0x8000 FUNCTION_LIST ESUK IF_DATA DIM_X 0xFD54 INTERN BYTE IF_DATA MCMESS 0xFD54 INTERN /end MEASUREMENT
/begin MEASUREMENT B_val "Bedingung Verzögerungsabmagerung L-Anteil" UWORD B_TRUE 1 100 0 1 BIT_MASK 0x1 FUNCTION_LIST ESUK IF_DATA DIM_X 0xFD56 INTERN BYTE IF_DATA MCMESS 0xFD56 INTERN /end MEASUREMENT
/begin MEASUREMENT B_vbemg "Bedingung Verbrennungserkennung möglich" UWORD B_TRUE 1 100 0 1 BIT_MASK 0x4000 FUNCTION_LIST ESSTT BGTABS STADAP IF_DATA DIM_X 0xFD52 INTERN BYTE IF_DATA MCMESS 0xFD52 INTERN /end MEASUREMENT
/begin MEASUREMENT B_vbmg "Bedingung Verbrennung möglich" UWORD B_TRUE 1 100 0 1 BIT_MASK 0x8000 FUNCTION_LIST ESSTT IF_DATA DIM_X 0xFD52 INTERN BYTE IF_DATA MCMESS 0xFD52 INTERN /end MEASUREMENT
/begin MEASUREMENT B_vekat "Fehlerverdacht bei Katdiagnose" UBYTE B_TRUE 1 100 0 1 BIT_MASK 0x1 FUNCTION_LIST DKATLRS DLSU IF_DATA DIM_X 0x382FE9 EXTERN BYTE IF_DATA MCMESS 0x382FE9 EXTERN /end MEASUREMENT
/begin MEASUREMENT B_vekat2 "Fehlerverdacht bei Katdiagnose, Bank2" UBYTE B_TRUE 1 100 0 1 BIT_MASK 0x2 FUNCTION_LIST DKATLRS DLSU IF_DATA DIM_X 0x382FE9 EXTERN BYTE IF_DATA MCMESS 0x382FE9 EXTERN /end MEASUREMENT
/begin MEASUREMENT B_vfzgget "Bedingung VFZG Schwelle entprellt überschritten" UBYTE B_TRUE 1 100 0 1 BIT_MASK 0x2 FUNCTION_LIST GGTGET IF_DATA DIM_X 0x380B68 EXTERN BYTE IF_DATA MCMESS 0x380B68 EXTERN /end MEASUREMENT
/begin MEASUREMENT B_vfzggetx "Bedingung VFZGMAX-Schwelle entprellt überschritten" UBYTE B_TRUE 1 100 0 1 BIT_MASK 0x4 FUNCTION_LIST GGTGET IF_DATA DIM_X 0x380B68 EXTERN BYTE IF_DATA MCMESS 0x380B68 EXTERN /end MEASUREMENT
/begin MEASUREMENT B_vl "Bedingung Vollast" UWORD B_TRUE 1 100 0 1 BIT_MASK 0x4 FUNCTION_LIST MDFAW LRAEB T2DFA T2LID IF_DATA DIM_X 0xFD6E INTERN BYTE IF_DATA MCMESS 0xFD6E INTERN /end MEASUREMENT
/begin MEASUREMENT B_vllr "Bedingung Fahrzeug rollt mit eingelegtem Gang" UWORD B_TRUE 1 100 0 1 BIT_MASK 0x1000 FUNCTION_LIST LLRBB LLRRM MDVERAD IF_DATA DIM_X 0xFD68 INTERN BYTE IF_DATA MCMESS 0xFD68 INTERN /end MEASUREMENT
/begin MEASUREMENT B_vmax "Bedingung VMAX-Regelung aktiv" UWORD dez 1 100 0 1 BIT_MASK 0x100 FUNCTION_LIST VMAXMD IF_DATA DIM_X 0xFD70 INTERN BYTE IF_DATA MCMESS 0xFD70 INTERN /end MEASUREMENT
/begin MEASUREMENT B_vnull "Bedingung Fahrzeug steht" UWORD B_TRUE 1 100 0 1 BIT_MASK 0x2000 FUNCTION_LIST GGVFZG BBGANG MDFAW IF_DATA DIM_X 0xFD30 INTERN BYTE IF_DATA MCMESS 0xFD30 INTERN /end MEASUREMENT
/begin MEASUREMENT B_vs "Bedingung Ventilhub gross" UWORD B_TRUE 1 100 0 1 BIT_MASK 0x2 FUNCTION_LIST VS BGSRM DFFTCNV DMDDVS DMDLU DVS ESVW LLRNS LRSEB T2LID IF_DATA DIM_X 0xFD8E INTERN BYTE IF_DATA MCMESS 0xFD8E INTERN /end MEASUREMENT
/begin MEASUREMENT B_vsa "Bedingung Ventilhubsteuerung aktiv" UWORD B_TRUE 1 100 0 1 BIT_MASK 0x4 FUNCTION_LIST VS NMAXMD IF_DATA DIM_X 0xFD8E INTERN BYTE IF_DATA MCMESS 0xFD8E INTERN /end MEASUREMENT
/begin MEASUREMENT B_vsal "Lokales Freigabebit ohne Rückkopplung)" UWORD B_TRUE 1 100 0 1 BIT_MASK 0x8 FUNCTION_LIST VS IF_DATA DIM_X 0xFD8E INTERN BYTE IF_DATA MCMESS 0xFD8E INTERN /end MEASUREMENT
/begin MEASUREMENT B_vsfg "Bedingung Ventilhub gross im Fehlerfall" UWORD B_TRUE 1 100 0 1 BIT_MASK 0x2000 FUNCTION_LIST VS DMDMIL T2LID IF_DATA DIM_X 0x382CBC EXTERN BYTE IF_DATA MCMESS 0x382CBC EXTERN /end MEASUREMENT
/begin MEASUREMENT B_vsfk "Bedingung Ventilhub klein im Fehlerfall" UWORD B_TRUE 1 100 0 1 BIT_MASK 0x4000 FUNCTION_LIST VS DMDMIL MDEX T2LID IF_DATA DIM_X 0x382CBC EXTERN BYTE IF_DATA MCMESS 0x382CBC EXTERN /end MEASUREMENT
/begin MEASUREMENT B_vsgw "Bedingung Ventilhub gross nach Verzögerung bei Gangwechsel" UWORD B_TRUE 1 100 0 1 BIT_MASK 0x10 FUNCTION_LIST VS esvs ESWL IF_DATA DIM_X 0xFD8E INTERN BYTE IF_DATA MCMESS 0xFD8E INTERN /end MEASUREMENT
/begin MEASUREMENT B_vsl "Bedingung Ventilhub gross lokal" UWORD B_TRUE 1 100 0 1 BIT_MASK 0x1000 FUNCTION_LIST VS IF_DATA DIM_X 0x382CBC EXTERN BYTE IF_DATA MCMESS 0x382CBC EXTERN /end MEASUREMENT
/begin MEASUREMENT B_vsnwsa "Bedingung VS verbietet Nockenwellenumschaltung" UWORD B_TRUE 1 100 0 1 BIT_MASK 0x20 FUNCTION_LIST VS NWS IF_DATA DIM_X 0xFD8E INTERN BYTE IF_DATA MCMESS 0xFD8E INTERN /end MEASUREMENT
/begin MEASUREMENT B_vssfk "Bedingung mindestens ein Ventil hängt auf kleiner oder unplausibler Position" UWORD B_TRUE 1 100 0 1 BIT_MASK 0x40 FUNCTION_LIST VS MDEX IF_DATA DIM_X 0xFD8E INTERN BYTE IF_DATA MCMESS 0xFD8E INTERN /end MEASUREMENT
/begin MEASUREMENT B_vssrm "Umschaltung Parametersatz für Füllungserfassung" UWORD B_TRUE 1 100 0 1 BIT_MASK 0x80 FUNCTION_LIST VS BGSRM IF_DATA DIM_X 0xFD8E INTERN BYTE IF_DATA MCMESS 0xFD8E INTERN /end MEASUREMENT
/begin MEASUREMENT B_vsv "Bestromung Schaltventile" UWORD B_TRUE 1 100 0 1 BIT_MASK 0x100 FUNCTION_LIST VS BGTMPK DHFM DVSE GK KRKE MDVER T2LID VSST ZWVS IF_DATA DIM_X 0xFD8E INTERN BYTE IF_DATA MCMESS 0xFD8E INTERN /end MEASUREMENT
/begin MEASUREMENT B_vsw "Bedingung Wechsel Ventilhub" UWORD B_TRUE 1 100 0 1 BIT_MASK 0x200 FUNCTION_LIST VS BGSRM DMDSTP DVS IF_DATA DIM_X 0xFD8E INTERN BYTE IF_DATA MCMESS 0xFD8E INTERN /end MEASUREMENT
/begin MEASUREMENT B_vsz "Bedingung ZW-Freigabe durch Ventilhubsteuerung" UWORD B_TRUE 1 100 0 1 BIT_MASK 0x8 FUNCTION_LIST ZWVS IF_DATA DIM_X 0xFD90 INTERN BYTE IF_DATA MCMESS 0xFD90 INTERN /end MEASUREMENT
/begin MEASUREMENT B_vzl_um "erkannter Low-Pegel am FGR-Bedienhebelschalter Verzögern in der Funktionsüberw." UBYTE B_TRUE 1 100 0 1 BIT_MASK 0x8 FUNCTION_LIST UFURAM IF_DATA DIM_X 0x382E43 EXTERN WORD IF_DATA MCMESS 0x382E43 EXTERN /end MEASUREMENT
/begin MEASUREMENT B_wal_um "erkannter Low-Pegel am FGR-Bedienhebelschalter Wiederaufnahme in Funktionsüberw." UBYTE B_TRUE 1 100 0 1 BIT_MASK 0x20 FUNCTION_LIST UFURAM IF_DATA DIM_X 0x382E43 EXTERN WORD IF_DATA MCMESS 0x382E43 EXTERN /end MEASUREMENT
/begin MEASUREMENT B_wavo "Bedingung Wiederaufnahme von oben" UBYTE B_TRUE 1 100 0 1 BIT_MASK 0x40 FUNCTION_LIST FGRMD IF_DATA DIM_X 0x380ADA EXTERN BYTE IF_DATA MCMESS 0x380ADA EXTERN /end MEASUREMENT
/begin MEASUREMENT B_wdk12ev "Bedingung Vorläufiger Gleichlauffehler der DK-Potis" UWORD B_TRUE 1 100 0 1 BIT_MASK 0x20 FUNCTION_LIST GGDVE IF_DATA DIM_X 0xFD3A INTERN BYTE IF_DATA MCMESS 0xFD3A INTERN /end MEASUREMENT
/begin MEASUREMENT B_wdk13ev "Bedingung Vorläufige Unplausibilität zw. DK-Poti 1 und Ersatzwert aus Füllung" UWORD B_TRUE 1 100 0 1 BIT_MASK 0x40 FUNCTION_LIST GGDVE IF_DATA DIM_X 0xFD3A INTERN BYTE IF_DATA MCMESS 0xFD3A INTERN /end MEASUREMENT
/begin MEASUREMENT B_wdk1v "Bedingung Berechnung des DK-Winkels aus verstärktem Signal von Poti 1" UWORD B_TRUE 1 100 0 1 BIT_MASK 0x80 FUNCTION_LIST GGDVE ADVE FUEDKSA IF_DATA DIM_X 0xFD3A INTERN BYTE IF_DATA MCMESS 0xFD3A INTERN /end MEASUREMENT
/begin MEASUREMENT B_wdk23ev "Bedingung Vorläufige Unplausibilität zw. DK-Poti 2 und Ersatzwert aus Füllung" UWORD B_TRUE 1 100 0 1 BIT_MASK 0x100 FUNCTION_LIST GGDVE IF_DATA DIM_X 0xFD3A INTERN BYTE IF_DATA MCMESS 0xFD3A INTERN /end MEASUREMENT
/begin MEASUREMENT B_wdk2sel "Bedingung DK-Winkel-Berechnung für Lageregler aus Poti 2" UWORD B_TRUE 1 100 0 1 BIT_MASK 0x200 FUNCTION_LIST GGDVE ADVE BGDVE DUF T2DVE UFRLC IF_DATA DIM_X 0xFD3A INTERN BYTE IF_DATA MCMESS 0xFD3A INTERN /end MEASUREMENT
/begin MEASUREMENT B_wdk2st "Bedingung DK-Winkel-Berechnung für Lageregler temporär aus Poti 2" UWORD B_TRUE 1 100 0 1 BIT_MASK 0x400 FUNCTION_LIST GGDVE IF_DATA DIM_X 0xFD3A INTERN BYTE IF_DATA MCMESS 0xFD3A INTERN /end MEASUREMENT
/begin MEASUREMENT B_wdkap "Bedingung: DK-Sollwert aus appl. Kennlinie bzw. im Start aus Startwinkel" UBYTE B_TRUE 1 100 0 1 BIT_MASK 0x20 FUNCTION_LIST FUEDK IF_DATA DIM_X 0x380AFD EXTERN BYTE IF_DATA MCMESS 0x380AFD EXTERN /end MEASUREMENT
/begin MEASUREMENT B_wdksap "DK-Steuerung über Festwert, Bit 1 hat Priorität" UWORD B_TRUE 1 100 0 1 BIT_MASK 0x400 FUNCTION_LIST PROKON FUEDK IF_DATA DIM_X 0xFD76 INTERN BYTE IF_DATA MCMESS 0xFD76 INTERN /end MEASUREMENT
/begin MEASUREMENT B_wdksauf "Bedingung: DLR, Sollsprung in Richtung AUF" UWORD B_TRUE 1 100 0 1 BIT_MASK 0x8 FUNCTION_LIST ADVE IF_DATA DIM_X 0xFD34 INTERN BYTE IF_DATA MCMESS 0xFD34 INTERN /end MEASUREMENT
/begin MEASUREMENT B_wdksive "Bedingung: Fehler im Vergleich DK-Winkel-Sollwert/-Istwert" UWORD B_TRUE 1 100 0 1 BIT_MASK 0x10 FUNCTION_LIST ADVE DDVE SREAKT IF_DATA DIM_X 0xFD34 INTERN BYTE IF_DATA MCMESS 0xFD34 INTERN /end MEASUREMENT
/begin MEASUREMENT B_wdksom "Drosselklappensollwinkel ohne Momentenstruktur aktiv" UWORD B_TRUE 1 100 0 1 BIT_MASK 0x100 FUNCTION_LIST SWADP FUEDK IF_DATA DIM_X 0xFD86 INTERN BYTE IF_DATA MCMESS 0xFD86 INTERN /end MEASUREMENT
/begin MEASUREMENT B_wf "Bedingung Wandfilmberechnung" UWORD B_TRUE 1 100 0 1 BIT_MASK 0x2 FUNCTION_LIST ESUK IF_DATA DIM_X 0xFD56 INTERN BYTE IF_DATA MCMESS 0xFD56 INTERN /end MEASUREMENT
/begin MEASUREMENT B_wfsstfr "Bedingung Wegfahrsperre: Starter aktuell freigegeben" UBYTE B_TRUE 1 100 0 1 BIT_MASK 0x1 FUNCTION_LIST WFS STA IF_DATA DIM_X 0x3830B5 EXTERN BYTE IF_DATA MCMESS 0x3830B5 EXTERN /end MEASUREMENT
/begin MEASUREMENT B_wiauf "Bedingung FGR im Zustand Wiederaufnahme" UBYTE B_TRUE 1 100 0 1 BIT_MASK 0x80 FUNCTION_LIST FGRMD IF_DATA DIM_X 0x380ADA EXTERN BYTE IF_DATA MCMESS 0x380ADA EXTERN /end MEASUREMENT
/begin MEASUREMENT B_wk "Bedingung: Wandlerkupplung überbrückt" UWORD B_TRUE 1 100 0 1 BIT_MASK 0x4 FUNCTION_LIST WK IF_DATA DIM_X 0xFD0C INTERN BYTE IF_DATA MCMESS 0xFD0C INTERN /end MEASUREMENT
/begin MEASUREMENT B_wkr "Bedingung für Wandlerkupplung geregelt" UWORD B_TRUE 1 100 0 1 BIT_MASK 0x8 FUNCTION_LIST WK ARMD IF_DATA DIM_X 0xFD0C INTERN BYTE IF_DATA MCMESS 0xFD0C INTERN /end MEASUREMENT
/begin MEASUREMENT B_wkral "Bedingung wkr aus KR-Adaptionskennfeld einlesen" UWORD B_TRUE 1 100 0 1 BIT_MASK 0x200 FUNCTION_LIST KRRA IF_DATA DIM_X 0xFD64 INTERN BYTE IF_DATA MCMESS 0xFD64 INTERN /end MEASUREMENT
/begin MEASUREMENT B_wks "Bedingung Wiederholkaltstart" UWORD B_TRUE 1 100 0 1 BIT_MASK 0x1 FUNCTION_LIST ESSTT ESNST ESWL STADAP IF_DATA DIM_X 0xFD54 INTERN BYTE IF_DATA MCMESS 0xFD54 INTERN /end MEASUREMENT
/begin MEASUREMENT B_wnwi2out "Bedingung: Winkeldifferenz wnwi2_ad_w nicht plausibel" UWORD B_TRUE 1 100 0 1 BIT_MASK 0x1000 FUNCTION_LIST WANWKW NLDG IF_DATA DIM_X 0xFD1A INTERN BYTE IF_DATA MCMESS 0xFD1A INTERN /end MEASUREMENT
/begin MEASUREMENT B_wnwiout "Bedingung: Winkeldifferenz wnwi_ad_w nicht plausibel" UWORD B_TRUE 1 100 0 1 BIT_MASK 0x2000 FUNCTION_LIST WANWKW NLDG IF_DATA DIM_X 0xFD1A INTERN BYTE IF_DATA MCMESS 0xFD1A INTERN /end MEASUREMENT
/begin MEASUREMENT B_wnwioutx "Bedingung für unplausiblen Winkelfehler" UWORD B_TRUE 1 100 0 1 BIT_MASK 0x200 FUNCTION_LIST NLDG IF_DATA DIM_X 0xFD18 INTERN BYTE IF_DATA MCMESS 0xFD18 INTERN /end MEASUREMENT
/begin MEASUREMENT B_wpabnb "Bedingung Änderungsbegrenzung des Pedalwerts nach Bremsbetätigung" UWORD B_TRUE 1 100 0 1 BIT_MASK 0x200 FUNCTION_LIST GGPED IF_DATA DIM_X 0xFD3C INTERN BYTE IF_DATA MCMESS 0xFD3C INTERN /end MEASUREMENT
/begin MEASUREMENT B_wpmbbr "Bedingung Maximalbegrenzung des Pedalwerts bei Bremsbetätigung" UWORD B_TRUE 1 100 0 1 BIT_MASK 0x400 FUNCTION_LIST GGPED IF_DATA DIM_X 0xFD3C INTERN BYTE IF_DATA MCMESS 0xFD3C INTERN /end MEASUREMENT
/begin MEASUREMENT B_wprmdbgv "Bedingung Reset B_mibgv wegen Unterschreitung Pedalwinkelschwelle" UWORD B_TRUE 1 100 0 1 BIT_MASK 0x400 FUNCTION_LIST MDBGV IF_DATA DIM_X 0xFD6C INTERN BYTE IF_DATA MCMESS 0xFD6C INTERN /end MEASUREMENT
/begin MEASUREMENT B_wst "Bedingung Wiederholstart" UWORD B_TRUE 1 100 0 1 BIT_MASK 0x2 FUNCTION_LIST ESSTT BBKHZ IF_DATA DIM_X 0xFD54 INTERN BYTE IF_DATA MCMESS 0xFD54 INTERN /end MEASUREMENT
/begin MEASUREMENT B_wst0 "Bedingung Wiederholstart (Anteil 1: erkannte Verbrennungen)" UBYTE B_TRUE 1 100 0 1 BIT_MASK 0x2 FUNCTION_LIST ESSTT IF_DATA DIM_X 0x383002 EXTERN BYTE IF_DATA MCMESS 0x383002 EXTERN /end MEASUREMENT
/begin MEASUREMENT B_wst1 "Bedingung Wiederholstart (Anteil 2: Abstellzeit)" UWORD B_TRUE 1 100 0 1 BIT_MASK 0x4 FUNCTION_LIST ESSTT IF_DATA DIM_X 0xFD54 INTERN BYTE IF_DATA MCMESS 0xFD54 INTERN /end MEASUREMENT
/begin MEASUREMENT B_wst2 "Bedingung Wiederholstart (Anteil1: letzter Zyklus erkannte Verbrennungen)" UWORD B_TRUE 1 100 0 1 BIT_MASK 0x8 FUNCTION_LIST ESSTT IF_DATA DIM_X 0xFD54 INTERN BYTE IF_DATA MCMESS 0xFD54 INTERN /end MEASUREMENT
/begin MEASUREMENT B_wu "Flagge Verzögerungszeit TVLSUWU abgelaufen" UWORD B_TRUE 1 100 0 1 BIT_MASK 0x400 FUNCTION_LIST HLSU IF_DATA DIM_X 0xFD80 INTERN BYTE IF_DATA MCMESS 0xFD80 INTERN /end MEASUREMENT
/begin MEASUREMENT B_wu2 "Flagge Verzögerungszeit TVLSUWU abgelaufen, LSU2" UWORD B_TRUE 1 100 0 1 BIT_MASK 0x800 FUNCTION_LIST HLSU IF_DATA DIM_X 0xFD80 INTERN BYTE IF_DATA MCMESS 0xFD80 INTERN /end MEASUREMENT
/begin MEASUREMENT B_wuc "Bedingung 'warm up cycle' erkannt" UBYTE B_TRUE 1 100 0 1 BIT_MASK 0x1 FUNCTION_LIST DWUC IF_DATA DIM_X 0x380A15 EXTERN BYTE IF_DATA MCMESS 0x380A15 EXTERN /end MEASUREMENT
/begin MEASUREMENT B_wvlsn "Bedingung Vollastzündwinkel spät Motorschutz" UWORD B_TRUE 1 100 0 1 BIT_MASK 0x1 FUNCTION_LIST ZWBTSK IF_DATA DIM_X 0xFD90 INTERN BYTE IF_DATA MCMESS 0xFD90 INTERN /end MEASUREMENT
/begin MEASUREMENT B_y2max "Integralanteil der LRS hat obere Schranke erreicht" UWORD B_TRUE 1 100 0 1 BIT_MASK 0x2 FUNCTION_LIST LRS IF_DATA DIM_X 0xFD7C INTERN BYTE IF_DATA MCMESS 0xFD7C INTERN /end MEASUREMENT
/begin MEASUREMENT B_y2max2 "Integralanteil der LRS hat obere Schranke erreicht, Bank2" UWORD B_TRUE 1 100 0 1 BIT_MASK 0x4 FUNCTION_LIST LRS IF_DATA DIM_X 0xFD7C INTERN BYTE IF_DATA MCMESS 0xFD7C INTERN /end MEASUREMENT
/begin MEASUREMENT B_y2min "Integralanteil der LRS hat untere Schranke erreicht" UWORD B_TRUE 1 100 0 1 BIT_MASK 0x8 FUNCTION_LIST LRS IF_DATA DIM_X 0xFD7C INTERN BYTE IF_DATA MCMESS 0xFD7C INTERN /end MEASUREMENT
/begin MEASUREMENT B_y2min2 "Integralanteil der LRS hat untere Schranke erreicht, Bank2" UWORD B_TRUE 1 100 0 1 BIT_MASK 0x10 FUNCTION_LIST LRS IF_DATA DIM_X 0xFD7C INTERN BYTE IF_DATA MCMESS 0xFD7C INTERN /end MEASUREMENT
/begin MEASUREMENT B_z1 "Bedingung Zündbereich 1 aktiv" UWORD B_TRUE 1 100 0 1 BIT_MASK 0x100 FUNCTION_LIST AZUE IF_DATA DIM_X 0xFD00 INTERN BYTE IF_DATA MCMESS 0xFD00 INTERN /end MEASUREMENT
/begin MEASUREMENT B_z1not "Flag Zündbereich 1 aktiv :  Anforderung im Notlauf" UWORD B_TRUE 1 100 0 1 BIT_MASK 0x200 FUNCTION_LIST AZUE IF_DATA DIM_X 0xFD00 INTERN BYTE IF_DATA MCMESS 0xFD00 INTERN /end MEASUREMENT
/begin MEASUREMENT B_za "Bedingung Zwangsamplitude" UWORD B_TRUE 1 100 0 1 BIT_MASK 0x20 FUNCTION_LIST LRS DLSU IF_DATA DIM_X 0xFD7C INTERN BYTE IF_DATA MCMESS 0xFD7C INTERN /end MEASUREMENT
/begin MEASUREMENT B_za2 "Bedingung Zwangsamplitude, Bank2" UWORD B_TRUE 1 100 0 1 BIT_MASK 0x40 FUNCTION_LIST LRS DLSU IF_DATA DIM_X 0xFD7C INTERN BYTE IF_DATA MCMESS 0xFD7C INTERN /end MEASUREMENT
/begin MEASUREMENT B_zesync "Bedingung Zündung synchronisiert" UWORD B_TRUE 1 100 0 1 BIT_MASK 0x400 FUNCTION_LIST AZUE IF_DATA DIM_X 0xFD00 INTERN BYTE IF_DATA MCMESS 0xFD00 INTERN /end MEASUREMENT
/begin MEASUREMENT B_zk1mdbgv "Bedingung ZK1 wirkt bei geschw.-abh. Momentenaufbaubegrenzung" UWORD B_TRUE 1 100 0 1 BIT_MASK 0x800 FUNCTION_LIST MDBGV IF_DATA DIM_X 0xFD6C INTERN BYTE IF_DATA MCMESS 0xFD6C INTERN /end MEASUREMENT
/begin MEASUREMENT B_zkatb "Bankspezifische Zykluszeit für MODE 6" UWORD B_TRUE 1 100 0 1 BIT_MASK 0x40 FUNCTION_LIST DKATLRS IF_DATA DIM_X 0xFD22 INTERN BYTE IF_DATA MCMESS 0xFD22 INTERN /end MEASUREMENT
/begin MEASUREMENT B_zkatb2 "Bankspezifische Zykluszeit für MODE 6 (stereo 2.Bank)" UWORD B_TRUE 1 100 0 1 BIT_MASK 0x80 FUNCTION_LIST DKATLRS IF_DATA DIM_X 0xFD22 INTERN BYTE IF_DATA MCMESS 0xFD22 INTERN /end MEASUREMENT
/begin MEASUREMENT B_zkats "Zykluszeit für eine Bank abgelaufen" UWORD B_TRUE 1 100 0 1 BIT_MASK 0x100 FUNCTION_LIST DKATLRS IF_DATA DIM_X 0xFD22 INTERN BYTE IF_DATA MCMESS 0xFD22 INTERN /end MEASUREMENT
/begin MEASUREMENT B_zkats2 "Zykluszeit für 2. Bank abgelaufen" UWORD B_TRUE 1 100 0 1 BIT_MASK 0x200 FUNCTION_LIST DKATLRS IF_DATA DIM_X 0xFD22 INTERN BYTE IF_DATA MCMESS 0xFD22 INTERN /end MEASUREMENT
/begin MEASUREMENT B_zkatz "Bedinging für Summenfehler im MODE 6" UWORD B_TRUE 1 100 0 1 BIT_MASK 0x400 FUNCTION_LIST DKATLRS IF_DATA DIM_X 0xFD22 INTERN BYTE IF_DATA MCMESS 0xFD22 INTERN /end MEASUREMENT
/begin MEASUREMENT B_zkatz2 "Bedingung für Summenfehler im MODE 6 (Stereo 2.Bank)" UWORD B_TRUE 1 100 0 1 BIT_MASK 0x800 FUNCTION_LIST DKATLRS IF_DATA DIM_X 0xFD22 INTERN BYTE IF_DATA MCMESS 0xFD22 INTERN /end MEASUREMENT
/begin MEASUREMENT B_zoptm "Bedingung: Zyklusfreigabe von Unplausibilitätsprüfung oben TMOT-Signal" UBYTE B_TRUE 1 100 0 1 BIT_MASK 0x4 FUNCTION_LIST GGTFM IF_DATA DIM_X 0x380B55 EXTERN BYTE IF_DATA MCMESS 0x380B55 EXTERN /end MEASUREMENT
/begin MEASUREMENT B_zprel "Bedingung Zahnentprellung erfolgt" UWORD B_TRUE 1 100 0 1 BIT_MASK 0x2 FUNCTION_LIST GGDPG ALE DDG IF_DATA DIM_X 0xFD16 INTERN BYTE IF_DATA MCMESS 0xFD16 INTERN /end MEASUREMENT
/begin MEASUREMENT B_zslsp "lokales Zyklusflag: Sekundärluft-System" UBYTE B_TRUE 1 100 0 1 BIT_MASK 0x20 FUNCTION_LIST DSLSLRS T2LID IF_DATA DIM_X 0x380905 EXTERN BYTE IF_DATA MCMESS 0x380905 EXTERN /end MEASUREMENT
/begin MEASUREMENT B_zslsp2 "lokales Zyklusflag: Sekundärluft-System, Bank 2" UBYTE B_TRUE 1 100 0 1 BIT_MASK 0x10 FUNCTION_LIST DSLSLRS T2LID IF_DATA DIM_X 0x380906 EXTERN BYTE IF_DATA MCMESS 0x380906 EXTERN /end MEASUREMENT
/begin MEASUREMENT B_zslvp "lokales Zyklusflag: Sekundärluftventil" UBYTE B_TRUE 1 100 0 1 BIT_MASK 0x4 FUNCTION_LIST DSLSLRS IF_DATA DIM_X 0x380900 EXTERN BYTE IF_DATA MCMESS 0x380900 EXTERN /end MEASUREMENT
/begin MEASUREMENT B_zslvp2 "lokales Zyklusflag: Sekundärluftventil, Bank 2" UBYTE B_TRUE 1 100 0 1 BIT_MASK 0x80 FUNCTION_LIST DSLSLRS IF_DATA DIM_X 0x380906 EXTERN BYTE IF_DATA MCMESS 0x380906 EXTERN /end MEASUREMENT
/begin MEASUREMENT B_ztev "Bedingung Endstufendiagnose TEV zu" UWORD B_TRUE 1 100 0 1 BIT_MASK 0x4000 FUNCTION_LIST DTEVE IF_DATA DIM_X 0xFD42 INTERN BYTE IF_DATA MCMESS 0xFD42 INTERN /end MEASUREMENT
/begin MEASUREMENT B_zwappl "Bedingung Zündwinkelapplikation ohne Drehmomenteingriffe" UWORD B_TRUE 1 100 0 1 BIT_MASK 0x800 FUNCTION_LIST PROKON ZUE IF_DATA DIM_X 0xFD76 INTERN BYTE IF_DATA MCMESS 0xFD76 INTERN /end MEASUREMENT
/begin MEASUREMENT B_zwget "Zündwinkeleingriff durch Getriebeeingriff" UWORD B_TRUE 1 100 0 1 BIT_MASK 0x100 FUNCTION_LIST MDKOG IF_DATA DIM_X 0xFD6E INTERN BYTE IF_DATA MCMESS 0xFD6E INTERN /end MEASUREMENT
/begin MEASUREMENT B_zwkra "Bedingung: Zündwinkel der KR wird ausgegeben" UWORD B_TRUE 1 100 0 1 BIT_MASK 0x1000 FUNCTION_LIST ZUE IF_DATA DIM_X 0xFD8E INTERN BYTE IF_DATA MCMESS 0xFD8E INTERN /end MEASUREMENT
/begin MEASUREMENT B_zwkraa "Bedingung Zündwinkel der KR wird ausgegeben" UWORD B_TRUE 1 100 0 1 BIT_MASK 0x400 FUNCTION_LIST KRRA KRDY IF_DATA DIM_X 0xFD64 INTERN BYTE IF_DATA MCMESS 0xFD64 INTERN /end MEASUREMENT
/begin MEASUREMENT B_zwkrum "Flag: schnelle Frühverstellung" UWORD B_TRUE 1 100 0 1 BIT_MASK 0x800 FUNCTION_LIST KRRA IF_DATA DIM_X 0xFD64 INTERN BYTE IF_DATA MCMESS 0xFD64 INTERN /end MEASUREMENT
/begin MEASUREMENT B_zwksc "Zündinkeleingriff bei Knallstart" UWORD B_TRUE 1 100 0 1 BIT_MASK 0x200 FUNCTION_LIST MDKOG IF_DATA DIM_X 0xFD6E INTERN BYTE IF_DATA MCMESS 0xFD6E INTERN /end MEASUREMENT
/begin MEASUREMENT B_zwmnste "Bedingung Abregelung der Zündwinkelspätbegrenzung erfüllt" UWORD B_TRUE 1 100 0 1 BIT_MASK 0x2 FUNCTION_LIST ZWMIN IF_DATA DIM_X 0xFD90 INTERN BYTE IF_DATA MCMESS 0xFD90 INTERN /end MEASUREMENT
/begin MEASUREMENT B_zwms "Bedingung Motorschutz-Zündwinkelbegrenzung" UWORD B_TRUE 1 100 0 1 BIT_MASK 0x4 FUNCTION_LIST ZWMIN IF_DATA DIM_X 0xFD90 INTERN BYTE IF_DATA MCMESS 0xFD90 INTERN /end MEASUREMENT
/begin MEASUREMENT B_zwnget "Zündwinkeleingriff nicht durch Getriebeeingriff" UWORD B_TRUE 1 100 0 1 BIT_MASK 0x400 FUNCTION_LIST MDKOG IF_DATA DIM_X 0xFD6E INTERN BYTE IF_DATA MCMESS 0xFD6E INTERN /end MEASUREMENT
/begin MEASUREMENT B_zws0 "Bedingung Übergang zur einfachen Schliesszeitüberlappung - Schliesszeitausgabe" UWORD B_TRUE 1 100 0 1 BIT_MASK 0x800 FUNCTION_LIST AZUE IF_DATA DIM_X 0xFD00 INTERN BYTE IF_DATA MCMESS 0xFD00 INTERN /end MEASUREMENT
/begin MEASUREMENT B_zwspae "Bedingung: Zündwinkel zwspae bei Schubabschaltung wird ausgegeben" UWORD B_TRUE 1 100 0 1 BIT_MASK 0x2000 FUNCTION_LIST ZUE IF_DATA DIM_X 0xFD8E INTERN BYTE IF_DATA MCMESS 0xFD8E INTERN /end MEASUREMENT
/begin MEASUREMENT B_zwvs "Bedingung für schnellen äußeren ZW-Eingriff der Momentenschnittstelle" UWORD B_TRUE 1 100 0 1 BIT_MASK 0x800 FUNCTION_LIST MDKOG MDZW IF_DATA DIM_X 0xFD6E INTERN BYTE IF_DATA MCMESS 0xFD6E INTERN /end MEASUREMENT
/begin MEASUREMENT B_zwvz "Bedingung für Zündwinkeleingriff der Momentenschnittstelle" UWORD B_TRUE 1 100 0 1 BIT_MASK 0x1000 FUNCTION_LIST MDKOG MDAUTG MDZW IF_DATA DIM_X 0xFD6E INTERN BYTE IF_DATA MCMESS 0xFD6E INTERN /end MEASUREMENT
/begin MEASUREMENT B_zwvzm "" UWORD B_TRUE 1 100 0 1 BIT_MASK 0x800 FUNCTION_LIST MDZW IF_DATA DIM_X 0xFD8E INTERN BYTE IF_DATA MCMESS 0xFD8E INTERN /end MEASUREMENT
/begin MEASUREMENT B_zztab "Bedingung: Zahnzeitentabelle gültig" UWORD B_TRUE 1 100 0 1 BIT_MASK 0x4 FUNCTION_LIST GGDPG DPH WANWKW IF_DATA DIM_X 0xFD16 INTERN BYTE IF_DATA MCMESS 0xFD16 INTERN /end MEASUREMENT
/begin MEASUREMENT can_asr_alter "" UWORD t10msxs_uw_b655p35 1 100 0 655.35 FUNCTION_LIST CAN IF_DATA DIM_X 0x380F66 EXTERN WORD IF_DATA MCMESS 0x380F66 EXTERN /end MEASUREMENT
/begin MEASUREMENT can_egs_alter "" UWORD t10msxs_uw_b655p35 1 100 0 655.35 FUNCTION_LIST CAN IF_DATA DIM_X 0x380F68 EXTERN WORD IF_DATA MCMESS 0x380F68 EXTERN /end MEASUREMENT
/begin MEASUREMENT can_kombi_alter "" UWORD t10msxs_uw_b655p35 1 100 0 655.35 FUNCTION_LIST CAN IF_DATA DIM_X 0x380F6A EXTERN WORD IF_DATA MCMESS 0x380F6A EXTERN /end MEASUREMENT
/begin MEASUREMENT cc_cha_0 "" UWORD dez 1 100 0 65535 FUNCTION_LIST ACIFI EVI TIMU IF_DATA DIM_X 0xFA7E INTERN WORD IF_DATA MCMESS 0xFA7E INTERN /end MEASUREMENT
/begin MEASUREMENT cc_cha_1 "" UWORD dez 1 100 0 65535 FUNCTION_LIST ACIFI EVI TIMU IF_DATA DIM_X 0xFA80 INTERN WORD IF_DATA MCMESS 0xFA80 INTERN /end MEASUREMENT
/begin MEASUREMENT cc_cha_2 "" UWORD dez 1 100 0 65535 FUNCTION_LIST ACIFI EVI TIMU IF_DATA DIM_X 0xFA82 INTERN WORD IF_DATA MCMESS 0xFA82 INTERN /end MEASUREMENT
/begin MEASUREMENT cc_cha_3 "" UWORD dez 1 100 0 65535 FUNCTION_LIST ACIFI EVI TIMU IF_DATA DIM_X 0xFA84 INTERN WORD IF_DATA MCMESS 0xFA84 INTERN /end MEASUREMENT
/begin MEASUREMENT cc_cha_4 "" UWORD dez 1 100 0 65535 FUNCTION_LIST ACIFI EVI TIMU IF_DATA DIM_X 0xFA86 INTERN WORD IF_DATA MCMESS 0xFA86 INTERN /end MEASUREMENT
/begin MEASUREMENT cc_cha_5 "" UWORD dez 1 100 0 65535 FUNCTION_LIST ACIFI EVI TIMU IF_DATA DIM_X 0xFA88 INTERN WORD IF_DATA MCMESS 0xFA88 INTERN /end MEASUREMENT
/begin MEASUREMENT cc_cha_6 "" UWORD dez 1 100 0 65535 FUNCTION_LIST ACIFI IF_DATA DIM_X 0xFA8A INTERN WORD IF_DATA MCMESS 0xFA8A INTERN /end MEASUREMENT
/begin MEASUREMENT cc_cha_7 "" UWORD dez 1 100 0 65535 FUNCTION_LIST ACIFI IF_DATA DIM_X 0xFA8C INTERN WORD IF_DATA MCMESS 0xFA8C INTERN /end MEASUREMENT
/begin MEASUREMENT cd_bits1_w "" UWORD dez 1 100 0 65535 FUNCTION_LIST PROKON DKATLRS DKVS DLSU DMDLU DSWEC IF_DATA DIM_X 0x38283E EXTERN WORD IF_DATA MCMESS 0x38283E EXTERN /end MEASUREMENT
/begin MEASUREMENT cd_bits2_w "" UWORD dez 1 100 0 65535 FUNCTION_LIST PROKON DLLR DLSAHK IF_DATA DIM_X 0x382840 EXTERN WORD IF_DATA MCMESS 0x382840 EXTERN /end MEASUREMENT
/begin MEASUREMENT cfoxx "zeigt die Eigenschaften des aktuellen KF-Bereiches der Fuel-on/-off Adaption" UBYTE dez 1 100 0 255 FUNCTION_LIST DMDFON IF_DATA DIM_X 0x382F11 EXTERN WORD IF_DATA MCMESS 0x382F11 EXTERN /end MEASUREMENT
/begin MEASUREMENT cpaw1 "Zähler für Poti 1 bei DK-Poti-Auswahl" UBYTE dez 1 100 0 255 FUNCTION_LIST GGDVE IF_DATA DIM_X 0x380AB0 EXTERN WORD IF_DATA MCMESS 0x380AB0 EXTERN /end MEASUREMENT
/begin MEASUREMENT cpaw2 "Zähler für Poti 2 bei DK-Poti-Auswahl" UBYTE dez 1 100 0 255 FUNCTION_LIST GGDVE IF_DATA DIM_X 0x380AB1 EXTERN WORD IF_DATA MCMESS 0x380AB1 EXTERN /end MEASUREMENT
/begin MEASUREMENT ctdkp1 "Fehlerzeitzähler für Bereichsprüfung DK-Poti 1" UBYTE t10msxs_ub_b2p55 1 100 0 2.55 FUNCTION_LIST GGDVE IF_DATA DIM_X 0x380AB2 EXTERN WORD IF_DATA MCMESS 0x380AB2 EXTERN /end MEASUREMENT
/begin MEASUREMENT ctdkp2 "Fehlerzeitzähler für Bereichsprüfung DK-Poti 2" UBYTE t10msxs_ub_b2p55 1 100 0 2.55 FUNCTION_LIST GGDVE IF_DATA DIM_X 0x380AB3 EXTERN WORD IF_DATA MCMESS 0x380AB3 EXTERN /end MEASUREMENT
/begin MEASUREMENT ctdkpaw "Zeitzähler für DK-Poti-Auswahl" UBYTE t10msxs_ub_b2p55 1 100 0 2.55 FUNCTION_LIST GGDVE IF_DATA DIM_X 0x380AB4 EXTERN WORD IF_DATA MCMESS 0x380AB4 EXTERN /end MEASUREMENT
/begin MEASUREMENT ctrbwf "Fehlerzähler Bewegungserkennung" UBYTE dez 1 100 0 255 FUNCTION_LIST GGPED IF_DATA DIM_X 0x380AC0 EXTERN WORD IF_DATA MCMESS 0x380AC0 EXTERN /end MEASUREMENT
/begin MEASUREMENT ctwdk12 "Fehlerzeitzähler für Gleichlaufprüfung der DK-Potis" UBYTE t10msxs_ub_b2p55 1 100 0 2.55 FUNCTION_LIST GGDVE IF_DATA DIM_X 0x380AB5 EXTERN WORD IF_DATA MCMESS 0x380AB5 EXTERN /end MEASUREMENT
/begin MEASUREMENT ctwdk13 "Fehlerzeitzähler für Plausibilitätsprüfung DK-Poti 1 mit Ersatzwert aus Füllung" UBYTE t10msxs_ub_b2p55 1 100 0 2.55 FUNCTION_LIST GGDVE IF_DATA DIM_X 0x380AB6 EXTERN WORD IF_DATA MCMESS 0x380AB6 EXTERN /end MEASUREMENT
/begin MEASUREMENT ctwdk23 "Fehlerzeitzähler für Plausibilitätsprüfung DK-Poti 2 mit Ersatzwert aus Füllung" UBYTE t10msxs_ub_b2p55 1 100 0 2.55 FUNCTION_LIST GGDVE IF_DATA DIM_X 0x380AB7 EXTERN WORD IF_DATA MCMESS 0x380AB7 EXTERN /end MEASUREMENT
/begin MEASUREMENT cvnh_w "High-Word der CVN entsprechend SAE J1979 Mode $09 VIT $06" UWORD dez 1 100 0 65535 FUNCTION_LIST BGCVN T2LID TC9MOD IF_DATA DIM_X 0x383534 EXTERN WORD IF_DATA MCMESS 0x383534 EXTERN /end MEASUREMENT
/begin MEASUREMENT cvnl_w "Low-Word der CVN entsprechend SAE J1979 Mode $09 VIT $06" UWORD dez 1 100 0 65535 FUNCTION_LIST BGCVN T2LID TC9MOD IF_DATA DIM_X 0x383536 EXTERN WORD IF_DATA MCMESS 0x383536 EXTERN /end MEASUREMENT
/begin MEASUREMENT cwfgrla "Kodierung Fahrgeschwindigkeitsreglerlampe, Maske" UBYTE dez 1 100 0 255 FUNCTION_LIST DEKON2 IF_DATA DIM_X 0x380AD0 EXTERN WORD IF_DATA MCMESS 0x380AD0 EXTERN /end MEASUREMENT
/begin MEASUREMENT cwfgrlacod "" UBYTE dez 1 100 0 255 FUNCTION_LIST DEKON2 IF_DATA DIM_X 0x380AD1 EXTERN WORD IF_DATA MCMESS 0x380AD1 EXTERN /end MEASUREMENT
/begin MEASUREMENT cwkos "Kodierung Klimakompressor, Maske" UBYTE dez 1 100 0 255 FUNCTION_LIST DEKON2 IF_DATA DIM_X 0x380AD2 EXTERN WORD IF_DATA MCMESS 0x380AD2 EXTERN /end MEASUREMENT
/begin MEASUREMENT cwkoscod "" UBYTE dez 1 100 0 255 FUNCTION_LIST DEKON2 IF_DATA DIM_X 0x382FF9 EXTERN WORD IF_DATA MCMESS 0x382FF9 EXTERN /end MEASUREMENT
/begin MEASUREMENT cw_erfil "Status Codewort Filtervariante für Ausgabe der AS-Fehler an GST" UBYTE dez 1 100 0 255 FUNCTION_LIST PROKON DTIP TCSORT IF_DATA DIM_X 0x380C4A EXTERN WORD IF_DATA MCMESS 0x380C4A EXTERN /end MEASUREMENT
/begin MEASUREMENT cw_obd "Status Codewort CWOBD" UBYTE dez 1 100 0 255 FUNCTION_LIST PROKON IF_DATA DIM_X 0x380C4B EXTERN WORD IF_DATA MCMESS 0x380C4B EXTERN /end MEASUREMENT
/begin MEASUREMENT cyclebg_w "" UWORD runtime2_sy 1 100 0 699040 FUNCTION_LIST RUNTIME IF_DATA DIM_X 0x382842 EXTERN WORD IF_DATA MCMESS 0x382842 EXTERN /end MEASUREMENT
/begin MEASUREMENT dcycnt "Driving cycle - counter" UWORD dez 1 100 0 65535 FUNCTION_LIST DDCY T2LID IF_DATA DIM_X 0x383540 EXTERN WORD IF_DATA MCMESS 0x383540 EXTERN /end MEASUREMENT
/begin MEASUREMENT dekpub "Differenz der Batteriespannung zwischen zwei Messungen bis EKP-Dauerbetrieb" UBYTE spg_ubatt 1 100 0 19.38 FUNCTION_LIST AEKP IF_DATA DIM_X 0x380D20 EXTERN WORD IF_DATA MCMESS 0x380D20 EXTERN /end MEASUREMENT
/begin MEASUREMENT delayedTime_w "" UWORD t_wdt_high 1 100 0 89477.1 FUNCTION_LIST URDELAY IF_DATA DIM_X 0x383A34 EXTERN WORD IF_DATA MCMESS 0x383A34 EXTERN /end MEASUREMENT
/begin MEASUREMENT deltaseg_w "Delta Segmente bei Umsynchronisation der Einspritzausgabe" UWORD dez 1 100 0 65535 FUNCTION_LIST ACIFI IF_DATA DIM_X 0x381EE6 EXTERN WORD IF_DATA MCMESS 0x381EE6 EXTERN /end MEASUREMENT
/begin MEASUREMENT detazwbs "Delta ZW-Wirkungsgrad für Bauteileschutz" UBYTE rel_ub_b127p5 1 100 0 127.5 FUNCTION_LIST LAMBTS IF_DATA DIM_X 0x380B40 EXTERN WORD IF_DATA MCMESS 0x380B40 EXTERN /end MEASUREMENT
/begin MEASUREMENT detazwte "Korrekturfaktor des Zündwinkelwirkungsgrads für DTEV" UBYTE rel_ub_b127p5 1 100 0 127.5 FUNCTION_LIST DTEV IF_DATA DIM_X 0x380CCE EXTERN WORD IF_DATA MCMESS 0x380CCE EXTERN /end MEASUREMENT
/begin MEASUREMENT devoff "EV-Ausblendmaske bei Testeranforderung" UBYTE dez 1 100 0 255 FUNCTION_LIST T2STA AEVAB BGEVAB IF_DATA DIM_X 0x38093A EXTERN WORD IF_DATA MCMESS 0x38093A EXTERN /end MEASUREMENT
/begin MEASUREMENT dfcmFcm "" UBYTE dez 1 100 0 255 FUNCTION_LIST DFPM IF_DATA DIM_X 0x382FC9 EXTERN WORD IF_DATA MCMESS 0x382FC9 EXTERN /end MEASUREMENT
/begin MEASUREMENT dfcmNo "" UBYTE dez 1 100 0 255 FUNCTION_LIST DFPM IF_DATA DIM_X 0x382FCA EXTERN WORD IF_DATA MCMESS 0x382FCA EXTERN /end MEASUREMENT
/begin MEASUREMENT dfcmSfp "" UBYTE dez 1 100 0 255 FUNCTION_LIST DFPM IF_DATA DIM_X 0x382FCB EXTERN WORD IF_DATA MCMESS 0x382FCB EXTERN /end MEASUREMENT
/begin MEASUREMENT dfftBits_u "Umsetzen von Bits in Byte-Werte" UBYTE dez 1 100 0 255 FUNCTION_LIST DFFTCNV DFFTK IF_DATA DIM_X 0x3809D9 EXTERN WORD IF_DATA MCMESS 0x3809D9 EXTERN /end MEASUREMENT
/begin MEASUREMENT dfpmEpclState "" UWORD dez 1 100 0 65535 FUNCTION_LIST DFPM IF_DATA DIM_X 0x383542 EXTERN WORD IF_DATA MCMESS 0x383542 EXTERN /end MEASUREMENT
/begin MEASUREMENT dfpmMilState "" UWORD dez 1 100 0 65535 FUNCTION_LIST DFPM DMIL IF_DATA DIM_X 0x383543 EXTERN WORD IF_DATA MCMESS 0x383543 EXTERN /end MEASUREMENT
/begin MEASUREMENT dfp_ap "" UBYTE dez 1 100 0 255 FUNCTION_LIST DFPM IF_DATA DIM_X 0x382FCC EXTERN WORD IF_DATA MCMESS 0x382FCC EXTERN /end MEASUREMENT
/begin MEASUREMENT dfr2_w "Delta Lambdaregler (Faktor ), Bank2" SWORD fak_sw_b1 1 100 -1 0.999969 FUNCTION_LIST LRS IF_DATA DIM_X 0x382970 EXTERN WORD IF_DATA MCMESS 0x382970 EXTERN /end MEASUREMENT
/begin MEASUREMENT dfrm2_w "Abweichung schneller Mittelwert des Lambdareglers von 1.0 (Word)" SWORD fak_sw_b1 1 100 -1 0.999969 FUNCTION_LIST LRA IF_DATA DIM_X 0x38234A EXTERN WORD IF_DATA MCMESS 0x38234A EXTERN /end MEASUREMENT
/begin MEASUREMENT dfrmin2_w "Untergrenze von dfr_w bei Abmagerungsverbot (B_lrms=true), Bank2" SWORD fak_sw_b1 1 100 -1 0.999969 FUNCTION_LIST LRS IF_DATA DIM_X 0x382972 EXTERN WORD IF_DATA MCMESS 0x382972 EXTERN /end MEASUREMENT
/begin MEASUREMENT dfrmin_w "Untergrenze von dfr_w bei Abmagerungsverbot (B_lrms=true)" SWORD fak_sw_b1 1 100 -1 0.999969 FUNCTION_LIST LRS IF_DATA DIM_X 0x382974 EXTERN WORD IF_DATA MCMESS 0x382974 EXTERN /end MEASUREMENT
/begin MEASUREMENT dfrmoff2_w "frm-Offset: zur Kontrolle von Problemen der Vorsteuerung, Bank 2" SWORD fak_sw_b1 1 100 -1 0.999969 FUNCTION_LIST DSLSLRS IF_DATA DIM_X 0x380E26 EXTERN WORD IF_DATA MCMESS 0x380E26 EXTERN /end MEASUREMENT
/begin MEASUREMENT dfrmoff_w "frm-Offset: zur Kontrolle von Problemen der Vorsteuerung" SWORD fak_sw_b1 1 100 -1 0.999969 FUNCTION_LIST DSLSLRS IF_DATA DIM_X 0x380E28 EXTERN WORD IF_DATA MCMESS 0x380E28 EXTERN /end MEASUREMENT
/begin MEASUREMENT dfrm_w "Abweichung schneller Mittelwert des Lambdareglers von 1.0 (Word)" SWORD fak_sw_b1 1 100 -1 0.999969 FUNCTION_LIST LRA IF_DATA DIM_X 0x38234C EXTERN WORD IF_DATA MCMESS 0x38234C EXTERN /end MEASUREMENT
/begin MEASUREMENT dfrzaf_w "LRS-Zwangsamplitude, gefiltert" SWORD fak_sw_b1 1 100 -1 0.999969 FUNCTION_LIST LRS DLSU IF_DATA DIM_X 0x382976 EXTERN WORD IF_DATA MCMESS 0x382976 EXTERN /end MEASUREMENT
/begin MEASUREMENT dfrza_w "LRS-Zwangsamplitude" SWORD fak_sw_b1 1 100 -1 0.999969 FUNCTION_LIST LRS IF_DATA DIM_X 0x382978 EXTERN WORD IF_DATA MCMESS 0x382978 EXTERN /end MEASUREMENT
/begin MEASUREMENT dfr_w "Delta Lambdaregler (Faktor )" SWORD fak_sw_b1 1 100 -1 0.999969 FUNCTION_LIST LRS IF_DATA DIM_X 0x38297A EXTERN WORD IF_DATA MCMESS 0x38297A EXTERN /end MEASUREMENT
/begin MEASUREMENT dfse01 "Status Plausibilitätsprüfung der fuel-on/-off Adaption im Drehzahlber.01 erfüllt" SBYTE dtsegn_b11p25divZyl 1 100 -1.875 1.86035 FUNCTION_LIST DMDFON IF_DATA DIM_X 0x380989 EXTERN WORD IF_DATA MCMESS 0x380989 EXTERN /end MEASUREMENT
/begin MEASUREMENT dfse02 "Status Plausibilitätsprüfung der fuel-on/-off Adaption im Drehzahlber.02erfüllt" SBYTE dtsegn_b11p25divZyl 1 100 -1.875 1.86035 FUNCTION_LIST DMDFON IF_DATA DIM_X 0x38098A EXTERN WORD IF_DATA MCMESS 0x38098A EXTERN /end MEASUREMENT
/begin MEASUREMENT dfse03 "Status Plausibilitätsprüfung der fuel-on/-off Adaption im Drehzahlber.3 erfüllt" SBYTE dtsegn_b11p25divZyl 1 100 -1.875 1.86035 FUNCTION_LIST DMDFON IF_DATA DIM_X 0x38098B EXTERN WORD IF_DATA MCMESS 0x38098B EXTERN /end MEASUREMENT
/begin MEASUREMENT dfse04 "Status Plausibilitätsprüfung der fuel-on/-off Adaption im Drehzahlber.4 erfüllt" SBYTE dtsegn_b11p25divZyl 1 100 -1.875 1.86035 FUNCTION_LIST DMDFON IF_DATA DIM_X 0x38098C EXTERN WORD IF_DATA MCMESS 0x38098C EXTERN /end MEASUREMENT
/begin MEASUREMENT dfse05 "Status Plausibilitätsprüfung der fuel-on/-off Adaption im Drehzahlber.5 erfüllt" SBYTE dtsegn_b11p25divZyl 1 100 -1.875 1.86035 FUNCTION_LIST DMDFON IF_DATA DIM_X 0x38098D EXTERN WORD IF_DATA MCMESS 0x38098D EXTERN /end MEASUREMENT
/begin MEASUREMENT dfse06 "Status Plausibilitätsprüfung der fuel-on/-off Adaption im Drehzahlber.6 erfüllt" SBYTE dtsegn_b11p25divZyl 1 100 -1.875 1.86035 FUNCTION_LIST DMDFON IF_DATA DIM_X 0x38098E EXTERN WORD IF_DATA MCMESS 0x38098E EXTERN /end MEASUREMENT
/begin MEASUREMENT dfse07 "Status Plausibilitätsprüfung der fuel-on/-off Adaption im Drehzahlber.7 erfüllt" SBYTE dtsegn_b11p25divZyl 1 100 -1.875 1.86035 FUNCTION_LIST DMDFON IF_DATA DIM_X 0x38098F EXTERN WORD IF_DATA MCMESS 0x38098F EXTERN /end MEASUREMENT
/begin MEASUREMENT dfse08 "Status Plausibilitätsprüfung der fuel-on/-off Adaption im Drehzahlber.8 erfüllt" SBYTE dtsegn_b11p25divZyl 1 100 -1.875 1.86035 FUNCTION_LIST DMDFON IF_DATA DIM_X 0x380990 EXTERN WORD IF_DATA MCMESS 0x380990 EXTERN /end MEASUREMENT
/begin MEASUREMENT dfsen "Differenz der FSE-Werte im Normalbetrieb im aktuellen n-Bereich" SBYTE dtsegn_b11p25divZyl 1 100 -1.875 1.86035 FUNCTION_LIST DMDFON IF_DATA DIM_X 0x380991 EXTERN WORD IF_DATA MCMESS 0x380991 EXTERN /end MEASUREMENT
/begin MEASUREMENT dfseresz "Resetzähler Plausibilitätsprüfung FSE" UWORD dez 1 100 0 65535 FUNCTION_LIST DMDFON IF_DATA DIM_X 0x383520 EXTERN WORD IF_DATA MCMESS 0x383520 EXTERN /end MEASUREMENT
/begin MEASUREMENT dftef_w "Eingang Integrator Spülrate" SWORD perio_sw_b1p562 1 100 -1.562 1.56195 FUNCTION_LIST TEB IF_DATA DIM_X 0x382B9E EXTERN WORD IF_DATA MCMESS 0x382B9E EXTERN /end MEASUREMENT
/begin MEASUREMENT dfuelsan_w "Delta Füllungssensor zu Alpha/n-System" SWORD fak_sw_b1 1 100 -1 0.999969 FUNCTION_LIST BGMSZS DTEV IF_DATA DIM_X 0x381FEE EXTERN WORD IF_DATA MCMESS 0x381FEE EXTERN /end MEASUREMENT
/begin MEASUREMENT dkatakt2_w "aktive Überwachungszeit für DKAT (Steroe 2.Bank)" UWORD t50msxs_uw_b3276p75 1 100 0 3276.75 FUNCTION_LIST DKATLRS T2LID IF_DATA DIM_X 0x381C50 EXTERN WORD IF_DATA MCMESS 0x381C50 EXTERN /end MEASUREMENT
/begin MEASUREMENT dkatakt_w "aktive Überwachungszeit für DKAT" UWORD t50msxs_uw_b3276p75 1 100 0 3276.75 FUNCTION_LIST DKATLRS T2LID IF_DATA DIM_X 0x381C52 EXTERN WORD IF_DATA MCMESS 0x381C52 EXTERN /end MEASUREMENT
/begin MEASUREMENT dkatefrg "Abweichung Kraftstoffanteil Tankentlüftung bei Sollspülrate von Zielwert" SBYTE fak_sb_b1 1 100 -1 0.992188 FUNCTION_LIST TEB IF_DATA DIM_X 0x380CBD EXTERN WORD IF_DATA MCMESS 0x380CBD EXTERN /end MEASUREMENT
/begin MEASUREMENT dkhc_w "Eingang Integrator HC-Konzentration" SWORD perio_sw_b6p125 1 100 -6.125 6.12481 FUNCTION_LIST TEB IF_DATA DIM_X 0x382B96 EXTERN WORD IF_DATA MCMESS 0x382B96 EXTERN /end MEASUREMENT
/begin MEASUREMENT dklagerc "Fehlerzähler DK-Lageüberwachung" UBYTE t20msxs_ub_b5p1 1 100 0 5.1 FUNCTION_LIST ADVE IF_DATA DIM_X 0x380A9E EXTERN WORD IF_DATA MCMESS 0x380A9E EXTERN /end MEASUREMENT
/begin MEASUREMENT dkpstg_w "Steigung DK-Poti (% DK / V)" UWORD rel_uw_b40 1 100 0 39.9994 FUNCTION_LIST BGDVE GGDVE IF_DATA DIM_X 0x381E70 EXTERN WORD IF_DATA MCMESS 0x381E70 EXTERN /end MEASUREMENT
/begin MEASUREMENT DKVSbits "" UBYTE dez 1 100 0 255 FUNCTION_LIST DKVS IF_DATA DIM_X 0x383001 EXTERN WORD IF_DATA MCMESS 0x383001 EXTERN /end MEASUREMENT
/begin MEASUREMENT dlahi2_u "I-Anteil der stetigen LRHK Bank2 (Byte)" SBYTE fak_sb_b1 1 100 -1 0.992188 FUNCTION_LIST DFFTCNV DFFTK IF_DATA DIM_X 0x3809E4 EXTERN WORD IF_DATA MCMESS 0x3809E4 EXTERN /end MEASUREMENT
/begin MEASUREMENT dlahi2_w "I-Anteil der stetigen LRHK2" SWORD fak_sw_b1 1 100 -1 0.999969 FUNCTION_LIST LRSHK DFFTCNV DLSSA DLSU LRS T2LID IF_DATA DIM_X 0x383A40 EXTERN WORD IF_DATA MCMESS 0x383A40 EXTERN /end MEASUREMENT
/begin MEASUREMENT dlahini2_w "Intialisierungswert für Integralanteil LRSHK, Bank2" SWORD fak_sw_b1 1 100 -1 0.999969 FUNCTION_LIST LRSHK IF_DATA DIM_X 0x382A6C EXTERN WORD IF_DATA MCMESS 0x382A6C EXTERN /end MEASUREMENT
/begin MEASUREMENT dlahini_w "Intialisierungswert für Integralanteil LRSHK" SWORD fak_sw_b1 1 100 -1 0.999969 FUNCTION_LIST LRSHK IF_DATA DIM_X 0x382A6E EXTERN WORD IF_DATA MCMESS 0x382A6E EXTERN /end MEASUREMENT
/begin MEASUREMENT dlahisa "I-Anteil LRSHK Signalausgabe DLSSA (SY_STETLR := TRUE), Bank 1" UBYTE fak_ub_b0p1_o0p05 1 100 -0.05 0.0496094 FUNCTION_LIST DLSSA TC5MOD IF_DATA DIM_X 0x380ADD EXTERN WORD IF_DATA MCMESS 0x380ADD EXTERN /end MEASUREMENT
/begin MEASUREMENT dlahisa2 "I-Anteil LRSHK Signalausgabe DLSSA (SY_STETLR := TRUE), Bank 2" UBYTE fak_ub_b0p1_o0p05 1 100 -0.05 0.0496094 FUNCTION_LIST DLSSA TC5MOD IF_DATA DIM_X 0x380ADE EXTERN WORD IF_DATA MCMESS 0x380ADE EXTERN /end MEASUREMENT
/begin MEASUREMENT dlahi_u "I-Anteil der stetigen LRHK (Byte)" SBYTE fak_sb_b1 1 100 -1 0.992188 FUNCTION_LIST DFFTCNV DFFTK IF_DATA DIM_X 0x3809E5 EXTERN WORD IF_DATA MCMESS 0x3809E5 EXTERN /end MEASUREMENT
/begin MEASUREMENT dlahi_w "I-Anteil der stetigen LRHK" SWORD fak_sw_b1 1 100 -1 0.999969 FUNCTION_LIST LRSHK DFFTCNV DLSSA DLSU LRS T2LID IF_DATA DIM_X 0x383A42 EXTERN WORD IF_DATA MCMESS 0x383A42 EXTERN /end MEASUREMENT
/begin MEASUREMENT dlahkab2_w "Dynamische Überhöhung des Pseudo Lambda-Sollwertes hinter Kat, Bank2" SWORD fak_sw_b1 1 100 -1 0.999969 FUNCTION_LIST LRSHK IF_DATA DIM_X 0x382A70 EXTERN WORD IF_DATA MCMESS 0x382A70 EXTERN /end MEASUREMENT
/begin MEASUREMENT dlahkab_w "Dynamische Überhöhung des Pseudo Lambda-Sollwertes hinter Kat" SWORD fak_sw_b1 1 100 -1 0.999969 FUNCTION_LIST LRSHK IF_DATA DIM_X 0x382A72 EXTERN WORD IF_DATA MCMESS 0x382A72 EXTERN /end MEASUREMENT
/begin MEASUREMENT dlahp2_w "P-Anteil der stetigen LRHK2" SWORD fak_sw_b1 1 100 -1 0.999969 FUNCTION_LIST LRSHK LRS IF_DATA DIM_X 0x382A74 EXTERN WORD IF_DATA MCMESS 0x382A74 EXTERN /end MEASUREMENT
/begin MEASUREMENT dlahp_w "P-Anteil der stetigen LRHK" SWORD fak_sw_b1 1 100 -1 0.999969 FUNCTION_LIST LRSHK LRS IF_DATA DIM_X 0x382A76 EXTERN WORD IF_DATA MCMESS 0x382A76 EXTERN /end MEASUREMENT
/begin MEASUREMENT dlam2_w "delta Lambda Bank2, Abweichung von Lambda 1" SWORD fak_sw_b8 1 100 -8 7.99976 FUNCTION_LIST GGLSU IF_DATA DIM_X 0x381DE4 EXTERN WORD IF_DATA MCMESS 0x381DE4 EXTERN /end MEASUREMENT
/begin MEASUREMENT dlamatr2_w "Delta Lambdasoll aus Abgastemperaturregelung Bank 2" SWORD fak_sw_b8 1 100 -8 7.99976 FUNCTION_LIST SWADP IF_DATA DIM_X 0x382B18 EXTERN WORD IF_DATA MCMESS 0x382B18 EXTERN /end MEASUREMENT
/begin MEASUREMENT dlamatr_w "Delta Lambdasoll aus Abgastemperaturregelung" SWORD fak_sw_b8 1 100 -8 7.99976 FUNCTION_LIST SWADP IF_DATA DIM_X 0x382B1A EXTERN WORD IF_DATA MCMESS 0x382B1A EXTERN /end MEASUREMENT
/begin MEASUREMENT dlambts_w "Delta Lambda für Bauteileschutz" SWORD fak_sw_b8 1 100 -8 7.99976 FUNCTION_LIST LAMBTS T2LID IF_DATA DIM_X 0x38231A EXTERN WORD IF_DATA MCMESS 0x38231A EXTERN /end MEASUREMENT
/begin MEASUREMENT dlam_w "delta Lambda, Abweichung von Lambda 1" SWORD fak_sw_b8 1 100 -8 7.99976 FUNCTION_LIST GGLSU IF_DATA DIM_X 0x381DE6 EXTERN WORD IF_DATA MCMESS 0x381DE6 EXTERN /end MEASUREMENT
/begin MEASUREMENT dlashki2_w "Delta-Lambda gewichtet für I-Anteil LRSHK, Bank2" SWORD fak_sw_b1 1 100 -1 0.999969 FUNCTION_LIST LRSHK IF_DATA DIM_X 0x382A78 EXTERN WORD IF_DATA MCMESS 0x382A78 EXTERN /end MEASUREMENT
/begin MEASUREMENT dlashki_w "Delta-Lambda gewichtet für I-Anteil LRSHK" SWORD fak_sw_b1 1 100 -1 0.999969 FUNCTION_LIST LRSHK IF_DATA DIM_X 0x382A7A EXTERN WORD IF_DATA MCMESS 0x382A7A EXTERN /end MEASUREMENT
/begin MEASUREMENT dlashkm2_w "Delta-Lambda aus Lambdaregelung hinter Kat (Ist-Wert fr-synchron gemittelt), Ba2" SWORD fak_sw_b1 1 100 -1 0.999969 FUNCTION_LIST LRSHK SSTBER87 IF_DATA DIM_X 0x382A7C EXTERN WORD IF_DATA MCMESS 0x382A7C EXTERN /end MEASUREMENT
/begin MEASUREMENT dlashkm_w "Delta-Lambda aus Lambdaregelung hinter Kat (Ist-Wert fr-synchron gemittelt)" SWORD fak_sw_b1 1 100 -1 0.999969 FUNCTION_LIST LRSHK SSTBER87 IF_DATA DIM_X 0x382A7E EXTERN WORD IF_DATA MCMESS 0x382A7E EXTERN /end MEASUREMENT
/begin MEASUREMENT dlashkp2_w "Delta-Lambda gewichtet für P-Anteil LRSHK5.30, Bank2" SWORD fak_sw_b1 1 100 -1 0.999969 FUNCTION_LIST LRSHK IF_DATA DIM_X 0x382A80 EXTERN WORD IF_DATA MCMESS 0x382A80 EXTERN /end MEASUREMENT
/begin MEASUREMENT dlashkp_w "Delta-Lambda gewichtet für P-Anteil LRSHK5.30" SWORD fak_sw_b1 1 100 -1 0.999969 FUNCTION_LIST LRSHK IF_DATA DIM_X 0x382A82 EXTERN WORD IF_DATA MCMESS 0x382A82 EXTERN /end MEASUREMENT
/begin MEASUREMENT dlasza_w "Sollwert delta Lambda der Zusatzamplitude" SWORD fak_sw_b1 1 100 -1 0.999969 FUNCTION_LIST LRS IF_DATA DIM_X 0x38297C EXTERN WORD IF_DATA MCMESS 0x38297C EXTERN /end MEASUREMENT
/begin MEASUREMENT dlrd "DLR, D-Parameter" UBYTE relDK_q4 1 100 0 1020 FUNCTION_LIST ADVE IF_DATA DIM_X 0xFA20 INTERN WORD IF_DATA MCMESS 0xFA20 INTERN /end MEASUREMENT
/begin MEASUREMENT dlrhaftak "Zeitzähler Haftreibungsroutine" SWORD rel_q0p1957 1 100 -6412.52 6412.33 FUNCTION_LIST ADVE IF_DATA DIM_X 0x381E54 EXTERN WORD IF_DATA MCMESS 0x381E54 EXTERN /end MEASUREMENT
/begin MEASUREMENT dlri "DLR, I-Parameter" UBYTE relDK_q0p0625 1 100 0 15.9375 FUNCTION_LIST ADVE IF_DATA DIM_X 0xFA21 INTERN WORD IF_DATA MCMESS 0xFA21 INTERN /end MEASUREMENT
/begin MEASUREMENT dlriamax "DLR, maximal möglicher I-Anteil" UWORD rel_q0p1957 1 100 0 12824.9 FUNCTION_LIST ADVE IF_DATA DIM_X 0xFA26 INTERN WORD IF_DATA MCMESS 0xFA26 INTERN /end MEASUREMENT
/begin MEASUREMENT dlriant_w "DLR, I-Anteil, highword von dlriant_l" SWORD rel_sw_q0p1953 1 100 -6400 6399.8 FUNCTION_LIST ADVE IF_DATA DIM_X 0x381E56 EXTERN WORD IF_DATA MCMESS 0x381E56 EXTERN /end MEASUREMENT
/begin MEASUREMENT dlrihaftc "DLR, Zähler für DV-E in Haftreibung" UBYTE t50msxs_q0p05 1 100 0 12.75 FUNCTION_LIST ADVE IF_DATA DIM_X 0x380A9D EXTERN WORD IF_DATA MCMESS 0x380A9D EXTERN /end MEASUREMENT
/begin MEASUREMENT dlriklst_w "Vorladewert I-Kleinanteil" SWORD rel_q0p1957 1 100 -6412.52 6412.33 FUNCTION_LIST ADVE IF_DATA DIM_X 0x381E58 EXTERN WORD IF_DATA MCMESS 0x381E58 EXTERN /end MEASUREMENT
/begin MEASUREMENT dlrikl_w "DLR, I-Kleinanteil" SWORD rel_q0p1957 1 100 -6412.52 6412.33 FUNCTION_LIST ADVE IF_DATA DIM_X 0xFA28 INTERN WORD IF_DATA MCMESS 0xFA28 INTERN /end MEASUREMENT
/begin MEASUREMENT dlrini_w "I-Anteil bei Initialisierung der NLP-Function" UWORD rel_q0p1957 1 100 0 12824.9 FUNCTION_LIST ADVE IF_DATA DIM_X 0x381E5A EXTERN WORD IF_DATA MCMESS 0x381E5A EXTERN /end MEASUREMENT
/begin MEASUREMENT dlrkomp "DLR, Faktor Kreisverstärkung" UBYTE fak_ub_b2 1 100 0 1.99219 FUNCTION_LIST ADVE IF_DATA DIM_X 0xFA22 INTERN WORD IF_DATA MCMESS 0xFA22 INTERN /end MEASUREMENT
/begin MEASUREMENT dlrmxt "timer für DLR im UMA in der Begrenzung" UBYTE t50msxs_q0p05 1 100 0 12.75 FUNCTION_LIST BGDVE IF_DATA DIM_X 0x380AA5 EXTERN WORD IF_DATA MCMESS 0x380AA5 EXTERN /end MEASUREMENT
/begin MEASUREMENT dlrndif_w "Istwert aktuell - Istwert letzter für D-Anteil des DLR" SWORD relDK_q0p02441 1 100 -800 799.976 FUNCTION_LIST ADVE IF_DATA DIM_X 0xFA2A INTERN WORD IF_DATA MCMESS 0xFA2A INTERN /end MEASUREMENT
/begin MEASUREMENT dlrp "DLR, P-Parameter" UBYTE relDK_q1 1 100 0 255 FUNCTION_LIST ADVE IF_DATA DIM_X 0xFA23 INTERN WORD IF_DATA MCMESS 0xFA23 INTERN /end MEASUREMENT
/begin MEASUREMENT dlrpidc "Fehlerzähler DLR-Stellbereichsüberwachung" UWORD t10msxs_uw_b655p35 1 100 0 655.35 FUNCTION_LIST ADVE IF_DATA DIM_X 0x381E5C EXTERN WORD IF_DATA MCMESS 0x381E5C EXTERN /end MEASUREMENT
/begin MEASUREMENT dlrspid_u "dlr für DV_E: Summe der PID-Anteile (Bytegröße)" UBYTE rel_ub_b100 1 100 0 99.6094 FUNCTION_LIST DFFTCNV DFFTK IF_DATA DIM_X 0x3809E6 EXTERN WORD IF_DATA MCMESS 0x3809E6 EXTERN /end MEASUREMENT
/begin MEASUREMENT dlrspid_w "DLR für DV-E: Summe der PID-Anteile" UWORD rel_uw_b100 1 100 0 99.9985 FUNCTION_LIST ADVE BGDVE DFFTCNV IF_DATA DIM_X 0xFA2C INTERN WORD IF_DATA MCMESS 0xFA2C INTERN /end MEASUREMENT
/begin MEASUREMENT dlsd_w "Dämpfung PT2-Filter in Lastschlagdämpfung" UWORD fak_uw_b2 1 100 0 1.99997 FUNCTION_LIST MDFAW IF_DATA DIM_X 0x382640 EXTERN WORD IF_DATA MCMESS 0x382640 EXTERN /end MEASUREMENT
/begin MEASUREMENT DLSHerrors "" UBYTE dez 1 100 0 255 FUNCTION_LIST DLSH IF_DATA DIM_X 0x380A80 EXTERN WORD IF_DATA MCMESS 0x380A80 EXTERN /end MEASUREMENT
/begin MEASUREMENT DLSHintbits "" UBYTE dez 1 100 0 255 FUNCTION_LIST DLSH IF_DATA DIM_X 0x380A81 EXTERN WORD IF_DATA MCMESS 0x380A81 EXTERN /end MEASUREMENT
/begin MEASUREMENT DLSHintbits2 "" UBYTE dez 1 100 0 255 FUNCTION_LIST DLSH IF_DATA DIM_X 0x380A82 EXTERN WORD IF_DATA MCMESS 0x380A82 EXTERN /end MEASUREMENT
/begin MEASUREMENT DLSUebits "" UWORD dez 1 100 0 65535 FUNCTION_LIST DLSU IF_DATA DIM_X 0x381D14 EXTERN WORD IF_DATA MCMESS 0x381D14 EXTERN /end MEASUREMENT
/begin MEASUREMENT dlurs "Laufunruhedifferenz-Referenzwert, signed" SBYTE luquant 1 100 -232.831 231.012 FUNCTION_LIST DMDDLU IF_DATA DIM_X 0x3809B2 EXTERN WORD IF_DATA MCMESS 0x3809B2 EXTERN /end MEASUREMENT
/begin MEASUREMENT dlursvs "Laufunruhedifferenz-Referenzwert für Diagn. Ventilhub, signed" SBYTE luquant 1 100 -232.831 231.012 FUNCTION_LIST DMDDVS IF_DATA DIM_X 0x3809B6 EXTERN WORD IF_DATA MCMESS 0x3809B6 EXTERN /end MEASUREMENT
/begin MEASUREMENT dlursvs1 "" SBYTE luquant 1 100 -232.831 231.012 FUNCTION_LIST DMDDVS IF_DATA DIM_X 0x3809B7 EXTERN WORD IF_DATA MCMESS 0x3809B7 EXTERN /end MEASUREMENT
/begin MEASUREMENT dlursvs2 "" SBYTE luquant 1 100 -232.831 231.012 FUNCTION_LIST DMDDVS IF_DATA DIM_X 0x3809B8 EXTERN WORD IF_DATA MCMESS 0x3809B8 EXTERN /end MEASUREMENT
/begin MEASUREMENT dlursvs3 "" SBYTE luquant 1 100 -232.831 231.012 FUNCTION_LIST DMDDVS IF_DATA DIM_X 0x3809B9 EXTERN WORD IF_DATA MCMESS 0x3809B9 EXTERN /end MEASUREMENT
/begin MEASUREMENT dlursvs4 "" SBYTE luquant 1 100 -232.831 231.012 FUNCTION_LIST DMDDVS IF_DATA DIM_X 0x3809BA EXTERN WORD IF_DATA MCMESS 0x3809BA EXTERN /end MEASUREMENT
/begin MEASUREMENT dlursvs5 "" SBYTE luquant 1 100 -232.831 231.012 FUNCTION_LIST DMDDVS IF_DATA DIM_X 0x3809BB EXTERN WORD IF_DATA MCMESS 0x3809BB EXTERN /end MEASUREMENT
/begin MEASUREMENT dlursvs6 "" SBYTE luquant 1 100 -232.831 231.012 FUNCTION_LIST DMDDVS IF_DATA DIM_X 0x3809BC EXTERN WORD IF_DATA MCMESS 0x3809BC EXTERN /end MEASUREMENT
/begin MEASUREMENT dlurs_m "Monitor, Laufunruhedifferenz-Referenzwert, signed, verzögerte Ausgabe" SBYTE luquant 1 100 -232.831 231.012 FUNCTION_LIST DMDDLU IF_DATA DIM_X 0xE3EE INTERN WORD IF_DATA MCMESS 0xE3EE INTERN /end MEASUREMENT
/begin MEASUREMENT dluts "Laufunruhedifferenz-Testgröße, signed" SBYTE luquant 1 100 -232.831 231.012 FUNCTION_LIST DMDDLU IF_DATA DIM_X 0x380995 EXTERN WORD IF_DATA MCMESS 0x380995 EXTERN /end MEASUREMENT
/begin MEASUREMENT dluts1 "Differenz Laufunruhe-Testgröße, signed" SBYTE luquant 1 100 -232.831 231.012 FUNCTION_LIST DMDDLU IF_DATA DIM_X 0x380996 EXTERN WORD IF_DATA MCMESS 0x380996 EXTERN /end MEASUREMENT
/begin MEASUREMENT dluts2 "Differenz Laufunruhe-Testgröße, signed" SBYTE luquant 1 100 -232.831 231.012 FUNCTION_LIST DMDDLU IF_DATA DIM_X 0x380997 EXTERN WORD IF_DATA MCMESS 0x380997 EXTERN /end MEASUREMENT
/begin MEASUREMENT dluts3 "Differenz Laufunruhe-Testgröße, signed" SBYTE luquant 1 100 -232.831 231.012 FUNCTION_LIST DMDDLU IF_DATA DIM_X 0x380998 EXTERN WORD IF_DATA MCMESS 0x380998 EXTERN /end MEASUREMENT
/begin MEASUREMENT dluts4 "Differenz Laufunruhe-Testgröße, signed" SBYTE luquant 1 100 -232.831 231.012 FUNCTION_LIST DMDDLU IF_DATA DIM_X 0x380999 EXTERN WORD IF_DATA MCMESS 0x380999 EXTERN /end MEASUREMENT
/begin MEASUREMENT dluts5 "Differenz Laufunruhe-Testgröße, signed" SBYTE luquant 1 100 -232.831 231.012 FUNCTION_LIST DMDDLU IF_DATA DIM_X 0x38099A EXTERN WORD IF_DATA MCMESS 0x38099A EXTERN /end MEASUREMENT
/begin MEASUREMENT dluts6 "Differenz Laufunruhe-Testgröße, signed" SBYTE luquant 1 100 -232.831 231.012 FUNCTION_LIST DMDDLU IF_DATA DIM_X 0x38099B EXTERN WORD IF_DATA MCMESS 0x38099B EXTERN /end MEASUREMENT
/begin MEASUREMENT dluts7 "Differenz Laufunruhe-Testgröße, signed" SBYTE luquant 1 100 -232.831 231.012 FUNCTION_LIST DMDDLU IF_DATA DIM_X 0x38099C EXTERN WORD IF_DATA MCMESS 0x38099C EXTERN /end MEASUREMENT
/begin MEASUREMENT dluts8 "Differenz Laufunruhe-Testgröße, signed" SBYTE luquant 1 100 -232.831 231.012 FUNCTION_LIST DMDDLU IF_DATA DIM_X 0x38099D EXTERN WORD IF_DATA MCMESS 0x38099D EXTERN /end MEASUREMENT
/begin MEASUREMENT dluts_m "Monitor, Laufunruhedifferenz-Testgröße, signed, verzögerte Ausgabe" SBYTE luquant 1 100 -232.831 231.012 FUNCTION_LIST DMDDLU IF_DATA DIM_X 0xE3ED INTERN WORD IF_DATA MCMESS 0xE3ED INTERN /end MEASUREMENT
/begin MEASUREMENT dmar_w "Delta Drehmoment antiruckel" SWORD rel_sw_b100 1 100 -100 99.9969 FUNCTION_LIST ARMD MDKOG IF_DATA DIM_X 0x3825BE EXTERN WORD IF_DATA MCMESS 0x3825BE EXTERN /end MEASUREMENT
/begin MEASUREMENT dmaufr_w "Delta Aufregelmoment" UWORD rel_uw_b100 1 100 0 99.9985 FUNCTION_LIST MDZW MDAUTG IF_DATA DIM_X 0x382CDC EXTERN WORD IF_DATA MCMESS 0x382CDC EXTERN /end MEASUREMENT
/begin MEASUREMENT dmdpo_w "delta Moment Dashpot-Ausloesung" SWORD rel_sw_b100 1 100 -100 99.9969 FUNCTION_LIST MDFAW IF_DATA DIM_X 0x382642 EXTERN WORD IF_DATA MCMESS 0x382642 EXTERN /end MEASUREMENT
/begin MEASUREMENT dmdpu_w "delta Moment Dashpot-Ende" SWORD rel_sw_b100 1 100 -100 99.9969 FUNCTION_LIST MDFAW IF_DATA DIM_X 0x382644 EXTERN WORD IF_DATA MCMESS 0x382644 EXTERN /end MEASUREMENT
/begin MEASUREMENT dmibdp_w "" SWORD rel_sw_b100 1 100 -100 99.9969 FUNCTION_LIST MDFAW IF_DATA DIM_X 0x382646 EXTERN WORD IF_DATA MCMESS 0x382646 EXTERN /end MEASUREMENT
/begin MEASUREMENT dmifabas_w "Delta Fahrermomentenwunsch zu Basismoment" SWORD rel_sw_b100 1 100 -100 99.9969 FUNCTION_LIST MDAUTG IF_DATA DIM_X 0x382612 EXTERN WORD IF_DATA MCMESS 0x382612 EXTERN /end MEASUREMENT
/begin MEASUREMENT dmletanf_w "gefilterter Wert für Abweichung Leerlaufenergiebedarf während DTEV" SWORD m_q0p0031 1 100 -102.4 102.397 FUNCTION_LIST DTEV IF_DATA DIM_X 0x382C32 EXTERN WORD IF_DATA MCMESS 0x382C32 EXTERN /end MEASUREMENT
/begin MEASUREMENT dmletanu "Abweichung Produkt Luftmasse * Zündwinkelwirkungsgrad bei Prüfung DTEV unsigned" UBYTE m_q0p1 1 100 0 25.5 FUNCTION_LIST DTEV IF_DATA DIM_X 0x380CCF EXTERN WORD IF_DATA MCMESS 0x380CCF EXTERN /end MEASUREMENT
/begin MEASUREMENT dmletan_w "Abweichung Produkt Luftmasse * Zündwinkelwirkungsgrad bei Prüfung DTEV 16 Bits" SWORD m_q0p0031 1 100 -102.4 102.397 FUNCTION_LIST DTEV IF_DATA DIM_X 0x382C34 EXTERN WORD IF_DATA MCMESS 0x382C34 EXTERN /end MEASUREMENT
/begin MEASUREMENT dmlftef "Produkt Spülrate mal prozentuale Luftmassenänderung" UBYTE fak_ub_b0p5 1 100 0 0.498047 FUNCTION_LIST TEB IF_DATA DIM_X 0x380CBE EXTERN WORD IF_DATA MCMESS 0x380CBE EXTERN /end MEASUREMENT
/begin MEASUREMENT dmllrd_w "geforderte Drehmomentänderung von der LLR (D-Anteil)" SWORD rel_sw_b100 1 100 -100 99.9969 FUNCTION_LIST LLRRM IF_DATA DIM_X 0x38252C EXTERN WORD IF_DATA MCMESS 0x38252C EXTERN /end MEASUREMENT
/begin MEASUREMENT dmllri_w "geforderte Drehmomentänderung von der LLR (I-Anteil)" SWORD rel_sw_b100 1 100 -100 99.9969 FUNCTION_LIST LLRRM DLLR KHMD LLRBB MDFAW MDVERAD T2LID IF_DATA DIM_X 0x38252E EXTERN WORD IF_DATA MCMESS 0x38252E EXTERN /end MEASUREMENT
/begin MEASUREMENT dmllrl_w "geforderte Drehmomentänderung von der LLR (Anteil Luftpfad)" SWORD rel_sw_b100 1 100 -100 99.9969 FUNCTION_LIST LLRRM MDKOL IF_DATA DIM_X 0x382530 EXTERN WORD IF_DATA MCMESS 0x382530 EXTERN /end MEASUREMENT
/begin MEASUREMENT dmllrp_w "geforderte Drehmomentänderung von der LLR (P-Anteil)" SWORD rel_sw_b100 1 100 -100 99.9969 FUNCTION_LIST LLRRM IF_DATA DIM_X 0x382532 EXTERN WORD IF_DATA MCMESS 0x382532 EXTERN /end MEASUREMENT
/begin MEASUREMENT dmllr_w "geforderte Drehmomentänderung von der LLR (PD-Anteil)" SWORD rel_sw_b100 1 100 -100 99.9969 FUNCTION_LIST LLRRM MDAUTG MDKOG T2LID IF_DATA DIM_X 0x382534 EXTERN WORD IF_DATA MCMESS 0x382534 EXTERN /end MEASUREMENT
/begin MEASUREMENT dmlsdo_w "Delta Moment Auslösung Lastschlagdämpfung" SWORD rel_sw_b100 1 100 -100 99.9969 FUNCTION_LIST MDFAW IF_DATA DIM_X 0x382648 EXTERN WORD IF_DATA MCMESS 0x382648 EXTERN /end MEASUREMENT
/begin MEASUREMENT dmlsdu_w "Delta Moment Ende Lastschlagdämpfung" SWORD rel_sw_b100 1 100 -100 99.9969 FUNCTION_LIST MDFAW IF_DATA DIM_X 0x38264A EXTERN WORD IF_DATA MCMESS 0x38264A EXTERN /end MEASUREMENT
/begin MEASUREMENT dmnmxi_w "Drehmoment aus Integralanteil der NMAX-Regelung" SWORD rel_sw_b100 1 100 -100 99.9969 FUNCTION_LIST NMAXMD IF_DATA DIM_X 0x3826D0 EXTERN WORD IF_DATA MCMESS 0x3826D0 EXTERN /end MEASUREMENT
/begin MEASUREMENT dmnmxp_w "Drehmoment aus Proportionalanteil der NMAX-Regelung" SWORD rel_sw_b100 1 100 -100 99.9969 FUNCTION_LIST NMAXMD IF_DATA DIM_X 0x3826D2 EXTERN WORD IF_DATA MCMESS 0x3826D2 EXTERN /end MEASUREMENT
/begin MEASUREMENT dmrac "Reservemoment für AC-Kompressor" UBYTE rel_ub_b99p6 1 100 0 99.6094 FUNCTION_LIST MDVERB LLRMR IF_DATA DIM_X 0x380C11 EXTERN WORD IF_DATA MCMESS 0x380C11 EXTERN /end MEASUREMENT
/begin MEASUREMENT dmrar_w "Delta Relatives Moment bei Abschaltrampe FGR" UWORD rel_uw_b200 1 100 0 199.997 FUNCTION_LIST FGRAUS IF_DATA DIM_X 0x381F8A EXTERN WORD IF_DATA MCMESS 0x381F8A EXTERN /end MEASUREMENT
/begin MEASUREMENT dmrdagr_w "Momentenreserve für Diagnose AGR" UWORD rel_uw_b100 1 100 0 99.9985 FUNCTION_LIST SWADP MDTRIP IF_DATA DIM_X 0x382B2A EXTERN WORD IF_DATA MCMESS 0x382B2A EXTERN /end MEASUREMENT
/begin MEASUREMENT dmrdkt_w "Momenten-Reserve für Katalysatordiagnose" UWORD rel_uw_b100 1 100 0 99.9985 FUNCTION_LIST DKATLRS MDTRIP IF_DATA DIM_X 0x381C46 EXTERN WORD IF_DATA MCMESS 0x381C46 EXTERN /end MEASUREMENT
/begin MEASUREMENT dmrdsls_w "Momentenreserve für Diagnose Sekundärluft" UWORD rel_uw_b100 1 100 0 99.9985 FUNCTION_LIST KHMD MDTRIP IF_DATA DIM_X 0x3823FE EXTERN WORD IF_DATA MCMESS 0x3823FE EXTERN /end MEASUREMENT
/begin MEASUREMENT dmrfabn_w "Aktuelle gewichtete Leistung um Schwelle MRFABNTE verschoben" SWORD rel_sw_b100 1 100 -100 99.9969 FUNCTION_LIST BBTEGA IF_DATA DIM_X 0x3821F0 EXTERN WORD IF_DATA MCMESS 0x3821F0 EXTERN /end MEASUREMENT
/begin MEASUREMENT dmrkh "Momenten-Reserve für Katheizen" UBYTE rel_ub_b99p6 1 100 0 99.6094 FUNCTION_LIST KHMD DMDLU DMDLU_C DMDSTP MDKOG MDKOL IF_DATA DIM_X 0x380B73 EXTERN WORD IF_DATA MCMESS 0x380B73 EXTERN /end MEASUREMENT
/begin MEASUREMENT dmrkhz_w "Momentenreserve für Katheizen" UWORD rel_uw_b100 1 100 0 99.9985 FUNCTION_LIST KHMD IF_DATA DIM_X 0x382400 EXTERN WORD IF_DATA MCMESS 0x382400 EXTERN /end MEASUREMENT
/begin MEASUREMENT dmrkh_w "Momentenreserve für Katheizen" UWORD rel_uw_b100 1 100 0 99.9985 FUNCTION_LIST KHMD IF_DATA DIM_X 0x382402 EXTERN WORD IF_DATA MCMESS 0x382402 EXTERN /end MEASUREMENT
/begin MEASUREMENT dmrkt_w "Momentenreserve im Kurztrip" UWORD rel_uw_b100 1 100 0 99.9985 FUNCTION_LIST MDTRIP MDKOG MDKOL IF_DATA DIM_X 0x3826BE EXTERN WORD IF_DATA MCMESS 0x3826BE EXTERN /end MEASUREMENT
/begin MEASUREMENT dmrlash_w "Momenten-Reserve für Lambdasonden-Alterungsüberwachung hinter Kat" UWORD rel_uw_b100 1 100 0 99.9985 FUNCTION_LIST DLSAHK MDTRIP IF_DATA DIM_X 0x381CB0 EXTERN WORD IF_DATA MCMESS 0x381CB0 EXTERN /end MEASUREMENT
/begin MEASUREMENT dmrlf1 "Momentreserve Lüfterstufe 1" UBYTE rel_ub_b99p6 1 100 0 99.6094 FUNCTION_LIST MDVERB IF_DATA DIM_X 0x380C12 EXTERN WORD IF_DATA MCMESS 0x380C12 EXTERN /end MEASUREMENT
/begin MEASUREMENT dmrlf2 "Reservemoment Lüfterstufe 2" UBYTE rel_ub_b99p6 1 100 0 99.6094 FUNCTION_LIST MDVERB IF_DATA DIM_X 0x380C13 EXTERN WORD IF_DATA MCMESS 0x380C13 EXTERN /end MEASUREMENT
/begin MEASUREMENT dmrllr "Momenten-Reserve für Leerlaufregelung" UBYTE rel_ub_b99p6 1 100 0 99.6094 FUNCTION_LIST LLRMR MDKOL IF_DATA DIM_X 0x380C03 EXTERN WORD IF_DATA MCMESS 0x380C03 EXTERN /end MEASUREMENT
/begin MEASUREMENT dmrlsh_w "Momenten-Reserve für Sondendiagnose hinter Kat" UWORD rel_uw_b100 1 100 0 99.9985 FUNCTION_LIST DLSH MDTRIP IF_DATA DIM_X 0x381CEE EXTERN WORD IF_DATA MCMESS 0x381CEE EXTERN /end MEASUREMENT
/begin MEASUREMENT dmrlsv_w "Momenten-Reserve für Sondendiagnose vor Kat" UWORD rel_uw_b100 1 100 0 99.9985 FUNCTION_LIST DLSU MDTRIP IF_DATA DIM_X 0x381D16 EXTERN WORD IF_DATA MCMESS 0x381D16 EXTERN /end MEASUREMENT
/begin MEASUREMENT dmrmsg "Reservemoment Motorspülgebläse" UBYTE rel_ub_b99p6 1 100 0 99.6094 FUNCTION_LIST MDVERB IF_DATA DIM_X 0x380C14 EXTERN WORD IF_DATA MCMESS 0x380C14 EXTERN /end MEASUREMENT
/begin MEASUREMENT dmsldrl_w "Delta relative Luftfüllung (Word)" UWORD rel_uw_q0p0234 1 100 0 1535.98 FUNCTION_LIST DSLSLRS IF_DATA DIM_X 0x380E2A EXTERN WORD IF_DATA MCMESS 0x380E2A EXTERN /end MEASUREMENT
/begin MEASUREMENT dmsnte_w "normierte Massenstromänderung über TEV" SWORD m_q0p1 1 100 -3276.8 3276.7 FUNCTION_LIST DTEV IF_DATA DIM_X 0x382C36 EXTERN WORD IF_DATA MCMESS 0x382C36 EXTERN /end MEASUREMENT
/begin MEASUREMENT dmssginr "relative Änderung des Massenstromes mssgin_w" SBYTE fak_sb_b1 1 100 -1 0.992188 FUNCTION_LIST TEB IF_DATA DIM_X 0x380CBF EXTERN WORD IF_DATA MCMESS 0x380CBF EXTERN /end MEASUREMENT
/begin MEASUREMENT dmtvvs "Anstieg Drehmoment zur Verkürzung Verzugszeiten bei Ventilhubsteuerung" UBYTE rel_ub_q0p75 1 100 0 191.25 FUNCTION_LIST VS IF_DATA DIM_X 0x380D00 EXTERN WORD IF_DATA MCMESS 0x380D00 EXTERN /end MEASUREMENT
/begin MEASUREMENT dmvadfk_w "Delta-Motordrehmoment aus Verlustmoment-Adaption (B_fs=1 & B_ko=1)" SWORD rel_sw_b100 1 100 -100 99.9969 FUNCTION_LIST MDVERAD IF_DATA DIM_X 0x383A06 EXTERN WORD IF_DATA MCMESS 0x383A06 EXTERN /end MEASUREMENT
/begin MEASUREMENT dmvadfs_w "Delta-Motordrehmoment aus Verlustmoment-Adaption (B_fs=1)" SWORD rel_sw_b100 1 100 -100 99.9969 FUNCTION_LIST MDVERAD IF_DATA DIM_X 0x383A08 EXTERN WORD IF_DATA MCMESS 0x383A08 EXTERN /end MEASUREMENT
/begin MEASUREMENT dmvadko_w "Delta-Motordrehmoment aus Verlustmoment-Adaption (B_ko=1)" SWORD rel_sw_b100 1 100 -100 99.9969 FUNCTION_LIST MDVERAD IF_DATA DIM_X 0x383A0A EXTERN WORD IF_DATA MCMESS 0x383A0A EXTERN /end MEASUREMENT
/begin MEASUREMENT dmvadll_w "Delta-Motordrehmoment aus Verlustmoment-Adaption (B_ll=1)" SWORD rel_sw_b100 1 100 -100 99.9969 FUNCTION_LIST MDVERAD T2LID IF_DATA DIM_X 0x383A0C EXTERN WORD IF_DATA MCMESS 0x383A0C EXTERN /end MEASUREMENT
/begin MEASUREMENT dmvad_w "Delta-Motordrehmoment aus Verlustmoment-Adaption" SWORD rel_sw_b100 1 100 -100 99.9969 FUNCTION_LIST MDVERAD DTEV MDVER IF_DATA DIM_X 0x382578 EXTERN WORD IF_DATA MCMESS 0x382578 EXTERN /end MEASUREMENT
/begin MEASUREMENT dmvamnfk_w "Minimalbegrenzung der Verlustmomentadaption (B_fs=1 & B_ko=1)" SWORD rel_sw_b100 1 100 -100 99.9969 FUNCTION_LIST MDVERAD IF_DATA DIM_X 0x38257A EXTERN WORD IF_DATA MCMESS 0x38257A EXTERN /end MEASUREMENT
/begin MEASUREMENT dmvamnfs_w "Minimalbegrenzung der Verlustmomentadaption (B_fs=1)" SWORD rel_sw_b100 1 100 -100 99.9969 FUNCTION_LIST MDVERAD IF_DATA DIM_X 0x38257C EXTERN WORD IF_DATA MCMESS 0x38257C EXTERN /end MEASUREMENT
/begin MEASUREMENT dmvamnko_w "Minimalbegrenzung der Verlustmomentadaption (B_ko=1)" SWORD rel_sw_b100 1 100 -100 99.9969 FUNCTION_LIST MDVERAD IF_DATA DIM_X 0x38257E EXTERN WORD IF_DATA MCMESS 0x38257E EXTERN /end MEASUREMENT
/begin MEASUREMENT dmvamnll_w "Minimalbegrenzung der Verlustmomentadaption (B_ll=1)" SWORD rel_sw_b100 1 100 -100 99.9969 FUNCTION_LIST MDVERAD IF_DATA DIM_X 0x382580 EXTERN WORD IF_DATA MCMESS 0x382580 EXTERN /end MEASUREMENT
/begin MEASUREMENT dmvamxfk_w "0aximalbegrenzung der Verlustmomentadaption (B_fs=1 & B_ko=1)" SWORD rel_sw_b100 1 100 -100 99.9969 FUNCTION_LIST MDVERAD IF_DATA DIM_X 0x382582 EXTERN WORD IF_DATA MCMESS 0x382582 EXTERN /end MEASUREMENT
/begin MEASUREMENT dmvamxfs_w "Maximalbegrenzung der Verlustmomentadaption (B_fs=1)" SWORD rel_sw_b100 1 100 -100 99.9969 FUNCTION_LIST MDVERAD IF_DATA DIM_X 0x382584 EXTERN WORD IF_DATA MCMESS 0x382584 EXTERN /end MEASUREMENT
/begin MEASUREMENT dmvamxko_w "Maximalbegrenzung der Verlustmomentadaption (B_ko=1)" SWORD rel_sw_b100 1 100 -100 99.9969 FUNCTION_LIST MDVERAD IF_DATA DIM_X 0x382586 EXTERN WORD IF_DATA MCMESS 0x382586 EXTERN /end MEASUREMENT
/begin MEASUREMENT dmvamxll_w "Maximalbegrenzung der Verlustmomentadaption (B_ll=1)" SWORD rel_sw_b100 1 100 -100 99.9969 FUNCTION_LIST MDVERAD IF_DATA DIM_X 0x382588 EXTERN WORD IF_DATA MCMESS 0x382588 EXTERN /end MEASUREMENT
/begin MEASUREMENT dmverl_w "Verlustmoment nach DT1-Filter" SWORD rel_sw_b100 1 100 -100 99.9969 FUNCTION_LIST MDVER MDFAW IF_DATA DIM_X 0x38259E EXTERN WORD IF_DATA MCMESS 0x38259E EXTERN /end MEASUREMENT
/begin MEASUREMENT dmvmxi_w "Drehmoment I-Anteil bei VMAX-Regelung" SWORD rel_sw_b100 1 100 -100 99.9969 FUNCTION_LIST VMAXMD IF_DATA DIM_X 0x3826EE EXTERN WORD IF_DATA MCMESS 0x3826EE EXTERN /end MEASUREMENT
/begin MEASUREMENT dmvmxp_w "Drehmoment P-Anteil bei VMAX-Regelung" SWORD rel_sw_b100 1 100 -100 99.9969 FUNCTION_LIST VMAXMD IF_DATA DIM_X 0x3826F0 EXTERN WORD IF_DATA MCMESS 0x3826F0 EXTERN /end MEASUREMENT
/begin MEASUREMENT dmzms_w "Abstand des indizierten Sollmoments vom zulässigen Sollmoment" SWORD rel_sw_b100 1 100 -100 99.9969 FUNCTION_LIST MDKOG IF_DATA DIM_X 0x382696 EXTERN WORD IF_DATA MCMESS 0x382696 EXTERN /end MEASUREMENT
/begin MEASUREMENT dn "Drehzahlabweichung bei Leerlaufregelung" SBYTE nmotd_sb_q10 1 100 -1280 1270 FUNCTION_LIST LLRRM LLRBB LLRMR IF_DATA DIM_X 0x380C0E EXTERN WORD IF_DATA MCMESS 0x380C0E EXTERN /end MEASUREMENT
/begin MEASUREMENT dnikorr_w "Korrekturwert auf den Integrator nach Diagnose" UWORD nmot_uw_q0p25 1 100 0 16383.8 FUNCTION_LIST LLRRM IF_DATA DIM_X 0x382536 EXTERN WORD IF_DATA MCMESS 0x382536 EXTERN /end MEASUREMENT
/begin MEASUREMENT dnmotas_w "Differenzdrehzahl über ein Arbeitsspiel" SWORD nmot_sw_q0p25 1 100 -8192 8191.75 FUNCTION_LIST BGNG IF_DATA DIM_X 0x381B28 EXTERN WORD IF_DATA MCMESS 0x381B28 EXTERN /end MEASUREMENT
/begin MEASUREMENT dnmot_w "Differenzdrehzahl zwischen zwei folgenden Segmenten" SWORD nmot_sw_q0p25 1 100 -8192 8191.75 FUNCTION_LIST BGNG ESSTT STADAP IF_DATA DIM_X 0x381B2A EXTERN WORD IF_DATA MCMESS 0x381B2A EXTERN /end MEASUREMENT
/begin MEASUREMENT dns "LLR: Drehzahlabweichung zur stationären Solldrehzahl" SBYTE nmotd_sb_q10 1 100 -1280 1270 FUNCTION_LIST LLRNS DLLR LLRMR LLRRM IF_DATA DIM_X 0x380C07 EXTERN WORD IF_DATA MCMESS 0x380C07 EXTERN /end MEASUREMENT
/begin MEASUREMENT dnsa "Zeitabhängige Schubhysterese" UBYTE nmot_ub_q40 1 100 0 10200 FUNCTION_LIST BBSAWE IF_DATA DIM_X 0x380C00 EXTERN WORD IF_DATA MCMESS 0x380C00 EXTERN /end MEASUREMENT
/begin MEASUREMENT dnsi_w "Differenz zwischen Soll- und Ist-Motordrehzahl" SWORD nmot_sw_q0p25 1 100 -8192 8191.75 FUNCTION_LIST NMAXMD IF_DATA DIM_X 0x3826D4 EXTERN WORD IF_DATA MCMESS 0x3826D4 EXTERN /end MEASUREMENT
/begin MEASUREMENT dnturb "Turbinendrehzahldifferenz des Wandlers" SBYTE nmot_sb_q20 1 100 -2560 2540 FUNCTION_LIST MDWAN IF_DATA DIM_X 0x380C1B EXTERN WORD IF_DATA MCMESS 0x380C1B EXTERN /end MEASUREMENT
/begin MEASUREMENT dn_w "Drehzahlabweichung bei Leerlaufregelung" SWORD nmot_sw_q0p25 1 100 -8192 8191.75 FUNCTION_LIST LLRRM IF_DATA DIM_X 0x382538 EXTERN WORD IF_DATA MCMESS 0x382538 EXTERN /end MEASUREMENT
/begin MEASUREMENT dpdk_w "Druckabfall über Drosselklappe" UWORD p_uw_q0p039 1 100 0 2559.96 FUNCTION_LIST FUEDK LDRLMX IF_DATA DIM_X 0x382128 EXTERN WORD IF_DATA MCMESS 0x382128 EXTERN /end MEASUREMENT
/begin MEASUREMENT dpgNvBits "" UBYTE dez 1 100 0 255 FUNCTION_LIST GGDPG IF_DATA DIM_X 0x382FDB EXTERN WORD IF_DATA MCMESS 0x382FDB EXTERN /end MEASUREMENT
/begin MEASUREMENT dphBits "" UBYTE dez 1 100 0 255 FUNCTION_LIST DPH IF_DATA DIM_X 0x380A22 EXTERN WORD IF_DATA MCMESS 0x380A22 EXTERN /end MEASUREMENT
/begin MEASUREMENT dpsdvs_w "delta Saugrohrdruck aus Drosselventilen (Word)" SWORD p_sw_q0p039 1 100 -1280 1279.96 FUNCTION_LIST BGRLP IF_DATA DIM_X 0x3821FE EXTERN WORD IF_DATA MCMESS 0x3821FE EXTERN /end MEASUREMENT
/begin MEASUREMENT dpsfg_w "delta-Frischgaspartialdruck im Saugrohr" SWORD p_sw_q0p039 1 100 -1280 1279.96 FUNCTION_LIST BGSRM BGRLP IF_DATA DIM_X 0x3820DE EXTERN WORD IF_DATA MCMESS 0x3820DE EXTERN /end MEASUREMENT
/begin MEASUREMENT dpsmp_w "delta extrapolierter Saugrohrdruck (Word)" SWORD p_sw_q0p039 1 100 -1280 1279.96 FUNCTION_LIST BGRLP IF_DATA DIM_X 0x382200 EXTERN WORD IF_DATA MCMESS 0x382200 EXTERN /end MEASUREMENT
/begin MEASUREMENT dpus_w "Delta Druck Umgebung Saugrohr" SWORD p_sw_q0p078 1 100 -2560 2559.92 FUNCTION_LIST AES IF_DATA DIM_X 0x3821E6 EXTERN WORD IF_DATA MCMESS 0x3821E6 EXTERN /end MEASUREMENT
/begin MEASUREMENT dpvdkspu_w "delta zwischen Druck vor Drosselklappe und Umgebungsdruck" UWORD p_uw_q0p039 1 100 0 2559.96 FUNCTION_LIST GGDSAS IF_DATA DIM_X 0x38208E EXTERN WORD IF_DATA MCMESS 0x38208E EXTERN /end MEASUREMENT
/begin MEASUREMENT dpvl_w "Druckabfall am Luftfilter" UWORD p_uw_q0p039 1 100 0 2559.96 FUNCTION_LIST BGTEV IF_DATA DIM_X 0x382B70 EXTERN WORD IF_DATA MCMESS 0x382B70 EXTERN /end MEASUREMENT
/begin MEASUREMENT dpwrsvc "Zeitzähler DV-E-Powersave" UWORD t10msxs_uw_b655p35 1 100 0 655.35 FUNCTION_LIST ADVE IF_DATA DIM_X 0x381E5E EXTERN WORD IF_DATA MCMESS 0x381E5E EXTERN /end MEASUREMENT
/begin MEASUREMENT drkuke_w "Delta relative Kraftstoffmasse Ersatzwert" UWORD rel_uw_q0p1875 1 100 0 12287.8 FUNCTION_LIST ESUK IF_DATA DIM_X 0x38228E EXTERN WORD IF_DATA MCMESS 0x38228E EXTERN /end MEASUREMENT
/begin MEASUREMENT drkwtmp_w "Momentenreserve für Kat warmhalten, zeitweise" UWORD rel_uw_b100 1 100 0 99.9985 FUNCTION_LIST KHMD IF_DATA DIM_X 0x382404 EXTERN WORD IF_DATA MCMESS 0x382404 EXTERN /end MEASUREMENT
/begin MEASUREMENT drlas_w "Füllungsänderung pro Arbeitsspiel" SWORD relNWU_q0p0234 1 100 -768 767.977 FUNCTION_LIST BGRLG IF_DATA DIM_X 0x382052 EXTERN WORD IF_DATA MCMESS 0x382052 EXTERN /end MEASUREMENT
/begin MEASUREMENT drldkzu_w "Differenz zwischen rl aus Hauptlastsignal zu Nebenlastsignal" SWORD rel_sw_q0p0234 1 100 -768 767.977 FUNCTION_LIST BGMSZS IF_DATA DIM_X 0x381FF0 EXTERN WORD IF_DATA MCMESS 0x381FF0 EXTERN /end MEASUREMENT
/begin MEASUREMENT drlfue_w "Lastkorrektur des Füllungsreglers" SWORD rel_sw_q0p0234 1 100 -768 767.977 FUNCTION_LIST FUEREG FUEDK IF_DATA DIM_X 0x3821AA EXTERN WORD IF_DATA MCMESS 0x3821AA EXTERN /end MEASUREMENT
/begin MEASUREMENT drlkrdy "Lastgradient für Auslösung KR-Lastdynamik" SWORD rel_sw_q0p0234 1 100 -768 767.977 FUNCTION_LIST KRDY IF_DATA DIM_X 0x382466 EXTERN WORD IF_DATA MCMESS 0x382466 EXTERN /end MEASUREMENT
/begin MEASUREMENT drllad_w "Dynamikanteil der relativen Füllung rl bei Laderdynamik" SWORD rel_sw_q0p0234 1 100 -768 767.977 FUNCTION_LIST BGMSZS IF_DATA DIM_X 0x381FF2 EXTERN WORD IF_DATA MCMESS 0x381FF2 EXTERN /end MEASUREMENT
/begin MEASUREMENT drlmaxo "Delta Maximalfuellung bei Overboost" UBYTE rel_ub_q0p75 1 100 0 191.25 FUNCTION_LIST LDOB LDRLMX SSTBER87 IF_DATA DIM_X 0x380BF1 EXTERN WORD IF_DATA MCMESS 0x380BF1 EXTERN /end MEASUREMENT
/begin MEASUREMENT drlm_w "Soll- Istwertdifferenz des Luftmassenreglers" SWORD rel_sw_q0p0234 1 100 -768 767.977 FUNCTION_LIST FUEREG IF_DATA DIM_X 0x3821AC EXTERN WORD IF_DATA MCMESS 0x3821AC EXTERN /end MEASUREMENT
/begin MEASUREMENT drlp_w "delta-Einspritzberechnungs-Last aus Praediktion (Word)" SWORD rel_sw_q0p0234 1 100 -768 767.977 FUNCTION_LIST BGRLP ESUK KRDY IF_DATA DIM_X 0xFAE2 INTERN WORD IF_DATA MCMESS 0xFAE2 INTERN /end MEASUREMENT
/begin MEASUREMENT drlsolf_w "gefilterte Änderung Sollfüllung" SWORD rel_sw_q0p0234 1 100 -768 767.977 FUNCTION_LIST MDFUE IF_DATA DIM_X 0x3821B6 EXTERN WORD IF_DATA MCMESS 0x3821B6 EXTERN /end MEASUREMENT
/begin MEASUREMENT drlsolmf_w "delta Sollfüllung für medianfilter" UWORD rel_uw_q0p0234 1 100 0 1535.98 FUNCTION_LIST FUEDK IF_DATA DIM_X 0x382130 EXTERN WORD IF_DATA MCMESS 0x382130 EXTERN /end MEASUREMENT
/begin MEASUREMENT drlsol_w "Änderung Sollfüllung" SWORD rel_sw_q0p0234 1 100 -768 767.977 FUNCTION_LIST MDFUE IF_DATA DIM_X 0x3821B8 EXTERN WORD IF_DATA MCMESS 0x3821B8 EXTERN /end MEASUREMENT
/begin MEASUREMENT drl_w "Füllungsänderung (Word)" SWORD rel_sw_q0p0234 1 100 -768 767.977 FUNCTION_LIST BGSRM BGRLP KRDY IF_DATA DIM_X 0x3820E0 EXTERN WORD IF_DATA MCMESS 0x3820E0 EXTERN /end MEASUREMENT
/begin MEASUREMENT DSLSLRSlokBits1 "" UBYTE dez 1 100 0 255 FUNCTION_LIST DSLSLRS IF_DATA DIM_X 0x380900 EXTERN WORD IF_DATA MCMESS 0x380900 EXTERN /end MEASUREMENT
/begin MEASUREMENT DSLSLRSlokBits1a "" UBYTE dez 1 100 0 255 FUNCTION_LIST DSLSLRS IF_DATA DIM_X 0x380901 EXTERN WORD IF_DATA MCMESS 0x380901 EXTERN /end MEASUREMENT
/begin MEASUREMENT DSLSLRSlokBits2 "" UBYTE dez 1 100 0 255 FUNCTION_LIST DSLSLRS IF_DATA DIM_X 0x380902 EXTERN WORD IF_DATA MCMESS 0x380902 EXTERN /end MEASUREMENT
/begin MEASUREMENT DSLSLRSlokBits2a "" UBYTE dez 1 100 0 255 FUNCTION_LIST DSLSLRS IF_DATA DIM_X 0x380903 EXTERN WORD IF_DATA MCMESS 0x380903 EXTERN /end MEASUREMENT
/begin MEASUREMENT DSLSLRSlokBits3 "" UBYTE dez 1 100 0 255 FUNCTION_LIST DSLSLRS IF_DATA DIM_X 0x380904 EXTERN WORD IF_DATA MCMESS 0x380904 EXTERN /end MEASUREMENT
/begin MEASUREMENT DSLSLRSlokBits3a "" UBYTE dez 1 100 0 255 FUNCTION_LIST DSLSLRS IF_DATA DIM_X 0x380905 EXTERN WORD IF_DATA MCMESS 0x380905 EXTERN /end MEASUREMENT
/begin MEASUREMENT DSLSLRSlokBits4 "" UBYTE dez 1 100 0 255 FUNCTION_LIST DSLSLRS IF_DATA DIM_X 0x380906 EXTERN WORD IF_DATA MCMESS 0x380906 EXTERN /end MEASUREMENT
/begin MEASUREMENT DSLSLRSlokBits4a "" UBYTE dez 1 100 0 255 FUNCTION_LIST DSLSLRS IF_DATA DIM_X 0x380907 EXTERN WORD IF_DATA MCMESS 0x380907 EXTERN /end MEASUREMENT
/begin MEASUREMENT DSLSLRSlokBits5 "" UBYTE dez 1 100 0 255 FUNCTION_LIST DSLSLRS IF_DATA DIM_X 0x380908 EXTERN WORD IF_DATA MCMESS 0x380908 EXTERN /end MEASUREMENT
/begin MEASUREMENT dstert20_w "Normierte Weitertransportstrecke Regeneriergas im Saugrohr im 20ms-Raster" UWORD fak_uw_b2 1 100 0 1.99997 FUNCTION_LIST TEB IF_DATA DIM_X 0x382BA0 EXTERN WORD IF_DATA MCMESS 0x382BA0 EXTERN /end MEASUREMENT
/begin MEASUREMENT DTEVbit "" UBYTE dez 1 100 0 255 FUNCTION_LIST DTEV IF_DATA DIM_X 0x380CD8 EXTERN WORD IF_DATA MCMESS 0x380CD8 EXTERN /end MEASUREMENT
/begin MEASUREMENT DTEVNonVolbits "" UBYTE dez 1 100 0 255 FUNCTION_LIST DTEV IF_DATA DIM_X 0x38311B EXTERN WORD IF_DATA MCMESS 0x38311B EXTERN /end MEASUREMENT
/begin MEASUREMENT dtsegph_w "Faktor zur Bewertung der Motordynamik" SWORD t5usxus_q5 1 100 -163840 163835 FUNCTION_LIST NLDG IF_DATA DIM_X 0x381B78 EXTERN WORD IF_DATA MCMESS 0x381B78 EXTERN /end MEASUREMENT
/begin MEASUREMENT dub "Batteriespannungsabweichung für Batteriespannungsregelung" SBYTE spg_ubatt 1 100 -9.728 9.652 FUNCTION_LIST BGLBZ IF_DATA DIM_X 0x380A93 EXTERN WORD IF_DATA MCMESS 0x380A93 EXTERN /end MEASUREMENT
/begin MEASUREMENT dveadchst "DV-E-Adaption: Status Prüfbedingungen" UBYTE dez 1 100 0 255 FUNCTION_LIST BGDVE DDVE IF_DATA DIM_X 0x380AA6 EXTERN WORD IF_DATA MCMESS 0x380AA6 EXTERN /end MEASUREMENT
/begin MEASUREMENT dveesc "Entprellzähler für DV-E-Endstufe" UBYTE t10msxs_ub_b2p55 1 100 0 2.55 FUNCTION_LIST ADVE IF_DATA DIM_X 0x380A9F EXTERN WORD IF_DATA MCMESS 0x380A9F EXTERN /end MEASUREMENT
/begin MEASUREMENT dvfrmvs "" UBYTE fak_ub_b2 1 100 0 1.99219 FUNCTION_LIST DVS IF_DATA DIM_X 0x380CDA EXTERN WORD IF_DATA MCMESS 0x380CDA EXTERN /end MEASUREMENT
/begin MEASUREMENT dvprae_w "Prädizierter Geschwindigkeitsanteil" UWORD vfzg_uw_q0p00781 1 100 0 511.992 FUNCTION_LIST VMAXMD IF_DATA DIM_X 0x3826F2 EXTERN WORD IF_DATA MCMESS 0x3826F2 EXTERN /end MEASUREMENT
/begin MEASUREMENT dvrabe_w "Delta Geschwindigkeit bei Beschleunigungsrampe" UWORD vfzg_uw_b512 1 100 0 511.992 FUNCTION_LIST FGRMD IF_DATA DIM_X 0x381F92 EXTERN WORD IF_DATA MCMESS 0x381F92 EXTERN /end MEASUREMENT
/begin MEASUREMENT dvrave_w "Delta Geschwindigkeit bei Verzögerungsrampe" UWORD vfzg_uw_b512 1 100 0 511.992 FUNCTION_LIST FGRMD IF_DATA DIM_X 0x381F94 EXTERN WORD IF_DATA MCMESS 0x381F94 EXTERN /end MEASUREMENT
/begin MEASUREMENT dvsi_w "Abweichung zwischen Soll- und Istgeschwindigkeit der VMAX-Regelung" SWORD vfzg_sw_q0p00781 1 100 -256 255.992 FUNCTION_LIST VMAXMD IF_DATA DIM_X 0x3826F4 EXTERN WORD IF_DATA MCMESS 0x3826F4 EXTERN /end MEASUREMENT
/begin MEASUREMENT dvzvi_w "Differenz zwischen Ziel- und Istgeschwindigkeit" SWORD vfzg_sw_q0p00781 1 100 -256 255.992 FUNCTION_LIST FGRMD IF_DATA DIM_X 0x381F96 EXTERN WORD IF_DATA MCMESS 0x381F96 EXTERN /end MEASUREMENT
/begin MEASUREMENT dv_hl_w "Radgeschwindigkeitsdifferenz hinten links" SWORD vfzg_uw_b325 1 100 -162.5 162.495 FUNCTION_LIST BGRBS IF_DATA DIM_X 0x382B40 EXTERN WORD IF_DATA MCMESS 0x382B40 EXTERN /end MEASUREMENT
/begin MEASUREMENT dv_hr_w "Radgeschwindigkeitsdifferenz hinten rechts" SWORD vfzg_uw_b325 1 100 -162.5 162.495 FUNCTION_LIST BGRBS IF_DATA DIM_X 0x382B42 EXTERN WORD IF_DATA MCMESS 0x382B42 EXTERN /end MEASUREMENT
/begin MEASUREMENT dv_max_w "Maximale Radgeschwindigkeitsdifferenz" SWORD vfzg_uw_b325 1 100 -162.5 162.495 FUNCTION_LIST BGRBS IF_DATA DIM_X 0x382B44 EXTERN WORD IF_DATA MCMESS 0x382B44 EXTERN /end MEASUREMENT
/begin MEASUREMENT dv_vl_w "Radgeschwindigkeitsdifferenz vorne links" SWORD vfzg_uw_b325 1 100 -162.5 162.495 FUNCTION_LIST BGRBS IF_DATA DIM_X 0x382B46 EXTERN WORD IF_DATA MCMESS 0x382B46 EXTERN /end MEASUREMENT
/begin MEASUREMENT dv_vr_w "Radgeschwindigkeitsdifferenz vorne rechts" SWORD vfzg_uw_b325 1 100 -162.5 162.495 FUNCTION_LIST BGRBS IF_DATA DIM_X 0x382B48 EXTERN WORD IF_DATA MCMESS 0x382B48 EXTERN /end MEASUREMENT
/begin MEASUREMENT dwdkba_w "Gradient DK-Winkel" SWORD relDK_q0p02441 1 100 -800 799.976 FUNCTION_LIST GGDVE IF_DATA DIM_X 0x381EA2 EXTERN WORD IF_DATA MCMESS 0x381EA2 EXTERN /end MEASUREMENT
/begin MEASUREMENT dwdkdlr_w "Differenz-DK-Winkel Sollwert - Istwert (wdkdlr_w - wdkba_w)" SWORD relDK_q0p02441 1 100 -800 799.976 FUNCTION_LIST ADVE IF_DATA DIM_X 0xFA2E INTERN WORD IF_DATA MCMESS 0xFA2E INTERN /end MEASUREMENT
/begin MEASUREMENT dwdksumx_w "Delta Sollwinkel Drosselklappe Beginn ungedrosselt bis Maximum" UWORD rel_uw_b100 1 100 0 99.9985 FUNCTION_LIST FUEDK IF_DATA DIM_X 0x38212A EXTERN WORD IF_DATA MCMESS 0x38212A EXTERN /end MEASUREMENT
/begin MEASUREMENT dwdksut_w "Delta Sollwinkel Drosselklappe ab Beginn ungedrosselt bei Turbo motor" UWORD rel_uw_b100 1 100 0 99.9985 FUNCTION_LIST FUEDK IF_DATA DIM_X 0x382132 EXTERN WORD IF_DATA MCMESS 0x382132 EXTERN /end MEASUREMENT
/begin MEASUREMENT dwdks_w "Änderung des Drosselklappen-Sollwinkels" UWORD relDK_uw_b100 1 100 0 100 FUNCTION_LIST FUEDKSA IF_DATA DIM_X 0x38218C EXTERN WORD IF_DATA MCMESS 0x38218C EXTERN /end MEASUREMENT
/begin MEASUREMENT dwfk_w "Wandfilmmengendifferenz Kurzzeitanteil" SWORD rel_sw_q0p1875 1 100 -6144 6143.81 FUNCTION_LIST ESUK IF_DATA DIM_X 0x382290 EXTERN WORD IF_DATA MCMESS 0x382290 EXTERN /end MEASUREMENT
/begin MEASUREMENT dwfl_w "Wandfilmmengendifferenz Langzeitanteil" SWORD rel_sw_q0p1875 1 100 -6144 6143.81 FUNCTION_LIST ESUK IF_DATA DIM_X 0x382292 EXTERN WORD IF_DATA MCMESS 0x382292 EXTERN /end MEASUREMENT
/begin MEASUREMENT dwf_w "Wandfilmmengendifferenz" SWORD rel_sw_q0p1875 1 100 -6144 6143.81 FUNCTION_LIST ESUK IF_DATA DIM_X 0x382294 EXTERN WORD IF_DATA MCMESS 0x382294 EXTERN /end MEASUREMENT
/begin MEASUREMENT dwkr "zylinderindividuelle Zündwinkelspätverstellung KR" SBYTE zw_sb_q0p75 1 100 -96 95.25 FUNCTION_LIST KRRA IF_DATA DIM_X 0x380BD2 EXTERN WORD IF_DATA MCMESS 0x380BD2 EXTERN /end MEASUREMENT
/begin MEASUREMENT dwkrm "Differenz wkrm-wkrmstat" UBYTE zw_ub_q0p75 1 100 0 191.25 FUNCTION_LIST LDRLMX IF_DATA DIM_X 0x380BF2 EXTERN WORD IF_DATA MCMESS 0x380BF2 EXTERN /end MEASUREMENT
/begin MEASUREMENT dwkrmsw "aktueller Wert für Mittelwertbegrenzung der Spätverstellung" UBYTE zw_ub_qn0p75 1 100 -191.25 0 FUNCTION_LIST KRRA IF_DATA DIM_X 0x380BD3 EXTERN WORD IF_DATA MCMESS 0x380BD3 EXTERN /end MEASUREMENT
/begin MEASUREMENT dwkrz_0_A "zyl.ind. ZW-Spätverstellung inkl. Dyn.vorhalt" SBYTE zw_sb_q0p75 1 100 -96 95.25 FUNCTION_LIST KRRA T2LID ZUE IF_DATA DIM_X 0x380BD4 EXTERN WORD IF_DATA MCMESS 0x380BD4 EXTERN /end MEASUREMENT
/begin MEASUREMENT dwkrz_1_A "zyl.ind. ZW-Spätverstellung inkl. Dyn.vorhalt" SBYTE zw_sb_q0p75 1 100 -96 95.25 FUNCTION_LIST KRRA T2LID ZUE IF_DATA DIM_X 0x380BD5 EXTERN WORD IF_DATA MCMESS 0x380BD5 EXTERN /end MEASUREMENT
/begin MEASUREMENT dwkrz_2_A "zyl.ind. ZW-Spätverstellung inkl. Dyn.vorhalt" SBYTE zw_sb_q0p75 1 100 -96 95.25 FUNCTION_LIST KRRA T2LID ZUE IF_DATA DIM_X 0x380BD6 EXTERN WORD IF_DATA MCMESS 0x380BD6 EXTERN /end MEASUREMENT
/begin MEASUREMENT dwkrz_3_A "zyl.ind. ZW-Spätverstellung inkl. Dyn.vorhalt" SBYTE zw_sb_q0p75 1 100 -96 95.25 FUNCTION_LIST KRRA T2LID ZUE IF_DATA DIM_X 0x380BD7 EXTERN WORD IF_DATA MCMESS 0x380BD7 EXTERN /end MEASUREMENT
/begin MEASUREMENT dwkrz_4_A "zyl.ind. ZW-Spätverstellung inkl. Dyn.vorhalt" SBYTE zw_sb_q0p75 1 100 -96 95.25 FUNCTION_LIST KRRA T2LID ZUE IF_DATA DIM_X 0x380BD8 EXTERN WORD IF_DATA MCMESS 0x380BD8 EXTERN /end MEASUREMENT
/begin MEASUREMENT dwkrz_5_A "zyl.ind. ZW-Spätverstellung inkl. Dyn.vorhalt" SBYTE zw_sb_q0p75 1 100 -96 95.25 FUNCTION_LIST KRRA T2LID ZUE IF_DATA DIM_X 0x380BD9 EXTERN WORD IF_DATA MCMESS 0x380BD9 EXTERN /end MEASUREMENT
/begin MEASUREMENT dwkrz_6_A "zyl.ind. ZW-Spätverstellung inkl. Dyn.vorhalt" SBYTE zw_sb_q0p75 1 100 -96 95.25 FUNCTION_LIST KRRA T2LID ZUE IF_DATA DIM_X 0x380BDA EXTERN WORD IF_DATA MCMESS 0x380BDA EXTERN /end MEASUREMENT
/begin MEASUREMENT dwkrz_7_A "zyl.ind. ZW-Spätverstellung inkl. Dyn.vorhalt" SBYTE zw_sb_q0p75 1 100 -96 95.25 FUNCTION_LIST KRRA T2LID ZUE IF_DATA DIM_X 0x380BDB EXTERN WORD IF_DATA MCMESS 0x380BDB EXTERN /end MEASUREMENT
/begin MEASUREMENT dwnwsp2_u "Abweichung des Adaptionswinkels vom fahrzeugspez. Sollwinkel der Nockenwelle2" SBYTE kw_q4 1 100 -512 508 FUNCTION_LIST DFFTCNV DFFTK IF_DATA DIM_X 0x3809DA EXTERN WORD IF_DATA MCMESS 0x3809DA EXTERN /end MEASUREMENT
/begin MEASUREMENT dwnwsp2_w "Abweichung des Adaptionswinkels 2 vom fahrzeugspez. Sollwinkel der Nockenwelle" SWORD kw_q0p0156 1 100 -512 511.984 FUNCTION_LIST DNWKW DFFTCNV T2LID IF_DATA DIM_X 0x381B44 EXTERN WORD IF_DATA MCMESS 0x381B44 EXTERN /end MEASUREMENT
/begin MEASUREMENT dwnwsp_u "Abweichung des Adaptionswinkels vom fahrzeugspez. Sollwinkel der Nockenwelle" SBYTE kw_q4 1 100 -512 508 FUNCTION_LIST DFFTCNV DFFTK IF_DATA DIM_X 0x3809DB EXTERN WORD IF_DATA MCMESS 0x3809DB EXTERN /end MEASUREMENT
/begin MEASUREMENT dwnwsp_w "Abweichung des Adaptionswinkels vom fahrzeugspez. Sollwinkel der Nockenwelle" SWORD kw_q0p0156 1 100 -512 511.984 FUNCTION_LIST DNWKW DFFTCNV T2LID IF_DATA DIM_X 0x381B46 EXTERN WORD IF_DATA MCMESS 0x381B46 EXTERN /end MEASUREMENT
/begin MEASUREMENT dwped "Gradient des normierten Fahrpedalwinkels" SBYTE rel_sb_q0p39 1 100 -49.9968 49.6062 FUNCTION_LIST GGPED LDUVST IF_DATA DIM_X 0x380AC1 EXTERN WORD IF_DATA MCMESS 0x380AC1 EXTERN /end MEASUREMENT
/begin MEASUREMENT dwped_w "Gradient des normierten Fahrpedalwinkels" SWORD rel_sw_b50 1 100 -50 49.9985 FUNCTION_LIST GGPED MDFAW IF_DATA DIM_X 0x381EBA EXTERN WORD IF_DATA MCMESS 0x381EBA EXTERN /end MEASUREMENT
/begin MEASUREMENT dwvls "aktueller Deltazündwinkel nach spät bei Motorschutz Vollast" SBYTE zw_sb_q0p75 1 100 -96 95.25 FUNCTION_LIST ZWBTSK ZUE IF_DATA DIM_X 0x380D12 EXTERN WORD IF_DATA MCMESS 0x380D12 EXTERN /end MEASUREMENT
/begin MEASUREMENT dyesofv "aktueller Wert Offset für Lastdynamikerkennungsschwelle" SWORD rel_sw_q0p0234 1 100 -768 767.977 FUNCTION_LIST KRDY IF_DATA DIM_X 0x382468 EXTERN WORD IF_DATA MCMESS 0x382468 EXTERN /end MEASUREMENT
/begin MEASUREMENT dyesv "aktueller Wert Lastdynamikerkennungsschwelle" SWORD rel_sw_q0p0234 1 100 -768 767.977 FUNCTION_LIST KRDY IF_DATA DIM_X 0x38246A EXTERN WORD IF_DATA MCMESS 0x38246A EXTERN /end MEASUREMENT
/begin MEASUREMENT dyesvs "" SWORD rel_sw_q0p0234 1 100 -768 767.977 FUNCTION_LIST KRDY IF_DATA DIM_X 0x38246C EXTERN WORD IF_DATA MCMESS 0x38246C EXTERN /end MEASUREMENT
/begin MEASUREMENT dynlsu2_u "Dynamikwert der LSU Bank2 (Byte)" UBYTE fak_ub_b16 1 100 0 15.9375 FUNCTION_LIST DFFTCNV DFFTK IF_DATA DIM_X 0x3809E7 EXTERN WORD IF_DATA MCMESS 0x3809E7 EXTERN /end MEASUREMENT
/begin MEASUREMENT dynlsu2_w "Dynamikwert der LSU, Bank 2" UWORD fak_uw_b16 1 100 0 15.9998 FUNCTION_LIST DLSU DFFTCNV DLSSA T2LID IF_DATA DIM_X 0x38397E EXTERN WORD IF_DATA MCMESS 0x38397E EXTERN /end MEASUREMENT
/begin MEASUREMENT dynlsusa "Dynamikwert der LSU, DLSSA" UBYTE fak_q0p0195 1 100 0 4.98047 FUNCTION_LIST DLSSA TC5MOD IF_DATA DIM_X 0x380ADF EXTERN WORD IF_DATA MCMESS 0x380ADF EXTERN /end MEASUREMENT
/begin MEASUREMENT dynlsusa2 "Dynamikwert der LSU, DLSSA Bank 2" UBYTE fak_q0p0195 1 100 0 4.98047 FUNCTION_LIST DLSSA TC5MOD IF_DATA DIM_X 0x380AE0 EXTERN WORD IF_DATA MCMESS 0x380AE0 EXTERN /end MEASUREMENT
/begin MEASUREMENT dynlsu_u "Dynamikwert der LSU (Byte)" UBYTE fak_ub_b16 1 100 0 15.9375 FUNCTION_LIST DFFTCNV DFFTK IF_DATA DIM_X 0x3809E8 EXTERN WORD IF_DATA MCMESS 0x3809E8 EXTERN /end MEASUREMENT
/begin MEASUREMENT dynlsu_w "Dynamikwert der LSU" UWORD fak_uw_b16 1 100 0 15.9998 FUNCTION_LIST DLSU DFFTCNV DLSSA T2LID IF_DATA DIM_X 0x383980 EXTERN WORD IF_DATA MCMESS 0x383980 EXTERN /end MEASUREMENT
/begin MEASUREMENT dynPeriod "" SWORD dez 1 100 -32768 32767 FUNCTION_LIST V7804X_T ADVE IF_DATA DIM_X 0x380D30 EXTERN WORD IF_DATA MCMESS 0x380D30 EXTERN /end MEASUREMENT
/begin MEASUREMENT dzaCtr "Zähler DZA Betrieb, zählt Modusübergang aus" UBYTE dez 1 100 0 255 FUNCTION_LIST AZUE IF_DATA DIM_X 0xF8E2 INTERN WORD IF_DATA MCMESS 0xF8E2 INTERN /end MEASUREMENT
/begin MEASUREMENT dzwb "Differenz BasisZW optimaler Zündwinkel" SBYTE zw_sb_q0p75 1 100 -96 95.25 FUNCTION_LIST MDBAS IF_DATA DIM_X 0x380C2C EXTERN WORD IF_DATA MCMESS 0x380C2C EXTERN /end MEASUREMENT
/begin MEASUREMENT dzwg "Delta Zündwinkel Grund-ZW zu Optimal-ZW" SBYTE zw_sb_q0p75 1 100 -96 95.25 FUNCTION_LIST LAMBTS IF_DATA DIM_X 0x380B41 EXTERN WORD IF_DATA MCMESS 0x380B41 EXTERN /end MEASUREMENT
/begin MEASUREMENT dzwi "Delta Zündwinkel zwischen zwopt und zwout" SBYTE zw_sb_q0p75 1 100 -96 95.25 FUNCTION_LIST MDIST IF_DATA DIM_X 0x380C39 EXTERN WORD IF_DATA MCMESS 0x380C39 EXTERN /end MEASUREMENT
/begin MEASUREMENT dzwkg "Delta-Zündwinkel Verschiebung Klopfgrenze" SBYTE zw_sb_q0p75 1 100 -96 95.25 FUNCTION_LIST ZWGRU IF_DATA DIM_X 0x380D13 EXTERN WORD IF_DATA MCMESS 0x380D13 EXTERN /end MEASUREMENT
/begin MEASUREMENT dzwmna "Min-Zündwinkel Änderungsgeschwindigeit zw. Brenngrenze und Motorschutz" SBYTE zw_sb_q0p75 1 100 -96 95.25 FUNCTION_LIST ZWMIN IF_DATA DIM_X 0x380D15 EXTERN WORD IF_DATA MCMESS 0x380D15 EXTERN /end MEASUREMENT
/begin MEASUREMENT dzwoag "abgasrückführratenabh. Zündwinkelkorrektur des optimalen ZW" SBYTE zw_sb_q0p75 1 100 -96 95.25 FUNCTION_LIST MDBAS ZWGRU ZWMIN IF_DATA DIM_X 0x380C2D EXTERN WORD IF_DATA MCMESS 0x380C2D EXTERN /end MEASUREMENT
/begin MEASUREMENT dzwol "lambdaabh. Zündwinkelkorrektur des optimalen ZW" SBYTE zw_sb_q0p75 1 100 -96 95.25 FUNCTION_LIST MDBAS IF_DATA DIM_X 0x380C2E EXTERN WORD IF_DATA MCMESS 0x380C2E EXTERN /end MEASUREMENT
/begin MEASUREMENT dzwotm "temperaturabhängige Zündwinkelkorrektur des optimalen ZW" SBYTE zw_sb_q0p75 1 100 -96 95.25 FUNCTION_LIST MDBAS IF_DATA DIM_X 0x380C2F EXTERN WORD IF_DATA MCMESS 0x380C2F EXTERN /end MEASUREMENT
/begin MEASUREMENT dzws "Delta Zündwinekl zwischen zwopt und zwsol" SBYTE zw_sb_q0p75 1 100 -96 95.25 FUNCTION_LIST MDZW IF_DATA DIM_X 0x380D04 EXTERN WORD IF_DATA MCMESS 0x380D04 EXTERN /end MEASUREMENT
/begin MEASUREMENT dzwspae "Korrektur-Zündwinkel für den spätest erlaubten Zündwinkel" SBYTE zw_sb_q0p75 1 100 -96 95.25 FUNCTION_LIST ZWMIN IF_DATA DIM_X 0x380D16 EXTERN WORD IF_DATA MCMESS 0x380D16 EXTERN /end MEASUREMENT
/begin MEASUREMENT dzwvs "Zündwinkelrücknahme bei Ventilhubumschaltung" SBYTE zw_sb_q0p75 1 100 -96 95.25 FUNCTION_LIST ZWVS ZUE IF_DATA DIM_X 0x380D1D EXTERN WORD IF_DATA MCMESS 0x380D1D EXTERN /end MEASUREMENT
/begin MEASUREMENT dzwwl "Delta Zuendwinkel aus Warmlauf" SBYTE zw_sb_q0p75 1 100 -96 95.25 FUNCTION_LIST ZWWL ZUE IF_DATA DIM_X 0x380D1E EXTERN WORD IF_DATA MCMESS 0x380D1E EXTERN /end MEASUREMENT
/begin MEASUREMENT dzw_kge "Eingang Delta-Zündwinkel für mehrfach verwendete Kenngrößen" SBYTE zw_sb_q0p75 1 100 -96 95.25 FUNCTION_LIST MDBAS LAMBTS MDIST ZWMIN IF_DATA DIM_X 0x380C30 EXTERN WORD IF_DATA MCMESS 0x380C30 EXTERN /end MEASUREMENT
/begin MEASUREMENT dzw_uc "Delta Zündwinkel zwischen zwopt und zwout im Befehlstest" UBYTE zw_ub_q0p75 1 100 0 191.25 FUNCTION_LIST URCMIST IF_DATA DIM_X 0x380C66 EXTERN WORD IF_DATA MCMESS 0x380C66 EXTERN /end MEASUREMENT
/begin MEASUREMENT dzw_um "Delta Zündwinkel zwischen zwopt und zwout in der Funktionsüberwachung" UBYTE zw_ub_q0p75 1 100 0 191.25 FUNCTION_LIST UFMIST IF_DATA DIM_X 0x382E6E EXTERN WORD IF_DATA MCMESS 0x382E6E EXTERN /end MEASUREMENT
/begin MEASUREMENT edge_ctr "Index der Phasenflanke bei erkannter Schnellstartposition" SBYTE dez 1 100 -128 127 FUNCTION_LIST GGDPG IF_DATA DIM_X 0xF9D2 INTERN WORD IF_DATA MCMESS 0xF9D2 INTERN /end MEASUREMENT
/begin MEASUREMENT eevx "EV Fehlerbyte" UBYTE dez 1 100 0 255 FUNCTION_LIST AEVAB BGEVAB DIAVALVE IF_DATA DIM_X 0x380B0C EXTERN WORD IF_DATA MCMESS 0x380B0C EXTERN /end MEASUREMENT
/begin MEASUREMENT egaspfad "EGAS-Pfad als Umweltbedingung für Funktionsüberwachungs-Diagnoseeintrag" UBYTE dez 1 100 0 255 FUNCTION_LIST DUF DFFT DFPM IF_DATA DIM_X 0x380C7F EXTERN WORD IF_DATA MCMESS 0x380C7F EXTERN /end MEASUREMENT
/begin MEASUREMENT egs_obd "EGS OBD-Status" UBYTE dez 1 100 0 255 FUNCTION_LIST CAN DCG IF_DATA DIM_X 0x38095A EXTERN WORD IF_DATA MCMESS 0x38095A EXTERN /end MEASUREMENT
/begin MEASUREMENT ei_adcc_um "irreversibles Fehlerbit bei der AD-Wandler-Überwachung" UWORD B_TRUE 1 100 0 1 BIT_MASK 0x400 FUNCTION_LIST URADCC DUF IF_DATA DIM_X 0xFD78 INTERN BYTE IF_DATA MCMESS 0xFD78 INTERN /end MEASUREMENT
/begin MEASUREMENT ei_ipa_um "irrev. Fehlerbit für unterer DK-Anschlag im ungültigen Bereich in der Fkt-Überw." UWORD B_TRUE 1 100 0 1 BIT_MASK 0x1 FUNCTION_LIST UFRLC DUF IF_DATA DIM_X 0xFD78 INTERN BYTE IF_DATA MCMESS 0xFD78 INTERN /end MEASUREMENT
/begin MEASUREMENT ei_msrc_uc "irreversibles Fehlerbit bei der MSR-Überwachung im Befehlstest" UWORD B_TRUE 1 100 0 1 BIT_MASK 0x4000 FUNCTION_LIST URCMSRC URCAUS IF_DATA DIM_X 0xFD78 INTERN BYTE IF_DATA MCMESS 0xFD78 INTERN /end MEASUREMENT
/begin MEASUREMENT ei_msrc_um "irreversibles Fehlerbit bei der MSR-Überwachung der Funktionsüberwachung" UWORD B_TRUE 1 100 0 1 BIT_MASK 0x80 FUNCTION_LIST UFMSRC IF_DATA DIM_X 0xFD78 INTERN BYTE IF_DATA MCMESS 0xFD78 INTERN /end MEASUREMENT
/begin MEASUREMENT ei_mver_uc "Ebene 3 irreversibles Fehlerbit fuer URCMVER aus BT" UWORD B_TRUE 1 100 0 1 BIT_MASK 0x1 FUNCTION_LIST URCMVER URCAUS IF_DATA DIM_X 0xFD7A INTERN BYTE IF_DATA MCMESS 0xFD7A INTERN /end MEASUREMENT
/begin MEASUREMENT ei_mver_um "irreversibles Fehlerbit beim Momentenvergleich der Funktionsüberwachung" UWORD B_TRUE 1 100 0 1 BIT_MASK 0x100 FUNCTION_LIST UFMVER DUF IF_DATA DIM_X 0xFD78 INTERN BYTE IF_DATA MCMESS 0xFD78 INTERN /end MEASUREMENT
/begin MEASUREMENT ei_nc_um "irreversibles Fehlerbit beim Drehzahlvergleich der Funktionsüberwachung" UWORD B_TRUE 1 100 0 1 BIT_MASK 0x2000 FUNCTION_LIST UFNC DUF IF_DATA DIM_X 0xFD76 INTERN BYTE IF_DATA MCMESS 0xFD76 INTERN /end MEASUREMENT
/begin MEASUREMENT ei_reac_uc "Ebene 3 irreversibles Fehlerbit fuer UFREAC aus BT" UWORD B_TRUE 1 100 0 1 BIT_MASK 0x2 FUNCTION_LIST URCREAC URCAUS IF_DATA DIM_X 0xFD7A INTERN BYTE IF_DATA MCMESS 0xFD7A INTERN /end MEASUREMENT
/begin MEASUREMENT ei_reac_um "irreversibles Fehlerbit der Fehlerreaktionsüberwachung der Funktionsüberwachung" UWORD B_TRUE 1 100 0 1 BIT_MASK 0x200 FUNCTION_LIST UFREAC DUF IF_DATA DIM_X 0xFD78 INTERN BYTE IF_DATA MCMESS 0xFD78 INTERN /end MEASUREMENT
/begin MEASUREMENT ei_rlc_um "irreversibles Fehlerbit beim rl-Vergleich mit der Funktion in der Funktionsüberw" UWORD B_TRUE 1 100 0 1 BIT_MASK 0x2 FUNCTION_LIST UFRLC DUF IF_DATA DIM_X 0xFD78 INTERN BYTE IF_DATA MCMESS 0xFD78 INTERN /end MEASUREMENT
/begin MEASUREMENT ei_rlip_um "irreversibles Fehlerbit beim rl/rlip-Vergleich der Funktionsüberwachung" UWORD B_TRUE 1 100 0 1 BIT_MASK 0x4 FUNCTION_LIST UFRLC DUF IF_DATA DIM_X 0xFD78 INTERN BYTE IF_DATA MCMESS 0xFD78 INTERN /end MEASUREMENT
/begin MEASUREMENT ei_spsc_um "irreversibles Fehlerbit bei d. Sollwertplausibilisierung d. Funktionsüberwachung" UWORD B_TRUE 1 100 0 1 BIT_MASK 0x10 FUNCTION_LIST UFSPSC DUF IF_DATA DIM_X 0xFD78 INTERN BYTE IF_DATA MCMESS 0xFD78 INTERN /end MEASUREMENT
/begin MEASUREMENT ei_zwc_um "irreversibles Fehlerbit bei der Zündwinkelüberwachung der Funktionsüberwachung" UWORD B_TRUE 1 100 0 1 BIT_MASK 0x8000 FUNCTION_LIST UFZWC DUF IF_DATA DIM_X 0xFD76 INTERN BYTE IF_DATA MCMESS 0xFD76 INTERN /end MEASUREMENT
/begin MEASUREMENT errorCntTcsort "" UBYTE dez 1 100 0 255 FUNCTION_LIST TCSORT IF_DATA DIM_X 0x380A18 EXTERN WORD IF_DATA MCMESS 0x380A18 EXTERN /end MEASUREMENT
/begin MEASUREMENT ESKONF_0_A "" UBYTE dez 1 100 0 255 FUNCTION_LIST DEKON DEKON2 IF_DATA DIM_X 0x380AC4 EXTERN WORD IF_DATA MCMESS 0x380AC4 EXTERN /end MEASUREMENT
/begin MEASUREMENT ESKONF_1_A "" UBYTE dez 1 100 0 255 FUNCTION_LIST DEKON DEKON2 IF_DATA DIM_X 0x380AC5 EXTERN WORD IF_DATA MCMESS 0x380AC5 EXTERN /end MEASUREMENT
/begin MEASUREMENT ESKONF_2_A "" UBYTE dez 1 100 0 255 FUNCTION_LIST DEKON DEKON2 IF_DATA DIM_X 0x380AC6 EXTERN WORD IF_DATA MCMESS 0x380AC6 EXTERN /end MEASUREMENT
/begin MEASUREMENT ESKONF_3_A "" UBYTE dez 1 100 0 255 FUNCTION_LIST DEKON DEKON2 IF_DATA DIM_X 0x380AC7 EXTERN WORD IF_DATA MCMESS 0x380AC7 EXTERN /end MEASUREMENT
/begin MEASUREMENT ESKONF_4_A "" UBYTE dez 1 100 0 255 FUNCTION_LIST DEKON DEKON2 IF_DATA DIM_X 0x380AC8 EXTERN WORD IF_DATA MCMESS 0x380AC8 EXTERN /end MEASUREMENT
/begin MEASUREMENT ESKONF_5_A "" UBYTE dez 1 100 0 255 FUNCTION_LIST DEKON DEKON2 IF_DATA DIM_X 0x380AC9 EXTERN WORD IF_DATA MCMESS 0x380AC9 EXTERN /end MEASUREMENT
/begin MEASUREMENT ESKONF_6_A "" UBYTE dez 1 100 0 255 FUNCTION_LIST DEKON DEKON2 IF_DATA DIM_X 0x380ACA EXTERN WORD IF_DATA MCMESS 0x380ACA EXTERN /end MEASUREMENT
/begin MEASUREMENT ESKONF_7_A "" UBYTE dez 1 100 0 255 FUNCTION_LIST DEKON DEKON2 IF_DATA DIM_X 0x380ACB EXTERN WORD IF_DATA MCMESS 0x380ACB EXTERN /end MEASUREMENT
/begin MEASUREMENT ESKONF_8_A "" UBYTE dez 1 100 0 255 FUNCTION_LIST DEKON DEKON2 IF_DATA DIM_X 0x380ACC EXTERN WORD IF_DATA MCMESS 0x380ACC EXTERN /end MEASUREMENT
/begin MEASUREMENT ESKONF_9_A "" UBYTE dez 1 100 0 255 FUNCTION_LIST DEKON DEKON2 IF_DATA DIM_X 0x380ACD EXTERN WORD IF_DATA MCMESS 0x380ACD EXTERN /end MEASUREMENT
/begin MEASUREMENT ESKONF_10_A "" UBYTE dez 1 100 0 255 FUNCTION_LIST DEKON DEKON2 IF_DATA DIM_X 0x380ACE EXTERN WORD IF_DATA MCMESS 0x380ACE EXTERN /end MEASUREMENT
/begin MEASUREMENT ESKONF_11_A "" UBYTE dez 1 100 0 255 FUNCTION_LIST DEKON DEKON2 IF_DATA DIM_X 0x380ACF EXTERN WORD IF_DATA MCMESS 0x380ACF EXTERN /end MEASUREMENT
/begin MEASUREMENT ESSTTbits "Bits zur Funktion Start" UBYTE dez 1 100 0 255 FUNCTION_LIST ESSTT ESNST IF_DATA DIM_X 0x383002 EXTERN WORD IF_DATA MCMESS 0x383002 EXTERN /end MEASUREMENT
/begin MEASUREMENT esst_san12esuw "" UWORD dez 1 100 0 65535 FUNCTION_LIST SSTBER87 ESNST IF_DATA DIM_X 0xE40A INTERN WORD IF_DATA MCMESS 0xE40A INTERN /end MEASUREMENT
/begin MEASUREMENT esst_sbf02mfsb "" UWORD dez 1 100 0 65535 FUNCTION_LIST VMAXMD IF_DATA DIM_X 0x3826F6 EXTERN WORD IF_DATA MCMESS 0x3826F6 EXTERN /end MEASUREMENT
/begin MEASUREMENT esst_sdk10teub "" UWORD dez 1 100 0 65535 FUNCTION_LIST SSTBER87 TEB IF_DATA DIM_X 0xE40C INTERN WORD IF_DATA MCMESS 0xE40C INTERN /end MEASUREMENT
/begin MEASUREMENT esst_sdn06llsb "" UWORD dez 1 100 0 65535 FUNCTION_LIST LLRRM IF_DATA DIM_X 0x38253A EXTERN WORD IF_DATA MCMESS 0x38253A EXTERN /end MEASUREMENT
/begin MEASUREMENT esst_sdr02ldub "" UWORD dez 1 100 0 65535 FUNCTION_LIST SSTBER87 IF_DATA DIM_X 0x380DB8 EXTERN WORD IF_DATA MCMESS 0x380DB8 EXTERN /end MEASUREMENT
/begin MEASUREMENT esst_sdz03dmub "" UWORD dez 1 100 0 65535 FUNCTION_LIST DMDFON IF_DATA DIM_X 0x380FF6 EXTERN WORD IF_DATA MCMESS 0x380FF6 EXTERN /end MEASUREMENT
/begin MEASUREMENT esst_sdz08dmub "" UWORD dez 1 100 0 65535 FUNCTION_LIST DMDFON IF_DATA DIM_X 0x380FF8 EXTERN WORD IF_DATA MCMESS 0x380FF8 EXTERN /end MEASUREMENT
/begin MEASUREMENT esst_sez06tmub "" UWORD dez 1 100 0 65535 FUNCTION_LIST SSTBER87 ATM IF_DATA DIM_X 0x380DBA EXTERN WORD IF_DATA MCMESS 0x380DBA EXTERN /end MEASUREMENT
/begin MEASUREMENT esst_sfr05teub "" UWORD dez 1 100 0 65535 FUNCTION_LIST SSTBER87 TEB IF_DATA DIM_X 0xE40E INTERN WORD IF_DATA MCMESS 0xE40E INTERN /end MEASUREMENT
/begin MEASUREMENT esst_sga06mdub "" UWORD dez 1 100 0 65535 FUNCTION_LIST SSTBER87 ARMD IF_DATA DIM_X 0x380DAE EXTERN WORD IF_DATA MCMESS 0x380DAE EXTERN /end MEASUREMENT
/begin MEASUREMENT esst_sga08mdub "" UWORD dez 1 100 0 65535 FUNCTION_LIST SSTBER87 DMDSTP MDFAW NMAXMD IF_DATA DIM_X 0xE410 INTERN WORD IF_DATA MCMESS 0xE410 INTERN /end MEASUREMENT
/begin MEASUREMENT esst_sks06esub "" UWORD dez 1 100 0 65535 FUNCTION_LIST SSTBER87 ESNST IF_DATA DIM_X 0xE412 INTERN WORD IF_DATA MCMESS 0xE412 INTERN /end MEASUREMENT
/begin MEASUREMENT esst_sld04ldub "" UWORD dez 1 100 0 65535 FUNCTION_LIST SSTBER87 LDRPID IF_DATA DIM_X 0x380DBC EXTERN WORD IF_DATA MCMESS 0x380DBC EXTERN /end MEASUREMENT
/begin MEASUREMENT esst_slx06tmuw "" UWORD dez 1 100 0 65535 FUNCTION_LIST SSTBER87 ATM IF_DATA DIM_X 0x380DBE EXTERN WORD IF_DATA MCMESS 0x380DBE EXTERN /end MEASUREMENT
/begin MEASUREMENT esst_sly06tmuw "" UWORD dez 1 100 0 65535 FUNCTION_LIST SSTBER87 ATM IF_DATA DIM_X 0x380DC0 EXTERN WORD IF_DATA MCMESS 0x380DC0 EXTERN /end MEASUREMENT
/begin MEASUREMENT esst_sm108lhsw "" SWORD dez 1 100 -32768 32767 FUNCTION_LIST SSTBER87 LRSHK IF_DATA DIM_X 0x380DC2 EXTERN WORD IF_DATA MCMESS 0x380DC2 EXTERN /end MEASUREMENT
/begin MEASUREMENT esst_sm208lhsw "" SWORD dez 1 100 -32768 32767 FUNCTION_LIST SSTBER87 LRSHK IF_DATA DIM_X 0x380DC4 EXTERN WORD IF_DATA MCMESS 0x380DC4 EXTERN /end MEASUREMENT
/begin MEASUREMENT esst_smi08llub "" UWORD dez 1 100 0 65535 FUNCTION_LIST SSTBER87 LLRMR IF_DATA DIM_X 0x380DC6 EXTERN WORD IF_DATA MCMESS 0x380DC6 EXTERN /end MEASUREMENT
/begin MEASUREMENT esst_smk08mdsw "" UWORD dez 1 100 0 65535 FUNCTION_LIST ARMD IF_DATA DIM_X 0x3825BC EXTERN WORD IF_DATA MCMESS 0x3825BC EXTERN /end MEASUREMENT
/begin MEASUREMENT esst_smk106mdsw "" UWORD dez 1 100 0 65535 FUNCTION_LIST SSTBER87 MDFAW IF_DATA DIM_X 0x380DC8 EXTERN WORD IF_DATA MCMESS 0x380DC8 EXTERN /end MEASUREMENT
/begin MEASUREMENT esst_smk206mdsw "" UWORD dez 1 100 0 65535 FUNCTION_LIST SSTBER87 MDFAW IF_DATA DIM_X 0x380DCA EXTERN WORD IF_DATA MCMESS 0x380DCA EXTERN /end MEASUREMENT
/begin MEASUREMENT esst_sml04duub "" UWORD dez 1 100 0 65535 FUNCTION_LIST SSTBER87 IF_DATA DIM_X 0x380DB0 EXTERN WORD IF_DATA MCMESS 0x380DB0 EXTERN /end MEASUREMENT
/begin MEASUREMENT esst_sml05dkub "" UWORD dez 1 100 0 65535 FUNCTION_LIST SSTBER87 DKATLRS T2DFA T2LID IF_DATA DIM_X 0x380DCC EXTERN WORD IF_DATA MCMESS 0x380DCC EXTERN /end MEASUREMENT
/begin MEASUREMENT esst_sml06teub "" UWORD dez 1 100 0 65535 FUNCTION_LIST SSTBER87 TEB IF_DATA DIM_X 0xE414 INTERN WORD IF_DATA MCMESS 0xE414 INTERN /end MEASUREMENT
/begin MEASUREMENT esst_sml06tmub "" UWORD dez 1 100 0 65535 FUNCTION_LIST SSTBER87 ATM IF_DATA DIM_X 0x380DCE EXTERN WORD IF_DATA MCMESS 0x380DCE EXTERN /end MEASUREMENT
/begin MEASUREMENT esst_sml07tmuw "" UWORD dez 1 100 0 65535 FUNCTION_LIST SSTBER87 ATM IF_DATA DIM_X 0x380DD0 EXTERN WORD IF_DATA MCMESS 0x380DD0 EXTERN /end MEASUREMENT
/begin MEASUREMENT esst_sml08lhub "" UWORD dez 1 100 0 65535 FUNCTION_LIST SSTBER87 LRSHK IF_DATA DIM_X 0xE416 INTERN WORD IF_DATA MCMESS 0xE416 INTERN /end MEASUREMENT
/begin MEASUREMENT esst_smo08opub "" UWORD dez 1 100 0 65535 FUNCTION_LIST MDZUL IF_DATA DIM_X 0x3826C0 EXTERN WORD IF_DATA MCMESS 0x3826C0 EXTERN /end MEASUREMENT
/begin MEASUREMENT esst_sng06llsb "" UWORD dez 1 100 0 65535 FUNCTION_LIST SSTBER87 LLRRM IF_DATA DIM_X 0xE418 INTERN WORD IF_DATA MCMESS 0xE418 INTERN /end MEASUREMENT
/begin MEASUREMENT esst_snm05dkub "" UWORD dez 1 100 0 65535 FUNCTION_LIST SSTBER87 DKATLRS IF_DATA DIM_X 0xE41A INTERN WORD IF_DATA MCMESS 0xE41A INTERN /end MEASUREMENT
/begin MEASUREMENT esst_snm06llub "" UWORD dez 1 100 0 65535 FUNCTION_LIST SSTBER87 LLRRM IF_DATA DIM_X 0xE41C INTERN WORD IF_DATA MCMESS 0xE41C INTERN /end MEASUREMENT
/begin MEASUREMENT esst_snm06lsub "" UWORD dez 1 100 0 65535 FUNCTION_LIST SSTBER87 IF_DATA DIM_X 0x380DD2 EXTERN WORD IF_DATA MCMESS 0x380DD2 EXTERN /end MEASUREMENT
/begin MEASUREMENT esst_snm06mdub "" UWORD dez 1 100 0 65535 FUNCTION_LIST MDVERB IF_DATA DIM_X 0x382572 EXTERN WORD IF_DATA MCMESS 0x382572 EXTERN /end MEASUREMENT
/begin MEASUREMENT esst_snm06mduw "" UWORD dez 1 100 0 65535 FUNCTION_LIST SSTBER87 MDFAW IF_DATA DIM_X 0xE41E INTERN WORD IF_DATA MCMESS 0xE41E INTERN /end MEASUREMENT
/begin MEASUREMENT esst_snm07lsuw "" UWORD dez 1 100 0 65535 FUNCTION_LIST SSTBER87 LRS IF_DATA DIM_X 0x380DD4 EXTERN WORD IF_DATA MCMESS 0x380DD4 EXTERN /end MEASUREMENT
/begin MEASUREMENT esst_snm08d2ub "" UWORD dez 1 100 0 65535 FUNCTION_LIST SSTBER87 DMDDVS IF_DATA DIM_X 0xE420 INTERN WORD IF_DATA MCMESS 0xE420 INTERN /end MEASUREMENT
/begin MEASUREMENT esst_snm08dmub "" UWORD dez 1 100 0 65535 FUNCTION_LIST SSTBER87 DMDDLU DMDDVS DMDLU DMDLUA DMDMIL DMDSTP IF_DATA DIM_X 0xE422 INTERN WORD IF_DATA MCMESS 0xE422 INTERN /end MEASUREMENT
/begin MEASUREMENT esst_snm08feub "" UWORD dez 1 100 0 65535 FUNCTION_LIST SSTBER87 FUEREG IF_DATA DIM_X 0xE424 INTERN WORD IF_DATA MCMESS 0xE424 INTERN /end MEASUREMENT
/begin MEASUREMENT esst_snm08gkub "" UWORD dez 1 100 0 65535 FUNCTION_LIST ESVW IF_DATA DIM_X 0x3822FA EXTERN WORD IF_DATA MCMESS 0x3822FA EXTERN /end MEASUREMENT
/begin MEASUREMENT esst_snm08koub "" UWORD rel_ub_b99p6 1 100 0 25599.6 FUNCTION_LIST KOS IF_DATA DIM_X 0x382D24 EXTERN WORD IF_DATA MCMESS 0x382D24 EXTERN /end MEASUREMENT
/begin MEASUREMENT esst_snm08kruw "" UWORD dez 1 100 0 65535 FUNCTION_LIST SSTBER87 KRDY IF_DATA DIM_X 0xE426 INTERN WORD IF_DATA MCMESS 0xE426 INTERN /end MEASUREMENT
/begin MEASUREMENT esst_snm08ldub "" UWORD dez 1 100 0 65535 FUNCTION_LIST SSTBER87 LDOB LDRLMX LDRPID IF_DATA DIM_X 0x380DD6 EXTERN WORD IF_DATA MCMESS 0x380DD6 EXTERN /end MEASUREMENT
/begin MEASUREMENT esst_snm08lduw "" UWORD dez 1 100 0 65535 FUNCTION_LIST SSTBER87 LDRLMX LDRPID IF_DATA DIM_X 0x380DD8 EXTERN WORD IF_DATA MCMESS 0x380DD8 EXTERN /end MEASUREMENT
/begin MEASUREMENT esst_snm08lhub "" UWORD dez 1 100 0 65535 FUNCTION_LIST SSTBER87 LRSHK IF_DATA DIM_X 0xE428 INTERN WORD IF_DATA MCMESS 0xE428 INTERN /end MEASUREMENT
/begin MEASUREMENT esst_snm08opub "" UWORD dez 1 100 0 65535 FUNCTION_LIST SSTBER87 MDZUL IF_DATA DIM_X 0x380DDA EXTERN WORD IF_DATA MCMESS 0x380DDA EXTERN /end MEASUREMENT
/begin MEASUREMENT esst_snm08__ub "" UWORD dez 1 100 0 65535 FUNCTION_LIST SSTBER87 BBSAWE ZUE IF_DATA DIM_X 0xE42A INTERN WORD IF_DATA MCMESS 0xE42A INTERN /end MEASUREMENT
/begin MEASUREMENT esst_snm10llub "" UWORD dez 1 100 0 65535 FUNCTION_LIST SSTBER87 LLRMR IF_DATA DIM_X 0xE42C INTERN WORD IF_DATA MCMESS 0xE42C INTERN /end MEASUREMENT
/begin MEASUREMENT esst_snm10lsub "" UWORD dez 1 100 0 65535 FUNCTION_LIST SSTBER87 LRS IF_DATA DIM_X 0x380DDC EXTERN WORD IF_DATA MCMESS 0x380DDC EXTERN /end MEASUREMENT
/begin MEASUREMENT esst_snm10teub "" UWORD dez 1 100 0 65535 FUNCTION_LIST SSTBER87 TEB IF_DATA DIM_X 0xE42E INTERN WORD IF_DATA MCMESS 0xE42E INTERN /end MEASUREMENT
/begin MEASUREMENT esst_snm12esub "" UWORD dez 1 100 0 65535 FUNCTION_LIST SSTBER87 IF_DATA DIM_X 0xE430 INTERN WORD IF_DATA MCMESS 0xE430 INTERN /end MEASUREMENT
/begin MEASUREMENT esst_snm12esub2 "" UWORD dez 1 100 0 65535 FUNCTION_LIST SSTBER87 ESUK ESWL IF_DATA DIM_X 0xE432 INTERN WORD IF_DATA MCMESS 0xE432 INTERN /end MEASUREMENT
/begin MEASUREMENT esst_snm12feub "" UWORD dez 1 100 0 65535 FUNCTION_LIST SSTBER87 BGMSZS FUEDK MDFUE IF_DATA DIM_X 0xE434 INTERN WORD IF_DATA MCMESS 0xE434 INTERN /end MEASUREMENT
/begin MEASUREMENT esst_snm12lduw "" UWORD dez 1 100 0 65535 FUNCTION_LIST SSTBER87 LDRPLS IF_DATA DIM_X 0x380DDE EXTERN WORD IF_DATA MCMESS 0x380DDE EXTERN /end MEASUREMENT
/begin MEASUREMENT esst_snm16ciub "" UWORD dez 1 100 0 65535 FUNCTION_LIST SSTBER87 ACIFI IF_DATA DIM_X 0x380DE0 EXTERN WORD IF_DATA MCMESS 0x380DE0 EXTERN /end MEASUREMENT
/begin MEASUREMENT esst_snm16gkub "" UWORD dez 1 100 0 65535 FUNCTION_LIST SSTBER87 LAMBTS IF_DATA DIM_X 0x380DB2 EXTERN WORD IF_DATA MCMESS 0x380DB2 EXTERN /end MEASUREMENT
/begin MEASUREMENT esst_snm16krub "" UWORD dez 1 100 0 65535 FUNCTION_LIST SSTBER87 DKRS GGKS KRDY KRKE KRRA IF_DATA DIM_X 0xE436 INTERN WORD IF_DATA MCMESS 0xE436 INTERN /end MEASUREMENT
/begin MEASUREMENT esst_snm16ldub "" UWORD dez 1 100 0 65535 FUNCTION_LIST SSTBER87 LDRPID IF_DATA DIM_X 0x380DE2 EXTERN WORD IF_DATA MCMESS 0x380DE2 EXTERN /end MEASUREMENT
/begin MEASUREMENT esst_snm16lduw "" UWORD dez 1 100 0 65535 FUNCTION_LIST SSTBER87 LDRPID IF_DATA DIM_X 0x380DE4 EXTERN WORD IF_DATA MCMESS 0x380DE4 EXTERN /end MEASUREMENT
/begin MEASUREMENT esst_snm16opuw "" UWORD dez 1 100 0 65535 FUNCTION_LIST SSTBER87 MDBAS MDMAX IF_DATA DIM_X 0xE438 INTERN WORD IF_DATA MCMESS 0xE438 INTERN /end MEASUREMENT
/begin MEASUREMENT esst_snm16zuub "" UWORD dez 1 100 0 65535 FUNCTION_LIST SSTBER87 ZWMIN IF_DATA DIM_X 0xE43A INTERN WORD IF_DATA MCMESS 0xE43A INTERN /end MEASUREMENT
/begin MEASUREMENT esst_snm24zuub "" UWORD dez 1 100 0 65535 FUNCTION_LIST SSTBER87 ZWGRU IF_DATA DIM_X 0xE43C INTERN WORD IF_DATA MCMESS 0xE43C INTERN /end MEASUREMENT
/begin MEASUREMENT esst_sns06llsb "" UWORD dez 1 100 0 65535 FUNCTION_LIST LLRNS LLRRM IF_DATA DIM_X 0x38251E EXTERN WORD IF_DATA MCMESS 0x38251E EXTERN /end MEASUREMENT
/begin MEASUREMENT esst_sns206llsb "" UWORD dez 1 100 0 65535 FUNCTION_LIST LLRRM IF_DATA DIM_X 0x38253C EXTERN WORD IF_DATA MCMESS 0x38253C EXTERN /end MEASUREMENT
/begin MEASUREMENT esst_spl08ldub "" UWORD dez 1 100 0 65535 FUNCTION_LIST SSTBER87 IF_DATA DIM_X 0x380DE6 EXTERN WORD IF_DATA MCMESS 0x380DE6 EXTERN /end MEASUREMENT
/begin MEASUREMENT esst_spl08lduw "" UWORD dez 1 100 0 65535 FUNCTION_LIST SSTBER87 LDRPID IF_DATA DIM_X 0x380DE8 EXTERN WORD IF_DATA MCMESS 0x380DE8 EXTERN /end MEASUREMENT
/begin MEASUREMENT esst_spu08ldub "" UWORD dez 1 100 0 65535 FUNCTION_LIST SSTBER87 LDRPID IF_DATA DIM_X 0x380DEA EXTERN WORD IF_DATA MCMESS 0x380DEA EXTERN /end MEASUREMENT
/begin MEASUREMENT esst_sqm05teub "" UWORD dez 1 100 0 65535 FUNCTION_LIST SSTBER87 TEB IF_DATA DIM_X 0x380DEC EXTERN WORD IF_DATA MCMESS 0x380DEC EXTERN /end MEASUREMENT
/begin MEASUREMENT esst_srl03mfuw "" UWORD dez 1 100 0 65535 FUNCTION_LIST VMAXMD IF_DATA DIM_X 0x3826F8 EXTERN WORD IF_DATA MCMESS 0x3826F8 EXTERN /end MEASUREMENT
/begin MEASUREMENT esst_srl03zuub "" UWORD dez 1 100 0 65535 FUNCTION_LIST SSTBER87 ZWGRU IF_DATA DIM_X 0x380DEE EXTERN WORD IF_DATA MCMESS 0x380DEE EXTERN /end MEASUREMENT
/begin MEASUREMENT esst_srl04krub "" UWORD dez 1 100 0 65535 FUNCTION_LIST SSTBER87 GGKS IF_DATA DIM_X 0xE43E INTERN WORD IF_DATA MCMESS 0xE43E INTERN /end MEASUREMENT
/begin MEASUREMENT esst_srl06lsub "" UWORD dez 1 100 0 65535 FUNCTION_LIST SSTBER87 IF_DATA DIM_X 0x380DF0 EXTERN WORD IF_DATA MCMESS 0x380DF0 EXTERN /end MEASUREMENT
/begin MEASUREMENT esst_srl08d2ub "" UWORD dez 1 100 0 65535 FUNCTION_LIST SSTBER87 DMDDVS IF_DATA DIM_X 0xE440 INTERN WORD IF_DATA MCMESS 0xE440 INTERN /end MEASUREMENT
/begin MEASUREMENT esst_srl08dmub "" UWORD dez 1 100 0 65535 FUNCTION_LIST SSTBER87 DMDDLU DMDLU DMDLUA DMDSTP IF_DATA DIM_X 0xE442 INTERN WORD IF_DATA MCMESS 0xE442 INTERN /end MEASUREMENT
/begin MEASUREMENT esst_srl08gkub "" UWORD dez 1 100 0 65535 FUNCTION_LIST ESVW IF_DATA DIM_X 0x3822FC EXTERN WORD IF_DATA MCMESS 0x3822FC EXTERN /end MEASUREMENT
/begin MEASUREMENT esst_srl08ldub "" UWORD dez 1 100 0 65535 FUNCTION_LIST SSTBER87 IF_DATA DIM_X 0x380DF2 EXTERN WORD IF_DATA MCMESS 0x380DF2 EXTERN /end MEASUREMENT
/begin MEASUREMENT esst_srl08lsuw "" UWORD dez 1 100 0 65535 FUNCTION_LIST SSTBER87 LRS IF_DATA DIM_X 0x380DF4 EXTERN WORD IF_DATA MCMESS 0x380DF4 EXTERN /end MEASUREMENT
/begin MEASUREMENT esst_srl08mfub "" UWORD dez 1 100 0 65535 FUNCTION_LIST SSTBER87 IF_DATA DIM_X 0x380DF6 EXTERN WORD IF_DATA MCMESS 0x380DF6 EXTERN /end MEASUREMENT
/begin MEASUREMENT esst_srl08nxub "" UWORD dez 1 100 0 65535 FUNCTION_LIST SSTBER87 NMAXMD IF_DATA DIM_X 0x380DF8 EXTERN WORD IF_DATA MCMESS 0x380DF8 EXTERN /end MEASUREMENT
/begin MEASUREMENT esst_srl10lsub "" UWORD dez 1 100 0 65535 FUNCTION_LIST SSTBER87 LRS IF_DATA DIM_X 0x380DFA EXTERN WORD IF_DATA MCMESS 0x380DFA EXTERN /end MEASUREMENT
/begin MEASUREMENT esst_srl11opuw "" UWORD dez 1 100 0 65535 FUNCTION_LIST MDBAS MDMAX IF_DATA DIM_X 0x38261E EXTERN WORD IF_DATA MCMESS 0x38261E EXTERN /end MEASUREMENT
/begin MEASUREMENT esst_srl12esub "" UWORD dez 1 100 0 65535 FUNCTION_LIST SSTBER87 ESWL IF_DATA DIM_X 0xE444 INTERN WORD IF_DATA MCMESS 0xE444 INTERN /end MEASUREMENT
/begin MEASUREMENT esst_srl12gkub "" UWORD dez 1 100 0 65535 FUNCTION_LIST SSTBER87 LAMBTS IF_DATA DIM_X 0x380DB4 EXTERN WORD IF_DATA MCMESS 0x380DB4 EXTERN /end MEASUREMENT
/begin MEASUREMENT esst_srl12zuub "" UWORD dez 1 100 0 65535 FUNCTION_LIST SSTBER87 ZWMIN IF_DATA DIM_X 0xE446 INTERN WORD IF_DATA MCMESS 0xE446 INTERN /end MEASUREMENT
/begin MEASUREMENT esst_srl16zuub "" UWORD dez 1 100 0 65535 FUNCTION_LIST SSTBER87 ZWGRU IF_DATA DIM_X 0xE448 INTERN WORD IF_DATA MCMESS 0xE448 INTERN /end MEASUREMENT
/begin MEASUREMENT esst_st107tmub "" UWORD dez 1 100 0 65535 FUNCTION_LIST SSTBER87 ATM IF_DATA DIM_X 0x380DFC EXTERN WORD IF_DATA MCMESS 0x380DFC EXTERN /end MEASUREMENT
/begin MEASUREMENT esst_st207tmub "" UWORD dez 1 100 0 65535 FUNCTION_LIST SSTBER87 ATM IF_DATA DIM_X 0x380DFE EXTERN WORD IF_DATA MCMESS 0x380DFE EXTERN /end MEASUREMENT
/begin MEASUREMENT esst_st307tmub "" UWORD dez 1 100 0 65535 FUNCTION_LIST SSTBER87 ATM IF_DATA DIM_X 0x380E00 EXTERN WORD IF_DATA MCMESS 0x380E00 EXTERN /end MEASUREMENT
/begin MEASUREMENT esst_st407tmub "" UWORD dez 1 100 0 65535 FUNCTION_LIST SSTBER87 ATM IF_DATA DIM_X 0x380E02 EXTERN WORD IF_DATA MCMESS 0x380E02 EXTERN /end MEASUREMENT
/begin MEASUREMENT esst_sta06esub "" UWORD dez 1 100 0 65535 FUNCTION_LIST SSTBER87 ESNST IF_DATA DIM_X 0x380DB6 EXTERN WORD IF_DATA MCMESS 0x380DB6 EXTERN /end MEASUREMENT
/begin MEASUREMENT esst_sta08ldub "" UWORD dez 1 100 0 65535 FUNCTION_LIST SSTBER87 LDRLMX LDRPID IF_DATA DIM_X 0x380E04 EXTERN WORD IF_DATA MCMESS 0x380E04 EXTERN /end MEASUREMENT
/begin MEASUREMENT esst_stm04feub "" UWORD dez 1 100 0 65535 FUNCTION_LIST SSTBER87 MDFUE IF_DATA DIM_X 0x380E06 EXTERN WORD IF_DATA MCMESS 0x380E06 EXTERN /end MEASUREMENT
/begin MEASUREMENT esst_stm04ldub "" UWORD dez 1 100 0 65535 FUNCTION_LIST SSTBER87 IF_DATA DIM_X 0x380E08 EXTERN WORD IF_DATA MCMESS 0x380E08 EXTERN /end MEASUREMENT
/begin MEASUREMENT esst_stm04__ub "" UWORD dez 1 100 0 65535 FUNCTION_LIST SSTBER87 BBKHZ IF_DATA DIM_X 0xE44A INTERN WORD IF_DATA MCMESS 0xE44A INTERN /end MEASUREMENT
/begin MEASUREMENT esst_stm05saub "" UWORD dez 1 100 0 65535 FUNCTION_LIST SSTBER87 BBSAWE IF_DATA DIM_X 0x380E0A EXTERN WORD IF_DATA MCMESS 0x380E0A EXTERN /end MEASUREMENT
/begin MEASUREMENT esst_stm05tmub "" UWORD dez 1 100 0 65535 FUNCTION_LIST SSTBER87 ATM IF_DATA DIM_X 0xE44C INTERN WORD IF_DATA MCMESS 0xE44C INTERN /end MEASUREMENT
/begin MEASUREMENT esst_stm06llub "" UWORD dez 1 100 0 65535 FUNCTION_LIST SSTBER87 DMDMIL LLRNS LLRRM IF_DATA DIM_X 0x380E0C EXTERN WORD IF_DATA MCMESS 0x380E0C EXTERN /end MEASUREMENT
/begin MEASUREMENT esst_stm06__ub "" UWORD dez 1 100 0 65535 FUNCTION_LIST SSTBER87 MDVER ZWMIN IF_DATA DIM_X 0x380E0E EXTERN WORD IF_DATA MCMESS 0x380E0E EXTERN /end MEASUREMENT
/begin MEASUREMENT esst_stm08dmub "" UWORD dez 1 100 0 65535 FUNCTION_LIST SSTBER87 DMDLU IF_DATA DIM_X 0xE44E INTERN WORD IF_DATA MCMESS 0xE44E INTERN /end MEASUREMENT
/begin MEASUREMENT esst_stm09esub "" UWORD dez 1 100 0 65535 FUNCTION_LIST SSTBER87 ESUK IF_DATA DIM_X 0xE450 INTERN WORD IF_DATA MCMESS 0xE450 INTERN /end MEASUREMENT
/begin MEASUREMENT esst_stm12esub "" UWORD dez 1 100 0 65535 FUNCTION_LIST SSTBER87 ESWL LAMKO IF_DATA DIM_X 0x380E10 EXTERN WORD IF_DATA MCMESS 0x380E10 EXTERN /end MEASUREMENT
/begin MEASUREMENT esst_stn12esub "" UWORD dez 1 100 0 65535 FUNCTION_LIST SSTBER87 IF_DATA DIM_X 0x380E12 EXTERN WORD IF_DATA MCMESS 0x380E12 EXTERN /end MEASUREMENT
/begin MEASUREMENT esst_sts06tmuw "" UWORD dez 1 100 0 65535 FUNCTION_LIST ATM IF_DATA DIM_X 0x381BC0 EXTERN WORD IF_DATA MCMESS 0x381BC0 EXTERN /end MEASUREMENT
/begin MEASUREMENT esst_sts12esub "" UWORD dez 1 100 0 65535 FUNCTION_LIST SSTBER87 ESNST ESWL IF_DATA DIM_X 0x380E14 EXTERN WORD IF_DATA MCMESS 0x380E14 EXTERN /end MEASUREMENT
/begin MEASUREMENT esst_stv10ldsw "" UWORD dez 1 100 0 65535 FUNCTION_LIST LDRPID IF_DATA DIM_X 0x3824C8 EXTERN WORD IF_DATA MCMESS 0x3824C8 EXTERN /end MEASUREMENT
/begin MEASUREMENT esst_stw06mdub "" UWORD dez 1 100 0 65535 FUNCTION_LIST MDWAN IF_DATA DIM_X 0x38258C EXTERN WORD IF_DATA MCMESS 0x38258C EXTERN /end MEASUREMENT
/begin MEASUREMENT esst_svp12lduw "" UWORD dez 1 100 0 65535 FUNCTION_LIST SSTBER87 LDRPLS IF_DATA DIM_X 0x380E16 EXTERN WORD IF_DATA MCMESS 0x380E16 EXTERN /end MEASUREMENT
/begin MEASUREMENT esst_swd06krsw "" UWORD dez 1 100 0 65535 FUNCTION_LIST SSTBER87 KRDY IF_DATA DIM_X 0xE452 INTERN WORD IF_DATA MCMESS 0xE452 INTERN /end MEASUREMENT
/begin MEASUREMENT esst_swk08ldub "" UWORD dez 1 100 0 65535 FUNCTION_LIST SSTBER87 LDRLMX IF_DATA DIM_X 0x380E18 EXTERN WORD IF_DATA MCMESS 0x380E18 EXTERN /end MEASUREMENT
/begin MEASUREMENT esst_swk108ldub "" UWORD dez 1 100 0 65535 FUNCTION_LIST SSTBER87 LDRLMX IF_DATA DIM_X 0x380E1A EXTERN WORD IF_DATA MCMESS 0x380E1A EXTERN /end MEASUREMENT
/begin MEASUREMENT esst_swk208ldub "" UWORD dez 1 100 0 65535 FUNCTION_LIST SSTBER87 LDRLMX IF_DATA DIM_X 0x380E1C EXTERN WORD IF_DATA MCMESS 0x380E1C EXTERN /end MEASUREMENT
/begin MEASUREMENT esst_swp08ldub "" UWORD dez 1 100 0 65535 FUNCTION_LIST SSTBER87 IF_DATA DIM_X 0x380E1E EXTERN WORD IF_DATA MCMESS 0x380E1E EXTERN /end MEASUREMENT
/begin MEASUREMENT esst_swp08opub "" UWORD dez 1 100 0 65535 FUNCTION_LIST SSTBER87 MDZUL IF_DATA DIM_X 0x380E20 EXTERN WORD IF_DATA MCMESS 0x380E20 EXTERN /end MEASUREMENT
/begin MEASUREMENT esst_szk04ldub "" UWORD dez 1 100 0 65535 FUNCTION_LIST SSTBER87 IF_DATA DIM_X 0x380E22 EXTERN WORD IF_DATA MCMESS 0x380E22 EXTERN /end MEASUREMENT
/begin MEASUREMENT esst_szk08ldub "" UWORD dez 1 100 0 65535 FUNCTION_LIST SSTBER87 IF_DATA DIM_X 0x380E24 EXTERN WORD IF_DATA MCMESS 0x380E24 EXTERN /end MEASUREMENT
/begin MEASUREMENT etalab "Lambda-Wirkungsgrad ohne Eingriff bezogen auf optimales Moment bei Lambda=1" UBYTE rel_ub_b127p5 1 100 0 127.5 FUNCTION_LIST MDBAS MDFUE IF_DATA DIM_X 0x380C31 EXTERN WORD IF_DATA MCMESS 0x380C31 EXTERN /end MEASUREMENT
/begin MEASUREMENT etate "Motorwirkungsgrad bei Tankentlüftung mit hoher Beladung" UBYTE rel_ub_b127p5 1 100 0 127.5 FUNCTION_LIST TEB IF_DATA DIM_X 0x380CB1 EXTERN WORD IF_DATA MCMESS 0x380CB1 EXTERN /end MEASUREMENT
/begin MEASUREMENT etateint "Integrator Motrwirkungsgrad bei Tankentlüftung" UBYTE rel_ub_b127p5 1 100 0 127.5 FUNCTION_LIST TEB IF_DATA DIM_X 0x380CB2 EXTERN WORD IF_DATA MCMESS 0x380CB2 EXTERN /end MEASUREMENT
/begin MEASUREMENT etatesol "beladungsabhängiger Soll-Motorwirkungsgrad bei Betrieb mit Tankentlüftung" UBYTE rel_ub_b127p5 1 100 0 127.5 FUNCTION_LIST TEB IF_DATA DIM_X 0x380CB3 EXTERN WORD IF_DATA MCMESS 0x380CB3 EXTERN /end MEASUREMENT
/begin MEASUREMENT etatrmn "minimaler Wert in der Wirkungsgradtrommel" UBYTE rel_ub_b127p5 1 100 0 127.5 FUNCTION_LIST MDBAS IF_DATA DIM_X 0x380C32 EXTERN WORD IF_DATA MCMESS 0x380C32 EXTERN /end MEASUREMENT
/begin MEASUREMENT etazaist "Ist-Zylinderausblendungswirkungsgrad" UBYTE rel_ub_b127p5 1 100 0 127.5 FUNCTION_LIST MDIST MDZW IF_DATA DIM_X 0x380C3A EXTERN WORD IF_DATA MCMESS 0x380C3A EXTERN /end MEASUREMENT
/begin MEASUREMENT etazwb "Zündwinkelwirkungsgrad des Basiszündwinkels" UBYTE rel_ub_b127p5 1 100 0 127.5 FUNCTION_LIST MDBAS MDKOG IF_DATA DIM_X 0x380C33 EXTERN WORD IF_DATA MCMESS 0x380C33 EXTERN /end MEASUREMENT
/begin MEASUREMENT etazwbm "gemittelter Zündwinkelwirkungsgrad des Basiszündwinkels" UBYTE rel_ub_b127p5 1 100 0 127.5 FUNCTION_LIST MDBAS MDFUE MDKOL IF_DATA DIM_X 0x380C34 EXTERN WORD IF_DATA MCMESS 0x380C34 EXTERN /end MEASUREMENT
/begin MEASUREMENT etazwg "Wirkungsgrad beim Grundzündwinkel" UBYTE rel_ub_b127p5 1 100 0 127.5 FUNCTION_LIST LAMBTS IF_DATA DIM_X 0x380B42 EXTERN WORD IF_DATA MCMESS 0x380B42 EXTERN /end MEASUREMENT
/begin MEASUREMENT etazwif "Ist-Zündwinkelwirkungsgrad: für DTEV gefilterter Wert" UBYTE rel_ub_b127p5 1 100 0 127.5 FUNCTION_LIST DTEV IF_DATA DIM_X 0x380CD0 EXTERN WORD IF_DATA MCMESS 0x380CD0 EXTERN /end MEASUREMENT
/begin MEASUREMENT etazwim "Gemittelter Wirkungsgrad beim Ist-Zündwinkel" UBYTE rel_ub_b127p5 1 100 0 127.5 FUNCTION_LIST LAMBTS IF_DATA DIM_X 0x380B43 EXTERN WORD IF_DATA MCMESS 0x380B43 EXTERN /end MEASUREMENT
/begin MEASUREMENT etazwimt "Ist_Zündwinkelwirkungsgrad für ATM gemittelt (200 ms)" UBYTE rel_ub_b127p5 1 100 0 127.5 FUNCTION_LIST ATM SSTBER87 IF_DATA DIM_X 0x380A3D EXTERN WORD IF_DATA MCMESS 0x380A3D EXTERN /end MEASUREMENT
/begin MEASUREMENT etazwist "Ist-Zündwinkelwirkungsgrad" UBYTE rel_ub_b127p5 1 100 0 127.5 FUNCTION_LIST MDIST ATM DTEV LAMBTS SSTBER87 IF_DATA DIM_X 0x380C3B EXTERN WORD IF_DATA MCMESS 0x380C3B EXTERN /end MEASUREMENT
/begin MEASUREMENT etazwkte "korrigierter Zündwinkelwirkungsgrad für DTEV" UBYTE rel_ub_b127p5 1 100 0 127.5 FUNCTION_LIST DTEV IF_DATA DIM_X 0x380CD1 EXTERN WORD IF_DATA MCMESS 0x380CD1 EXTERN /end MEASUREMENT
/begin MEASUREMENT etazwmn "Minimum-Zündwinkelwirkungsgrad" UBYTE rel_ub_b127p5 1 100 0 127.5 FUNCTION_LIST ZWMIN MDKOL MDRED1 IF_DATA DIM_X 0xFB4A INTERN WORD IF_DATA MCMESS 0xFB4A INTERN /end MEASUREMENT
/begin MEASUREMENT etazws "Sollzündwinkelwirkungsgrad" UBYTE rel_ub_b127p5 1 100 0 127.5 FUNCTION_LIST MDZW IF_DATA DIM_X 0x380D05 EXTERN WORD IF_DATA MCMESS 0x380D05 EXTERN /end MEASUREMENT
/begin MEASUREMENT etazw_uc "Ist-Zündwinkelwirkungsgrad im Befehlstest" UBYTE rel_ub_b127p5 1 100 0 127.5 FUNCTION_LIST URCMIST IF_DATA DIM_X 0x380C67 EXTERN WORD IF_DATA MCMESS 0x380C67 EXTERN /end MEASUREMENT
/begin MEASUREMENT etazw_um "Ist-Zündwinkelwirkungsgrad in der Funktionsüberwachung" UBYTE rel_ub_b127p5 1 100 0 127.5 FUNCTION_LIST UFMIST IF_DATA DIM_X 0x380C4E EXTERN WORD IF_DATA MCMESS 0x380C4E EXTERN /end MEASUREMENT
/begin MEASUREMENT evrbgn_one "Ev Nr -1 bei Beginn der Ev-Abschaltung zur Adressierung von REDABM" UBYTE dez 1 100 0 255 FUNCTION_LIST AEVAB IF_DATA DIM_X 0x380B0D EXTERN WORD IF_DATA MCMESS 0x380B0D EXTERN /end MEASUREMENT
/begin MEASUREMENT evsup1 "Funktionskennungsbyte für Ausgabe SAE J1979 Mode2" UBYTE dez 1 100 0 255 FUNCTION_LIST DIMC TC1MOD IF_DATA DIM_X 0x380A10 EXTERN WORD IF_DATA MCMESS 0x380A10 EXTERN /end MEASUREMENT
/begin MEASUREMENT evtmod "Einlaßventiltemperatur modelliert (Temperaturmodell)" SWORD temp_sw_q0p75 1 100 -24576 24575.3 FUNCTION_LIST BGTMPK FUEDK IF_DATA DIM_X 0x382102 EXTERN WORD IF_DATA MCMESS 0x382102 EXTERN /end MEASUREMENT
/begin MEASUREMENT evz_aus "Einspritzausblendmuster" UBYTE dez 1 100 0 255 FUNCTION_LIST AEVAB AEVABZK IF_DATA DIM_X 0x380B0E EXTERN WORD IF_DATA MCMESS 0x380B0E EXTERN /end MEASUREMENT
/begin MEASUREMENT evz_austot "Einspritzausblendmuster total" UBYTE dez 1 100 0 255 FUNCTION_LIST AEVABZK ACIFI BGEVAB DEVE UFEING IF_DATA DIM_X 0x380B13 EXTERN WORD IF_DATA MCMESS 0x380B13 EXTERN /end MEASUREMENT
/begin MEASUREMENT evz_aus_uc "Einspritzausblendmuster im Befehlstest" UBYTE dez 1 100 0 255 FUNCTION_LIST URCEIN URCREAC IF_DATA DIM_X 0x380C59 EXTERN WORD IF_DATA MCMESS 0x380C59 EXTERN /end MEASUREMENT
/begin MEASUREMENT evz_aus_um "Einspritzausblendmuster in der Funktionsüberwachung" UBYTE dez 1 100 0 255 FUNCTION_LIST UFEING UFREAC IF_DATA DIM_X 0x382E45 EXTERN WORD IF_DATA MCMESS 0x382E45 EXTERN /end MEASUREMENT
/begin MEASUREMENT E_aaa "Dummy: Tabellenanfang" UWORD B_TRUE 1 100 0 1 BIT_MASK 0x1 FUNCTION_LIST DFPM_DFPM IF_DATA DIM_X 0x383814 EXTERN BYTE IF_DATA MCMESS 0x383814 EXTERN /end MEASUREMENT
/begin MEASUREMENT E_aave "Errorflag: Absperrventil Aktivkohlefilter (Endstufe)" UWORD B_TRUE 1 100 0 1 BIT_MASK 0x1 FUNCTION_LIST DFPM_DEKON IF_DATA DIM_X 0x383816 EXTERN BYTE IF_DATA MCMESS 0x383816 EXTERN /end MEASUREMENT
/begin MEASUREMENT E_agre "Errorflag: Überwachung AGR-Endstufe" UWORD B_TRUE 1 100 0 1 BIT_MASK 0x1 FUNCTION_LIST DFPM_DUMMY043 IF_DATA DIM_X 0x383818 EXTERN BYTE IF_DATA MCMESS 0x383818 EXTERN /end MEASUREMENT
/begin MEASUREMENT E_agrf "Errorflag: Überwachung AGR-FLOW" UWORD B_TRUE 1 100 0 1 BIT_MASK 0x1 FUNCTION_LIST DFPM_DUMMY043 IF_DATA DIM_X 0x38381A EXTERN BYTE IF_DATA MCMESS 0x38381A EXTERN /end MEASUREMENT
/begin MEASUREMENT E_bm "Errorflag: Bezugsmarkengeber" UWORD B_TRUE 1 100 0 1 BIT_MASK 0x1 FUNCTION_LIST DFPM_DDG IF_DATA DIM_X 0x38381C EXTERN BYTE IF_DATA MCMESS 0x38381C EXTERN /end MEASUREMENT
/begin MEASUREMENT E_brems "Fehlerflag: BREMS (Bremsschalter)" UWORD B_TRUE 1 100 0 1 BIT_MASK 0x1 FUNCTION_LIST DFPM_GGEGAS IF_DATA DIM_X 0x38381E EXTERN BYTE IF_DATA MCMESS 0x38381E EXTERN /end MEASUREMENT
/begin MEASUREMENT E_bwf "Errorflag: PWG Bewegung" UWORD B_TRUE 1 100 0 1 BIT_MASK 0x1 FUNCTION_LIST DFPM_GGPED IF_DATA DIM_X 0x383820 EXTERN BYTE IF_DATA MCMESS 0x383820 EXTERN /end MEASUREMENT
/begin MEASUREMENT E_cas "Errorflag: CAN-Schnittstelle, Timeout ASC" UWORD B_TRUE 1 100 0 1 BIT_MASK 0x1 FUNCTION_LIST DFPM_DCAS IF_DATA DIM_X 0x383822 EXTERN BYTE IF_DATA MCMESS 0x383822 EXTERN /end MEASUREMENT
/begin MEASUREMENT E_cge "Errorflag: CAN-Schnittstelle, Timeout EGS" UWORD B_TRUE 1 100 0 1 BIT_MASK 0x1 FUNCTION_LIST DFPM_DCGE IF_DATA DIM_X 0x383824 EXTERN BYTE IF_DATA MCMESS 0x383824 EXTERN /end MEASUREMENT
/begin MEASUREMENT E_cgegs "Errorflag: EGS; Steuergerät" UWORD B_TRUE 1 100 0 1 BIT_MASK 0x1 FUNCTION_LIST DFPM_DCG IF_DATA DIM_X 0x383826 EXTERN BYTE IF_DATA MCMESS 0x383826 EXTERN /end MEASUREMENT
/begin MEASUREMENT E_cgggp "Errorflag: EGS; Gang unplausibel" UWORD B_TRUE 1 100 0 1 BIT_MASK 0x1 FUNCTION_LIST DFPM_DCG IF_DATA DIM_X 0x383828 EXTERN BYTE IF_DATA MCMESS 0x383828 EXTERN /end MEASUREMENT
/begin MEASUREMENT E_cgggv "Errorflag: EGS; Gangvergleich negativ" UWORD B_TRUE 1 100 0 1 BIT_MASK 0x1 FUNCTION_LIST DFPM_DCG IF_DATA DIM_X 0x38382A EXTERN BYTE IF_DATA MCMESS 0x38382A EXTERN /end MEASUREMENT
/begin MEASUREMENT E_cgm1v "Errorflag: EGS; Magnetventil 1-2/4-5 Schaltung" UWORD B_TRUE 1 100 0 1 BIT_MASK 0x1 FUNCTION_LIST DFPM_DCG IF_DATA DIM_X 0x38382C EXTERN BYTE IF_DATA MCMESS 0x38382C EXTERN /end MEASUREMENT
/begin MEASUREMENT E_cgm2v "Errorflag: EGS; Magnetventil 2-3 Schaltung" UWORD B_TRUE 1 100 0 1 BIT_MASK 0x1 FUNCTION_LIST DFPM_DCG IF_DATA DIM_X 0x38382E EXTERN BYTE IF_DATA MCMESS 0x38382E EXTERN /end MEASUREMENT
/begin MEASUREMENT E_cgm3v "Errorflag: EGS; Magnetventil 3-4 Schaltung" UWORD B_TRUE 1 100 0 1 BIT_MASK 0x1 FUNCTION_LIST DFPM_DCG IF_DATA DIM_X 0x383830 EXTERN BYTE IF_DATA MCMESS 0x383830 EXTERN /end MEASUREMENT
/begin MEASUREMENT E_cgmvk "Errorflag: EGS; Magnetventil Wandlerkupplung" UWORD B_TRUE 1 100 0 1 BIT_MASK 0x1 FUNCTION_LIST DFPM_DCG IF_DATA DIM_X 0x383832 EXTERN BYTE IF_DATA MCMESS 0x383832 EXTERN /end MEASUREMENT
/begin MEASUREMENT E_cgrmm "Errorflag: EGS; Regelmagnetventil Modulierdruck" UWORD B_TRUE 1 100 0 1 BIT_MASK 0x1 FUNCTION_LIST DFPM_DCG IF_DATA DIM_X 0x383834 EXTERN BYTE IF_DATA MCMESS 0x383834 EXTERN /end MEASUREMENT
/begin MEASUREMENT E_cgrms "Errorflag: EGS; Regelmagnetventil Schaltdruck" UWORD B_TRUE 1 100 0 1 BIT_MASK 0x1 FUNCTION_LIST DFPM_DCG IF_DATA DIM_X 0x383836 EXTERN BYTE IF_DATA MCMESS 0x383836 EXTERN /end MEASUREMENT
/begin MEASUREMENT E_cgudg "Errorflag: EGS; Versorgungsspannung Drehzahlsensoren" UWORD B_TRUE 1 100 0 1 BIT_MASK 0x1 FUNCTION_LIST DFPM_DCG IF_DATA DIM_X 0x383838 EXTERN BYTE IF_DATA MCMESS 0x383838 EXTERN /end MEASUREMENT
/begin MEASUREMENT E_cgumv "Errorflag: EGS; Versorgungsspannung Magnetventile" UWORD B_TRUE 1 100 0 1 BIT_MASK 0x1 FUNCTION_LIST DFPM_DCG IF_DATA DIM_X 0x38383A EXTERN BYTE IF_DATA MCMESS 0x38383A EXTERN /end MEASUREMENT
/begin MEASUREMENT E_cgvgc "Errorflag: EGS; Verteilergetr.-Stellung unplausibel" UWORD B_TRUE 1 100 0 1 BIT_MASK 0x1 FUNCTION_LIST DFPM_DCG IF_DATA DIM_X 0x38383C EXTERN BYTE IF_DATA MCMESS 0x38383C EXTERN /end MEASUREMENT
/begin MEASUREMENT E_cgvrc "Errorflag: EGS; Raddrehzahl hinten unplausibel" UWORD B_TRUE 1 100 0 1 BIT_MASK 0x1 FUNCTION_LIST DFPM_DCG IF_DATA DIM_X 0x38383E EXTERN BYTE IF_DATA MCMESS 0x38383E EXTERN /end MEASUREMENT
/begin MEASUREMENT E_cgwk "Errorflag: EGS; Wandlerkupplung" UWORD B_TRUE 1 100 0 1 BIT_MASK 0x1 FUNCTION_LIST DFPM_DCG IF_DATA DIM_X 0x383840 EXTERN BYTE IF_DATA MCMESS 0x383840 EXTERN /end MEASUREMENT
/begin MEASUREMENT E_ckbi "Errorflag CAN-Schnittstelle Timeout Kombi" UWORD B_TRUE 1 100 0 1 BIT_MASK 0x1 FUNCTION_LIST DFPM_DCKBI IF_DATA DIM_X 0x383842 EXTERN BYTE IF_DATA MCMESS 0x383842 EXTERN /end MEASUREMENT
/begin MEASUREMENT E_cmil "Fehler MIL über CAN" UWORD B_TRUE 1 100 0 1 BIT_MASK 0x1 FUNCTION_LIST DFPM_DCMIL IF_DATA DIM_X 0x383844 EXTERN BYTE IF_DATA MCMESS 0x383844 EXTERN /end MEASUREMENT
/begin MEASUREMENT E_cra "Errorflag: EKP Crashfunktion" UWORD B_TRUE 1 100 0 1 BIT_MASK 0x1 FUNCTION_LIST DFPM_GGAIRBAG IF_DATA DIM_X 0x383846 EXTERN BYTE IF_DATA MCMESS 0x383846 EXTERN /end MEASUREMENT
/begin MEASUREMENT E_dk "Errorflag: DK - Potentiometer" UWORD B_TRUE 1 100 0 1 BIT_MASK 0x1 FUNCTION_LIST DFPM_DDVE IF_DATA DIM_X 0x383848 EXTERN BYTE IF_DATA MCMESS 0x383848 EXTERN /end MEASUREMENT
/begin MEASUREMENT E_dk1p "Errorflag: Drosselklappe 1. Poti" UWORD B_TRUE 1 100 0 1 BIT_MASK 0x1 FUNCTION_LIST DFPM_DDVE IF_DATA DIM_X 0x38384A EXTERN BYTE IF_DATA MCMESS 0x38384A EXTERN /end MEASUREMENT
/begin MEASUREMENT E_dk2p "Errorflag: Drosselklappe 2. Poti" UWORD B_TRUE 1 100 0 1 BIT_MASK 0x1 FUNCTION_LIST DFPM_DDVE IF_DATA DIM_X 0x38384C EXTERN BYTE IF_DATA MCMESS 0x38384C EXTERN /end MEASUREMENT
/begin MEASUREMENT E_dpl "Errorflag: Dauerplus" UWORD B_TRUE 1 100 0 1 BIT_MASK 0x1 FUNCTION_LIST DFPM_DUMMY043 IF_DATA DIM_X 0x38384E EXTERN BYTE IF_DATA MCMESS 0x38384E EXTERN /end MEASUREMENT
/begin MEASUREMENT E_dsl "Errorflag: Drucksensor Ladedruck" UWORD B_TRUE 1 100 0 1 BIT_MASK 0x1 FUNCTION_LIST DFPM_GGDSAS IF_DATA DIM_X 0x383850 EXTERN BYTE IF_DATA MCMESS 0x383850 EXTERN /end MEASUREMENT
/begin MEASUREMENT E_dsu "Errorflag: Umgebungsdrucksensor" UWORD B_TRUE 1 100 0 1 BIT_MASK 0x1 FUNCTION_LIST DFPM_GGDSAS IF_DATA DIM_X 0x383852 EXTERN BYTE IF_DATA MCMESS 0x383852 EXTERN /end MEASUREMENT
/begin MEASUREMENT E_dsvlu "Errorflag: Drucksensorsignalvergleich (DS-L DS-U)" UWORD B_TRUE 1 100 0 1 BIT_MASK 0x1 FUNCTION_LIST DFPM_GGDSAS IF_DATA DIM_X 0x383854 EXTERN BYTE IF_DATA MCMESS 0x383854 EXTERN /end MEASUREMENT
/begin MEASUREMENT E_dvee "Errorflag: DV-E Endstufe" UWORD B_TRUE 1 100 0 1 BIT_MASK 0x1 FUNCTION_LIST DFPM_DDVE IF_DATA DIM_X 0x383856 EXTERN BYTE IF_DATA MCMESS 0x383856 EXTERN /end MEASUREMENT
/begin MEASUREMENT E_dvef "Errorflag: DV-E Fehler bei Federprüfung" UWORD B_TRUE 1 100 0 1 BIT_MASK 0x1 FUNCTION_LIST DFPM_DDVE IF_DATA DIM_X 0x383858 EXTERN BYTE IF_DATA MCMESS 0x383858 EXTERN /end MEASUREMENT
/begin MEASUREMENT E_dvefo "Errorflag: DV-E-Fehler bei Federprüfung ""Öffnen""" UWORD B_TRUE 1 100 0 1 BIT_MASK 0x1 FUNCTION_LIST DFPM_DDVE IF_DATA DIM_X 0x38385A EXTERN BYTE IF_DATA MCMESS 0x38385A EXTERN /end MEASUREMENT
/begin MEASUREMENT E_dvel "Errorflag: DV-E Lageabweichung" UWORD B_TRUE 1 100 0 1 BIT_MASK 0x1 FUNCTION_LIST DFPM_DDVE IF_DATA DIM_X 0x38385C EXTERN BYTE IF_DATA MCMESS 0x38385C EXTERN /end MEASUREMENT
/begin MEASUREMENT E_dven "Errorflag: DV-E Fehler bei Prüfung Notluftposition" UWORD B_TRUE 1 100 0 1 BIT_MASK 0x1 FUNCTION_LIST DFPM_DDVE IF_DATA DIM_X 0x38385E EXTERN BYTE IF_DATA MCMESS 0x38385E EXTERN /end MEASUREMENT
/begin MEASUREMENT E_dver "Errorflag: DV-E Regelbereich" UWORD B_TRUE 1 100 0 1 BIT_MASK 0x1 FUNCTION_LIST DFPM_DDVE IF_DATA DIM_X 0x383860 EXTERN BYTE IF_DATA MCMESS 0x383860 EXTERN /end MEASUREMENT
/begin MEASUREMENT E_dvet "Errorflag: DV-E-Tauscherkennung ohne Adaption" UWORD B_TRUE 1 100 0 1 BIT_MASK 0x1 FUNCTION_LIST DFPM_DDVE IF_DATA DIM_X 0x383862 EXTERN BYTE IF_DATA MCMESS 0x383862 EXTERN /end MEASUREMENT
/begin MEASUREMENT E_dveu "Errorflag: DV-E Fehler beim UMA-Lernen" UWORD B_TRUE 1 100 0 1 BIT_MASK 0x1 FUNCTION_LIST DFPM_DDVE IF_DATA DIM_X 0x383864 EXTERN BYTE IF_DATA MCMESS 0x383864 EXTERN /end MEASUREMENT
/begin MEASUREMENT E_dveub "Errorflag: DV-E-Adaption Abbruch wg. Umweltbedingung" UWORD B_TRUE 1 100 0 1 BIT_MASK 0x1 FUNCTION_LIST DFPM_DDVE IF_DATA DIM_X 0x383866 EXTERN BYTE IF_DATA MCMESS 0x383866 EXTERN /end MEASUREMENT
/begin MEASUREMENT E_dveuw "Errorflag: Fehler bei UMA-Wiederlernen" UWORD B_TRUE 1 100 0 1 BIT_MASK 0x1 FUNCTION_LIST DFPM_DDVE IF_DATA DIM_X 0x383868 EXTERN BYTE IF_DATA MCMESS 0x383868 EXTERN /end MEASUREMENT
/begin MEASUREMENT E_dvev "Errorflag: DV-E Fehler bei Verstärkerabgleich" UWORD B_TRUE 1 100 0 1 BIT_MASK 0x1 FUNCTION_LIST DFPM_DDVE IF_DATA DIM_X 0x38386A EXTERN BYTE IF_DATA MCMESS 0x38386A EXTERN /end MEASUREMENT
/begin MEASUREMENT E_egfe "Errorflag: Eingangsgrößen Füllungserfassung" UWORD B_TRUE 1 100 0 1 BIT_MASK 0x1 FUNCTION_LIST DFPM_EGFE IF_DATA DIM_X 0x38386C EXTERN BYTE IF_DATA MCMESS 0x38386C EXTERN /end MEASUREMENT
/begin MEASUREMENT E_ev1 "Errorflag: EV von Zyl. 1" UWORD B_TRUE 1 100 0 1 BIT_MASK 0x1 FUNCTION_LIST DFPM_DEKON STADAP IF_DATA DIM_X 0x38386E EXTERN BYTE IF_DATA MCMESS 0x38386E EXTERN /end MEASUREMENT
/begin MEASUREMENT E_ev2 "Errorflag: EV von Zyl. 2" UWORD B_TRUE 1 100 0 1 BIT_MASK 0x1 FUNCTION_LIST DFPM_DEKON STADAP IF_DATA DIM_X 0x383870 EXTERN BYTE IF_DATA MCMESS 0x383870 EXTERN /end MEASUREMENT
/begin MEASUREMENT E_ev3 "Errorflag: EV von Zyl. 3" UWORD B_TRUE 1 100 0 1 BIT_MASK 0x1 FUNCTION_LIST DFPM_DEKON STADAP IF_DATA DIM_X 0x383872 EXTERN BYTE IF_DATA MCMESS 0x383872 EXTERN /end MEASUREMENT
/begin MEASUREMENT E_ev4 "Errorflag: EV von Zyl. 4" UWORD B_TRUE 1 100 0 1 BIT_MASK 0x1 FUNCTION_LIST DFPM_DEKON STADAP IF_DATA DIM_X 0x383874 EXTERN BYTE IF_DATA MCMESS 0x383874 EXTERN /end MEASUREMENT
/begin MEASUREMENT E_ev5 "Errorflag: EV von Zyl. 5" UWORD B_TRUE 1 100 0 1 BIT_MASK 0x1 FUNCTION_LIST DFPM_DEKON STADAP IF_DATA DIM_X 0x383876 EXTERN BYTE IF_DATA MCMESS 0x383876 EXTERN /end MEASUREMENT
/begin MEASUREMENT E_ev6 "Errorflag: EV von Zyl. 6" UWORD B_TRUE 1 100 0 1 BIT_MASK 0x1 FUNCTION_LIST DFPM_DEKON STADAP IF_DATA DIM_X 0x383878 EXTERN BYTE IF_DATA MCMESS 0x383878 EXTERN /end MEASUREMENT
/begin MEASUREMENT E_fgrl "Fehler FGR-Lampe über CAN" UWORD B_TRUE 1 100 0 1 BIT_MASK 0x1 FUNCTION_LIST DFPM_DCFGRL IF_DATA DIM_X 0x38387A EXTERN BYTE IF_DATA MCMESS 0x38387A EXTERN /end MEASUREMENT
/begin MEASUREMENT E_fp1p "Errorflag: Fahrpedal 1. Poti" UWORD B_TRUE 1 100 0 1 BIT_MASK 0x1 FUNCTION_LIST DFPM_GGPED IF_DATA DIM_X 0x38387C EXTERN BYTE IF_DATA MCMESS 0x38387C EXTERN /end MEASUREMENT
/begin MEASUREMENT E_fp2p "Errorflag: Fahrpedal 2. Poti" UWORD B_TRUE 1 100 0 1 BIT_MASK 0x1 FUNCTION_LIST DFPM_GGPED IF_DATA DIM_X 0x38387E EXTERN BYTE IF_DATA MCMESS 0x38387E EXTERN /end MEASUREMENT
/begin MEASUREMENT E_fpp "Errorflag Fahrpedal-Poti" UWORD B_TRUE 1 100 0 1 BIT_MASK 0x1 FUNCTION_LIST DFPM_GGPED IF_DATA DIM_X 0x383880 EXTERN BYTE IF_DATA MCMESS 0x383880 EXTERN /end MEASUREMENT
/begin MEASUREMENT E_frao "Errorflag: LR-Adaption oberer multiplikativer Bereich" UWORD B_TRUE 1 100 0 1 BIT_MASK 0x1 FUNCTION_LIST DFPM_DKVS STADAP IF_DATA DIM_X 0x383882 EXTERN BYTE IF_DATA MCMESS 0x383882 EXTERN /end MEASUREMENT
/begin MEASUREMENT E_frao2 "Errorflag: LR-Adaption oberer multiplikativer Bereich (Bank 2)" UWORD B_TRUE 1 100 0 1 BIT_MASK 0x1 FUNCTION_LIST DFPM_DKVS STADAP IF_DATA DIM_X 0x383884 EXTERN BYTE IF_DATA MCMESS 0x383884 EXTERN /end MEASUREMENT
/begin MEASUREMENT E_frau "Errorflag: LR-Adaption unterer multiplikativer Bereich" UWORD B_TRUE 1 100 0 1 BIT_MASK 0x1 FUNCTION_LIST DFPM_DKVS STADAP IF_DATA DIM_X 0x383886 EXTERN BYTE IF_DATA MCMESS 0x383886 EXTERN /end MEASUREMENT
/begin MEASUREMENT E_frau2 "Errorflag: LR-Adaption unterer multiplikativer Bereich (Bank 2)" UWORD B_TRUE 1 100 0 1 BIT_MASK 0x1 FUNCTION_LIST DFPM_DKVS STADAP IF_DATA DIM_X 0x383888 EXTERN BYTE IF_DATA MCMESS 0x383888 EXTERN /end MEASUREMENT
/begin MEASUREMENT E_frst "Errorflag: Fehler aus Diagnose Kraftstoffversorgungssystem (Kurztest)" UWORD B_TRUE 1 100 0 1 BIT_MASK 0x1 FUNCTION_LIST DFPM_DKVS IF_DATA DIM_X 0x38388A EXTERN BYTE IF_DATA MCMESS 0x38388A EXTERN /end MEASUREMENT
/begin MEASUREMENT E_frst2 "Errorflag: Fehler aus Diagnose Kraftstoffvers.-System (Kurztest Bank 2)" UWORD B_TRUE 1 100 0 1 BIT_MASK 0x1 FUNCTION_LIST DFPM_DKVS IF_DATA DIM_X 0x38388C EXTERN BYTE IF_DATA MCMESS 0x38388C EXTERN /end MEASUREMENT
/begin MEASUREMENT e_gCtr_0__A "" UBYTE dez 1 100 0 255 FUNCTION_LIST DVS IF_DATA DIM_X 0x380CDC EXTERN WORD IF_DATA MCMESS 0x380CDC EXTERN /end MEASUREMENT
/begin MEASUREMENT e_gCtr_1__A "" UBYTE dez 1 100 0 255 FUNCTION_LIST DVS IF_DATA DIM_X 0x380CDD EXTERN WORD IF_DATA MCMESS 0x380CDD EXTERN /end MEASUREMENT
/begin MEASUREMENT e_gCtr_2__A "" UBYTE dez 1 100 0 255 FUNCTION_LIST DVS IF_DATA DIM_X 0x380CDE EXTERN WORD IF_DATA MCMESS 0x380CDE EXTERN /end MEASUREMENT
/begin MEASUREMENT e_gCtr_3__A "" UBYTE dez 1 100 0 255 FUNCTION_LIST DVS IF_DATA DIM_X 0x380CDF EXTERN WORD IF_DATA MCMESS 0x380CDF EXTERN /end MEASUREMENT
/begin MEASUREMENT e_gCtr_4__A "" UBYTE dez 1 100 0 255 FUNCTION_LIST DVS IF_DATA DIM_X 0x380CE0 EXTERN WORD IF_DATA MCMESS 0x380CE0 EXTERN /end MEASUREMENT
/begin MEASUREMENT e_gCtr_5__A "" UBYTE dez 1 100 0 255 FUNCTION_LIST DVS IF_DATA DIM_X 0x380CE1 EXTERN WORD IF_DATA MCMESS 0x380CE1 EXTERN /end MEASUREMENT
/begin MEASUREMENT e_gCtr2_0__A "" UBYTE dez 1 100 0 255 FUNCTION_LIST DVS IF_DATA DIM_X 0x380CE2 EXTERN WORD IF_DATA MCMESS 0x380CE2 EXTERN /end MEASUREMENT
/begin MEASUREMENT e_gCtr2_1__A "" UBYTE dez 1 100 0 255 FUNCTION_LIST DVS IF_DATA DIM_X 0x380CE3 EXTERN WORD IF_DATA MCMESS 0x380CE3 EXTERN /end MEASUREMENT
/begin MEASUREMENT e_gCtr2_2__A "" UBYTE dez 1 100 0 255 FUNCTION_LIST DVS IF_DATA DIM_X 0x380CE4 EXTERN WORD IF_DATA MCMESS 0x380CE4 EXTERN /end MEASUREMENT
/begin MEASUREMENT e_gCtr2_3__A "" UBYTE dez 1 100 0 255 FUNCTION_LIST DVS IF_DATA DIM_X 0x380CE5 EXTERN WORD IF_DATA MCMESS 0x380CE5 EXTERN /end MEASUREMENT
/begin MEASUREMENT e_gCtr2_4__A "" UBYTE dez 1 100 0 255 FUNCTION_LIST DVS IF_DATA DIM_X 0x380CE6 EXTERN WORD IF_DATA MCMESS 0x380CE6 EXTERN /end MEASUREMENT
/begin MEASUREMENT e_gCtr2_5__A "" UBYTE dez 1 100 0 255 FUNCTION_LIST DVS IF_DATA DIM_X 0x380CE7 EXTERN WORD IF_DATA MCMESS 0x380CE7 EXTERN /end MEASUREMENT
/begin MEASUREMENT e_gDCtr_0__A "" UWORD dez 1 100 0 65535 FUNCTION_LIST DVS IF_DATA DIM_X 0x382C8E EXTERN WORD IF_DATA MCMESS 0x382C8E EXTERN /end MEASUREMENT
/begin MEASUREMENT e_gDCtr_1__A "" UWORD dez 1 100 0 65535 FUNCTION_LIST DVS IF_DATA DIM_X 0x382C90 EXTERN WORD IF_DATA MCMESS 0x382C90 EXTERN /end MEASUREMENT
/begin MEASUREMENT e_gDCtr_2__A "" UWORD dez 1 100 0 65535 FUNCTION_LIST DVS IF_DATA DIM_X 0x382C92 EXTERN WORD IF_DATA MCMESS 0x382C92 EXTERN /end MEASUREMENT
/begin MEASUREMENT e_gDCtr_3__A "" UWORD dez 1 100 0 65535 FUNCTION_LIST DVS IF_DATA DIM_X 0x382C94 EXTERN WORD IF_DATA MCMESS 0x382C94 EXTERN /end MEASUREMENT
/begin MEASUREMENT e_gDCtr_4__A "" UWORD dez 1 100 0 65535 FUNCTION_LIST DVS IF_DATA DIM_X 0x382C96 EXTERN WORD IF_DATA MCMESS 0x382C96 EXTERN /end MEASUREMENT
/begin MEASUREMENT e_gDCtr_5__A "" UWORD dez 1 100 0 65535 FUNCTION_LIST DVS IF_DATA DIM_X 0x382C98 EXTERN WORD IF_DATA MCMESS 0x382C98 EXTERN /end MEASUREMENT
/begin MEASUREMENT E_hsh "Errorflag: Lambdasonden-Heizung hinter Katalysator" UWORD B_TRUE 1 100 0 1 BIT_MASK 0x1 FUNCTION_LIST DFPM_DHLSHK IF_DATA DIM_X 0x38388E EXTERN BYTE IF_DATA MCMESS 0x38388E EXTERN /end MEASUREMENT
/begin MEASUREMENT E_hsh2 "Errorflag: Lambdasonden-Heizung hinter Katalysator Bank 2" UWORD B_TRUE 1 100 0 1 BIT_MASK 0x1 FUNCTION_LIST DFPM_DHLSHK IF_DATA DIM_X 0x383890 EXTERN BYTE IF_DATA MCMESS 0x383890 EXTERN /end MEASUREMENT
/begin MEASUREMENT E_hshe "Errorflag: Lambdasonden-Heizung hinter Katalysator (Endstufe)" UWORD B_TRUE 1 100 0 1 BIT_MASK 0x1 FUNCTION_LIST DFPM_DEKON IF_DATA DIM_X 0x383892 EXTERN BYTE IF_DATA MCMESS 0x383892 EXTERN /end MEASUREMENT
/begin MEASUREMENT E_hshe2 "Errorflag: Lambdasonden-Heizung hinter Katalysator Bank 2 (Endstufe)" UWORD B_TRUE 1 100 0 1 BIT_MASK 0x1 FUNCTION_LIST DFPM_DEKON IF_DATA DIM_X 0x383894 EXTERN BYTE IF_DATA MCMESS 0x383894 EXTERN /end MEASUREMENT
/begin MEASUREMENT E_hsv "Errorflag: Lambdasonden-Heizung vor Katalysator" UWORD B_TRUE 1 100 0 1 BIT_MASK 0x1 FUNCTION_LIST DFPM_DHLSU IF_DATA DIM_X 0x383896 EXTERN BYTE IF_DATA MCMESS 0x383896 EXTERN /end MEASUREMENT
/begin MEASUREMENT E_hsv2 "Errorflag: Lambdasonden-Heizung vor Katalysator Bank 2" UWORD B_TRUE 1 100 0 1 BIT_MASK 0x1 FUNCTION_LIST DFPM_DHLSU IF_DATA DIM_X 0x383898 EXTERN BYTE IF_DATA MCMESS 0x383898 EXTERN /end MEASUREMENT
/begin MEASUREMENT E_hsvsa "Errorflag: reduzierte  LSU-Heizung oder LSU-Kennlinie abgeflacht" UWORD B_TRUE 1 100 0 1 BIT_MASK 0x1 FUNCTION_LIST DFPM_DHLSU IF_DATA DIM_X 0x38389A EXTERN BYTE IF_DATA MCMESS 0x38389A EXTERN /end MEASUREMENT
/begin MEASUREMENT E_hsvsa2 "Errorflag: reduzierte  LSU_2-Heizung oder LSU_2-Kennlinie abgeflacht" UWORD B_TRUE 1 100 0 1 BIT_MASK 0x1 FUNCTION_LIST DFPM_DHLSU IF_DATA DIM_X 0x38389C EXTERN BYTE IF_DATA MCMESS 0x38389C EXTERN /end MEASUREMENT
/begin MEASUREMENT E_kat "Errorflag: Katalysator-Konvertierung" UWORD B_TRUE 1 100 0 1 BIT_MASK 0x1 FUNCTION_LIST DFPM_DKAT IF_DATA DIM_X 0x38389E EXTERN BYTE IF_DATA MCMESS 0x38389E EXTERN /end MEASUREMENT
/begin MEASUREMENT E_kat2 "Errorflag: Katalysator-Konvertierung	(Bank 2)" UWORD B_TRUE 1 100 0 1 BIT_MASK 0x1 FUNCTION_LIST DFPM_DKAT IF_DATA DIM_X 0x3838A0 EXTERN BYTE IF_DATA MCMESS 0x3838A0 EXTERN /end MEASUREMENT
/begin MEASUREMENT e_kCtr_0__A "" UBYTE dez 1 100 0 255 FUNCTION_LIST DVS IF_DATA DIM_X 0x380CE8 EXTERN WORD IF_DATA MCMESS 0x380CE8 EXTERN /end MEASUREMENT
/begin MEASUREMENT e_kCtr_1__A "" UBYTE dez 1 100 0 255 FUNCTION_LIST DVS IF_DATA DIM_X 0x380CE9 EXTERN WORD IF_DATA MCMESS 0x380CE9 EXTERN /end MEASUREMENT
/begin MEASUREMENT e_kCtr_2__A "" UBYTE dez 1 100 0 255 FUNCTION_LIST DVS IF_DATA DIM_X 0x380CEA EXTERN WORD IF_DATA MCMESS 0x380CEA EXTERN /end MEASUREMENT
/begin MEASUREMENT e_kCtr_3__A "" UBYTE dez 1 100 0 255 FUNCTION_LIST DVS IF_DATA DIM_X 0x380CEB EXTERN WORD IF_DATA MCMESS 0x380CEB EXTERN /end MEASUREMENT
/begin MEASUREMENT e_kCtr_4__A "" UBYTE dez 1 100 0 255 FUNCTION_LIST DVS IF_DATA DIM_X 0x380CEC EXTERN WORD IF_DATA MCMESS 0x380CEC EXTERN /end MEASUREMENT
/begin MEASUREMENT e_kCtr_5__A "" UBYTE dez 1 100 0 255 FUNCTION_LIST DVS IF_DATA DIM_X 0x380CED EXTERN WORD IF_DATA MCMESS 0x380CED EXTERN /end MEASUREMENT
/begin MEASUREMENT e_kCtr2_0__A "" UBYTE dez 1 100 0 255 FUNCTION_LIST DVS IF_DATA DIM_X 0x380CEE EXTERN WORD IF_DATA MCMESS 0x380CEE EXTERN /end MEASUREMENT
/begin MEASUREMENT e_kCtr2_1__A "" UBYTE dez 1 100 0 255 FUNCTION_LIST DVS IF_DATA DIM_X 0x380CEF EXTERN WORD IF_DATA MCMESS 0x380CEF EXTERN /end MEASUREMENT
/begin MEASUREMENT e_kCtr2_2__A "" UBYTE dez 1 100 0 255 FUNCTION_LIST DVS IF_DATA DIM_X 0x380CF0 EXTERN WORD IF_DATA MCMESS 0x380CF0 EXTERN /end MEASUREMENT
/begin MEASUREMENT e_kCtr2_3__A "" UBYTE dez 1 100 0 255 FUNCTION_LIST DVS IF_DATA DIM_X 0x380CF1 EXTERN WORD IF_DATA MCMESS 0x380CF1 EXTERN /end MEASUREMENT
/begin MEASUREMENT e_kCtr2_4__A "" UBYTE dez 1 100 0 255 FUNCTION_LIST DVS IF_DATA DIM_X 0x380CF2 EXTERN WORD IF_DATA MCMESS 0x380CF2 EXTERN /end MEASUREMENT
/begin MEASUREMENT e_kCtr2_5__A "" UBYTE dez 1 100 0 255 FUNCTION_LIST DVS IF_DATA DIM_X 0x380CF3 EXTERN WORD IF_DATA MCMESS 0x380CF3 EXTERN /end MEASUREMENT
/begin MEASUREMENT e_kDCtr_0__A "" UWORD dez 1 100 0 65535 FUNCTION_LIST DVS IF_DATA DIM_X 0x382C9A EXTERN WORD IF_DATA MCMESS 0x382C9A EXTERN /end MEASUREMENT
/begin MEASUREMENT e_kDCtr_1__A "" UWORD dez 1 100 0 65535 FUNCTION_LIST DVS IF_DATA DIM_X 0x382C9C EXTERN WORD IF_DATA MCMESS 0x382C9C EXTERN /end MEASUREMENT
/begin MEASUREMENT e_kDCtr_2__A "" UWORD dez 1 100 0 65535 FUNCTION_LIST DVS IF_DATA DIM_X 0x382C9E EXTERN WORD IF_DATA MCMESS 0x382C9E EXTERN /end MEASUREMENT
/begin MEASUREMENT e_kDCtr_3__A "" UWORD dez 1 100 0 65535 FUNCTION_LIST DVS IF_DATA DIM_X 0x382CA0 EXTERN WORD IF_DATA MCMESS 0x382CA0 EXTERN /end MEASUREMENT
/begin MEASUREMENT e_kDCtr_4__A "" UWORD dez 1 100 0 65535 FUNCTION_LIST DVS IF_DATA DIM_X 0x382CA2 EXTERN WORD IF_DATA MCMESS 0x382CA2 EXTERN /end MEASUREMENT
/begin MEASUREMENT e_kDCtr_5__A "" UWORD dez 1 100 0 65535 FUNCTION_LIST DVS IF_DATA DIM_X 0x382CA4 EXTERN WORD IF_DATA MCMESS 0x382CA4 EXTERN /end MEASUREMENT
/begin MEASUREMENT E_kos "Errorflag: Klimakompressorsteuerung" UWORD B_TRUE 1 100 0 1 BIT_MASK 0x1 FUNCTION_LIST DFPM_DEKON IF_DATA DIM_X 0x3838A2 EXTERN BYTE IF_DATA MCMESS 0x3838A2 EXTERN /end MEASUREMENT
/begin MEASUREMENT E_kpe "Errorflag: EKP-Relais Endstufe" UWORD B_TRUE 1 100 0 1 BIT_MASK 0x1 FUNCTION_LIST DFPM_DEKON IF_DATA DIM_X 0x3838A4 EXTERN BYTE IF_DATA MCMESS 0x3838A4 EXTERN /end MEASUREMENT
/begin MEASUREMENT E_krnt "Errorflag: Klopfregelung Nulltest" UWORD B_TRUE 1 100 0 1 BIT_MASK 0x1 FUNCTION_LIST DFPM_DKRNT IF_DATA DIM_X 0x3838A6 EXTERN BYTE IF_DATA MCMESS 0x3838A6 EXTERN /end MEASUREMENT
/begin MEASUREMENT E_krof "Errorflag: Klopfregelung Offset" UWORD B_TRUE 1 100 0 1 BIT_MASK 0x1 FUNCTION_LIST DFPM_DKRNT IF_DATA DIM_X 0x3838A8 EXTERN BYTE IF_DATA MCMESS 0x3838A8 EXTERN /end MEASUREMENT
/begin MEASUREMENT E_krtp "Errorflag: Klopfregelung Testimpuls" UWORD B_TRUE 1 100 0 1 BIT_MASK 0x1 FUNCTION_LIST DFPM_DKRTP IF_DATA DIM_X 0x3838AA EXTERN BYTE IF_DATA MCMESS 0x3838AA EXTERN /end MEASUREMENT
/begin MEASUREMENT E_ks1 "Errorflag: Klopfsensor 1" UWORD B_TRUE 1 100 0 1 BIT_MASK 0x1 FUNCTION_LIST DFPM_DKRS IF_DATA DIM_X 0x3838AC EXTERN BYTE IF_DATA MCMESS 0x3838AC EXTERN /end MEASUREMENT
/begin MEASUREMENT E_ks2 "Errorflag: Klopfsensor 2" UWORD B_TRUE 1 100 0 1 BIT_MASK 0x1 FUNCTION_LIST DFPM_DKRS IF_DATA DIM_X 0x3838AE EXTERN BYTE IF_DATA MCMESS 0x3838AE EXTERN /end MEASUREMENT
/begin MEASUREMENT E_ks3 "Errorflag: Klopfsensor 3" UWORD B_TRUE 1 100 0 1 BIT_MASK 0x1 FUNCTION_LIST DFPM_DKRS IF_DATA DIM_X 0x3838B0 EXTERN BYTE IF_DATA MCMESS 0x3838B0 EXTERN /end MEASUREMENT
/begin MEASUREMENT E_ks4 "Errorflag: Klopfsensor 4" UWORD B_TRUE 1 100 0 1 BIT_MASK 0x1 FUNCTION_LIST DFPM_DKRS IF_DATA DIM_X 0x3838B2 EXTERN BYTE IF_DATA MCMESS 0x3838B2 EXTERN /end MEASUREMENT
/begin MEASUREMENT E_kuppl "Fehlerflag: Gebergröße Kupplung" UWORD B_TRUE 1 100 0 1 BIT_MASK 0x1 FUNCTION_LIST DFPM_DKUPPL IF_DATA DIM_X 0x3838B4 EXTERN BYTE IF_DATA MCMESS 0x3838B4 EXTERN /end MEASUREMENT
/begin MEASUREMENT E_kwave "Errorflag: Kühlwasserabsperrventil Endstufe" UWORD B_TRUE 1 100 0 1 BIT_MASK 0x1 FUNCTION_LIST DFPM_DEKON IF_DATA DIM_X 0x3838B6 EXTERN BYTE IF_DATA MCMESS 0x3838B6 EXTERN /end MEASUREMENT
/begin MEASUREMENT E_lash "Errorflag: Lambda-Sondenalterung hinter Katalysator" UWORD B_TRUE 1 100 0 1 BIT_MASK 0x1 FUNCTION_LIST DFPM_DLSAHK IF_DATA DIM_X 0x3838B8 EXTERN BYTE IF_DATA MCMESS 0x3838B8 EXTERN /end MEASUREMENT
/begin MEASUREMENT E_lash2 "Errorflag: Lambda-Sondenalterung hinter Kat. (Bank 2)" UWORD B_TRUE 1 100 0 1 BIT_MASK 0x1 FUNCTION_LIST DFPM_DLSAHK IF_DATA DIM_X 0x3838BA EXTERN BYTE IF_DATA MCMESS 0x3838BA EXTERN /end MEASUREMENT
/begin MEASUREMENT E_lde "Errorflag: Ladedrucksteuerventil (Endstufe)" UWORD B_TRUE 1 100 0 1 BIT_MASK 0x1 FUNCTION_LIST DFPM_DEKON IF_DATA DIM_X 0x3838BC EXTERN BYTE IF_DATA MCMESS 0x3838BC EXTERN /end MEASUREMENT
/begin MEASUREMENT E_ldo "Errorflag: Ladedruckkennlinie; oberer Wert überschritten" UWORD B_TRUE 1 100 0 1 BIT_MASK 0x1 FUNCTION_LIST DFPM_DLDR IF_DATA DIM_X 0x3838BE EXTERN BYTE IF_DATA MCMESS 0x3838BE EXTERN /end MEASUREMENT
/begin MEASUREMENT E_ldra "Errorflag: Ladedruckregelabweichung" UWORD B_TRUE 1 100 0 1 BIT_MASK 0x1 FUNCTION_LIST DFPM_DLDR IF_DATA DIM_X 0x3838C0 EXTERN BYTE IF_DATA MCMESS 0x3838C0 EXTERN /end MEASUREMENT
/begin MEASUREMENT E_lf1e "Errorflag: Lüfter1 Endstufe" UWORD B_TRUE 1 100 0 1 BIT_MASK 0x1 FUNCTION_LIST DFPM_DEKON IF_DATA DIM_X 0x3838C2 EXTERN BYTE IF_DATA MCMESS 0x3838C2 EXTERN /end MEASUREMENT
/begin MEASUREMENT E_lf2e "Errorflag: Lüfter2 Endstufe" UWORD B_TRUE 1 100 0 1 BIT_MASK 0x1 FUNCTION_LIST DFPM_DEKON IF_DATA DIM_X 0x3838C4 EXTERN BYTE IF_DATA MCMESS 0x3838C4 EXTERN /end MEASUREMENT
/begin MEASUREMENT E_lf3e "Errorflag: Lüfter3 Endstufe" UWORD B_TRUE 1 100 0 1 BIT_MASK 0x1 FUNCTION_LIST DFPM_DEKON IF_DATA DIM_X 0x3838C6 EXTERN BYTE IF_DATA MCMESS 0x3838C6 EXTERN /end MEASUREMENT
/begin MEASUREMENT E_llr "Errorflag: Leerlaufregelung" UWORD B_TRUE 1 100 0 1 BIT_MASK 0x1 FUNCTION_LIST DFPM_DLLR IF_DATA DIM_X 0x3838C8 EXTERN BYTE IF_DATA MCMESS 0x3838C8 EXTERN /end MEASUREMENT
/begin MEASUREMENT E_lm "Errorflag: Hauptlastsensor" UWORD B_TRUE 1 100 0 1 BIT_MASK 0x1 FUNCTION_LIST DFPM_DHFM DSLSLRS IF_DATA DIM_X 0x3838CA EXTERN BYTE IF_DATA MCMESS 0x3838CA EXTERN /end MEASUREMENT
/begin MEASUREMENT E_lsh "Errorflag: Lambda-Sonde hinter Kat" UWORD B_TRUE 1 100 0 1 BIT_MASK 0x1 FUNCTION_LIST DFPM_DLSH IF_DATA DIM_X 0x3838CC EXTERN BYTE IF_DATA MCMESS 0x3838CC EXTERN /end MEASUREMENT
/begin MEASUREMENT E_lsh2 "Errorflag: Lambda-Sonde hinter Kat Bank2" UWORD B_TRUE 1 100 0 1 BIT_MASK 0x1 FUNCTION_LIST DFPM_DLSH IF_DATA DIM_X 0x3838CE EXTERN BYTE IF_DATA MCMESS 0x3838CE EXTERN /end MEASUREMENT
/begin MEASUREMENT E_lsv "Errorflag: Lambda-Sonde vor Kat" UWORD B_TRUE 1 100 0 1 BIT_MASK 0x1 FUNCTION_LIST DFPM_DLSU IF_DATA DIM_X 0x3838D0 EXTERN BYTE IF_DATA MCMESS 0x3838D0 EXTERN /end MEASUREMENT
/begin MEASUREMENT E_lsv2 "Errorflag: Lambda-Sonde 2 vor Kat" UWORD B_TRUE 1 100 0 1 BIT_MASK 0x1 FUNCTION_LIST DFPM_DLSU IF_DATA DIM_X 0x3838D2 EXTERN BYTE IF_DATA MCMESS 0x3838D2 EXTERN /end MEASUREMENT
/begin MEASUREMENT E_lsvv "Errorflag: Vertauschte Lambda-Sonden vor Kat" UWORD B_TRUE 1 100 0 1 BIT_MASK 0x1 FUNCTION_LIST DFPM_LSVV IF_DATA DIM_X 0x3838D4 EXTERN BYTE IF_DATA MCMESS 0x3838D4 EXTERN /end MEASUREMENT
/begin MEASUREMENT E_md "Errorflag: Aussetzer, Summenfehler (multiple)" UWORD B_TRUE 1 100 0 1 BIT_MASK 0x1 FUNCTION_LIST DFPM_DMDMIL IF_DATA DIM_X 0x3838D6 EXTERN BYTE IF_DATA MCMESS 0x3838D6 EXTERN /end MEASUREMENT
/begin MEASUREMENT E_md00 "Errorflag: Aussetzer Zündung 0" UWORD B_TRUE 1 100 0 1 BIT_MASK 0x1 FUNCTION_LIST DFPM_DMDMIL IF_DATA DIM_X 0x3838D8 EXTERN BYTE IF_DATA MCMESS 0x3838D8 EXTERN /end MEASUREMENT
/begin MEASUREMENT E_md01 "Errorflag: Aussetzer Zündung 1" UWORD B_TRUE 1 100 0 1 BIT_MASK 0x1 FUNCTION_LIST DFPM_DMDMIL IF_DATA DIM_X 0x3838DA EXTERN BYTE IF_DATA MCMESS 0x3838DA EXTERN /end MEASUREMENT
/begin MEASUREMENT E_md02 "Errorflag: Aussetzer Zündung 2" UWORD B_TRUE 1 100 0 1 BIT_MASK 0x1 FUNCTION_LIST DFPM_DMDMIL IF_DATA DIM_X 0x3838DC EXTERN BYTE IF_DATA MCMESS 0x3838DC EXTERN /end MEASUREMENT
/begin MEASUREMENT E_md03 "Errorflag: Aussetzer Zündung 3" UWORD B_TRUE 1 100 0 1 BIT_MASK 0x1 FUNCTION_LIST DFPM_DMDMIL IF_DATA DIM_X 0x3838DE EXTERN BYTE IF_DATA MCMESS 0x3838DE EXTERN /end MEASUREMENT
/begin MEASUREMENT E_md04 "Errorflag: Aussetzer Zündung 4" UWORD B_TRUE 1 100 0 1 BIT_MASK 0x1 FUNCTION_LIST DFPM_DMDMIL IF_DATA DIM_X 0x3838E0 EXTERN BYTE IF_DATA MCMESS 0x3838E0 EXTERN /end MEASUREMENT
/begin MEASUREMENT E_md05 "Errorflag: Aussetzer Zündung 5" UWORD B_TRUE 1 100 0 1 BIT_MASK 0x1 FUNCTION_LIST DFPM_DMDMIL IF_DATA DIM_X 0x3838E2 EXTERN BYTE IF_DATA MCMESS 0x3838E2 EXTERN /end MEASUREMENT
/begin MEASUREMENT E_mdb "Errorflag: Momentenüberwachung begrenzt dauerhaft" UWORD B_TRUE 1 100 0 1 BIT_MASK 0x1 FUNCTION_LIST DFPM_MDKOG IF_DATA DIM_X 0x3838E4 EXTERN BYTE IF_DATA MCMESS 0x3838E4 EXTERN /end MEASUREMENT
/begin MEASUREMENT E_msg "Errorflag: Motorraumspülgebläse" UWORD B_TRUE 1 100 0 1 BIT_MASK 0x1 FUNCTION_LIST DFPM_MLS IF_DATA DIM_X 0x3838E6 EXTERN BYTE IF_DATA MCMESS 0x3838E6 EXTERN /end MEASUREMENT
/begin MEASUREMENT E_msge "Errorflag: Motorraumspülgebläse Endstufe" UWORD B_TRUE 1 100 0 1 BIT_MASK 0x1 FUNCTION_LIST DFPM_DEKON IF_DATA DIM_X 0x3838E8 EXTERN BYTE IF_DATA MCMESS 0x3838E8 EXTERN /end MEASUREMENT
/begin MEASUREMENT E_n "Errorflag: Drehzahlsignalgeber" UWORD B_TRUE 1 100 0 1 BIT_MASK 0x1 FUNCTION_LIST DFPM_DDG STADAP IF_DATA DIM_X 0x3838EA EXTERN BYTE IF_DATA MCMESS 0x3838EA EXTERN /end MEASUREMENT
/begin MEASUREMENT E_nwkw "Errorflag: Zuordnung Nockenwelle zu Kurbelwelle" UWORD B_TRUE 1 100 0 1 BIT_MASK 0x1 FUNCTION_LIST DFPM_DNWKW IF_DATA DIM_X 0x3838EC EXTERN BYTE IF_DATA MCMESS 0x3838EC EXTERN /end MEASUREMENT
/begin MEASUREMENT E_nwkw2 "Errorflag: Zuordnung Nockenwelle 2 zu Kurbelwelle" UWORD B_TRUE 1 100 0 1 BIT_MASK 0x1 FUNCTION_LIST DFPM_DNWKW IF_DATA DIM_X 0x3838EE EXTERN BYTE IF_DATA MCMESS 0x3838EE EXTERN /end MEASUREMENT
/begin MEASUREMENT E_nws "Errorflag: Nockenwellensteuerung" UWORD B_TRUE 1 100 0 1 BIT_MASK 0x1 FUNCTION_LIST DFPM_DNWS IF_DATA DIM_X 0x3838F0 EXTERN BYTE IF_DATA MCMESS 0x3838F0 EXTERN /end MEASUREMENT
/begin MEASUREMENT E_nws2 "Errorflag: Nockenwellensteuerung (Bank 2)" UWORD B_TRUE 1 100 0 1 BIT_MASK 0x1 FUNCTION_LIST DFPM_DNWS IF_DATA DIM_X 0x3838F2 EXTERN BYTE IF_DATA MCMESS 0x3838F2 EXTERN /end MEASUREMENT
/begin MEASUREMENT E_nwse "Errorflag: Nockenwellensteuerungsventil Endstufe" UWORD B_TRUE 1 100 0 1 BIT_MASK 0x1 FUNCTION_LIST DFPM_DEKON IF_DATA DIM_X 0x3838F4 EXTERN BYTE IF_DATA MCMESS 0x3838F4 EXTERN /end MEASUREMENT
/begin MEASUREMENT E_nwse2 "Errorflag: Nockenwellensteuerungsventil Endstufe (Bank 2)" UWORD B_TRUE 1 100 0 1 BIT_MASK 0x1 FUNCTION_LIST DFPM_DEKON IF_DATA DIM_X 0x3838F6 EXTERN BYTE IF_DATA MCMESS 0x3838F6 EXTERN /end MEASUREMENT
/begin MEASUREMENT E_ph "Errorflag: Phasensensor" UWORD B_TRUE 1 100 0 1 BIT_MASK 0x1 FUNCTION_LIST DFPM_DPH STADAP IF_DATA DIM_X 0x3838F8 EXTERN BYTE IF_DATA MCMESS 0x3838F8 EXTERN /end MEASUREMENT
/begin MEASUREMENT E_ph2 "Errorflag: Phasensensor 2" UWORD B_TRUE 1 100 0 1 BIT_MASK 0x1 FUNCTION_LIST DFPM_DPH IF_DATA DIM_X 0x3838FA EXTERN BYTE IF_DATA MCMESS 0x3838FA EXTERN /end MEASUREMENT
/begin MEASUREMENT E_rkat "Errorflag DKVS (additive Korrektur pro Zeit)" UWORD B_TRUE 1 100 0 1 BIT_MASK 0x1 FUNCTION_LIST DFPM_DKVS STADAP IF_DATA DIM_X 0x3838FC EXTERN BYTE IF_DATA MCMESS 0x3838FC EXTERN /end MEASUREMENT
/begin MEASUREMENT E_rkat2 "Errorflag DKVS (additive Korrektur pro Zeit Bank 2)" UWORD B_TRUE 1 100 0 1 BIT_MASK 0x1 FUNCTION_LIST DFPM_DKVS STADAP IF_DATA DIM_X 0x3838FE EXTERN BYTE IF_DATA MCMESS 0x3838FE EXTERN /end MEASUREMENT
/begin MEASUREMENT E_rkaz "Errorflag DKVS (additive Korrektur pro Zündung)" UWORD B_TRUE 1 100 0 1 BIT_MASK 0x1 FUNCTION_LIST DFPM_DKVS IF_DATA DIM_X 0x383900 EXTERN BYTE IF_DATA MCMESS 0x383900 EXTERN /end MEASUREMENT
/begin MEASUREMENT E_rkaz2 "Errorflag DKVS (additive Korrektur pro Zündung Bank 2)" UWORD B_TRUE 1 100 0 1 BIT_MASK 0x1 FUNCTION_LIST DFPM_DKVS IF_DATA DIM_X 0x383902 EXTERN BYTE IF_DATA MCMESS 0x383902 EXTERN /end MEASUREMENT
/begin MEASUREMENT E_sgeep "Errorflag: Steuergerät defekt (EEPROM)" UWORD B_TRUE 1 100 0 1 BIT_MASK 0x1 FUNCTION_LIST DFPM_DSGEEP IF_DATA DIM_X 0x383904 EXTERN BYTE IF_DATA MCMESS 0x383904 EXTERN /end MEASUREMENT
/begin MEASUREMENT E_slpe "Errorflag: Sekundärluftpumpe (Endstufe)" UWORD B_TRUE 1 100 0 1 BIT_MASK 0x1 FUNCTION_LIST DFPM_DEKON DSLSLRS IF_DATA DIM_X 0x383906 EXTERN BYTE IF_DATA MCMESS 0x383906 EXTERN /end MEASUREMENT
/begin MEASUREMENT E_sls "Errorflag: Sekundärluft-System" UWORD B_TRUE 1 100 0 1 BIT_MASK 0x1 FUNCTION_LIST DFPM_DSLSLRS IF_DATA DIM_X 0x383908 EXTERN BYTE IF_DATA MCMESS 0x383908 EXTERN /end MEASUREMENT
/begin MEASUREMENT E_sls2 "Errorflag: Sekundärluft-System Bank 2" UWORD B_TRUE 1 100 0 1 BIT_MASK 0x1 FUNCTION_LIST DFPM_DSLSLRS IF_DATA DIM_X 0x38390A EXTERN BYTE IF_DATA MCMESS 0x38390A EXTERN /end MEASUREMENT
/begin MEASUREMENT E_slv "Errorflag: Sekundärluftventil" UWORD B_TRUE 1 100 0 1 BIT_MASK 0x1 FUNCTION_LIST DFPM_DSLSLRS IF_DATA DIM_X 0x38390C EXTERN BYTE IF_DATA MCMESS 0x38390C EXTERN /end MEASUREMENT
/begin MEASUREMENT E_slv2 "Errorflag: Sekundärluftventil Bank 2" UWORD B_TRUE 1 100 0 1 BIT_MASK 0x1 FUNCTION_LIST DFPM_DSLSLRS IF_DATA DIM_X 0x38390E EXTERN BYTE IF_DATA MCMESS 0x38390E EXTERN /end MEASUREMENT
/begin MEASUREMENT E_slve "Errorflag: Sekundärluftventil (Endstufe)" UWORD B_TRUE 1 100 0 1 BIT_MASK 0x1 FUNCTION_LIST DFPM_DEKON DSLSLRS IF_DATA DIM_X 0x383910 EXTERN BYTE IF_DATA MCMESS 0x383910 EXTERN /end MEASUREMENT
/begin MEASUREMENT E_swe "Errorflag: Beschleunigungssensor der Schlechtwegeerkennung" UWORD B_TRUE 1 100 0 1 BIT_MASK 0x1 FUNCTION_LIST DFPM_BGRBS IF_DATA DIM_X 0x383912 EXTERN BYTE IF_DATA MCMESS 0x383912 EXTERN /end MEASUREMENT
/begin MEASUREMENT E_ta "Errorflag: TANS" UWORD B_TRUE 1 100 0 1 BIT_MASK 0x1 FUNCTION_LIST DFPM_GGTFA DSLSLRS IF_DATA DIM_X 0x383914 EXTERN BYTE IF_DATA MCMESS 0x383914 EXTERN /end MEASUREMENT
/begin MEASUREMENT E_tes "Errorflag: Tankentlüftungssystem" UWORD B_TRUE 1 100 0 1 BIT_MASK 0x1 FUNCTION_LIST DFPM_DTEV DSLSLRS IF_DATA DIM_X 0x383916 EXTERN BYTE IF_DATA MCMESS 0x383916 EXTERN /end MEASUREMENT
/begin MEASUREMENT E_teve "Errorflag: Tankentlüftungsventil Endstufe" UWORD B_TRUE 1 100 0 1 BIT_MASK 0x1 FUNCTION_LIST DFPM_DEKON IF_DATA DIM_X 0x383918 EXTERN BYTE IF_DATA MCMESS 0x383918 EXTERN /end MEASUREMENT
/begin MEASUREMENT E_teve2 "Errorflag: Tankentlüftungsventil Endstufe, Bank 2" UWORD B_TRUE 1 100 0 1 BIT_MASK 0x1 FUNCTION_LIST DFPM_DUMMY043 IF_DATA DIM_X 0x38391A EXTERN BYTE IF_DATA MCMESS 0x38391A EXTERN /end MEASUREMENT
/begin MEASUREMENT E_tget "Errorflag: Getriebetemperatur" UWORD B_TRUE 1 100 0 1 BIT_MASK 0x1 FUNCTION_LIST DFPM_GGTGET IF_DATA DIM_X 0x38391C EXTERN BYTE IF_DATA MCMESS 0x38391C EXTERN /end MEASUREMENT
/begin MEASUREMENT E_thm "Error_flag: Kühlwasser-Thermostat" UWORD B_TRUE 1 100 0 1 BIT_MASK 0x1 FUNCTION_LIST DFPM_GGTFM IF_DATA DIM_X 0x38391E EXTERN BYTE IF_DATA MCMESS 0x38391E EXTERN /end MEASUREMENT
/begin MEASUREMENT E_tm "Errorflag: TMOT" UWORD B_TRUE 1 100 0 1 BIT_MASK 0x1 FUNCTION_LIST DFPM_GGTFM DSLSLRS STADAP IF_DATA DIM_X 0x383920 EXTERN BYTE IF_DATA MCMESS 0x383920 EXTERN /end MEASUREMENT
/begin MEASUREMENT E_tmki "Errorflag: Motortemperatur aus Kombiinstrument" UWORD B_TRUE 1 100 0 1 BIT_MASK 0x1 FUNCTION_LIST DFPM_DUMMY043 IF_DATA DIM_X 0x383922 EXTERN BYTE IF_DATA MCMESS 0x383922 EXTERN /end MEASUREMENT
/begin MEASUREMENT E_tmr "Errorflag: TMR" UWORD B_TRUE 1 100 0 1 BIT_MASK 0x1 FUNCTION_LIST DFPM_GGTFMR IF_DATA DIM_X 0x383924 EXTERN BYTE IF_DATA MCMESS 0x383924 EXTERN /end MEASUREMENT
/begin MEASUREMENT E_tol "Errorflag: Öltemperatur" UWORD B_TRUE 1 100 0 1 BIT_MASK 0x1 FUNCTION_LIST DFPM_GGTFOL IF_DATA DIM_X 0x383926 EXTERN BYTE IF_DATA MCMESS 0x383926 EXTERN /end MEASUREMENT
/begin MEASUREMENT E_tum "Errorflag:  Umgebungstemperatur tumg" UWORD B_TRUE 1 100 0 1 BIT_MASK 0x1 FUNCTION_LIST DFPM_GGTFUMG IF_DATA DIM_X 0x383928 EXTERN BYTE IF_DATA MCMESS 0x383928 EXTERN /end MEASUREMENT
/begin MEASUREMENT E_ub "Errorflag: UB" UWORD B_TRUE 1 100 0 1 BIT_MASK 0x1 FUNCTION_LIST DFPM_GGUB STADAP IF_DATA DIM_X 0x38392A EXTERN BYTE IF_DATA MCMESS 0x38392A EXTERN /end MEASUREMENT
/begin MEASUREMENT E_ufmv "Errorflag: Funktionsüberwachung: Momentenvergleich" UWORD B_TRUE 1 100 0 1 BIT_MASK 0x1 FUNCTION_LIST DFPM_DUF IF_DATA DIM_X 0x38392C EXTERN BYTE IF_DATA MCMESS 0x38392C EXTERN /end MEASUREMENT
/begin MEASUREMENT E_ufska "Errorflag: Funktionsüberwachung: Sicherheits-Kraftstoff-Abschaltung" UWORD B_TRUE 1 100 0 1 BIT_MASK 0x1 FUNCTION_LIST DFPM_DUF IF_DATA DIM_X 0x38392E EXTERN BYTE IF_DATA MCMESS 0x38392E EXTERN /end MEASUREMENT
/begin MEASUREMENT E_urram "Errorflag: Rechnerüberwachung: RAM" UWORD B_TRUE 1 100 0 1 BIT_MASK 0x1 FUNCTION_LIST DFPM_DUR IF_DATA DIM_X 0x383930 EXTERN BYTE IF_DATA MCMESS 0x383930 EXTERN /end MEASUREMENT
/begin MEASUREMENT E_urrom "Errorflag: Rechnerüberwachung: ROM" UWORD B_TRUE 1 100 0 1 BIT_MASK 0x1 FUNCTION_LIST DFPM_DUR IF_DATA DIM_X 0x383932 EXTERN BYTE IF_DATA MCMESS 0x383932 EXTERN /end MEASUREMENT
/begin MEASUREMENT E_urrst "Errorflag: Rechnerüberwachung: Reset" UWORD B_TRUE 1 100 0 1 BIT_MASK 0x1 FUNCTION_LIST DFPM_DUR IF_DATA DIM_X 0x383934 EXTERN BYTE IF_DATA MCMESS 0x383934 EXTERN /end MEASUREMENT
/begin MEASUREMENT E_uvse "Errorflag: Endstufe Umluftventil Turbo" UWORD B_TRUE 1 100 0 1 BIT_MASK 0x1 FUNCTION_LIST DFPM_DEKON IF_DATA DIM_X 0x383936 EXTERN BYTE IF_DATA MCMESS 0x383936 EXTERN /end MEASUREMENT
/begin MEASUREMENT E_vfz "Errorflag: Fahrzeug-Geschwindigkeit" UWORD B_TRUE 1 100 0 1 BIT_MASK 0x1 FUNCTION_LIST DFPM_DVFZ IF_DATA DIM_X 0x383938 EXTERN BYTE IF_DATA MCMESS 0x383938 EXTERN /end MEASUREMENT
/begin MEASUREMENT E_vs01 "Errorflag: Ventilhubsteuerung Zdg.1" UWORD B_TRUE 1 100 0 1 BIT_MASK 0x1 FUNCTION_LIST DFPM_DVS IF_DATA DIM_X 0x38393A EXTERN BYTE IF_DATA MCMESS 0x38393A EXTERN /end MEASUREMENT
/begin MEASUREMENT E_vs02 "Errorflag: Ventilhubsteuerung Zdg.2" UWORD B_TRUE 1 100 0 1 BIT_MASK 0x1 FUNCTION_LIST DFPM_DVS IF_DATA DIM_X 0x38393C EXTERN BYTE IF_DATA MCMESS 0x38393C EXTERN /end MEASUREMENT
/begin MEASUREMENT E_vs03 "Errorflag: Ventilhubsteuerung Zdg.3" UWORD B_TRUE 1 100 0 1 BIT_MASK 0x1 FUNCTION_LIST DFPM_DVS IF_DATA DIM_X 0x38393E EXTERN BYTE IF_DATA MCMESS 0x38393E EXTERN /end MEASUREMENT
/begin MEASUREMENT E_vs04 "Errorflag: Ventilhubsteuerung Zdg.4" UWORD B_TRUE 1 100 0 1 BIT_MASK 0x1 FUNCTION_LIST DFPM_DVS IF_DATA DIM_X 0x383940 EXTERN BYTE IF_DATA MCMESS 0x383940 EXTERN /end MEASUREMENT
/begin MEASUREMENT E_vs05 "Errorflag: Ventilhubsteuerung Zdg.5" UWORD B_TRUE 1 100 0 1 BIT_MASK 0x1 FUNCTION_LIST DFPM_DVS IF_DATA DIM_X 0x383942 EXTERN BYTE IF_DATA MCMESS 0x383942 EXTERN /end MEASUREMENT
/begin MEASUREMENT E_vs06 "Errorflag: Ventilhubsteuerung Zdg.6" UWORD B_TRUE 1 100 0 1 BIT_MASK 0x1 FUNCTION_LIST DFPM_DVS IF_DATA DIM_X 0x383944 EXTERN BYTE IF_DATA MCMESS 0x383944 EXTERN /end MEASUREMENT
/begin MEASUREMENT E_vs1e "Error Flag: Endstufe Ventilhubsteuerung 1" UWORD B_TRUE 1 100 0 1 BIT_MASK 0x1 FUNCTION_LIST DFPM_DEKON IF_DATA DIM_X 0x383946 EXTERN BYTE IF_DATA MCMESS 0x383946 EXTERN /end MEASUREMENT
/begin COMPU_METHOD B_TRUE "boolsche Zustände, positive Logik" TAB_VERB "%6.3" "" COMPU_TAB_REF B_TRUE /end COMPU_METHOD
/begin COMPU_VTAB B_TRUE "boolsche Zustände, positive Logik" TAB_VERB 2 0 "----" 1 "TRUE" /end COMPU_VTAB
/begin COMPU_METHOD dez "1 : 1 Umrechnug (dez/hex)" RAT_FUNC "%6.2" "" COEFFS 0 1 0 0 0 1 /end COMPU_METHOD
/begin COMPU_METHOD dtsegn_b11p25divZyl "" RAT_FUNC "%6.4" "grad/KW" COEFFS 0 68.2667 0 0 0 1 /end COMPU_METHOD
/begin COMPU_METHOD fak_q0p0195 "" RAT_FUNC "%6.4" "-" COEFFS 0 256 0 0 0 5 /end COMPU_METHOD
/begin COMPU_METHOD fak_sb_b1 "" RAT_FUNC "%6.4" "-" COEFFS 0 256 0 0 0 2 /end COMPU_METHOD
/begin COMPU_METHOD fak_sw_b1 "" RAT_FUNC "%7.6" "-" COEFFS 0 65536 0 0 0 2 /end COMPU_METHOD
/begin COMPU_METHOD fak_sw_b8 "" RAT_FUNC "%6.5" "-" COEFFS 0 65536 0 0 0 16 /end COMPU_METHOD
/begin COMPU_METHOD fak_ub_b0p1_o0p05 "" RAT_FUNC "%8.7" "-" COEFFS 0 256 12.8 0 0 0.1 /end COMPU_METHOD
/begin COMPU_METHOD fak_ub_b0p5 "" RAT_FUNC "%6.4" "-" COEFFS 0 256 0 0 0 0.5 /end COMPU_METHOD
/begin COMPU_METHOD fak_ub_b16 "" RAT_FUNC "%6.4" "-" COEFFS 0 256 0 0 0 16 /end COMPU_METHOD
/begin COMPU_METHOD fak_ub_b2 "" RAT_FUNC "%6.4" "-" COEFFS 0 256 0 0 0 2 /end COMPU_METHOD
/begin COMPU_METHOD fak_uw_b16 "" RAT_FUNC "%6.5" "-" COEFFS 0 65536 0 0 0 16 /end COMPU_METHOD
/begin COMPU_METHOD fak_uw_b2 "" RAT_FUNC "%7.6" "-" COEFFS 0 65536 0 0 0 2 /end COMPU_METHOD
/begin COMPU_METHOD kw_q0p0156 "" RAT_FUNC "%6.4" "°KW" COEFFS 0 64 0 0 0 1 /end COMPU_METHOD
/begin COMPU_METHOD kw_q4 "" RAT_FUNC "%6.2" "°KW" COEFFS 0 1 0 0 0 4 /end COMPU_METHOD
/begin COMPU_METHOD luquant "Umrechnung Laufunruhe in DMD" RAT_FUNC "%6.2" "(Umdr./sec)^2" COEFFS 0 0.549756 0 0 0 1 /end COMPU_METHOD
/begin COMPU_METHOD m_q0p0031 "" RAT_FUNC "%6.4" "kg/h" COEFFS 0 320 0 0 0 1 /end COMPU_METHOD
/begin COMPU_METHOD m_q0p1 "" RAT_FUNC "%6.3" "kg/h" COEFFS 0 10 0 0 0 1 /end COMPU_METHOD
/begin COMPU_METHOD nmotd_sb_q10 "" RAT_FUNC "%6.1" "U/min" COEFFS 0 1 0 0 0 10 /end COMPU_METHOD
/begin COMPU_METHOD nmot_sb_q20 "" RAT_FUNC "%6.1" "U/min" COEFFS 0 1 0 0 0 20 /end COMPU_METHOD
/begin COMPU_METHOD nmot_sw_q0p25 "" RAT_FUNC "%6.3" "U/min" COEFFS 0 1 0 0 0 0.25 /end COMPU_METHOD
/begin COMPU_METHOD nmot_ub_q40 "" RAT_FUNC "%6.1" "Upm" COEFFS 0 1 0 0 0 40 /end COMPU_METHOD
/begin COMPU_METHOD nmot_uw_q0p25 "" RAT_FUNC "%6.3" "U/min" COEFFS 0 1 0 0 0 0.25 /end COMPU_METHOD
/begin COMPU_METHOD perio_sw_b1p562 "" RAT_FUNC "%7.6" "1/s" COEFFS 0 65536 0 0 0 3.124 /end COMPU_METHOD
/begin COMPU_METHOD perio_sw_b6p125 "" RAT_FUNC "%6.5" "1/s" COEFFS 0 65536 0 0 0 12.25 /end COMPU_METHOD
/begin COMPU_METHOD p_sw_q0p039 "" RAT_FUNC "%6.4" "hPa" COEFFS 0 256 0 0 0 10 /end COMPU_METHOD
/begin COMPU_METHOD p_sw_q0p078 "" RAT_FUNC "%6.4" "hPa" COEFFS 0 65536 0 0 0 5120 /end COMPU_METHOD
/begin COMPU_METHOD p_uw_q0p039 "" RAT_FUNC "%6.4" "hPa" COEFFS 0 256 0 0 0 10 /end COMPU_METHOD
/begin COMPU_METHOD relDK_q0p02441 "" RAT_FUNC "%6.4" "% DK" COEFFS 0 65536 0 0 0 1600 /end COMPU_METHOD
/begin COMPU_METHOD relDK_q0p0625 "" RAT_FUNC "%6.4" "%PWM/%DK" COEFFS 0 16 0 0 0 1 /end COMPU_METHOD
/begin COMPU_METHOD relDK_q1 "" RAT_FUNC "%6.2" "%PWM/%DK" COEFFS 0 1 0 0 0 1 /end COMPU_METHOD
/begin COMPU_METHOD relDK_q4 "" RAT_FUNC "%6.2" "%PWM/%DK" COEFFS 0 1 0 0 0 4 /end COMPU_METHOD
/begin COMPU_METHOD relDK_uw_b100 "" RAT_FUNC "%6.4" "% DK" COEFFS 0 65535 0 0 0 100 /end COMPU_METHOD
/begin COMPU_METHOD relNWU_q0p0234 "" RAT_FUNC "%6.4" "%/NWU" COEFFS 0 32 0 0 0 0.75 /end COMPU_METHOD
/begin COMPU_METHOD rel_q0p1957 "" RAT_FUNC "%6.3" "%" COEFFS 0 511 0 0 0 100 /end COMPU_METHOD
/begin COMPU_METHOD rel_sb_q0p39 "" RAT_FUNC "%6.3" "%" COEFFS 0 1 0 0 0 0.3906 /end COMPU_METHOD
/begin COMPU_METHOD rel_sw_b100 "" RAT_FUNC "%6.4" "%" COEFFS 0 32768 0 0 0 100 /end COMPU_METHOD
/begin COMPU_METHOD rel_sw_b50 "" RAT_FUNC "%6.4" "%" COEFFS 0 65536 0 0 0 100 /end COMPU_METHOD
/begin COMPU_METHOD rel_sw_q0p0234 "" RAT_FUNC "%6.4" "%/seg" COEFFS 0 32 0 0 0 0.75 /end COMPU_METHOD
/begin COMPU_METHOD rel_sw_q0p1875 "" RAT_FUNC "%6.3" "%" COEFFS 0 65536 0 0 0 12288 /end COMPU_METHOD
/begin COMPU_METHOD rel_sw_q0p1953 "" RAT_FUNC "%6.3" "%" COEFFS 0 65536 0 0 0 12800 /end COMPU_METHOD
/begin COMPU_METHOD rel_ub_b100 "" RAT_FUNC "%6.3" "%" COEFFS 0 256 0 0 0 100 /end COMPU_METHOD
/begin COMPU_METHOD rel_ub_b127p5 "" RAT_FUNC "%6.3" "%" COEFFS 0 2 0 0 0 1 /end COMPU_METHOD
/begin COMPU_METHOD rel_ub_b99p6 "" RAT_FUNC "%6.3" "%" COEFFS 0 256 0 0 0 100 /end COMPU_METHOD
/begin COMPU_METHOD rel_ub_q0p75 "" RAT_FUNC "%6.3" "%" COEFFS 0 1 0 0 0 0.75 /end COMPU_METHOD
/begin COMPU_METHOD rel_uw_b100 "" RAT_FUNC "%6.4" "%" COEFFS 0 65536 0 0 0 100 /end COMPU_METHOD
/begin COMPU_METHOD rel_uw_b200 "" RAT_FUNC "%6.4" "%" COEFFS 0 65536 0 0 0 200 /end COMPU_METHOD
/begin COMPU_METHOD rel_uw_b40 "" RAT_FUNC "%6.5" "%" COEFFS 0 65536 0 0 0 40 /end COMPU_METHOD
/begin COMPU_METHOD rel_uw_q0p0234 "" RAT_FUNC "%6.4" "%" COEFFS 0 32 0 0 0 0.75 /end COMPU_METHOD
/begin COMPU_METHOD rel_uw_q0p1875 "" RAT_FUNC "%6.3" "%" COEFFS 0 65536 0 0 0 12288 /end COMPU_METHOD
/begin COMPU_METHOD runtime2_sy "" RAT_FUNC "%6.1" "us" COEFFS 0 0.09375 0 0 0 1 /end COMPU_METHOD
/begin COMPU_METHOD spg_ubatt "" RAT_FUNC "%6.4" "V" COEFFS 0 1 0 0 0 0.076 /end COMPU_METHOD
/begin COMPU_METHOD t10msxs_ub_b2p55 "" RAT_FUNC "%6.4" "s" COEFFS 0 1 0 0 0 0.01 /end COMPU_METHOD
/begin COMPU_METHOD t10msxs_uw_b655p35 "" RAT_FUNC "%6.4" "s" COEFFS 0 1 0 0 0 0.01 /end COMPU_METHOD
/begin COMPU_METHOD t20msxs_ub_b5p1 "" RAT_FUNC "%6.4" "s" COEFFS 0 1 0 0 0 0.02 /end COMPU_METHOD
/begin COMPU_METHOD t50msxs_q0p05 "" RAT_FUNC "%6.4" "s" COEFFS 0 1 0 0 0 0.05 /end COMPU_METHOD
/begin COMPU_METHOD t50msxs_uw_b3276p75 "" RAT_FUNC "%6.4" "s" COEFFS 0 1 0 0 0 0.05 /end COMPU_METHOD
/begin COMPU_METHOD t5usxus_q5 "" RAT_FUNC "%6.2" "us" COEFFS 0 1 0 0 0 5 /end COMPU_METHOD
/begin COMPU_METHOD temp_sw_q0p75 "" RAT_FUNC "%6.3" "Grad C" COEFFS 0 4 0 0 0 3 /end COMPU_METHOD
/begin COMPU_METHOD t_wdt_high "" RAT_FUNC "%6.2" "ms" COEFFS 0 0.732422 0 0 0 1 /end COMPU_METHOD
/begin COMPU_METHOD vfzg_sw_q0p00781 "" RAT_FUNC "%6.4" "km/h" COEFFS 0 1 0 0 0 0.0078125 /end COMPU_METHOD
/begin COMPU_METHOD vfzg_uw_b325 "" RAT_FUNC "%6.4" "km/h" COEFFS 0 65536 0 0 0 325 /end COMPU_METHOD
/begin COMPU_METHOD vfzg_uw_b512 "" RAT_FUNC "%6.4" "km/h" COEFFS 0 65536 0 0 0 512 /end COMPU_METHOD
/begin COMPU_METHOD vfzg_uw_q0p00781 "" RAT_FUNC "%6.4" "km/h" COEFFS 0 1 0 0 0 0.0078125 /end COMPU_METHOD
/begin COMPU_METHOD zw_sb_q0p75 "" RAT_FUNC "%6.3" "grad KW" COEFFS 0 255 0 0 0 191.25 /end COMPU_METHOD
/begin COMPU_METHOD zw_ub_q0p75 "" RAT_FUNC "%6.3" "Grad KW" COEFFS 0 255 0 0 0 191.25 /end COMPU_METHOD
/begin COMPU_METHOD zw_ub_qn0p75 "" RAT_FUNC "%6.4" "grad KW" COEFFS 0 1 0 0 0 -0.75 /end COMPU_METHOD
/end MODULE
/end PROJECT
