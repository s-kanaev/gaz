/begin PROJECT _7804367 "156"
/begin HEADER "" VERSION "_7804367" PROJECT_NO _7804367 /end HEADER
/begin MODULE DIM ""
/begin MOD_COMMON "" BYTE_ORDER BIG_ENDIAN S_REC_LAYOUT DAMOS /end MOD_COMMON
/begin MEASUREMENT fwez7 "Faktor Wiedereinsetzmenge zylinderindividuell Zyl. 8" UBYTE fak_ub_b2 1 100 0 1.99219 FUNCTION_LIST ACIFI IF_DATA DIM_X 0xFA5D INTERN WORD IF_DATA MCMESS 0xFA5D INTERN /end MEASUREMENT
/begin MEASUREMENT fwl "Faktor Warmlauf" UBYTE fak_ub_b2 1 100 0 1.99219 FUNCTION_LIST ESWL GK IF_DATA DIM_X 0x380B3F EXTERN WORD IF_DATA MCMESS 0x380B3F EXTERN /end MEASUREMENT
/begin MEASUREMENT fwmlhfm_w "gewichteter MLHFMMN in Abhängigkeit von Faktor Höhe" UWORD m_q0p1 1 100 0 6553.5 FUNCTION_LIST DHFM IF_DATA DIM_X 0x382072 EXTERN WORD IF_DATA MCMESS 0x382072 EXTERN /end MEASUREMENT
/begin MEASUREMENT fwnws "Gemischfaktor Nockenwellensteuerung" UBYTE fak_ub_b4 1 100 0 3.98438 FUNCTION_LIST ESNWS GK IF_DATA DIM_X 0x380B25 EXTERN WORD IF_DATA MCMESS 0x380B25 EXTERN /end MEASUREMENT
/begin MEASUREMENT fwprs_w "Faktor Preadiktionswinkel bezogen auf Segment" UWORD fak_uw_b32 1 100 0 31.9995 FUNCTION_LIST BGRLP IF_DATA DIM_X 0x382202 EXTERN WORD IF_DATA MCMESS 0x382202 EXTERN /end MEASUREMENT
/begin MEASUREMENT fwrldk_w "Faktor Wichtung relative Luftfüllung aus Dk-Signal" UWORD fak_uw_b2 1 100 0 1.99997 FUNCTION_LIST BGMSZS IF_DATA DIM_X 0x381FFC EXTERN WORD IF_DATA MCMESS 0x381FFC EXTERN /end MEASUREMENT
/begin MEASUREMENT fwvs "Gemischfaktor Ventilhubsteuerung" UBYTE fak_ub_b4 1 100 0 3.98438 FUNCTION_LIST esvs GK IF_DATA DIM_X 0x380CD9 EXTERN WORD IF_DATA MCMESS 0x380CD9 EXTERN /end MEASUREMENT
/begin MEASUREMENT fzabgs_w "Fehlerzähler Summe, zählt abgasrelevante Aussetzer über alle Zylinder" UWORD dez 1 100 0 65535 FUNCTION_LIST DMDMIL IF_DATA DIM_X 0x3819C4 EXTERN WORD IF_DATA MCMESS 0x3819C4 EXTERN /end MEASUREMENT
/begin MEASUREMENT fzabg_w_0__A "Aussetzerzähler" UWORD dez 1 100 0 65535 FUNCTION_LIST DMDMIL T2LID IF_DATA DIM_X 0x3819C6 EXTERN WORD IF_DATA MCMESS 0x3819C6 EXTERN /end MEASUREMENT
/begin MEASUREMENT fzabg_w_1__A "Aussetzerzähler" UWORD dez 1 100 0 65535 FUNCTION_LIST DMDMIL T2LID IF_DATA DIM_X 0x3819C8 EXTERN WORD IF_DATA MCMESS 0x3819C8 EXTERN /end MEASUREMENT
/begin MEASUREMENT fzabg_w_2__A "Aussetzerzähler" UWORD dez 1 100 0 65535 FUNCTION_LIST DMDMIL T2LID IF_DATA DIM_X 0x3819CA EXTERN WORD IF_DATA MCMESS 0x3819CA EXTERN /end MEASUREMENT
/begin MEASUREMENT fzabg_w_3__A "Aussetzerzähler" UWORD dez 1 100 0 65535 FUNCTION_LIST DMDMIL T2LID IF_DATA DIM_X 0x3819CC EXTERN WORD IF_DATA MCMESS 0x3819CC EXTERN /end MEASUREMENT
/begin MEASUREMENT fzabg_w_4__A "Aussetzerzähler" UWORD dez 1 100 0 65535 FUNCTION_LIST DMDMIL T2LID IF_DATA DIM_X 0x3819CE EXTERN WORD IF_DATA MCMESS 0x3819CE EXTERN /end MEASUREMENT
/begin MEASUREMENT fzabg_w_5__A "Aussetzerzähler" UWORD dez 1 100 0 65535 FUNCTION_LIST DMDMIL T2LID IF_DATA DIM_X 0x3819D0 EXTERN WORD IF_DATA MCMESS 0x3819D0 EXTERN /end MEASUREMENT
/begin MEASUREMENT fzans1 "Faktor Abregelung Nachstart ohne Berücksichtigung des Startmengenadaptionswerts" UBYTE fak_ub_b0p25 1 100 0 0.249023 FUNCTION_LIST ESNST IF_DATA DIM_X 0x380B20 EXTERN WORD IF_DATA MCMESS 0x380B20 EXTERN /end MEASUREMENT
/begin MEASUREMENT fzans2 "Faktor Abregelung Nachstart mit Berücksichtigung des Startmengenadaptionswerts" UBYTE fak_ub_b0p25 1 100 0 0.249023 FUNCTION_LIST ESNST IF_DATA DIM_X 0x380B21 EXTERN WORD IF_DATA MCMESS 0x380B21 EXTERN /end MEASUREMENT
/begin MEASUREMENT fzarv_w "Fehlerzähler, zählt Aussetzer über alle Zylinder" UWORD dez 1 100 0 65535 FUNCTION_LIST DMDMIL IF_DATA DIM_X 0x3819D2 EXTERN WORD IF_DATA MCMESS 0x3819D2 EXTERN /end MEASUREMENT
/begin MEASUREMENT fzkats1_w "Fehlerzähler Summe Bank 1, zählt katschädigende Aussetzer über alle Zyl. Bank 1" UWORD dez 1 100 0 65535 FUNCTION_LIST DMDMIL IF_DATA DIM_X 0x3819D4 EXTERN WORD IF_DATA MCMESS 0x3819D4 EXTERN /end MEASUREMENT
/begin MEASUREMENT fzkats2_w "Fehlerzähler Summe Bank 2, zählt katschädigende Aussetzer über alle Zyl. Bank 2" UWORD dez 1 100 0 65535 FUNCTION_LIST DMDMIL IF_DATA DIM_X 0x3819D6 EXTERN WORD IF_DATA MCMESS 0x3819D6 EXTERN /end MEASUREMENT
/begin MEASUREMENT fzkats_w "Fehlerzähler Summe, zählt katschädigende Aussetzer über alle Zylinder" UWORD dez 1 100 0 65535 FUNCTION_LIST DMDMIL IF_DATA DIM_X 0x3819D8 EXTERN WORD IF_DATA MCMESS 0x3819D8 EXTERN /end MEASUREMENT
/begin MEASUREMENT fzkat_w_0__A "" UWORD dez 1 100 0 65535 FUNCTION_LIST DMDMIL IF_DATA DIM_X 0x3819DA EXTERN WORD IF_DATA MCMESS 0x3819DA EXTERN /end MEASUREMENT
/begin MEASUREMENT fzkat_w_1__A "" UWORD dez 1 100 0 65535 FUNCTION_LIST DMDMIL IF_DATA DIM_X 0x3819DC EXTERN WORD IF_DATA MCMESS 0x3819DC EXTERN /end MEASUREMENT
/begin MEASUREMENT fzkat_w_2__A "" UWORD dez 1 100 0 65535 FUNCTION_LIST DMDMIL IF_DATA DIM_X 0x3819DE EXTERN WORD IF_DATA MCMESS 0x3819DE EXTERN /end MEASUREMENT
/begin MEASUREMENT fzkat_w_3__A "" UWORD dez 1 100 0 65535 FUNCTION_LIST DMDMIL IF_DATA DIM_X 0x3819E0 EXTERN WORD IF_DATA MCMESS 0x3819E0 EXTERN /end MEASUREMENT
/begin MEASUREMENT fzkat_w_4__A "" UWORD dez 1 100 0 65535 FUNCTION_LIST DMDMIL IF_DATA DIM_X 0x3819E2 EXTERN WORD IF_DATA MCMESS 0x3819E2 EXTERN /end MEASUREMENT
/begin MEASUREMENT fzkat_w_5__A "" UWORD dez 1 100 0 65535 FUNCTION_LIST DMDMIL IF_DATA DIM_X 0x3819E4 EXTERN WORD IF_DATA MCMESS 0x3819E4 EXTERN /end MEASUREMENT
/begin MEASUREMENT fzmd_0_A "" UWORD dez 1 100 0 65535 FUNCTION_LIST DMDMIL T2LID IF_DATA DIM_X 0x383528 EXTERN WORD IF_DATA MCMESS 0x383528 EXTERN /end MEASUREMENT
/begin MEASUREMENT fzmd_1_A "" UWORD dez 1 100 0 65535 FUNCTION_LIST DMDMIL T2LID IF_DATA DIM_X 0x38352A EXTERN WORD IF_DATA MCMESS 0x38352A EXTERN /end MEASUREMENT
/begin MEASUREMENT fzmd_2_A "" UWORD dez 1 100 0 65535 FUNCTION_LIST DMDMIL T2LID IF_DATA DIM_X 0x38352C EXTERN WORD IF_DATA MCMESS 0x38352C EXTERN /end MEASUREMENT
/begin MEASUREMENT fzmd_3_A "" UWORD dez 1 100 0 65535 FUNCTION_LIST DMDMIL T2LID IF_DATA DIM_X 0x38352E EXTERN WORD IF_DATA MCMESS 0x38352E EXTERN /end MEASUREMENT
/begin MEASUREMENT fzmd_4_A "" UWORD dez 1 100 0 65535 FUNCTION_LIST DMDMIL T2LID IF_DATA DIM_X 0x383530 EXTERN WORD IF_DATA MCMESS 0x383530 EXTERN /end MEASUREMENT
/begin MEASUREMENT fzmd_5_A "" UWORD dez 1 100 0 65535 FUNCTION_LIST DMDMIL T2LID IF_DATA DIM_X 0x383532 EXTERN WORD IF_DATA MCMESS 0x383532 EXTERN /end MEASUREMENT
/begin MEASUREMENT gangauti "bei Automatikgetriebe über CAN empfangener aktueller Gang" UBYTE dez 1 100 0 255 FUNCTION_LIST CAN BBGANG IF_DATA DIM_X 0x38095B EXTERN WORD IF_DATA MCMESS 0x38095B EXTERN /end MEASUREMENT
/begin MEASUREMENT gangi "Ist-Gang" UBYTE dez 1 100 0 255 FUNCTION_LIST BBGANG ARMD BBFGR BBSAWE DFFT DFFTK DKUPPL DMDSTP FGRAUS FGRMD LLRBB MDBGRG MDBGV MDFAW MDMIN MDWAN NMAXMD NWS SSTBER87 T2LID VS IF_DATA DIM_X 0x380AA0 EXTERN WORD IF_DATA MCMESS 0x380AA0 EXTERN /end MEASUREMENT
/begin MEASUREMENT gaptooth "Stand des Zahnzählers zur Lückenabfrage" UBYTE dez 1 100 0 255 FUNCTION_LIST GGDPG IF_DATA DIM_X 0xF9D3 INTERN WORD IF_DATA MCMESS 0xF9D3 INTERN /end MEASUREMENT
/begin MEASUREMENT ggairblokBits01 "" UBYTE dez 1 100 0 255 FUNCTION_LIST GGAIRB IF_DATA DIM_X 0x380D21 EXTERN WORD IF_DATA MCMESS 0x380D21 EXTERN /end MEASUREMENT
/begin MEASUREMENT GgdsasNvBits "" UBYTE dez 1 100 0 255 FUNCTION_LIST GGDSAS IF_DATA DIM_X 0x382FFE EXTERN WORD IF_DATA MCMESS 0x382FFE EXTERN /end MEASUREMENT
/begin MEASUREMENT ggfgrhLokBits "" UBYTE dez 1 100 0 255 FUNCTION_LIST GGFGRH IF_DATA DIM_X 0x380ADC EXTERN WORD IF_DATA MCMESS 0x380ADC EXTERN /end MEASUREMENT
/begin MEASUREMENT GGFSTBits "" UBYTE dez 1 100 0 255 FUNCTION_LIST GGFST IF_DATA DIM_X 0x382FF5 EXTERN WORD IF_DATA MCMESS 0x382FF5 EXTERN /end MEASUREMENT
/begin MEASUREMENT GGFSTNonvolatileBits "" UBYTE dez 1 100 0 255 FUNCTION_LIST GGFST IF_DATA DIM_X 0x382FF6 EXTERN WORD IF_DATA MCMESS 0x382FF6 EXTERN /end MEASUREMENT
/begin MEASUREMENT GGLSUBits "" UBYTE dez 1 100 0 255 FUNCTION_LIST GGLSU IF_DATA DIM_X 0x380A8C EXTERN WORD IF_DATA MCMESS 0x380A8C EXTERN /end MEASUREMENT
/begin MEASUREMENT GGPEDlokbits "" UWORD dez 1 100 0 65535 FUNCTION_LIST GGPED IF_DATA DIM_X 0x381EBC EXTERN WORD IF_DATA MCMESS 0x381EBC EXTERN /end MEASUREMENT
/begin MEASUREMENT GGPEDlokbits2 "" UBYTE dez 1 100 0 255 FUNCTION_LIST GGPED IF_DATA DIM_X 0x380AC2 EXTERN WORD IF_DATA MCMESS 0x380AC2 EXTERN /end MEASUREMENT
/begin MEASUREMENT GGPEDnonVolbits "" UBYTE dez 1 100 0 255 FUNCTION_LIST GGPED IF_DATA DIM_X 0x382FF8 EXTERN WORD IF_DATA MCMESS 0x382FF8 EXTERN /end MEASUREMENT
/begin MEASUREMENT ggtfumgLokbits "" UBYTE dez 1 100 0 255 FUNCTION_LIST GGTFUMG IF_DATA DIM_X 0x380B66 EXTERN WORD IF_DATA MCMESS 0x380B66 EXTERN /end MEASUREMENT
/begin MEASUREMENT grdpssol_w "Gradient des Soll-Saugrohrdrucks (Word)" SWORD dez 1 100 -32768 32767 FUNCTION_LIST BGMSZS IF_DATA DIM_X 0x381FFE EXTERN WORD IF_DATA MCMESS 0x381FFE EXTERN /end MEASUREMENT
/begin MEASUREMENT gwdkdlr_w "Änderung des Drosselklappen-Sollwinkels, Betrag für Kennlinieneingang" SWORD relDK_q0p00152 1 100 -50 49.9985 FUNCTION_LIST ADVE IF_DATA DIM_X 0xFA30 INTERN WORD IF_DATA MCMESS 0xFA30 INTERN /end MEASUREMENT
/begin MEASUREMENT gwdk_kge "Änderung des Drosselklappen-Sollwinkels, Betrag für Kennlinieneingang" UWORD relDK_q0p00152 1 100 0 99.9985 FUNCTION_LIST ADVE IF_DATA DIM_X 0x381E60 EXTERN WORD IF_DATA MCMESS 0x381E60 EXTERN /end MEASUREMENT
/begin MEASUREMENT hlsukor "Korrekturfaktor für die LSU-Heizung" UBYTE fak_ub_b2 1 100 0 1.99219 FUNCTION_LIST HLSU IF_DATA DIM_X 0x3830C7 EXTERN WORD IF_DATA MCMESS 0x3830C7 EXTERN /end MEASUREMENT
/begin MEASUREMENT hlsukor2 "Korrekturfaktor für die LSU-Heizung Bank 2" UBYTE fak_ub_b2 1 100 0 1.99219 FUNCTION_LIST HLSU IF_DATA DIM_X 0x3830C8 EXTERN WORD IF_DATA MCMESS 0x3830C8 EXTERN /end MEASUREMENT
/begin MEASUREMENT h_gCtr_0__A "" UBYTE dez 1 100 0 255 FUNCTION_LIST DVS IF_DATA DIM_X 0x380CF4 EXTERN WORD IF_DATA MCMESS 0x380CF4 EXTERN /end MEASUREMENT
/begin MEASUREMENT h_gCtr_1__A "" UBYTE dez 1 100 0 255 FUNCTION_LIST DVS IF_DATA DIM_X 0x380CF5 EXTERN WORD IF_DATA MCMESS 0x380CF5 EXTERN /end MEASUREMENT
/begin MEASUREMENT h_gCtr_2__A "" UBYTE dez 1 100 0 255 FUNCTION_LIST DVS IF_DATA DIM_X 0x380CF6 EXTERN WORD IF_DATA MCMESS 0x380CF6 EXTERN /end MEASUREMENT
/begin MEASUREMENT h_gCtr_3__A "" UBYTE dez 1 100 0 255 FUNCTION_LIST DVS IF_DATA DIM_X 0x380CF7 EXTERN WORD IF_DATA MCMESS 0x380CF7 EXTERN /end MEASUREMENT
/begin MEASUREMENT h_gCtr_4__A "" UBYTE dez 1 100 0 255 FUNCTION_LIST DVS IF_DATA DIM_X 0x380CF8 EXTERN WORD IF_DATA MCMESS 0x380CF8 EXTERN /end MEASUREMENT
/begin MEASUREMENT h_gCtr_5__A "" UBYTE dez 1 100 0 255 FUNCTION_LIST DVS IF_DATA DIM_X 0x380CF9 EXTERN WORD IF_DATA MCMESS 0x380CF9 EXTERN /end MEASUREMENT
/begin MEASUREMENT h_kCtr_0__A "" UBYTE dez 1 100 0 255 FUNCTION_LIST DVS IF_DATA DIM_X 0x380CFA EXTERN WORD IF_DATA MCMESS 0x380CFA EXTERN /end MEASUREMENT
/begin MEASUREMENT h_kCtr_1__A "" UBYTE dez 1 100 0 255 FUNCTION_LIST DVS IF_DATA DIM_X 0x380CFB EXTERN WORD IF_DATA MCMESS 0x380CFB EXTERN /end MEASUREMENT
/begin MEASUREMENT h_kCtr_2__A "" UBYTE dez 1 100 0 255 FUNCTION_LIST DVS IF_DATA DIM_X 0x380CFC EXTERN WORD IF_DATA MCMESS 0x380CFC EXTERN /end MEASUREMENT
/begin MEASUREMENT h_kCtr_3__A "" UBYTE dez 1 100 0 255 FUNCTION_LIST DVS IF_DATA DIM_X 0x380CFD EXTERN WORD IF_DATA MCMESS 0x380CFD EXTERN /end MEASUREMENT
/begin MEASUREMENT h_kCtr_4__A "" UBYTE dez 1 100 0 255 FUNCTION_LIST DVS IF_DATA DIM_X 0x380CFE EXTERN WORD IF_DATA MCMESS 0x380CFE EXTERN /end MEASUREMENT
/begin MEASUREMENT h_kCtr_5__A "" UBYTE dez 1 100 0 255 FUNCTION_LIST DVS IF_DATA DIM_X 0x380CFF EXTERN WORD IF_DATA MCMESS 0x380CFF EXTERN /end MEASUREMENT
/begin MEASUREMENT idxfo "Index: Kennzeichnet den aktuellen KF-Bereich" UWORD dez 1 100 0 65535 FUNCTION_LIST DMDFON IF_DATA DIM_X 0x381636 EXTERN WORD IF_DATA MCMESS 0x381636 EXTERN /end MEASUREMENT
/begin MEASUREMENT idxfob "Index: Kennzeichnet den aktuellen KF-Bereich (Drehz., Last)" UBYTE dez 1 100 0 255 FUNCTION_LIST DMDFON IF_DATA DIM_X 0x3809AF EXTERN WORD IF_DATA MCMESS 0x3809AF EXTERN /end MEASUREMENT
/begin MEASUREMENT idxfon "Drehzahlindex für Betriebsbereich der fuel-on Adaption" UBYTE dez 1 100 0 255 FUNCTION_LIST DMDFON IF_DATA DIM_X 0x381636 EXTERN WORD IF_DATA MCMESS 0x381636 EXTERN /end MEASUREMENT
/begin MEASUREMENT idxforl "Lastindex für Betriebsbereich der fuel-on Adaption" UBYTE dez 1 100 0 255 FUNCTION_LIST DMDFON IF_DATA DIM_X 0x381637 EXTERN WORD IF_DATA MCMESS 0x381637 EXTERN /end MEASUREMENT
/begin MEASUREMENT igod_u "Integratorgradient für Nulltest-Diagnose Klopfregelung (1 Byte für Tester)" SBYTE tknockintgrad_sy_u 1 100 -114.432 113.538 FUNCTION_LIST DFFTCNV DFFTK IF_DATA DIM_X 0x3809ED EXTERN WORD IF_DATA MCMESS 0x3809ED EXTERN /end MEASUREMENT
/begin MEASUREMENT igod_w "Integratorgradient für Nulltest-Diagnose Klopfregelung" SWORD tknockintgrad_sy 1 100 -3661.82 3661.71 FUNCTION_LIST GGKS DFFTCNV DKRNT IF_DATA DIM_X 0x382450 EXTERN WORD IF_DATA MCMESS 0x382450 EXTERN /end MEASUREMENT
/begin MEASUREMENT igokr_w "Integratorgradient für Offsetkorrektur Klopfregelung (Word)" SWORD tknockintgrad_sy 1 100 -3661.82 3661.71 FUNCTION_LIST GGKS T2LID IF_DATA DIM_X 0x382452 EXTERN WORD IF_DATA MCMESS 0x382452 EXTERN /end MEASUREMENT
/begin MEASUREMENT ikr_0_A "Integratorwert Klopfregelung offsetkorrigiert" UBYTE spg_ub_b5 1 100 0 4.98047 FUNCTION_LIST GGKS KRKE IF_DATA DIM_X 0xE3F6 INTERN WORD IF_DATA MCMESS 0xE3F6 INTERN /end MEASUREMENT
/begin MEASUREMENT ikr_1_A "Integratorwert Klopfregelung offsetkorrigiert" UBYTE spg_ub_b5 1 100 0 4.98047 FUNCTION_LIST GGKS KRKE IF_DATA DIM_X 0xE3F7 INTERN WORD IF_DATA MCMESS 0xE3F7 INTERN /end MEASUREMENT
/begin MEASUREMENT ikr_2_A "Integratorwert Klopfregelung offsetkorrigiert" UBYTE spg_ub_b5 1 100 0 4.98047 FUNCTION_LIST GGKS KRKE IF_DATA DIM_X 0xE3F8 INTERN WORD IF_DATA MCMESS 0xE3F8 INTERN /end MEASUREMENT
/begin MEASUREMENT ikr_3_A "Integratorwert Klopfregelung offsetkorrigiert" UBYTE spg_ub_b5 1 100 0 4.98047 FUNCTION_LIST GGKS KRKE IF_DATA DIM_X 0xE3F9 INTERN WORD IF_DATA MCMESS 0xE3F9 INTERN /end MEASUREMENT
/begin MEASUREMENT ikr_4_A "Integratorwert Klopfregelung offsetkorrigiert" UBYTE spg_ub_b5 1 100 0 4.98047 FUNCTION_LIST GGKS KRKE IF_DATA DIM_X 0xE3FA INTERN WORD IF_DATA MCMESS 0xE3FA INTERN /end MEASUREMENT
/begin MEASUREMENT ikr_5_A "Integratorwert Klopfregelung offsetkorrigiert" UBYTE spg_ub_b5 1 100 0 4.98047 FUNCTION_LIST GGKS KRKE IF_DATA DIM_X 0xE3FB INTERN WORD IF_DATA MCMESS 0xE3FB INTERN /end MEASUREMENT
/begin MEASUREMENT ikr_6_A "Integratorwert Klopfregelung offsetkorrigiert" UBYTE spg_ub_b5 1 100 0 4.98047 FUNCTION_LIST GGKS KRKE IF_DATA DIM_X 0xE3FC INTERN WORD IF_DATA MCMESS 0xE3FC INTERN /end MEASUREMENT
/begin MEASUREMENT ikr_7_A "Integratorwert Klopfregelung offsetkorrigiert" UBYTE spg_ub_b5 1 100 0 4.98047 FUNCTION_LIST GGKS KRKE IF_DATA DIM_X 0xE3FD INTERN WORD IF_DATA MCMESS 0xE3FD INTERN /end MEASUREMENT
/begin MEASUREMENT ikrma "Integratorwert Klopfregelung Meßfensteranfang" UBYTE spg_ub_b5 1 100 0 4.98047 FUNCTION_LIST GGKS DFFTK DKRNT DKRTP KRKE T2LID IF_DATA DIM_X 0x380B88 EXTERN WORD IF_DATA MCMESS 0x380B88 EXTERN /end MEASUREMENT
/begin MEASUREMENT ikrme_0_A "Integratorwert Klopfregelung Meßfensterende" UBYTE spg_ub_b5 1 100 0 4.98047 FUNCTION_LIST GGKS KRKE IF_DATA DIM_X 0xE3FE INTERN WORD IF_DATA MCMESS 0xE3FE INTERN /end MEASUREMENT
/begin MEASUREMENT ikrme_1_A "Integratorwert Klopfregelung Meßfensterende" UBYTE spg_ub_b5 1 100 0 4.98047 FUNCTION_LIST GGKS KRKE IF_DATA DIM_X 0xE3FF INTERN WORD IF_DATA MCMESS 0xE3FF INTERN /end MEASUREMENT
/begin MEASUREMENT ikrme_2_A "Integratorwert Klopfregelung Meßfensterende" UBYTE spg_ub_b5 1 100 0 4.98047 FUNCTION_LIST GGKS KRKE IF_DATA DIM_X 0xE400 INTERN WORD IF_DATA MCMESS 0xE400 INTERN /end MEASUREMENT
/begin MEASUREMENT ikrme_3_A "Integratorwert Klopfregelung Meßfensterende" UBYTE spg_ub_b5 1 100 0 4.98047 FUNCTION_LIST GGKS KRKE IF_DATA DIM_X 0xE401 INTERN WORD IF_DATA MCMESS 0xE401 INTERN /end MEASUREMENT
/begin MEASUREMENT ikrme_4_A "Integratorwert Klopfregelung Meßfensterende" UBYTE spg_ub_b5 1 100 0 4.98047 FUNCTION_LIST GGKS KRKE IF_DATA DIM_X 0xE402 INTERN WORD IF_DATA MCMESS 0xE402 INTERN /end MEASUREMENT
/begin MEASUREMENT ikrme_5_A "Integratorwert Klopfregelung Meßfensterende" UBYTE spg_ub_b5 1 100 0 4.98047 FUNCTION_LIST GGKS KRKE IF_DATA DIM_X 0xE403 INTERN WORD IF_DATA MCMESS 0xE403 INTERN /end MEASUREMENT
/begin MEASUREMENT ikrme_6_A "Integratorwert Klopfregelung Meßfensterende" UBYTE spg_ub_b5 1 100 0 4.98047 FUNCTION_LIST GGKS KRKE IF_DATA DIM_X 0xE404 INTERN WORD IF_DATA MCMESS 0xE404 INTERN /end MEASUREMENT
/begin MEASUREMENT ikrme_7_A "Integratorwert Klopfregelung Meßfensterende" UBYTE spg_ub_b5 1 100 0 4.98047 FUNCTION_LIST GGKS KRKE IF_DATA DIM_X 0xE405 INTERN WORD IF_DATA MCMESS 0xE405 INTERN /end MEASUREMENT
/begin MEASUREMENT ikrmen "Integratorwert Klopfregelung Meßfensterende Nulltest" UBYTE spg_ub_b5 1 100 0 4.98047 FUNCTION_LIST GGKS IF_DATA DIM_X 0x380B89 EXTERN WORD IF_DATA MCMESS 0x380B89 EXTERN /end MEASUREMENT
/begin MEASUREMENT ikrmet "Integratorwert Klopfregelung Meßfensterende Testimpuls" UBYTE spg_ub_b5 1 100 0 4.98047 FUNCTION_LIST GGKS DFFTK DKRTP T2LID IF_DATA DIM_X 0x380B8A EXTERN WORD IF_DATA MCMESS 0x380B8A EXTERN /end MEASUREMENT
/begin MEASUREMENT ikr_tst "Integratorwert Klopfregelung offsetkorregiert rollierend mit Zyl.zähler" UBYTE spg_ub_b5 1 100 0 4.98047 FUNCTION_LIST GGKS IF_DATA DIM_X 0x380B8B EXTERN WORD IF_DATA MCMESS 0x380B8B EXTERN /end MEASUREMENT
/begin MEASUREMENT ilmlka2_w "Integrator Fettfläche für Katalysator-Ausräumen, Bank 2" UWORD m_uw_b4660 1 100 0 4660.27 FUNCTION_LIST LRSKA IF_DATA DIM_X 0x382954 EXTERN WORD IF_DATA MCMESS 0x382954 EXTERN /end MEASUREMENT
/begin MEASUREMENT ilmlkav2_w "Gewichteter Integrator Fettfläche nach Ende Ausräumen Vorkat, Bank 2" UWORD m_uw_b4660 1 100 0 4660.27 FUNCTION_LIST LRSKA IF_DATA DIM_X 0x382956 EXTERN WORD IF_DATA MCMESS 0x382956 EXTERN /end MEASUREMENT
/begin MEASUREMENT ilmlkav_w "Gewichteter Integrator Fettfläche nach Ende Ausräumen Vorkat" UWORD m_uw_b4660 1 100 0 4660.27 FUNCTION_LIST LRSKA IF_DATA DIM_X 0x382958 EXTERN WORD IF_DATA MCMESS 0x382958 EXTERN /end MEASUREMENT
/begin MEASUREMENT ilmlkax2_w "Fettflächenschwelle gesteuertes Kat-Ausräumen f(tkatm2), Bank 2" UWORD m_uw_b4660 1 100 0 4660.27 FUNCTION_LIST LRSKA IF_DATA DIM_X 0x38295A EXTERN WORD IF_DATA MCMESS 0x38295A EXTERN /end MEASUREMENT
/begin MEASUREMENT ilmlkax_w "Fettflächenschwelle gesteuertes Kat-Ausräumen f(tkatm), Bank 1" UWORD m_uw_b4660 1 100 0 4660.27 FUNCTION_LIST LRSKA IF_DATA DIM_X 0x38295C EXTERN WORD IF_DATA MCMESS 0x38295C EXTERN /end MEASUREMENT
/begin MEASUREMENT ilmlka_w "Integrator Fettfläche für Katalysator-Ausräumen" UWORD m_uw_b4660 1 100 0 4660.27 FUNCTION_LIST LRSKA IF_DATA DIM_X 0x38295E EXTERN WORD IF_DATA MCMESS 0x38295E EXTERN /end MEASUREMENT
/begin MEASUREMENT imlatm "integr. Luftmassenfluss ab Motorstart bis Max.wert" UBYTE m_ub_b23p3 1 100 0 23.2107 FUNCTION_LIST ATM BGTABS ESSTT GGTFM GGTFUMG IF_DATA DIM_X 0x380A3E EXTERN WORD IF_DATA MCMESS 0x380A3E EXTERN /end MEASUREMENT
/begin MEASUREMENT imlatm_w "integr. Luftmassenfluss ab Startende bis max. Wert, (Word)" UWORD m_uw_b23p3 1 100 0 23.3013 FUNCTION_LIST ATM BBKHZ DSLSLRS T2DFA IF_DATA DIM_X 0x381BC2 EXTERN WORD IF_DATA MCMESS 0x381BC2 EXTERN /end MEASUREMENT
/begin MEASUREMENT imlkvszs_w "Zwischenspeicher: Luftmasse nach Auftreten eines DKVS Fehles bei leerem Tank" UWORD m_q0p00355 1 100 0 233.013 FUNCTION_LIST DKVS IF_DATA DIM_X 0x3839B8 EXTERN WORD IF_DATA MCMESS 0x3839B8 EXTERN /end MEASUREMENT
/begin MEASUREMENT imlkvs_w "Luftmasse nach Auftreten eines DKVS Fehles bei leerem Tank" UWORD m_q0p00355 1 100 0 233.013 FUNCTION_LIST DKVS IF_DATA DIM_X 0x382236 EXTERN WORD IF_DATA MCMESS 0x382236 EXTERN /end MEASUREMENT
/begin MEASUREMENT imlpr "Relatives Luftmassenintegral bei Katheizung" UBYTE fak_ub_b1 1 100 0 0.996094 FUNCTION_LIST BBKHZ DSLSLRS LAKH SLS IF_DATA DIM_X 0x380B70 EXTERN WORD IF_DATA MCMESS 0x380B70 EXTERN /end MEASUREMENT
/begin MEASUREMENT imlpr_w "Relatives Luftmassenintegral bei Katheizung (word)" UWORD fak_uw_b1 1 100 0 0.999985 FUNCTION_LIST BBKHZ NWS IF_DATA DIM_X 0x3823E6 EXTERN WORD IF_DATA MCMESS 0x3823E6 EXTERN /end MEASUREMENT
/begin MEASUREMENT imlrsa_w "Luftmasse nach SA für stetige Lambdaregelung" UWORD m_uw_b4660 1 100 0 4660.27 FUNCTION_LIST LRSEB IF_DATA DIM_X 0x382A56 EXTERN WORD IF_DATA MCMESS 0x382A56 EXTERN /end MEASUREMENT
/begin MEASUREMENT imlsla_w "Luftmassenintegral für Einbringen der Sekundärluft" UWORD m_uw_b4660 1 100 0 4660.27 FUNCTION_LIST SLS IF_DATA DIM_X 0x380E9A EXTERN WORD IF_DATA MCMESS 0x380E9A EXTERN /end MEASUREMENT
/begin MEASUREMENT imlsle_w "Luftmassenintegral für Ende der Sekundärluft im Abgas" UWORD m_uw_b4660 1 100 0 4660.27 FUNCTION_LIST SLS IF_DATA DIM_X 0x380E9C EXTERN WORD IF_DATA MCMESS 0x380E9C EXTERN /end MEASUREMENT
/begin MEASUREMENT imsteini "Integral Massenstrom TEV nach längerem TE-Stop" UBYTE m_ub_q0p0444 1 100 0 11.322 FUNCTION_LIST TEB DTEV IF_DATA DIM_X 0x380CBC EXTERN WORD IF_DATA MCMESS 0x380CBC EXTERN /end MEASUREMENT
/begin MEASUREMENT iniRoutineCtr "" UWORD dez 1 100 0 65535 FUNCTION_LIST V7804X_T IF_DATA DIM_X 0x380D32 EXTERN WORD IF_DATA MCMESS 0x380D32 EXTERN /end MEASUREMENT
/begin MEASUREMENT iokkr "Integratoroffsetkorrektur Klopfregelung" UBYTE spg_ub_b5 1 100 0 4.98047 FUNCTION_LIST GGKS IF_DATA DIM_X 0x380B8C EXTERN WORD IF_DATA MCMESS 0x380B8C EXTERN /end MEASUREMENT
/begin MEASUREMENT ipa_c_um "Fehlerzähler für unterer DK-Anschlag im ungültigen Bereich f. d. Funktionsüberw." UBYTE t40ms_ub_b10200 1 100 0 10200 FUNCTION_LIST UFRLC IF_DATA DIM_X 0x382E54 EXTERN WORD IF_DATA MCMESS 0x382E54 EXTERN /end MEASUREMENT
/begin MEASUREMENT iplsu2_w "Pumpstrom IP LSU 2" SWORD i_q0p0039_mA 1 100 -128 127.996 FUNCTION_LIST GGLSU IF_DATA DIM_X 0x381DD0 EXTERN WORD IF_DATA MCMESS 0x381DD0 EXTERN /end MEASUREMENT
/begin MEASUREMENT iplsuvj2_w "Pumpstrom IP LSU2" UWORD dez 1 100 0 65535 FUNCTION_LIST GGLSU TC1MOD IF_DATA DIM_X 0x381DD2 EXTERN WORD IF_DATA MCMESS 0x381DD2 EXTERN /end MEASUREMENT
/begin MEASUREMENT iplsuvj_w "Pumpstrom IP LSU" UWORD dez 1 100 0 65535 FUNCTION_LIST GGLSU TC1MOD IF_DATA DIM_X 0x381DD4 EXTERN WORD IF_DATA MCMESS 0x381DD4 EXTERN /end MEASUREMENT
/begin MEASUREMENT iplsu_w "Pumpstrom IP LSU" SWORD i_q0p0039_mA 1 100 -128 127.996 FUNCTION_LIST GGLSU IF_DATA DIM_X 0x381DD6 EXTERN WORD IF_DATA MCMESS 0x381DD6 EXTERN /end MEASUREMENT
/begin MEASUREMENT ipsn_um "aktive DK-Istwertpoti-Info ohne unteren Anschlag für die Funktionsüberwachung" UBYTE spg_ub_q0p019 1 100 0 4.98047 FUNCTION_LIST UFRLC IF_DATA DIM_X 0x382E55 EXTERN WORD IF_DATA MCMESS 0x382E55 EXTERN /end MEASUREMENT
/begin MEASUREMENT irspsyn "Index für Ringspeicheradressierung tsegrsp_w, nmotrsp_w, rlrsp_w" UBYTE dez 1 100 0 255 FUNCTION_LIST BGNG BGRLG IF_DATA DIM_X 0x380A1D EXTERN WORD IF_DATA MCMESS 0x380A1D EXTERN /end MEASUREMENT
/begin MEASUREMENT iUipoti1_w "ADC-Wert incl. Kanalnummer Drosselklappen-Istwert-Poti 1" UWORD dez 1 100 0 65535 FUNCTION_LIST ADC UFRLC IF_DATA DIM_X 0xF92E INTERN WORD IF_DATA MCMESS 0xF92E INTERN /end MEASUREMENT
/begin MEASUREMENT iUipoti2_w "ADC-Wert incl. Kanalnummer Drosselklappen-Istwert-Poti 2" UWORD dez 1 100 0 65535 FUNCTION_LIST ADC UFRLC IF_DATA DIM_X 0xF92A INTERN WORD IF_DATA MCMESS 0xF92A INTERN /end MEASUREMENT
/begin MEASUREMENT iUrefsp1_w "ADC-Wert incl. Kanalnummer, 5 Volt-Referenzspannung" UWORD dez 1 100 0 65535 FUNCTION_LIST ADC UFSPSC IF_DATA DIM_X 0xF918 INTERN WORD IF_DATA MCMESS 0xF918 INTERN /end MEASUREMENT
/begin MEASUREMENT iUspoti1_w "ADC-Wert incl. Kanalnummer, Sollwertpoti 1" UWORD dez 1 100 0 65535 FUNCTION_LIST ADC UFSPSC URADCC IF_DATA DIM_X 0xF920 INTERN WORD IF_DATA MCMESS 0xF920 INTERN /end MEASUREMENT
/begin MEASUREMENT iUspoti2_w "ADC-Wert incl. Kanalnummer, Sollwertpoti 2" UWORD dez 1 100 0 65535 FUNCTION_LIST ADC UFSPSC IF_DATA DIM_X 0xF91E INTERN WORD IF_DATA MCMESS 0xF91E INTERN /end MEASUREMENT
/begin MEASUREMENT iver "Integratorverstärkung" UBYTE rel_q0p002383 1 100 0 0.607617 FUNCTION_LIST LLRRM IF_DATA DIM_X 0x380C0F EXTERN WORD IF_DATA MCMESS 0x380C0F EXTERN /end MEASUREMENT
/begin MEASUREMENT ivmax "Initialisierungswert Integrator für VMAX-Regelung" SBYTE rel_sb_q0p78 1 100 -99.84 99.06 FUNCTION_LIST VMAXMD IF_DATA DIM_X 0x380C46 EXTERN WORD IF_DATA MCMESS 0x380C46 EXTERN /end MEASUREMENT
/begin MEASUREMENT ivzabg_w "Intervallzähler für abgasrelevante Aussetzer (0-1000 KW-Umdr. bzw. 0-500 NW-Um.)" UWORD dez 1 100 0 65535 FUNCTION_LIST DMDMIL T2LID IF_DATA DIM_X 0x3819E6 EXTERN WORD IF_DATA MCMESS 0x3819E6 EXTERN /end MEASUREMENT
/begin MEASUREMENT ivzaint_w "Intervallzähler für Freigabe ti-Abschaltung (0-200 Kw-Umdr.)" UWORD dez 1 100 0 65535 FUNCTION_LIST DMDMIL IF_DATA DIM_X 0x3819E8 EXTERN WORD IF_DATA MCMESS 0x3819E8 EXTERN /end MEASUREMENT
/begin MEASUREMENT ivzarv_w "Intervallzähler für Aussetzer (0-60 KW-Umdr.), zur Ausblendung weiterer Funktion" UWORD dez 1 100 0 65535 FUNCTION_LIST DMDMIL IF_DATA DIM_X 0x3819EA EXTERN WORD IF_DATA MCMESS 0x3819EA EXTERN /end MEASUREMENT
/begin MEASUREMENT ivzkat_w "Intervallzähler für katschädigende Aussetzer (0-200 Kw-Umdr. bzw. 0-100 NW-Um.)" UWORD dez 1 100 0 65535 FUNCTION_LIST DMDMIL IF_DATA DIM_X 0x3819EC EXTERN WORD IF_DATA MCMESS 0x3819EC EXTERN /end MEASUREMENT
/begin MEASUREMENT iwflsd_w "Initialisierungswert Filter Lastschlagdämpfung" UWORD rel_uw_b100 1 100 0 99.9985 FUNCTION_LIST MDFAW IF_DATA DIM_X 0x38264C EXTERN WORD IF_DATA MCMESS 0x38264C EXTERN /end MEASUREMENT
/begin MEASUREMENT iwmatm2_w "Wärmemenge für Kondenswasser-Taupunktende Abgas/Kat (word) bank2" UWORD q_uw_q0p0566 1 100 0 3712 FUNCTION_LIST ATM IF_DATA DIM_X 0x381BC4 EXTERN WORD IF_DATA MCMESS 0x381BC4 EXTERN /end MEASUREMENT
/begin MEASUREMENT iwmatm_w "Wärmemenge für Kondenswasser-Taupunktende Abgas/Kat (word)" UWORD q_uw_q0p0566 1 100 0 3712 FUNCTION_LIST ATM IF_DATA DIM_X 0x381BC6 EXTERN WORD IF_DATA MCMESS 0x381BC6 EXTERN /end MEASUREMENT
/begin MEASUREMENT kakbmt "Korrekturwert der berechneten Kat-Amplitude abhängig von Luftmasse und Kat.-Temp" UBYTE fak_ub_b2 1 100 0 1.99219 FUNCTION_LIST DKATLRS IF_DATA DIM_X 0x380A5A EXTERN WORD IF_DATA MCMESS 0x380A5A EXTERN /end MEASUREMENT
/begin MEASUREMENT kakbmt2 "Korrekturwert der berechneten Kat-Amplitude, Bank2" UBYTE fak_ub_b2 1 100 0 1.99219 FUNCTION_LIST DKATLRS IF_DATA DIM_X 0x380A5B EXTERN WORD IF_DATA MCMESS 0x380A5B EXTERN /end MEASUREMENT
/begin MEASUREMENT katbf "Signal nach Speicher normiert vergleichbar mit ushk" UBYTE spg_ub_q0p0052_o0p2 1 100 -0.2 1.13 FUNCTION_LIST DKATLRS IF_DATA DIM_X 0x380A6B EXTERN WORD IF_DATA MCMESS 0x380A6B EXTERN /end MEASUREMENT
/begin MEASUREMENT katbf2 "Signal nach Speicher normiert vergleichbar mit ushk2 (stereo 2.Bank)" UBYTE spg_ub_q0p0052_o0p2 1 100 -0.2 1.13 FUNCTION_LIST DKATLRS IF_DATA DIM_X 0x380A6C EXTERN WORD IF_DATA MCMESS 0x380A6C EXTERN /end MEASUREMENT
/begin MEASUREMENT katbfi2_w "Sauerstoff-Anteil vor dem Speicher (Kat-Modell Stereo 2.Bank)" SWORD freq_sw_b512 1 100 -512 511.984 FUNCTION_LIST DKATLRS IF_DATA DIM_X 0x381C54 EXTERN WORD IF_DATA MCMESS 0x381C54 EXTERN /end MEASUREMENT
/begin MEASUREMENT katbfi_w "Sauerstoff-Anteil vor dem Speicher (Kat-Modell)" SWORD freq_sw_b512 1 100 -512 511.984 FUNCTION_LIST DKATLRS T2DFA IF_DATA DIM_X 0x381C56 EXTERN WORD IF_DATA MCMESS 0x381C56 EXTERN /end MEASUREMENT
/begin MEASUREMENT katbfs "Signal nach Speicher (Kat-Modell)" SBYTE fak_sb_b1 1 100 -1 0.992188 FUNCTION_LIST DKATLRS T2DFA IF_DATA DIM_X 0x380A6D EXTERN WORD IF_DATA MCMESS 0x380A6D EXTERN /end MEASUREMENT
/begin MEASUREMENT katbfs2 "Signal nach Speicher (Kat-Modell, Stereo 2.Bank)" SBYTE fak_sb_b1 1 100 -1 0.992188 FUNCTION_LIST DKATLRS IF_DATA DIM_X 0x380A6E EXTERN WORD IF_DATA MCMESS 0x380A6E EXTERN /end MEASUREMENT
/begin MEASUREMENT katbftp "Signal nach Speicher normiert, tiefpaßgefiltert" UBYTE spg_ub_q0p0052 1 100 0 1.33 FUNCTION_LIST DKATLRS IF_DATA DIM_X 0x380A6F EXTERN WORD IF_DATA MCMESS 0x380A6F EXTERN /end MEASUREMENT
/begin MEASUREMENT katbftp2 "Signal nach Speicher normiert, tiefpaßgefiltert (Bank2)" UBYTE spg_ub_q0p0052 1 100 0 1.33 FUNCTION_LIST DKATLRS IF_DATA DIM_X 0x380A70 EXTERN WORD IF_DATA MCMESS 0x380A70 EXTERN /end MEASUREMENT
/begin MEASUREMENT katbshd2_w "Signal für Fett-Verschiebung des Modells (Bank2)" SWORD mgrad_sw_b28p44 1 100 -28.4444 28.4436 FUNCTION_LIST DKATLRS IF_DATA DIM_X 0x381C58 EXTERN WORD IF_DATA MCMESS 0x381C58 EXTERN /end MEASUREMENT
/begin MEASUREMENT katbshd_w "Signal für Fett-Verschiebung des Modells" SWORD mgrad_sw_b28p44 1 100 -28.4444 28.4436 FUNCTION_LIST DKATLRS IF_DATA DIM_X 0x381C5A EXTERN WORD IF_DATA MCMESS 0x381C5A EXTERN /end MEASUREMENT
/begin MEASUREMENT kbdkt2_w "Katbelastungssignal, Bank2" SWORD mgrad_sw_b28p44 1 100 -28.4444 28.4436 FUNCTION_LIST DKATLRS IF_DATA DIM_X 0x381C5C EXTERN WORD IF_DATA MCMESS 0x381C5C EXTERN /end MEASUREMENT
/begin MEASUREMENT kbdkt_w "Katbelastungssignal" SWORD mgrad_sw_b28p44 1 100 -28.4444 28.4436 FUNCTION_LIST DKATLRS IF_DATA DIM_X 0x381C5E EXTERN WORD IF_DATA MCMESS 0x381C5E EXTERN /end MEASUREMENT
/begin MEASUREMENT ke_0_A "Klopferkennungsschwelle aus Kennfeld" UBYTE fak_ub_b16 1 100 0 15.9375 FUNCTION_LIST KRKE IF_DATA DIM_X 0x380B9A EXTERN WORD IF_DATA MCMESS 0x380B9A EXTERN /end MEASUREMENT
/begin MEASUREMENT ke_1_A "Klopferkennungsschwelle aus Kennfeld" UBYTE fak_ub_b16 1 100 0 15.9375 FUNCTION_LIST KRKE IF_DATA DIM_X 0x380B9B EXTERN WORD IF_DATA MCMESS 0x380B9B EXTERN /end MEASUREMENT
/begin MEASUREMENT ke_2_A "Klopferkennungsschwelle aus Kennfeld" UBYTE fak_ub_b16 1 100 0 15.9375 FUNCTION_LIST KRKE IF_DATA DIM_X 0x380B9C EXTERN WORD IF_DATA MCMESS 0x380B9C EXTERN /end MEASUREMENT
/begin MEASUREMENT ke_3_A "Klopferkennungsschwelle aus Kennfeld" UBYTE fak_ub_b16 1 100 0 15.9375 FUNCTION_LIST KRKE IF_DATA DIM_X 0x380B9D EXTERN WORD IF_DATA MCMESS 0x380B9D EXTERN /end MEASUREMENT
/begin MEASUREMENT ke_4_A "Klopferkennungsschwelle aus Kennfeld" UBYTE fak_ub_b16 1 100 0 15.9375 FUNCTION_LIST KRKE IF_DATA DIM_X 0x380B9E EXTERN WORD IF_DATA MCMESS 0x380B9E EXTERN /end MEASUREMENT
/begin MEASUREMENT ke_5_A "Klopferkennungsschwelle aus Kennfeld" UBYTE fak_ub_b16 1 100 0 15.9375 FUNCTION_LIST KRKE IF_DATA DIM_X 0x380B9F EXTERN WORD IF_DATA MCMESS 0x380B9F EXTERN /end MEASUREMENT
/begin MEASUREMENT ke_6_A "Klopferkennungsschwelle aus Kennfeld" UBYTE fak_ub_b16 1 100 0 15.9375 FUNCTION_LIST KRKE IF_DATA DIM_X 0x380BA0 EXTERN WORD IF_DATA MCMESS 0x380BA0 EXTERN /end MEASUREMENT
/begin MEASUREMENT ke_7_A "Klopferkennungsschwelle aus Kennfeld" UBYTE fak_ub_b16 1 100 0 15.9375 FUNCTION_LIST KRKE IF_DATA DIM_X 0x380BA1 EXTERN WORD IF_DATA MCMESS 0x380BA1 EXTERN /end MEASUREMENT
/begin MEASUREMENT kek_0_A "Klopferkennungsschwelle korrigiert" UBYTE fak_ub_b16 1 100 0 15.9375 FUNCTION_LIST KRKE KRDY IF_DATA DIM_X 0x380BA4 EXTERN WORD IF_DATA MCMESS 0x380BA4 EXTERN /end MEASUREMENT
/begin MEASUREMENT kek_1_A "Klopferkennungsschwelle korrigiert" UBYTE fak_ub_b16 1 100 0 15.9375 FUNCTION_LIST KRKE KRDY IF_DATA DIM_X 0x380BA5 EXTERN WORD IF_DATA MCMESS 0x380BA5 EXTERN /end MEASUREMENT
/begin MEASUREMENT kek_2_A "Klopferkennungsschwelle korrigiert" UBYTE fak_ub_b16 1 100 0 15.9375 FUNCTION_LIST KRKE KRDY IF_DATA DIM_X 0x380BA6 EXTERN WORD IF_DATA MCMESS 0x380BA6 EXTERN /end MEASUREMENT
/begin MEASUREMENT kek_3_A "Klopferkennungsschwelle korrigiert" UBYTE fak_ub_b16 1 100 0 15.9375 FUNCTION_LIST KRKE KRDY IF_DATA DIM_X 0x380BA7 EXTERN WORD IF_DATA MCMESS 0x380BA7 EXTERN /end MEASUREMENT
/begin MEASUREMENT kek_4_A "Klopferkennungsschwelle korrigiert" UBYTE fak_ub_b16 1 100 0 15.9375 FUNCTION_LIST KRKE KRDY IF_DATA DIM_X 0x380BA8 EXTERN WORD IF_DATA MCMESS 0x380BA8 EXTERN /end MEASUREMENT
/begin MEASUREMENT kek_5_A "Klopferkennungsschwelle korrigiert" UBYTE fak_ub_b16 1 100 0 15.9375 FUNCTION_LIST KRKE KRDY IF_DATA DIM_X 0x380BA9 EXTERN WORD IF_DATA MCMESS 0x380BA9 EXTERN /end MEASUREMENT
/begin MEASUREMENT kek_6_A "Klopferkennungsschwelle korrigiert" UBYTE fak_ub_b16 1 100 0 15.9375 FUNCTION_LIST KRKE KRDY IF_DATA DIM_X 0x380BAA EXTERN WORD IF_DATA MCMESS 0x380BAA EXTERN /end MEASUREMENT
/begin MEASUREMENT kek_7_A "Klopferkennungsschwelle korrigiert" UBYTE fak_ub_b16 1 100 0 15.9375 FUNCTION_LIST KRKE KRDY IF_DATA DIM_X 0x380BAB EXTERN WORD IF_DATA MCMESS 0x380BAB EXTERN /end MEASUREMENT
/begin MEASUREMENT kek_tst "Klopferkennungsschwelle korrigiert rollierend mit Zyl.zähler" UBYTE fak_ub_b16 1 100 0 15.9375 FUNCTION_LIST KRKE IF_DATA DIM_X 0x380BAC EXTERN WORD IF_DATA MCMESS 0x380BAC EXTERN /end MEASUREMENT
/begin MEASUREMENT kfgr_w "Verstärkungsfaktor FGR-Regler" UWORD rel_uw_b3200 1 100 0 3199.95 FUNCTION_LIST FGRMD IF_DATA DIM_X 0x381F98 EXTERN WORD IF_DATA MCMESS 0x381F98 EXTERN /end MEASUREMENT
/begin MEASUREMENT khc_w "Adaptierte HC-Konzentration Regenerierstrom" SWORD fak_sw_b2 1 100 -2 1.99994 FUNCTION_LIST TEB IF_DATA DIM_X 0x382B9C EXTERN WORD IF_DATA MCMESS 0x382B9C EXTERN /end MEASUREMENT
/begin MEASUREMENT kifz_w "Verstärkung des Fahrzeugmodells" UWORD fak_uw_b4864 1 100 0 4863.93 FUNCTION_LIST ARMD IF_DATA DIM_X 0x3825C0 EXTERN WORD IF_DATA MCMESS 0x3825C0 EXTERN /end MEASUREMENT
/begin MEASUREMENT kinmx "Verstärkung Integralanteil der NMAX-Regelung" UBYTE relnmot_q0p02 1 100 0 5.1 FUNCTION_LIST NMAXMD IF_DATA DIM_X 0x380C43 EXTERN WORD IF_DATA MCMESS 0x380C43 EXTERN /end MEASUREMENT
/begin MEASUREMENT klaf_kge "Kenngrößensource für KLAF" UWORD fak_uw_q0p001 1 100 0 65.535 FUNCTION_LIST BGMSZS BGRLP IF_DATA DIM_X 0x382000 EXTERN WORD IF_DATA MCMESS 0x382000 EXTERN /end MEASUREMENT
/begin MEASUREMENT kltalu_w "" UWORD t10msxs_uw_b655p35 1 100 0 655.35 FUNCTION_LIST DMDSTP IF_DATA DIM_X 0x380FFA EXTERN WORD IF_DATA MCMESS 0x380FFA EXTERN /end MEASUREMENT
/begin MEASUREMENT kl_twstt_w "Ausgang Kennlinie TWSTT" UWORD t1sxs_uw_q1 1 100 0 65535 FUNCTION_LIST ESSTT IF_DATA DIM_X 0x38227C EXTERN WORD IF_DATA MCMESS 0x38227C EXTERN /end MEASUREMENT
/begin MEASUREMENT kmstl_w "Zurückgelegte Fahrstrecke über Fz-Lebensdauer (EEPROM-gesichert)" UWORD s_q6_km 1 100 0 393210 FUNCTION_LIST BGKML DUMWEX T2LID IF_DATA DIM_X 0x381A22 EXTERN WORD IF_DATA MCMESS 0x381A22 EXTERN /end MEASUREMENT
/begin MEASUREMENT kmstmil_w "Zurückgelegte Fahrstrecke mit MIL on" UWORD s_q1_km 1 100 0 65535 FUNCTION_LIST BGKMST T2LID TC1MOD IF_DATA DIM_X 0x38353A EXTERN WORD IF_DATA MCMESS 0x38353A EXTERN /end MEASUREMENT
/begin MEASUREMENT kmst_w "Zurückgelegte Fahrstrecke seit Powerfail" UWORD s_q6_km 1 100 0 393210 FUNCTION_LIST BGKMST BGKML T2LID IF_DATA DIM_X 0x38353C EXTERN WORD IF_DATA MCMESS 0x38353C EXTERN /end MEASUREMENT
/begin MEASUREMENT kopwm "Klimakompressor-Signal als PWM-Signal" UBYTE dez 1 100 0 255 FUNCTION_LIST KOLS MDVERB IF_DATA DIM_X 0x380D22 EXTERN WORD IF_DATA MCMESS 0x380D22 EXTERN /end MEASUREMENT
/begin MEASUREMENT kopwmr "Klimakompressor-Signal als PWM-Rohsignal" UBYTE default 1 100 0 255 FUNCTION_LIST KOLS IF_DATA DIM_X 0x380D23 EXTERN WORD IF_DATA MCMESS 0x380D23 EXTERN /end MEASUREMENT
/begin MEASUREMENT kopwmr1 "" UWORD default 1 100 0 65535 FUNCTION_LIST KOLS IF_DATA DIM_X 0x382D22 EXTERN WORD IF_DATA MCMESS 0x382D22 EXTERN /end MEASUREMENT
/begin MEASUREMENT korrfak "" UBYTE fak_ub_b2 1 100 0 1.99219 FUNCTION_LIST GGTFM IF_DATA DIM_X 0x380B56 EXTERN WORD IF_DATA MCMESS 0x380B56 EXTERN /end MEASUREMENT
/begin MEASUREMENT koslokBits01 "" UBYTE dez 1 100 0 255 FUNCTION_LIST KOS IF_DATA DIM_X 0x380D25 EXTERN WORD IF_DATA MCMESS 0x380D25 EXTERN /end MEASUREMENT
/begin MEASUREMENT kral1w "aktueller Wert Last-Adaptionsbereich 1" UBYTE rel_ub_q0p75 1 100 0 191.25 FUNCTION_LIST KRRA IF_DATA DIM_X 0x380BCE EXTERN WORD IF_DATA MCMESS 0x380BCE EXTERN /end MEASUREMENT
/begin MEASUREMENT kral2w "aktueller Wert Last-Adaptionsbereich 2" UBYTE rel_ub_q0p75 1 100 0 191.25 FUNCTION_LIST KRRA IF_DATA DIM_X 0x380BCF EXTERN WORD IF_DATA MCMESS 0x380BCF EXTERN /end MEASUREMENT
/begin MEASUREMENT kral3w "aktueller Wert Last-Adaptionsbereich 3" UBYTE rel_ub_q0p75 1 100 0 191.25 FUNCTION_LIST KRRA IF_DATA DIM_X 0x380BD0 EXTERN WORD IF_DATA MCMESS 0x380BD0 EXTERN /end MEASUREMENT
/begin MEASUREMENT krdwsw "aktueller KL-Wert der Sicherheitsspätverstellung" UBYTE zw_ub_qn0p75 1 100 -191.25 0 FUNCTION_LIST KRRA IF_DATA DIM_X 0x380BDC EXTERN WORD IF_DATA MCMESS 0x380BDC EXTERN /end MEASUREMENT
/begin MEASUREMENT krfkw "Aktueller Wert aus KRFKN" UBYTE zw_ub_qn0p75 1 100 -191.25 0 FUNCTION_LIST KRRA IF_DATA DIM_X 0x380BDD EXTERN WORD IF_DATA MCMESS 0x380BDD EXTERN /end MEASUREMENT
/begin MEASUREMENT krmxw "aktueller Wert für Spätbegrenzung der Spätverstellung" UBYTE zw_ub_qn0p75 1 100 -191.25 0 FUNCTION_LIST KRRA IF_DATA DIM_X 0x380BDE EXTERN WORD IF_DATA MCMESS 0x380BDE EXTERN /end MEASUREMENT
/begin MEASUREMENT krvfakt "" UBYTE dez 1 100 0 255 FUNCTION_LIST KRRA IF_DATA DIM_X 0x380BDF EXTERN WORD IF_DATA MCMESS 0x380BDF EXTERN /end MEASUREMENT
/begin MEASUREMENT krvfsw "Initwert für schnelle Frühverstellung" UBYTE dez 1 100 0 255 FUNCTION_LIST KRRA IF_DATA DIM_X 0x380BE0 EXTERN WORD IF_DATA MCMESS 0x380BE0 EXTERN /end MEASUREMENT
/begin MEASUREMENT krvfw "Initwert für normale Frühverstellung" UBYTE dez 1 100 0 255 FUNCTION_LIST KRRA IF_DATA DIM_X 0x380BE1 EXTERN WORD IF_DATA MCMESS 0x380BE1 EXTERN /end MEASUREMENT
/begin MEASUREMENT ksta0 "Kaltstartanreicherung Bereich 0, gepuffert" UBYTE fak_ub_b2 1 100 0 1.99219 FUNCTION_LIST STADAP T2LID IF_DATA DIM_X 0x383003 EXTERN WORD IF_DATA MCMESS 0x383003 EXTERN /end MEASUREMENT
/begin MEASUREMENT ksta0w "Kaltstartanreicherung Bereich 0, aktuell eingerechnet" UBYTE fak_ub_b2 1 100 0 1.99219 FUNCTION_LIST STADAP IF_DATA DIM_X 0x380B47 EXTERN WORD IF_DATA MCMESS 0x380B47 EXTERN /end MEASUREMENT
/begin MEASUREMENT ksta1 "Kaltstartanreicherung Bereich 1, gepuffert" UBYTE fak_ub_b2 1 100 0 1.99219 FUNCTION_LIST STADAP T2LID IF_DATA DIM_X 0x383004 EXTERN WORD IF_DATA MCMESS 0x383004 EXTERN /end MEASUREMENT
/begin MEASUREMENT ksta1w "Kaltstartanreicherung Bereich 1, aktuell eingerechnet" UBYTE fak_ub_b2 1 100 0 1.99219 FUNCTION_LIST STADAP IF_DATA DIM_X 0x380B48 EXTERN WORD IF_DATA MCMESS 0x380B48 EXTERN /end MEASUREMENT
/begin MEASUREMENT ksta2 "Kaltstartanreicherung Bereich 2, gepuffert" UBYTE fak_ub_b2 1 100 0 1.99219 FUNCTION_LIST STADAP T2LID IF_DATA DIM_X 0x383005 EXTERN WORD IF_DATA MCMESS 0x383005 EXTERN /end MEASUREMENT
/begin MEASUREMENT ksta2w "Kaltstartanreicherung Bereich 2, aktuell eingerechnet" UBYTE fak_ub_b2 1 100 0 1.99219 FUNCTION_LIST STADAP IF_DATA DIM_X 0x380B49 EXTERN WORD IF_DATA MCMESS 0x380B49 EXTERN /end MEASUREMENT
/begin MEASUREMENT kstaa "Aktueller Startmengenadaptionsfaktor" UBYTE fak_ub_b2 1 100 0 1.99219 FUNCTION_LIST STADAP ESNST ESSTT SSTBER87 T2LID IF_DATA DIM_X 0x380B4A EXTERN WORD IF_DATA MCMESS 0x380B4A EXTERN /end MEASUREMENT
/begin MEASUREMENT kswf "Kat.-Schutz-Wichtungsfaktoren, aus KFKSWF" UBYTE dez 1 100 0 255 FUNCTION_LIST DMDMIL IF_DATA DIM_X 0x3809D4 EXTERN WORD IF_DATA MCMESS 0x3809D4 EXTERN /end MEASUREMENT
/begin MEASUREMENT ks_sym_0__A "Eingang des Klopfauswerte-IC" UBYTE dez 1 100 0 255 FUNCTION_LIST GGKS DKRS IF_DATA DIM_X 0xE406 INTERN WORD IF_DATA MCMESS 0xE406 INTERN /end MEASUREMENT
/begin MEASUREMENT ks_sym_1__A "Eingang des Klopfauswerte-IC" UBYTE dez 1 100 0 255 FUNCTION_LIST GGKS DKRS IF_DATA DIM_X 0xE407 INTERN WORD IF_DATA MCMESS 0xE407 INTERN /end MEASUREMENT
/begin MEASUREMENT ks_sym_2__A "Eingang des Klopfauswerte-IC" UBYTE dez 1 100 0 255 FUNCTION_LIST GGKS DKRS IF_DATA DIM_X 0xE408 INTERN WORD IF_DATA MCMESS 0xE408 INTERN /end MEASUREMENT
/begin MEASUREMENT ks_sym_3__A "Eingang des Klopfauswerte-IC" UBYTE dez 1 100 0 255 FUNCTION_LIST GGKS DKRS IF_DATA DIM_X 0xE409 INTERN WORD IF_DATA MCMESS 0xE409 INTERN /end MEASUREMENT
/begin MEASUREMENT kteev_w "Konzentration Regeneriergas im Saugrohr auf Höhe der Einspritzventile" UWORD fak_uw_b1 1 100 0 0.999985 FUNCTION_LIST TEB IF_DATA DIM_X 0x382BB2 EXTERN WORD IF_DATA MCMESS 0x382BB2 EXTERN /end MEASUREMENT
/begin MEASUREMENT ktetevvz_w "Konzentration Regeneriergas im Saugrohr verzögert" UWORD fak_uw_b1 1 100 0 0.999985 FUNCTION_LIST TEB IF_DATA DIM_X 0x382BB4 EXTERN WORD IF_DATA MCMESS 0x382BB4 EXTERN /end MEASUREMENT
/begin MEASUREMENT ktetev_w "Konzentration Regeneriergas im Saugrohr auf Höhe vom TEV" UWORD fak_uw_b1 1 100 0 0.999985 FUNCTION_LIST TEB IF_DATA DIM_X 0x382BB6 EXTERN WORD IF_DATA MCMESS 0x382BB6 EXTERN /end MEASUREMENT
/begin MEASUREMENT kusvk2_w "Korrekturwert der LSU-Spannung vor Kat Bank2" SWORD spg_sw_q0p00488 1 100 -160 159.995 FUNCTION_LIST GGLSU T2LID IF_DATA DIM_X 0x38398C EXTERN WORD IF_DATA MCMESS 0x38398C EXTERN /end MEASUREMENT
/begin MEASUREMENT kusvk_w "Korrekturwert der LSU-Spannung vor Kat" SWORD spg_sw_q0p00488 1 100 -160 159.995 FUNCTION_LIST GGLSU T2LID IF_DATA DIM_X 0x38398E EXTERN WORD IF_DATA MCMESS 0x38398E EXTERN /end MEASUREMENT
/begin MEASUREMENT kvarest "KVA-Rest" UWORD fuel_uw_b1 1 100 0 0.999985 FUNCTION_LIST KVA IF_DATA DIM_X 0x382D2E EXTERN WORD IF_DATA MCMESS 0x382D2E EXTERN /end MEASUREMENT
/begin MEASUREMENT kvaverbr "Verbrauchte Kraftstoffmenge über CAN; normiert in u-Liter" UWORD fuel_uw_b65535 1 100 0 65535 FUNCTION_LIST KVA CAN IF_DATA DIM_X 0x382D30 EXTERN WORD IF_DATA MCMESS 0x382D30 EXTERN /end MEASUREMENT
/begin MEASUREMENT kvaverbz_w "Überlaufzähler für kvaverbr zur Langzeitüberwachung Kraftstoffverbrauch" UWORD dez 1 100 0 65535 FUNCTION_LIST KVA IF_DATA DIM_X 0x383E76 EXTERN WORD IF_DATA MCMESS 0x383E76 EXTERN /end MEASUREMENT
/begin MEASUREMENT ladiff2_w "Regelabweichung Lambda;Bank2" SWORD fak_sw_b1 1 100 -1 0.999969 FUNCTION_LIST LRS IF_DATA DIM_X 0x38298E EXTERN WORD IF_DATA MCMESS 0x38298E EXTERN /end MEASUREMENT
/begin MEASUREMENT ladiff_w "Regelabweichung Lambda" SWORD fak_sw_b1 1 100 -1 0.999969 FUNCTION_LIST LRS IF_DATA DIM_X 0x382990 EXTERN WORD IF_DATA MCMESS 0x382990 EXTERN /end MEASUREMENT
/begin MEASUREMENT lahkmz "Zustandsbyte des Automaten: fr-synchrone Mittelung Pseodo-Lambda hinter Kat" UBYTE dez 1 100 0 255 FUNCTION_LIST LRSHK IF_DATA DIM_X 0x380C8D EXTERN WORD IF_DATA MCMESS 0x380C8D EXTERN /end MEASUREMENT
/begin MEASUREMENT lahkmz2 "Zustandsbyte des Automaten: fr-synchrone Mittelung Pseodo-Lambda h. Kat, Bank 2" UBYTE dez 1 100 0 255 FUNCTION_LIST LRSHK IF_DATA DIM_X 0x380C8E EXTERN WORD IF_DATA MCMESS 0x380C8E EXTERN /end MEASUREMENT
/begin MEASUREMENT LAKHlokBits "" UBYTE dez 1 100 0 255 FUNCTION_LIST LAKH IF_DATA DIM_X 0x380B79 EXTERN WORD IF_DATA MCMESS 0x380B79 EXTERN /end MEASUREMENT
/begin MEASUREMENT lalsuvj2_w "Lambda-Istwert Bank2" UWORD fak_uw_b2 1 100 0 1.99997 FUNCTION_LIST GGLSU TC1MOD IF_DATA DIM_X 0x381DD8 EXTERN WORD IF_DATA MCMESS 0x381DD8 EXTERN /end MEASUREMENT
/begin MEASUREMENT lalsuvj_w "Lambda-Istwert" UWORD fak_uw_b2 1 100 0 1.99997 FUNCTION_LIST GGLSU TC1MOD IF_DATA DIM_X 0x381DDA EXTERN WORD IF_DATA MCMESS 0x381DDA EXTERN /end MEASUREMENT
/begin MEASUREMENT lambas "Basis-Lambda" UBYTE fak_ub_b2 1 100 0 1.99219 FUNCTION_LIST LAMKO MDBAS ZWGRU IF_DATA DIM_X 0x380B44 EXTERN WORD IF_DATA MCMESS 0x380B44 EXTERN /end MEASUREMENT
/begin MEASUREMENT lambts_w "Lambda für Bauteileschutz" UWORD fak_uw_b16 1 100 0 15.9998 FUNCTION_LIST LAMBTS LAMKO IF_DATA DIM_X 0x38231C EXTERN WORD IF_DATA MCMESS 0x38231C EXTERN /end MEASUREMENT
/begin MEASUREMENT lamelsh2_w "Lambdasoll für elektrische Sondendiagnose hinter KAT (Kurztrip), Bank 2" UWORD fak_uw_b16 1 100 0 15.9998 FUNCTION_LIST DLSH LAMKO IF_DATA DIM_X 0x381CF0 EXTERN WORD IF_DATA MCMESS 0x381CF0 EXTERN /end MEASUREMENT
/begin MEASUREMENT lamelsh_w "Lambdasoll für elektrische Sondendiagnose hinter KAT (Kurztrip)" UWORD fak_uw_b16 1 100 0 15.9998 FUNCTION_LIST DLSH LAMKO IF_DATA DIM_X 0x381CF2 EXTERN WORD IF_DATA MCMESS 0x381CF2 EXTERN /end MEASUREMENT
/begin MEASUREMENT lamfa_w "Lambdasoll Fahrerwunsch (word)" UWORD fak_uw_b16 1 100 0 15.9998 FUNCTION_LIST LAMFAW LAMKO IF_DATA DIM_X 0x382328 EXTERN WORD IF_DATA MCMESS 0x382328 EXTERN /end MEASUREMENT
/begin MEASUREMENT lamfrm2_w "Lambdaabweichung aus Mittelwert Lambdaregelfaktor Bank2" UWORD fak_uw_b16 1 100 0 15.9998 FUNCTION_LIST DLSAHK IF_DATA DIM_X 0x381CB6 EXTERN WORD IF_DATA MCMESS 0x381CB6 EXTERN /end MEASUREMENT
/begin MEASUREMENT lamfrm_w "Lambdaabweichung aus Mittelwert Lambdaregelfaktor" UWORD fak_uw_b16 1 100 0 15.9998 FUNCTION_LIST DLSAHK IF_DATA DIM_X 0x381CB8 EXTERN WORD IF_DATA MCMESS 0x381CB8 EXTERN /end MEASUREMENT
/begin MEASUREMENT lamhf2_w "Pseudolinearisietes Lambda hinter Kat, PT1-gefiltert,Bank2, Word" UWORD fak_uw_b16 1 100 0 15.9998 FUNCTION_LIST LRSHK IF_DATA DIM_X 0x382A84 EXTERN WORD IF_DATA MCMESS 0x382A84 EXTERN /end MEASUREMENT
/begin MEASUREMENT lamhf_w "Pseudolinearisietes Lambda hinter Kat, PT1-gefiltert, Word" UWORD fak_uw_b16 1 100 0 15.9998 FUNCTION_LIST LRSHK IF_DATA DIM_X 0x382A86 EXTERN WORD IF_DATA MCMESS 0x382A86 EXTERN /end MEASUREMENT
/begin MEASUREMENT lamhm2_w "fr-synchron gemittelter Pseudo Lambda-Istwert gem. mit Nernst-Sonde h.Kat,Bank2" UWORD fak_uw_b16 1 100 0 15.9998 FUNCTION_LIST LRSHK IF_DATA DIM_X 0x382A88 EXTERN WORD IF_DATA MCMESS 0x382A88 EXTERN /end MEASUREMENT
/begin MEASUREMENT lamhm_w "fr-synchron gemittelter Pseudo Lambda-Istwert gem. mit Nernst-Sonde h.Kat, Word" UWORD fak_uw_b16 1 100 0 15.9998 FUNCTION_LIST LRSHK IF_DATA DIM_X 0x382A8A EXTERN WORD IF_DATA MCMESS 0x382A8A EXTERN /end MEASUREMENT
/begin MEASUREMENT lamka2_w "Lambdasollwert Katausräumen, Bank2" UWORD fak_uw_b16 1 100 0 15.9998 FUNCTION_LIST LRSKA LAMKO IF_DATA DIM_X 0x382950 EXTERN WORD IF_DATA MCMESS 0x382950 EXTERN /end MEASUREMENT
/begin MEASUREMENT lamka_w "Lambdasollwert Katausräumen" UWORD fak_uw_b16 1 100 0 15.9998 FUNCTION_LIST LRSKA LAMKO IF_DATA DIM_X 0x382952 EXTERN WORD IF_DATA MCMESS 0x382952 EXTERN /end MEASUREMENT
/begin MEASUREMENT lamkh2_w "Lambda-Motor-Soll bei Katheizen, Bank 2 (word)" UWORD fak_q0p000244 1 100 0 15.9998 FUNCTION_LIST LAKH LAMKO IF_DATA DIM_X 0x382426 EXTERN WORD IF_DATA MCMESS 0x382426 EXTERN /end MEASUREMENT
/begin MEASUREMENT lamkhe2_w "Lambda-Motor-Soll bei Katheizen, effektiv, Bank 2" UWORD fak_uw_b16 1 100 0 15.9998 FUNCTION_LIST LAMKO IF_DATA DIM_X 0x38232C EXTERN WORD IF_DATA MCMESS 0x38232C EXTERN /end MEASUREMENT
/begin MEASUREMENT lamkhe_w "Lambda-Motor-Soll bei Katheizen, effektiv" UWORD fak_uw_b16 1 100 0 15.9998 FUNCTION_LIST LAMKO IF_DATA DIM_X 0x38232E EXTERN WORD IF_DATA MCMESS 0x38232E EXTERN /end MEASUREMENT
/begin MEASUREMENT lamkhg2_w "Lambda-Motor-Soll bei Katheizen (word) gewichtet mit flakh, Bank 2" UWORD fak_q0p000244 1 100 0 15.9998 FUNCTION_LIST LAKH IF_DATA DIM_X 0x382428 EXTERN WORD IF_DATA MCMESS 0x382428 EXTERN /end MEASUREMENT
/begin MEASUREMENT lamkhg_w "Lambda-Motor-Soll bei Katheizen (word) gewichtet mit flakh" UWORD fak_q0p000244 1 100 0 15.9998 FUNCTION_LIST LAKH IF_DATA DIM_X 0x38242A EXTERN WORD IF_DATA MCMESS 0x38242A EXTERN /end MEASUREMENT
/begin MEASUREMENT lamkhr2_w "Lambda-Motor-Soll resultierend bei Katheizen, Bank 2 (word)" UWORD fak_q0p000244 1 100 0 15.9998 FUNCTION_LIST LAKH IF_DATA DIM_X 0x382412 EXTERN WORD IF_DATA MCMESS 0x382412 EXTERN /end MEASUREMENT
/begin MEASUREMENT lamkhr_w "Lambda-Motor-Soll resultierend bei Katheizen (word)" UWORD fak_q0p000244 1 100 0 15.9998 FUNCTION_LIST LAKH IF_DATA DIM_X 0x382414 EXTERN WORD IF_DATA MCMESS 0x382414 EXTERN /end MEASUREMENT
/begin MEASUREMENT lamkh_w "Lambda-Motor-Soll bei Katheizen (word)" UWORD fak_q0p000244 1 100 0 15.9998 FUNCTION_LIST LAKH LAMKO IF_DATA DIM_X 0x38242C EXTERN WORD IF_DATA MCMESS 0x38242C EXTERN /end MEASUREMENT
/begin MEASUREMENT lamlash2_w "Lambdasoll für Test Schwingungsprüfung hinter KAT Bank2" UWORD fak_uw_b16 1 100 0 15.9998 FUNCTION_LIST DLSAHK LAMKO IF_DATA DIM_X 0x381CBA EXTERN WORD IF_DATA MCMESS 0x381CBA EXTERN /end MEASUREMENT
/begin MEASUREMENT lamlash_w "Lambdasoll für Test Schwingungsprüfung hinter KAT" UWORD fak_uw_b16 1 100 0 15.9998 FUNCTION_LIST DLSAHK LAMKO IF_DATA DIM_X 0x381CBC EXTERN WORD IF_DATA MCMESS 0x381CBC EXTERN /end MEASUREMENT
/begin MEASUREMENT lamlgm "Laufgrenze ""Lambda mager""" UBYTE fak_ub_b2 1 100 0 1.99219 FUNCTION_LIST LAMKO IF_DATA DIM_X 0x380B45 EXTERN WORD IF_DATA MCMESS 0x380B45 EXTERN /end MEASUREMENT
/begin MEASUREMENT lamnswl_w "Lambda-Motor-Soll für Nachstart und Warmlauf" UWORD fak_uw_b16 1 100 0 15.9998 FUNCTION_LIST ESWL LAMKO IF_DATA DIM_X 0x382302 EXTERN WORD IF_DATA MCMESS 0x382302 EXTERN /end MEASUREMENT
/begin MEASUREMENT lamns_w "Lambda-Motor-Soll für Nachstart" UWORD fak_uw_b16 1 100 0 15.9998 FUNCTION_LIST ESNST ESWL GK IF_DATA DIM_X 0x38225C EXTERN WORD IF_DATA MCMESS 0x38225C EXTERN /end MEASUREMENT
/begin MEASUREMENT lams2_w "Lambdasoll (word)" UWORD fak_uw_b16 1 100 0 15.9998 FUNCTION_LIST LAMKO IF_DATA DIM_X 0x382330 EXTERN WORD IF_DATA MCMESS 0x382330 EXTERN /end MEASUREMENT
/begin MEASUREMENT lamsam2_w "Lambdaamplitude nach Filterung Bank 2" SWORD fak_sw_b8 1 100 -8 7.99976 FUNCTION_LIST DLSU IF_DATA DIM_X 0x381D18 EXTERN WORD IF_DATA MCMESS 0x381D18 EXTERN /end MEASUREMENT
/begin MEASUREMENT lamsam_w "Lambdaamplitude nach Filterung" SWORD fak_sw_b8 1 100 -8 7.99976 FUNCTION_LIST DLSU IF_DATA DIM_X 0x381D1A EXTERN WORD IF_DATA MCMESS 0x381D1A EXTERN /end MEASUREMENT
/begin MEASUREMENT lamsbg2_w "Lambdasoll Begrenzung (word) Bank2" UWORD fak_uw_b16 1 100 0 15.9998 FUNCTION_LIST LAMKO ATM DSLSLRS GK LRS SSTBER87 IF_DATA DIM_X 0x382332 EXTERN WORD IF_DATA MCMESS 0x382332 EXTERN /end MEASUREMENT
/begin MEASUREMENT lamsbgt2_w "Lambdasoll bezogen auf Brennraum Bank 2, totzeitverschoben" UWORD fak_uw_b16 1 100 0 15.9998 FUNCTION_LIST LRS ESUKAS IF_DATA DIM_X 0x382992 EXTERN WORD IF_DATA MCMESS 0x382992 EXTERN /end MEASUREMENT
/begin MEASUREMENT lamsbgt_w "Lambdasoll bezogen auf Brennraum, totzeitverschoben" UWORD fak_uw_b16 1 100 0 15.9998 FUNCTION_LIST LRS ESUKAS IF_DATA DIM_X 0x382994 EXTERN WORD IF_DATA MCMESS 0x382994 EXTERN /end MEASUREMENT
/begin MEASUREMENT lamsbg_w "Lambdasoll Begrenzung (word)" UWORD fak_uw_b16 1 100 0 15.9998 FUNCTION_LIST LAMKO ATM DSLSLRS GK LRS SSTBER87 IF_DATA DIM_X 0x382334 EXTERN WORD IF_DATA MCMESS 0x382334 EXTERN /end MEASUREMENT
/begin MEASUREMENT lamsisa "Lambda Ist an Sonde Signalausgabe DLSSA, Bank 1" UBYTE fak_ub_b2 1 100 0 1.99219 FUNCTION_LIST DLSSA TC5MOD IF_DATA DIM_X 0x380AE1 EXTERN WORD IF_DATA MCMESS 0x380AE1 EXTERN /end MEASUREMENT
/begin MEASUREMENT lamsisa2 "Lambda Ist an Sonde Signalausgabe DLSSA, Bank 2" UBYTE fak_ub_b2 1 100 0 1.99219 FUNCTION_LIST DLSSA TC5MOD IF_DATA DIM_X 0x380AE2 EXTERN WORD IF_DATA MCMESS 0x380AE2 EXTERN /end MEASUREMENT
/begin MEASUREMENT lamsolh2_w "Pseudo Lambda-Sollwert hinter Kat, Bank2" UWORD fak_uw_b16 1 100 0 15.9998 FUNCTION_LIST LRSHK IF_DATA DIM_X 0x382A8C EXTERN WORD IF_DATA MCMESS 0x382A8C EXTERN /end MEASUREMENT
/begin MEASUREMENT lamsolh_w "Pseudo Lambda-Sollwert hinter Kat" UWORD fak_uw_b16 1 100 0 15.9998 FUNCTION_LIST LRSHK IF_DATA DIM_X 0x382A8E EXTERN WORD IF_DATA MCMESS 0x382A8E EXTERN /end MEASUREMENT
/begin MEASUREMENT lamsonb2_w "Basis-Lambda Istwert Bank2" UWORD fak_uw_b16 1 100 0 15.9998 FUNCTION_LIST GGLSU IF_DATA DIM_X 0x381DE8 EXTERN WORD IF_DATA MCMESS 0x381DE8 EXTERN /end MEASUREMENT
/begin MEASUREMENT lamsonb_w "Basis-Lambda Istwert" UWORD fak_uw_b16 1 100 0 15.9998 FUNCTION_LIST GGLSU IF_DATA DIM_X 0x381DEA EXTERN WORD IF_DATA MCMESS 0x381DEA EXTERN /end MEASUREMENT
/begin MEASUREMENT lamsonh2_w "Pseudo Lambda-Istwert gemessen mit Nernst-Sonde hinter Kat (word), Bank2" UWORD fak_uw_b16 1 100 0 15.9998 FUNCTION_LIST LRSHK IF_DATA DIM_X 0x382A90 EXTERN WORD IF_DATA MCMESS 0x382A90 EXTERN /end MEASUREMENT
/begin MEASUREMENT lamsonh_w "Pseudo Lambda-Istwert gemessen mit Nernst-Sonde hinter Kat (word)" UWORD fak_uw_b16 1 100 0 15.9998 FUNCTION_LIST LRSHK IF_DATA DIM_X 0x382A92 EXTERN WORD IF_DATA MCMESS 0x382A92 EXTERN /end MEASUREMENT
/begin MEASUREMENT lamsoni2_u "Lambda-Istwert Bank2 (Byte)" UBYTE fak_ub_b4 1 100 0 3.98438 FUNCTION_LIST DFFTCNV DFFTK IF_DATA DIM_X 0x3809EE EXTERN WORD IF_DATA MCMESS 0x3809EE EXTERN /end MEASUREMENT
/begin MEASUREMENT lamsoni2_w "Lambda-Istwert Bank2" UWORD fak_uw_b16 1 100 0 15.9998 FUNCTION_LIST GGLSU DFFTCNV DKATLRS DLSSA DLSU DSLSLRS LRS LRSEB LRSKA T2LID IF_DATA DIM_X 0x381DEC EXTERN WORD IF_DATA MCMESS 0x381DEC EXTERN /end MEASUREMENT
/begin MEASUREMENT lamsoni_u "Lambda-Istwert (Byte)" UBYTE fak_ub_b4 1 100 0 3.98438 FUNCTION_LIST DFFTCNV DFFTK IF_DATA DIM_X 0x3809EF EXTERN WORD IF_DATA MCMESS 0x3809EF EXTERN /end MEASUREMENT
/begin MEASUREMENT lamsoni_w "Lambda-Istwert" UWORD fak_uw_b16 1 100 0 15.9998 FUNCTION_LIST GGLSU DFFTCNV DKATLRS DLSSA DLSU DSLSLRS LRS LRSEB LRSKA T2LID IF_DATA DIM_X 0x381DEE EXTERN WORD IF_DATA MCMESS 0x381DEE EXTERN /end MEASUREMENT
/begin MEASUREMENT lamsons2_w "Lambda-Sollwert bezogen auf Einbauort Lambda-Sensor Bank2" UWORD fak_uw_b16 1 100 0 15.9998 FUNCTION_LIST LAMKO DLSAHK DLSH DLSSA DLSU GGLSU LRS LRSEB LRSHK LRSKA T2LID IF_DATA DIM_X 0x382336 EXTERN WORD IF_DATA MCMESS 0x382336 EXTERN /end MEASUREMENT
/begin MEASUREMENT lamsons_w "Lambda-Sollwert bezogen auf Einbauort Lambda-Sensor" UWORD fak_uw_b16 1 100 0 15.9998 FUNCTION_LIST LAMKO BGMSZS DLSAHK DLSH DLSSA DLSU GGLSU LRS LRSEB LRSHK LRSKA T2LID TEBEB IF_DATA DIM_X 0x382338 EXTERN WORD IF_DATA MCMESS 0x382338 EXTERN /end MEASUREMENT
/begin MEASUREMENT lamsos2_w "Lambda-Sollwert bezogen auf Einbauort Lambda-Sensor Bank2" UWORD fak_uw_b16 1 100 0 15.9998 FUNCTION_LIST LAMKO IF_DATA DIM_X 0x38233A EXTERN WORD IF_DATA MCMESS 0x38233A EXTERN /end MEASUREMENT
/begin MEASUREMENT lamsosa "Lambda Soll an Sonde Signalausgabe DLSSA, Bank 1" UBYTE fak_ub_b2 1 100 0 1.99219 FUNCTION_LIST DLSSA TC5MOD IF_DATA DIM_X 0x380AE3 EXTERN WORD IF_DATA MCMESS 0x380AE3 EXTERN /end MEASUREMENT
/begin MEASUREMENT lamsosa2 "Lambda Soll an Sonde Signalausgabe DLSSA, Bank 2" UBYTE fak_ub_b2 1 100 0 1.99219 FUNCTION_LIST DLSSA TC5MOD IF_DATA DIM_X 0x380AE4 EXTERN WORD IF_DATA MCMESS 0x380AE4 EXTERN /end MEASUREMENT
/begin MEASUREMENT lamsos_w "Lambda-Sollwert bezogen auf Einbauort Lambda-Sensor" UWORD fak_uw_b16 1 100 0 15.9998 FUNCTION_LIST LAMKO IF_DATA DIM_X 0x38233C EXTERN WORD IF_DATA MCMESS 0x38233C EXTERN /end MEASUREMENT
/begin MEASUREMENT lamsubg2_w "Lambdasoll unbegrenzt (word)" UWORD fak_uw_b16 1 100 0 15.9998 FUNCTION_LIST LAMKO IF_DATA DIM_X 0x38233E EXTERN WORD IF_DATA MCMESS 0x38233E EXTERN /end MEASUREMENT
/begin MEASUREMENT lamsubg_w "Lambdasoll unbegrenzt (word)" UWORD fak_uw_b16 1 100 0 15.9998 FUNCTION_LIST LAMKO IF_DATA DIM_X 0x382340 EXTERN WORD IF_DATA MCMESS 0x382340 EXTERN /end MEASUREMENT
/begin MEASUREMENT lams_w "Lambdasoll (word)" UWORD fak_uw_b16 1 100 0 15.9998 FUNCTION_LIST LAMKO IF_DATA DIM_X 0x382342 EXTERN WORD IF_DATA MCMESS 0x382342 EXTERN /end MEASUREMENT
/begin MEASUREMENT lamvoa2_w "Lambdavorsteuerung ohne additive Anteile" UWORD fak_uw_b16 1 100 0 15.9998 FUNCTION_LIST LAMKO IF_DATA DIM_X 0x382344 EXTERN WORD IF_DATA MCMESS 0x382344 EXTERN /end MEASUREMENT
/begin MEASUREMENT lamvoa_w "Lambdavorsteuerung ohne additive Anteile" UWORD fak_uw_b16 1 100 0 15.9998 FUNCTION_LIST LAMKO IF_DATA DIM_X 0x382346 EXTERN WORD IF_DATA MCMESS 0x382346 EXTERN /end MEASUREMENT
/begin MEASUREMENT lamwl_w "Lambda-Motor-Soll für Warmlauf" UWORD fak_uw_b16 1 100 0 15.9998 FUNCTION_LIST ESWL IF_DATA DIM_X 0x382304 EXTERN WORD IF_DATA MCMESS 0x382304 EXTERN /end MEASUREMENT
/begin MEASUREMENT lamzak2_w "Lambdasondenistwert, korrigiert um Zusatzamplitude, Bank2" UWORD fak_uw_b16 1 100 0 15.9998 FUNCTION_LIST LRS ESUKAS IF_DATA DIM_X 0x382996 EXTERN WORD IF_DATA MCMESS 0x382996 EXTERN /end MEASUREMENT
/begin MEASUREMENT lamzak_w "Lambdasondenistwert, korrigiert um Zusatzamplitude" UWORD fak_uw_b16 1 100 0 15.9998 FUNCTION_LIST LRS ESUKAS IF_DATA DIM_X 0x382998 EXTERN WORD IF_DATA MCMESS 0x382998 EXTERN /end MEASUREMENT
/begin MEASUREMENT lanskh_w "Lambda-Motor-Soll im Nachstart bei Katheizen" UWORD fak_q0p000244 1 100 0 15.9998 FUNCTION_LIST LAKH IF_DATA DIM_X 0x382416 EXTERN WORD IF_DATA MCMESS 0x382416 EXTERN /end MEASUREMENT
/begin MEASUREMENT lasdslg2_w "Lambda-Abgas-Soll für Sekundärluftdiagnose Bank 2 gewichtet mit flamsl2" UWORD fak_q0p000244 1 100 0 15.9998 FUNCTION_LIST LAKH IF_DATA DIM_X 0x382418 EXTERN WORD IF_DATA MCMESS 0x382418 EXTERN /end MEASUREMENT
/begin MEASUREMENT lasdslg_w "Lambda-Abgas-Soll für Sekundärluftdiagnose gewichtet mit flamsl" UWORD fak_q0p000244 1 100 0 15.9998 FUNCTION_LIST LAKH IF_DATA DIM_X 0x38241A EXTERN WORD IF_DATA MCMESS 0x38241A EXTERN /end MEASUREMENT
/begin MEASUREMENT lasdsl_w "Lambda-Abgas-Soll für Sekundärluftdiagnose" UWORD fak_q0p000244 1 100 0 15.9998 FUNCTION_LIST LAKH IF_DATA DIM_X 0x38241C EXTERN WORD IF_DATA MCMESS 0x38241C EXTERN /end MEASUREMENT
/begin MEASUREMENT laskh_w "Lambda-Abgas-Soll bei Katheizen (word)" UWORD fak_q0p000244 1 100 0 15.9998 FUNCTION_LIST LAKH IF_DATA DIM_X 0x38241E EXTERN WORD IF_DATA MCMESS 0x38241E EXTERN /end MEASUREMENT
/begin MEASUREMENT laufz100_w "" UWORD runtime1_sy 1 100 0 43690 FUNCTION_LIST RUNTIME IF_DATA DIM_X 0x382844 EXTERN WORD IF_DATA MCMESS 0x382844 EXTERN /end MEASUREMENT
/begin MEASUREMENT laufz10m_w "" UWORD runtime1_sy 1 100 0 43690 FUNCTION_LIST RUNTIME IF_DATA DIM_X 0x38284E EXTERN WORD IF_DATA MCMESS 0x38284E EXTERN /end MEASUREMENT
/begin MEASUREMENT laufz1m_w "" UWORD runtime1_sy 1 100 0 43690 FUNCTION_LIST RUNTIME IF_DATA DIM_X 0xFB1C INTERN WORD IF_DATA MCMESS 0xFB1C INTERN /end MEASUREMENT
/begin MEASUREMENT laufz1s_w "" UWORD runtime1_sy 1 100 0 43690 FUNCTION_LIST RUNTIME IF_DATA DIM_X 0x382850 EXTERN WORD IF_DATA MCMESS 0x382850 EXTERN /end MEASUREMENT
/begin MEASUREMENT laufz200_w "" UWORD runtime1_sy 1 100 0 43690 FUNCTION_LIST RUNTIME IF_DATA DIM_X 0x382846 EXTERN WORD IF_DATA MCMESS 0x382846 EXTERN /end MEASUREMENT
/begin MEASUREMENT laufz20m_w "" UWORD runtime1_sy 1 100 0 43690 FUNCTION_LIST RUNTIME IF_DATA DIM_X 0x382852 EXTERN WORD IF_DATA MCMESS 0x382852 EXTERN /end MEASUREMENT
/begin MEASUREMENT laufz2m_w "" UWORD runtime1_sy 1 100 0 43690 FUNCTION_LIST RUNTIME IF_DATA DIM_X 0xFB1E INTERN WORD IF_DATA MCMESS 0xFB1E INTERN /end MEASUREMENT
/begin MEASUREMENT laufz50m_w "" UWORD runtime1_sy 1 100 0 43690 FUNCTION_LIST RUNTIME IF_DATA DIM_X 0x382848 EXTERN WORD IF_DATA MCMESS 0x382848 EXTERN /end MEASUREMENT
/begin MEASUREMENT laufz5m_w "" UWORD runtime1_sy 1 100 0 43690 FUNCTION_LIST RUNTIME IF_DATA DIM_X 0xFB20 INTERN WORD IF_DATA MCMESS 0xFB20 INTERN /end MEASUREMENT
/begin MEASUREMENT laufzbg_w "" UWORD runtime1_sy 1 100 0 43690 FUNCTION_LIST RUNTIME IF_DATA DIM_X 0x38284A EXTERN WORD IF_DATA MCMESS 0x38284A EXTERN /end MEASUREMENT
/begin MEASUREMENT laufzfbg_w "" UWORD runtime1_sy 1 100 0 43690 FUNCTION_LIST RUNTIME IF_DATA DIM_X 0x38284C EXTERN WORD IF_DATA MCMESS 0x38284C EXTERN /end MEASUREMENT
/begin MEASUREMENT laufzsyn_w "" UWORD runtime1_sy 1 100 0 43690 FUNCTION_LIST RUNTIME IF_DATA DIM_X 0x382854 EXTERN WORD IF_DATA MCMESS 0x382854 EXTERN /end MEASUREMENT
/begin MEASUREMENT lbts_w "Lambda für Bauteileschutz aus Stationärkennfeld" UWORD fak_uw_b16 1 100 0 15.9998 FUNCTION_LIST LAMBTS IF_DATA DIM_X 0x38231E EXTERN WORD IF_DATA MCMESS 0x38231E EXTERN /end MEASUREMENT
/begin MEASUREMENT lbz "Ladebilanz der Batterie" UBYTE rel_ub_b99p6 1 100 0 99.6094 FUNCTION_LIST BGLBZ CAN LLRNS IF_DATA DIM_X 0x380A94 EXTERN WORD IF_DATA MCMESS 0x380A94 EXTERN /end MEASUREMENT
/begin MEASUREMENT lde "LDR-Regelabweichung (Sollwert - Istwert)" SBYTE p_sb_q10 1 100 -1280 1270 FUNCTION_LIST LDRPID DLDR LDOB SSTBER87 T2LID IF_DATA DIM_X 0x380BFB EXTERN WORD IF_DATA MCMESS 0x380BFB EXTERN /end MEASUREMENT
/begin MEASUREMENT ldebu "Regelabweichung LDR im back up Betrieb" SWORD rel_q1p5 1 100 -49152 49150.5 FUNCTION_LIST LDTVMA IF_DATA DIM_X 0x3824F6 EXTERN WORD IF_DATA MCMESS 0x3824F6 EXTERN /end MEASUREMENT
/begin MEASUREMENT ldfki_w "Ladedruck Filterzeitkonstante aus Kennfeld" UWORD zk10msxs_uw_b655 1 100 0.0100002 655.36 FUNCTION_LIST GGDSAS IF_DATA DIM_X 0x3820A0 EXTERN WORD IF_DATA MCMESS 0x3820A0 EXTERN /end MEASUREMENT
/begin MEASUREMENT ldimn "Aktueller Wert zur Minimalwertbegrenzung I-Anteil LDR" SWORD tv_sw_q0p005 1 100 -163.84 163.835 FUNCTION_LIST LDRPID IF_DATA DIM_X 0x3824CA EXTERN WORD IF_DATA MCMESS 0x3824CA EXTERN /end MEASUREMENT
/begin MEASUREMENT ldimx "Aktueller Wert zur Maximalwertbegrenzung I-Anteil LDR" SWORD tv_sw_q0p005 1 100 -163.84 163.835 FUNCTION_LIST LDRPID IF_DATA DIM_X 0x3824CC EXTERN WORD IF_DATA MCMESS 0x3824CC EXTERN /end MEASUREMENT
/begin MEASUREMENT ldimxa_0_A "Adaptive Korrektur der LDR I-Regler Maximalwertbegrenzung" SWORD tv_sw_q0p005 1 100 -163.84 163.835 FUNCTION_LIST LDRPID T2LID IF_DATA DIM_X 0x3839FC EXTERN WORD IF_DATA MCMESS 0x3839FC EXTERN /end MEASUREMENT
/begin MEASUREMENT ldimxa_1_A "Adaptive Korrektur der LDR I-Regler Maximalwertbegrenzung" SWORD tv_sw_q0p005 1 100 -163.84 163.835 FUNCTION_LIST LDRPID T2LID IF_DATA DIM_X 0x3839FE EXTERN WORD IF_DATA MCMESS 0x3839FE EXTERN /end MEASUREMENT
/begin MEASUREMENT ldimxa_2_A "Adaptive Korrektur der LDR I-Regler Maximalwertbegrenzung" SWORD tv_sw_q0p005 1 100 -163.84 163.835 FUNCTION_LIST LDRPID T2LID IF_DATA DIM_X 0x383A00 EXTERN WORD IF_DATA MCMESS 0x383A00 EXTERN /end MEASUREMENT
/begin MEASUREMENT ldimxa_3_A "Adaptive Korrektur der LDR I-Regler Maximalwertbegrenzung" SWORD tv_sw_q0p005 1 100 -163.84 163.835 FUNCTION_LIST LDRPID T2LID IF_DATA DIM_X 0x383A02 EXTERN WORD IF_DATA MCMESS 0x383A02 EXTERN /end MEASUREMENT
/begin MEASUREMENT ldimxa_4_A "Adaptive Korrektur der LDR I-Regler Maximalwertbegrenzung" SWORD tv_sw_q0p005 1 100 -163.84 163.835 FUNCTION_LIST LDRPID T2LID IF_DATA DIM_X 0x383A04 EXTERN WORD IF_DATA MCMESS 0x383A04 EXTERN /end MEASUREMENT
/begin MEASUREMENT ldimxak "Aktueller korrigierter Begrenzungswert I-Anteil LDR" SWORD tv_sw_q0p005 1 100 -163.84 163.835 FUNCTION_LIST LDRPID DLDR IF_DATA DIM_X 0x3824CE EXTERN WORD IF_DATA MCMESS 0x3824CE EXTERN /end MEASUREMENT
/begin MEASUREMENT ldimxr "Aktueller Referenzwert zur Maximalwertbegrenzung I-Anteil LDR" SWORD tv_sw_q0p005 1 100 -163.84 163.835 FUNCTION_LIST LDRPID IF_DATA DIM_X 0x3824D0 EXTERN WORD IF_DATA MCMESS 0x3824D0 EXTERN /end MEASUREMENT
/begin MEASUREMENT lditv_w "LDR, Tastverhältnis vom I-Regler (word)" SWORD tv_sw_q0p005 1 100 -163.84 163.835 FUNCTION_LIST LDRPID FUEDK IF_DATA DIM_X 0x3824D2 EXTERN WORD IF_DATA MCMESS 0x3824D2 EXTERN /end MEASUREMENT
/begin MEASUREMENT ldptv "LDR, Tastverhältnis vom P-Regler" SWORD tv_sw_q0p005 1 100 -163.84 163.835 FUNCTION_LIST LDRPID IF_DATA DIM_X 0x3824D4 EXTERN WORD IF_DATA MCMESS 0x3824D4 EXTERN /end MEASUREMENT
/begin MEASUREMENT ldrdtv "LDR Tastverhältnis vom D-Regler" SWORD tv_sw_q0p005 1 100 -163.84 163.835 FUNCTION_LIST LDRPID IF_DATA DIM_X 0x3824D6 EXTERN WORD IF_DATA MCMESS 0x3824D6 EXTERN /end MEASUREMENT
/begin MEASUREMENT ldrkd "LDR-Reglerparameter für D-Anteil" UWORD rel_uw_b3276p75 1 100 0 3276.75 FUNCTION_LIST LDRPID IF_DATA DIM_X 0x3824D8 EXTERN WORD IF_DATA MCMESS 0x3824D8 EXTERN /end MEASUREMENT
/begin MEASUREMENT ldrki "LDR-Reglerparameter für I-Anteil" UWORD rel_uw_b3276p75 1 100 0 3276.75 FUNCTION_LIST LDRPID IF_DATA DIM_X 0x3824DA EXTERN WORD IF_DATA MCMESS 0x3824DA EXTERN /end MEASUREMENT
/begin MEASUREMENT ldrkp "LDR-Reglerparameter für P-Anteil" UWORD rel_uw_b3276p75 1 100 0 3276.75 FUNCTION_LIST LDRPID IF_DATA DIM_X 0x3824DC EXTERN WORD IF_DATA MCMESS 0x3824DC EXTERN /end MEASUREMENT
/begin MEASUREMENT ldrlms_w "Begrenzungswert für maximale Füllung LDR für Motorschutz" UWORD rel_uw_q0p0234 1 100 0 1535.98 FUNCTION_LIST LDRLMX T2LID IF_DATA DIM_X 0x3824BA EXTERN WORD IF_DATA MCMESS 0x3824BA EXTERN /end MEASUREMENT
/begin MEASUREMENT ldrlts_w "Begrenzungswert für maximale Füllung LDR für ATL-Schutz" UWORD rel_uw_q0p0234 1 100 0 1535.98 FUNCTION_LIST LDRLMX T2LID IF_DATA DIM_X 0x3824BC EXTERN WORD IF_DATA MCMESS 0x3824BC EXTERN /end MEASUREMENT
/begin MEASUREMENT ldtv "LDR Tastverhältnis" SWORD tv_sw_q0p005 1 100 -163.84 163.835 FUNCTION_LIST LDRPID LDTVMA IF_DATA DIM_X 0x3824DE EXTERN WORD IF_DATA MCMESS 0x3824DE EXTERN /end MEASUREMENT
/begin MEASUREMENT ldtvbu_w "LDR Tastverhältnis vom back up Regler" SWORD rel_sw_b50 1 100 -50 49.9985 FUNCTION_LIST LDTVMA IF_DATA DIM_X 0x3824F8 EXTERN WORD IF_DATA MCMESS 0x3824F8 EXTERN /end MEASUREMENT
/begin MEASUREMENT ldtvm "LDR Tastverhältnis , moduliert (Endergebnis)" UBYTE tv_ub_b100 1 100 0 99.6094 FUNCTION_LIST LDTVMA DLDE T2LID VHW IF_DATA DIM_X 0x380BFE EXTERN WORD IF_DATA MCMESS 0x380BFE EXTERN /end MEASUREMENT
/begin MEASUREMENT ldtvmd "LDR-Tastverhältnis aus Md-Koordination" SWORD tv_ub_b100 1 100 -12800 12799.6 FUNCTION_LIST LDTVMA IF_DATA DIM_X 0x3824FA EXTERN WORD IF_DATA MCMESS 0x3824FA EXTERN /end MEASUREMENT
/begin MEASUREMENT ldtvr_w "LDR Tastverhältnis vom Regler" SWORD tv_sw_q0p005 1 100 -163.84 163.835 FUNCTION_LIST LDRPID IF_DATA DIM_X 0x3824E0 EXTERN WORD IF_DATA MCMESS 0x3824E0 EXTERN /end MEASUREMENT
/begin MEASUREMENT len_hiseg "Länge des letzten 'high' Phasensegmentes im Schnellstart" UBYTE dez 1 100 0 255 FUNCTION_LIST GGDPG IF_DATA DIM_X 0xF9D4 INTERN WORD IF_DATA MCMESS 0xF9D4 INTERN /end MEASUREMENT
/begin MEASUREMENT len_loseg "Länge des letzten 'low' Phasensegmentes im Schnellstart" UBYTE dez 1 100 0 255 FUNCTION_LIST GGDPG IF_DATA DIM_X 0xF9D5 INTERN WORD IF_DATA MCMESS 0xF9D5 INTERN /end MEASUREMENT
/begin MEASUREMENT limax_w "LLR-Integrator-Maximalwert" SWORD rel_sw_b100 1 100 -100 99.9969 FUNCTION_LIST LLRRM DLLR IF_DATA DIM_X 0x38253E EXTERN WORD IF_DATA MCMESS 0x38253E EXTERN /end MEASUREMENT
/begin MEASUREMENT limin_w "LLR-Integrator-Minimalwert" SWORD rel_sw_b100 1 100 -100 99.9969 FUNCTION_LIST LLRRM DLLR IF_DATA DIM_X 0x382540 EXTERN WORD IF_DATA MCMESS 0x382540 EXTERN /end MEASUREMENT
/begin MEASUREMENT limnst "LLR-Integrator-Minimalwert während Nachstart" UBYTE rel_ub_b24p9 1 100 0 24.9 FUNCTION_LIST LLRRM IF_DATA DIM_X 0x380C10 EXTERN WORD IF_DATA MCMESS 0x380C10 EXTERN /end MEASUREMENT
/begin MEASUREMENT lkrnew "Lastwert Zeitpunkt t" SWORD rel_sw_q0p0234 1 100 -768 767.977 FUNCTION_LIST KRDY IF_DATA DIM_X 0x38246E EXTERN WORD IF_DATA MCMESS 0x38246E EXTERN /end MEASUREMENT
/begin MEASUREMENT lkrold "Lastwert Zeitpunkt t-dt" SWORD rel_sw_q0p0234 1 100 -768 767.977 FUNCTION_LIST KRDY IF_DATA DIM_X 0x382470 EXTERN WORD IF_DATA MCMESS 0x382470 EXTERN /end MEASUREMENT
/begin MEASUREMENT lkrw "aktueller Wert der Lastschwelle Klopfregelung" UBYTE rel_ub_q0p75 1 100 0 191.25 FUNCTION_LIST KRRA IF_DATA DIM_X 0x380BD1 EXTERN WORD IF_DATA MCMESS 0x380BD1 EXTERN /end MEASUREMENT
/begin MEASUREMENT lmskh_w "Lambda-Motor-Soll bei katheizen (word)" UWORD fak_q0p000244 1 100 0 15.9998 FUNCTION_LIST LAKH IF_DATA DIM_X 0x382420 EXTERN WORD IF_DATA MCMESS 0x382420 EXTERN /end MEASUREMENT
/begin MEASUREMENT lmssl2_w "Lambda-Motor-Soll wegen Sekundärluft bei Kathezen, Bank 2" UWORD fak_q0p000244 1 100 0 15.9998 FUNCTION_LIST LAKH IF_DATA DIM_X 0x382422 EXTERN WORD IF_DATA MCMESS 0x382422 EXTERN /end MEASUREMENT
/begin MEASUREMENT lmssl_w "Lambda-Motor-Soll wegen Sekundärluft bei Katheizen (word)" UWORD fak_q0p000244 1 100 0 15.9998 FUNCTION_LIST LAKH IF_DATA DIM_X 0x382424 EXTERN WORD IF_DATA MCMESS 0x382424 EXTERN /end MEASUREMENT
/begin MEASUREMENT LokBits1 "" UBYTE dez 1 100 0 255 FUNCTION_LIST DLSAHK IF_DATA DIM_X 0x380A7B EXTERN WORD IF_DATA MCMESS 0x380A7B EXTERN /end MEASUREMENT
/begin MEASUREMENT lokBits_Aekp "" UBYTE dez 1 100 0 255 FUNCTION_LIST AEKP IF_DATA DIM_X 0x380D1F EXTERN WORD IF_DATA MCMESS 0x380D1F EXTERN /end MEASUREMENT
/begin MEASUREMENT lrkaz "Zustandsbyte des Automaten Kat-Ausräumen" UBYTE dez 1 100 0 255 FUNCTION_LIST LRSKA IF_DATA DIM_X 0x380C84 EXTERN WORD IF_DATA MCMESS 0x380C84 EXTERN /end MEASUREMENT
/begin MEASUREMENT lrkaz2 "Zustandsbyte des Automaten Kat-Ausräumen für Stereo-LR Bank 2" UBYTE dez 1 100 0 255 FUNCTION_LIST LRSKA IF_DATA DIM_X 0x380C85 EXTERN WORD IF_DATA MCMESS 0x380C85 EXTERN /end MEASUREMENT
/begin MEASUREMENT lrnstep_c "Zähler für Lerndauer eines Lernsteps" UBYTE dez 1 100 0 255 FUNCTION_LIST BGDVE DDVE T2DVE IF_DATA DIM_X 0x380AA9 EXTERN WORD IF_DATA MCMESS 0x380AA9 EXTERN /end MEASUREMENT
/begin MEASUREMENT lrntim_c "Zeitzähler für Wartezeit in den Lernschritten" UBYTE t20msxs_ub_b5p1 1 100 0 5.1 FUNCTION_LIST BGDVE IF_DATA DIM_X 0x380AAA EXTERN WORD IF_DATA MCMESS 0x380AAA EXTERN /end MEASUREMENT
/begin MEASUREMENT lrnvb_c "Lernverbotszähler (Wartezeit)" UWORD t20msxs_uw_q0p02 1 100 0 1310.7 FUNCTION_LIST BGDVE IF_DATA DIM_X 0x381E72 EXTERN WORD IF_DATA MCMESS 0x381E72 EXTERN /end MEASUREMENT
/begin MEASUREMENT lrsg1_w "Interner Reglerkoeffizient stetige Lambdaregelung" SWORD fak_sw_b32 1 100 -32 31.999 FUNCTION_LIST LRS IF_DATA DIM_X 0x38299A EXTERN WORD IF_DATA MCMESS 0x38299A EXTERN /end MEASUREMENT
/begin MEASUREMENT lrsg2_w "Interner Reglerkoeffizient stetige Lambdaregelung" UWORD fak_uw_b64 1 100 0 63.999 FUNCTION_LIST LRS IF_DATA DIM_X 0x38299C EXTERN WORD IF_DATA MCMESS 0x38299C EXTERN /end MEASUREMENT
/begin MEASUREMENT lrsg4_w "Interner Reglerkoeffizient stetige Lambdaregelung" SWORD fak_sw_b2 1 100 -2 1.99994 FUNCTION_LIST LRS IF_DATA DIM_X 0x38299E EXTERN WORD IF_DATA MCMESS 0x38299E EXTERN /end MEASUREMENT
/begin MEASUREMENT lrsp1_w "Interner Reglerkoeffizient stetige Lambdaregelung" UWORD fak_uw_b128 1 100 0 127.998 FUNCTION_LIST LRS IF_DATA DIM_X 0x3829A0 EXTERN WORD IF_DATA MCMESS 0x3829A0 EXTERN /end MEASUREMENT
/begin MEASUREMENT lrsp2_w "Interner Reglerkoeffizient stetige Lambdaregelung" UWORD fak_uw_b128 1 100 0 127.998 FUNCTION_LIST LRS IF_DATA DIM_X 0x3829A2 EXTERN WORD IF_DATA MCMESS 0x3829A2 EXTERN /end MEASUREMENT
/begin MEASUREMENT lrsp3_w "Interner Reglerkoeffizient stetige Lambdaregelung" UWORD fak_uw_b128 1 100 0 127.998 FUNCTION_LIST LRS IF_DATA DIM_X 0x3829A4 EXTERN WORD IF_DATA MCMESS 0x3829A4 EXTERN /end MEASUREMENT
/begin MEASUREMENT lrsp4_w "Interner Reglerkoeffizient stetige Lambdaregelung" SWORD fak_sw_b64 1 100 -64 63.998 FUNCTION_LIST LRS IF_DATA DIM_X 0x3829A6 EXTERN WORD IF_DATA MCMESS 0x3829A6 EXTERN /end MEASUREMENT
/begin MEASUREMENT lrsw12_w "Interner Reglerzustand stetige Lambdaregelung;Bank2" SWORD fak_sw_b4 1 100 -4 3.99988 FUNCTION_LIST LRS IF_DATA DIM_X 0x3829A8 EXTERN WORD IF_DATA MCMESS 0x3829A8 EXTERN /end MEASUREMENT
/begin MEASUREMENT lrsw1_w "Interner Reglerzustand stetige Lambdaregelung" SWORD fak_sw_b4 1 100 -4 3.99988 FUNCTION_LIST LRS IF_DATA DIM_X 0x3829AA EXTERN WORD IF_DATA MCMESS 0x3829AA EXTERN /end MEASUREMENT
/begin MEASUREMENT lrsw22_w "Interner Reglerzustand stetige Lambdaregelung;Bank2" SWORD fak_sw_b4 1 100 -4 3.99988 FUNCTION_LIST LRS IF_DATA DIM_X 0x3829AC EXTERN WORD IF_DATA MCMESS 0x3829AC EXTERN /end MEASUREMENT
/begin MEASUREMENT lrsw2_w "Interner Reglerzustand stetige Lambdaregelung" SWORD fak_sw_b4 1 100 -4 3.99988 FUNCTION_LIST LRS IF_DATA DIM_X 0x3829AE EXTERN WORD IF_DATA MCMESS 0x3829AE EXTERN /end MEASUREMENT
/begin MEASUREMENT lrsxk12_w "Interner Reglerzustand stetige Lambdaregelung;Bank 2" SWORD fak_sw_b1 1 100 -1 0.999969 FUNCTION_LIST LRS IF_DATA DIM_X 0x3829B0 EXTERN WORD IF_DATA MCMESS 0x3829B0 EXTERN /end MEASUREMENT
/begin MEASUREMENT lrsxk1_w "Interner Reglerzustand stetige Lambdaregelung" SWORD fak_sw_b1 1 100 -1 0.999969 FUNCTION_LIST LRS IF_DATA DIM_X 0x3829B2 EXTERN WORD IF_DATA MCMESS 0x3829B2 EXTERN /end MEASUREMENT
/begin MEASUREMENT lrsxk32_w "Interner Reglerzustand stetige Lambdaregelung;Bank2" SWORD fak_sw_b1 1 100 -1 0.999969 FUNCTION_LIST LRS IF_DATA DIM_X 0x3829B4 EXTERN WORD IF_DATA MCMESS 0x3829B4 EXTERN /end MEASUREMENT
/begin MEASUREMENT lrsxk3_w "Interner Reglerzustand stetige Lambdaregelung" SWORD fak_sw_b1 1 100 -1 0.999969 FUNCTION_LIST LRS IF_DATA DIM_X 0x3829B6 EXTERN WORD IF_DATA MCMESS 0x3829B6 EXTERN /end MEASUREMENT
/begin MEASUREMENT lrsxk42_w "Interner Reglerzustand stetige Lambdaregelung;Bank2" SWORD fak_sw_b1 1 100 -1 0.999969 FUNCTION_LIST LRS IF_DATA DIM_X 0x3829B8 EXTERN WORD IF_DATA MCMESS 0x3829B8 EXTERN /end MEASUREMENT
/begin MEASUREMENT lrsxk4_w "Interner Reglerzustand stetige Lambdaregelung" SWORD fak_sw_b1 1 100 -1 0.999969 FUNCTION_LIST LRS IF_DATA DIM_X 0x3829BA EXTERN WORD IF_DATA MCMESS 0x3829BA EXTERN /end MEASUREMENT
/begin MEASUREMENT lrsy22_w "Interner Reglerzustand stetige Lambdaregelung;Bank2" SWORD fak_sw_b1 1 100 -1 0.999969 FUNCTION_LIST LRS IF_DATA DIM_X 0x3829BC EXTERN WORD IF_DATA MCMESS 0x3829BC EXTERN /end MEASUREMENT
/begin MEASUREMENT lrsy2_w "Interner Reglerzustand stetige Lambdaregelung" SWORD fak_sw_b1 1 100 -1 0.999969 FUNCTION_LIST LRS IF_DATA DIM_X 0x3829BE EXTERN WORD IF_DATA MCMESS 0x3829BE EXTERN /end MEASUREMENT
/begin MEASUREMENT lrsy42_w "Interner Reglerzustand stetige Lambdaregelung;Bank2" SWORD fak_sw_b8 1 100 -8 7.99976 FUNCTION_LIST LRS IF_DATA DIM_X 0x3829C0 EXTERN WORD IF_DATA MCMESS 0x3829C0 EXTERN /end MEASUREMENT
/begin MEASUREMENT lrsy4_w "Interner Reglerzustand stetige Lambdaregelung" SWORD fak_sw_b8 1 100 -8 7.99976 FUNCTION_LIST LRS IF_DATA DIM_X 0x3829C2 EXTERN WORD IF_DATA MCMESS 0x3829C2 EXTERN /end MEASUREMENT
/begin MEASUREMENT lrsza "Interpolationsergebnis der LRS-Zwangsamplitude" UBYTE fak_ub_b0p25 1 100 0 0.249023 FUNCTION_LIST LRS IF_DATA DIM_X 0x380C88 EXTERN WORD IF_DATA MCMESS 0x380C88 EXTERN /end MEASUREMENT
/begin MEASUREMENT luar "Laufunruhe-Abstandsmass-Referenzwert" SBYTE luquant 1 100 -232.831 231.012 FUNCTION_LIST DMDLUA IF_DATA DIM_X 0x38099F EXTERN WORD IF_DATA MCMESS 0x38099F EXTERN /end MEASUREMENT
/begin MEASUREMENT luarmn "Laufunruhe-Abstandsmass-Referenzwert Minimun" SBYTE luquant 1 100 -232.831 231.012 FUNCTION_LIST DMDLUA IF_DATA DIM_X 0x3809A0 EXTERN WORD IF_DATA MCMESS 0x3809A0 EXTERN /end MEASUREMENT
/begin MEASUREMENT luaroff "Laufunruhe-Abstandsmass-Referenzwert offset" UBYTE luquant 1 100 0 463.842 FUNCTION_LIST DMDLUA IF_DATA DIM_X 0x3809A1 EXTERN WORD IF_DATA MCMESS 0x3809A1 EXTERN /end MEASUREMENT
/begin MEASUREMENT luar_m "Monitor, Laufunruhe-Abstandsmaß-Referenzwert, verzögerte Ausgabe" SBYTE luquant 1 100 -232.831 231.012 FUNCTION_LIST DMDLUA IF_DATA DIM_X 0xE3EF INTERN WORD IF_DATA MCMESS 0xE3EF INTERN /end MEASUREMENT
/begin MEASUREMENT lums "Laufunruhe-Mittelwert für Erkennung Mehrfachaussetzer, signed" SBYTE luquant 1 100 -232.831 231.012 FUNCTION_LIST DMDLU IF_DATA DIM_X 0xE463 INTERN WORD IF_DATA MCMESS 0xE463 INTERN /end MEASUREMENT
/begin MEASUREMENT lums_m "Monitor, Laufunruhe-Mittelwert für Erkennung Mehrfachaussetzer, signed" SBYTE luquant 1 100 -232.831 231.012 FUNCTION_LIST DMDLU IF_DATA DIM_X 0xE45B INTERN WORD IF_DATA MCMESS 0xE45B INTERN /end MEASUREMENT
/begin MEASUREMENT lunw "Laufunruhe über 1 NW-Umdr." UBYTE luquant 1 100 0 463.842 FUNCTION_LIST DMDFON IF_DATA DIM_X 0x3809A9 EXTERN WORD IF_DATA MCMESS 0x3809A9 EXTERN /end MEASUREMENT
/begin MEASUREMENT lurms "Laufunruhe-Referenzwert für Mehrfachaussetzererkennung, -> Vgl. mit Lum, signed" SBYTE luquant 1 100 -232.831 231.012 FUNCTION_LIST DMDLU IF_DATA DIM_X 0x3809A5 EXTERN WORD IF_DATA MCMESS 0x3809A5 EXTERN /end MEASUREMENT
/begin MEASUREMENT lurms_m "Monitor, Laufunruhe-Referenzwert für Mehrfachaussetzererkenng, signed" SBYTE luquant 1 100 -232.831 231.012 FUNCTION_LIST DMDLU IF_DATA DIM_X 0xE45A INTERN WORD IF_DATA MCMESS 0xE45A INTERN /end MEASUREMENT
/begin MEASUREMENT lurs "Laufunruhe-Referenzwert, signed" SBYTE luquant 1 100 -232.831 231.012 FUNCTION_LIST DMDLU IF_DATA DIM_X 0x380976 EXTERN WORD IF_DATA MCMESS 0x380976 EXTERN /end MEASUREMENT
/begin MEASUREMENT lursktm "tmot-abhängiger offset zum Laufunruhe-Referenzwert dlurs, signed" SBYTE luquant 1 100 -232.831 231.012 FUNCTION_LIST DMDLU IF_DATA DIM_X 0x3809B0 EXTERN WORD IF_DATA MCMESS 0x3809B0 EXTERN /end MEASUREMENT
/begin MEASUREMENT lurste "" UBYTE fak_ub_b2 1 100 0 1.99219 FUNCTION_LIST DMDLU_C IF_DATA DIM_X 0xF9AA INTERN WORD IF_DATA MCMESS 0xF9AA INTERN /end MEASUREMENT
/begin MEASUREMENT lurs_m "Monitor Laufunruhe-Referenzwert, signed" SBYTE luquant 1 100 -232.831 231.012 FUNCTION_LIST DMDLU IF_DATA DIM_X 0xE458 INTERN WORD IF_DATA MCMESS 0xE458 INTERN /end MEASUREMENT
/begin MEASUREMENT lurs_min "Wert von LUR falls Adaption nicht abgeschlossen, Wert aus LURMIN*" UBYTE luquant 1 100 0 463.842 FUNCTION_LIST DMDLU IF_DATA DIM_X 0x380977 EXTERN WORD IF_DATA MCMESS 0x380977 EXTERN /end MEASUREMENT
/begin MEASUREMENT luts "Laufunruhe-Testgröße, signed" SBYTE luquant 1 100 -232.831 231.012 FUNCTION_LIST DMDLU IF_DATA DIM_X 0xE3F5 INTERN WORD IF_DATA MCMESS 0xE3F5 INTERN /end MEASUREMENT
/begin MEASUREMENT luts1 "Laufunruhe-Testgröße von Zylinder 1 bzw. Zündung 1, signed" SBYTE luquant 1 100 -232.831 231.012 FUNCTION_LIST DMDLU IF_DATA DIM_X 0x38097F EXTERN WORD IF_DATA MCMESS 0x38097F EXTERN /end MEASUREMENT
/begin MEASUREMENT luts2 "Laufunruhe-Testgröße von Zylinder 2 bzw. Zündung 2, signed" SBYTE luquant 1 100 -232.831 231.012 FUNCTION_LIST DMDLU IF_DATA DIM_X 0x380980 EXTERN WORD IF_DATA MCMESS 0x380980 EXTERN /end MEASUREMENT
/begin MEASUREMENT luts3 "Laufunruhe-Testgröße von Zylinder 3 bzw. Zündung 3, signed" SBYTE luquant 1 100 -232.831 231.012 FUNCTION_LIST DMDLU IF_DATA DIM_X 0x380981 EXTERN WORD IF_DATA MCMESS 0x380981 EXTERN /end MEASUREMENT
/begin MEASUREMENT luts4 "Laufunruhe-Testgröße von Zylinder 4 bzw. Zündung 4, signed" SBYTE luquant 1 100 -232.831 231.012 FUNCTION_LIST DMDLU IF_DATA DIM_X 0x380982 EXTERN WORD IF_DATA MCMESS 0x380982 EXTERN /end MEASUREMENT
/begin MEASUREMENT luts5 "Laufunruhe-Testgröße von Zylinder 5 bzw. Zündung 5, signed" SBYTE luquant 1 100 -232.831 231.012 FUNCTION_LIST DMDLU IF_DATA DIM_X 0x380983 EXTERN WORD IF_DATA MCMESS 0x380983 EXTERN /end MEASUREMENT
/begin MEASUREMENT luts6 "Laufunruhe-Testgröße von Zylinder 6 bzw. Zündung 6, signed" SBYTE luquant 1 100 -232.831 231.012 FUNCTION_LIST DMDLU IF_DATA DIM_X 0x380984 EXTERN WORD IF_DATA MCMESS 0x380984 EXTERN /end MEASUREMENT
/begin MEASUREMENT luts7 "Laufunruhe-Testgröße von Zylinder 7 bzw. Zündung 7, signed" SBYTE luquant 1 100 -232.831 231.012 FUNCTION_LIST DMDLU IF_DATA DIM_X 0x380985 EXTERN WORD IF_DATA MCMESS 0x380985 EXTERN /end MEASUREMENT
/begin MEASUREMENT luts8 "Laufunruhe-Testgröße von Zylinder 8 bzw. Zündung 8, signed" SBYTE luquant 1 100 -232.831 231.012 FUNCTION_LIST DMDLU IF_DATA DIM_X 0x380986 EXTERN WORD IF_DATA MCMESS 0x380986 EXTERN /end MEASUREMENT
/begin MEASUREMENT luts_m "Monitor Laufunruhe-Testgröße, signed" SBYTE luquant 1 100 -232.831 231.012 FUNCTION_LIST DMDLU IF_DATA DIM_X 0xE457 INTERN WORD IF_DATA MCMESS 0xE457 INTERN /end MEASUREMENT
/begin MEASUREMENT lzmaxnmot "" UBYTE nmot_ub_q40 1 100 0 10200 FUNCTION_LIST RUNTIME IF_DATA DIM_X 0x3830B6 EXTERN WORD IF_DATA MCMESS 0x3830B6 EXTERN /end MEASUREMENT
/begin MEASUREMENT lzmaxrl "" UBYTE rel_ub_b99p6 1 100 0 99.6094 FUNCTION_LIST RUNTIME IF_DATA DIM_X 0x3830B7 EXTERN WORD IF_DATA MCMESS 0x3830B7 EXTERN /end MEASUREMENT
/begin MEASUREMENT lzmaxstate "" UBYTE dez 1 100 0 255 FUNCTION_LIST RUNTIME IF_DATA DIM_X 0x3830B8 EXTERN WORD IF_DATA MCMESS 0x3830B8 EXTERN /end MEASUREMENT
/begin MEASUREMENT lzmaxwdkba "" UBYTE relDK_ub_b100 1 100 0 100 FUNCTION_LIST RUNTIME IF_DATA DIM_X 0x3830B9 EXTERN WORD IF_DATA MCMESS 0x3830B9 EXTERN /end MEASUREMENT
/begin MEASUREMENT lzmaxwped "" UBYTE rel_ub_b99p6 1 100 0 99.6094 FUNCTION_LIST RUNTIME IF_DATA DIM_X 0x3830BA EXTERN WORD IF_DATA MCMESS 0x3830BA EXTERN /end MEASUREMENT
/begin MEASUREMENT lzs_dash "" UBYTE B_TRUE 1 100 0 1 BIT_MASK 0x10 FUNCTION_LIST RUNTIME IF_DATA DIM_X 0x3830B8 EXTERN BYTE IF_DATA MCMESS 0x3830B8 EXTERN /end MEASUREMENT
/begin MEASUREMENT lzs_kr "" UBYTE B_TRUE 1 100 0 1 BIT_MASK 0x1 FUNCTION_LIST RUNTIME IF_DATA DIM_X 0x3830B8 EXTERN BYTE IF_DATA MCMESS 0x3830B8 EXTERN /end MEASUREMENT
/begin MEASUREMENT lzs_ldr "" UBYTE B_TRUE 1 100 0 1 BIT_MASK 0x4 FUNCTION_LIST RUNTIME IF_DATA DIM_X 0x3830B8 EXTERN BYTE IF_DATA MCMESS 0x3830B8 EXTERN /end MEASUREMENT
/begin MEASUREMENT lzs_lr "" UBYTE B_TRUE 1 100 0 1 BIT_MASK 0x2 FUNCTION_LIST RUNTIME IF_DATA DIM_X 0x3830B8 EXTERN BYTE IF_DATA MCMESS 0x3830B8 EXTERN /end MEASUREMENT
/begin MEASUREMENT lzs_lsd "" UBYTE B_TRUE 1 100 0 1 BIT_MASK 0x8 FUNCTION_LIST RUNTIME IF_DATA DIM_X 0x3830B8 EXTERN BYTE IF_DATA MCMESS 0x3830B8 EXTERN /end MEASUREMENT
/begin MEASUREMENT lzs_sa "" UBYTE B_TRUE 1 100 0 1 BIT_MASK 0x20 FUNCTION_LIST RUNTIME IF_DATA DIM_X 0x3830B8 EXTERN BYTE IF_DATA MCMESS 0x3830B8 EXTERN /end MEASUREMENT
/begin MEASUREMENT m6amsl "Mode 6 - Speicher: Anzahl Werteblöcke bei Prüfung Sekundärluftmasse" UBYTE dez 1 100 0 255 FUNCTION_LIST DSLSLRS IF_DATA DIM_X 0x382F0A EXTERN WORD IF_DATA MCMESS 0x382F0A EXTERN /end MEASUREMENT
/begin MEASUREMENT m6cmsl "Mode 6 - Speicher: Component ID für Prüfung Sekundärluftsystem" UBYTE dez 1 100 0 255 FUNCTION_LIST DSLSLRS TC6MOD IF_DATA DIM_X 0x382F0B EXTERN WORD IF_DATA MCMESS 0x382F0B EXTERN /end MEASUREMENT
/begin MEASUREMENT m6cmsl2 "Mode 6 - Speicher: Component ID für Prüfung Sekundärluftsystem (Bank 2)" UBYTE dez 1 100 0 255 FUNCTION_LIST DSLSLRS TC6MOD IF_DATA DIM_X 0x382F0C EXTERN WORD IF_DATA MCMESS 0x382F0C EXTERN /end MEASUREMENT
/begin MEASUREMENT m6cmslv "Mode 6 - Speicher: Component ID für Prüfung Dichtheit Sekundärluftsystem" UBYTE dez 1 100 0 255 FUNCTION_LIST DSLSLRS TC6MOD IF_DATA DIM_X 0x382F0D EXTERN WORD IF_DATA MCMESS 0x382F0D EXTERN /end MEASUREMENT
/begin MEASUREMENT m6cmslv2 "Mode 6 - Speicher: Component ID für Prüfung Dichtheit Sekundärluftsystem" UBYTE dez 1 100 0 255 FUNCTION_LIST DSLSLRS TC6MOD IF_DATA DIM_X 0x382F0E EXTERN WORD IF_DATA MCMESS 0x382F0E EXTERN /end MEASUREMENT
/begin MEASUREMENT m6cthm "Mode 6 - Speicher: Component ID für Thermostat-Monitoring" UBYTE dez 1 100 0 255 FUNCTION_LIST GGTFM TC6MOD IF_DATA DIM_X 0x383007 EXTERN WORD IF_DATA MCMESS 0x383007 EXTERN /end MEASUREMENT
/begin MEASUREMENT m6smsl2_w "Mode 6 - Speicher: Schwellwert bei Prüfung Sekundärluftmasse, Bank 2" UWORD dez 1 100 0 65535 FUNCTION_LIST DSLSLRS TC6MOD IF_DATA DIM_X 0x383120 EXTERN WORD IF_DATA MCMESS 0x383120 EXTERN /end MEASUREMENT
/begin MEASUREMENT m6smslv2_w "Mode 6 - Speicher: Schwellwert bei Ventildichtheitsprüfung, Bank 2" UWORD dez 1 100 0 65535 FUNCTION_LIST DSLSLRS TC6MOD IF_DATA DIM_X 0x383122 EXTERN WORD IF_DATA MCMESS 0x383122 EXTERN /end MEASUREMENT
/begin MEASUREMENT m6smslv_w "Mode 6 - Speicher: Schwellwert bei Ventildichtheitsprüfung" UWORD dez 1 100 0 65535 FUNCTION_LIST DSLSLRS TC6MOD IF_DATA DIM_X 0x383124 EXTERN WORD IF_DATA MCMESS 0x383124 EXTERN /end MEASUREMENT
/begin MEASUREMENT m6smsl_w "Mode 6 - Speicher: Schwellwert bei Prüfung Sekundärluftmasse" UWORD dez 1 100 0 65535 FUNCTION_LIST DSLSLRS TC6MOD IF_DATA DIM_X 0x383126 EXTERN WORD IF_DATA MCMESS 0x383126 EXTERN /end MEASUREMENT
/begin MEASUREMENT m6sthm_w "Mode 6 - Speicher: Schwellwert für Thermostat-Monitoring" UWORD dez 1 100 0 65535 FUNCTION_LIST GGTFM TC6MOD IF_DATA DIM_X 0x3839F6 EXTERN WORD IF_DATA MCMESS 0x3839F6 EXTERN /end MEASUREMENT
/begin MEASUREMENT m6wmsl2_w "Mode 6 - Speicher: Messwert Sekundärluftmasse bei SL-Einblasung, Bank 2" UWORD dez 1 100 0 65535 FUNCTION_LIST DSLSLRS TC6MOD IF_DATA DIM_X 0x383128 EXTERN WORD IF_DATA MCMESS 0x383128 EXTERN /end MEASUREMENT
/begin MEASUREMENT m6wmslv2_w "Mode 6 - Speicher: Messwert Ventildichtheit, Bank 2" UWORD dez 1 100 0 65535 FUNCTION_LIST DSLSLRS TC6MOD IF_DATA DIM_X 0x38312A EXTERN WORD IF_DATA MCMESS 0x38312A EXTERN /end MEASUREMENT
/begin MEASUREMENT m6wmslv_w "Mode 6 - Speicher: Messwert Ventildichtheit" UWORD dez 1 100 0 65535 FUNCTION_LIST DSLSLRS TC6MOD IF_DATA DIM_X 0x38312C EXTERN WORD IF_DATA MCMESS 0x38312C EXTERN /end MEASUREMENT
/begin MEASUREMENT m6wmsl_w "Mode 6 - Speicher: Messwert Sekundärluftmasse bei SL-Einblasung" UWORD dez 1 100 0 65535 FUNCTION_LIST DSLSLRS TC6MOD IF_DATA DIM_X 0x38312E EXTERN WORD IF_DATA MCMESS 0x38312E EXTERN /end MEASUREMENT
/begin MEASUREMENT m6wthm_w "Mode 6 - Speicher: Meßwert für Thermostat-Monitoring" UWORD dez 1 100 0 65535 FUNCTION_LIST GGTFM TC6MOD IF_DATA DIM_X 0x3839F8 EXTERN WORD IF_DATA MCMESS 0x3839F8 EXTERN /end MEASUREMENT
/begin MEASUREMENT mautmx_w "Moment für Getriebesteuerung" UWORD rel_uw_b100 1 100 0 99.9985 FUNCTION_LIST MDAUTG IF_DATA DIM_X 0x382614 EXTERN WORD IF_DATA MCMESS 0x382614 EXTERN /end MEASUREMENT
/begin MEASUREMENT mdbes_w "Beschleunigungsmoment" SWORD rel_sw_b100 1 100 -100 99.9969 FUNCTION_LIST ARMD IF_DATA DIM_X 0x3825C2 EXTERN WORD IF_DATA MCMESS 0x3825C2 EXTERN /end MEASUREMENT
/begin MEASUREMENT mdfawLokbits "" UBYTE dez 1 100 0 255 FUNCTION_LIST MDFAW IF_DATA DIM_X 0x380C37 EXTERN WORD IF_DATA MCMESS 0x380C37 EXTERN /end MEASUREMENT
/begin MEASUREMENT mdif_w_uc "Differenz zwischen zulässigem und Ist-Moment im Befehlstest" SWORD rel_ub_q0p3906 1 100 -12800 12799.6 FUNCTION_LIST URCMVER IF_DATA DIM_X 0x382936 EXTERN WORD IF_DATA MCMESS 0x382936 EXTERN /end MEASUREMENT
/begin MEASUREMENT mdif_w_um "Differenz zwischen zulässigem und Ist-Moment in der Funktionsüberwachung" SWORD rel_ub_q0p3906 1 100 -12800 12799.6 FUNCTION_LIST UFMVER IF_DATA DIM_X 0x382910 EXTERN WORD IF_DATA MCMESS 0x382910 EXTERN /end MEASUREMENT
/begin MEASUREMENT mdindg_w "indiziertes Motormoment Hochdruckphase wenn alle Zylinder befeuert" UWORD rel_uw_b100 1 100 0 99.9985 FUNCTION_LIST MDIST IF_DATA DIM_X 0x382692 EXTERN WORD IF_DATA MCMESS 0x382692 EXTERN /end MEASUREMENT
/begin MEASUREMENT mdko "Momentenaufnahme Klimakompressor" UBYTE rel_ub_b99p6 1 100 0 99.6094 FUNCTION_LIST MDVERB KOS IF_DATA DIM_X 0x380C15 EXTERN WORD IF_DATA MCMESS 0x380C15 EXTERN /end MEASUREMENT
/begin MEASUREMENT mdlf1f "Momentenaufnahme Lüfterstufe 1" UBYTE rel_ub_b99p6 1 100 0 99.6094 FUNCTION_LIST MDVERB IF_DATA DIM_X 0x380C16 EXTERN WORD IF_DATA MCMESS 0x380C16 EXTERN /end MEASUREMENT
/begin MEASUREMENT mdlf2f "Momentenaufnahme Lüfterstufe 2" UBYTE rel_ub_b99p6 1 100 0 99.6094 FUNCTION_LIST MDVERB IF_DATA DIM_X 0x380C17 EXTERN WORD IF_DATA MCMESS 0x380C17 EXTERN /end MEASUREMENT
/begin MEASUREMENT mdlfges "Gesamte Momentenaufnahme Motorlüfter" UBYTE rel_ub_b99p6 1 100 0 99.6094 FUNCTION_LIST MDVERB IF_DATA DIM_X 0x380C18 EXTERN WORD IF_DATA MCMESS 0x380C18 EXTERN /end MEASUREMENT
/begin MEASUREMENT mdmsgf "Momentenaufnahme Motorspülgebläse" UBYTE rel_ub_b99p6 1 100 0 99.6094 FUNCTION_LIST MDVERB IF_DATA DIM_X 0x380C19 EXTERN WORD IF_DATA MCMESS 0x380C19 EXTERN /end MEASUREMENT
/begin MEASUREMENT mdst08_uc "" UWORD dez 1 100 0 65535 FUNCTION_LIST URCMZUL IF_DATA DIM_X 0x382934 EXTERN WORD IF_DATA MCMESS 0x382934 EXTERN /end MEASUREMENT
/begin MEASUREMENT mdst08_um "Stützstelle für Momenten-Info (MZ_UM) zur Ermittlung des Momenten-Offsets in FU" UWORD dez 1 100 0 65535 FUNCTION_LIST UFMZUL IF_DATA DIM_X 0x382EA0 EXTERN WORD IF_DATA MCMESS 0x382EA0 EXTERN /end MEASUREMENT
/begin MEASUREMENT mds_w "Motorschleppmoment" UWORD rel_uw_b100 1 100 0 99.9985 FUNCTION_LIST MDVER IF_DATA DIM_X 0x3825A0 EXTERN WORD IF_DATA MCMESS 0x3825A0 EXTERN /end MEASUREMENT
/begin MEASUREMENT mdverb "Momentenbedarf der Nebenaggregate" UBYTE rel_ub_b99p6 1 100 0 99.6094 FUNCTION_LIST MDVERB MDVER IF_DATA DIM_X 0x380C1A EXTERN WORD IF_DATA MCMESS 0x380C1A EXTERN /end MEASUREMENT
/begin MEASUREMENT mdverf_w "Gefiltertes Verlustmoment" UWORD rel_uw_b100 1 100 0 99.9985 FUNCTION_LIST MDVER MDMIN IF_DATA DIM_X 0x3825A2 EXTERN WORD IF_DATA MCMESS 0x3825A2 EXTERN /end MEASUREMENT
/begin MEASUREMENT mdverl_w "Motor-Verlustmoment" UWORD rel_uw_b100 1 100 0 99.9985 FUNCTION_LIST MDVER ARMD CAN MDFAW STMD T2LID IF_DATA DIM_X 0x3825A4 EXTERN WORD IF_DATA MCMESS 0x3825A4 EXTERN /end MEASUREMENT
/begin MEASUREMENT mdwanfkt_w "Drehmomentenaufnahme des Wandlers (Funktionswert)" SWORD rel_sw_b100 1 100 -100 99.9969 FUNCTION_LIST MDWAN IF_DATA DIM_X 0x38258E EXTERN WORD IF_DATA MCMESS 0x38258E EXTERN /end MEASUREMENT
/begin MEASUREMENT mdwan_can "Drehmomentenaufnahme des Wandlers (CAN-Signal)" UBYTE rel_ub_b99p6 1 100 0 99.6094 FUNCTION_LIST CAN MDWAN IF_DATA DIM_X 0x38095C EXTERN WORD IF_DATA MCMESS 0x38095C EXTERN /end MEASUREMENT
/begin MEASUREMENT mdwan_w "Drehmomentaufnahme des Wandlers" SWORD rel_sw_b100 1 100 -100 99.9969 FUNCTION_LIST MDWAN MDVER IF_DATA DIM_X 0x382590 EXTERN WORD IF_DATA MCMESS 0x382590 EXTERN /end MEASUREMENT
/begin MEASUREMENT mfgr_uc "Momentenwunsch aus der Fahrgeschwindigkeitsregelung im Befehlstest" UBYTE rel_ub_q0p3906 1 100 0 99.6094 FUNCTION_LIST URCFGRC URCAUS URCMZUL IF_DATA DIM_X 0x380C62 EXTERN WORD IF_DATA MCMESS 0x380C62 EXTERN /end MEASUREMENT
/begin MEASUREMENT mfgr_um "Momentenwunsch aus der Fahrgeschwindigkeitsregelung für die Funktionsüberwachung" UBYTE rel_ub_q0p3906 1 100 0 99.6094 FUNCTION_LIST UFFGRC UFMZUL IF_DATA DIM_X 0x382E69 EXTERN WORD IF_DATA MCMESS 0x382E69 EXTERN /end MEASUREMENT
/begin MEASUREMENT miasrl_can "Anforderung ""langsamer ASR-Eingriff"" über CAN" UBYTE rel_ub_b99p6 1 100 0 99.6094 FUNCTION_LIST CAN MDEX IF_DATA DIM_X 0x38095D EXTERN WORD IF_DATA MCMESS 0x38095D EXTERN /end MEASUREMENT
/begin MEASUREMENT miasrl_w "Indiziertes Soll-Motormoment ASR für langsamen Eingriff" UWORD rel_uw_b100 1 100 0 99.9985 FUNCTION_LIST MDEX MDKOG MDKOL IF_DATA DIM_X 0x380F7E EXTERN WORD IF_DATA MCMESS 0x380F7E EXTERN /end MEASUREMENT
/begin MEASUREMENT miasrs_can "Anforderung ""schneller ASR-Eingriff"" über CAN" UBYTE rel_ub_b99p6 1 100 0 99.6094 FUNCTION_LIST CAN MDEX IF_DATA DIM_X 0x38095E EXTERN WORD IF_DATA MCMESS 0x38095E EXTERN /end MEASUREMENT
/begin MEASUREMENT miasrs_w "Indiziertes Soll-Motormoment ASR für schnellen Eingriff" UWORD rel_uw_b100 1 100 0 99.9985 FUNCTION_LIST MDEX MDAUTG MDKOG IF_DATA DIM_X 0x380F80 EXTERN WORD IF_DATA MCMESS 0x380F80 EXTERN /end MEASUREMENT
/begin MEASUREMENT miautget_w "Motormoment ohne Getriebeeingriff" UWORD rel_uw_b100 1 100 0 99.9985 FUNCTION_LIST MDAUTG CAN IF_DATA DIM_X 0x382616 EXTERN WORD IF_DATA MCMESS 0x382616 EXTERN /end MEASUREMENT
/begin MEASUREMENT miautgs_w "Motorsollmoment ohne Getriebeeingriff" UWORD rel_uw_b100 1 100 0 99.9985 FUNCTION_LIST MDAUTG CAN IF_DATA DIM_X 0x382618 EXTERN WORD IF_DATA MCMESS 0x382618 EXTERN /end MEASUREMENT
/begin MEASUREMENT mibas_w "indiziertes Basis-Moment" UWORD rel_uw_b100 1 100 0 99.9985 FUNCTION_LIST MDBAS CAN MDAUTG MDKOG MDRED1 MDZW IF_DATA DIM_X 0x382620 EXTERN WORD IF_DATA MCMESS 0x382620 EXTERN /end MEASUREMENT
/begin MEASUREMENT mibdp_w "indiziertes Soll-Motormoment Dashpot" UWORD rel_uw_b100 1 100 0 99.9985 FUNCTION_LIST MDFAW IF_DATA DIM_X 0x38264E EXTERN WORD IF_DATA MCMESS 0x38264E EXTERN /end MEASUREMENT
/begin MEASUREMENT mibeg_w "Begrenzungsmoment" UWORD rel_uw_b100 1 100 0 99.9985 FUNCTION_LIST MDKOG IF_DATA DIM_X 0x382698 EXTERN WORD IF_DATA MCMESS 0x382698 EXTERN /end MEASUREMENT
/begin MEASUREMENT mibgr_w "indiziertes soll-Moment für gangabhängige Kupplungsmomentbegrenzung" UWORD rel_uw_b100 1 100 0 99.9985 FUNCTION_LIST MDBGRG MDAUTG MDKOG MDKOL IF_DATA DIM_X 0x382632 EXTERN WORD IF_DATA MCMESS 0x382632 EXTERN /end MEASUREMENT
/begin MEASUREMENT mibgv_w "indiziertes Moment aus Momentenaufbaubegrenzung" SWORD rel_sw_b100 1 100 -100 99.9969 FUNCTION_LIST MDBGV MDKOL IF_DATA DIM_X 0x382634 EXTERN WORD IF_DATA MCMESS 0x382634 EXTERN /end MEASUREMENT
/begin MEASUREMENT miblsd_w "Begrenztes indiziertes Moment aus Lastschlagdämpfung" UWORD rel_uw_b100 1 100 0 99.9985 FUNCTION_LIST MDFAW IF_DATA DIM_X 0x382650 EXTERN WORD IF_DATA MCMESS 0x382650 EXTERN /end MEASUREMENT
/begin MEASUREMENT miextv_w "von extern gefordertes Moment vor Abwürgeschutz" UWORD rel_uw_b100 1 100 0 99.9985 FUNCTION_LIST MDKOG IF_DATA DIM_X 0x38269A EXTERN WORD IF_DATA MCMESS 0x38269A EXTERN /end MEASUREMENT
/begin MEASUREMENT miext_w "von außen (ASR, GS, usw.) angefordertes indiziertes Motormoment" UWORD rel_uw_b100 1 100 0 99.9985 FUNCTION_LIST MDKOG IF_DATA DIM_X 0x38269C EXTERN WORD IF_DATA MCMESS 0x38269C EXTERN /end MEASUREMENT
/begin MEASUREMENT mifa "indiziertes Motormoment Fahrerwunsch" UBYTE rel_ub_b99p6 1 100 0 99.6094 FUNCTION_LIST MDFAW UFEING VS IF_DATA DIM_X 0x380C38 EXTERN WORD IF_DATA MCMESS 0x380C38 EXTERN /end MEASUREMENT
/begin MEASUREMENT mifabg "" UBYTE rel_ub_b100 1 100 0 99.6094 FUNCTION_LIST CAN IF_DATA DIM_X 0x38095F EXTERN WORD IF_DATA MCMESS 0x38095F EXTERN /end MEASUREMENT
/begin MEASUREMENT mifabh_w "begrenztes ind. Motormoment Fahrerwunsch (sample & hold)" UWORD rel_uw_b100 1 100 0 99.9985 FUNCTION_LIST NMAXMD IF_DATA DIM_X 0x3826C8 EXTERN WORD IF_DATA MCMESS 0x3826C8 EXTERN /end MEASUREMENT
/begin MEASUREMENT mifab_w "Begrenztes indiziertes Fahrerwunschmoment" UWORD rel_uw_b100 1 100 0 99.9985 FUNCTION_LIST MDKOG CAN NMAXMD VMAXMD IF_DATA DIM_X 0x38269E EXTERN WORD IF_DATA MCMESS 0x38269E EXTERN /end MEASUREMENT
/begin MEASUREMENT mifafu_w "Fahrermomentenwunsch für Füllung" UWORD rel_uw_b100 1 100 0 99.9985 FUNCTION_LIST MDKOL FUEDK IF_DATA DIM_X 0x3826AE EXTERN WORD IF_DATA MCMESS 0x3826AE EXTERN /end MEASUREMENT
/begin MEASUREMENT mifakh_w "indiziertes Motormoment für Katheizen" UWORD rel_uw_b100 1 100 0 99.9985 FUNCTION_LIST KHMD IF_DATA DIM_X 0x382408 EXTERN WORD IF_DATA MCMESS 0x382408 EXTERN /end MEASUREMENT
/begin MEASUREMENT mifal_w "Indiziertes Fahrerwunschmoment für Momentenkoordination Füllung" UWORD rel_uw_b100 1 100 0 99.9985 FUNCTION_LIST MDFAW KOS MDKOL IF_DATA DIM_X 0x382652 EXTERN WORD IF_DATA MCMESS 0x382652 EXTERN /end MEASUREMENT
/begin MEASUREMENT mifa_uc "FGR-/ACC- oder Fahrerwunschmoment der Funktion im Befehlstest" UBYTE rel_ub_q0p3906 1 100 0 99.6094 FUNCTION_LIST URCEIN URCFGRC IF_DATA DIM_X 0x380C5A EXTERN WORD IF_DATA MCMESS 0x380C5A EXTERN /end MEASUREMENT
/begin MEASUREMENT mifa_um "FGR-/ACC- oder Fahrerwunschmoment der Funktion für die Funktionsüberwachung" UBYTE rel_ub_q0p3906 1 100 0 99.6094 FUNCTION_LIST UFEING UFFGRC IF_DATA DIM_X 0x382E46 EXTERN WORD IF_DATA MCMESS 0x382E46 EXTERN /end MEASUREMENT
/begin MEASUREMENT mifa_w "indiziertes Motormoment Fahrerwunsch" UWORD rel_uw_b100 1 100 0 99.9985 FUNCTION_LIST MDFAW ARMD CAN KHMD LLRMR MDAUTG MDEX MDKOG MDKOL SSTBER87 TEB IF_DATA DIM_X 0x382654 EXTERN WORD IF_DATA MCMESS 0x382654 EXTERN /end MEASUREMENT
/begin MEASUREMENT migef_w "Gefiltertes indiziertes Fahrerwunschmoment" UWORD rel_uw_b100 1 100 0 99.9985 FUNCTION_LIST MDFAW IF_DATA DIM_X 0x382656 EXTERN WORD IF_DATA MCMESS 0x382656 EXTERN /end MEASUREMENT
/begin MEASUREMENT miges_w "Indiziertes Soll-Motormoment für Getriebeschutz" UWORD rel_uw_b100 1 100 0 99.9985 FUNCTION_LIST MDEX MDKOL IF_DATA DIM_X 0x380F82 EXTERN WORD IF_DATA MCMESS 0x380F82 EXTERN /end MEASUREMENT
/begin MEASUREMENT migsl_w "Inneres Soll-Motormoment zur Füllungsbegrenzung bei GSf" UWORD rel_uw_b100 1 100 0 99.9985 FUNCTION_LIST MDEX MDKOL IF_DATA DIM_X 0x380F84 EXTERN WORD IF_DATA MCMESS 0x380F84 EXTERN /end MEASUREMENT
/begin MEASUREMENT migs_can "Indiziertes Sollmoment für Getriebeeingriff (CAN-Signal)" UBYTE rel_ub_b99p6 1 100 0 99.6094 FUNCTION_LIST CAN MDEX IF_DATA DIM_X 0x380960 EXTERN WORD IF_DATA MCMESS 0x380960 EXTERN /end MEASUREMENT
/begin MEASUREMENT migs_w "Indiziertes Soll-Motormoment GS für schnellen Eingriff" UWORD rel_uw_b100 1 100 0 99.9985 FUNCTION_LIST MDEX MDKOG ZWMIN IF_DATA DIM_X 0x380F86 EXTERN WORD IF_DATA MCMESS 0x380F86 EXTERN /end MEASUREMENT
/begin MEASUREMENT miistoar_w "Istmoment ohne Antiruckel-Anteil" UWORD rel_uw_b100 1 100 0 99.9985 FUNCTION_LIST MDAUTG IF_DATA DIM_X 0x38261A EXTERN WORD IF_DATA MCMESS 0x38261A EXTERN /end MEASUREMENT
/begin MEASUREMENT miist_w "indiziertes Motormoment Hochdruckphase Istwert" UWORD rel_uw_b100 1 100 0 99.9985 FUNCTION_LIST MDIST CAN MDBGV MDFAW T2LID VMAXMD IF_DATA DIM_X 0x382694 EXTERN WORD IF_DATA MCMESS 0x382694 EXTERN /end MEASUREMENT
/begin MEASUREMENT mikscan_w "indiziertes Moment bei Knallstart" UWORD rel_uw_b100 1 100 0 99.9985 FUNCTION_LIST MDEX MDKOG MDKOL IF_DATA DIM_X 0x380F88 EXTERN WORD IF_DATA MCMESS 0x380F88 EXTERN /end MEASUREMENT
/begin MEASUREMENT mill_w "Indiziertes Motormoment im Leerlauf" UWORD rel_uw_b100 1 100 0 99.9985 FUNCTION_LIST MDMIN LLRBB IF_DATA DIM_X 0x382568 EXTERN WORD IF_DATA MCMESS 0x382568 EXTERN /end MEASUREMENT
/begin MEASUREMENT milres_w "Momentenanforderung für Luftpfad mit allen Reserven" UWORD rel_uw_b100 1 100 0 99.9985 FUNCTION_LIST MDKOL MDKOG IF_DATA DIM_X 0x3826B0 EXTERN WORD IF_DATA MCMESS 0x3826B0 EXTERN /end MEASUREMENT
/begin MEASUREMENT milsol_uc "Fahrermomentenwunsch für Füllung im Befehlstest" UBYTE rel_ub_q0p3906 1 100 0 99.6094 FUNCTION_LIST URCEIN URCMZUL IF_DATA DIM_X 0x380C5B EXTERN WORD IF_DATA MCMESS 0x380C5B EXTERN /end MEASUREMENT
/begin MEASUREMENT milsol_um "Fahrermomentenwunsch für Füllung für die Funktionsüberwachung" UBYTE rel_ub_q0p3906 1 100 0 99.6094 FUNCTION_LIST UFEING UFMZUL IF_DATA DIM_X 0x382E47 EXTERN WORD IF_DATA MCMESS 0x382E47 EXTERN /end MEASUREMENT
/begin MEASUREMENT milsol_w "Fahrermomentenwunsch für Füllung" UWORD rel_uw_b100 1 100 0 99.9985 FUNCTION_LIST MDKOL FUEDK MDFUE T2LID UFEING VS IF_DATA DIM_X 0x3826B2 EXTERN WORD IF_DATA MCMESS 0x3826B2 EXTERN /end MEASUREMENT
/begin MEASUREMENT milstat "" UBYTE dez 1 100 0 255 FUNCTION_LIST DMIL IF_DATA DIM_X 0x380A11 EXTERN WORD IF_DATA MCMESS 0x380A11 EXTERN /end MEASUREMENT
/begin MEASUREMENT milstatNOV "" UBYTE dez 1 100 0 255 FUNCTION_LIST DMIL IF_DATA DIM_X 0x382FD6 EXTERN WORD IF_DATA MCMESS 0x382FD6 EXTERN /end MEASUREMENT
/begin MEASUREMENT mil_c "MIL Ansteuerung codiert für CAN" UBYTE dez 1 100 0 255 FUNCTION_LIST DMIL CAN IF_DATA DIM_X 0x380A12 EXTERN WORD IF_DATA MCMESS 0x380A12 EXTERN /end MEASUREMENT
/begin MEASUREMENT mimax_w "maximal erreichbares indiziertes Moment" UWORD rel_uw_b100 1 100 0 99.9985 FUNCTION_LIST MDMAX CAN MDAUTG MDFAW MDKOG T2LID IF_DATA DIM_X 0x3826B4 EXTERN WORD IF_DATA MCMESS 0x3826B4 EXTERN /end MEASUREMENT
/begin MEASUREMENT mimins_w "minimales Schubmoment" UWORD rel_uw_b100 1 100 0 99.9985 FUNCTION_LIST MDMIN IF_DATA DIM_X 0x38256A EXTERN WORD IF_DATA MCMESS 0x38256A EXTERN /end MEASUREMENT
/begin MEASUREMENT mimin_w "Minimales Motor-Moment" UWORD rel_uw_b100 1 100 0 99.9985 FUNCTION_LIST MDMIN MDAUTG MDFAW T2LID IF_DATA DIM_X 0x38256C EXTERN WORD IF_DATA MCMESS 0x38256C EXTERN /end MEASUREMENT
/begin MEASUREMENT mimsr_can "MSR-Wunsch über CAN" UBYTE rel_ub_b99p6 1 100 0 99.6094 FUNCTION_LIST CAN MDEX IF_DATA DIM_X 0x380961 EXTERN WORD IF_DATA MCMESS 0x380961 EXTERN /end MEASUREMENT
/begin MEASUREMENT mimsr_w "Indiziertes Soll-Motormoment MSR" UWORD rel_uw_b100 1 100 0 99.9985 FUNCTION_LIST MDEX MDAUTG MDKOG MDKOL IF_DATA DIM_X 0x380F8A EXTERN WORD IF_DATA MCMESS 0x380F8A EXTERN /end MEASUREMENT
/begin MEASUREMENT mimxl1_w "Maximales optimales Moment bei Lambda = 1" UWORD rel_uw_b100 1 100 0 99.9985 FUNCTION_LIST MDMAX IF_DATA DIM_X 0x3826B6 EXTERN WORD IF_DATA MCMESS 0x3826B6 EXTERN /end MEASUREMENT
/begin MEASUREMENT minbeg_w "Indiziertes Fahrerwunschmoment nach Änderungsbegrenzung" UWORD rel_uw_b100 1 100 0 99.9985 FUNCTION_LIST MDFAW IF_DATA DIM_X 0x382658 EXTERN WORD IF_DATA MCMESS 0x382658 EXTERN /end MEASUREMENT
/begin MEASUREMENT minmxb_w "indiziertes Soll-Moment für NMAX-Begrenzung ohne Begrenzung" SWORD rel_sw_b100 1 100 -100 99.9969 FUNCTION_LIST NMAXMD IF_DATA DIM_X 0x3826D6 EXTERN WORD IF_DATA MCMESS 0x3826D6 EXTERN /end MEASUREMENT
/begin MEASUREMENT minmx_w "Momentenanforderung der Drehzahlbegrenzung" UWORD rel_uw_b100 1 100 0 99.9985 FUNCTION_LIST NMAXMD MDKOG MDKOL IF_DATA DIM_X 0x3826D8 EXTERN WORD IF_DATA MCMESS 0x3826D8 EXTERN /end MEASUREMENT
/begin MEASUREMENT minzahn "Minimale Zahnzahl ab TR-Marke ab dem Zündereignis stattfinden kann" UBYTE dez 1 100 0 255 FUNCTION_LIST AZUE IF_DATA DIM_X 0xF8E4 INTERN WORD IF_DATA MCMESS 0xF8E4 INTERN /end MEASUREMENT
/begin MEASUREMENT mioptl1_w "optimales indiziertes Motormoment bei Lambda = 1" UWORD rel_uw_b100 1 100 0 99.9985 FUNCTION_LIST MDBAS IF_DATA DIM_X 0x382622 EXTERN WORD IF_DATA MCMESS 0x382622 EXTERN /end MEASUREMENT
/begin MEASUREMENT miopt_uc "optimales indiziertes Moment im Befehlstest" UBYTE rel_ub_b99p6 1 100 0 99.6094 FUNCTION_LIST URCMIST IF_DATA DIM_X 0x380C68 EXTERN WORD IF_DATA MCMESS 0x380C68 EXTERN /end MEASUREMENT
/begin MEASUREMENT miopt_um "optimales indiziertes Moment in der Funktionsüberwachung" UBYTE rel_ub_b99p6 1 100 0 99.6094 FUNCTION_LIST UFMIST IF_DATA DIM_X 0x380C4F EXTERN WORD IF_DATA MCMESS 0x380C4F EXTERN /end MEASUREMENT
/begin MEASUREMENT miopt_w "optimales indiziertes Moment" UWORD rel_uw_b100 1 100 0 99.9985 FUNCTION_LIST MDBAS MDIST MDKOG MDRED1 MDZW TEB IF_DATA DIM_X 0x382624 EXTERN WORD IF_DATA MCMESS 0x382624 EXTERN /end MEASUREMENT
/begin MEASUREMENT mired "indiziertes Reduktionsmoment zur VMAX-Regelung" UBYTE rel_ub_b99p6 1 100 0 99.6094 FUNCTION_LIST VMAXMD IF_DATA DIM_X 0x380C47 EXTERN WORD IF_DATA MCMESS 0x380C47 EXTERN /end MEASUREMENT
/begin MEASUREMENT misolp_w "Indiziertes Sollmoment vor Momentenbegrenzung, lokale Größe" UWORD rel_uw_b100 1 100 0 99.9985 FUNCTION_LIST MDKOG IF_DATA DIM_X 0x3826A0 EXTERN WORD IF_DATA MCMESS 0x3826A0 EXTERN /end MEASUREMENT
/begin MEASUREMENT misolv_w "Indiziertes resultierendes Sollmoment vor Momentenbegrenzung" UWORD rel_uw_b100 1 100 0 99.9985 FUNCTION_LIST MDKOG ARMD MDBGV ZWMIN IF_DATA DIM_X 0x3826A2 EXTERN WORD IF_DATA MCMESS 0x3826A2 EXTERN /end MEASUREMENT
/begin MEASUREMENT misol_w "Indiziertes resultierendes Sollmoment" UWORD rel_uw_b100 1 100 0 99.9985 FUNCTION_LIST MDKOG CAN MDRED1 MDZW T2LID ZWMIN IF_DATA DIM_X 0x3826A4 EXTERN WORD IF_DATA MCMESS 0x3826A4 EXTERN /end MEASUREMENT
/begin MEASUREMENT misopl1_w "Solluftmoment, rückgerechnet auf Lambda=1 und zwopt" UWORD rel_uw_b100 1 100 0 99.9985 FUNCTION_LIST MDFUE IF_DATA DIM_X 0x3821BA EXTERN WORD IF_DATA MCMESS 0x3821BA EXTERN /end MEASUREMENT
/begin MEASUREMENT mistt "Startmoment" UBYTE rel_ub_b99p6 1 100 0 99.6094 FUNCTION_LIST STMD LLRBB MDMIN IF_DATA DIM_X 0x380C20 EXTERN WORD IF_DATA MCMESS 0x380C20 EXTERN /end MEASUREMENT
/begin MEASUREMENT miszul_w "Maximal zulässiges indiziertes Moment" UWORD rel_uw_b100 1 100 0 99.9985 FUNCTION_LIST MDZUL MDAUTG MDKOG MDKOL IF_DATA DIM_X 0x3826C2 EXTERN WORD IF_DATA MCMESS 0x3826C2 EXTERN /end MEASUREMENT
/begin MEASUREMENT mitebg_w "Momentvorgabe für Mindestfüllung Tankentlüftung" UWORD rel_uw_b100 1 100 0 99.9985 FUNCTION_LIST TEB MDKOG MDKOL IF_DATA DIM_X 0x382BB8 EXTERN WORD IF_DATA MCMESS 0x382BB8 EXTERN /end MEASUREMENT
/begin MEASUREMENT mivbeb_w "Indiziertes Moment vor Änderungsbegrenzung, nach oben auf mimax_w begrenzt" UWORD rel_uw_b100 1 100 0 99.9985 FUNCTION_LIST MDFAW MDAUTG IF_DATA DIM_X 0x38265A EXTERN WORD IF_DATA MCMESS 0x38265A EXTERN /end MEASUREMENT
/begin MEASUREMENT mivbeg_w "inidziertes Fahrerwunschmoment vor Änderungsbegrenzung" UWORD rel_uw_b100 1 100 0 99.9985 FUNCTION_LIST MDFAW IF_DATA DIM_X 0x38265C EXTERN WORD IF_DATA MCMESS 0x38265C EXTERN /end MEASUREMENT
/begin MEASUREMENT mivmxs "ind. Soll-Motormoment zur Integratorinitialisierung VMAX-Regelung" SBYTE rel_sb_q0p78 1 100 -99.84 99.06 FUNCTION_LIST VMAXMD IF_DATA DIM_X 0x380C48 EXTERN WORD IF_DATA MCMESS 0x380C48 EXTERN /end MEASUREMENT
/begin MEASUREMENT mivmx_w "Indiziertes Sollmoment der VMAX-Regelung" UWORD rel_uw_b100 1 100 0 99.9985 FUNCTION_LIST VMAXMD MDAUTG MDKOG MDKOL IF_DATA DIM_X 0x3826FA EXTERN WORD IF_DATA MCMESS 0x3826FA EXTERN /end MEASUREMENT
/begin MEASUREMENT mizsolv_u "Indiziertes resultierendes Sollmoment für ZW-Eingriff vor Momentenbegrenzung" UBYTE rel_ub_b100 1 100 0 99.6094 FUNCTION_LIST DFFTCNV DFFT DFFTK IF_DATA DIM_X 0x3809F0 EXTERN WORD IF_DATA MCMESS 0x3809F0 EXTERN /end MEASUREMENT
/begin MEASUREMENT mizsolv_w "Indiziertes resultierendes Sollmoment für ZW-Eingriff vor Momentenbegrenzung" UWORD rel_uw_b100 1 100 0 99.9985 FUNCTION_LIST MDKOG DFFTCNV IF_DATA DIM_X 0x3826A6 EXTERN WORD IF_DATA MCMESS 0x3826A6 EXTERN /end MEASUREMENT
/begin MEASUREMENT mizsol_w "Indiziertes resultierendes Sollmoment für ZW-Eingriff" UWORD rel_uw_b100 1 100 0 99.9985 FUNCTION_LIST MDKOG MDZW T2LID IF_DATA DIM_X 0x3826A8 EXTERN WORD IF_DATA MCMESS 0x3826A8 EXTERN /end MEASUREMENT
/begin MEASUREMENT mizufil_w "Zulässiges indiziertes Moment nach Filter" UWORD rel_uw_b100 1 100 0 99.9985 FUNCTION_LIST MDZUL IF_DATA DIM_X 0x3826C4 EXTERN WORD IF_DATA MCMESS 0x3826C4 EXTERN /end MEASUREMENT
/begin MEASUREMENT mizuofil "Zulässiges indiziertes Moment ohne Filter" UBYTE rel_ub_b99p6 1 100 0 99.6094 FUNCTION_LIST MDZUL IF_DATA DIM_X 0x380C40 EXTERN WORD IF_DATA MCMESS 0x380C40 EXTERN /end MEASUREMENT
/begin MEASUREMENT mizuvfil "Zulässiges indiziertes Moment vor Filter" UBYTE rel_ub_b99p6 1 100 0 99.6094 FUNCTION_LIST MDZUL DFFT DFFTK IF_DATA DIM_X 0x380C41 EXTERN WORD IF_DATA MCMESS 0x380C41 EXTERN /end MEASUREMENT
/begin MEASUREMENT mizwmn_w "indiziertes Motormoment beim spätesten Zündwinkel" UWORD rel_uw_b100 1 100 0 99.9985 FUNCTION_LIST MDRED1 CAN MDAUTG MDZW IF_DATA DIM_X 0x3826BA EXTERN WORD IF_DATA MCMESS 0x3826BA EXTERN /end MEASUREMENT
/begin MEASUREMENT mi_duf "Istmoment beim Ansprechen des Momentenvergleichs in der Funktionsüberwachung" UBYTE rel_ub_b99p6 1 100 0 99.6094 FUNCTION_LIST DUF DFFT DFPM IF_DATA DIM_X 0x380C80 EXTERN WORD IF_DATA MCMESS 0x380C80 EXTERN /end MEASUREMENT
/begin MEASUREMENT mi_uc "Berechnetes Ist-Moment im Befehlstest" UBYTE rel_ub_b99p6 1 100 0 99.6094 FUNCTION_LIST URCMIST URCAUS URCMVER IF_DATA DIM_X 0x380C69 EXTERN WORD IF_DATA MCMESS 0x380C69 EXTERN /end MEASUREMENT
/begin MEASUREMENT mi_um "Berechnetes Ist-Moment in der Funktionsüberwachung" UBYTE rel_ub_b99p6 1 100 0 99.6094 FUNCTION_LIST UFMIST DFFT DFFTK DUF UFMVER IF_DATA DIM_X 0x382E6F EXTERN WORD IF_DATA MCMESS 0x382E6F EXTERN /end MEASUREMENT
/begin MEASUREMENT mkar_w "Berechnetes Kupplungsmoment für Antiruckelfunktion" SWORD rel_sw_b100 1 100 -100 99.9969 FUNCTION_LIST ARMD IF_DATA DIM_X 0x3825C4 EXTERN WORD IF_DATA MCMESS 0x3825C4 EXTERN /end MEASUREMENT
/begin MEASUREMENT mkfanb_w "Kupplungsmoment aus begrenztem Fahrerwunsch" SWORD rel_sw_b100 1 100 -100 99.9969 FUNCTION_LIST MDFAW SSTBER87 IF_DATA DIM_X 0x38265E EXTERN WORD IF_DATA MCMESS 0x38265E EXTERN /end MEASUREMENT
/begin MEASUREMENT ml "Luftmassenfluß" UBYTE m_ub_b1020 1 100 0 1020 FUNCTION_LIST BGSRM ATM BBKHZ BGMSABG DFFT DKATLRS DKVS DTEV GGTFM LRS LRSHK LRSKA SLS SSTBER87 T2DFA TEB ZWMIN IF_DATA DIM_X 0xFADA INTERN WORD IF_DATA MCMESS 0xFADA INTERN /end MEASUREMENT
/begin MEASUREMENT mlast_w "geschätztes Lastmoment" SWORD rel_sw_b100 1 100 -100 99.9969 FUNCTION_LIST ARMD IF_DATA DIM_X 0x3825C6 EXTERN WORD IF_DATA MCMESS 0x3825C6 EXTERN /end MEASUREMENT
/begin MEASUREMENT mlbb "Luftmassenfluß gefiltert (Byte), Bank1 bezogen" UBYTE m_ub_b1020 1 100 0 1020 FUNCTION_LIST BGMSABG IF_DATA DIM_X 0x380A4C EXTERN WORD IF_DATA MCMESS 0x380A4C EXTERN /end MEASUREMENT
/begin MEASUREMENT mlbb2 "Luftmassenfluß gefiltert (Byte), Bank2 bezogen" UBYTE m_ub_b1020 1 100 0 1020 FUNCTION_LIST BGMSABG IF_DATA DIM_X 0x380A4D EXTERN WORD IF_DATA MCMESS 0x380A4D EXTERN /end MEASUREMENT
/begin MEASUREMENT mlbb2_w "Luftmassenfluß gefiltert (Word), Bank2 bezogen" UWORD m_uw_b6553p5 1 100 0 6553.5 FUNCTION_LIST BGMSABG DSLSLRS IF_DATA DIM_X 0x381BFE EXTERN WORD IF_DATA MCMESS 0x381BFE EXTERN /end MEASUREMENT
/begin MEASUREMENT mlbb_w "Luftmassenfluß gefiltert (Word), Bank1 bezogen" UWORD m_uw_b6553p5 1 100 0 6553.5 FUNCTION_LIST BGMSABG DSLSLRS IF_DATA DIM_X 0x381C00 EXTERN WORD IF_DATA MCMESS 0x381C00 EXTERN /end MEASUREMENT
/begin MEASUREMENT mlb_w "Luftmassenfluß gefiltert (Word)" UWORD m_uw_b6553p5 1 100 0 6553.5 FUNCTION_LIST LRS IF_DATA DIM_X 0x3829C4 EXTERN WORD IF_DATA MCMESS 0x3829C4 EXTERN /end MEASUREMENT
/begin MEASUREMENT mldmnfho_w "minimale Luftmasse aus KFMLDMN mit einem höhenabhängigen Faktor korrigiert" SWORD m_q0p1 1 100 -3276.8 3276.7 FUNCTION_LIST DHFM IF_DATA DIM_X 0x382074 EXTERN WORD IF_DATA MCMESS 0x382074 EXTERN /end MEASUREMENT
/begin MEASUREMENT mldmn_w "minimale Luftmasse aus Kennfeld KFMLDMN" SWORD m_q0p1 1 100 -3276.8 3276.7 FUNCTION_LIST DHFM IF_DATA DIM_X 0x382076 EXTERN WORD IF_DATA MCMESS 0x382076 EXTERN /end MEASUREMENT
/begin MEASUREMENT mldmx_w "maximale Luftmasse aus Kennfeld KFMLDMX" UWORD m_q0p1 1 100 0 6553.5 FUNCTION_LIST DHFM GGHFM IF_DATA DIM_X 0x382078 EXTERN WORD IF_DATA MCMESS 0x382078 EXTERN /end MEASUREMENT
/begin MEASUREMENT mldyn_w "Luftmassenintegral im Schubbetrieb" UWORD m_q0p00277 1 100 0 182.042 FUNCTION_LIST DLSAHK IF_DATA DIM_X 0x381CBE EXTERN WORD IF_DATA MCMESS 0x381CBE EXTERN /end MEASUREMENT
/begin MEASUREMENT mleitmx_w "Maximale Regeneriergasmasse in Leitung TEV Saugrohr" UWORD m_q2p71Em5_g 1 100 0 1.77775 FUNCTION_LIST BGTEV IF_DATA DIM_X 0x382B74 EXTERN WORD IF_DATA MCMESS 0x382B74 EXTERN /end MEASUREMENT
/begin MEASUREMENT mleit_w "Aktuelle Regeneriergasmasse in Leitung TEV Saugrohr" UWORD m_q2p71Em5_g 1 100 0 1.77775 FUNCTION_LIST BGTEV IF_DATA DIM_X 0x382B76 EXTERN WORD IF_DATA MCMESS 0x382B76 EXTERN /end MEASUREMENT
/begin MEASUREMENT mletanzs_w "Zwischenspeicher: Auf den Zündwinkelwirkungsgrad 100% normierter Luftmassenstrom" UWORD m_q0p004 1 100 0 262.14 FUNCTION_LIST DTEV IF_DATA DIM_X 0x382C44 EXTERN WORD IF_DATA MCMESS 0x382C44 EXTERN /end MEASUREMENT
/begin MEASUREMENT mletan_w "Auf den Zündwinkelwirkungsgrad 100% normierter Luftmassenstrom" UWORD m_q0p004 1 100 0 262.14 FUNCTION_LIST DTEV IF_DATA DIM_X 0x382C46 EXTERN WORD IF_DATA MCMESS 0x382C46 EXTERN /end MEASUREMENT
/begin MEASUREMENT mlhfmas_w "aufsummierte Luftmasse über ein Synchro" UWORD m_uw_b6553p5 1 100 0 6553.5 FUNCTION_LIST GGHFM IF_DATA DIM_X 0xFAC6 INTERN WORD IF_DATA MCMESS 0xFAC6 INTERN /end MEASUREMENT
/begin MEASUREMENT mlhfma_w "Luftmassenabtastwert von HFM 16-Bit" UWORD m_uw_b6553p5 1 100 0 6553.5 FUNCTION_LIST GGHFM IF_DATA DIM_X 0xFAC8 INTERN WORD IF_DATA MCMESS 0xFAC8 INTERN /end MEASUREMENT
/begin MEASUREMENT mlhfmf_w "gefilterter Luftmassen HFM-Mittelwert 16Bit-Wert" UWORD m_q0p1 1 100 0 6553.5 FUNCTION_LIST DHFM IF_DATA DIM_X 0x38207A EXTERN WORD IF_DATA MCMESS 0x38207A EXTERN /end MEASUREMENT
/begin MEASUREMENT mlhfmm_w "Luftmassen HFM-Mittelwert 16Bit-Wert" UWORD m_uw_b6553p5 1 100 0 6553.5 FUNCTION_LIST GGHFM DHFM IF_DATA DIM_X 0xFACA INTERN WORD IF_DATA MCMESS 0xFACA INTERN /end MEASUREMENT
/begin MEASUREMENT mlkge_w "Eingang in Kennfeld KLDPDK" UWORD m_uw_b6553p5 1 100 0 6553.5 FUNCTION_LIST FUEDK IF_DATA DIM_X 0x38212E EXTERN WORD IF_DATA MCMESS 0x38212E EXTERN /end MEASUREMENT
/begin MEASUREMENT mll1 "Luftmassenfluß bezogen auf lambda=1" UBYTE m_ub_b1020 1 100 0 1020 FUNCTION_LIST GGTFM IF_DATA DIM_X 0x380B57 EXTERN WORD IF_DATA MCMESS 0x380B57 EXTERN /end MEASUREMENT
/begin MEASUREMENT mlnka2_w "Luftmasse nach Kat-Ausräumen, Bank 2" UWORD m_uw_b7281 1 100 0 7281.67 FUNCTION_LIST LRSHK IF_DATA DIM_X 0x382A94 EXTERN WORD IF_DATA MCMESS 0x382A94 EXTERN /end MEASUREMENT
/begin MEASUREMENT mlnka_w "Luftmasse nach Kat-Ausräumen" UWORD m_uw_b7281 1 100 0 7281.67 FUNCTION_LIST LRSHK IF_DATA DIM_X 0x382A96 EXTERN WORD IF_DATA MCMESS 0x382A96 EXTERN /end MEASUREMENT
/begin MEASUREMENT mlsol_w "Soll-Luftmassenstrom" UWORD m_uw_b6553p5 1 100 0 6553.5 FUNCTION_LIST FUEDK TEB IF_DATA DIM_X 0x382138 EXTERN WORD IF_DATA MCMESS 0x382138 EXTERN /end MEASUREMENT
/begin MEASUREMENT mlsu "Soll-Luftmasse für Katheizen" UBYTE m_ub_b5p8 1 100 0 5.80267 FUNCTION_LIST BBKHZ IF_DATA DIM_X 0x380B6B EXTERN WORD IF_DATA MCMESS 0x380B6B EXTERN /end MEASUREMENT
/begin MEASUREMENT mlwdknf_w "gefilterter normierter Luftmassenstrom für Sollwinkelbestimmung Drosselklappe" UWORD m_uw_b6553p5 1 100 0 6553.5 FUNCTION_LIST FUEDK IF_DATA DIM_X 0x38213A EXTERN WORD IF_DATA MCMESS 0x38213A EXTERN /end MEASUREMENT
/begin MEASUREMENT ml_w "Luftmassenfluß gefiltert (Word)" UWORD m_uw_b6553p5 1 100 0 6553.5 FUNCTION_LIST BGSRM ATM BGMSABG BGMSZS BGRML DKATLRS DLSAHK DSLSLRS DTEV FUEDK GGDSAS LAKH LRA LRS LRSEB LRSHK LRSKA MDEX SLS SSTBER87 T2DFA T2LID TEB IF_DATA DIM_X 0xFADC INTERN WORD IF_DATA MCMESS 0xFADC INTERN /end MEASUREMENT
/begin MEASUREMENT mmsr_uc "zulässiger MSR-Momentenwunsch für die Funktionsüberwachung" UBYTE rel_ub_q0p3906 1 100 0 99.6094 FUNCTION_LIST URCMSRC URCAUS URCMZUL IF_DATA DIM_X 0x380C64 EXTERN WORD IF_DATA MCMESS 0x380C64 EXTERN /end MEASUREMENT
/begin MEASUREMENT mmsr_um "zulässiger MSR-Momentenwunsch für die Funktionsüberwachung" UBYTE rel_ub_q0p3906 1 100 0 99.6094 FUNCTION_LIST UFMSRC UFMZUL IF_DATA DIM_X 0x382E6C EXTERN WORD IF_DATA MCMESS 0x382E6C EXTERN /end MEASUREMENT
/begin MEASUREMENT mped_uc "zulässiges indiziertes Moment aus Fahrpedal im Befehlstest" UBYTE rel_ub_b99p6 1 100 0 99.6094 FUNCTION_LIST URCMZUL URCAUS IF_DATA DIM_X 0x380C6B EXTERN WORD IF_DATA MCMESS 0x380C6B EXTERN /end MEASUREMENT
/begin MEASUREMENT mped_um "zulässiges indiziertes Moment aus Fahrpedal in der Funktionsüberwachung" UBYTE rel_ub_b99p6 1 100 0 99.6094 FUNCTION_LIST UFMZUL IF_DATA DIM_X 0x380C51 EXTERN WORD IF_DATA MCMESS 0x380C51 EXTERN /end MEASUREMENT
/begin MEASUREMENT mpfad "Momenten-Pfad in Funktion und Funktionsüberwachung als Umweltbedingung für Diag." UBYTE dez 1 100 0 255 FUNCTION_LIST DUF DFFT DFPM IF_DATA DIM_X 0x380C81 EXTERN WORD IF_DATA MCMESS 0x380C81 EXTERN /end MEASUREMENT
/begin MEASUREMENT mracc_w "Relativer Momentenwunsch von ACC" UWORD rel_uw_b100 1 100 0 99.9985 FUNCTION_LIST SWADP FGRUE IF_DATA DIM_X 0x382B2C EXTERN WORD IF_DATA MCMESS 0x382B2C EXTERN /end MEASUREMENT
/begin MEASUREMENT mrfabn "aktuelle gewichtete Leistung (für Dauer-Hochlasterkennung)" UBYTE rel_ub_b100 1 100 0 99.6094 FUNCTION_LIST BBTEGA IF_DATA DIM_X 0x380B14 EXTERN WORD IF_DATA MCMESS 0x380B14 EXTERN /end MEASUREMENT
/begin MEASUREMENT mrfabnf "Tiefpaß-gefilterte gewichtete Leistung - DauerHochlasterkenung" UBYTE rel_ub_b100 1 100 0 99.6094 FUNCTION_LIST BBTEGA IF_DATA DIM_X 0x380B15 EXTERN WORD IF_DATA MCMESS 0x380B15 EXTERN /end MEASUREMENT
/begin MEASUREMENT mrfabugd_w "Relatives Fahrerwunschmoment zu Beginn ungedrosselt" UWORD rel_uw_b200 1 100 0 199.997 FUNCTION_LIST FUEDK IF_DATA DIM_X 0x38213C EXTERN WORD IF_DATA MCMESS 0x38213C EXTERN /end MEASUREMENT
/begin MEASUREMENT mrfamx_w "Relatives Fahrerwunschmoment Maximalwert" UWORD rel_uw_b200 1 100 0 199.997 FUNCTION_LIST MDFAW FUEDK IF_DATA DIM_X 0x382660 EXTERN WORD IF_DATA MCMESS 0x382660 EXTERN /end MEASUREMENT
/begin MEASUREMENT mrfaugd_w "Relatives Fahrerwunschmoment für Pedalüberweg im ungedrosselten" UWORD rel_uw_b200 1 100 0 199.997 FUNCTION_LIST FUEDK IF_DATA DIM_X 0x38213E EXTERN WORD IF_DATA MCMESS 0x38213E EXTERN /end MEASUREMENT
/begin MEASUREMENT mrfa_w "Relatives Fahrerwunschmoment aus FGR und Pedal" UWORD rel_uw_b200 1 100 0 199.997 FUNCTION_LIST MDFAW BBTEGA CAN ESVW FUEDK LAMFAW IF_DATA DIM_X 0x382662 EXTERN WORD IF_DATA MCMESS 0x382662 EXTERN /end MEASUREMENT
/begin MEASUREMENT mrfgri_w "Relatives Moment Initialisierungswert für FGR-Regler" UWORD rel_uw_b200 1 100 0 199.997 FUNCTION_LIST FGRMD IF_DATA DIM_X 0x381F9A EXTERN WORD IF_DATA MCMESS 0x381F9A EXTERN /end MEASUREMENT
/begin MEASUREMENT mrfgrm_w "Relativer Momentenwunsch von FGR (aus ME)" UWORD rel_uw_b200 1 100 0 199.997 FUNCTION_LIST FGRMD FGRUE IF_DATA DIM_X 0x381F9C EXTERN WORD IF_DATA MCMESS 0x381F9C EXTERN /end MEASUREMENT
/begin MEASUREMENT mrfgru_w "Untere Grenze für relatives Moment aus FGR" UWORD rel_uw_b200 1 100 0 199.997 FUNCTION_LIST FGRAUS IF_DATA DIM_X 0x381F8C EXTERN WORD IF_DATA MCMESS 0x381F8C EXTERN /end MEASUREMENT
/begin MEASUREMENT mrfgrv_w "Relativer Momentenwunsch aus FGR vor Begrenzung" UWORD rel_uw_b200 1 100 0 199.997 FUNCTION_LIST FGRUE FGRAUS IF_DATA DIM_X 0x381FDE EXTERN WORD IF_DATA MCMESS 0x381FDE EXTERN /end MEASUREMENT
/begin MEASUREMENT mrfgr_w "Relative Momentenanforderung von FGR" UWORD rel_uw_b200 1 100 0 199.997 FUNCTION_LIST FGRAUS CAN FGRLAMP FGRMD MDFAW IF_DATA DIM_X 0x381F8E EXTERN WORD IF_DATA MCMESS 0x381F8E EXTERN /end MEASUREMENT
/begin MEASUREMENT mrped_w "relatives Fahrerwunschmoment aus Fahrpedal" UWORD rel_uw_b200 1 100 0 199.997 FUNCTION_LIST MDFAW CAN FGRLAMP FGRMD IF_DATA DIM_X 0x382664 EXTERN WORD IF_DATA MCMESS 0x382664 EXTERN /end MEASUREMENT
/begin MEASUREMENT mrregl_w "Relatives Moment Reglerausgang FGR" UWORD rel_uw_b200 1 100 0 199.997 FUNCTION_LIST FGRMD IF_DATA DIM_X 0x381F9E EXTERN WORD IF_DATA MCMESS 0x381F9E EXTERN /end MEASUREMENT
/begin MEASUREMENT mrrgli_w "Initialisierungswert Relatives Moment für FGR-Regler" UWORD rel_uw_b200 1 100 0 199.997 FUNCTION_LIST FGRMD IF_DATA DIM_X 0x381FA0 EXTERN WORD IF_DATA MCMESS 0x381FA0 EXTERN /end MEASUREMENT
/begin MEASUREMENT msabg "Abgasmassenfluß gefiltert, Bank 1" UBYTE m_ub_b1020 1 100 0 1020 FUNCTION_LIST BGMSABG DHLSU DLSU HLSU SSTBER87 IF_DATA DIM_X 0x380A4E EXTERN WORD IF_DATA MCMESS 0x380A4E EXTERN /end MEASUREMENT
/begin MEASUREMENT msabg2 "Abgasmassenfluß gefiltert, Bank 2" UBYTE m_ub_b1020 1 100 0 1020 FUNCTION_LIST BGMSABG DHLSU DLSU HLSU IF_DATA DIM_X 0x380A4F EXTERN WORD IF_DATA MCMESS 0x380A4F EXTERN /end MEASUREMENT
/begin MEASUREMENT msabg2_w "Abgasmassenfluß gefiltert (Word), Bank 2" UWORD m_uw_b6553p5 1 100 0 6553.5 FUNCTION_LIST BGMSABG GGLSU IF_DATA DIM_X 0x381C02 EXTERN WORD IF_DATA MCMESS 0x381C02 EXTERN /end MEASUREMENT
/begin MEASUREMENT msabg_w "Abgasmassenstrom gefiltert (Word), Bank 1" UWORD m_uw_b6553p5 1 100 0 6553.5 FUNCTION_LIST BGMSABG GGLSU T2LID IF_DATA DIM_X 0x381C04 EXTERN WORD IF_DATA MCMESS 0x381C04 EXTERN /end MEASUREMENT
/begin MEASUREMENT msdif_w "Massenstromdifferenz mshfm_w - msdk_w" SWORD m_sw_q0p1 1 100 -3276.8 3276.7 FUNCTION_LIST BGMSZS IF_DATA DIM_X 0x382002 EXTERN WORD IF_DATA MCMESS 0x382002 EXTERN /end MEASUREMENT
/begin MEASUREMENT msdkalm_w "Massenstrom über Drosselklappe (abgeglichen mit HFM Signal)" UWORD m_uw_b6553p5 1 100 0 6553.5 FUNCTION_LIST BGMSZS TEB IF_DATA DIM_X 0x382004 EXTERN WORD IF_DATA MCMESS 0x382004 EXTERN /end MEASUREMENT
/begin MEASUREMENT msdkoo_w "Massenstrom Drosselklappe ohne offset" UWORD m_q0p1 1 100 0 6553.5 FUNCTION_LIST DTEV IF_DATA DIM_X 0x382C48 EXTERN WORD IF_DATA MCMESS 0x382C48 EXTERN /end MEASUREMENT
/begin MEASUREMENT msdks_w "Soll-Luftmassenstrom durch Drosselvorrichtung" UWORD m_uw_b6553p5 1 100 0 6553.5 FUNCTION_LIST FUEDK IF_DATA DIM_X 0x382140 EXTERN WORD IF_DATA MCMESS 0x382140 EXTERN /end MEASUREMENT
/begin MEASUREMENT msdkue_w "Massenstrom über Drosselklappe überkritisch (word)" UWORD m_uw_b6553p5 1 100 0 6553.5 FUNCTION_LIST BGMSZS IF_DATA DIM_X 0x382006 EXTERN WORD IF_DATA MCMESS 0x382006 EXTERN /end MEASUREMENT
/begin MEASUREMENT msdk_w "Massenstrom über Drosselklappe (word)" UWORD m_uw_b6553p5 1 100 0 6553.5 FUNCTION_LIST BGMSZS IF_DATA DIM_X 0x382008 EXTERN WORD IF_DATA MCMESS 0x382008 EXTERN /end MEASUREMENT
/begin MEASUREMENT mshfms_w "Massenstrom HFM (signed Größe)" SWORD m_sw_b3276p8 1 100 -3276.8 3276.7 FUNCTION_LIST GGHFM BGMSZS IF_DATA DIM_X 0xFACC INTERN WORD IF_DATA MCMESS 0xFACC INTERN /end MEASUREMENT
/begin MEASUREMENT mshfm_u "Massenstrom HFM (Byte)" UBYTE m_ub_b1638 1 100 0 1638 FUNCTION_LIST DFFTCNV DFFTK IF_DATA DIM_X 0x3809F1 EXTERN WORD IF_DATA MCMESS 0x3809F1 EXTERN /end MEASUREMENT
/begin MEASUREMENT mshfm_w "Massenstrom HFM 16-Bit Größe" UWORD m_uw_b6553p5 1 100 0 6553.5 FUNCTION_LIST GGHFM BGMSZS BGTEV DFFTCNV T2LID TC1MOD IF_DATA DIM_X 0xFACE INTERN WORD IF_DATA MCMESS 0xFACE INTERN /end MEASUREMENT
/begin MEASUREMENT msl "Sekundärluftmassenstrom" UBYTE m_ub_q0p4 1 100 0 102 FUNCTION_LIST SLS BGMSABG DSLSLRS LRS IF_DATA DIM_X 0x38091B EXTERN WORD IF_DATA MCMESS 0x38091B EXTERN /end MEASUREMENT
/begin MEASUREMENT msl2 "Sekundärluftmasse Bank 2" UBYTE m_ub_q0p4 1 100 0 102 FUNCTION_LIST SLS BGMSABG DSLSLRS LRS IF_DATA DIM_X 0x38091C EXTERN WORD IF_DATA MCMESS 0x38091C EXTERN /end MEASUREMENT
/begin MEASUREMENT mslift "Istwert Sekundärluftmasse, gefiltert, temporär" UBYTE m_q0p4 1 100 0 102 FUNCTION_LIST DSLSLRS IF_DATA DIM_X 0x38090B EXTERN WORD IF_DATA MCMESS 0x38090B EXTERN /end MEASUREMENT
/begin MEASUREMENT mslift2 "Istwert Sekundärluftmasse, gefiltert, temporär (Bank 2)" UBYTE m_q0p4 1 100 0 102 FUNCTION_LIST DSLSLRS IF_DATA DIM_X 0x38090C EXTERN WORD IF_DATA MCMESS 0x38090C EXTERN /end MEASUREMENT
/begin MEASUREMENT mslnenn "Nennwert Sekundärluftmasse" UBYTE m_q0p4 1 100 0 102 FUNCTION_LIST DSLSLRS IF_DATA DIM_X 0x382F0F EXTERN WORD IF_DATA MCMESS 0x382F0F EXTERN /end MEASUREMENT
/begin MEASUREMENT mslnenn2 "Nennwert Sekundärluftmasse, Bank 2" UBYTE m_q0p4 1 100 0 102 FUNCTION_LIST DSLSLRS IF_DATA DIM_X 0x382F10 EXTERN WORD IF_DATA MCMESS 0x382F10 EXTERN /end MEASUREMENT
/begin MEASUREMENT mslnf "Nenn-Sekundärluftmasse, gefiltert" UBYTE m_q0p4 1 100 0 102 FUNCTION_LIST DSLSLRS IF_DATA DIM_X 0x38090D EXTERN WORD IF_DATA MCMESS 0x38090D EXTERN /end MEASUREMENT
/begin MEASUREMENT mslnf2 "Nenn-Sekundärluftmasse, gefiltert, Bank 2" UBYTE m_q0p4 1 100 0 102 FUNCTION_LIST DSLSLRS IF_DATA DIM_X 0x38090E EXTERN WORD IF_DATA MCMESS 0x38090E EXTERN /end MEASUREMENT
/begin MEASUREMENT mslnt "Nenn-Sekundärluftmasse, temporär" UBYTE m_q0p4 1 100 0 102 FUNCTION_LIST DSLSLRS IF_DATA DIM_X 0x38090F EXTERN WORD IF_DATA MCMESS 0x38090F EXTERN /end MEASUREMENT
/begin MEASUREMENT mslnt2 "Nenn-Sekundärluftmasse,temporär, Bank 2" UBYTE m_q0p4 1 100 0 102 FUNCTION_LIST DSLSLRS IF_DATA DIM_X 0x380910 EXTERN WORD IF_DATA MCMESS 0x380910 EXTERN /end MEASUREMENT
/begin MEASUREMENT mslpub "Sekundärluftmassenstrom, batteriespannungsabhängig" UBYTE m_ub_q0p4 1 100 0 102 FUNCTION_LIST SLS IF_DATA DIM_X 0x38091D EXTERN WORD IF_DATA MCMESS 0x38091D EXTERN /end MEASUREMENT
/begin MEASUREMENT mslstat "statischer Sekundärluftmassenstrom" UBYTE m_ub_q0p4 1 100 0 102 FUNCTION_LIST SLS IF_DATA DIM_X 0x38091E EXTERN WORD IF_DATA MCMESS 0x38091E EXTERN /end MEASUREMENT
/begin MEASUREMENT mslt2_w "temporäre Sekundärluftmasse, Bank 2" UWORD m_uw_b6553p5 1 100 0 6553.5 FUNCTION_LIST DSLSLRS IF_DATA DIM_X 0x380E2C EXTERN WORD IF_DATA MCMESS 0x380E2C EXTERN /end MEASUREMENT
/begin MEASUREMENT mslt_w "temporäre Sekundärluftmasse" UWORD m_uw_b6553p5 1 100 0 6553.5 FUNCTION_LIST DSLSLRS IF_DATA DIM_X 0x380E2E EXTERN WORD IF_DATA MCMESS 0x380E2E EXTERN /end MEASUREMENT
/begin MEASUREMENT mslv2_w "Sekundärluftmasse für Ventildichtheitsprüfung (word); Bank 2" UWORD m_q0p0015625 1 100 0 102.398 FUNCTION_LIST DSLSLRS IF_DATA DIM_X 0x380E30 EXTERN WORD IF_DATA MCMESS 0x380E30 EXTERN /end MEASUREMENT
/begin MEASUREMENT mslvft2_w "" SWORD m_q0p0015625 1 100 -51.2 51.1984 FUNCTION_LIST DSLSLRS IF_DATA DIM_X 0x380E32 EXTERN WORD IF_DATA MCMESS 0x380E32 EXTERN /end MEASUREMENT
/begin MEASUREMENT mslvft_w "Sekundärluftventilundichtheit, gefiltert, temporär (word)" SWORD m_q0p0015625 1 100 -51.2 51.1984 FUNCTION_LIST DSLSLRS IF_DATA DIM_X 0x380E34 EXTERN WORD IF_DATA MCMESS 0x380E34 EXTERN /end MEASUREMENT
/begin MEASUREMENT mslvt2_w "temporäre Ventilleckage, Bank 2" SWORD m_sw_q0p1 1 100 -3276.8 3276.7 FUNCTION_LIST DSLSLRS IF_DATA DIM_X 0x380E36 EXTERN WORD IF_DATA MCMESS 0x380E36 EXTERN /end MEASUREMENT
/begin MEASUREMENT mslvt_w "temporäre Ventilleckage" SWORD m_sw_q0p1 1 100 -3276.8 3276.7 FUNCTION_LIST DSLSLRS IF_DATA DIM_X 0x380E38 EXTERN WORD IF_DATA MCMESS 0x380E38 EXTERN /end MEASUREMENT
/begin MEASUREMENT mslv_w "Sekundärluftmasse für Ventildichtheitsprüfung (word)" UWORD m_q0p0015625 1 100 0 102.398 FUNCTION_LIST DSLSLRS IF_DATA DIM_X 0x380E3A EXTERN WORD IF_DATA MCMESS 0x380E3A EXTERN /end MEASUREMENT
/begin MEASUREMENT msndkoos_w "Normierter Luftmassenstrom für Sollwinkelbestimmung Drosselklappe" UWORD m_uw_b6553p5 1 100 0 6553.5 FUNCTION_LIST FUEDK IF_DATA DIM_X 0x382142 EXTERN WORD IF_DATA MCMESS 0x382142 EXTERN /end MEASUREMENT
/begin MEASUREMENT msndkoo_w "normierter Massenstrom Drosselklappe ohne offset (word)" UWORD m_uw_b6553p5 1 100 0 6553.5 FUNCTION_LIST BGMSZS DTEV IF_DATA DIM_X 0x3839AA EXTERN WORD IF_DATA MCMESS 0x3839AA EXTERN /end MEASUREMENT
/begin MEASUREMENT msndko_w "normierter Leckluftmassenstrom über Drosselklappe (word)" UWORD m_uw_b6553p5 1 100 0 6553.5 FUNCTION_LIST BGMSZS BGRLP FUEDK IF_DATA DIM_X 0x3839AC EXTERN WORD IF_DATA MCMESS 0x3839AC EXTERN /end MEASUREMENT
/begin MEASUREMENT msndkpk_w "normierter praedizierter korrig. Massenstrom ueber Drosselklappe (word)" UWORD m_uw_b6553p5 1 100 0 6553.5 FUNCTION_LIST BGRLP IF_DATA DIM_X 0x382204 EXTERN WORD IF_DATA MCMESS 0x382204 EXTERN /end MEASUREMENT
/begin MEASUREMENT msndks_w "Normierter Soll-Luftmassenstrom durch Drosselvorrichtung" UWORD m_uw_b6553p5 1 100 0 6553.5 FUNCTION_LIST FUEDK IF_DATA DIM_X 0x382144 EXTERN WORD IF_DATA MCMESS 0x382144 EXTERN /end MEASUREMENT
/begin MEASUREMENT msndk_w "normierter Massenstrom über Drosselklappe (word)" UWORD m_uw_b6553p5 1 100 0 6553.5 FUNCTION_LIST BGMSZS IF_DATA DIM_X 0x38200A EXTERN WORD IF_DATA MCMESS 0x38200A EXTERN /end MEASUREMENT
/begin MEASUREMENT msnsaug_w "normierter Massenstrom durch Saugrohr (word)" UWORD m_uw_b6553p5 1 100 0 6553.5 FUNCTION_LIST BGMSZS IF_DATA DIM_X 0x38200C EXTERN WORD IF_DATA MCMESS 0x38200C EXTERN /end MEASUREMENT
/begin MEASUREMENT msntate_kge "" UWORD rel_uw_b100 1 100 0 99.9985 FUNCTION_LIST BGTEV IF_DATA DIM_X 0x382B78 EXTERN WORD IF_DATA MCMESS 0x382B78 EXTERN /end MEASUREMENT
/begin MEASUREMENT msntetev_w "normierter, überkritischer Massenstrom durch das TEV" UWORD m_uw_b25p6 1 100 0 25.5996 FUNCTION_LIST BGTEV IF_DATA DIM_X 0x382B7A EXTERN WORD IF_DATA MCMESS 0x382B7A EXTERN /end MEASUREMENT
/begin MEASUREMENT msntevo_w "normierter, überkritischer Massenstrom durch das 100% offene TEV" UWORD m_uw_b25p6 1 100 0 25.5996 FUNCTION_LIST BGTEV ATEV IF_DATA DIM_X 0x382B6E EXTERN WORD IF_DATA MCMESS 0x382B6E EXTERN /end MEASUREMENT
/begin MEASUREMENT msntev_w "gewünschter normierter, überkritischer Massenstrom TEV" UWORD m_uw_b25p6 1 100 0 25.5996 FUNCTION_LIST ATEV IF_DATA DIM_X 0x382B5C EXTERN WORD IF_DATA MCMESS 0x382B5C EXTERN /end MEASUREMENT
/begin MEASUREMENT msnwdk_kge "" UWORD rel_uw_b100 1 100 0 99.9985 FUNCTION_LIST BGMSZS BGRLP IF_DATA DIM_X 0x38200E EXTERN WORD IF_DATA MCMESS 0x38200E EXTERN /end MEASUREMENT
/begin MEASUREMENT msrc_c_uc "Fehlerzähler für MSR-Überwachung des Befehlstestes" UBYTE t40ms_ub_b10200 1 100 0 10200 FUNCTION_LIST URCMSRC URCREF IF_DATA DIM_X 0x380C65 EXTERN WORD IF_DATA MCMESS 0x380C65 EXTERN /end MEASUREMENT
/begin MEASUREMENT msrc_c_um "Fehlerzähler für MSR-Eingriff-Überwachung der Funktionsüberwachung" UBYTE t40ms_ub_b10200 1 100 0 10200 FUNCTION_LIST UFMSRC IF_DATA DIM_X 0x382E6D EXTERN WORD IF_DATA MCMESS 0x382E6D EXTERN /end MEASUREMENT
/begin MEASUREMENT mssaug "Massenstrom durch Saugrohr (Byte)" UBYTE m_ub_q25p6 1 100 0 6528 FUNCTION_LIST BGMSZS IF_DATA DIM_X 0x380AEC EXTERN WORD IF_DATA MCMESS 0x380AEC EXTERN /end MEASUREMENT
/begin MEASUREMENT mssaug_w "Massenstrom durch Saugrohr (word)" UWORD m_uw_b6553p5 1 100 0 6553.5 FUNCTION_LIST BGMSZS IF_DATA DIM_X 0x382010 EXTERN WORD IF_DATA MCMESS 0x382010 EXTERN /end MEASUREMENT
/begin MEASUREMENT mssginmn_w "Minmaler ins Saugrohr strömender Massenstrom (Drosselklappe + TEV)" UWORD m_uw_b6553p5 1 100 0 6553.5 FUNCTION_LIST TEB IF_DATA DIM_X 0x382BBA EXTERN WORD IF_DATA MCMESS 0x382BBA EXTERN /end MEASUREMENT
/begin MEASUREMENT mssgin_w "Ins Saugrohr strömender Massenstrom (Drosselklappe + TEV)" UWORD m_uw_b6553p5 1 100 0 6553.5 FUNCTION_LIST TEB IF_DATA DIM_X 0x382BBC EXTERN WORD IF_DATA MCMESS 0x382BBC EXTERN /end MEASUREMENT
/begin MEASUREMENT mss_w "Massenstrom vom Sensor (Auswahl zwischen mshfm_w und ml_w)" UWORD m_uw_b6553p5 1 100 0 6553.5 FUNCTION_LIST BGMSZS IF_DATA DIM_X 0x382012 EXTERN WORD IF_DATA MCMESS 0x382012 EXTERN /end MEASUREMENT
/begin MEASUREMENT mste "Massenstrom Tankentlüftung ins Saugrohr" UBYTE m_ub_b25p6 1 100 0 25.5 FUNCTION_LIST BGTEV BGMSZS BGRLP TEB IF_DATA DIM_X 0xFB3C INTERN WORD IF_DATA MCMESS 0xFB3C INTERN /end MEASUREMENT
/begin MEASUREMENT mstedte "Massenstrom TEV für DTEV" UBYTE m_ub_b25p6 1 100 0 25.5 FUNCTION_LIST BGTEV DTEV IF_DATA DIM_X 0x380CAF EXTERN WORD IF_DATA MCMESS 0x380CAF EXTERN /end MEASUREMENT
/begin MEASUREMENT mstedtef_w "Massenstrom Tankentlüftungsventil (gefiltert) für DTEV" UWORD m_q0p0031 1 100 0 204.797 FUNCTION_LIST DTEV IF_DATA DIM_X 0x382C4A EXTERN WORD IF_DATA MCMESS 0x382C4A EXTERN /end MEASUREMENT
/begin MEASUREMENT mstedte_w "Massenstrom TEV für DTEV (Word)" UWORD m_uw_b25p6 1 100 0 25.5996 FUNCTION_LIST BGTEV TEB IF_DATA DIM_X 0x382B7C EXTERN WORD IF_DATA MCMESS 0x382B7C EXTERN /end MEASUREMENT
/begin MEASUREMENT msteev_w "Massenstrom Regeneriergas auf Höhe Einspritzventil" UWORD m_uw_b25p6 1 100 0 25.5996 FUNCTION_LIST TEB IF_DATA DIM_X 0x382BBE EXTERN WORD IF_DATA MCMESS 0x382BBE EXTERN /end MEASUREMENT
/begin MEASUREMENT msteo_w "Massenstom durch das 100% offene TEV" UWORD m_uw_b25p6 1 100 0 25.5996 FUNCTION_LIST BGTEV ATEV TEB IF_DATA DIM_X 0x382B7E EXTERN WORD IF_DATA MCMESS 0x382B7E EXTERN /end MEASUREMENT
/begin MEASUREMENT mstesg_w "Massenstrom Tankentlüftung ins Saugrohr (Anteil Einleitung auf Unterdruckseite)" UWORD m_uw_b25p6 1 100 0 25.5996 FUNCTION_LIST BGTEV IF_DATA DIM_X 0x382B80 EXTERN WORD IF_DATA MCMESS 0x382B80 EXTERN /end MEASUREMENT
/begin MEASUREMENT mstesmx_w "Maximal möglicher Sollmassenstrom Tankentlüftung" UWORD m_uw_b25p6 1 100 0 25.5996 FUNCTION_LIST TEB IF_DATA DIM_X 0x382BC0 EXTERN WORD IF_DATA MCMESS 0x382BC0 EXTERN /end MEASUREMENT
/begin MEASUREMENT mstesoll_w "Massenstrom Tankentlüftung ins Saugrohr, Sollwert" UWORD m_uw_b25p6 1 100 0 25.5996 FUNCTION_LIST TEB ATEV IF_DATA DIM_X 0x382BC2 EXTERN WORD IF_DATA MCMESS 0x382BC2 EXTERN /end MEASUREMENT
/begin MEASUREMENT mstetev_w "Massenstrom durch das TEV" UWORD m_uw_b25p6 1 100 0 25.5996 FUNCTION_LIST BGTEV IF_DATA DIM_X 0x382B82 EXTERN WORD IF_DATA MCMESS 0x382B82 EXTERN /end MEASUREMENT
/begin MEASUREMENT mstevl_w "Anteil Massenstrom durch das TEV der Einleitung vor Lader" UWORD m_uw_b25p6 1 100 0 25.5996 FUNCTION_LIST BGTEV IF_DATA DIM_X 0x382B84 EXTERN WORD IF_DATA MCMESS 0x382B84 EXTERN /end MEASUREMENT
/begin MEASUREMENT mste_w "Massenstrom Tankentlüftung in das Saugrohr" UWORD m_uw_b25p6 1 100 0 25.5996 FUNCTION_LIST BGTEV FUEDK TEB IF_DATA DIM_X 0x382B86 EXTERN WORD IF_DATA MCMESS 0x382B86 EXTERN /end MEASUREMENT
/begin MEASUREMENT mtsegph_w "Gleitender Mittelwert der Phasenperiodendauer" UWORD t40usxus_q40 1 100 0 2.6214e+006 FUNCTION_LIST NLDG IF_DATA DIM_X 0x381B7A EXTERN WORD IF_DATA MCMESS 0x381B7A EXTERN /end MEASUREMENT
/begin MEASUREMENT mver_c_uc "Fehlerzähler für Momentenvergleich im Befehlstest" UBYTE t40ms_ub_b10200 1 100 0 10200 FUNCTION_LIST URCMVER URCAUS URCREF IF_DATA DIM_X 0x380C7A EXTERN WORD IF_DATA MCMESS 0x380C7A EXTERN /end MEASUREMENT
/begin MEASUREMENT mver_c_um "Fehlerzähler für Momentenvergleich der Funktionsüberwachung" UBYTE t40ms_ub_b10200 1 100 0 10200 FUNCTION_LIST UFMVER IF_DATA DIM_X 0x382E7D EXTERN WORD IF_DATA MCMESS 0x382E7D EXTERN /end MEASUREMENT
/begin MEASUREMENT mzfo_uc "Gefiltertes zulässiges Moment inclusive Offset im Befehlstest" UBYTE rel_ub_q0p3906 1 100 0 99.6094 FUNCTION_LIST URCMVER URCAUS IF_DATA DIM_X 0x380C7B EXTERN WORD IF_DATA MCMESS 0x380C7B EXTERN /end MEASUREMENT
/begin MEASUREMENT mzfo_um "gefiltertes zulässiges Moment inclusive Offset in der Funktionsüberwachung" UBYTE rel_ub_q0p3906 1 100 0 99.6094 FUNCTION_LIST UFMVER IF_DATA DIM_X 0x382E7E EXTERN WORD IF_DATA MCMESS 0x382E7E EXTERN /end MEASUREMENT
/begin MEASUREMENT mzf_low_uc "" UBYTE rel_ub_q0p00153 1 100 0 0.389074 FUNCTION_LIST URCMZF URCREF IF_DATA DIM_X 0x380C6F EXTERN WORD IF_DATA MCMESS 0x380C6F EXTERN /end MEASUREMENT
/begin MEASUREMENT mzf_low_um "Nachkommastellen für gefiltertes zulässiges Moment der Funktionsüberwachung" UBYTE rel_ub_q0p00153 1 100 0 0.389074 FUNCTION_LIST UFMZF IF_DATA DIM_X 0x382E72 EXTERN WORD IF_DATA MCMESS 0x382E72 EXTERN /end MEASUREMENT
/begin MEASUREMENT mzf_ptr_uc "" UBYTE dez 1 100 0 255 FUNCTION_LIST URCMZF URCREF IF_DATA DIM_X 0x380C70 EXTERN WORD IF_DATA MCMESS 0x380C70 EXTERN /end MEASUREMENT
/begin MEASUREMENT mzf_ptr_um "Zeiger des Registers mzf_reg_um" UBYTE dez 1 100 0 255 FUNCTION_LIST UFMZF IF_DATA DIM_X 0x382E73 EXTERN WORD IF_DATA MCMESS 0x382E73 EXTERN /end MEASUREMENT
/begin MEASUREMENT mzf_reg_uc_0___A "" UBYTE rel_ub_q0p3906 1 100 0 99.6094 FUNCTION_LIST URCMZF URCREF IF_DATA DIM_X 0x380C71 EXTERN WORD IF_DATA MCMESS 0x380C71 EXTERN /end MEASUREMENT
/begin MEASUREMENT mzf_reg_uc_1___A "" UBYTE rel_ub_q0p3906 1 100 0 99.6094 FUNCTION_LIST URCMZF URCREF IF_DATA DIM_X 0x380C72 EXTERN WORD IF_DATA MCMESS 0x380C72 EXTERN /end MEASUREMENT
/begin MEASUREMENT mzf_reg_uc_2___A "" UBYTE rel_ub_q0p3906 1 100 0 99.6094 FUNCTION_LIST URCMZF URCREF IF_DATA DIM_X 0x380C73 EXTERN WORD IF_DATA MCMESS 0x380C73 EXTERN /end MEASUREMENT
/begin MEASUREMENT mzf_reg_uc_3___A "" UBYTE rel_ub_q0p3906 1 100 0 99.6094 FUNCTION_LIST URCMZF URCREF IF_DATA DIM_X 0x380C74 EXTERN WORD IF_DATA MCMESS 0x380C74 EXTERN /end MEASUREMENT
/begin MEASUREMENT mzf_reg_uc_4___A "" UBYTE rel_ub_q0p3906 1 100 0 99.6094 FUNCTION_LIST URCMZF URCREF IF_DATA DIM_X 0x380C75 EXTERN WORD IF_DATA MCMESS 0x380C75 EXTERN /end MEASUREMENT
/begin MEASUREMENT mzf_reg_uc_5___A "" UBYTE rel_ub_q0p3906 1 100 0 99.6094 FUNCTION_LIST URCMZF URCREF IF_DATA DIM_X 0x380C76 EXTERN WORD IF_DATA MCMESS 0x380C76 EXTERN /end MEASUREMENT
/begin MEASUREMENT mzf_reg_uc_6___A "" UBYTE rel_ub_q0p3906 1 100 0 99.6094 FUNCTION_LIST URCMZF URCREF IF_DATA DIM_X 0x380C77 EXTERN WORD IF_DATA MCMESS 0x380C77 EXTERN /end MEASUREMENT
/begin MEASUREMENT mzf_reg_uc_7___A "" UBYTE rel_ub_q0p3906 1 100 0 99.6094 FUNCTION_LIST URCMZF URCREF IF_DATA DIM_X 0x380C78 EXTERN WORD IF_DATA MCMESS 0x380C78 EXTERN /end MEASUREMENT
/begin MEASUREMENT mzf_reg_um_0___A "Register für zulässiges Moment zeitverzögert" UBYTE rel_ub_q0p3906 1 100 0 99.6094 FUNCTION_LIST UFMZF IF_DATA DIM_X 0x382E74 EXTERN WORD IF_DATA MCMESS 0x382E74 EXTERN /end MEASUREMENT
/begin MEASUREMENT mzf_reg_um_1___A "Register für zulässiges Moment zeitverzögert" UBYTE rel_ub_q0p3906 1 100 0 99.6094 FUNCTION_LIST UFMZF IF_DATA DIM_X 0x382E75 EXTERN WORD IF_DATA MCMESS 0x382E75 EXTERN /end MEASUREMENT
/begin MEASUREMENT mzf_reg_um_2___A "Register für zulässiges Moment zeitverzögert" UBYTE rel_ub_q0p3906 1 100 0 99.6094 FUNCTION_LIST UFMZF IF_DATA DIM_X 0x382E76 EXTERN WORD IF_DATA MCMESS 0x382E76 EXTERN /end MEASUREMENT
/begin MEASUREMENT mzf_reg_um_3___A "Register für zulässiges Moment zeitverzögert" UBYTE rel_ub_q0p3906 1 100 0 99.6094 FUNCTION_LIST UFMZF IF_DATA DIM_X 0x382E77 EXTERN WORD IF_DATA MCMESS 0x382E77 EXTERN /end MEASUREMENT
/begin MEASUREMENT mzf_reg_um_4___A "Register für zulässiges Moment zeitverzögert" UBYTE rel_ub_q0p3906 1 100 0 99.6094 FUNCTION_LIST UFMZF IF_DATA DIM_X 0x382E78 EXTERN WORD IF_DATA MCMESS 0x382E78 EXTERN /end MEASUREMENT
/begin MEASUREMENT mzf_reg_um_5___A "Register für zulässiges Moment zeitverzögert" UBYTE rel_ub_q0p3906 1 100 0 99.6094 FUNCTION_LIST UFMZF IF_DATA DIM_X 0x382E79 EXTERN WORD IF_DATA MCMESS 0x382E79 EXTERN /end MEASUREMENT
/begin MEASUREMENT mzf_reg_um_6___A "Register für zulässiges Moment zeitverzögert" UBYTE rel_ub_q0p3906 1 100 0 99.6094 FUNCTION_LIST UFMZF IF_DATA DIM_X 0x382E7A EXTERN WORD IF_DATA MCMESS 0x382E7A EXTERN /end MEASUREMENT
/begin MEASUREMENT mzf_reg_um_7___A "Register für zulässiges Moment zeitverzögert" UBYTE rel_ub_q0p3906 1 100 0 99.6094 FUNCTION_LIST UFMZF IF_DATA DIM_X 0x382E7B EXTERN WORD IF_DATA MCMESS 0x382E7B EXTERN /end MEASUREMENT
/begin MEASUREMENT mzf_uc "gefiltertes zulässiges Moment im Befehlstest" UBYTE rel_ub_q0p3906 1 100 0 99.6094 FUNCTION_LIST URCMZF URCMVER URCREF IF_DATA DIM_X 0x380C79 EXTERN WORD IF_DATA MCMESS 0x380C79 EXTERN /end MEASUREMENT
/begin MEASUREMENT mzf_um "gefiltertes zulässiges Moment der Funktionsüberwachung" UBYTE rel_ub_q0p3906 1 100 0 99.6094 FUNCTION_LIST UFMZF UFMVER IF_DATA DIM_X 0x382E7C EXTERN WORD IF_DATA MCMESS 0x382E7C EXTERN /end MEASUREMENT
/begin MEASUREMENT mzmax_uc "" UBYTE rel_ub_b99p6 1 100 0 99.6094 FUNCTION_LIST URCMZUL IF_DATA DIM_X 0x380C6C EXTERN WORD IF_DATA MCMESS 0x380C6C EXTERN /end MEASUREMENT
/begin MEASUREMENT mzmax_um "zulässiges Moment aus der Maximalauswahl in der Funktionsüberwachung" UBYTE rel_ub_b99p6 1 100 0 99.6094 FUNCTION_LIST UFMZUL IF_DATA DIM_X 0x380C52 EXTERN WORD IF_DATA MCMESS 0x380C52 EXTERN /end MEASUREMENT
/begin MEASUREMENT mzo_uc "Toleranz-Offset für das zulässige Moment im Befehlstest" UBYTE rel_ub_b99p6 1 100 0 99.6094 FUNCTION_LIST URCMZUL URCMVER IF_DATA DIM_X 0x380C6D EXTERN WORD IF_DATA MCMESS 0x380C6D EXTERN /end MEASUREMENT
/begin MEASUREMENT mzo_um "Toleranz-Offset fürs zulässige Moment in der Funktionsüberwachung" UBYTE rel_ub_b99p6 1 100 0 99.6094 FUNCTION_LIST UFMZUL UFMVER IF_DATA DIM_X 0x382E70 EXTERN WORD IF_DATA MCMESS 0x382E70 EXTERN /end MEASUREMENT
/begin MEASUREMENT mz_uc "resultierendes zulässiges Moment im Befehlstest" UBYTE rel_ub_b99p6 1 100 0 99.6094 FUNCTION_LIST URCMZUL URCMZF IF_DATA DIM_X 0x380C6E EXTERN WORD IF_DATA MCMESS 0x380C6E EXTERN /end MEASUREMENT
/begin MEASUREMENT mz_um "resultierendes zulässiges Moment aus der Koordination der Funktionsüberwachung" UBYTE rel_ub_b99p6 1 100 0 99.6094 FUNCTION_LIST UFMZUL UFMZF IF_DATA DIM_X 0x382E71 EXTERN WORD IF_DATA MCMESS 0x382E71 EXTERN /end MEASUREMENT
/begin MEASUREMENT na_abs_c "" UBYTE dez 1 100 0 255 FUNCTION_LIST ACIFI IF_DATA DIM_X 0xFA5E INTERN WORD IF_DATA MCMESS 0xFA5E INTERN /end MEASUREMENT
/begin MEASUREMENT na_rel_c "" UBYTE dez 1 100 0 255 FUNCTION_LIST ACIFI IF_DATA DIM_X 0xFA5F INTERN WORD IF_DATA MCMESS 0xFA5F INTERN /end MEASUREMENT
/begin MEASUREMENT nc_c_um "Fehlerzähler für Motordrehzahlvergleich für die Funktionsüberwachung" UBYTE t40ms_ub_b10200 1 100 0 10200 FUNCTION_LIST UFNC IF_DATA DIM_X 0x382E4E EXTERN WORD IF_DATA MCMESS 0x382E4E EXTERN /end MEASUREMENT
/begin MEASUREMENT ndar_w "Differenzdrehzahl für Momenteneingriff" SWORD nmot_sw_q0p25 1 100 -8192 8191.75 FUNCTION_LIST ARMD IF_DATA DIM_X 0x3825C8 EXTERN WORD IF_DATA MCMESS 0x3825C8 EXTERN /end MEASUREMENT
/begin MEASUREMENT ndfibet_w "Betrag der gefilterten Differenzdrehzahl" UWORD nmot_uw_q0p25 1 100 0 16383.8 FUNCTION_LIST ARMD IF_DATA DIM_X 0x3825CA EXTERN WORD IF_DATA MCMESS 0x3825CA EXTERN /end MEASUREMENT
/begin MEASUREMENT ndfil_w "gefilterte Differenzdrehzahl" SWORD nmot_sw_q0p25 1 100 -8192 8191.75 FUNCTION_LIST ARMD IF_DATA DIM_X 0x3825CC EXTERN WORD IF_DATA MCMESS 0x3825CC EXTERN /end MEASUREMENT
/begin MEASUREMENT ndiffog_w "Schwelle Drehzahldifferenz zum Resetieren der AR beim Verzögern" SWORD nmot_sw_q0p25 1 100 -8192 8191.75 FUNCTION_LIST ARMD IF_DATA DIM_X 0x3825CE EXTERN WORD IF_DATA MCMESS 0x3825CE EXTERN /end MEASUREMENT
/begin MEASUREMENT ndiff_w "Differenzdrehzahl für LFR-HS-Verstärkungen" SWORD nmot_sw_q0p25 1 100 -8192 8191.75 FUNCTION_LIST ARMD IF_DATA DIM_X 0x3825D0 EXTERN WORD IF_DATA MCMESS 0x3825D0 EXTERN /end MEASUREMENT
/begin MEASUREMENT nfskh "Leerlaufdrehzahl Fahrstufe bei Katheizen" UBYTE nmot_ub_q10 1 100 0 2550 FUNCTION_LIST BBKHZ LLRNS IF_DATA DIM_X 0x380B71 EXTERN WORD IF_DATA MCMESS 0x380B71 EXTERN /end MEASUREMENT
/begin MEASUREMENT ngasf_w "Drehzahlgradient über ein Arbeitsspiel (gefiltert)" SWORD nmotg_sw_q0p39 1 100 -12800.2 12799.8 FUNCTION_LIST LLRRM IF_DATA DIM_X 0x382542 EXTERN WORD IF_DATA MCMESS 0x382542 EXTERN /end MEASUREMENT
/begin MEASUREMENT ngas_w "Drehzahlgradient über ein Arbeitsspiel" SWORD nmotg_sw_q0p39 1 100 -12800.2 12799.8 FUNCTION_LIST BGNG KRDY LLRRM IF_DATA DIM_X 0x381B2C EXTERN WORD IF_DATA MCMESS 0x381B2C EXTERN /end MEASUREMENT
/begin MEASUREMENT ngfil "gefilterter Drehzahlgradient" SBYTE nmotg_sb_q100 1 100 -12800 12700 FUNCTION_LIST BGNG BBSAWE LLRNS LLRRM SSTBER87 IF_DATA DIM_X 0x380A1E EXTERN WORD IF_DATA MCMESS 0x380A1E EXTERN /end MEASUREMENT
/begin MEASUREMENT ngfil_w "gefilterter Drehzahlgradient" SWORD nmotg_sw_q0p39 1 100 -12800.2 12799.8 FUNCTION_LIST BGNG MDFAW NMAXMD IF_DATA DIM_X 0x381B2E EXTERN WORD IF_DATA MCMESS 0x381B2E EXTERN /end MEASUREMENT
/begin MEASUREMENT ngkrf_w "gefilterter Drehzahlgradient KRKE" SWORD nmotg_sw_q0p39 1 100 -12800.2 12799.8 FUNCTION_LIST KRDY IF_DATA DIM_X 0x382472 EXTERN WORD IF_DATA MCMESS 0x382472 EXTERN /end MEASUREMENT
/begin MEASUREMENT ngkrv_w "aktueller Wert Drehzahldynamikschwelle" SWORD nmotg_sw_q0p39 1 100 -12800.2 12799.8 FUNCTION_LIST KRDY IF_DATA DIM_X 0x382474 EXTERN WORD IF_DATA MCMESS 0x382474 EXTERN /end MEASUREMENT
/begin MEASUREMENT nllkh "Leerlaufdrehzahl bei Katheizen" UBYTE nmot_ub_q10 1 100 0 2550 FUNCTION_LIST BBKHZ LLRNS IF_DATA DIM_X 0x380B72 EXTERN WORD IF_DATA MCMESS 0x380B72 EXTERN /end MEASUREMENT
/begin MEASUREMENT nlp1tim "Zeitzähler für Wartezeit 1 im NLP-Lernen" UBYTE t10msxs_ub_b2p55 1 100 0 2.55 FUNCTION_LIST BGDVE IF_DATA DIM_X 0x380AAB EXTERN WORD IF_DATA MCMESS 0x380AAB EXTERN /end MEASUREMENT
/begin MEASUREMENT nmaxdvg_w "gangabhängige Drehzahlbegrenzung bei Fehlererkennung Geschwindigkeitssignal" UWORD nmot_uw_q0p25 1 100 0 16383.8 FUNCTION_LIST NMAXMD IF_DATA DIM_X 0x3826CA EXTERN WORD IF_DATA MCMESS 0x3826CA EXTERN /end MEASUREMENT
/begin MEASUREMENT nmaxdz_w "Drehzahlbegrenzung bei Doppelzündung" UWORD nmot_uw_q0p25 1 100 0 16383.8 FUNCTION_LIST NMAXMD IF_DATA DIM_X 0x3826CC EXTERN WORD IF_DATA MCMESS 0x3826CC EXTERN /end MEASUREMENT
/begin MEASUREMENT nmaxg_w "Maximaldrehzahl Getriebe" UWORD nmot_uw_q0p25 1 100 0 16383.8 FUNCTION_LIST NMAXMD IF_DATA DIM_X 0x3826DA EXTERN WORD IF_DATA MCMESS 0x3826DA EXTERN /end MEASUREMENT
/begin MEASUREMENT nmaxvs_w "Maximaldrehzahl Ventilhubsteuerung" UWORD nmot_uw_q0p25 1 100 0 16383.8 FUNCTION_LIST NMAXMD IF_DATA DIM_X 0x383A20 EXTERN WORD IF_DATA MCMESS 0x383A20 EXTERN /end MEASUREMENT
/begin MEASUREMENT nmaxv_w "Maximaldrehzahl vor Begrenzung durch Getriebe und Ventilhubsteuerung" UWORD nmot_uw_q0p25 1 100 0 16383.8 FUNCTION_LIST NMAXMD AMUENE IF_DATA DIM_X 0x3826DC EXTERN WORD IF_DATA MCMESS 0x3826DC EXTERN /end MEASUREMENT
/begin MEASUREMENT nmod_w "Motordrehzahl aus Modell" UWORD nmot_uw_q0p25 1 100 0 16383.8 FUNCTION_LIST ARMD IF_DATA DIM_X 0x3825D2 EXTERN WORD IF_DATA MCMESS 0x3825D2 EXTERN /end MEASUREMENT
/begin MEASUREMENT nmot "Motordrehzahl" UBYTE nmot_ub_q40 1 100 0 10200 FUNCTION_LIST BGNMOT ACIFI ADVE AEVABU ARMD ATEV ATM BBFGR BBSAWE BBSTT BBTEGA BGMSZS BGTABS BGTMPK DECJ DFFT DFPM DKATLRS DKRNT DKRS DLDR DLSU DMDDLU DMDDVS DMDFON DMDLU DMDLUA DMDMIL DMDSTP DMDUE DNWS DVFZ DVS ESGRU ESNWS ESSTT ESUK ESUKAS esvs ESVW ESWL FUEDK FUEDKSA FUEREG GGDPG GGDSAS GGDVE GGHFM GGKS GGLSU GGPED GGTFM GGTFUMG GK KOS KRDY KRKE KRRA KWP2000F LAMBTS LAMFAW LDOB LDRLMX LDRPID LDTVMA LDUVST LLRBB LLRMR LLRNS LLRRM LRA LRAEB LRS LRSEB LRSHK LRSKA MDBAS MDBGRG MDFUE MDKOG MDKOL MDVERB MDZUL MLS NLDG NLPH NWS PROKON RKTI RUNTIME SSTBER87 STADAP SU T2AU T2DFA T2DVE T2STA TEB UFNC VMAXMD VS WANWKW WFS ZUE ZUESZ ZWBTSK ZWGRU ZWMIN ZWSTT ZWVS ZWWL IF_DATA DIM_X 0xF9AC INTERN WORD IF_DATA MCMESS 0xF9AC INTERN /end MEASUREMENT
/begin MEASUREMENT nmotas_w "Motordrehzahl von 2 Umdrehungen (1 Arbeitsspiel) zuvor" UWORD nmot_uw_q0p25 1 100 0 16383.8 FUNCTION_LIST BGNG IF_DATA DIM_X 0x381B30 EXTERN WORD IF_DATA MCMESS 0x381B30 EXTERN /end MEASUREMENT
/begin MEASUREMENT nmotk1_w "" UWORD nmot_uw_q0p25 1 100 0 16383.8 FUNCTION_LIST ARMD IF_DATA DIM_X 0x3825D4 EXTERN WORD IF_DATA MCMESS 0x3825D4 EXTERN /end MEASUREMENT
/begin MEASUREMENT nmotk2_w "" UWORD nmot_uw_q0p25 1 100 0 16383.8 FUNCTION_LIST ARMD IF_DATA DIM_X 0x3825D6 EXTERN WORD IF_DATA MCMESS 0x3825D6 EXTERN /end MEASUREMENT
/begin MEASUREMENT nmotll "Motordrehzahl im Leerlaufbereich" UBYTE nmot_ub_q10 1 100 0 2550 FUNCTION_LIST BGNMOT BGDVE BGLBZ DTEV LLRBB LLRNS STA STMD T2DVE IF_DATA DIM_X 0x380A1B EXTERN WORD IF_DATA MCMESS 0x380A1B EXTERN /end MEASUREMENT
/begin MEASUREMENT nmotllfil "Gefilterte Drehzahl nmotll" UBYTE nmot_ub_q10 1 100 0 2550 FUNCTION_LIST BGNMOT DDG IF_DATA DIM_X 0x380A1C EXTERN WORD IF_DATA MCMESS 0x380A1C EXTERN /end MEASUREMENT
/begin MEASUREMENT nmotpr_w "Prädizierte Motordrehzahl für NMAX-Regelung" UWORD nmot_uw_q0p25 1 100 0 16383.8 FUNCTION_LIST NMAXMD IF_DATA DIM_X 0x3826DE EXTERN WORD IF_DATA MCMESS 0x3826DE EXTERN /end MEASUREMENT
/begin MEASUREMENT nmotrsp_w_0__A "Beginn Ringspeicher für Drehzahl" UWORD nmot_uw_q0p25 1 100 0 16383.8 FUNCTION_LIST BGNG IF_DATA DIM_X 0xF9B2 INTERN WORD IF_DATA MCMESS 0xF9B2 INTERN /end MEASUREMENT
/begin MEASUREMENT nmotrsp_w_1__A "Beginn Ringspeicher für Drehzahl" UWORD nmot_uw_q0p25 1 100 0 16383.8 FUNCTION_LIST BGNG IF_DATA DIM_X 0xF9B4 INTERN WORD IF_DATA MCMESS 0xF9B4 INTERN /end MEASUREMENT
/begin MEASUREMENT nmotrsp_w_2__A "Beginn Ringspeicher für Drehzahl" UWORD nmot_uw_q0p25 1 100 0 16383.8 FUNCTION_LIST BGNG IF_DATA DIM_X 0xF9B6 INTERN WORD IF_DATA MCMESS 0xF9B6 INTERN /end MEASUREMENT
/begin MEASUREMENT nmotrsp_w_3__A "Beginn Ringspeicher für Drehzahl" UWORD nmot_uw_q0p25 1 100 0 16383.8 FUNCTION_LIST BGNG IF_DATA DIM_X 0xF9B8 INTERN WORD IF_DATA MCMESS 0xF9B8 INTERN /end MEASUREMENT
/begin MEASUREMENT nmotrsp_w_4__A "Beginn Ringspeicher für Drehzahl" UWORD nmot_uw_q0p25 1 100 0 16383.8 FUNCTION_LIST BGNG IF_DATA DIM_X 0xF9BA INTERN WORD IF_DATA MCMESS 0xF9BA INTERN /end MEASUREMENT
/begin MEASUREMENT nmotrsp_w_5__A "Beginn Ringspeicher für Drehzahl" UWORD nmot_uw_q0p25 1 100 0 16383.8 FUNCTION_LIST BGNG IF_DATA DIM_X 0xF9BC INTERN WORD IF_DATA MCMESS 0xF9BC INTERN /end MEASUREMENT
/begin MEASUREMENT nmotrsp_w_6__A "Beginn Ringspeicher für Drehzahl" UWORD nmot_uw_q0p25 1 100 0 16383.8 FUNCTION_LIST BGNG IF_DATA DIM_X 0xF9BE INTERN WORD IF_DATA MCMESS 0xF9BE INTERN /end MEASUREMENT
/begin MEASUREMENT nmotrsp_w_7__A "Beginn Ringspeicher für Drehzahl" UWORD nmot_uw_q0p25 1 100 0 16383.8 FUNCTION_LIST BGNG IF_DATA DIM_X 0xF9C0 INTERN WORD IF_DATA MCMESS 0xF9C0 INTERN /end MEASUREMENT
/begin MEASUREMENT nmottoel "Drehzahl von Öltemperatur abhängig" UBYTE nmot_ub_q40 1 100 0 10200 FUNCTION_LIST NWS IF_DATA DIM_X 0x380B03 EXTERN WORD IF_DATA MCMESS 0x380B03 EXTERN /end MEASUREMENT
/begin MEASUREMENT nmot_uc "Motordrehzahl im Befehlstest" UBYTE nmot_ub_q40 1 100 0 10200 FUNCTION_LIST URCEIN URCEINS URCMIST URCMZUL URCREAC IF_DATA DIM_X 0x380C5C EXTERN WORD IF_DATA MCMESS 0x380C5C EXTERN /end MEASUREMENT
/begin MEASUREMENT nmot_um "Motordrehzahl in der Funktionsüberwachung" UBYTE nmot_ub_q40 1 100 0 10200 FUNCTION_LIST UFNC DUF UFEINS UFMIST UFMZUL UFNSC UFREAC UFRLC IF_DATA DIM_X 0x382E4F EXTERN WORD IF_DATA MCMESS 0x382E4F EXTERN /end MEASUREMENT
/begin MEASUREMENT nmot_w "Motordrehzahl" UWORD nmot_uw_q0p25 1 100 0 16383.8 FUNCTION_LIST BGNMOT ACIFI AMUENE ARMD BBGANG BGMSZS BGNG BGRLP BGSRM CAN DHFM DMDSTP ESUK FUEDK GGDPG GGDSAS KHMD KRDY LAKH LDRLMX LDRPID LDRPLS LLRRM LRS MDBAS MDBGV MDEX MDFAW MDFUE MDMAX MDMIN MDNSTAB MDVER MDZW NMAXMD SSTBER87 T2LID TC1MOD TC9MOD TEB IF_DATA DIM_X 0xF9AE INTERN WORD IF_DATA MCMESS 0xF9AE INTERN /end MEASUREMENT
/begin MEASUREMENT nmst08_uc "" UWORD dez 1 100 0 65535 FUNCTION_LIST URCEINS URCMZUL IF_DATA DIM_X 0x38292C EXTERN WORD IF_DATA MCMESS 0x38292C EXTERN /end MEASUREMENT
/begin MEASUREMENT nmst08_um "Stützstelle für Motordrehzahl in der Funktionsüberwachung (NMOT_UM)" UWORD dez 1 100 0 65535 FUNCTION_LIST UFEINS UFMZUL IF_DATA DIM_X 0x382E98 EXTERN WORD IF_DATA MCMESS 0x382E98 EXTERN /end MEASUREMENT
/begin MEASUREMENT nmxpr "Verstärkung Proportionalanteil der NMAX-Regelung" UBYTE relnmot_q0p0039 1 100 0 0.996094 FUNCTION_LIST NMAXMD IF_DATA DIM_X 0x380C44 EXTERN WORD IF_DATA MCMESS 0x380C44 EXTERN /end MEASUREMENT
/begin MEASUREMENT nnmaxo "Anzahl Zündungen bei Drehzahl > Maximaldrehzahl oberer Bereich" UWORD dez 1 100 0 65535 FUNCTION_LIST AMUENE T2LID IF_DATA DIM_X 0x38395A EXTERN WORD IF_DATA MCMESS 0x38395A EXTERN /end MEASUREMENT
/begin MEASUREMENT nnmaxu "Anzahl Zündungen bei Drehzahl > Maximaldrehzahl unterer Bereich" UWORD dez 1 100 0 65535 FUNCTION_LIST AMUENE T2LID IF_DATA DIM_X 0x38395C EXTERN WORD IF_DATA MCMESS 0x38395C EXTERN /end MEASUREMENT
/begin MEASUREMENT NovBits "" UBYTE dez 1 100 0 255 FUNCTION_LIST DLSAHK IF_DATA DIM_X 0x382FF1 EXTERN WORD IF_DATA MCMESS 0x382FF1 EXTERN /end MEASUREMENT
/begin MEASUREMENT nsa "Drehzahl Schub" UBYTE nmot_ub_q40 1 100 0 10200 FUNCTION_LIST BBSAWE IF_DATA DIM_X 0x380C01 EXTERN WORD IF_DATA MCMESS 0x380C01 EXTERN /end MEASUREMENT
/begin MEASUREMENT nsactr "Nachstartcounter" UBYTE fak_ub_b2 1 100 0 1.99219 FUNCTION_LIST ESNST IF_DATA DIM_X 0x380B22 EXTERN WORD IF_DATA MCMESS 0x380B22 EXTERN /end MEASUREMENT
/begin MEASUREMENT nsactr1 "Nachstartcounter ohne Berücksichtigung des Startmengenadaptionswerts" UBYTE fak_ub_b2 1 100 0 1.99219 FUNCTION_LIST ESNST IF_DATA DIM_X 0x380B23 EXTERN WORD IF_DATA MCMESS 0x380B23 EXTERN /end MEASUREMENT
/begin MEASUREMENT nsactr2 "Nachstartcounter mit Berücksichtigung des Startmengenadaptionswerts" UBYTE fak_ub_b2 1 100 0 1.99219 FUNCTION_LIST ESNST IF_DATA DIM_X 0x380B24 EXTERN WORD IF_DATA MCMESS 0x380B24 EXTERN /end MEASUREMENT
/begin MEASUREMENT nsber_w "Solldrehzahl für NMAX-Regelung" UWORD nmot_uw_q0p25 1 100 0 16383.8 FUNCTION_LIST NMAXMD IF_DATA DIM_X 0x3826E0 EXTERN WORD IF_DATA MCMESS 0x3826E0 EXTERN /end MEASUREMENT
/begin MEASUREMENT nsc_c_um "Nachstart-Zeitzähler Nachstartaufweitung der FU" UWORD t40msxs_uw_q0p04 1 100 0 2621.4 FUNCTION_LIST UFNSC IF_DATA DIM_X 0x382E96 EXTERN WORD IF_DATA MCMESS 0x382E96 EXTERN /end MEASUREMENT
/begin MEASUREMENT nsfsm "LLR: Motortemperaturabhängige Solldrehzahl im LL bei S_fs=1" UBYTE nmot_ub_q10 1 100 0 2550 FUNCTION_LIST LLRNS IF_DATA DIM_X 0x380C04 EXTERN WORD IF_DATA MCMESS 0x380C04 EXTERN /end MEASUREMENT
/begin MEASUREMENT nsfsmn "LLR: Minimale Solldrehzahl bei eingelegter Fahrstufe" UBYTE nmot_ub_q10 1 100 0 2550 FUNCTION_LIST LLRNS IF_DATA DIM_X 0x380C08 EXTERN WORD IF_DATA MCMESS 0x380C08 EXTERN /end MEASUREMENT
/begin MEASUREMENT nska_uc "Grenzdrehzahl bei aktiver Fehlerreaktion im Befehlstest" UBYTE nmot_ub_q40 1 100 0 10200 FUNCTION_LIST URCREAC IF_DATA DIM_X 0x380C7C EXTERN WORD IF_DATA MCMESS 0x380C7C EXTERN /end MEASUREMENT
/begin MEASUREMENT nska_um "Grenzdrehzahl bei aktiver Fehlerreaktion in der Funktionsüberwachung" UBYTE nmot_ub_q40 1 100 0 10200 FUNCTION_LIST UFREAC IF_DATA DIM_X 0x382E7F EXTERN WORD IF_DATA MCMESS 0x382E7F EXTERN /end MEASUREMENT
/begin MEASUREMENT nslbz "Solldrehtahl abhängig von lbz" UBYTE nmot_ub_q10 1 100 0 2550 FUNCTION_LIST LLRNS IF_DATA DIM_X 0x380C05 EXTERN WORD IF_DATA MCMESS 0x380C05 EXTERN /end MEASUREMENT
/begin MEASUREMENT nsllm "LLR: Motortemperaturabhängige Solldrehzahl im LL" UBYTE nmot_ub_q10 1 100 0 2550 FUNCTION_LIST LLRNS IF_DATA DIM_X 0x380C06 EXTERN WORD IF_DATA MCMESS 0x380C06 EXTERN /end MEASUREMENT
/begin MEASUREMENT nsllmn "LLR: Minimale Solldrehzahl im LL" UBYTE nmot_ub_q10 1 100 0 2550 FUNCTION_LIST LLRNS IF_DATA DIM_X 0x380C09 EXTERN WORD IF_DATA MCMESS 0x380C09 EXTERN /end MEASUREMENT
/begin MEASUREMENT nsnf "LLR: Nachgeführte Solldrehzahl" UBYTE nmot_ub_q10 1 100 0 2550 FUNCTION_LIST LLRNS IF_DATA DIM_X 0x380C0A EXTERN WORD IF_DATA MCMESS 0x380C0A EXTERN /end MEASUREMENT
/begin MEASUREMENT nsof_c_um "Zähler Entprellzeit für Abschaltung der Nachstartaufweitung" UBYTE t40ms_ub_b10200 1 100 0 10200 FUNCTION_LIST UFNSC IF_DATA DIM_X 0x382E51 EXTERN WORD IF_DATA MCMESS 0x382E51 EXTERN /end MEASUREMENT
/begin MEASUREMENT nsol "Leerlaufsolldrehzahl" UBYTE nmot_ub_q10 1 100 0 2550 FUNCTION_LIST LLRNS CAN DTEV LLRRM T2LID IF_DATA DIM_X 0x380C0B EXTERN WORD IF_DATA MCMESS 0x380C0B EXTERN /end MEASUREMENT
/begin MEASUREMENT nsolfa "Leerlaufsolldrehzahl, Funktionsanforderung Tester" UBYTE nmot_ub_q10 1 100 0 2550 FUNCTION_LIST SWADP LLRNS IF_DATA DIM_X 0x380C99 EXTERN WORD IF_DATA MCMESS 0x380C99 EXTERN /end MEASUREMENT
/begin MEASUREMENT nsst "Initialisierungswert der Solldrehzahl im Start" UBYTE nmot_ub_q10 1 100 0 2550 FUNCTION_LIST LLRNS STMD IF_DATA DIM_X 0x380C0C EXTERN WORD IF_DATA MCMESS 0x380C0C EXTERN /end MEASUREMENT
/begin MEASUREMENT nstat "Solldrehzahl stationär" UBYTE nmot_ub_q10 1 100 0 2550 FUNCTION_LIST LLRNS DDG LLRBB MDNSTAB MDWAN IF_DATA DIM_X 0x380C0D EXTERN WORD IF_DATA MCMESS 0x380C0D EXTERN /end MEASUREMENT
/begin MEASUREMENT nsynggdpg "Neusynchronisationsmonitor für GGDPG" UBYTE dez 1 100 0 255 FUNCTION_LIST GGDPG IF_DATA DIM_X 0x380A28 EXTERN WORD IF_DATA MCMESS 0x380A28 EXTERN /end MEASUREMENT
/begin MEASUREMENT nsynnldg "Neusynchronisationsmonitor für NLDG" UBYTE dez 1 100 0 255 FUNCTION_LIST NLDG DDG IF_DATA DIM_X 0x380A31 EXTERN WORD IF_DATA MCMESS 0x380A31 EXTERN /end MEASUREMENT
/begin MEASUREMENT nsynnlph "Neusynchronisationsmonitor für NLPH" UBYTE dez 1 100 0 255 FUNCTION_LIST NLPH IF_DATA DIM_X 0x380A36 EXTERN WORD IF_DATA MCMESS 0x380A36 EXTERN /end MEASUREMENT
/begin MEASUREMENT ntolvs "Drehzahl korrigiert" UBYTE nmot_ub_q40 1 100 0 10200 FUNCTION_LIST VS IF_DATA DIM_X 0x380D01 EXTERN WORD IF_DATA MCMESS 0x380D01 EXTERN /end MEASUREMENT
/begin MEASUREMENT nturb "Turbinendrehzahl des Wandlers" UBYTE nmot_ub_q20 1 100 0 5100 FUNCTION_LIST MDWAN IF_DATA DIM_X 0x380C1C EXTERN WORD IF_DATA MCMESS 0x380C1C EXTERN /end MEASUREMENT
/begin MEASUREMENT nturbv "Voraussichtliche Turbinendrehzahl des Wandlers" UBYTE nmot_ub_q20 1 100 0 5100 FUNCTION_LIST MDWAN IF_DATA DIM_X 0x380C1D EXTERN WORD IF_DATA MCMESS 0x380C1D EXTERN /end MEASUREMENT
/begin MEASUREMENT nver_w "Drehzahlverhältnis" UWORD fak_uw_b8 1 100 0 7.99988 FUNCTION_LIST MDNSTAB IF_DATA DIM_X 0x382570 EXTERN WORD IF_DATA MCMESS 0x382570 EXTERN /end MEASUREMENT
/begin MEASUREMENT nvquot_w "Quotient Motordrehzahl nmot / Fahrgeschwindigkeit vfzg" UWORD qnv_uw_b512 1 100 0 511.992 FUNCTION_LIST BBGANG IF_DATA DIM_X 0x381E6E EXTERN WORD IF_DATA MCMESS 0x381E6E EXTERN /end MEASUREMENT
/begin MEASUREMENT nwe "Wiedereinsetzdrehzahl" UBYTE nmot_ub_q40 1 100 0 10200 FUNCTION_LIST BBSAWE IF_DATA DIM_X 0x380C02 EXTERN WORD IF_DATA MCMESS 0x380C02 EXTERN /end MEASUREMENT
/begin MEASUREMENT nwslokBits01 "" UBYTE dez 1 100 0 255 FUNCTION_LIST NWS IF_DATA DIM_X 0x380B06 EXTERN WORD IF_DATA MCMESS 0x380B06 EXTERN /end MEASUREMENT
/begin MEASUREMENT nwslokBits02 "" UBYTE dez 1 100 0 255 FUNCTION_LIST NWS IF_DATA DIM_X 0x380B07 EXTERN WORD IF_DATA MCMESS 0x380B07 EXTERN /end MEASUREMENT
/begin MEASUREMENT nzwst08_uc "" UWORD dez 1 100 0 65535 FUNCTION_LIST URCEINS URCMIST IF_DATA DIM_X 0x38292E EXTERN WORD IF_DATA MCMESS 0x38292E EXTERN /end MEASUREMENT
/begin MEASUREMENT nzwst08_um "" UWORD dez 1 100 0 65535 FUNCTION_LIST UFEINS UFMIST IF_DATA DIM_X 0x382E9A EXTERN WORD IF_DATA MCMESS 0x382E9A EXTERN /end MEASUREMENT
/begin MEASUREMENT nz_um "Motordrehzahl aus Zahnzählerdifferenz pro Zeit in der Funktionsüberwachung" UBYTE nmot_ub_q40 1 100 0 10200 FUNCTION_LIST UFNC IF_DATA DIM_X 0x382E50 EXTERN WORD IF_DATA MCMESS 0x382E50 EXTERN /end MEASUREMENT
/begin MEASUREMENT n_flags_uc "Byte für Nachstart-Bits des Befehlstestes" UBYTE dez 1 100 0 255 FUNCTION_LIST URCRAM IF_DATA DIM_X 0x380C54 EXTERN WORD IF_DATA MCMESS 0x380C54 EXTERN /end MEASUREMENT
/begin MEASUREMENT n_flags_um "Byte für Nachstart-Bits der Funktionsüberwachung" UBYTE dez 1 100 0 255 FUNCTION_LIST UFURAM IF_DATA DIM_X 0x382E41 EXTERN WORD IF_DATA MCMESS 0x382E41 EXTERN /end MEASUREMENT
/begin MEASUREMENT offz_w "Offenzeit Funkenpakete Funkenbandzündung" UWORD tsegment_sy 1 100 0 43.69 FUNCTION_LIST ZUESZ AZUE IF_DATA DIM_X 0xFB46 INTERN WORD IF_DATA MCMESS 0xFB46 INTERN /end MEASUREMENT
/begin MEASUREMENT ovlCtr "Schließzeit-Überlappsungszähler" UBYTE dez 1 100 0 255 FUNCTION_LIST AZUE IF_DATA DIM_X 0xF8E5 INTERN WORD IF_DATA MCMESS 0xF8E5 INTERN /end MEASUREMENT
/begin MEASUREMENT padlsu2_w "Abgasgegendruck 2 (Differenz gg. Umgebung)" UWORD p_uw_q0p039 1 100 0 2559.96 FUNCTION_LIST GGLSU IF_DATA DIM_X 0x381DDC EXTERN WORD IF_DATA MCMESS 0x381DDC EXTERN /end MEASUREMENT
/begin MEASUREMENT padlsu_w "Abgasgegendruck (Differenz gg. Umgebung)" UWORD p_uw_q0p039 1 100 0 2559.96 FUNCTION_LIST GGLSU IF_DATA DIM_X 0x381DDE EXTERN WORD IF_DATA MCMESS 0x381DDE EXTERN /end MEASUREMENT
/begin MEASUREMENT palsu2_w "Absolutdruck Abgassystem 2" UWORD p_uw_q0p039 1 100 0 2559.96 FUNCTION_LIST GGLSU IF_DATA DIM_X 0x381DE0 EXTERN WORD IF_DATA MCMESS 0x381DE0 EXTERN /end MEASUREMENT
/begin MEASUREMENT palsu_w "Absolutdruck Abgassystem" UWORD p_uw_q0p039 1 100 0 2559.96 FUNCTION_LIST GGLSU IF_DATA DIM_X 0x381DE2 EXTERN WORD IF_DATA MCMESS 0x381DE2 EXTERN /end MEASUREMENT
/begin MEASUREMENT pbr_w "Berechneter Brennraumdruck" UWORD p_uw_q0p039 1 100 0 2559.96 FUNCTION_LIST BGSRM IF_DATA DIM_X 0x3820E4 EXTERN WORD IF_DATA MCMESS 0x3820E4 EXTERN /end MEASUREMENT
/begin MEASUREMENT pdpld "Prädizierter Delta Druck (Überschwinger Soll-Ist)" UBYTE p_ub_q10 1 100 0 2550 FUNCTION_LIST LDUVST FUEDK IF_DATA DIM_X 0x380BEF EXTERN WORD IF_DATA MCMESS 0x380BEF EXTERN /end MEASUREMENT
/begin MEASUREMENT pd_we_zy "" UWORD dez 1 100 0 65535 FUNCTION_LIST ACIFI IF_DATA DIM_X 0xFA8E INTERN WORD IF_DATA MCMESS 0xFA8E INTERN /end MEASUREMENT
/begin MEASUREMENT percnt2_w "Zähler 10-ms-Schritte für fr-synchrone lamsolh-Mittelung, Bank 2" UWORD dez 1 100 0 65535 FUNCTION_LIST LRSHK IF_DATA DIM_X 0x382A98 EXTERN WORD IF_DATA MCMESS 0x382A98 EXTERN /end MEASUREMENT
/begin MEASUREMENT percnt_w "Zähler 10-ms-Schritte für fr-synchrone lamsolh-Mittelung" UWORD dez 1 100 0 65535 FUNCTION_LIST LRSHK IF_DATA DIM_X 0x382A9A EXTERN WORD IF_DATA MCMESS 0x382A9A EXTERN /end MEASUREMENT
/begin MEASUREMENT perffilt_w "" UWORD rel_q0p025 1 100 0 1638.38 FUNCTION_LIST RUNTIME IF_DATA DIM_X 0x382856 EXTERN WORD IF_DATA MCMESS 0x382856 EXTERN /end MEASUREMENT
/begin MEASUREMENT perfmax_w "" UWORD rel_q0p025 1 100 0 1638.38 FUNCTION_LIST RUNTIME IF_DATA DIM_X 0x383A2C EXTERN WORD IF_DATA MCMESS 0x383A2C EXTERN /end MEASUREMENT
/begin MEASUREMENT perfmin_w "" UWORD rel_q0p025 1 100 0 1638.38 FUNCTION_LIST RUNTIME IF_DATA DIM_X 0x383A2E EXTERN WORD IF_DATA MCMESS 0x383A2E EXTERN /end MEASUREMENT
/begin MEASUREMENT perform_w "" UWORD rel_q0p025 1 100 0 1638.38 FUNCTION_LIST RUNTIME IF_DATA DIM_X 0x382858 EXTERN WORD IF_DATA MCMESS 0x382858 EXTERN /end MEASUREMENT
/begin MEASUREMENT peri50ms_w "" UWORD runtime2_sy 1 100 0 699040 FUNCTION_LIST RUNTIME IF_DATA DIM_X 0x38285A EXTERN WORD IF_DATA MCMESS 0x38285A EXTERN /end MEASUREMENT
/begin MEASUREMENT phLosCtr_w "Zähler Neusynchronisation durch falsche Synchronisation an BM (word)" UWORD dez 1 100 0 65535 FUNCTION_LIST NLPH IF_DATA DIM_X 0x383966 EXTERN WORD IF_DATA MCMESS 0x383966 EXTERN /end MEASUREMENT
/begin MEASUREMENT phlsnh "normierte Heizleistung der Lambdasonde hinter Kat" UBYTE fak_ub_q0p01 1 100 0 2.55 FUNCTION_LIST HLSHK DHLSHK DLSH T2LID IF_DATA DIM_X 0x380A8D EXTERN WORD IF_DATA MCMESS 0x380A8D EXTERN /end MEASUREMENT
/begin MEASUREMENT phlsnh2 "normierte Heizleistung der Lambdasonde 2 hinter Kat" UBYTE fak_ub_q0p01 1 100 0 2.55 FUNCTION_LIST HLSHK DHLSHK T2LID IF_DATA DIM_X 0x380A8E EXTERN WORD IF_DATA MCMESS 0x380A8E EXTERN /end MEASUREMENT
/begin MEASUREMENT phlsnhf "normierte Heizleistung der Lambdasonde hinter Kat, gefiltert" UBYTE fak_ub_q0p01 1 100 0 2.55 FUNCTION_LIST DHLSHK IF_DATA DIM_X 0x380A50 EXTERN WORD IF_DATA MCMESS 0x380A50 EXTERN /end MEASUREMENT
/begin MEASUREMENT phlsnhf2 "normierte Heizleistung der Lambdasonde 2 hinter Kat, gefiltert" UBYTE fak_ub_q0p01 1 100 0 2.55 FUNCTION_LIST DHLSHK IF_DATA DIM_X 0x380A51 EXTERN WORD IF_DATA MCMESS 0x380A51 EXTERN /end MEASUREMENT
/begin MEASUREMENT phpw "Phasensignal Pegelwechsel (8 Bit Schieberegister)" UBYTE dez 1 100 0 255 FUNCTION_LIST DPH IF_DATA DIM_X 0x380A23 EXTERN WORD IF_DATA MCMESS 0x380A23 EXTERN /end MEASUREMENT
/begin MEASUREMENT phpw2 "Phasensignal 2 Pegelwechsel (8 Bit Schieberegister)" UBYTE dez 1 100 0 255 FUNCTION_LIST DPH IF_DATA DIM_X 0x380A24 EXTERN WORD IF_DATA MCMESS 0x380A24 EXTERN /end MEASUREMENT
/begin MEASUREMENT phtevpu_w "Quotient Druck hinter TEV / Umgebungsdruck" UWORD fak_uw_b2 1 100 0 1.99997 FUNCTION_LIST BGTEV IF_DATA DIM_X 0x382B88 EXTERN WORD IF_DATA MCMESS 0x382B88 EXTERN /end MEASUREMENT
/begin MEASUREMENT pirgfue_w "Partialdruck Restgas interne AGR (für FUEDK)" UWORD p_uw_q0p039 1 100 0 2559.96 FUNCTION_LIST BGSRM FUEDK IF_DATA DIM_X 0x3820CE EXTERN WORD IF_DATA MCMESS 0x3820CE EXTERN /end MEASUREMENT
/begin MEASUREMENT pirgrold_w "Rohwert Partialdruck Restgas interne AGR für rlmax-Berechnung" UWORD p_uw_q0p039 1 100 0 2559.96 FUNCTION_LIST BGSRM LDRLMX IF_DATA DIM_X 0x3820D0 EXTERN WORD IF_DATA MCMESS 0x3820D0 EXTERN /end MEASUREMENT
/begin MEASUREMENT pirgro_w "Rohwert Partialdruck Restgas internes AGR" UWORD p_uw_q0p039 1 100 0 2559.96 FUNCTION_LIST BGSRM IF_DATA DIM_X 0x3820D2 EXTERN WORD IF_DATA MCMESS 0x3820D2 EXTERN /end MEASUREMENT
/begin MEASUREMENT pirg_w "Partialdruck Restgas interne AGR (16-Bit)" UWORD p_uw_q0p039 1 100 0 2559.96 FUNCTION_LIST BGSRM BGRLP IF_DATA DIM_X 0x3820E6 EXTERN WORD IF_DATA MCMESS 0x3820E6 EXTERN /end MEASUREMENT
/begin MEASUREMENT plsol "Soll-Ladedruck" UBYTE p_ub_q10 1 100 0 2550 FUNCTION_LIST FUEDK DFFTK DLDR LDRPID LDTVMA LDUVST SSTBER87 IF_DATA DIM_X 0x380AFE EXTERN WORD IF_DATA MCMESS 0x380AFE EXTERN /end MEASUREMENT
/begin MEASUREMENT plsolr_w "Relativer Solladedruck LDR" UWORD p_uw_q0p039 1 100 0 2559.96 FUNCTION_LIST LDRPID IF_DATA DIM_X 0x3824E2 EXTERN WORD IF_DATA MCMESS 0x3824E2 EXTERN /end MEASUREMENT
/begin MEASUREMENT plsol_w "Soll-Ladedruck" UWORD p_uw_q0p039 1 100 0 2559.96 FUNCTION_LIST FUEDK BBLDR GGDSAS LDRPID LDUVST SSTBER87 T2LID IF_DATA DIM_X 0x382146 EXTERN WORD IF_DATA MCMESS 0x382146 EXTERN /end MEASUREMENT
/begin MEASUREMENT poel "Öldruck" UBYTE p_ub_q40 1 100 0 10200 FUNCTION_LIST CAN VS IF_DATA DIM_X 0x380962 EXTERN WORD IF_DATA MCMESS 0x380962 EXTERN /end MEASUREMENT
/begin MEASUREMENT poshebel "Position des Wählhebels bei Automatgetriebe" UBYTE dez 1 100 0 255 FUNCTION_LIST CAN MDEX IF_DATA DIM_X 0x380963 EXTERN WORD IF_DATA MCMESS 0x380963 EXTERN /end MEASUREMENT
/begin MEASUREMENT psagr_w "Partialdruck durch externes Restgas (Restluft+Inertgas)" UWORD p_uw_q0p039 1 100 0 2559.96 FUNCTION_LIST SWADP BGSRM IF_DATA DIM_X 0x382B2E EXTERN WORD IF_DATA MCMESS 0x382B2E EXTERN /end MEASUREMENT
/begin MEASUREMENT psdss_w "Saugrohrdruck gemessen mit Drucksensor am Saugrohr (DS-S)" UWORD p_uw_q0p039 1 100 0 2559.96 FUNCTION_LIST SWADP IF_DATA DIM_X 0x382B30 EXTERN WORD IF_DATA MCMESS 0x382B30 EXTERN /end MEASUREMENT
/begin MEASUREMENT pses_w "Saugrohrdruck über Verstellsystem korrigiert" UWORD p_uw_q0p039 1 100 0 2559.96 FUNCTION_LIST AES IF_DATA DIM_X 0x3821E8 EXTERN WORD IF_DATA MCMESS 0x3821E8 EXTERN /end MEASUREMENT
/begin MEASUREMENT psfg_w "Frischgaspartialdruck im Saugrohr (word)" UWORD p_uw_q0p039 1 100 0 2559.96 FUNCTION_LIST BGSRM IF_DATA DIM_X 0x3820E8 EXTERN WORD IF_DATA MCMESS 0x3820E8 EXTERN /end MEASUREMENT
/begin MEASUREMENT psl "Öldruck von der Servo-Lenkung" UBYTE dez 1 100 0 255 FUNCTION_LIST SWADP LLRNS IF_DATA DIM_X 0x380CA0 EXTERN WORD IF_DATA MCMESS 0x380CA0 EXTERN /end MEASUREMENT
/begin MEASUREMENT psmppvdk_w "praed. ps/Druck vor Drosselklappe (word)" UWORD fak_uw_q0p001 1 100 0 65.535 FUNCTION_LIST BGRLP IF_DATA DIM_X 0x382206 EXTERN WORD IF_DATA MCMESS 0x382206 EXTERN /end MEASUREMENT
/begin MEASUREMENT psmp_w "extrapolierter Saugrohrdruck (Word)" UWORD p_uw_q0p039 1 100 0 2559.96 FUNCTION_LIST BGRLP IF_DATA DIM_X 0x382208 EXTERN WORD IF_DATA MCMESS 0x382208 EXTERN /end MEASUREMENT
/begin MEASUREMENT psmx_w "Saugrohrmaximaldruckbegrenzung für modellierten Saugrohrdruck" UWORD p_uw_q0p039 1 100 0 2559.96 FUNCTION_LIST BGSRM IF_DATA DIM_X 0x3820EA EXTERN WORD IF_DATA MCMESS 0x3820EA EXTERN /end MEASUREMENT
/begin MEASUREMENT pspmx_w "max. praedizierter Saugrohrdruck" UWORD p_uw_q0p039 1 100 0 2559.96 FUNCTION_LIST BGRLP IF_DATA DIM_X 0x38220A EXTERN WORD IF_DATA MCMESS 0x38220A EXTERN /end MEASUREMENT
/begin MEASUREMENT pspu "Quotient Saugrohrdruck Umgebungsdruck" UBYTE fak_ub_b2 1 100 0 1.99219 FUNCTION_LIST TEB ATEV IF_DATA DIM_X 0x380CC8 EXTERN WORD IF_DATA MCMESS 0x380CC8 EXTERN /end MEASUREMENT
/begin MEASUREMENT pspvdb_w "Quotient Saugrohrduck/Druck vor DK begrenzt (word)" UWORD fak_uw_b2 1 100 0 1.99997 FUNCTION_LIST BGMSZS IF_DATA DIM_X 0x382014 EXTERN WORD IF_DATA MCMESS 0x382014 EXTERN /end MEASUREMENT
/begin MEASUREMENT pspvdk_w "Quotient Saugrohrdruck/Druck vor Drosselklappe (word)" UWORD fak_uw_b2 1 100 0 1.99997 FUNCTION_LIST BGMSZS FUEDK GGDSAS IF_DATA DIM_X 0x382016 EXTERN WORD IF_DATA MCMESS 0x382016 EXTERN /end MEASUREMENT
/begin MEASUREMENT pspvds_w "Quotient Saugrohrdruck/Druck vor DK" UWORD fak_uw_b2 1 100 0 1.99997 FUNCTION_LIST BGMSZS BGRLP DLDR IF_DATA DIM_X 0x382018 EXTERN WORD IF_DATA MCMESS 0x382018 EXTERN /end MEASUREMENT
/begin MEASUREMENT pspvmin_w "Minimalauswahl aus pspvdk und psspvdk" UWORD fak_uw_b2 1 100 0 1.99997 FUNCTION_LIST FUEDK IF_DATA DIM_X 0x382148 EXTERN WORD IF_DATA MCMESS 0x382148 EXTERN /end MEASUREMENT
/begin MEASUREMENT psp_w "praedizierter Saugrohrdruck (Word)" UWORD p_uw_q0p039 1 100 0 2559.96 FUNCTION_LIST BGRLP IF_DATA DIM_X 0x38220C EXTERN WORD IF_DATA MCMESS 0x38220C EXTERN /end MEASUREMENT
/begin MEASUREMENT psrlfue_w "Umrechnung Druck auf Füllung (für FUEDK)" UWORD rel_uw_b0p3 1 100 0 0.299995 FUNCTION_LIST BGSRM FUEDK IF_DATA DIM_X 0x3820D4 EXTERN WORD IF_DATA MCMESS 0x3820D4 EXTERN /end MEASUREMENT
/begin MEASUREMENT psrlrold_w "Umrschnung Drck auf Füllung für rlmax-Berechnung" UWORD rel_uw_b0p3 1 100 0 0.299995 FUNCTION_LIST BGSRM LDRLMX IF_DATA DIM_X 0x3820D6 EXTERN WORD IF_DATA MCMESS 0x3820D6 EXTERN /end MEASUREMENT
/begin MEASUREMENT psrlro_w "Rohwert für Faktor systembezogene Umrechnung Druck auf Füllung" UWORD rel_uw_b0p3 1 100 0 0.299995 FUNCTION_LIST BGSRM IF_DATA DIM_X 0x3820D8 EXTERN WORD IF_DATA MCMESS 0x3820D8 EXTERN /end MEASUREMENT
/begin MEASUREMENT pssol_w "Sollsaugrohrdruck" UWORD p_uw_q0p039 1 100 0 2559.96 FUNCTION_LIST FUEDK BGMSZS GGDSAS LDRPLS IF_DATA DIM_X 0x38214A EXTERN WORD IF_DATA MCMESS 0x38214A EXTERN /end MEASUREMENT
/begin MEASUREMENT psspvdkb_w "Verhältnis Soll-Saugrohrdruck zu Druck vor Drosselklappe begrenzt" UWORD fak_uw_b2 1 100 0 1.99997 FUNCTION_LIST FUEDK IF_DATA DIM_X 0x38214C EXTERN WORD IF_DATA MCMESS 0x38214C EXTERN /end MEASUREMENT
/begin MEASUREMENT psspvdkd_w "Verhältnis Sollsaugrohrdruck/Druck vor Drosselklappe von Drucksensor (word)" UWORD fak_uw_b4 1 100 0 3.99994 FUNCTION_LIST GGDSAS IF_DATA DIM_X 0x3820A2 EXTERN WORD IF_DATA MCMESS 0x3820A2 EXTERN /end MEASUREMENT
/begin MEASUREMENT psspvdk_w "Verhältnis Soll-Saugrohrdruck zu Druck vor Drosselklappe" UWORD fak_uw_b2 1 100 0 1.99997 FUNCTION_LIST FUEDK IF_DATA DIM_X 0x38214E EXTERN WORD IF_DATA MCMESS 0x38214E EXTERN /end MEASUREMENT
/begin MEASUREMENT ps_u "Saugrohr-Absolutdruck (Umwelt)" UBYTE p_ub_q10 1 100 0 2550 FUNCTION_LIST DFFTCNV DFFTK IF_DATA DIM_X 0x3809F2 EXTERN WORD IF_DATA MCMESS 0x3809F2 EXTERN /end MEASUREMENT
/begin MEASUREMENT ps_w "Saugrohr-Absolutdruck (Word)" UWORD p_uw_q0p039 1 100 0 2559.96 FUNCTION_LIST BGSRM AES BGMSZS BGRLP BGTEV DFFTCNV GGDSAS SLS T2DFA T2LID TEB IF_DATA DIM_X 0xFADE INTERN WORD IF_DATA MCMESS 0xFADE INTERN /end MEASUREMENT
/begin MEASUREMENT pte "Tankdifferenzdruck, Eingangssignal, (nach AD-Wandler)" SBYTE p_sb_q0p25 1 100 -32 31.75 FUNCTION_LIST SWADP TEB IF_DATA DIM_X 0x380CA1 EXTERN WORD IF_DATA MCMESS 0x380CA1 EXTERN /end MEASUREMENT
/begin MEASUREMENT pu "Umgebungsdruck" UBYTE p_ub_q5 1 100 0 1275 FUNCTION_LIST GGDSAS CAN DFFT DLDR LDRLMX LDRPID LDUVST SLS SSTBER87 T2DFA T2LID TEB IF_DATA DIM_X 0x380AF0 EXTERN WORD IF_DATA MCMESS 0x380AF0 EXTERN /end MEASUREMENT
/begin MEASUREMENT pus_u "Umgebungsdruck ohne Umschaltung auf Ersatzwert bei Sensorfehler (Umwelt)" UBYTE p_ub_q10 1 100 0 2550 FUNCTION_LIST DFFTCNV DFFTK IF_DATA DIM_X 0x3809F3 EXTERN WORD IF_DATA MCMESS 0x3809F3 EXTERN /end MEASUREMENT
/begin MEASUREMENT pus_w "Umgebungsdruck ohne Umschaltung auf Ersatzwert bei Sensorfehler" UWORD p_uw_q0p039 1 100 0 2559.96 FUNCTION_LIST GGDSAS DFFTCNV IF_DATA DIM_X 0x382096 EXTERN WORD IF_DATA MCMESS 0x382096 EXTERN /end MEASUREMENT
/begin MEASUREMENT pu_w "Umgebungsdruck" UWORD p_uw_q0p039 1 100 0 2559.96 FUNCTION_LIST GGDSAS AES BBLDR BGMSZS BGSRM BGTEV FUEDK GGLSU LDRPID LDRPLS LDUVST IF_DATA DIM_X 0x382098 EXTERN WORD IF_DATA MCMESS 0x382098 EXTERN /end MEASUREMENT
/begin MEASUREMENT pvdk "Druck vor Drosselklappe" UBYTE p_ub_q10 1 100 0 2550 FUNCTION_LIST BGMSZS DFFTK IF_DATA DIM_X 0x380AED EXTERN WORD IF_DATA MCMESS 0x380AED EXTERN /end MEASUREMENT
/begin MEASUREMENT pvdkds "Druck vor Drosselklappe von Drucksensor" UBYTE p_ub_q10 1 100 0 2550 FUNCTION_LIST GGDSAS LDRPID LDUVST IF_DATA DIM_X 0x380AF3 EXTERN WORD IF_DATA MCMESS 0x380AF3 EXTERN /end MEASUREMENT
/begin MEASUREMENT pvdkdsl_w "Druck vor Drosselklappe von Ladedrucksensor (word)" UWORD p_uw_q0p039 1 100 0 2559.96 FUNCTION_LIST GGDSAS IF_DATA DIM_X 0x3820A4 EXTERN WORD IF_DATA MCMESS 0x3820A4 EXTERN /end MEASUREMENT
/begin MEASUREMENT pvdkdsu_w "Druck vor Drosselklappe von Umgebungsdrucksensor (word)" UWORD p_uw_q0p039 1 100 0 2559.96 FUNCTION_LIST GGDSAS IF_DATA DIM_X 0x38209A EXTERN WORD IF_DATA MCMESS 0x38209A EXTERN /end MEASUREMENT
/begin MEASUREMENT pvdkds_w "Druck vor Drosselklappe von Drucksensor (word)" UWORD p_uw_q0p039 1 100 0 2559.96 FUNCTION_LIST GGDSAS BGMSZS BGSRM T2LID IF_DATA DIM_X 0x3820A6 EXTERN WORD IF_DATA MCMESS 0x3820A6 EXTERN /end MEASUREMENT
/begin MEASUREMENT pvdkmx_w "Maximaler Druck vor Drosselklappe Ausgangswert aus Kennlinie PVDKMX" UWORD p_uw_q0p039 1 100 0 2559.96 FUNCTION_LIST GGDSAS IF_DATA DIM_X 0x3820A8 EXTERN WORD IF_DATA MCMESS 0x3820A8 EXTERN /end MEASUREMENT
/begin MEASUREMENT pvdkr_w "Referenzdruck vor Drosselklappe" UWORD p_uw_q0p039 1 100 0 2559.96 FUNCTION_LIST FUEDK IF_DATA DIM_X 0x382150 EXTERN WORD IF_DATA MCMESS 0x382150 EXTERN /end MEASUREMENT
/begin MEASUREMENT pvdkspud "Differenz zwischen Umgebungsdruck und Druck vor Drosselklappe" UBYTE p_ub_q10 1 100 0 2550 FUNCTION_LIST GGDSAS CAN IF_DATA DIM_X 0x380AF1 EXTERN WORD IF_DATA MCMESS 0x380AF1 EXTERN /end MEASUREMENT
/begin MEASUREMENT pvdks_u "Druck vor Drosselklappe ohne Umschaltung auf Ersatzwert bei Sensorfehler" UBYTE p_ub_q10 1 100 0 2550 FUNCTION_LIST DFFTCNV DFFTK IF_DATA DIM_X 0x3809F4 EXTERN WORD IF_DATA MCMESS 0x3809F4 EXTERN /end MEASUREMENT
/begin MEASUREMENT pvdks_w "Druck vor Drosselklappe ohne Umschaltung auf Ersatzwert bei Sensorfehler" UWORD p_uw_q0p039 1 100 0 2559.96 FUNCTION_LIST GGDSAS DFFTCNV IF_DATA DIM_X 0x3820AA EXTERN WORD IF_DATA MCMESS 0x3820AA EXTERN /end MEASUREMENT
/begin MEASUREMENT pvdk_w "Druck vor Drosselklappe 16-Bit" UWORD p_uw_q0p039 1 100 0 2559.96 FUNCTION_LIST BGMSZS BGRLP FUEDK IF_DATA DIM_X 0x38201A EXTERN WORD IF_DATA MCMESS 0x38201A EXTERN /end MEASUREMENT
/begin MEASUREMENT pvl_w "Druck vor Lader" UWORD p_uw_q0p039 1 100 0 2559.96 FUNCTION_LIST BGTEV IF_DATA DIM_X 0x382B8A EXTERN WORD IF_DATA MCMESS 0x382B8A EXTERN /end MEASUREMENT
/begin MEASUREMENT qltefil "Füllungsgrad mit Regeneriergas der leitung TEV-Saugrohr" UBYTE fak_ub_b1 1 100 0 0.996094 FUNCTION_LIST BGTEV IF_DATA DIM_X 0x380CB0 EXTERN WORD IF_DATA MCMESS 0x380CB0 EXTERN /end MEASUREMENT
/begin MEASUREMENT qmsdyn "Quotient aus ml_w und mssgin_w" UBYTE fak_ub_b16 1 100 0 15.9375 FUNCTION_LIST TEB SSTBER87 IF_DATA DIM_X 0x380CC9 EXTERN WORD IF_DATA MCMESS 0x380CC9 EXTERN /end MEASUREMENT
/begin MEASUREMENT qnst "Drehzahlquotient im Start" UBYTE fak_ub_b2 1 100 0 1.99219 FUNCTION_LIST STMD IF_DATA DIM_X 0x380C21 EXTERN WORD IF_DATA MCMESS 0x380C21 EXTERN /end MEASUREMENT
/begin MEASUREMENT qntns "Quotient aus Turbinendrehzahl des Wandlers und Solldrehzahl der LLR" UBYTE fak_ub_b8 1 100 0 7.96875 FUNCTION_LIST MDWAN IF_DATA DIM_X 0x380C1E EXTERN WORD IF_DATA MCMESS 0x380C1E EXTERN /end MEASUREMENT
/begin MEASUREMENT qtetemin "Quotient: te / TEMIN für BDE teh_w/teminh_w bzw. tes_w/temins" UBYTE fak_ub_b4 1 100 0 3.98438 FUNCTION_LIST TEB IF_DATA DIM_X 0x380CCA EXTERN WORD IF_DATA MCMESS 0x380CCA EXTERN /end MEASUREMENT
/begin MEASUREMENT qzzyl "Initialisierungswert Zylinderzähler bei B_qsyn" UBYTE dez 1 100 0 255 FUNCTION_LIST GGDPG IF_DATA DIM_X 0x380A29 EXTERN WORD IF_DATA MCMESS 0x380A29 EXTERN /end MEASUREMENT
/begin MEASUREMENT r1000msCtr "" UWORD dez 1 100 0 65535 FUNCTION_LIST V7804X_T IF_DATA DIM_X 0x380D2A EXTERN WORD IF_DATA MCMESS 0x380D2A EXTERN /end MEASUREMENT
/begin MEASUREMENT r100msCtr "" UWORD dez 1 100 0 65535 FUNCTION_LIST V7804X_T IF_DATA DIM_X 0x380D2C EXTERN WORD IF_DATA MCMESS 0x380D2C EXTERN /end MEASUREMENT
/begin MEASUREMENT r10msCtr "10ms-Raster-Zähler der Funktion" UWORD dez 1 100 0 65535 FUNCTION_LIST V7804X_T IF_DATA DIM_X 0x380D34 EXTERN WORD IF_DATA MCMESS 0x380D34 EXTERN /end MEASUREMENT
/begin MEASUREMENT r1msCtr "" UWORD dez 1 100 0 65535 FUNCTION_LIST V7804X_T IF_DATA DIM_X 0x380D36 EXTERN WORD IF_DATA MCMESS 0x380D36 EXTERN /end MEASUREMENT
/begin MEASUREMENT r200msCtr "" UWORD dez 1 100 0 65535 FUNCTION_LIST V7804X_T IF_DATA DIM_X 0x380D2E EXTERN WORD IF_DATA MCMESS 0x380D2E EXTERN /end MEASUREMENT
/begin MEASUREMENT r20msCtr "" UWORD dez 1 100 0 65535 FUNCTION_LIST V7804X_T IF_DATA DIM_X 0x380D38 EXTERN WORD IF_DATA MCMESS 0x380D38 EXTERN /end MEASUREMENT
/begin MEASUREMENT r2msCtr "" UWORD dez 1 100 0 65535 FUNCTION_LIST V7804X_T IF_DATA DIM_X 0x380D3A EXTERN WORD IF_DATA MCMESS 0x380D3A EXTERN /end MEASUREMENT
/begin MEASUREMENT r50msCtr "" UWORD dez 1 100 0 65535 FUNCTION_LIST V7804X_T IF_DATA DIM_X 0x380D3C EXTERN WORD IF_DATA MCMESS 0x380D3C EXTERN /end MEASUREMENT
/begin MEASUREMENT ram_c_um "Fehlerzähler im Dauer-RAM für RAM-Konsistenz-Prüfung (Diagnose) in der Fkt-Überw" UBYTE dez 1 100 0 255 FUNCTION_LIST UFURAM IF_DATA DIM_X 0x3830BC EXTERN WORD IF_DATA MCMESS 0x3830BC EXTERN /end MEASUREMENT
/begin MEASUREMENT reac_c1_uc "Fehlerzähler 1 für Fehlerreaktionsüberwachung im Befehlstest" UBYTE t40ms_ub_b10200 1 100 0 10200 FUNCTION_LIST URCREAC URCAUS URCREF IF_DATA DIM_X 0x380C7D EXTERN WORD IF_DATA MCMESS 0x380C7D EXTERN /end MEASUREMENT
/begin MEASUREMENT reac_c1_um "Fehlerzähler 1 für Fehlerreaktionsüberwachung in Funktionsüberwachung" UBYTE t40ms_ub_b10200 1 100 0 10200 FUNCTION_LIST UFREAC IF_DATA DIM_X 0x382E80 EXTERN WORD IF_DATA MCMESS 0x382E80 EXTERN /end MEASUREMENT
/begin MEASUREMENT reac_c2_uc "Fehlerzähler 2 für Fehlerreaktionsüberwachung im Befehlstest" UBYTE t40ms_ub_b10200 1 100 0 10200 FUNCTION_LIST URCREAC URCAUS URCREF IF_DATA DIM_X 0x380C7E EXTERN WORD IF_DATA MCMESS 0x380C7E EXTERN /end MEASUREMENT
/begin MEASUREMENT reac_c2_um "Fehlerzähler 2 für Fehlerreaktionsüberwachung in Funktionsüberwachung" UBYTE t40ms_ub_b10200 1 100 0 10200 FUNCTION_LIST UFREAC IF_DATA DIM_X 0x382E81 EXTERN WORD IF_DATA MCMESS 0x382E81 EXTERN /end MEASUREMENT
/begin MEASUREMENT reac_c_um "Fehlerzähler im Dauer-RAM für Fehlerreaktionsüberwachung (Diagnose) in der FU" UBYTE dez 1 100 0 255 FUNCTION_LIST UFURAM IF_DATA DIM_X 0x3830BD EXTERN WORD IF_DATA MCMESS 0x3830BD EXTERN /end MEASUREMENT
/begin MEASUREMENT ready "readiness-Byte für Ausgabe SAE J1979 Mode2" UBYTE dez 1 100 0 255 FUNCTION_LIST DIMC T2LID TC1MOD IF_DATA DIM_X 0x382FD0 EXTERN WORD IF_DATA MCMESS 0x382FD0 EXTERN /end MEASUREMENT
/begin MEASUREMENT redbas "Basis-Reduzierstufe" UBYTE dez 1 100 0 255 FUNCTION_LIST BGEVAB IF_DATA DIM_X 0x380B1B EXTERN WORD IF_DATA MCMESS 0x380B1B EXTERN /end MEASUREMENT
/begin MEASUREMENT redhyst "Reduzierstufenhysterese" SBYTE rel_sb_q0p02 1 100 -2.56 2.54 FUNCTION_LIST MDRED1 IF_DATA DIM_X 0x380C3C EXTERN WORD IF_DATA MCMESS 0x380C3C EXTERN /end MEASUREMENT
/begin MEASUREMENT redist "Ist-Reduzierstufe" UBYTE dez 1 100 0 255 FUNCTION_LIST BGEVAB CAN MDIST MDZW ZUE IF_DATA DIM_X 0x380B1C EXTERN WORD IF_DATA MCMESS 0x380B1C EXTERN /end MEASUREMENT
/begin MEASUREMENT redneu "neu berechnete Reduzierstufe" UBYTE dez 1 100 0 255 FUNCTION_LIST MDRED1 IF_DATA DIM_X 0x380C3D EXTERN WORD IF_DATA MCMESS 0x380C3D EXTERN /end MEASUREMENT
/begin MEASUREMENT redsol "Berechnete Soll-Reduzierstufe" UBYTE dez 1 100 0 255 FUNCTION_LIST MDRED1 AEVAB BGEVAB IF_DATA DIM_X 0x380C3E EXTERN WORD IF_DATA MCMESS 0x380C3E EXTERN /end MEASUREMENT
/begin MEASUREMENT redsolr "Realisierte Reduzierstufe" UBYTE dez 1 100 0 255 FUNCTION_LIST AEVAB IF_DATA DIM_X 0x380B0F EXTERN WORD IF_DATA MCMESS 0x380B0F EXTERN /end MEASUREMENT
/begin MEASUREMENT redsol_one "Berechnete Soll-Reduzierstufe - 1 zur Adress. von REDABM" UBYTE dez 1 100 0 255 FUNCTION_LIST AEVAB IF_DATA DIM_X 0x380B10 EXTERN WORD IF_DATA MCMESS 0x380B10 EXTERN /end MEASUREMENT
/begin MEASUREMENT redze "Schwelle in Reduzierstufe zwischen Zünd- und Einspritzeingriff" UBYTE dez 1 100 0 255 FUNCTION_LIST MDRED1 IF_DATA DIM_X 0x380C3F EXTERN WORD IF_DATA MCMESS 0x380C3F EXTERN /end MEASUREMENT
/begin MEASUREMENT redzst_w "Reduzierstufe ohne Hysterese und Rundung" UWORD rel_uw_q0p001 1 100 0 65.535 FUNCTION_LIST MDRED1 IF_DATA DIM_X 0x3826BC EXTERN WORD IF_DATA MCMESS 0x3826BC EXTERN /end MEASUREMENT
/begin MEASUREMENT resetMonIdx "" UWORD dez 1 100 0 65535 FUNCTION_LIST rstmon IF_DATA DIM_X 0x383E52 EXTERN WORD IF_DATA MCMESS 0x383E52 EXTERN /end MEASUREMENT
/begin MEASUREMENT reset_indication_um "" UWORD dez 1 100 0 65535 FUNCTION_LIST UFURAM IF_DATA DIM_X 0x383A32 EXTERN WORD IF_DATA MCMESS 0x383A32 EXTERN /end MEASUREMENT
/begin MEASUREMENT restw_b1 "" UBYTE dez 1 100 0 255 FUNCTION_LIST ACIFI IF_DATA DIM_X 0xFA60 INTERN WORD IF_DATA MCMESS 0xFA60 INTERN /end MEASUREMENT
/begin MEASUREMENT restw_b2 "" UBYTE dez 1 100 0 255 FUNCTION_LIST ACIFI IF_DATA DIM_X 0xFA61 INTERN WORD IF_DATA MCMESS 0xFA61 INTERN /end MEASUREMENT
/begin MEASUREMENT rfagr_w "relative Füllung AGR (word)" UWORD rel_uw_q0p0234 1 100 0 1535.98 FUNCTION_LIST BGSRM BGRLP IF_DATA DIM_X 0x3820EC EXTERN WORD IF_DATA MCMESS 0x3820EC EXTERN /end MEASUREMENT
/begin MEASUREMENT rfges_w "gesamte relative Füllung (inclusive AGR) 16-Bit" UWORD rel_uw_q0p0234 1 100 0 1535.98 FUNCTION_LIST BGSRM IF_DATA DIM_X 0x3820DA EXTERN WORD IF_DATA MCMESS 0x3820DA EXTERN /end MEASUREMENT
/begin MEASUREMENT rinh2_u "Istwert (Byte) Innenwiderstand Ri-Nernstzelle der Lambdasonde hinter KAT Bank2" UBYTE r_ub_q64 1 100 0 16320 FUNCTION_LIST DFFTCNV DFFT T2LID IF_DATA DIM_X 0x3809F5 EXTERN WORD IF_DATA MCMESS 0x3809F5 EXTERN /end MEASUREMENT
/begin MEASUREMENT rinh2_w "Istwert (word) Innenwiderstand Ri-Nernstzelle der Lambdasonde hinter KAT Bank2" UWORD r_uw_q2 1 100 0 131070 FUNCTION_LIST GGLSH DFFTCNV DHLSHK DLSH IF_DATA DIM_X 0x381D7A EXTERN WORD IF_DATA MCMESS 0x381D7A EXTERN /end MEASUREMENT
/begin MEASUREMENT rinh_u "Istwert (Byte) Innenwiderstand Ri-Nernstzelle der Lambdasonde hinter KAT" UBYTE r_ub_q64 1 100 0 16320 FUNCTION_LIST DFFTCNV DFFT T2LID IF_DATA DIM_X 0x3809F6 EXTERN WORD IF_DATA MCMESS 0x3809F6 EXTERN /end MEASUREMENT
/begin MEASUREMENT rinh_w "Istwert (word) Innenwiderstand Ri-Nernstzelle der Lambdasonde hinter KAT" UWORD r_uw_q2 1 100 0 131070 FUNCTION_LIST GGLSH DFFTCNV DHLSHK DLSH IF_DATA DIM_X 0x381D7C EXTERN WORD IF_DATA MCMESS 0x381D7C EXTERN /end MEASUREMENT
/begin MEASUREMENT rinkfh "Innenwiderstand Nernstzelle der Lambdasonde aus Kennfeld vor Kat" UBYTE r_q8 1 100 0 2040 FUNCTION_LIST DHLSHK IF_DATA DIM_X 0x380A52 EXTERN WORD IF_DATA MCMESS 0x380A52 EXTERN /end MEASUREMENT
/begin MEASUREMENT rinkfh2 "Innenwiderstand Nernstzelle der Lambdasonde 2 aus Kennfeld vor Kat" UBYTE r_q8 1 100 0 2040 FUNCTION_LIST DHLSHK IF_DATA DIM_X 0x380A53 EXTERN WORD IF_DATA MCMESS 0x380A53 EXTERN /end MEASUREMENT
/begin MEASUREMENT rinofh2_w "Innenwiderstand (word) Ri Nernst ohne Filterung hinter KAT Bank2" UWORD r_uw_q2 1 100 0 131070 FUNCTION_LIST GGLSH IF_DATA DIM_X 0x381D7E EXTERN WORD IF_DATA MCMESS 0x381D7E EXTERN /end MEASUREMENT
/begin MEASUREMENT rinofha2_w "Innenwiderstand (word) Ri Nernst (alter Wert) ohne Filterung hinter KAT Bank2" UWORD r_uw_q2 1 100 0 131070 FUNCTION_LIST GGLSH IF_DATA DIM_X 0x381D80 EXTERN WORD IF_DATA MCMESS 0x381D80 EXTERN /end MEASUREMENT
/begin MEASUREMENT rinofha_w "Innenwiderstand (word) Ri Nernst (alter Wert) ohne Filterung hinter KAT" UWORD r_uw_q2 1 100 0 131070 FUNCTION_LIST GGLSH IF_DATA DIM_X 0x381D82 EXTERN WORD IF_DATA MCMESS 0x381D82 EXTERN /end MEASUREMENT
/begin MEASUREMENT rinofh_w "Innenwiderstand (word) Ri Nernst ohne Filterung hinter KAT" UWORD r_uw_q2 1 100 0 131070 FUNCTION_LIST GGLSH IF_DATA DIM_X 0x381D84 EXTERN WORD IF_DATA MCMESS 0x381D84 EXTERN /end MEASUREMENT
/begin MEASUREMENT rinsh2_w "Grenzwert Innenwiderstand Nernstzelle der Lambdasonde 2 hinter Kat" UWORD r_uw_q2 1 100 0 131070 FUNCTION_LIST DHLSHK T2LID IF_DATA DIM_X 0x381C06 EXTERN WORD IF_DATA MCMESS 0x381C06 EXTERN /end MEASUREMENT
/begin MEASUREMENT rinsh_w "Grenzwert Innenwiderstand Nernstzelle der Lambdasonde hinter Kat" UWORD r_uw_q2 1 100 0 131070 FUNCTION_LIST DHLSHK T2LID IF_DATA DIM_X 0x381C08 EXTERN WORD IF_DATA MCMESS 0x381C08 EXTERN /end MEASUREMENT
/begin MEASUREMENT rinv2_u "Istwert (Byte) Innenwiderstand Ri-Nernstzelle der Lambdasonde vor KAT Bank2" UBYTE r_ub_q64 1 100 0 16320 FUNCTION_LIST DFFTCNV DFFT IF_DATA DIM_X 0x3809F7 EXTERN WORD IF_DATA MCMESS 0x3809F7 EXTERN /end MEASUREMENT
/begin MEASUREMENT rinv2_w "Istwert (word) Innenwiderstand Ri-Nernstzelle der Lambdasonde vor KAT Bank2" UWORD r_uw_q2 1 100 0 131070 FUNCTION_LIST SWADP DFFTCNV IF_DATA DIM_X 0x382B32 EXTERN WORD IF_DATA MCMESS 0x382B32 EXTERN /end MEASUREMENT
/begin MEASUREMENT rinv_u "Istwert (Byte) Innenwiderstand Ri-Nernstzelle der Lambdasonde vor KAT" UBYTE r_ub_q64 1 100 0 16320 FUNCTION_LIST DFFTCNV DFFT IF_DATA DIM_X 0x3809F8 EXTERN WORD IF_DATA MCMESS 0x3809F8 EXTERN /end MEASUREMENT
/begin MEASUREMENT rinv_w "Istwert (word) Innenwiderstand Ri-Nernstzelle der Lambdasonde vor KAT" UWORD r_uw_q2 1 100 0 131070 FUNCTION_LIST SWADP DFFTCNV IF_DATA DIM_X 0x382B34 EXTERN WORD IF_DATA MCMESS 0x382B34 EXTERN /end MEASUREMENT
/begin MEASUREMENT rk2_w "relative Kraftstoffmasse Bank2" UWORD rel_uw_b3072 1 100 0 3071.95 FUNCTION_LIST GK KVA RKTI IF_DATA DIM_X 0x382312 EXTERN WORD IF_DATA MCMESS 0x382312 EXTERN /end MEASUREMENT
/begin MEASUREMENT rka2_w "Additive adaptive Korrektur der relativen Kraftstoffmasse" SWORD rel_sw_b1536 1 100 -1536 1535.95 FUNCTION_LIST LRA GK IF_DATA DIM_X 0x382352 EXTERN WORD IF_DATA MCMESS 0x382352 EXTERN /end MEASUREMENT
/begin MEASUREMENT rkam2_w "Auswahl additive Gemischkorrektur der Gemischadaption für Bestimmung B_gae2" SWORD rel_sw_b1536 1 100 -1536 1535.95 FUNCTION_LIST DKVS IF_DATA DIM_X 0x382238 EXTERN WORD IF_DATA MCMESS 0x382238 EXTERN /end MEASUREMENT
/begin MEASUREMENT rkamzs2_w "additive Gemischkorrektur (pro Zeit oder Zündung) Bank 2 (alter Wert)" SWORD rel_sw_b1536 1 100 -1536 1535.95 FUNCTION_LIST DKVS IF_DATA DIM_X 0x38223A EXTERN WORD IF_DATA MCMESS 0x38223A EXTERN /end MEASUREMENT
/begin MEASUREMENT rkamzs_w "additive Gemischkorrektur (pro Zeit oder Zündung); alter Wert" SWORD rel_sw_b1536 1 100 -1536 1535.95 FUNCTION_LIST DKVS IF_DATA DIM_X 0x38223C EXTERN WORD IF_DATA MCMESS 0x38223C EXTERN /end MEASUREMENT
/begin MEASUREMENT rkam_w "Auswahl additive Gemischkorrektur der Gemischadaption für Bestimmung B_gae" SWORD rel_sw_b1536 1 100 -1536 1535.95 FUNCTION_LIST DKVS IF_DATA DIM_X 0x38223E EXTERN WORD IF_DATA MCMESS 0x38223E EXTERN /end MEASUREMENT
/begin MEASUREMENT rkat2_u "additive Gemischkorrektur (pro Zeit) der Gemischadaption Bank 2 (Byte für %DFFT)" SBYTE rel_q12 1 100 -1536 1524 FUNCTION_LIST DFFTCNV DFFTK IF_DATA DIM_X 0x3809E0 EXTERN WORD IF_DATA MCMESS 0x3809E0 EXTERN /end MEASUREMENT
/begin MEASUREMENT rkat2_w "additive Gemischkorrektur (pro Zeit) der Gemischadaption Bank 2 (Word)" SWORD rel_sw_b1536 1 100 -1536 1535.95 FUNCTION_LIST LRA DFFTCNV DKVS DVS T2LID IF_DATA DIM_X 0x3839CE EXTERN WORD IF_DATA MCMESS 0x3839CE EXTERN /end MEASUREMENT
/begin MEASUREMENT rkat_u "additive Gemischkorrektur (pro Zeit) der Gemischdaption (Word) (8 Bit Umwelt)" SBYTE rel_q12 1 100 -1536 1524 FUNCTION_LIST DFFTCNV DFFTK IF_DATA DIM_X 0x3809E1 EXTERN WORD IF_DATA MCMESS 0x3809E1 EXTERN /end MEASUREMENT
/begin MEASUREMENT rkat_w "additive Gemischkorrektur (pro Zeit) der Gemischdaption (Word)" SWORD rel_sw_b1536 1 100 -1536 1535.95 FUNCTION_LIST LRA DFFTCNV DKVS DTEV DVS T2LID IF_DATA DIM_X 0x3839D0 EXTERN WORD IF_DATA MCMESS 0x3839D0 EXTERN /end MEASUREMENT
/begin MEASUREMENT rkaz2_w "additive Gemischkorrektur (pro Zündung) der Gemischadaption Bank2 (Word)" SWORD rel_sw_b1536 1 100 -1536 1535.95 FUNCTION_LIST LRA DKVS IF_DATA DIM_X 0x3839D2 EXTERN WORD IF_DATA MCMESS 0x3839D2 EXTERN /end MEASUREMENT
/begin MEASUREMENT rkaz_w "additive Gemischkorrektur (pro Zündung) der Gemischadaption" SWORD rel_sw_b1536 1 100 -1536 1535.95 FUNCTION_LIST LRA DKVS DTEV IF_DATA DIM_X 0x3839D4 EXTERN WORD IF_DATA MCMESS 0x3839D4 EXTERN /end MEASUREMENT
/begin MEASUREMENT rka_w "Additive adaptive Korrektur der relativen Kraftstoffmasse" SWORD rel_sw_b1536 1 100 -1536 1535.95 FUNCTION_LIST LRA GK IF_DATA DIM_X 0x382354 EXTERN WORD IF_DATA MCMESS 0x382354 EXTERN /end MEASUREMENT
/begin MEASUREMENT rkr_0_A "Referenzpegel Klopfregelung" UBYTE spg_ub_b5 1 100 0 4.98047 FUNCTION_LIST KRKE DKRS IF_DATA DIM_X 0x380BAD EXTERN WORD IF_DATA MCMESS 0x380BAD EXTERN /end MEASUREMENT
/begin MEASUREMENT rkr_1_A "Referenzpegel Klopfregelung" UBYTE spg_ub_b5 1 100 0 4.98047 FUNCTION_LIST KRKE DKRS IF_DATA DIM_X 0x380BAE EXTERN WORD IF_DATA MCMESS 0x380BAE EXTERN /end MEASUREMENT
/begin MEASUREMENT rkr_2_A "Referenzpegel Klopfregelung" UBYTE spg_ub_b5 1 100 0 4.98047 FUNCTION_LIST KRKE DKRS IF_DATA DIM_X 0x380BAF EXTERN WORD IF_DATA MCMESS 0x380BAF EXTERN /end MEASUREMENT
/begin COMPU_METHOD B_TRUE "boolsche Zustände, positive Logik" TAB_VERB "%6.3" "" COMPU_TAB_REF B_TRUE /end COMPU_METHOD
/begin COMPU_VTAB B_TRUE "boolsche Zustände, positive Logik" TAB_VERB 2 0 "----" 1 "TRUE" /end COMPU_VTAB
/begin COMPU_METHOD dez "1 : 1 Umrechnug (dez/hex)" RAT_FUNC "%6.2" "" COEFFS 0 1 0 0 0 1 /end COMPU_METHOD
/begin COMPU_METHOD fak_q0p000244 "" RAT_FUNC "%6.5" "-" COEFFS 0 65536 0 0 0 16 /end COMPU_METHOD
/begin COMPU_METHOD fak_sb_b1 "" RAT_FUNC "%6.4" "-" COEFFS 0 256 0 0 0 2 /end COMPU_METHOD
/begin COMPU_METHOD fak_sw_b1 "" RAT_FUNC "%7.6" "-" COEFFS 0 65536 0 0 0 2 /end COMPU_METHOD
/begin COMPU_METHOD fak_sw_b2 "" RAT_FUNC "%7.6" "-" COEFFS 0 65536 0 0 0 4 /end COMPU_METHOD
/begin COMPU_METHOD fak_sw_b32 "" RAT_FUNC "%6.5" "-" COEFFS 0 65536 0 0 0 64 /end COMPU_METHOD
/begin COMPU_METHOD fak_sw_b4 "" RAT_FUNC "%6.5" "-" COEFFS 0 65536 0 0 0 8 /end COMPU_METHOD
/begin COMPU_METHOD fak_sw_b64 "" RAT_FUNC "%6.4" "-" COEFFS 0 65536 0 0 0 128 /end COMPU_METHOD
/begin COMPU_METHOD fak_sw_b8 "" RAT_FUNC "%6.5" "-" COEFFS 0 65536 0 0 0 16 /end COMPU_METHOD
/begin COMPU_METHOD fak_ub_b0p25 "" RAT_FUNC "%10.7" "-" COEFFS 0 256 0 0 0 0.25 /end COMPU_METHOD
/begin COMPU_METHOD fak_ub_b1 "" RAT_FUNC "%6.4" "-" COEFFS 0 256 0 0 0 1 /end COMPU_METHOD
/begin COMPU_METHOD fak_ub_b16 "" RAT_FUNC "%6.4" "-" COEFFS 0 256 0 0 0 16 /end COMPU_METHOD
/begin COMPU_METHOD fak_ub_b2 "" RAT_FUNC "%6.4" "-" COEFFS 0 256 0 0 0 2 /end COMPU_METHOD
/begin COMPU_METHOD fak_ub_b4 "" RAT_FUNC "%6.4" "-" COEFFS 0 256 0 0 0 4 /end COMPU_METHOD
/begin COMPU_METHOD fak_ub_b8 "" RAT_FUNC "%6.4" "-" COEFFS 0 256 0 0 0 8 /end COMPU_METHOD
/begin COMPU_METHOD fak_ub_q0p01 "" RAT_FUNC "%6.4" "-" COEFFS 0 1 0 0 0 0.01 /end COMPU_METHOD
/begin COMPU_METHOD fak_uw_b1 "" RAT_FUNC "%7.6" "-" COEFFS 0 65536 0 0 0 1 /end COMPU_METHOD
/begin COMPU_METHOD fak_uw_b128 "" RAT_FUNC "%6.4" "-" COEFFS 0 65536 0 0 0 128 /end COMPU_METHOD
/begin COMPU_METHOD fak_uw_b16 "" RAT_FUNC "%6.5" "-" COEFFS 0 65536 0 0 0 16 /end COMPU_METHOD
/begin COMPU_METHOD fak_uw_b2 "" RAT_FUNC "%7.6" "-" COEFFS 0 65536 0 0 0 2 /end COMPU_METHOD
/begin COMPU_METHOD fak_uw_b32 "" RAT_FUNC "%6.5" "-" COEFFS 0 65536 0 0 0 32 /end COMPU_METHOD
/begin COMPU_METHOD fak_uw_b4 "" RAT_FUNC "%7.6" "-" COEFFS 0 65536 0 0 0 4 /end COMPU_METHOD
/begin COMPU_METHOD fak_uw_b4864 "" RAT_FUNC "%6.4" "-" COEFFS 0 65536 0 0 0 4864 /end COMPU_METHOD
/begin COMPU_METHOD fak_uw_b64 "" RAT_FUNC "%6.5" "-" COEFFS 0 65536 0 0 0 64 /end COMPU_METHOD
/begin COMPU_METHOD fak_uw_b8 "" RAT_FUNC "%6.5" "-" COEFFS 0 65536 0 0 0 8 /end COMPU_METHOD
/begin COMPU_METHOD fak_uw_q0p001 "" RAT_FUNC "%6.5" "" COEFFS 0 65536 0 0 0 65.536 /end COMPU_METHOD
/begin COMPU_METHOD freq_sw_b512 "" RAT_FUNC "%6.4" "1/s" COEFFS 0 65536 0 0 0 1024 /end COMPU_METHOD
/begin COMPU_METHOD fuel_uw_b1 "" RAT_FUNC "%7.6" "ul" COEFFS 0 65536 0 0 0 1 /end COMPU_METHOD
/begin COMPU_METHOD fuel_uw_b65535 "" RAT_FUNC "%6.2" "ul" COEFFS 0 1 0 0 0 1 /end COMPU_METHOD
/begin COMPU_METHOD i_q0p0039_mA "" RAT_FUNC "%6.4" "mA" COEFFS 0 65536 0 0 0 256 /end COMPU_METHOD
/begin COMPU_METHOD luquant "Umrechnung Laufunruhe in DMD" RAT_FUNC "%6.2" "(Umdr./sec)^2" COEFFS 0 0.549756 0 0 0 1 /end COMPU_METHOD
/begin COMPU_METHOD mgrad_sw_b28p44 "" RAT_FUNC "%6.5" "g/s" COEFFS 0 230.4 0 0 0 0.2 /end COMPU_METHOD
/begin COMPU_METHOD m_q0p0015625 "" RAT_FUNC "%6.4" "kg/h" COEFFS 0 640 0 0 0 1 /end COMPU_METHOD
/begin COMPU_METHOD m_q0p00277 "" RAT_FUNC "%6.4" "g" COEFFS 0 360 0 0 0 1 /end COMPU_METHOD
/begin COMPU_METHOD m_q0p0031 "" RAT_FUNC "%6.4" "kg/h" COEFFS 0 320 0 0 0 1 /end COMPU_METHOD
/begin COMPU_METHOD m_q0p00355 "" RAT_FUNC "%6.4" "kg" COEFFS 0 1125 0 0 0 4 /end COMPU_METHOD
/begin COMPU_METHOD m_q0p004 "" RAT_FUNC "%6.4" "kg/h" COEFFS 0 250 0 0 0 1 /end COMPU_METHOD
/begin COMPU_METHOD m_q0p1 "" RAT_FUNC "%6.3" "kg/h" COEFFS 0 10 0 0 0 1 /end COMPU_METHOD
/begin COMPU_METHOD m_q0p4 "" RAT_FUNC "%6.3" "kg/h" COEFFS 0 1 0 0 0 0.4 /end COMPU_METHOD
/begin COMPU_METHOD m_q2p71Em5_g "" RAT_FUNC "%7.6" "g" COEFFS 0 65536 0 0 0 1.77778 /end COMPU_METHOD
/begin COMPU_METHOD m_sw_b3276p8 "" RAT_FUNC "%6.3" "kg/h" COEFFS 0 1 0 0 0 0.1 /end COMPU_METHOD
/begin COMPU_METHOD m_sw_q0p1 "" RAT_FUNC "%6.3" "kg/h" COEFFS 0 1 0 0 0 0.1 /end COMPU_METHOD
/begin COMPU_METHOD m_ub_b1020 "" RAT_FUNC "%6.2" "kg/h" COEFFS 0 1 0 0 0 4 /end COMPU_METHOD
/begin COMPU_METHOD m_ub_b1638 "" RAT_FUNC "%6.2" "kg/h" COEFFS 0 255 0 0 0 1638 /end COMPU_METHOD
/begin COMPU_METHOD m_ub_b23p3 "" RAT_FUNC "%6.3" "kg" COEFFS 0 2812.5 0 0 0 256 /end COMPU_METHOD
/begin COMPU_METHOD m_ub_b25p6 "" RAT_FUNC "%6.3" "kg/h" COEFFS 0 256 0 0 0 25.6 /end COMPU_METHOD
/begin COMPU_METHOD m_ub_b5p8 "" RAT_FUNC "%6.4" "kg" COEFFS 0 5625 0 0 0 128 /end COMPU_METHOD
/begin COMPU_METHOD m_ub_q0p0444 "" RAT_FUNC "%6.4" "g" COEFFS 0 1 0 0 0 0.0444 /end COMPU_METHOD
/begin COMPU_METHOD m_ub_q0p4 "" RAT_FUNC "%6.3" "kg" COEFFS 0 1 0 0 0 0.4 /end COMPU_METHOD
/begin COMPU_METHOD m_ub_q25p6 "" RAT_FUNC "%6.1" "kg/h" COEFFS 0 1 0 0 0 25.6 /end COMPU_METHOD
/begin COMPU_METHOD m_uw_b23p3 "" RAT_FUNC "%6.5" "kg" COEFFS 0 2812.5 0 0 0 1 /end COMPU_METHOD
/begin COMPU_METHOD m_uw_b25p6 "" RAT_FUNC "%6.5" "kg/h" COEFFS 0 65536 0 0 0 25.6 /end COMPU_METHOD
/begin COMPU_METHOD m_uw_b4660 "" RAT_FUNC "%6.4" "g" COEFFS 0 3600 0 0 0 256 /end COMPU_METHOD
/begin COMPU_METHOD m_uw_b6553p5 "" RAT_FUNC "%6.3" "kg/h" COEFFS 0 1 0 0 0 0.1 /end COMPU_METHOD
/begin COMPU_METHOD m_uw_b7281 "" RAT_FUNC "%6.3" "g" COEFFS 0 9 0 0 0 1 /end COMPU_METHOD
/begin COMPU_METHOD nmotg_sb_q100 "" RAT_FUNC "%6.0" "U/min/s" COEFFS 0 1 0 0 0 100 /end COMPU_METHOD
/begin COMPU_METHOD nmotg_sw_q0p39 "" RAT_FUNC "%6.3" "U/min/s" COEFFS 0 1 0 0 0 0.39063 /end COMPU_METHOD
/begin COMPU_METHOD nmot_sw_q0p25 "" RAT_FUNC "%6.3" "U/min" COEFFS 0 1 0 0 0 0.25 /end COMPU_METHOD
/begin COMPU_METHOD nmot_ub_q10 "" RAT_FUNC "%6.1" "U/min" COEFFS 0 1 0 0 0 10 /end COMPU_METHOD
/begin COMPU_METHOD nmot_ub_q20 "" RAT_FUNC "%6.1" "U/min" COEFFS 0 1 0 0 0 20 /end COMPU_METHOD
/begin COMPU_METHOD nmot_ub_q40 "" RAT_FUNC "%6.1" "Upm" COEFFS 0 1 0 0 0 40 /end COMPU_METHOD
/begin COMPU_METHOD nmot_uw_q0p25 "" RAT_FUNC "%6.3" "U/min" COEFFS 0 1 0 0 0 0.25 /end COMPU_METHOD
/begin COMPU_METHOD p_sb_q0p25 "" RAT_FUNC "%6.3" "hPa" COEFFS 0 1 0 0 0 0.25 /end COMPU_METHOD
/begin COMPU_METHOD p_sb_q10 "" RAT_FUNC "%6.1" "hPa" COEFFS 0 1 0 0 0 10 /end COMPU_METHOD
/begin COMPU_METHOD p_ub_q10 "" RAT_FUNC "%6.1" "hPa" COEFFS 0 1 0 0 0 10 /end COMPU_METHOD
/begin COMPU_METHOD p_ub_q40 "" RAT_FUNC "%6.1" "hPa" COEFFS 0 1 0 0 0 40 /end COMPU_METHOD
/begin COMPU_METHOD p_ub_q5 "" RAT_FUNC "%6.2" "hPa" COEFFS 0 1 0 0 0 5 /end COMPU_METHOD
/begin COMPU_METHOD p_uw_q0p039 "" RAT_FUNC "%6.4" "hPa" COEFFS 0 256 0 0 0 10 /end COMPU_METHOD
/begin COMPU_METHOD qnv_uw_b512 "" RAT_FUNC "%6.4" "(U/min)/(km/h)" COEFFS 0 65536 0 0 0 512 /end COMPU_METHOD
/begin COMPU_METHOD q_uw_q0p0566 "" RAT_FUNC "%6.4" "kJ" COEFFS 0 65535 0 0 0 3712 /end COMPU_METHOD
/begin COMPU_METHOD relDK_q0p00152 "" RAT_FUNC "%6.4" "%DK" COEFFS 0 65536 0 0 0 100 /end COMPU_METHOD
/begin COMPU_METHOD relDK_ub_b100 "" RAT_FUNC "%6.3" "% DK" COEFFS 0 255 0 0 0 100 /end COMPU_METHOD
/begin COMPU_METHOD relnmot_q0p0039 "" RAT_FUNC "%6.4" "%/(U/min)" COEFFS 0 256 0 0 0 1 /end COMPU_METHOD
/begin COMPU_METHOD relnmot_q0p02 "" RAT_FUNC "%6.4" "%/(U/min)/s" COEFFS 0 1 0 0 0 0.02 /end COMPU_METHOD
/begin COMPU_METHOD rel_q0p002383 "" RAT_FUNC "%6.4" "%/(s*U/min)" COEFFS 0 256 0 0 0 0.61 /end COMPU_METHOD
/begin COMPU_METHOD rel_q0p025 "" RAT_FUNC "%6.4" "%" COEFFS 0 1 0 0 0 0.025 /end COMPU_METHOD
/begin COMPU_METHOD rel_q12 "" RAT_FUNC "%6.1" "%" COEFFS 0 1 0 0 0 12 /end COMPU_METHOD
/begin COMPU_METHOD rel_q1p5 "" RAT_FUNC "%6.2" "%" COEFFS 0 1 0 0 0 1.5 /end COMPU_METHOD
/begin COMPU_METHOD rel_sb_q0p02 "" RAT_FUNC "%6.4" "%" COEFFS 0 50 0 0 0 1 /end COMPU_METHOD
/begin COMPU_METHOD rel_sb_q0p78 "" RAT_FUNC "%6.3" "%" COEFFS 0 1 0 0 0 0.78 /end COMPU_METHOD
/begin COMPU_METHOD rel_sw_b100 "" RAT_FUNC "%6.4" "%" COEFFS 0 32768 0 0 0 100 /end COMPU_METHOD
/begin COMPU_METHOD rel_sw_b1536 "" RAT_FUNC "%6.4" "%" COEFFS 0 65536 0 0 0 3072 /end COMPU_METHOD
/begin COMPU_METHOD rel_sw_b50 "" RAT_FUNC "%6.4" "%" COEFFS 0 65536 0 0 0 100 /end COMPU_METHOD
/begin COMPU_METHOD rel_sw_q0p0234 "" RAT_FUNC "%6.4" "%/seg" COEFFS 0 32 0 0 0 0.75 /end COMPU_METHOD
/begin COMPU_METHOD rel_ub_b100 "" RAT_FUNC "%6.3" "%" COEFFS 0 256 0 0 0 100 /end COMPU_METHOD
/begin COMPU_METHOD rel_ub_b24p9 "" RAT_FUNC "%6.3" "%" COEFFS 0 255 0 0 0 24.9 /end COMPU_METHOD
/begin COMPU_METHOD rel_ub_b99p6 "" RAT_FUNC "%6.3" "%" COEFFS 0 256 0 0 0 100 /end COMPU_METHOD
/begin COMPU_METHOD rel_ub_q0p00153 "" RAT_FUNC "%6.4" "%" COEFFS 0 256 0 0 0 0.3906 /end COMPU_METHOD
/begin COMPU_METHOD rel_ub_q0p3906 "" RAT_FUNC "%6.3" "%" COEFFS 0 256 0 0 0 100 /end COMPU_METHOD
/begin COMPU_METHOD rel_ub_q0p75 "" RAT_FUNC "%6.3" "%" COEFFS 0 1 0 0 0 0.75 /end COMPU_METHOD
/begin COMPU_METHOD rel_uw_b0p3 "" RAT_FUNC "%8.7" "%/hPa" COEFFS 0 65536 0 0 0 0.3 /end COMPU_METHOD
/begin COMPU_METHOD rel_uw_b100 "" RAT_FUNC "%6.4" "%" COEFFS 0 65536 0 0 0 100 /end COMPU_METHOD
/begin COMPU_METHOD rel_uw_b200 "" RAT_FUNC "%6.4" "%" COEFFS 0 65536 0 0 0 200 /end COMPU_METHOD
/begin COMPU_METHOD rel_uw_b3072 "" RAT_FUNC "%6.4" "%" COEFFS 0 65536 0 0 0 3072 /end COMPU_METHOD
/begin COMPU_METHOD rel_uw_b3200 "" RAT_FUNC "%6.4" "%/(km/h)" COEFFS 0 65536 0 0 0 3200 /end COMPU_METHOD
/begin COMPU_METHOD rel_uw_b3276p75 "" RAT_FUNC "%6.4" "%/100hPa" COEFFS 0 1 0 0 0 0.05 /end COMPU_METHOD
/begin COMPU_METHOD rel_uw_q0p001 "" RAT_FUNC "%6.5" "%" COEFFS 0 1000 0 0 0 1 /end COMPU_METHOD
/begin COMPU_METHOD rel_uw_q0p0234 "" RAT_FUNC "%6.4" "%" COEFFS 0 32 0 0 0 0.75 /end COMPU_METHOD
/begin COMPU_METHOD runtime1_sy "" RAT_FUNC "%6.3" "us" COEFFS 0 1.5 0 0 0 1 /end COMPU_METHOD
/begin COMPU_METHOD runtime2_sy "" RAT_FUNC "%6.1" "us" COEFFS 0 0.09375 0 0 0 1 /end COMPU_METHOD
/begin COMPU_METHOD r_q8 "" RAT_FUNC "%6.2" "Ohm" COEFFS 0 1 0 0 0 8 /end COMPU_METHOD
/begin COMPU_METHOD r_ub_q64 "" RAT_FUNC "%6.1" "Ohm" COEFFS 0 1 0 0 0 64 /end COMPU_METHOD
/begin COMPU_METHOD r_uw_q2 "" RAT_FUNC "%6.2" "Ohm" COEFFS 0 1 0 0 0 2 /end COMPU_METHOD
/begin COMPU_METHOD spg_sw_q0p00488 "" RAT_FUNC "%6.4" "V" COEFFS 0 1024 0 0 0 5 /end COMPU_METHOD
/begin COMPU_METHOD spg_ub_b5 "" RAT_FUNC "%6.4" "V" COEFFS 0 256 0 0 0 5 /end COMPU_METHOD
/begin COMPU_METHOD spg_ub_q0p0052 "" RAT_FUNC "%6.4" "V" COEFFS 0 255 0 0 0 1.33 /end COMPU_METHOD
/begin COMPU_METHOD spg_ub_q0p0052_o0p2 "" RAT_FUNC "%6.3" "V" COEFFS 0 255 51 0 0 1.33 /end COMPU_METHOD
/begin COMPU_METHOD spg_ub_q0p019 "" RAT_FUNC "%6.4" "V" COEFFS 0 256 0 0 0 5 /end COMPU_METHOD
/begin COMPU_METHOD s_q1_km "" RAT_FUNC "%6.2" "km" COEFFS 0 1 0 0 0 1 /end COMPU_METHOD
/begin COMPU_METHOD s_q6_km "" RAT_FUNC "%6.2" "km" COEFFS 0 1 0 0 0 6 /end COMPU_METHOD
/begin COMPU_METHOD t10msxs_ub_b2p55 "" RAT_FUNC "%6.4" "s" COEFFS 0 1 0 0 0 0.01 /end COMPU_METHOD
/begin COMPU_METHOD t10msxs_uw_b655p35 "" RAT_FUNC "%6.4" "s" COEFFS 0 1 0 0 0 0.01 /end COMPU_METHOD
/begin COMPU_METHOD t1sxs_uw_q1 "" RAT_FUNC "%6.2" "s" COEFFS 0 1 0 0 0 1 /end COMPU_METHOD
/begin COMPU_METHOD t20msxs_ub_b5p1 "" RAT_FUNC "%6.4" "s" COEFFS 0 1 0 0 0 0.02 /end COMPU_METHOD
/begin COMPU_METHOD t20msxs_uw_q0p02 "" RAT_FUNC "%6.4" "s" COEFFS 0 1 0 0 0 0.02 /end COMPU_METHOD
/begin COMPU_METHOD t40msxs_uw_q0p04 "" RAT_FUNC "%6.4" "s" COEFFS 0 1 0 0 0 0.04 /end COMPU_METHOD
/begin COMPU_METHOD t40ms_ub_b10200 "" RAT_FUNC "%7.2" "ms" COEFFS 0 1 0 0 0 40 /end COMPU_METHOD
/begin COMPU_METHOD t40usxus_q40 "" RAT_FUNC "%6.1" "us" COEFFS 0 1 0 0 0 40 /end COMPU_METHOD
/begin COMPU_METHOD tknockintgrad_sy "" RAT_FUNC "%6.3" "V/s" COEFFS 0 8.94855 0 0 0 1 /end COMPU_METHOD
/begin COMPU_METHOD tknockintgrad_sy_u "" RAT_FUNC "%6.2" "V/s" COEFFS 0 1.11857 0 0 0 1 /end COMPU_METHOD
/begin COMPU_METHOD tsegment_sy "" RAT_FUNC "%6.5" "ms" COEFFS 0 1500 0 0 0 1 /end COMPU_METHOD
/begin COMPU_METHOD tv_sw_q0p005 "" RAT_FUNC "%6.4" "%" COEFFS 0 1 0 0 0 0.005 /end COMPU_METHOD
/begin COMPU_METHOD tv_ub_b100 "" RAT_FUNC "%6.3" "%" COEFFS 0 256 0 0 0 100 /end COMPU_METHOD
/begin COMPU_METHOD zk10msxs_uw_b655 "" RAT_FUNC "%10.4" "s" COEFFS 0 0 65536 0 100 0 /end COMPU_METHOD
/begin COMPU_METHOD zw_ub_qn0p75 "" RAT_FUNC "%6.4" "grad KW" COEFFS 0 1 0 0 0 -0.75 /end COMPU_METHOD
/begin COMPU_METHOD default "" RAT_FUNC "%6.2" "" COEFFS 0 1 0 0 0 1 /end COMPU_METHOD
/end MODULE
/end PROJECT
