/* Erstellt von DAMOS++ V1.17 */
/begin PROJECT _7804367 "156"
/begin HEADER "" VERSION "_7804367" PROJECT_NO _7804367 /end HEADER
/begin MODULE DIM ""
/begin MOD_PAR "156" VERSION "PrV = E670 mit _00" ADDR_EPK 0x810004 EPK "38/1/ME7.8/4/156//E6700/Dst_00/040401/" CUSTOMER_NO "4" USER "" PHONE_NO "" CPU_TYPE "S80166" ECU "ME7.8" MEMORY_LAYOUT PRG_CODE 0x800000 0x10000 -1 -1 -1 -1 -1 MEMORY_LAYOUT PRG_CODE 0x820000 0xE0000 -1 -1 -1 -1 -1 MEMORY_LAYOUT PRG_DATA 0x810000 0x10000 -1 -1 -1 -1 -1
 SYSTEM_CONSTANT "EPK_MAX_LEN" "80"
 SYSTEM_CONSTANT "MDNORM" "750"
 SYSTEM_CONSTANT "SK_PEASIC" "1"
 SYSTEM_CONSTANT "SK_UMASIC" "1"
 SYSTEM_CONSTANT "SWOFFDL_REQUEST_MASK" "8191"
 SYSTEM_CONSTANT "SY_2SG" "0"
 SYSTEM_CONSTANT "SY_2SLS" "0"
 SYSTEM_CONSTANT "SY_2TEV" "0"
 SYSTEM_CONSTANT "SY_AAU" "1"
 SYSTEM_CONSTANT "SY_AAV" "0"
 SYSTEM_CONSTANT "SY_ABGY" "0"
 SYSTEM_CONSTANT "SY_AGR" "0"
 SYSTEM_CONSTANT "SY_AGR_DSS" "0"
 SYSTEM_CONSTANT "SY_AIRBAG" "1"
 SYSTEM_CONSTANT "SY_ANZLUE" "3"
 SYSTEM_CONSTANT "SY_ASG" "0"
 SYSTEM_CONSTANT "SY_ASICRUNTIME" "1"
 SYSTEM_CONSTANT "SY_ASR" "0"
 SYSTEM_CONSTANT "SY_ATMLA" "0"
 SYSTEM_CONSTANT "SY_ATMST" "0"
 SYSTEM_CONSTANT "SY_ATR" "0"
 SYSTEM_CONSTANT "SY_AWUE" "0"
 SYSTEM_CONSTANT "SY_AZUE_PRE" "16"
 SYSTEM_CONSTANT "SY_BDE" "0"
 SYSTEM_CONSTANT "SY_BKVP" "0"
 SYSTEM_CONSTANT "SY_BLOOP" "0"
 SYSTEM_CONSTANT "SY_CDCSIZE" "4"
 SYSTEM_CONSTANT "SY_CDKSIZE" "1"
 SYSTEM_CONSTANT "SY_CDTSIZE" "1"
 SYSTEM_CONSTANT "SY_CKBI" "1"
 SYSTEM_CONSTANT "SY_CLASIZE" "1"
 SYSTEM_CONSTANT "SY_CONFSL" "1"
 SYSTEM_CONSTANT "SY_COPOTI" "0"
 SYSTEM_CONSTANT "SY_CRCTAB" "1"
 SYSTEM_CONSTANT "SY_CSBVAR" "0"
 SYSTEM_CONSTANT "SY_CVT" "0"
 SYSTEM_CONSTANT "SY_DELFCMS" "0"
 SYSTEM_CONSTANT "SY_DFPMENV" "3"
 SYSTEM_CONSTANT "SY_DFPMTIM" "4"
 SYSTEM_CONSTANT "SY_DFPMVAR" "3"
 SYSTEM_CONSTANT "SY_DFPM_DATA_FAR" "0"
 SYSTEM_CONSTANT "SY_DFPNL" "0"
 SYSTEM_CONSTANT "SY_DGANZ" "1"
 SYSTEM_CONSTANT "SY_DIADRL" "0"
 SYSTEM_CONSTANT "SY_DIBLKL" "0"
 SYSTEM_CONSTANT "SY_DIMONL" "0"
 SYSTEM_CONSTANT "SY_DIPRGL" "0"
 SYSTEM_CONSTANT "SY_DIVARL" "0"
 SYSTEM_CONSTANT "SY_DLCKD" "10"
 SYSTEM_CONSTANT "SY_DLCPEN" "20"
 SYSTEM_CONSTANT "SY_DLDP" "0"
 SYSTEM_CONSTANT "SY_DLS" "0"
 SYSTEM_CONSTANT "SY_DLSHV" "0"
 SYSTEM_CONSTANT "SY_DLSUV" "1"
 SYSTEM_CONSTANT "SY_DMDDVS" "1"
 SYSTEM_CONSTANT "SY_DMTL" "0"
 SYSTEM_CONSTANT "SY_DOPZW" "1"
 SYSTEM_CONSTANT "SY_DSL10MS" "1"
 SYSTEM_CONSTANT "SY_DSL2MS" "0"
 SYSTEM_CONSTANT "SY_DTANKL" "0"
 SYSTEM_CONSTANT "SY_DTES" "2"
 SYSTEM_CONSTANT "SY_DTESK" "0"
 SYSTEM_CONSTANT "SY_DTEV" "1"
 SYSTEM_CONSTANT "SY_DVEADA" "1"
 SYSTEM_CONSTANT "SY_ECECONF" "1"
 SYSTEM_CONSTANT "SY_EEPROM_ADDRESS_MODE" "0"
 SYSTEM_CONSTANT "SY_EEPROM_SIZE" "1024"
 SYSTEM_CONSTANT "SY_EGAS" "1"
 SYSTEM_CONSTANT "SY_EGFE" "13"
 SYSTEM_CONSTANT "SY_ELKUP" "0"
 SYSTEM_CONSTANT "SY_ENVBLOK" "2"
 SYSTEM_CONSTANT "SY_ERCOS_TIMER_INPUT_SEL" "5"
 SYSTEM_CONSTANT "SY_ESTZ" "0"
 SYSTEM_CONSTANT "SY_F1GETR" "0"
 SYSTEM_CONSTANT "SY_FANT" "0"
 SYSTEM_CONSTANT "SY_FARRAM_EN" "0"
 SYSTEM_CONSTANT "SY_FCMDISP" "0"
 SYSTEM_CONSTANT "SY_FCMIRD" "0"
 SYSTEM_CONSTANT "SY_FCMSIZE" "20"
 SYSTEM_CONSTANT "SY_FDTHM" "1"
 SYSTEM_CONSTANT "SY_FFESIZE" "0"
 SYSTEM_CONSTANT "SY_FFTSIZE" "3"
 SYSTEM_CONSTANT "SY_FFXSIZE" "11"
 SYSTEM_CONSTANT "SY_FFZ" "0"
 SYSTEM_CONSTANT "SY_FLASH_SIZE" "1024"
 SYSTEM_CONSTANT "SY_FLBOOT_V" "0"
 SYSTEM_CONSTANT "SY_FLUQ" "37"
 SYSTEM_CONSTANT "SY_FREQ_CPU" "24000"
 SYSTEM_CONSTANT "SY_FRROM_V" "1283"
 SYSTEM_CONSTANT "SY_GAP" "2"
 SYSTEM_CONSTANT "SY_GEKP" "0"
 SYSTEM_CONSTANT "SY_GENSS" "0"
 SYSTEM_CONSTANT "SY_GRDWOF" "0"
 SYSTEM_CONSTANT "SY_GRUNDWERT" "78"
 SYSTEM_CONSTANT "SY_HLCCARB" "3"
 SYSTEM_CONSTANT "SY_INGASOS" "8"
 SYSTEM_CONSTANT "SY_INI_OBD" "2"
 SYSTEM_CONSTANT "SY_INJTIM_PRE" "64"
 SYSTEM_CONSTANT "SY_KLDF" "0"
 SYSTEM_CONSTANT "SY_KNWS" "0"
 SYSTEM_CONSTANT "SY_KOEVAB" "0"
 SYSTEM_CONSTANT "SY_KORRZ" "1"
 SYSTEM_CONSTANT "SY_KRMFTIM_PRE" "64"
 SYSTEM_CONSTANT "SY_KR_EXT" "1"
 SYSTEM_CONSTANT "SY_KR_INT" "0"
 SYSTEM_CONSTANT "SY_KS1" "0"
 SYSTEM_CONSTANT "SY_KS2" "1"
 SYSTEM_CONSTANT "SY_KS3" "2"
 SYSTEM_CONSTANT "SY_KS4" "3"
 SYSTEM_CONSTANT "SY_KWP71" "0"
 SYSTEM_CONSTANT "SY_LAMBTS" "1"
 SYSTEM_CONSTANT "SY_LECK" "0"
 SYSTEM_CONSTANT "SY_LOWRA" "0"
 SYSTEM_CONSTANT "SY_M1I00A" "191"
 SYSTEM_CONSTANT "SY_M1I00B" "159"
 SYSTEM_CONSTANT "SY_M1I00C" "232"
 SYSTEM_CONSTANT "SY_M1I00D" "145"
 SYSTEM_CONSTANT "SY_M1I20A" "128"
 SYSTEM_CONSTANT "SY_M1I20B" "0"
 SYSTEM_CONSTANT "SY_M1I20C" "17"
 SYSTEM_CONSTANT "SY_M1I20D" "0"
 SYSTEM_CONSTANT "SY_M2I00A" "127"
 SYSTEM_CONSTANT "SY_M2I00B" "184"
 SYSTEM_CONSTANT "SY_M2I00C" "0"
 SYSTEM_CONSTANT "SY_M2I00D" "0"
 SYSTEM_CONSTANT "SY_M5IH00A" "195"
 SYSTEM_CONSTANT "SY_M5IH00B" "0"
 SYSTEM_CONSTANT "SY_M5IH00C" "0"
 SYSTEM_CONSTANT "SY_M5IH00D" "0"
 SYSTEM_CONSTANT "SY_M5IH20A" "0"
 SYSTEM_CONSTANT "SY_M5IH20B" "0"
 SYSTEM_CONSTANT "SY_M5IH20C" "0"
 SYSTEM_CONSTANT "SY_M5IH20D" "0"
 SYSTEM_CONSTANT "SY_M5IH40A" "0"
 SYSTEM_CONSTANT "SY_M5IH40B" "0"
 SYSTEM_CONSTANT "SY_M5IH40C" "0"
 SYSTEM_CONSTANT "SY_M5IH40D" "0"
 SYSTEM_CONSTANT "SY_M5IH60A" "0"
 SYSTEM_CONSTANT "SY_M5IH60B" "0"
 SYSTEM_CONSTANT "SY_M5IH60C" "0"
 SYSTEM_CONSTANT "SY_M5IH60D" "0"
 SYSTEM_CONSTANT "SY_M5IH80A" "0"
 SYSTEM_CONSTANT "SY_M5IH80B" "0"
 SYSTEM_CONSTANT "SY_M5IH80C" "0"
 SYSTEM_CONSTANT "SY_M5IH80D" "0"
 SYSTEM_CONSTANT "SY_M5IV00A" "0"
 SYSTEM_CONSTANT "SY_M5IV00B" "0"
 SYSTEM_CONSTANT "SY_M5IV00C" "0"
 SYSTEM_CONSTANT "SY_M5IV00D" "1"
 SYSTEM_CONSTANT "SY_M5IV20A" "0"
 SYSTEM_CONSTANT "SY_M5IV20B" "0"
 SYSTEM_CONSTANT "SY_M5IV20C" "0"
 SYSTEM_CONSTANT "SY_M5IV20D" "1"
 SYSTEM_CONSTANT "SY_M5IV40A" "0"
 SYSTEM_CONSTANT "SY_M5IV40B" "0"
 SYSTEM_CONSTANT "SY_M5IV40C" "0"
 SYSTEM_CONSTANT "SY_M5IV40D" "1"
 SYSTEM_CONSTANT "SY_M5IV60A" "0"
 SYSTEM_CONSTANT "SY_M5IV60B" "0"
 SYSTEM_CONSTANT "SY_M5IV60C" "0"
 SYSTEM_CONSTANT "SY_M5IV60D" "1"
 SYSTEM_CONSTANT "SY_M5IV80A" "240"
 SYSTEM_CONSTANT "SY_M5IV80B" "0"
 SYSTEM_CONSTANT "SY_M5IV80C" "0"
 SYSTEM_CONSTANT "SY_M5IV80D" "0"
 SYSTEM_CONSTANT "SY_M6I00A" "168"
 SYSTEM_CONSTANT "SY_M6I00B" "128"
 SYSTEM_CONSTANT "SY_M6I00C" "0"
 SYSTEM_CONSTANT "SY_M6I00D" "0"
 SYSTEM_CONSTANT "SY_M7VAR" "0"
 SYSTEM_CONSTANT "SY_M8I00B" "0"
 SYSTEM_CONSTANT "SY_M8I00C" "0"
 SYSTEM_CONSTANT "SY_M8I00D" "0"
 SYSTEM_CONSTANT "SY_M8I00E" "0"
 SYSTEM_CONSTANT "SY_M9I00A" "252"
 SYSTEM_CONSTANT "SY_M9I00B" "0"
 SYSTEM_CONSTANT "SY_M9I00C" "0"
 SYSTEM_CONSTANT "SY_M9I00D" "0"
 SYSTEM_CONSTANT "SY_MAX_EV" "6"
 SYSTEM_CONSTANT "SY_ME78HW" "0"
 SYSTEM_CONSTANT "SY_ME78VAR" "0"
 SYSTEM_CONSTANT "SY_NLDG" "1"
 SYSTEM_CONSTANT "SY_NLLMG" "0"
 SYSTEM_CONSTANT "SY_NWGA" "0"
 SYSTEM_CONSTANT "SY_NWGA2" "0"
 SYSTEM_CONSTANT "SY_NWGE" "0"
 SYSTEM_CONSTANT "SY_NWGE2" "0"
 SYSTEM_CONSTANT "SY_NWRA" "0"
 SYSTEM_CONSTANT "SY_NWRE" "0"
 SYSTEM_CONSTANT "SY_NWROI" "0"
 SYSTEM_CONSTANT "SY_NWS" "1"
 SYSTEM_CONSTANT "SY_NWSA" "0"
 SYSTEM_CONSTANT "SY_NWSE" "1"
 SYSTEM_CONSTANT "SY_NWSTIM_PRE" "16"
 SYSTEM_CONSTANT "SY_NWVAR" "0"
 SYSTEM_CONSTANT "SY_NZUEB" "800"
 SYSTEM_CONSTANT "SY_OVERSIZE" "2"
 SYSTEM_CONSTANT "SY_PGRAD" "4"
 SYSTEM_CONSTANT "SY_PGRAD2" "4"
 SYSTEM_CONSTANT "SY_PGRAD3" "0"
 SYSTEM_CONSTANT "SY_PGRAD4" "0"
 SYSTEM_CONSTANT "SY_PGTPO" "0"
 SYSTEM_CONSTANT "SY_PH2OFST" "3"
 SYSTEM_CONSTANT "SY_PHTWIN" "1"
 SYSTEM_CONSTANT "SY_RDE" "0"
 SYSTEM_CONSTANT "SY_REDMX" "6"
 SYSTEM_CONSTANT "SY_REVTIM_PRE" "16"
 SYSTEM_CONSTANT "SY_RLAPP" "0"
 SYSTEM_CONSTANT "SY_SGANZ" "1"
 SYSTEM_CONSTANT "SY_SLS" "1"
 SYSTEM_CONSTANT "SY_STA" "0"
 SYSTEM_CONSTANT "SY_STADAP" "0"
 SYSTEM_CONSTANT "SY_STERBTS" "0"
 SYSTEM_CONSTANT "SY_STEREO" "1"
 SYSTEM_CONSTANT "SY_STERHK" "1"
 SYSTEM_CONSTANT "SY_STERSY" "1"
 SYSTEM_CONSTANT "SY_STERVK" "1"
 SYSTEM_CONSTANT "SY_STETLR" "1"
 SYSTEM_CONSTANT "SY_SU" "0"
 SYSTEM_CONSTANT "SY_SU2" "0"
 SYSTEM_CONSTANT "SY_SWE_B" "1"
 SYSTEM_CONSTANT "SY_SWE_C" "0"
 SYSTEM_CONSTANT "SY_SWE_S" "0"
 SYSTEM_CONSTANT "SY_T6MDTHM" "0"
 SYSTEM_CONSTANT "SY_TABST" "0"
 SYSTEM_CONSTANT "SY_TEBF" "0"
 SYSTEM_CONSTANT "SY_TEETH" "60"
 SYSTEM_CONSTANT "SY_TFA" "0"
 SYSTEM_CONSTANT "SY_TFBA" "0"
 SYSTEM_CONSTANT "SY_TFMA" "1"
 SYSTEM_CONSTANT "SY_TFMAP" "0"
 SYSTEM_CONSTANT "SY_TFMHST" "0"
 SYSTEM_CONSTANT "SY_TFMO" "1"
 SYSTEM_CONSTANT "SY_TFNS" "0"
 SYSTEM_CONSTANT "SY_TFST" "0"
 SYSTEM_CONSTANT "SY_TFUMG" "0"
 SYSTEM_CONSTANT "SY_TFVA" "0"
 SYSTEM_CONSTANT "SY_TFWL" "0"
 SYSTEM_CONSTANT "SY_TGET" "1"
 SYSTEM_CONSTANT "SY_TIMER1_PRESCALER" "16"
 SYSTEM_CONSTANT "SY_TIMER3_PRESCALER" "64"
 SYSTEM_CONSTANT "SY_TIMER8_PRESCALER" "64"
 SYSTEM_CONSTANT "SY_TLR" "0"
 SYSTEM_CONSTANT "SY_TN" "1"
 SYSTEM_CONSTANT "SY_TRLX" "0"
 SYSTEM_CONSTANT "SY_TSFSIZE" "1"
 SYSTEM_CONSTANT "SY_TUM" "0"
 SYSTEM_CONSTANT "SY_TUN" "2"
 SYSTEM_CONSTANT "SY_TUNKEY" "1"
 SYSTEM_CONSTANT "SY_TUNKEY1" "1"
 SYSTEM_CONSTANT "SY_TURBO" "1"
 SYSTEM_CONSTANT "SY_TVVR" "0"
 SYSTEM_CONSTANT "SY_TWDKS" "0"
 SYSTEM_CONSTANT "SY_UB13V" "171"
 SYSTEM_CONSTANT "SY_UBDEDIS" "79"
 SYSTEM_CONSTANT "SY_UBDEEN" "92"
 SYSTEM_CONSTANT "SY_UBKL15" "0"
 SYSTEM_CONSTANT "SY_UBOKDIS" "79"
 SYSTEM_CONSTANT "SY_UBOKEN" "92"
 SYSTEM_CONSTANT "SY_UBR" "0"
 SYSTEM_CONSTANT "SY_UBRSQ_W" "0"
 SYSTEM_CONSTANT "SY_UBSQ_W" "720"
 SYSTEM_CONSTANT "SY_UMALS" "0"
 SYSTEM_CONSTANT "SY_USOFF" "205"
 SYSTEM_CONSTANT "SY_VAR" "0"
 SYSTEM_CONSTANT "SY_VS" "1"
 SYSTEM_CONSTANT "SY_WDTINPUT_SEL" "1"
 SYSTEM_CONSTANT "SY_WFS" "1"
 SYSTEM_CONSTANT "SY_WMAX" "80"
 SYSTEM_CONSTANT "SY_WMIN" "-24"
 SYSTEM_CONSTANT "SY_WNBM" "6"
 SYSTEM_CONSTANT "SY_ZAS" "0"
 SYSTEM_CONSTANT "SY_ZNDAUS" "1"
 SYSTEM_CONSTANT "SY_ZYLZA" "6"
 SYSTEM_CONSTANT "SY_ZZBANK" "42"
 SYSTEM_CONSTANT "SY_ZZLAM" "0"
 SYSTEM_CONSTANT "TSROHRES" "1000" /end MOD_PAR
/begin MOD_COMMON "" BYTE_ORDER BIG_ENDIAN S_REC_LAYOUT DAMOS /end MOD_COMMON
/* --- AgI-Objekt für DIM_X, Stand 0.1 12.7.96 --- */
/begin IF_DATA DIM_X TRGSEG_ADDRESS 0x382E00 DAT_MOD 1 TRG_MOD 39 DISPLAY_TAB 12 ETK_CFG 0xf 0xf0 0xff 0x3 0xff 0xee 0xff 0x1 MEMORY_LAYOUT PRG_EXRAM 0x380000 0x08000 -1 -1 -1 -1 -1 DISPLAY_PAR 0x817F68 10 0x381ACE 0x382E36 "Synchro" 0 DISPLAY_PAR 0x817F7E 26 0x381AD8 0x382E38 "10ms" 10 DISPLAY_PAR 0x817FB4 36 0x381AF2 0x382E3A "100ms" 100 /end IF_DATA
/begin IF_DATA KLEITUNG
 /begin APPL_PROT
  /begin MCMESS KOMKEN 13 /* Kommunikationskennung 1..255 */ MCTGT 0x11 /* Targetadresse im Steuergerät im KWP2000 */ MCINI MASSE /* Reizungstyp */ ZYLZNAME zzyl /* Name der Zylinderzählerramzelle */ ZYLZA 6 /* Zylinderanzahl */ ZYLREI "" /* Zündreihenfolge */ XRAMOF 0 /* EXRAM-Offset: 0..255 */ WFSIDLE0 12 /* Wartezeit bevor Tester mit Reizung/Vorspann beginnt (quant. 10ms) */ WFSIDLE1 8 /* Retriggerzeit von WFSIDLE0 (10ms-Quantisierung) */ WFS5B 0 /* Wartezeit nach 5-Baud-Vorspann, bevor Tester mit der Protokoll-Einleitung beginnt (quant. 100ms) */
   /begin VS_DEF /* Verstellparameterzuordnung */ "VSW:vszw" "VSFG:vsfrk" "VSWV:vsvw" "VSNS:vsns" "VSWZ1:vszwkr_0_A" "VSWZ2:vszwkr_1_A" "VSWZ3:vszwkr_2_A" "VSWZ4:vszwkr_3_A" "VSWZ5:vszwkr_4_A" "VSWZ6:vszwkr_5_A" "VSWZ7:vszwkr_6_A" "VSWZ8:vszwkr_7_A" "VSKF:vske" "VSMFA:vsdmr" "VSMFL:vsfpses" /end VS_DEF
  /end MCMESS
 /end APPL_PROT
/end IF_DATA
/begin CHARACTERISTIC A0 "Übertragungsfunktionskoeffizient" VALUE 0x81606E KwSw 0.1249981 fak_sw_b0p0625 -0.06250000 0.06249809 FUNCTION_LIST ARMD IF_DATA DIM_X DIRECT 0x81606E /end CHARACTERISTIC
/begin CHARACTERISTIC A1 "Übertragungsfunktionskoeffizient" VALUE 0x816070 KwSw 0.1249981 fak_sw_b0p0625 -0.06250000 0.06249809 FUNCTION_LIST ARMD IF_DATA DIM_X DIRECT 0x816070 /end CHARACTERISTIC
/begin CHARACTERISTIC A2 "Übertragungsfunktionskoeffizient" VALUE 0x816072 KwSw 0.1249981 fak_sw_b0p0625 -0.06250000 0.06249809 FUNCTION_LIST ARMD IF_DATA DIM_X DIRECT 0x816072 /end CHARACTERISTIC
/begin CHARACTERISTIC ABGMSIGH "Abgastemperaturschwelle für Signalunterbrechung mit Ri-Diagnose hinter KAT" VALUE 0x8183F6 KwUb 1275. temp_ub_q5_o50 -50.00 1225. FUNCTION_LIST DLSH IF_DATA DIM_X DIRECT 0x8183F6 /end CHARACTERISTIC
/begin CHARACTERISTIC ADCC_T_UM "Fehlerzeit bei zueinander unplausiblen ADC-Werten für sp1s" VALUE 0x817F0F KwUb 2.550 t10msxs_ub_b2p55 0.00 2.550 FUNCTION_LIST URADCC IF_DATA DIM_X DIRECT 0x817F0F /end CHARACTERISTIC
/begin CHARACTERISTIC ADKATNF "Normierungsfaktor für Signalamplitude der Sonde bzw. Katbelastung" VALUE 0x8183AD KwUb 23.87 spg_ub_b24 0.00 23.87 FUNCTION_LIST DKATLRS IF_DATA DIM_X DIRECT 0x8183AD /end CHARACTERISTIC
/begin CHARACTERISTIC AFNTOL "Toleranz zur Verkleinerung des Aussetzerfenster bzgl. Drehzahl" VALUE 0x810896 KwUb 10200. nmot_ub_q40 0.00 10200. FUNCTION_LIST DMDMIL READ_ONLY IF_DATA DIM_X DIRECT 0x810896 /end CHARACTERISTIC
/begin CHARACTERISTIC AGANGW "Anzahl Gangwechsel für Diagnose Kupplungsschalter" VALUE 0x818484 KwUb 255.0 dez 0.00 255.0 FUNCTION_LIST DKUPPL IF_DATA DIM_X DIRECT 0x818484 /end CHARACTERISTIC
/begin CHARACTERISTIC AHEAGW "Aussetzerhäufigkeit zum Erreichen der gesetzlichen Abgaslimits" VALUE 0x81387C KwUw 65535.00 dez 0.00 65535.00 FUNCTION_LIST DMDMIL IF_DATA DIM_X DIRECT 0x81387C /end CHARACTERISTIC
/begin CHARACTERISTIC AHEAGWS "Aussetzerhäufigkeit zum Erreichen der gesetzlichen Abgaslimits" VALUE 0x81387E KwUw 65535.00 dez 0.00 65535.00 FUNCTION_LIST DMDMIL IF_DATA DIM_X DIRECT 0x81387E /end CHARACTERISTIC
/begin CHARACTERISTIC AHEARV "Aussetzerhäufigkeit zum Erreichen der Ausblendung weiterer Funktionen" VALUE 0x813880 KwUw 65535.00 dez 0.00 65535.00 FUNCTION_LIST DMDMIL IF_DATA DIM_X DIRECT 0x813880 /end CHARACTERISTIC
/begin CHARACTERISTIC AHEKA "Aussetzerhäufigkeit zum Erreichen einer Kraftstoffabschaltung" VALUE 0x813882 KwUw 65535.00 dez 0.00 65535.00 FUNCTION_LIST DMDMIL IF_DATA DIM_X DIRECT 0x813882 /end CHARACTERISTIC
/begin CHARACTERISTIC AHEKS "Aussetzerhäufigkeit zum Erreichen einer Katalysatorschädigung" VALUE 0x813884 KwUw 65535.00 dez 0.00 65535.00 FUNCTION_LIST DMDMIL IF_DATA DIM_X DIRECT 0x813884 /end CHARACTERISTIC
/begin CHARACTERISTIC AHEKS1 "Aussetzerhäufigkeit zum Erreichen einer Katschädigung im 1. Intervall nach Start" VALUE 0x813886 KwUw 65535.00 dez 0.00 65535.00 FUNCTION_LIST DMDMIL IF_DATA DIM_X DIRECT 0x813886 /end CHARACTERISTIC
/begin CHARACTERISTIC AHKATMN "Schwellwert Katalysator gut,  AHKAT < AHKATMN" VALUE 0x8183AE KwUb 0.9961 fak_ub_b1 0.00 0.9961 FUNCTION_LIST DKATLRS IF_DATA DIM_X DIRECT 0x8183AE /end CHARACTERISTIC
/begin CHARACTERISTIC AHKATMX "Schwellwert Katalysator defekt,  AHKAT > AHKATMX" VALUE 0x8183AF KwUb 0.9961 fak_ub_b1 0.00 0.9961 FUNCTION_LIST DKATLRS IF_DATA DIM_X DIRECT 0x8183AF /end CHARACTERISTIC
/begin CHARACTERISTIC AHKATS "Schwellwert für Summe AHKAT,AHKAT2 (Stereo )" VALUE 0x8183B0 KwUb 1.992 fak_ub_b2 0.00 1.992 FUNCTION_LIST DKATLRS IF_DATA DIM_X DIRECT 0x8183B0 /end CHARACTERISTIC
/begin CHARACTERISTIC AHKATSB "Schwellwert für Summenbereichfehler (Stereo)" VALUE 0x8183B1 KwUb 0.9961 fak_ub_b1 0.00 0.9961 FUNCTION_LIST DKATLRS IF_DATA DIM_X DIRECT 0x8183B1 /end CHARACTERISTIC
/begin CHARACTERISTIC AHKTMXT "Schwellwert Katalysator defekt bei Testerbetrieb" VALUE 0x8183B2 KwUb 0.9961 fak_ub_b1 0.00 0.9961 FUNCTION_LIST DKATLRS IF_DATA DIM_X DIRECT 0x8183B2 /end CHARACTERISTIC
/begin CHARACTERISTIC AHKTTSW "Setztwert für Zeitgeber in Signalauswertung" VALUE 0x81B89E KwUw 3276.750 t50msxs_uw_b3276p75 0.00 3276.750 FUNCTION_LIST DKATLRS IF_DATA DIM_X DIRECT 0x81B89E /end CHARACTERISTIC
/begin CHARACTERISTIC AIMV "Anzahl Geschwindigkeitsimpulse pro km für Normierung v-Signal" VALUE 0x813D12 KwUl 691199999839.06750 aimv_ul_sy 160.93254093102473 691200000000.00000 FUNCTION_LIST GGVFZG IF_DATA DIM_X DIRECT 0x813D12 /end CHARACTERISTIC
/begin CHARACTERISTIC AINTKAN "Anzahl Intervalle mit Katschädigung für Ti-Abschaltung" CURVE 0x8181A5 GklWUb 255.0 dez 0.00 255.0 FUNCTION_LIST DMDMIL IF_DATA DIM_X DIRECT 0x8181A5
 /begin AXIS_DESCR COM_AXIS nmot nmot_ub_q40 8 0.00 10200. AXIS_PTS_REF SNM08DMUB /end AXIS_DESCR
/end CHARACTERISTIC
/begin CHARACTERISTIC AKUPPLB "Anzahl Kupplung betätigt für Diagnose Kupplungsschalter" VALUE 0x818485 KwUb 255.0 dez 0.00 255.0 FUNCTION_LIST DKUPPL IF_DATA DIM_X DIRECT 0x818485 /end CHARACTERISTIC
/begin CHARACTERISTIC ALFO "Anfangswert für Lernfilter bei fuel-on/fuel-off Adaption" VALUE 0x813846 KwUw 239.9963 dtsegn_b720divZyl 0.00 239.9963 FUNCTION_LIST DMDFON IF_DATA DIM_X DIRECT 0x813846 /end CHARACTERISTIC
/begin CHARACTERISTIC ANALUN "Anzahl Verbrennungen für Ausblendungen nach erkanntem Auss., drehzahlabhängig" CURVE 0x810599 GklWUb 255.0 dez 0.00 255.0 FUNCTION_LIST DMDLU IF_DATA DIM_X DIRECT 0x810599
 /begin AXIS_DESCR COM_AXIS nmot nmot_ub_q40 8 0.00 10200. AXIS_PTS_REF SNM08DMUB /end AXIS_DESCR
/end CHARACTERISTIC
/begin CHARACTERISTIC ANALUST "Anzahl Verbrennungen für Ausblendungen nach erkanntem Auss., nach Start" VALUE 0x8105A1 KwUb 255.0 dez 0.00 255.0 FUNCTION_LIST DMDLU IF_DATA DIM_X DIRECT 0x8105A1 /end CHARACTERISTIC
/begin CHARACTERISTIC ANRZUEMX "Zündungszähler-Schwelle bis zu der STADAP aktiv" VALUE 0x811419 KwUb 255.0 dez 0.00 255.0 FUNCTION_LIST STADAP IF_DATA DIM_X DIRECT 0x811419 /end CHARACTERISTIC
/begin CHARACTERISTIC ANWFOHE "Anzahl NW-Umdr. für Heilung" VALUE 0x81023B KwUb 255.0 dez 0.00 255.0 FUNCTION_LIST DMDFON IF_DATA DIM_X DIRECT 0x81023B /end CHARACTERISTIC
/begin CHARACTERISTIC ANWFOST "Anzahl NW-Umdr. für Reaktivierung fuel-on/-off Adaption nach Ausblendung" VALUE 0x81023C KwUb 255.0 dez 0.00 255.0 FUNCTION_LIST DMDFON IF_DATA DIM_X DIRECT 0x81023C /end CHARACTERISTIC
/begin CHARACTERISTIC ANZDYNSH "Anzahl der Dynamikmessungen für Schwingungsprüfung Sonde hinter KAT" VALUE 0x8183E8 KwUb 255.0 dez 0.00 255.0 FUNCTION_LIST DLSAHK IF_DATA DIM_X DIRECT 0x8183E8 /end CHARACTERISTIC
/begin CHARACTERISTIC ANZEAUS "Anzahl der auszublendenden Einspritzungen" VALUE 0x810C4E KwUb 3.000 dez 4.000 7.000 FUNCTION_LIST NLPH IF_DATA DIM_X DIRECT 0x810C4E /end CHARACTERISTIC
/begin CHARACTERISTIC ANZRIBEH "Anzahl der Ri-Berechnungen hinter KAT" VALUE 0x810C6E KwUb 255.0 dez 0.00 255.0 FUNCTION_LIST GGLSH IF_DATA DIM_X DIRECT 0x810C6E /end CHARACTERISTIC
/begin CHARACTERISTIC ANZTIBMX "Begrenzung ti-Einspritzzähler ""anztib_w""" VALUE 0x81555E KwUw 50176.00 dez 0.00 50176.00 FUNCTION_LIST ESNST IF_DATA DIM_X DIRECT 0x81555E /end CHARACTERISTIC
/begin CHARACTERISTIC ANZTPMX "Maximale Anzahl von hintereinander erlaubten Tips" VALUE 0x810F34 KwUb 255.0 dez 0.00 255.0 FUNCTION_LIST FGRMD IF_DATA DIM_X DIRECT 0x810F34 /end CHARACTERISTIC
/begin CHARACTERISTIC APDTEFRE "Anzahl Vergleiche Gradient fr für Erkennen fr-eingeschwungen in DTEV" VALUE 0x819B35 KwUb 50.00 dez 0.00 50.00 FUNCTION_LIST DTEV IF_DATA DIM_X DIRECT 0x819B35 /end CHARACTERISTIC
/begin CHARACTERISTIC APDTEVX "max. Anzahl Prüfungen bei erkanntem Fehler" VALUE 0x819B36 KwUb 10.00 dez 0.00 10.00 FUNCTION_LIST DTEV IF_DATA DIM_X DIRECT 0x819B36 /end CHARACTERISTIC
/begin CHARACTERISTIC APEKTDX "max. Anzahl Fehlerprüfungen bei Kat-Diagnose" VALUE 0x8183B3 KwUb 255.0 dez 0.00 255.0 FUNCTION_LIST DKATLRS IF_DATA DIM_X DIRECT 0x8183B3 /end CHARACTERISTIC
/begin CHARACTERISTIC ASRL_DAT_UC "" VAL_BLK 0x811C4C KwbUb 99.61 rel_ub_q0p3906 0.00 99.61 NUMBER 16 FUNCTION_LIST URCEIN IF_DATA DIM_X DIRECT 0x811C4C /end CHARACTERISTIC
/begin CHARACTERISTIC ASRS_DAT_UC "" VAL_BLK 0x811C5C KwbUb 99.61 rel_ub_q0p3906 0.00 99.61 NUMBER 16 FUNCTION_LIST URCEIN IF_DATA DIM_X DIRECT 0x811C5C /end CHARACTERISTIC
/begin CHARACTERISTIC ATISLATM "Anzti-Schwelle zur Umschaltung von lamns_w auf lamwl_w" CURVE 0x81C838 GklWUw 50176.00 dez 0.00 50176.00 FUNCTION_LIST ESWL IF_DATA DIM_X DIRECT 0x81C838
 /begin AXIS_DESCR COM_AXIS tmst temp_ub_q0p75_o48 12 -48.00 143.3 AXIS_PTS_REF STS12ESUB /end AXIS_DESCR
/end CHARACTERISTIC
/begin CHARACTERISTIC ATIWKSTM "Anzti-Schwelle zur Umschaltung von lamns_w auf lamwl_w bei Wiederholkaltstart" CURVE 0x81C850 GklWUw 50176.00 dez 0.00 50176.00 FUNCTION_LIST ESWL IF_DATA DIM_X DIRECT 0x81C850
 /begin AXIS_DESCR COM_AXIS tmst temp_ub_q0p75_o48 12 -48.00 143.3 AXIS_PTS_REF STS12ESUB /end AXIS_DESCR
/end CHARACTERISTIC
/begin CHARACTERISTIC ATMABKA "Faktor für Abgastemperaturabnahme = f(Abstellzeit)" CURVE 0x8181C6 GklWUb 0.9961 fak_ub_b1 0.00 0.9961 FUNCTION_LIST ATM IF_DATA DIM_X DIRECT 0x8181C6
 /begin AXIS_DESCR COM_AXIS tabstatm_w t1sxs_uw_q1 6 0.00 65535.00 AXIS_PTS_REF STS06TMUW /end AXIS_DESCR
/end CHARACTERISTIC
/begin CHARACTERISTIC ATMABKA2 "Faktor für Abgastemperaturabnahme = f(Abstellzeit) Bank2" CURVE 0x8181CC GklWUb 0.9961 fak_ub_b1 0.00 0.9961 FUNCTION_LIST ATM IF_DATA DIM_X DIRECT 0x8181CC
 /begin AXIS_DESCR COM_AXIS tabstatm_w t1sxs_uw_q1 6 0.00 65535.00 AXIS_PTS_REF STS06TMUW /end AXIS_DESCR
/end CHARACTERISTIC
/begin CHARACTERISTIC ATMABKK "Faktor für Abnahme der Katalysatortemperatur = f(Abstellzeit)" CURVE 0x8181D2 GklWUb 0.9961 fak_ub_b1 0.00 0.9961 FUNCTION_LIST ATM IF_DATA DIM_X DIRECT 0x8181D2
 /begin AXIS_DESCR COM_AXIS tabstatm_w t1sxs_uw_q1 6 0.00 65535.00 AXIS_PTS_REF STS06TMUW /end AXIS_DESCR
/end CHARACTERISTIC
/begin CHARACTERISTIC ATMABKK2 "Faktor für Abnahme der Katalysatortemperatur = f(Abstellzeit) Bank 2" CURVE 0x8181D8 GklWUb 0.9961 fak_ub_b1 0.00 0.9961 FUNCTION_LIST ATM IF_DATA DIM_X DIRECT 0x8181D8
 /begin AXIS_DESCR COM_AXIS tabstatm_w t1sxs_uw_q1 6 0.00 65535.00 AXIS_PTS_REF STS06TMUW /end AXIS_DESCR
/end CHARACTERISTIC
/begin CHARACTERISTIC ATMTANS "Temperaturkorrektur der Abgas-Modell-Temperatur" CURVE 0x81B708 KlAUbSstUbWSb 1275. temp_q5 -640.0 635.0 FUNCTION_LIST ATM IF_DATA DIM_X DIRECT 0x81B708
 /begin AXIS_DESCR STD_AXIS tatu temp_ub_q0p75_o48 3 -48.00 143.3 DEPOSIT ABSOLUT /end AXIS_DESCR
/end CHARACTERISTIC
/begin CHARACTERISTIC AUFW100M "" VALUE 0x81E1A6 KwUb 5100. t20usxus_q20 0.00 5100. FUNCTION_LIST RUNTIME IF_DATA DIM_X DIRECT 0x81E1A6 /end CHARACTERISTIC
/begin CHARACTERISTIC AUFW10MS "" VALUE 0x811C4A KwUb 5100. t20usxus_q20 0.00 5100. FUNCTION_LIST RUNTIME IF_DATA DIM_X DIRECT 0x811C4A /end CHARACTERISTIC
/begin CHARACTERISTIC AUFW20MS "" VALUE 0x81E1A7 KwUb 5100. t20usxus_q20 0.00 5100. FUNCTION_LIST RUNTIME IF_DATA DIM_X DIRECT 0x81E1A7 /end CHARACTERISTIC
/begin CHARACTERISTIC AUFWSYNC "" VALUE 0x811C4B KwUb 5100. t20usxus_q20 0.00 5100. FUNCTION_LIST RUNTIME IF_DATA DIM_X DIRECT 0x811C4B /end CHARACTERISTIC
/begin CHARACTERISTIC AUSGH_T_UM "Heilungszeit für Fehler in der zyklischen RAM-Prüfung der Funktionsüberwachung" VALUE 0x817F13 KwUb 10200.0 t40ms_ub_b10200 0.00 10200.0 FUNCTION_LIST URAUSG IF_DATA DIM_X DIRECT 0x817F13 /end CHARACTERISTIC
/begin CHARACTERISTIC AUSG_T_UM "Fehlertoleranzschwelle für zyklische RAM-Prüfung in der Funktionsüberwachung" VALUE 0x817F14 KwUb 255.0 dezsub1 1.000 256.0 FUNCTION_LIST URAUSG IF_DATA DIM_X DIRECT 0x817F14 /end CHARACTERISTIC
/begin CHARACTERISTIC AUSZH_T_UM "Heilungszeit für Fehler in der zyklischen ROM-Prüfung der Funktionsüberwachung" VALUE 0x817F15 KwUb 10200.0 t40ms_ub_b10200 0.00 10200.0 FUNCTION_LIST URAUSG IF_DATA DIM_X DIRECT 0x817F15 /end CHARACTERISTIC
/begin CHARACTERISTIC AUSZ_T_UM "Fehlertoleranzschwelle für zyklische ROM-Prüfung in der Funktionsüberwachung" VALUE 0x817F16 KwUb 255.0 dezsub1 1.000 256.0 FUNCTION_LIST URAUSG IF_DATA DIM_X DIRECT 0x817F16 /end CHARACTERISTIC
/begin CHARACTERISTIC AVDTEVX "max. Anzahl Prüfversuche DTEV" VALUE 0x819B37 KwUb 20.00 dez 0.00 20.00 FUNCTION_LIST DTEV IF_DATA DIM_X DIRECT 0x819B37 /end CHARACTERISTIC
/begin CHARACTERISTIC AVKATFS "Setztwert für AVKATF wenn Powerfail" VALUE 0x8183B4 KwUb 0.9961 fak_ub_b1 0.00 0.9961 FUNCTION_LIST DKATLRS IF_DATA DIM_X DIRECT 0x8183B4 /end CHARACTERISTIC
/begin CHARACTERISTIC AVRALU "Anzahl NW-Umdr./Verbrenng. f. Reaktivierung Aussetzererkennung nach Ausblendung" VALUE 0x810548 KwUb 42.33 nw_dmdstp_sy 0.1667 42.50 FUNCTION_LIST DMDSTP IF_DATA DIM_X DIRECT 0x810548 /end CHARACTERISTIC
/begin CHARACTERISTIC AZKRLDYN "Anzahl Zündungen pro Zyl. bei KR-Lastdynamik" CURVE 0x8191C8 GklWUb 254.0 dez 1.000 255.0 FUNCTION_LIST KRDY IF_DATA DIM_X DIRECT 0x8191C8
 /begin AXIS_DESCR COM_AXIS nmot nmot_ub_q40 16 0.00 10200. AXIS_PTS_REF SNM16KRUB /end AXIS_DESCR
/end CHARACTERISTIC
/begin CHARACTERISTIC AZKRNDYN "Anzahl Zündungen für KR-Drehzahldynamik" CURVE 0x8191D8 GklWUb 254.0 dez 1.000 255.0 FUNCTION_LIST KRDY IF_DATA DIM_X DIRECT 0x8191D8
 /begin AXIS_DESCR COM_AXIS nmot nmot_ub_q40 16 0.00 10200. AXIS_PTS_REF SNM16KRUB /end AXIS_DESCR
/end CHARACTERISTIC
/begin CHARACTERISTIC AZLRKTD "Zwangsamplitude für Lambdaregelung aus Kat-Diagnose" VALUE 0x8183B5 KwUb 0.249023438 fak_ub_b0p25 0.00 0.249023438 FUNCTION_LIST DKATLRS IF_DATA DIM_X DIRECT 0x8183B5 /end CHARACTERISTIC
/begin CHARACTERISTIC AZLRKTT "Zwangsamplitude für Lambdaregelung aus Kat-Diagnose bei Testeranforderung" VALUE 0x8183B6 KwUb 0.249023438 fak_ub_b0p25 0.00 0.249023438 FUNCTION_LIST DKATLRS IF_DATA DIM_X DIRECT 0x8183B6 /end CHARACTERISTIC
/begin CHARACTERISTIC AZSTLU "Verlängerung der Ausblendanforderung bei Motorstart in Anzahl Zündungen" VALUE 0x810549 KwUb 254.0 zue_dmdstp 1.000 255.0 FUNCTION_LIST DMDSTP IF_DATA DIM_X DIRECT 0x810549 /end CHARACTERISTIC
/begin CHARACTERISTIC AZSTPON "Umschaltung von Ausblendanforderung nach Motorstart in Anzahl Zündungen" VALUE 0x81054A KwUb 254.0 zue_dmdstp 1.000 255.0 FUNCTION_LIST DMDSTP IF_DATA DIM_X DIRECT 0x81054A /end CHARACTERISTIC
/begin CHARACTERISTIC AZYTIAB "Maximale Anzahl von Zylindern mit Ti-Abschaltung aufgrund von Aussetzern" VALUE 0x810897 KwUb 255.0 dez 0.00 255.0 FUNCTION_LIST DMDMIL IF_DATA DIM_X DIRECT 0x810897 /end CHARACTERISTIC
/begin CHARACTERISTIC B1 "Übertragungsfunktionskoeffizient" VALUE 0x816074 KwSw 3.999939 fak_sw_b2 -2.000000 1.999939 FUNCTION_LIST ARMD IF_DATA DIM_X DIRECT 0x816074 /end CHARACTERISTIC
/begin CHARACTERISTIC B2 "Übertragungsfunktionskoeffizient" VALUE 0x816076 KwSw 3.999939 fak_sw_b2 -2.000000 1.999939 FUNCTION_LIST ARMD IF_DATA DIM_X DIRECT 0x816076 /end CHARACTERISTIC
/begin CHARACTERISTIC BFGRO "Obere Schwelle für Beschleunigung im FGR-Betrieb" VALUE 0x810F27 KwSb 55.34 bfzg_sb_q0p217 -27.78 27.56 FUNCTION_LIST BBFGR IF_DATA DIM_X DIRECT 0x810F27 /end CHARACTERISTIC
/begin CHARACTERISTIC BFGRU "Untere Schwelle für Beschleunigung im FGR-Betrieb" VALUE 0x810F28 KwSb 55.34 bfzg_sb_q0p217 -27.78 27.56 FUNCTION_LIST BBFGR IF_DATA DIM_X DIRECT 0x810F28 /end CHARACTERISTIC
/begin CHARACTERISTIC BFGR_DAT_UC "" VAL_BLK 0x811C6C KwbUb 255.0 dez 0.00 255.0 NUMBER 16 FUNCTION_LIST URCEIN IF_DATA DIM_X DIRECT 0x811C6C /end CHARACTERISTIC
/begin CHARACTERISTIC BFLAGS_D_UC "" VAL_BLK 0x811C7C KwbUb 255.0 dez 0.00 255.0 NUMBER 16 FUNCTION_LIST URCEIN IF_DATA DIM_X DIRECT 0x811C7C /end CHARACTERISTIC
/begin CHARACTERISTIC BRABEVI "Beschleunigung bei Rampe Beschleunigen" CURVE 0x814780 KlAUwSstUwWUw 7110.547 bfzg_uw_q0p1085 0.00 7110.547 FUNCTION_LIST FGRMD IF_DATA DIM_X DIRECT 0x814780
 /begin AXIS_DESCR STD_AXIS vfzg_w vfzg_uw_b512 8 0.00 511.9922 DEPOSIT ABSOLUT /end AXIS_DESCR
/end CHARACTERISTIC
/begin CHARACTERISTIC BRATD "Beschleunigung (Betrag) bei Rampe Tip-Down" VALUE 0x810F35 KwUb 27.56 bfzg_ub_b27p67 0.00 27.56 FUNCTION_LIST FGRMD IF_DATA DIM_X DIRECT 0x810F35 /end CHARACTERISTIC
/begin CHARACTERISTIC BRATU "Beschleunigung bei Rampe Tip-Up" VALUE 0x810F36 KwUb 27.56 bfzg_ub_b27p67 0.00 27.56 FUNCTION_LIST FGRMD IF_DATA DIM_X DIRECT 0x810F36 /end CHARACTERISTIC
/begin CHARACTERISTIC BRAWA1GA "Beschleunigung Rampe Wiederaufnahme im Lande-Mode Bereich 1" CURVE 0x81B99C KlAUwSstUwWUw 7110.547 bfzg_uw_q0p1085 0.00 7110.547 FUNCTION_LIST FGRMD IF_DATA DIM_X DIRECT 0x81B99C
 /begin AXIS_DESCR STD_AXIS vfzg_w vfzg_uw_b512 8 0.00 511.9922 DEPOSIT ABSOLUT /end AXIS_DESCR
/end CHARACTERISTIC
/begin CHARACTERISTIC BRAWA2GA "Beschleunigung Rampe Wiederaufnahme im Lande-Mode Bereich 2" CURVE 0x81B9BE KlAUwSstUwWUw 7110.547 bfzg_uw_q0p1085 0.00 7110.547 FUNCTION_LIST FGRMD IF_DATA DIM_X DIRECT 0x81B9BE
 /begin AXIS_DESCR STD_AXIS vfzg_w vfzg_uw_b512 8 0.00 511.9922 DEPOSIT ABSOLUT /end AXIS_DESCR
/end CHARACTERISTIC
/begin CHARACTERISTIC BRAWA3GA "Beschleunigung Rampe Wiederaufnahme im Lande-Mode Bereich 3" CURVE 0x81B9E0 KlAUwSstUwWUw 7110.547 bfzg_uw_q0p1085 0.00 7110.547 FUNCTION_LIST FGRMD IF_DATA DIM_X DIRECT 0x81B9E0
 /begin AXIS_DESCR STD_AXIS vfzg_w vfzg_uw_b512 8 0.00 511.9922 DEPOSIT ABSOLUT /end AXIS_DESCR
/end CHARACTERISTIC
/begin CHARACTERISTIC BRAWAVI "Beschleunigung Rampe Wiederaufnahme" CURVE 0x8147A2 KlAUwSstUwWUw 7110.547 bfzg_uw_q0p1085 0.00 7110.547 FUNCTION_LIST FGRMD IF_DATA DIM_X DIRECT 0x8147A2
 /begin AXIS_DESCR STD_AXIS vfzg_w vfzg_uw_b512 8 0.00 511.9922 DEPOSIT ABSOLUT /end AXIS_DESCR
/end CHARACTERISTIC
/begin CHARACTERISTIC BREMS_T_UM "Entprellzeit für betätigte Bremse in der Funktionsüberwachung" VALUE 0x817D04 KwUb 10200.0 t40ms_ub_b10200 0.00 10200.0 FUNCTION_LIST UFFGRE IF_DATA DIM_X DIRECT 0x817D04 /end CHARACTERISTIC
/begin CHARACTERISTIC BTRKHTMS "Kennline zur Freigabe B_trkh" CURVE 0x8190F4 KlAUbSstUbWUb 255.0 dez 0.00 255.0 FUNCTION_LIST BBKHZ IF_DATA DIM_X DIRECT 0x8190F4
 /begin AXIS_DESCR STD_AXIS tmst temp_ub_q0p75_o48 8 -48.00 143.3 DEPOSIT ABSOLUT /end AXIS_DESCR
/end CHARACTERISTIC
/begin CHARACTERISTIC BZMSRA_DAT_UC "" VAL_BLK 0x811C8C KwbUb 255.0 dez 0.00 255.0 NUMBER 16 FUNCTION_LIST URCEIN IF_DATA DIM_X DIRECT 0x811C8C /end CHARACTERISTIC
/begin CHARACTERISTIC BZMSR_M "" VALUE 0x817D74 KwUb 255.0 dez 0.00 255.0 FUNCTION_LIST UFMSRC IF_DATA DIM_X DIRECT 0x817D74 /end CHARACTERISTIC
/begin CHARACTERISTIC BZ_MSR_UC "" VALUE 0x811E4C KwUb 255.0 dez 0.00 255.0 FUNCTION_LIST URCMSRC IF_DATA DIM_X DIRECT 0x811E4C /end CHARACTERISTIC
/begin CHARACTERISTIC CBGRLP "Codewort Konfiguration Funktion BGRLP" VALUE 0x8110EB KwUb 255.0 dez 0.00 255.0 FUNCTION_LIST BGRLP IF_DATA DIM_X DIRECT 0x8110EB /end CHARACTERISTIC
/begin CHARACTERISTIC CBIT_DAT_UC "" VAL_BLK 0x811C9C KwbUb 255.0 dez 0.00 255.0 NUMBER 16 FUNCTION_LIST URCEIN IF_DATA DIM_X DIRECT 0x811C9C /end CHARACTERISTIC
/begin CHARACTERISTIC CDADLCK "Codewort: Richtungsabhängige Adaptionssperre" VALUE 0x81141A KwUb 255.0 dez 0.00 255.0 FUNCTION_LIST STADAP IF_DATA DIM_X DIRECT 0x81141A /end CHARACTERISTIC
/begin CHARACTERISTIC CDAGR "Codewort DAGR abschalten (EURO-Codierung), CD..=0 -> keine Diagnose" VALUE 0x8198A8 KwUb 255.0 dez 0.00 255.0 FUNCTION_LIST PROKON IF_DATA DIM_X DIRECT 0x8198A8 /end CHARACTERISTIC
/begin CHARACTERISTIC CDATR "Konfigurationsbyte Diagnose Abgastemperaturregelung" VALUE 0x8198A9 KwUb 255.0 dez 0.00 255.0 FUNCTION_LIST PROKON IF_DATA DIM_X DIRECT 0x8198A9 /end CHARACTERISTIC
/begin CHARACTERISTIC CDATS "Konfigurationsbyte Diagnose Abgastemperatursensor" VALUE 0x8198AA KwUb 255.0 dez 0.00 255.0 FUNCTION_LIST PROKON IF_DATA DIM_X DIRECT 0x8198AA /end CHARACTERISTIC
/begin CHARACTERISTIC CDCAAA "Dummy: Tabellenanfang" VAL_BLK 0x814000 KwbUw 65535.00 dez 0.00 65535.00 NUMBER 4 FUNCTION_LIST DFPM_DFPM IF_DATA DIM_X DIRECT 0x814000 /end CHARACTERISTIC
/begin CHARACTERISTIC CDCAAVE "Codewort CARB: Absperrventil Aktivkohlefilter (Endstufe)" VAL_BLK 0x814008 KwbUw 65535.00 dez 0.00 65535.00 NUMBER 4 FUNCTION_LIST DFPM_DEKON IF_DATA DIM_X DIRECT 0x814008 /end CHARACTERISTIC
/begin CHARACTERISTIC CDCAGRE "Codewort CARB:	Überwachung AGR-Endstufe" VAL_BLK 0x814010 KwbUw 65535.00 dez 0.00 65535.00 NUMBER 4 FUNCTION_LIST DFPM_DUMMY043 IF_DATA DIM_X DIRECT 0x814010 /end CHARACTERISTIC
/begin CHARACTERISTIC CDCAGRF "Codewort CARB: Überwachung AGR-FLOW" VAL_BLK 0x814018 KwbUw 65535.00 dez 0.00 65535.00 NUMBER 4 FUNCTION_LIST DFPM_DUMMY043 IF_DATA DIM_X DIRECT 0x814018 /end CHARACTERISTIC
/begin CHARACTERISTIC CDCBM "Codewort CARB: Bezugsmarkengeber" VAL_BLK 0x814020 KwbUw 65535.00 dez 0.00 65535.00 NUMBER 4 FUNCTION_LIST DFPM_DDG IF_DATA DIM_X DIRECT 0x814020 /end CHARACTERISTIC
/begin CHARACTERISTIC CDCBREMS "Codewort CARB: Bremspedalgeber" VAL_BLK 0x814028 KwbUw 65535.00 dez 0.00 65535.00 NUMBER 4 FUNCTION_LIST DFPM_GGEGAS IF_DATA DIM_X DIRECT 0x814028 /end CHARACTERISTIC
/begin CHARACTERISTIC CDCBWF "Codewort CARB: PWG Bewegung" VAL_BLK 0x814030 KwbUw 65535.00 dez 0.00 65535.00 NUMBER 4 FUNCTION_LIST DFPM_GGPED IF_DATA DIM_X DIRECT 0x814030 /end CHARACTERISTIC
/begin CHARACTERISTIC CDCCAS "Codewort CARB: CAN-Schnittstelle, Timeout ASC" VAL_BLK 0x814038 KwbUw 65535.00 dez 0.00 65535.00 NUMBER 4 FUNCTION_LIST DFPM_DCAS IF_DATA DIM_X DIRECT 0x814038 /end CHARACTERISTIC
/begin CHARACTERISTIC CDCCGE "Codewort CARB: CAN-Schnittstelle, Timeout EGS" VAL_BLK 0x814040 KwbUw 65535.00 dez 0.00 65535.00 NUMBER 4 FUNCTION_LIST DFPM_DCGE IF_DATA DIM_X DIRECT 0x814040 /end CHARACTERISTIC
/begin CHARACTERISTIC CDCCGEGS "Codewort CARB: EGS; Steuergerät" VAL_BLK 0x814048 KwbUw 65535.00 dez 0.00 65535.00 NUMBER 4 FUNCTION_LIST DFPM_DCG IF_DATA DIM_X DIRECT 0x814048 /end CHARACTERISTIC
/begin CHARACTERISTIC CDCCGGGP "Codewort CARB: EGS; Gang unplausibel" VAL_BLK 0x814050 KwbUw 65535.00 dez 0.00 65535.00 NUMBER 4 FUNCTION_LIST DFPM_DCG IF_DATA DIM_X DIRECT 0x814050 /end CHARACTERISTIC
/begin CHARACTERISTIC CDCCGGGV "Codewort CARB: EGS; Gangvergleich negativ" VAL_BLK 0x814058 KwbUw 65535.00 dez 0.00 65535.00 NUMBER 4 FUNCTION_LIST DFPM_DCG IF_DATA DIM_X DIRECT 0x814058 /end CHARACTERISTIC
/begin CHARACTERISTIC CDCCGM1V "Codewort CARB: EGS; Magnetventil 1-2/4-5 Schaltung" VAL_BLK 0x814060 KwbUw 65535.00 dez 0.00 65535.00 NUMBER 4 FUNCTION_LIST DFPM_DCG IF_DATA DIM_X DIRECT 0x814060 /end CHARACTERISTIC
/begin CHARACTERISTIC CDCCGM2V "Codewort CARB: EGS; Magnetventil 2-3 Schaltung" VAL_BLK 0x814068 KwbUw 65535.00 dez 0.00 65535.00 NUMBER 4 FUNCTION_LIST DFPM_DCG IF_DATA DIM_X DIRECT 0x814068 /end CHARACTERISTIC
/begin CHARACTERISTIC CDCCGM3V "Codewort CARB: EGS; Magnetventil 3-4 Schaltung" VAL_BLK 0x814070 KwbUw 65535.00 dez 0.00 65535.00 NUMBER 4 FUNCTION_LIST DFPM_DCG IF_DATA DIM_X DIRECT 0x814070 /end CHARACTERISTIC
/begin CHARACTERISTIC CDCCGMVK "Codewort CARB: EGS; Magnetventil Wandlerkupplung" VAL_BLK 0x814078 KwbUw 65535.00 dez 0.00 65535.00 NUMBER 4 FUNCTION_LIST DFPM_DCG IF_DATA DIM_X DIRECT 0x814078 /end CHARACTERISTIC
/begin CHARACTERISTIC CDCCGRMM "Codewort CARB: EGS; Regelmagnetventil Modulierdruck" VAL_BLK 0x814080 KwbUw 65535.00 dez 0.00 65535.00 NUMBER 4 FUNCTION_LIST DFPM_DCG IF_DATA DIM_X DIRECT 0x814080 /end CHARACTERISTIC
/begin CHARACTERISTIC CDCCGRMS "Codewort CARB: EGS; Regelmagnetventil Schaltdruck" VAL_BLK 0x814088 KwbUw 65535.00 dez 0.00 65535.00 NUMBER 4 FUNCTION_LIST DFPM_DCG IF_DATA DIM_X DIRECT 0x814088 /end CHARACTERISTIC
/begin CHARACTERISTIC CDCCGUDG "Codewort CARB: EGS; Versorgungsspannung Drehzahlsensoren" VAL_BLK 0x814090 KwbUw 65535.00 dez 0.00 65535.00 NUMBER 4 FUNCTION_LIST DFPM_DCG IF_DATA DIM_X DIRECT 0x814090 /end CHARACTERISTIC
/begin CHARACTERISTIC CDCCGUMV "Codewort CARB: EGS; Versorgungsspannung Magnetventile" VAL_BLK 0x814098 KwbUw 65535.00 dez 0.00 65535.00 NUMBER 4 FUNCTION_LIST DFPM_DCG IF_DATA DIM_X DIRECT 0x814098 /end CHARACTERISTIC
/begin CHARACTERISTIC CDCCGVGC "Codewort CARB: EGS; Verteilergetriebestellung unplausibel" VAL_BLK 0x8140A0 KwbUw 65535.00 dez 0.00 65535.00 NUMBER 4 FUNCTION_LIST DFPM_DCG IF_DATA DIM_X DIRECT 0x8140A0 /end CHARACTERISTIC
/begin CHARACTERISTIC CDCCGVRC "Codewort CARB: EGS; Raddrehzahl hinten unplausibel" VAL_BLK 0x8140A8 KwbUw 65535.00 dez 0.00 65535.00 NUMBER 4 FUNCTION_LIST DFPM_DCG IF_DATA DIM_X DIRECT 0x8140A8 /end CHARACTERISTIC
/begin CHARACTERISTIC CDCCGWK "Codewort CARB: EGS; Wandlerkupplung" VAL_BLK 0x8140B0 KwbUw 65535.00 dez 0.00 65535.00 NUMBER 4 FUNCTION_LIST DFPM_DCG IF_DATA DIM_X DIRECT 0x8140B0 /end CHARACTERISTIC
/begin CHARACTERISTIC CDCCKBI "Codewort CARB: Timeout Kombibotschaft" VAL_BLK 0x8140B8 KwbUw 65535.00 dez 0.00 65535.00 NUMBER 4 FUNCTION_LIST DFPM_DCKBI IF_DATA DIM_X DIRECT 0x8140B8 /end CHARACTERISTIC
/begin CHARACTERISTIC CDCCMIL "Codewort CARB: MIL über CAN" VAL_BLK 0x8140C0 KwbUw 65535.00 dez 0.00 65535.00 NUMBER 4 FUNCTION_LIST DFPM_DCMIL IF_DATA DIM_X DIRECT 0x8140C0 /end CHARACTERISTIC
/begin CHARACTERISTIC CDCCRA "Codewort CARB: EKP aus bei Crash" VAL_BLK 0x8140C8 KwbUw 65535.00 dez 0.00 65535.00 NUMBER 4 FUNCTION_LIST DFPM_GGAIRBAG IF_DATA DIM_X DIRECT 0x8140C8 /end CHARACTERISTIC
/begin CHARACTERISTIC CDCDK "Codewort CARB:	DK - Potentiometer" VAL_BLK 0x8140D0 KwbUw 65535.00 dez 0.00 65535.00 NUMBER 4 FUNCTION_LIST DFPM_DDVE IF_DATA DIM_X DIRECT 0x8140D0 /end CHARACTERISTIC
/begin CHARACTERISTIC CDCDK1P "Codewort CARB: Drosselklappe 1. Poti" VAL_BLK 0x8140D8 KwbUw 65535.00 dez 0.00 65535.00 NUMBER 4 FUNCTION_LIST DFPM_DDVE IF_DATA DIM_X DIRECT 0x8140D8 /end CHARACTERISTIC
/begin CHARACTERISTIC CDCDK2P "Codewort CARB: Drosselklappe 2. Poti" VAL_BLK 0x8140E0 KwbUw 65535.00 dez 0.00 65535.00 NUMBER 4 FUNCTION_LIST DFPM_DDVE IF_DATA DIM_X DIRECT 0x8140E0 /end CHARACTERISTIC
/begin CHARACTERISTIC CDCDPL "Codewort CARB:	Dauerplus" VAL_BLK 0x8140E8 KwbUw 65535.00 dez 0.00 65535.00 NUMBER 4 FUNCTION_LIST DFPM_DUMMY043 IF_DATA DIM_X DIRECT 0x8140E8 /end CHARACTERISTIC
/begin CHARACTERISTIC CDCDSL "Codewort CARB: Drucksensor Ladedruck" VAL_BLK 0x8140F0 KwbUw 65535.00 dez 0.00 65535.00 NUMBER 4 FUNCTION_LIST DFPM_GGDSAS IF_DATA DIM_X DIRECT 0x8140F0 /end CHARACTERISTIC
/begin CHARACTERISTIC CDCDSU "Codewort CARB: Drucksensor Umgebung" VAL_BLK 0x8140F8 KwbUw 65535.00 dez 0.00 65535.00 NUMBER 4 FUNCTION_LIST DFPM_GGDSAS IF_DATA DIM_X DIRECT 0x8140F8 /end CHARACTERISTIC
/begin CHARACTERISTIC CDCDSVLU "Codewort CARB: Drucksensorsignalvergleich (DS-L DS-U)" VAL_BLK 0x814100 KwbUw 65535.00 dez 0.00 65535.00 NUMBER 4 FUNCTION_LIST DFPM_GGDSAS IF_DATA DIM_X DIRECT 0x814100 /end CHARACTERISTIC
/begin CHARACTERISTIC CDCDVEE "Codewort CARB: DV-E Endstufe" VAL_BLK 0x814108 KwbUw 65535.00 dez 0.00 65535.00 NUMBER 4 FUNCTION_LIST DFPM_DDVE IF_DATA DIM_X DIRECT 0x814108 /end CHARACTERISTIC
/begin CHARACTERISTIC CDCDVEF "Codewort CARB: DV-E Fehler bei Federprüfung" VAL_BLK 0x814110 KwbUw 65535.00 dez 0.00 65535.00 NUMBER 4 FUNCTION_LIST DFPM_DDVE IF_DATA DIM_X DIRECT 0x814110 /end CHARACTERISTIC
/begin CHARACTERISTIC CDCDVEFO "" VAL_BLK 0x814118 KwbUw 65535.00 dez 0.00 65535.00 NUMBER 4 FUNCTION_LIST DFPM_DDVE IF_DATA DIM_X DIRECT 0x814118 /end CHARACTERISTIC
/begin CHARACTERISTIC CDCDVEL "Codewort CARB: DV-E Lageabweichung" VAL_BLK 0x814120 KwbUw 65535.00 dez 0.00 65535.00 NUMBER 4 FUNCTION_LIST DFPM_DDVE IF_DATA DIM_X DIRECT 0x814120 /end CHARACTERISTIC
/begin CHARACTERISTIC CDCDVEN "Codewort CARB: DV-E Fehler bei Prüfung Notluftposition" VAL_BLK 0x814128 KwbUw 65535.00 dez 0.00 65535.00 NUMBER 4 FUNCTION_LIST DFPM_DDVE IF_DATA DIM_X DIRECT 0x814128 /end CHARACTERISTIC
/begin CHARACTERISTIC CDCDVER "Codewort CARB: DV-E Regelbereich" VAL_BLK 0x814130 KwbUw 65535.00 dez 0.00 65535.00 NUMBER 4 FUNCTION_LIST DFPM_DDVE IF_DATA DIM_X DIRECT 0x814130 /end CHARACTERISTIC
/begin CHARACTERISTIC CDCDVET "" VAL_BLK 0x814138 KwbUw 65535.00 dez 0.00 65535.00 NUMBER 4 FUNCTION_LIST DFPM_DDVE IF_DATA DIM_X DIRECT 0x814138 /end CHARACTERISTIC
/begin CHARACTERISTIC CDCDVEU "Codewort CARB: DV-E Fehler beim UMA-Lernen" VAL_BLK 0x814140 KwbUw 65535.00 dez 0.00 65535.00 NUMBER 4 FUNCTION_LIST DFPM_DDVE IF_DATA DIM_X DIRECT 0x814140 /end CHARACTERISTIC
/begin CHARACTERISTIC CDCDVEUB "" VAL_BLK 0x814148 KwbUw 65535.00 dez 0.00 65535.00 NUMBER 4 FUNCTION_LIST DFPM_DDVE IF_DATA DIM_X DIRECT 0x814148 /end CHARACTERISTIC
/begin CHARACTERISTIC CDCDVEUW "" VAL_BLK 0x814150 KwbUw 65535.00 dez 0.00 65535.00 NUMBER 4 FUNCTION_LIST DFPM_DDVE IF_DATA DIM_X DIRECT 0x814150 /end CHARACTERISTIC
/begin CHARACTERISTIC CDCDVEV "Codewort CARB: DV-E Fehler bei Verstärkerabgleich" VAL_BLK 0x814158 KwbUw 65535.00 dez 0.00 65535.00 NUMBER 4 FUNCTION_LIST DFPM_DDVE IF_DATA DIM_X DIRECT 0x814158 /end CHARACTERISTIC
/begin CHARACTERISTIC CDCEGFE "Codewort CARB: Lasterfassung" VAL_BLK 0x814160 KwbUw 65535.00 dez 0.00 65535.00 NUMBER 4 FUNCTION_LIST DFPM_EGFE IF_DATA DIM_X DIRECT 0x814160 /end CHARACTERISTIC
/begin CHARACTERISTIC CDCEV1 "Codewort CARB: EV von Zyl. 1" VAL_BLK 0x814168 KwbUw 65535.00 dez 0.00 65535.00 NUMBER 4 FUNCTION_LIST DFPM_DEKON IF_DATA DIM_X DIRECT 0x814168 /end CHARACTERISTIC
/begin CHARACTERISTIC CDCEV2 "Codewort CARB: EV von Zyl. 2" VAL_BLK 0x814170 KwbUw 65535.00 dez 0.00 65535.00 NUMBER 4 FUNCTION_LIST DFPM_DEKON IF_DATA DIM_X DIRECT 0x814170 /end CHARACTERISTIC
/begin CHARACTERISTIC CDCEV3 "Codewort CARB: EV von Zyl. 3" VAL_BLK 0x814178 KwbUw 65535.00 dez 0.00 65535.00 NUMBER 4 FUNCTION_LIST DFPM_DEKON IF_DATA DIM_X DIRECT 0x814178 /end CHARACTERISTIC
/begin CHARACTERISTIC CDCEV4 "Codewort CARB: EV von Zyl. 4" VAL_BLK 0x814180 KwbUw 65535.00 dez 0.00 65535.00 NUMBER 4 FUNCTION_LIST DFPM_DEKON IF_DATA DIM_X DIRECT 0x814180 /end CHARACTERISTIC
/begin CHARACTERISTIC CDCEV5 "Codewort CARB: EV von Zyl. 5" VAL_BLK 0x814188 KwbUw 65535.00 dez 0.00 65535.00 NUMBER 4 FUNCTION_LIST DFPM_DEKON IF_DATA DIM_X DIRECT 0x814188 /end CHARACTERISTIC
/begin CHARACTERISTIC CDCEV6 "Codewort CARB: EV von Zyl. 6" VAL_BLK 0x814190 KwbUw 65535.00 dez 0.00 65535.00 NUMBER 4 FUNCTION_LIST DFPM_DEKON IF_DATA DIM_X DIRECT 0x814190 /end CHARACTERISTIC
/begin CHARACTERISTIC CDCFGRL "Codewort CARB: FGR-Lampe über CAN" VAL_BLK 0x814198 KwbUw 65535.00 dez 0.00 65535.00 NUMBER 4 FUNCTION_LIST DFPM_DCFGRL IF_DATA DIM_X DIRECT 0x814198 /end CHARACTERISTIC
/begin CHARACTERISTIC CDCFP1P "Codewort CARB: Poti 1, Fahrpedal" VAL_BLK 0x8141A0 KwbUw 65535.00 dez 0.00 65535.00 NUMBER 4 FUNCTION_LIST DFPM_GGPED IF_DATA DIM_X DIRECT 0x8141A0 /end CHARACTERISTIC
/begin CHARACTERISTIC CDCFP2P "Codewort CARB: Poti 2, Fahrpedal" VAL_BLK 0x8141A8 KwbUw 65535.00 dez 0.00 65535.00 NUMBER 4 FUNCTION_LIST DFPM_GGPED IF_DATA DIM_X DIRECT 0x8141A8 /end CHARACTERISTIC
/begin CHARACTERISTIC CDCFPP "Codewort CARB: Fahrpedal" VAL_BLK 0x8141B0 KwbUw 65535.00 dez 0.00 65535.00 NUMBER 4 FUNCTION_LIST DFPM_GGPED IF_DATA DIM_X DIRECT 0x8141B0 /end CHARACTERISTIC
/begin CHARACTERISTIC CDCFRAO "Codewort CARB: LR-Adaption obere multiplikativ" VAL_BLK 0x8141B8 KwbUw 65535.00 dez 0.00 65535.00 NUMBER 4 FUNCTION_LIST DFPM_DKVS IF_DATA DIM_X DIRECT 0x8141B8 /end CHARACTERISTIC
/begin CHARACTERISTIC CDCFRAO2 "Codewort CARB: LR-Adaption obere multiplikativ Bank 2" VAL_BLK 0x8141C0 KwbUw 65535.00 dez 0.00 65535.00 NUMBER 4 FUNCTION_LIST DFPM_DKVS IF_DATA DIM_X DIRECT 0x8141C0 /end CHARACTERISTIC
/begin CHARACTERISTIC CDCFRAU "Codewort CARB: LR-Adaption untere multiplikativ" VAL_BLK 0x8141C8 KwbUw 65535.00 dez 0.00 65535.00 NUMBER 4 FUNCTION_LIST DFPM_DKVS IF_DATA DIM_X DIRECT 0x8141C8 /end CHARACTERISTIC
/begin CHARACTERISTIC CDCFRAU2 "Codewort CARB: LR-Adaption untere multiplikativ Bank 2" VAL_BLK 0x8141D0 KwbUw 65535.00 dez 0.00 65535.00 NUMBER 4 FUNCTION_LIST DFPM_DKVS IF_DATA DIM_X DIRECT 0x8141D0 /end CHARACTERISTIC
/begin CHARACTERISTIC CDCFRST "Codewort CARB: LR-Abweichung" VAL_BLK 0x8141D8 KwbUw 65535.00 dez 0.00 65535.00 NUMBER 4 FUNCTION_LIST DFPM_DKVS IF_DATA DIM_X DIRECT 0x8141D8 /end CHARACTERISTIC
/begin CHARACTERISTIC CDCFRST2 "Codewort CARB: LR-Abweichung Bank 2" VAL_BLK 0x8141E0 KwbUw 65535.00 dez 0.00 65535.00 NUMBER 4 FUNCTION_LIST DFPM_DKVS IF_DATA DIM_X DIRECT 0x8141E0 /end CHARACTERISTIC
/begin CHARACTERISTIC CDCHSH "Codewort CARB:	Lambdasonden-Heizung hinter Katalysator" VAL_BLK 0x8141E8 KwbUw 65535.00 dez 0.00 65535.00 NUMBER 4 FUNCTION_LIST DFPM_DHLSHK IF_DATA DIM_X DIRECT 0x8141E8 /end CHARACTERISTIC
/begin CHARACTERISTIC CDCHSH2 "Codewort CARB:	Lambdasonden-Heizung hinter Katalysator; (Bank2)" VAL_BLK 0x8141F0 KwbUw 65535.00 dez 0.00 65535.00 NUMBER 4 FUNCTION_LIST DFPM_DHLSHK IF_DATA DIM_X DIRECT 0x8141F0 /end CHARACTERISTIC
/begin CHARACTERISTIC CDCHSHE "Codewort CARB: Endstufe Heizung Sonde hinter Kat." VAL_BLK 0x8141F8 KwbUw 65535.00 dez 0.00 65535.00 NUMBER 4 FUNCTION_LIST DFPM_DEKON IF_DATA DIM_X DIRECT 0x8141F8 /end CHARACTERISTIC
/begin CHARACTERISTIC CDCHSHE2 "Codewort CARB: Endstufe Heizung Sonde Hinter Kat. Bank 2" VAL_BLK 0x814200 KwbUw 65535.00 dez 0.00 65535.00 NUMBER 4 FUNCTION_LIST DFPM_DEKON IF_DATA DIM_X DIRECT 0x814200 /end CHARACTERISTIC
/begin CHARACTERISTIC CDCHSV "Codewort CARB:	Lambdasonden-Heizung vor Katalysator" VAL_BLK 0x814208 KwbUw 65535.00 dez 0.00 65535.00 NUMBER 4 FUNCTION_LIST DFPM_DHLSU IF_DATA DIM_X DIRECT 0x814208 /end CHARACTERISTIC
/begin CHARACTERISTIC CDCHSV2 "Codewort CARB:	Lambdasonden-Heizung vor Katalysator; (Bank2)" VAL_BLK 0x814210 KwbUw 65535.00 dez 0.00 65535.00 NUMBER 4 FUNCTION_LIST DFPM_DHLSU IF_DATA DIM_X DIRECT 0x814210 /end CHARACTERISTIC
/begin CHARACTERISTIC CDCHSVSA "Codewort CARB:	Lambdasonden-Heizung vor Katalysator" VAL_BLK 0x814218 KwbUw 65535.00 dez 0.00 65535.00 NUMBER 4 FUNCTION_LIST DFPM_DHLSU IF_DATA DIM_X DIRECT 0x814218 /end CHARACTERISTIC
/begin CHARACTERISTIC CDCHSVSA2 "Codewort CARB:	Lambdasonden-Heizung 2 vor Katalysator" VAL_BLK 0x814220 KwbUw 65535.00 dez 0.00 65535.00 NUMBER 4 FUNCTION_LIST DFPM_DHLSU IF_DATA DIM_X DIRECT 0x814220 /end CHARACTERISTIC
/begin CHARACTERISTIC CDCKAT "Codewort CARB:	Katalysator-Konvertierung" VAL_BLK 0x814228 KwbUw 65535.00 dez 0.00 65535.00 NUMBER 4 FUNCTION_LIST DFPM_DKAT IF_DATA DIM_X DIRECT 0x814228 /end CHARACTERISTIC
/begin CHARACTERISTIC CDCKAT2 "Codewort CARB:	Katalysator-Konvertierung	(Bank 2)" VAL_BLK 0x814230 KwbUw 65535.00 dez 0.00 65535.00 NUMBER 4 FUNCTION_LIST DFPM_DKAT IF_DATA DIM_X DIRECT 0x814230 /end CHARACTERISTIC
/begin CHARACTERISTIC CDCKOS "Codewort CARB:	Klimakompressorsteuerung" VAL_BLK 0x814238 KwbUw 65535.00 dez 0.00 65535.00 NUMBER 4 FUNCTION_LIST DFPM_DEKON IF_DATA DIM_X DIRECT 0x814238 /end CHARACTERISTIC
/begin CHARACTERISTIC CDCKPE "Codewort CARB: EKP-Relais Endstufe" VAL_BLK 0x814240 KwbUw 65535.00 dez 0.00 65535.00 NUMBER 4 FUNCTION_LIST DFPM_DEKON IF_DATA DIM_X DIRECT 0x814240 /end CHARACTERISTIC
/begin CHARACTERISTIC CDCKRNT "Codewort CARB:	Klopfregelung Nulltest" VAL_BLK 0x814248 KwbUw 65535.00 dez 0.00 65535.00 NUMBER 4 FUNCTION_LIST DFPM_DKRNT IF_DATA DIM_X DIRECT 0x814248 /end CHARACTERISTIC
/begin CHARACTERISTIC CDCKROF "Codewort CARB: Klopfregelung Offset" VAL_BLK 0x814250 KwbUw 65535.00 dez 0.00 65535.00 NUMBER 4 FUNCTION_LIST DFPM_DKRNT IF_DATA DIM_X DIRECT 0x814250 /end CHARACTERISTIC
/begin CHARACTERISTIC CDCKRTP "Codewort CARB: Klopfregelung Testimpulse" VAL_BLK 0x814258 KwbUw 65535.00 dez 0.00 65535.00 NUMBER 4 FUNCTION_LIST DFPM_DKRTP IF_DATA DIM_X DIRECT 0x814258 /end CHARACTERISTIC
/begin CHARACTERISTIC CDCKS1 "Codewort CARB:	Klopfsensor 1" VAL_BLK 0x814260 KwbUw 65535.00 dez 0.00 65535.00 NUMBER 4 FUNCTION_LIST DFPM_DKRS IF_DATA DIM_X DIRECT 0x814260 /end CHARACTERISTIC
/begin CHARACTERISTIC CDCKS2 "Codewort CARB:	Klopfsensor 2" VAL_BLK 0x814268 KwbUw 65535.00 dez 0.00 65535.00 NUMBER 4 FUNCTION_LIST DFPM_DKRS IF_DATA DIM_X DIRECT 0x814268 /end CHARACTERISTIC
/begin CHARACTERISTIC CDCKS3 "Codewort CARB:	Klopfsensor 3" VAL_BLK 0x814270 KwbUw 65535.00 dez 0.00 65535.00 NUMBER 4 FUNCTION_LIST DFPM_DKRS IF_DATA DIM_X DIRECT 0x814270 /end CHARACTERISTIC
/begin CHARACTERISTIC CDCKS4 "Codewort CARB:	Klopfsensor 4" VAL_BLK 0x814278 KwbUw 65535.00 dez 0.00 65535.00 NUMBER 4 FUNCTION_LIST DFPM_DKRS IF_DATA DIM_X DIRECT 0x814278 /end CHARACTERISTIC
/begin CHARACTERISTIC CDCKUPPL "Codewort CARB: Kupplungspedalwertgeber" VAL_BLK 0x814280 KwbUw 65535.00 dez 0.00 65535.00 NUMBER 4 FUNCTION_LIST DFPM_DKUPPL IF_DATA DIM_X DIRECT 0x814280 /end CHARACTERISTIC
/begin CHARACTERISTIC CDCKWAVE "Codewort CARB: Kühlwasserabsperrventil Endstufe" VAL_BLK 0x814288 KwbUw 65535.00 dez 0.00 65535.00 NUMBER 4 FUNCTION_LIST DFPM_DEKON IF_DATA DIM_X DIRECT 0x814288 /end CHARACTERISTIC
/begin CHARACTERISTIC CDCLASH "Codewort CARB:	Lambda-Sondenalterung hinter Kat." VAL_BLK 0x814290 KwbUw 65535.00 dez 0.00 65535.00 NUMBER 4 FUNCTION_LIST DFPM_DLSAHK IF_DATA DIM_X DIRECT 0x814290 /end CHARACTERISTIC
/begin CHARACTERISTIC CDCLASH2 "Codewort CARB:	Lambda-Sondenalterung hinter Kat. (Bank 2)" VAL_BLK 0x814298 KwbUw 65535.00 dez 0.00 65535.00 NUMBER 4 FUNCTION_LIST DFPM_DLSAHK IF_DATA DIM_X DIRECT 0x814298 /end CHARACTERISTIC
/begin CHARACTERISTIC CDCLDE "Codewort CARB: Ladedrucksteuerventil (Endstufe)" VAL_BLK 0x8142A0 KwbUw 65535.00 dez 0.00 65535.00 NUMBER 4 FUNCTION_LIST DFPM_DEKON IF_DATA DIM_X DIRECT 0x8142A0 /end CHARACTERISTIC
/begin CHARACTERISTIC CDCLDO "Codewort CARB:	Ladedruckkennlinie; oberer Wert überschritten" VAL_BLK 0x8142A8 KwbUw 65535.00 dez 0.00 65535.00 NUMBER 4 FUNCTION_LIST DFPM_DLDR IF_DATA DIM_X DIRECT 0x8142A8 /end CHARACTERISTIC
/begin CHARACTERISTIC CDCLDRA "Codewort CARB:	Ladedruckregelabweichung" VAL_BLK 0x8142B0 KwbUw 65535.00 dez 0.00 65535.00 NUMBER 4 FUNCTION_LIST DFPM_DLDR IF_DATA DIM_X DIRECT 0x8142B0 /end CHARACTERISTIC
/begin CHARACTERISTIC CDCLF1E "Codeword CARB: Lüfter1 (Endstufe)" VAL_BLK 0x8142B8 KwbUw 65535.00 dez 0.00 65535.00 NUMBER 4 FUNCTION_LIST DFPM_DEKON IF_DATA DIM_X DIRECT 0x8142B8 /end CHARACTERISTIC
/begin CHARACTERISTIC CDCLF2E "Codeword CARB: Lüfter2 (Endstufe)" VAL_BLK 0x8142C0 KwbUw 65535.00 dez 0.00 65535.00 NUMBER 4 FUNCTION_LIST DFPM_DEKON IF_DATA DIM_X DIRECT 0x8142C0 /end CHARACTERISTIC
/begin CHARACTERISTIC CDCLF3E "Codewort CARB: Lüfter3 (Endstufe)" VAL_BLK 0x8142C8 KwbUw 65535.00 dez 0.00 65535.00 NUMBER 4 FUNCTION_LIST DFPM_DEKON IF_DATA DIM_X DIRECT 0x8142C8 /end CHARACTERISTIC
/begin CHARACTERISTIC CDCLLR "Codewort CARB: Leerlaufregelung am Anschlag" VAL_BLK 0x8142D0 KwbUw 65535.00 dez 0.00 65535.00 NUMBER 4 FUNCTION_LIST DFPM_DLLR IF_DATA DIM_X DIRECT 0x8142D0 /end CHARACTERISTIC
/begin CHARACTERISTIC CDCLM "Codewort CARB:	LMM/HLM/HFM" VAL_BLK 0x8142D8 KwbUw 65535.00 dez 0.00 65535.00 NUMBER 4 FUNCTION_LIST DFPM_DHFM IF_DATA DIM_X DIRECT 0x8142D8 /end CHARACTERISTIC
/begin CHARACTERISTIC CDCLSH "Codewort CARB:	Lambda-Sonde hinter Kat" VAL_BLK 0x8142E0 KwbUw 65535.00 dez 0.00 65535.00 NUMBER 4 FUNCTION_LIST DFPM_DLSH IF_DATA DIM_X DIRECT 0x8142E0 /end CHARACTERISTIC
/begin CHARACTERISTIC CDCLSH2 "Codewort CARB:	Lambda-Sonde 2 hinter Kat" VAL_BLK 0x8142E8 KwbUw 65535.00 dez 0.00 65535.00 NUMBER 4 FUNCTION_LIST DFPM_DLSH IF_DATA DIM_X DIRECT 0x8142E8 /end CHARACTERISTIC
/begin CHARACTERISTIC CDCLSV "Codewort CARB: Lambda-Sonde vor Kat" VAL_BLK 0x8142F0 KwbUw 65535.00 dez 0.00 65535.00 NUMBER 4 FUNCTION_LIST DFPM_DLSU IF_DATA DIM_X DIRECT 0x8142F0 /end CHARACTERISTIC
/begin CHARACTERISTIC CDCLSV2 "Codewort CARB: Lambda-Sonde 2 vor Kat" VAL_BLK 0x8142F8 KwbUw 65535.00 dez 0.00 65535.00 NUMBER 4 FUNCTION_LIST DFPM_DLSU IF_DATA DIM_X DIRECT 0x8142F8 /end CHARACTERISTIC
/begin CHARACTERISTIC CDCLSVV "Codewort CARB: Vertauschte Lambda-Sonden vor Kat" VAL_BLK 0x814300 KwbUw 65535.00 dez 0.00 65535.00 NUMBER 4 FUNCTION_LIST DFPM_LSVV IF_DATA DIM_X DIRECT 0x814300 /end CHARACTERISTIC
/begin CHARACTERISTIC CDCMD "Codewort CARB: Aussetzer, Summenfehler (multiple)" VAL_BLK 0x814308 KwbUw 65535.00 dez 0.00 65535.00 NUMBER 4 FUNCTION_LIST DFPM_DMDMIL IF_DATA DIM_X DIRECT 0x814308 /end CHARACTERISTIC
/begin CHARACTERISTIC CDCMD00 "Codewort CARB: Aussetzer Zyl. 0" VAL_BLK 0x814310 KwbUw 65535.00 dez 0.00 65535.00 NUMBER 4 FUNCTION_LIST DFPM_DMDMIL IF_DATA DIM_X DIRECT 0x814310 /end CHARACTERISTIC
/begin CHARACTERISTIC CDCMD01 "Codewort CARB: Aussetzer Zyl. 1" VAL_BLK 0x814318 KwbUw 65535.00 dez 0.00 65535.00 NUMBER 4 FUNCTION_LIST DFPM_DMDMIL IF_DATA DIM_X DIRECT 0x814318 /end CHARACTERISTIC
/begin CHARACTERISTIC CDCMD02 "Codewort CARB: Aussetzer Zylinder 2" VAL_BLK 0x814320 KwbUw 65535.00 dez 0.00 65535.00 NUMBER 4 FUNCTION_LIST DFPM_DMDMIL IF_DATA DIM_X DIRECT 0x814320 /end CHARACTERISTIC
/begin CHARACTERISTIC CDCMD03 "Codewort CARB: Aussetzer Zylinder 3" VAL_BLK 0x814328 KwbUw 65535.00 dez 0.00 65535.00 NUMBER 4 FUNCTION_LIST DFPM_DMDMIL IF_DATA DIM_X DIRECT 0x814328 /end CHARACTERISTIC
/begin CHARACTERISTIC CDCMD04 "Codewort CARB: Aussetzer Zylinder 4" VAL_BLK 0x814330 KwbUw 65535.00 dez 0.00 65535.00 NUMBER 4 FUNCTION_LIST DFPM_DMDMIL IF_DATA DIM_X DIRECT 0x814330 /end CHARACTERISTIC
/begin CHARACTERISTIC CDCMD05 "Codewort CARB: Aussetzer Zylinder 5" VAL_BLK 0x814338 KwbUw 65535.00 dez 0.00 65535.00 NUMBER 4 FUNCTION_LIST DFPM_DMDMIL IF_DATA DIM_X DIRECT 0x814338 /end CHARACTERISTIC
/begin CHARACTERISTIC CDCMDB "Codewort CARB: Momentbegrenzung Sollmoment" VAL_BLK 0x814340 KwbUw 65535.00 dez 0.00 65535.00 NUMBER 4 FUNCTION_LIST DFPM_MDKOG IF_DATA DIM_X DIRECT 0x814340 /end CHARACTERISTIC
/begin CHARACTERISTIC CDCMSG "Codeword CARB: Motorraumspülgebläse" VAL_BLK 0x814348 KwbUw 65535.00 dez 0.00 65535.00 NUMBER 4 FUNCTION_LIST DFPM_MLS IF_DATA DIM_X DIRECT 0x814348 /end CHARACTERISTIC
/begin CHARACTERISTIC CDCMSGE "Codeword CARB: Motorraumspülgebläse (Endstufe)" VAL_BLK 0x814350 KwbUw 65535.00 dez 0.00 65535.00 NUMBER 4 FUNCTION_LIST DFPM_DEKON IF_DATA DIM_X DIRECT 0x814350 /end CHARACTERISTIC
/begin CHARACTERISTIC CDCN "Codewort CARB: Drehzahlsignalgeber" VAL_BLK 0x814358 KwbUw 65535.00 dez 0.00 65535.00 NUMBER 4 FUNCTION_LIST DFPM_DDG IF_DATA DIM_X DIRECT 0x814358 /end CHARACTERISTIC
/begin CHARACTERISTIC CDCNWKW "Codewort CARB: Zuordnung Nockenwelle zu Kurbelwelle" VAL_BLK 0x814360 KwbUw 65535.00 dez 0.00 65535.00 NUMBER 4 FUNCTION_LIST DFPM_DNWKW IF_DATA DIM_X DIRECT 0x814360 /end CHARACTERISTIC
/begin CHARACTERISTIC CDCNWKW2 "Codewort CARB: Zuordnung Nockenwelle 2 zu Kurbelwelle" VAL_BLK 0x814368 KwbUw 65535.00 dez 0.00 65535.00 NUMBER 4 FUNCTION_LIST DFPM_DNWKW IF_DATA DIM_X DIRECT 0x814368 /end CHARACTERISTIC
/begin CHARACTERISTIC CDCNWS "Codewort CARB: Nockenwellensteuerung" VAL_BLK 0x814370 KwbUw 65535.00 dez 0.00 65535.00 NUMBER 4 FUNCTION_LIST DFPM_DNWS IF_DATA DIM_X DIRECT 0x814370 /end CHARACTERISTIC
/begin CHARACTERISTIC CDCNWS2 "Codewort CARB: Nockenwellensteuerung Bank2" VAL_BLK 0x814378 KwbUw 65535.00 dez 0.00 65535.00 NUMBER 4 FUNCTION_LIST DFPM_DNWS IF_DATA DIM_X DIRECT 0x814378 /end CHARACTERISTIC
/begin CHARACTERISTIC CDCNWSE "Codewort CARB: Nockenwellensteuerungsventil Endstufe" VAL_BLK 0x814380 KwbUw 65535.00 dez 0.00 65535.00 NUMBER 4 FUNCTION_LIST DFPM_DEKON IF_DATA DIM_X DIRECT 0x814380 /end CHARACTERISTIC
/begin CHARACTERISTIC CDCNWSE2 "Codewort CARB: Nockenwellensteuerungsventil Endstufe 2" VAL_BLK 0x814388 KwbUw 65535.00 dez 0.00 65535.00 NUMBER 4 FUNCTION_LIST DFPM_DEKON IF_DATA DIM_X DIRECT 0x814388 /end CHARACTERISTIC
/begin CHARACTERISTIC CDCPH "Codewort CARB: Phasensensor" VAL_BLK 0x814390 KwbUw 65535.00 dez 0.00 65535.00 NUMBER 4 FUNCTION_LIST DFPM_DPH IF_DATA DIM_X DIRECT 0x814390 /end CHARACTERISTIC
/begin CHARACTERISTIC CDCPH2 "Codewort CARB: Phasensensor Bank 2" VAL_BLK 0x814398 KwbUw 65535.00 dez 0.00 65535.00 NUMBER 4 FUNCTION_LIST DFPM_DPH IF_DATA DIM_X DIRECT 0x814398 /end CHARACTERISTIC
/begin CHARACTERISTIC CDCRKAT "Codewort CARB: LR-Adaption QL-additiv" VAL_BLK 0x8143A0 KwbUw 65535.00 dez 0.00 65535.00 NUMBER 4 FUNCTION_LIST DFPM_DKVS IF_DATA DIM_X DIRECT 0x8143A0 /end CHARACTERISTIC
/begin CHARACTERISTIC CDCRKAT2 "Codewort CARB: LR-Adaption QL-additiv Bank 2" VAL_BLK 0x8143A8 KwbUw 65535.00 dez 0.00 65535.00 NUMBER 4 FUNCTION_LIST DFPM_DKVS IF_DATA DIM_X DIRECT 0x8143A8 /end CHARACTERISTIC
/begin CHARACTERISTIC CDCRKAZ "Codewort CARB: LR-Adaption ti-additiv" VAL_BLK 0x8143B0 KwbUw 65535.00 dez 0.00 65535.00 NUMBER 4 FUNCTION_LIST DFPM_DKVS IF_DATA DIM_X DIRECT 0x8143B0 /end CHARACTERISTIC
/begin CHARACTERISTIC CDCRKAZ2 "Codewort CARB: LR-Adaption ti-additiv Bank 2" VAL_BLK 0x8143B8 KwbUw 65535.00 dez 0.00 65535.00 NUMBER 4 FUNCTION_LIST DFPM_DKVS IF_DATA DIM_X DIRECT 0x8143B8 /end CHARACTERISTIC
/begin CHARACTERISTIC CDCSGEEP "Codewort CARB:	Steuergerät defekt (EEPROM)" VAL_BLK 0x8143C0 KwbUw 65535.00 dez 0.00 65535.00 NUMBER 4 FUNCTION_LIST DFPM_DSGEEP IF_DATA DIM_X DIRECT 0x8143C0 /end CHARACTERISTIC
/begin CHARACTERISTIC CDCSLPE "Codewort CARB: Sekundärluftpumpe (Endstufe)" VAL_BLK 0x8143C8 KwbUw 65535.00 dez 0.00 65535.00 NUMBER 4 FUNCTION_LIST DFPM_DEKON IF_DATA DIM_X DIRECT 0x8143C8 /end CHARACTERISTIC
/begin CHARACTERISTIC CDCSLS "Codewort CARB: Sekundärluft-System" VAL_BLK 0x8143D0 KwbUw 65535.00 dez 0.00 65535.00 NUMBER 4 FUNCTION_LIST DFPM_DSLSLRS IF_DATA DIM_X DIRECT 0x8143D0 /end CHARACTERISTIC
/begin CHARACTERISTIC CDCSLS2 "Codewort CARB: Sekundärluft-System Bank 2" VAL_BLK 0x8143D8 KwbUw 65535.00 dez 0.00 65535.00 NUMBER 4 FUNCTION_LIST DFPM_DSLSLRS IF_DATA DIM_X DIRECT 0x8143D8 /end CHARACTERISTIC
/begin CHARACTERISTIC CDCSLV "Codewort CARB: Sekundärluftventil" VAL_BLK 0x8143E0 KwbUw 65535.00 dez 0.00 65535.00 NUMBER 4 FUNCTION_LIST DFPM_DSLSLRS IF_DATA DIM_X DIRECT 0x8143E0 /end CHARACTERISTIC
/begin CHARACTERISTIC CDCSLV2 "Codewort CARB: Sekundärluftventil, Bank 2" VAL_BLK 0x8143E8 KwbUw 65535.00 dez 0.00 65535.00 NUMBER 4 FUNCTION_LIST DFPM_DSLSLRS IF_DATA DIM_X DIRECT 0x8143E8 /end CHARACTERISTIC
/begin CHARACTERISTIC CDCSLVE "Codewort CARB: Sekundärluftventil (Endstufe)" VAL_BLK 0x8143F0 KwbUw 65535.00 dez 0.00 65535.00 NUMBER 4 FUNCTION_LIST DFPM_DEKON IF_DATA DIM_X DIRECT 0x8143F0 /end CHARACTERISTIC
/begin CHARACTERISTIC CDCSWE "Codewort CARB:	Beschleunigungssensor der Schlechtwegeerkennung" VAL_BLK 0x8143F8 KwbUw 65535.00 dez 0.00 65535.00 NUMBER 4 FUNCTION_LIST DFPM_BGRBS IF_DATA DIM_X DIRECT 0x8143F8 /end CHARACTERISTIC
/begin CHARACTERISTIC CDCTA "Codewort CARB: TANS" VAL_BLK 0x814400 KwbUw 65535.00 dez 0.00 65535.00 NUMBER 4 FUNCTION_LIST DFPM_GGTFA IF_DATA DIM_X DIRECT 0x814400 /end CHARACTERISTIC
/begin CHARACTERISTIC CDCTES "Codewort CARB: Tankentlüftungssystem" VAL_BLK 0x814408 KwbUw 65535.00 dez 0.00 65535.00 NUMBER 4 FUNCTION_LIST DFPM_DTEV IF_DATA DIM_X DIRECT 0x814408 /end CHARACTERISTIC
/begin CHARACTERISTIC CDCTEVE "Codewort CARB:	Tankentlüftungsventil Endstufe" VAL_BLK 0x814410 KwbUw 65535.00 dez 0.00 65535.00 NUMBER 4 FUNCTION_LIST DFPM_DEKON IF_DATA DIM_X DIRECT 0x814410 /end CHARACTERISTIC
/begin CHARACTERISTIC CDCTEVE2 "Codewort CARB:	Tankentlüftungsventil Endstufe  Bank2" VAL_BLK 0x814418 KwbUw 65535.00 dez 0.00 65535.00 NUMBER 4 FUNCTION_LIST DFPM_DUMMY043 IF_DATA DIM_X DIRECT 0x814418 /end CHARACTERISTIC
/begin CHARACTERISTIC CDCTGET "Codewort CARB: Getriebetemperatur" VAL_BLK 0x814420 KwbUw 65535.00 dez 0.00 65535.00 NUMBER 4 FUNCTION_LIST DFPM_GGTGET IF_DATA DIM_X DIRECT 0x814420 /end CHARACTERISTIC
/begin CHARACTERISTIC CDCTHM "Codewort CARB: Thermostat-Diagnose THM" VAL_BLK 0x814428 KwbUw 65535.00 dez 0.00 65535.00 NUMBER 4 FUNCTION_LIST DFPM_GGTFM IF_DATA DIM_X DIRECT 0x814428 /end CHARACTERISTIC
/begin CHARACTERISTIC CDCTM "Codewort CARB: Motortemperatur TMOT" VAL_BLK 0x814430 KwbUw 65535.00 dez 0.00 65535.00 NUMBER 4 FUNCTION_LIST DFPM_GGTFM IF_DATA DIM_X DIRECT 0x814430 /end CHARACTERISTIC
/begin CHARACTERISTIC CDCTMKI "Codewort CARB: Motortemperatur aus Kombiinstrument TMKI" VAL_BLK 0x814438 KwbUw 65535.00 dez 0.00 65535.00 NUMBER 4 FUNCTION_LIST DFPM_DUMMY043 IF_DATA DIM_X DIRECT 0x814438 /end CHARACTERISTIC
/begin CHARACTERISTIC CDCTMR "Codewort CARB: Motorraumtemperatur TMR" VAL_BLK 0x814440 KwbUw 65535.00 dez 0.00 65535.00 NUMBER 4 FUNCTION_LIST DFPM_GGTFMR IF_DATA DIM_X DIRECT 0x814440 /end CHARACTERISTIC
/begin CHARACTERISTIC CDCTOL "Codewort CARB: Öltemperatur" VAL_BLK 0x814448 KwbUw 65535.00 dez 0.00 65535.00 NUMBER 4 FUNCTION_LIST DFPM_GGTFOL IF_DATA DIM_X DIRECT 0x814448 /end CHARACTERISTIC
/begin CHARACTERISTIC CDCTUM "Codewort CARB: Umgebungs(-luft)-Temperatur TUM" VAL_BLK 0x814450 KwbUw 65535.00 dez 0.00 65535.00 NUMBER 4 FUNCTION_LIST DFPM_GGTFUMG IF_DATA DIM_X DIRECT 0x814450 /end CHARACTERISTIC
/begin CHARACTERISTIC CDCUB "Codewort CARB: Batteriespannung UB (Bordnetz)" VAL_BLK 0x814458 KwbUw 65535.00 dez 0.00 65535.00 NUMBER 4 FUNCTION_LIST DFPM_GGUB IF_DATA DIM_X DIRECT 0x814458 /end CHARACTERISTIC
/begin CHARACTERISTIC CDCUFMV "Codewort CARB: Funktionsüberwachung: Momentenvergleich" VAL_BLK 0x814460 KwbUw 65535.00 dez 0.00 65535.00 NUMBER 4 FUNCTION_LIST DFPM_DUF IF_DATA DIM_X DIRECT 0x814460 /end CHARACTERISTIC
/begin CHARACTERISTIC CDCUFSKA "Codewort CARB: Funktionsüberwachung: Sicherheits-Kraftstoff-Abschaltung" VAL_BLK 0x814468 KwbUw 65535.00 dez 0.00 65535.00 NUMBER 4 FUNCTION_LIST DFPM_DUF IF_DATA DIM_X DIRECT 0x814468 /end CHARACTERISTIC
/begin CHARACTERISTIC CDCURRAM "Codewort CARB: Rechnerüberwachung: RAM" VAL_BLK 0x814470 KwbUw 65535.00 dez 0.00 65535.00 NUMBER 4 FUNCTION_LIST DFPM_DUR IF_DATA DIM_X DIRECT 0x814470 /end CHARACTERISTIC
/begin CHARACTERISTIC CDCURROM "Codewort CARB: Rechnerüberwachung: ROM" VAL_BLK 0x814478 KwbUw 65535.00 dez 0.00 65535.00 NUMBER 4 FUNCTION_LIST DFPM_DUR IF_DATA DIM_X DIRECT 0x814478 /end CHARACTERISTIC
/begin CHARACTERISTIC CDCURRST "Codewort CARB: Rechnerüberwachung: Reset" VAL_BLK 0x814480 KwbUw 65535.00 dez 0.00 65535.00 NUMBER 4 FUNCTION_LIST DFPM_DUR IF_DATA DIM_X DIRECT 0x814480 /end CHARACTERISTIC
/begin CHARACTERISTIC CDCUVSE "Codewort CARB: Umluftventil-Steuerung Endstufe" VAL_BLK 0x814488 KwbUw 65535.00 dez 0.00 65535.00 NUMBER 4 FUNCTION_LIST DFPM_DEKON IF_DATA DIM_X DIRECT 0x814488 /end CHARACTERISTIC
/begin CHARACTERISTIC CDCVFZ "Codewort CARB: Fahrzeug-Geschwindigkeit" VAL_BLK 0x814490 KwbUw 65535.00 dez 0.00 65535.00 NUMBER 4 FUNCTION_LIST DFPM_DVFZ IF_DATA DIM_X DIRECT 0x814490 /end CHARACTERISTIC
/begin CHARACTERISTIC CDCVS01 "" VAL_BLK 0x814498 KwbUw 65535.00 dez 0.00 65535.00 NUMBER 4 FUNCTION_LIST DFPM_DVS IF_DATA DIM_X DIRECT 0x814498 /end CHARACTERISTIC
/begin CHARACTERISTIC CDCVS02 "" VAL_BLK 0x8144A0 KwbUw 65535.00 dez 0.00 65535.00 NUMBER 4 FUNCTION_LIST DFPM_DVS IF_DATA DIM_X DIRECT 0x8144A0 /end CHARACTERISTIC
/begin CHARACTERISTIC CDCVS03 "" VAL_BLK 0x8144A8 KwbUw 65535.00 dez 0.00 65535.00 NUMBER 4 FUNCTION_LIST DFPM_DVS IF_DATA DIM_X DIRECT 0x8144A8 /end CHARACTERISTIC
/begin CHARACTERISTIC CDCVS04 "" VAL_BLK 0x8144B0 KwbUw 65535.00 dez 0.00 65535.00 NUMBER 4 FUNCTION_LIST DFPM_DVS IF_DATA DIM_X DIRECT 0x8144B0 /end CHARACTERISTIC
/begin CHARACTERISTIC CDCVS05 "" VAL_BLK 0x8144B8 KwbUw 65535.00 dez 0.00 65535.00 NUMBER 4 FUNCTION_LIST DFPM_DVS IF_DATA DIM_X DIRECT 0x8144B8 /end CHARACTERISTIC
/begin CHARACTERISTIC CDCVS06 "" VAL_BLK 0x8144C0 KwbUw 65535.00 dez 0.00 65535.00 NUMBER 4 FUNCTION_LIST DFPM_DVS IF_DATA DIM_X DIRECT 0x8144C0 /end CHARACTERISTIC
/begin CHARACTERISTIC CDCVS1E "Codeword CARB: Ventilhub1 (Endstufe)" VAL_BLK 0x8144C8 KwbUw 65535.00 dez 0.00 65535.00 NUMBER 4 FUNCTION_LIST DFPM_DEKON IF_DATA DIM_X DIRECT 0x8144C8 /end CHARACTERISTIC
/begin CHARACTERISTIC CDCVS2E "Codeword CARB: Ventilhub2 (Endstufe)" VAL_BLK 0x8144D0 KwbUw 65535.00 dez 0.00 65535.00 NUMBER 4 FUNCTION_LIST DFPM_DEKON IF_DATA DIM_X DIRECT 0x8144D0 /end CHARACTERISTIC
/begin CHARACTERISTIC CDCVSB1 "" VAL_BLK 0x8144D8 KwbUw 65535.00 dez 0.00 65535.00 NUMBER 4 FUNCTION_LIST DFPM_DVS IF_DATA DIM_X DIRECT 0x8144D8 /end CHARACTERISTIC
/begin CHARACTERISTIC CDCVSB2 "" VAL_BLK 0x8144E0 KwbUw 65535.00 dez 0.00 65535.00 NUMBER 4 FUNCTION_LIST DFPM_DVS IF_DATA DIM_X DIRECT 0x8144E0 /end CHARACTERISTIC
/begin CHARACTERISTIC CDCVSS "" VAL_BLK 0x8144E8 KwbUw 65535.00 dez 0.00 65535.00 NUMBER 4 FUNCTION_LIST DFPM_DVS IF_DATA DIM_X DIRECT 0x8144E8 /end CHARACTERISTIC
/begin CHARACTERISTIC CDCWFS "Codewort CARB: Wegfahrsperre" VAL_BLK 0x8144F0 KwbUw 65535.00 dez 0.00 65535.00 NUMBER 4 FUNCTION_LIST DFPM_WFS IF_DATA DIM_X DIRECT 0x8144F0 /end CHARACTERISTIC
/begin CHARACTERISTIC CDCZZZ "Dummy: Tabellenende" VAL_BLK 0x8144F8 KwbUw 65535.00 dez 0.00 65535.00 NUMBER 4 FUNCTION_LIST DFPM_DFPM IF_DATA DIM_X DIRECT 0x8144F8 /end CHARACTERISTIC
/begin CHARACTERISTIC CDDMDVS "Codewort für Auswahl dluts ohne VS mit  plus oder minus zu wichten." VALUE 0x81080B KwSb 255.0 dez -128.0 127.0 FUNCTION_LIST DMDDVS IF_DATA DIM_X DIRECT 0x81080B /end CHARACTERISTIC
/begin CHARACTERISTIC CDDST "Codewort Tankdrucksensor-Diagnose abschalten (EURO-Codierung)" VALUE 0x8198AB KwUb 255.0 dez 0.00 255.0 FUNCTION_LIST PROKON IF_DATA DIM_X DIRECT 0x8198AB /end CHARACTERISTIC
/begin CHARACTERISTIC CDFO "Codewort zum Ausschalten und Rücksetzen der Adaption" VALUE 0x81023D KwUb 255.0 dez 0.00 255.0 FUNCTION_LIST DMDFON IF_DATA DIM_X DIRECT 0x81023D /end CHARACTERISTIC
/begin CHARACTERISTIC CDHSH "Codewort Heizerdiagnose hinter Kat (CDHSH = 0  => keine Diagnose)" VALUE 0x8198AC KwUb 255.0 dez 0.00 255.0 FUNCTION_LIST PROKON IF_DATA DIM_X DIRECT 0x8198AC /end CHARACTERISTIC
/begin CHARACTERISTIC CDHSHE "Eurobit für Diagnose Entstufe Lambdasondenheizung hinter Kat" VALUE 0x8198AD KwUb 255.0 dez 0.00 255.0 FUNCTION_LIST PROKON IF_DATA DIM_X DIRECT 0x8198AD /end CHARACTERISTIC
/begin CHARACTERISTIC CDHSV "Codewort Heizerdiagnose vor Kat im (CDHSV = 0  => keine Diagnose)" VALUE 0x8198AE KwUb 255.0 dez 0.00 255.0 FUNCTION_LIST PROKON IF_DATA DIM_X DIRECT 0x8198AE /end CHARACTERISTIC
/begin CHARACTERISTIC CDHSVSA "Codewort Heizerdiagnose vor Kat im Schub (CDHSVsa = 0  => keine Diagnose)" VALUE 0x8198AF KwUb 255.0 dez 0.00 255.0 FUNCTION_LIST PROKON IF_DATA DIM_X DIRECT 0x8198AF /end CHARACTERISTIC
/begin CHARACTERISTIC CDKAAA "Dummy: Tabellenanfang" VALUE 0x814500 KwUw 65535.00 dez 0.00 65535.00 FUNCTION_LIST DFPM_DFPM IF_DATA DIM_X DIRECT 0x814500 /end CHARACTERISTIC
/begin CHARACTERISTIC CDKAAVE "Codewort Kunde: Absperrventil Aktivkohlefilter (Endstufe)" VALUE 0x814502 KwUw 65535.00 dez 0.00 65535.00 FUNCTION_LIST DFPM_DEKON IF_DATA DIM_X DIRECT 0x814502 /end CHARACTERISTIC
/begin CHARACTERISTIC CDKAGRE "Codewort Kunde: Überwachung AGR-Endstufe" VALUE 0x814504 KwUw 65535.00 dez 0.00 65535.00 FUNCTION_LIST DFPM_DUMMY043 IF_DATA DIM_X DIRECT 0x814504 /end CHARACTERISTIC
/begin CHARACTERISTIC CDKAGRF "Codewort Kunde: Überwachung AGR-FLOW" VALUE 0x814506 KwUw 65535.00 dez 0.00 65535.00 FUNCTION_LIST DFPM_DUMMY043 IF_DATA DIM_X DIRECT 0x814506 /end CHARACTERISTIC
/begin CHARACTERISTIC CDKAT "Codewort Katalysator-Diagnose im OBDII-Mode (invers: Europa-Mode)" VALUE 0x8198B0 KwUb 255.0 dez 0.00 255.0 FUNCTION_LIST PROKON IF_DATA DIM_X DIRECT 0x8198B0 /end CHARACTERISTIC
/begin CHARACTERISTIC CDKATLK "Codewort für B_lrka aktiv" VALUE 0x8183B7 KwUb 255.0 dez 0.00 255.0 FUNCTION_LIST DKATLRS T2DFA IF_DATA DIM_X DIRECT 0x8183B7 /end CHARACTERISTIC
/begin CHARACTERISTIC CDKBM "Codewort Kunde: Bezugsmarkengeber" VALUE 0x814508 KwUw 65535.00 dez 0.00 65535.00 FUNCTION_LIST DFPM_DDG IF_DATA DIM_X DIRECT 0x814508 /end CHARACTERISTIC
/begin CHARACTERISTIC CDKBREMS "Codewort Kunde: BREMS (Bremsschalter)" VALUE 0x81450A KwUw 65535.00 dez 0.00 65535.00 FUNCTION_LIST DFPM_GGEGAS IF_DATA DIM_X DIRECT 0x81450A /end CHARACTERISTIC
/begin CHARACTERISTIC CDKBWF "Codewort Kunde: PWG Bewegung" VALUE 0x81450C KwUw 65535.00 dez 0.00 65535.00 FUNCTION_LIST DFPM_GGPED IF_DATA DIM_X DIRECT 0x81450C /end CHARACTERISTIC
/begin CHARACTERISTIC CDKCAS "Codewort Kunde: CAN-Schnittstelle, Timeout ASC" VALUE 0x81450E KwUw 65535.00 dez 0.00 65535.00 FUNCTION_LIST DFPM_DCAS IF_DATA DIM_X DIRECT 0x81450E /end CHARACTERISTIC
/begin CHARACTERISTIC CDKCGE "Codewort Kunde: CAN-Schnittstelle, Timeout EGS" VALUE 0x814510 KwUw 65535.00 dez 0.00 65535.00 FUNCTION_LIST DFPM_DCGE IF_DATA DIM_X DIRECT 0x814510 /end CHARACTERISTIC
/begin CHARACTERISTIC CDKCGEGS "" VALUE 0x814512 KwUw 65535.00 dez 0.00 65535.00 FUNCTION_LIST DFPM_DCG IF_DATA DIM_X DIRECT 0x814512 /end CHARACTERISTIC
/begin CHARACTERISTIC CDKCGGGP "" VALUE 0x814514 KwUw 65535.00 dez 0.00 65535.00 FUNCTION_LIST DFPM_DCG IF_DATA DIM_X DIRECT 0x814514 /end CHARACTERISTIC
/begin CHARACTERISTIC CDKCGGGV "" VALUE 0x814516 KwUw 65535.00 dez 0.00 65535.00 FUNCTION_LIST DFPM_DCG IF_DATA DIM_X DIRECT 0x814516 /end CHARACTERISTIC
/begin CHARACTERISTIC CDKCGM1V "" VALUE 0x814518 KwUw 65535.00 dez 0.00 65535.00 FUNCTION_LIST DFPM_DCG IF_DATA DIM_X DIRECT 0x814518 /end CHARACTERISTIC
/begin CHARACTERISTIC CDKCGM2V "" VALUE 0x81451A KwUw 65535.00 dez 0.00 65535.00 FUNCTION_LIST DFPM_DCG IF_DATA DIM_X DIRECT 0x81451A /end CHARACTERISTIC
/begin CHARACTERISTIC CDKCGM3V "" VALUE 0x81451C KwUw 65535.00 dez 0.00 65535.00 FUNCTION_LIST DFPM_DCG IF_DATA DIM_X DIRECT 0x81451C /end CHARACTERISTIC
/begin CHARACTERISTIC CDKCGMVK "" VALUE 0x81451E KwUw 65535.00 dez 0.00 65535.00 FUNCTION_LIST DFPM_DCG IF_DATA DIM_X DIRECT 0x81451E /end CHARACTERISTIC
/begin CHARACTERISTIC CDKCGRMM "" VALUE 0x814520 KwUw 65535.00 dez 0.00 65535.00 FUNCTION_LIST DFPM_DCG IF_DATA DIM_X DIRECT 0x814520 /end CHARACTERISTIC
/begin CHARACTERISTIC CDKCGRMS "" VALUE 0x814522 KwUw 65535.00 dez 0.00 65535.00 FUNCTION_LIST DFPM_DCG IF_DATA DIM_X DIRECT 0x814522 /end CHARACTERISTIC
/begin CHARACTERISTIC CDKCGUDG "" VALUE 0x814524 KwUw 65535.00 dez 0.00 65535.00 FUNCTION_LIST DFPM_DCG IF_DATA DIM_X DIRECT 0x814524 /end CHARACTERISTIC
/begin CHARACTERISTIC CDKCGUMV "" VALUE 0x814526 KwUw 65535.00 dez 0.00 65535.00 FUNCTION_LIST DFPM_DCG IF_DATA DIM_X DIRECT 0x814526 /end CHARACTERISTIC
/begin CHARACTERISTIC CDKCGVGC "" VALUE 0x814528 KwUw 65535.00 dez 0.00 65535.00 FUNCTION_LIST DFPM_DCG IF_DATA DIM_X DIRECT 0x814528 /end CHARACTERISTIC
/begin CHARACTERISTIC CDKCGVRC "" VALUE 0x81452A KwUw 65535.00 dez 0.00 65535.00 FUNCTION_LIST DFPM_DCG IF_DATA DIM_X DIRECT 0x81452A /end CHARACTERISTIC
/begin CHARACTERISTIC CDKCGWK "" VALUE 0x81452C KwUw 65535.00 dez 0.00 65535.00 FUNCTION_LIST DFPM_DCG IF_DATA DIM_X DIRECT 0x81452C /end CHARACTERISTIC
/begin CHARACTERISTIC CDKCKBI "" VALUE 0x81452E KwUw 65535.00 dez 0.00 65535.00 FUNCTION_LIST DFPM_DCKBI IF_DATA DIM_X DIRECT 0x81452E /end CHARACTERISTIC
/begin CHARACTERISTIC CDKCMIL "" VALUE 0x814530 KwUw 65535.00 dez 0.00 65535.00 FUNCTION_LIST DFPM_DCMIL IF_DATA DIM_X DIRECT 0x814530 /end CHARACTERISTIC
/begin CHARACTERISTIC CDKCRA "Codewort Kunde: EKP aus bei Crash" VALUE 0x814532 KwUw 65535.00 dez 0.00 65535.00 FUNCTION_LIST DFPM_GGAIRBAG IF_DATA DIM_X DIRECT 0x814532 /end CHARACTERISTIC
/begin CHARACTERISTIC CDKDK "Codewort Kunde: DK - Potentiometer" VALUE 0x814534 KwUw 65535.00 dez 0.00 65535.00 FUNCTION_LIST DFPM_DDVE IF_DATA DIM_X DIRECT 0x814534 /end CHARACTERISTIC
/begin CHARACTERISTIC CDKDK1P "Codewort Kunde: Drosselklappe 1. Poti" VALUE 0x814536 KwUw 65535.00 dez 0.00 65535.00 FUNCTION_LIST DFPM_DDVE IF_DATA DIM_X DIRECT 0x814536 /end CHARACTERISTIC
/begin CHARACTERISTIC CDKDK2P "Codewort Kunde: Drosselklappenpotentiometer 2" VALUE 0x814538 KwUw 65535.00 dez 0.00 65535.00 FUNCTION_LIST DFPM_DDVE IF_DATA DIM_X DIRECT 0x814538 /end CHARACTERISTIC
/begin CHARACTERISTIC CDKDPL "Codewort Kunde: Dauerplus" VALUE 0x81453A KwUw 65535.00 dez 0.00 65535.00 FUNCTION_LIST DFPM_DUMMY043 IF_DATA DIM_X DIRECT 0x81453A /end CHARACTERISTIC
/begin CHARACTERISTIC CDKDSL "Codewort Kunde: Drucksensor Ladedruck" VALUE 0x81453C KwUw 65535.00 dez 0.00 65535.00 FUNCTION_LIST DFPM_GGDSAS IF_DATA DIM_X DIRECT 0x81453C /end CHARACTERISTIC
/begin CHARACTERISTIC CDKDSU "Codewort Kunde: Drucksensor Umgebung" VALUE 0x81453E KwUw 65535.00 dez 0.00 65535.00 FUNCTION_LIST DFPM_GGDSAS IF_DATA DIM_X DIRECT 0x81453E /end CHARACTERISTIC
/begin CHARACTERISTIC CDKDSVLU "Codewort Kunde: Drucksensorsignalvergleich (DS-L DS-U)" VALUE 0x814540 KwUw 65535.00 dez 0.00 65535.00 FUNCTION_LIST DFPM_GGDSAS IF_DATA DIM_X DIRECT 0x814540 /end CHARACTERISTIC
/begin CHARACTERISTIC CDKDVEE "Codewort Kunde: DV-E Endstufe" VALUE 0x814542 KwUw 65535.00 dez 0.00 65535.00 FUNCTION_LIST DFPM_DDVE IF_DATA DIM_X DIRECT 0x814542 /end CHARACTERISTIC
/begin CHARACTERISTIC CDKDVEF "Codewort Kunde: DV-E Fehler bei Federprüfung" VALUE 0x814544 KwUw 65535.00 dez 0.00 65535.00 FUNCTION_LIST DFPM_DDVE IF_DATA DIM_X DIRECT 0x814544 /end CHARACTERISTIC
/begin CHARACTERISTIC CDKDVEFO "" VALUE 0x814546 KwUw 65535.00 dez 0.00 65535.00 FUNCTION_LIST DFPM_DDVE IF_DATA DIM_X DIRECT 0x814546 /end CHARACTERISTIC
/begin CHARACTERISTIC CDKDVEL "Codewort Kunde: DV-E Lageabweichung" VALUE 0x814548 KwUw 65535.00 dez 0.00 65535.00 FUNCTION_LIST DFPM_DDVE IF_DATA DIM_X DIRECT 0x814548 /end CHARACTERISTIC
/begin CHARACTERISTIC CDKDVEN "Codewort Kunde: DV-E Fehler bei Prüfung Notlufposition" VALUE 0x81454A KwUw 65535.00 dez 0.00 65535.00 FUNCTION_LIST DFPM_DDVE IF_DATA DIM_X DIRECT 0x81454A /end CHARACTERISTIC
/begin CHARACTERISTIC CDKDVER "Codewort Kunde: DV-E Regelbereich" VALUE 0x81454C KwUw 65535.00 dez 0.00 65535.00 FUNCTION_LIST DFPM_DDVE IF_DATA DIM_X DIRECT 0x81454C /end CHARACTERISTIC
/begin CHARACTERISTIC CDKDVET "" VALUE 0x81454E KwUw 65535.00 dez 0.00 65535.00 FUNCTION_LIST DFPM_DDVE IF_DATA DIM_X DIRECT 0x81454E /end CHARACTERISTIC
/begin CHARACTERISTIC CDKDVEU "Codewort Kunde: DV-E Fehler beim UMA-Lernen" VALUE 0x814550 KwUw 65535.00 dez 0.00 65535.00 FUNCTION_LIST DFPM_DDVE IF_DATA DIM_X DIRECT 0x814550 /end CHARACTERISTIC
/begin CHARACTERISTIC CDKDVEUB "" VALUE 0x814552 KwUw 65535.00 dez 0.00 65535.00 FUNCTION_LIST DFPM_DDVE IF_DATA DIM_X DIRECT 0x814552 /end CHARACTERISTIC
/begin CHARACTERISTIC CDKDVEUW "" VALUE 0x814554 KwUw 65535.00 dez 0.00 65535.00 FUNCTION_LIST DFPM_DDVE IF_DATA DIM_X DIRECT 0x814554 /end CHARACTERISTIC
/begin CHARACTERISTIC CDKDVEV "Codewort Kunde: DV-E Fehler bei Verstärkerabgleich" VALUE 0x814556 KwUw 65535.00 dez 0.00 65535.00 FUNCTION_LIST DFPM_DDVE IF_DATA DIM_X DIRECT 0x814556 /end CHARACTERISTIC
/begin CHARACTERISTIC CDKEGFE "Codewort Kunde: Lasterfassung" VALUE 0x814558 KwUw 65535.00 dez 0.00 65535.00 FUNCTION_LIST DFPM_EGFE IF_DATA DIM_X DIRECT 0x814558 /end CHARACTERISTIC
/begin CHARACTERISTIC CDKEV1 "Codewort Kunde: EV von Zyl. 1" VALUE 0x81455A KwUw 65535.00 dez 0.00 65535.00 FUNCTION_LIST DFPM_DEKON IF_DATA DIM_X DIRECT 0x81455A /end CHARACTERISTIC
/begin CHARACTERISTIC CDKEV2 "Codewort Kunde: EV von Zyl. 2" VALUE 0x81455C KwUw 65535.00 dez 0.00 65535.00 FUNCTION_LIST DFPM_DEKON IF_DATA DIM_X DIRECT 0x81455C /end CHARACTERISTIC
/begin CHARACTERISTIC CDKEV3 "Codewort Kunde: EV von Zyl. 3" VALUE 0x81455E KwUw 65535.00 dez 0.00 65535.00 FUNCTION_LIST DFPM_DEKON IF_DATA DIM_X DIRECT 0x81455E /end CHARACTERISTIC
/begin CHARACTERISTIC CDKEV4 "Codewort Kunde: EV von Zyl. 4" VALUE 0x814560 KwUw 65535.00 dez 0.00 65535.00 FUNCTION_LIST DFPM_DEKON IF_DATA DIM_X DIRECT 0x814560 /end CHARACTERISTIC
/begin CHARACTERISTIC CDKEV5 "Codewort Kunde: EV von Zyl. 5" VALUE 0x814562 KwUw 65535.00 dez 0.00 65535.00 FUNCTION_LIST DFPM_DEKON IF_DATA DIM_X DIRECT 0x814562 /end CHARACTERISTIC
/begin CHARACTERISTIC CDKEV6 "Codewort Kunde: EV von Zyl. 6" VALUE 0x814564 KwUw 65535.00 dez 0.00 65535.00 FUNCTION_LIST DFPM_DEKON IF_DATA DIM_X DIRECT 0x814564 /end CHARACTERISTIC
/begin CHARACTERISTIC CDKFGRL "" VALUE 0x814566 KwUw 65535.00 dez 0.00 65535.00 FUNCTION_LIST DFPM_DCFGRL IF_DATA DIM_X DIRECT 0x814566 /end CHARACTERISTIC
/begin CHARACTERISTIC CDKFP1P "Codewort Kunde: Poti 1, Fahrpedal" VALUE 0x814568 KwUw 65535.00 dez 0.00 65535.00 FUNCTION_LIST DFPM_GGPED IF_DATA DIM_X DIRECT 0x814568 /end CHARACTERISTIC
/begin CHARACTERISTIC CDKFP2P "Codewort Kunde: Poti 2, Fahrpedal" VALUE 0x81456A KwUw 65535.00 dez 0.00 65535.00 FUNCTION_LIST DFPM_GGPED IF_DATA DIM_X DIRECT 0x81456A /end CHARACTERISTIC
/begin CHARACTERISTIC CDKFPP "Codewort Kunde: Poti Fahrpedal" VALUE 0x81456C KwUw 65535.00 dez 0.00 65535.00 FUNCTION_LIST DFPM_GGPED IF_DATA DIM_X DIRECT 0x81456C /end CHARACTERISTIC
/begin CHARACTERISTIC CDKFRAO "Codewort Kunde: LR- Adaption multi. obere Schwelle" VALUE 0x81456E KwUw 65535.00 dez 0.00 65535.00 FUNCTION_LIST DFPM_DKVS IF_DATA DIM_X DIRECT 0x81456E /end CHARACTERISTIC
/begin CHARACTERISTIC CDKFRAO2 "Codewort Kunde: LR- Adaption mult. oderer Bereich" VALUE 0x814570 KwUw 65535.00 dez 0.00 65535.00 FUNCTION_LIST DFPM_DKVS IF_DATA DIM_X DIRECT 0x814570 /end CHARACTERISTIC
/begin CHARACTERISTIC CDKFRAU "Codewort Kunde: LR- Adaption multi. untere Schwelle" VALUE 0x814572 KwUw 65535.00 dez 0.00 65535.00 FUNCTION_LIST DFPM_DKVS IF_DATA DIM_X DIRECT 0x814572 /end CHARACTERISTIC
/begin CHARACTERISTIC CDKFRAU2 "Codewort Kunde: LR- Adaption mult. untere Schwelle Bank 2" VALUE 0x814574 KwUw 65535.00 dez 0.00 65535.00 FUNCTION_LIST DFPM_DKVS IF_DATA DIM_X DIRECT 0x814574 /end CHARACTERISTIC
/begin CHARACTERISTIC CDKFRST "Codewort Kunde: LR- Abweichung" VALUE 0x814576 KwUw 65535.00 dez 0.00 65535.00 FUNCTION_LIST DFPM_DKVS IF_DATA DIM_X DIRECT 0x814576 /end CHARACTERISTIC
/begin CHARACTERISTIC CDKFRST2 "Codewort Kunde: LR- Abweichung Bank 2" VALUE 0x814578 KwUw 65535.00 dez 0.00 65535.00 FUNCTION_LIST DFPM_DKVS IF_DATA DIM_X DIRECT 0x814578 /end CHARACTERISTIC
/begin CHARACTERISTIC CDKHSH "Codewort Kunde:Lambdasonden-Heizung hinter Katalysator" VALUE 0x81457A KwUw 65535.00 dez 0.00 65535.00 FUNCTION_LIST DFPM_DHLSHK IF_DATA DIM_X DIRECT 0x81457A /end CHARACTERISTIC
/begin CHARACTERISTIC CDKHSH2 "Codewort Kunde:	Lambdasonden-Heizung hinter Katalysator, Bank 2" VALUE 0x81457C KwUw 65535.00 dez 0.00 65535.00 FUNCTION_LIST DFPM_DHLSHK IF_DATA DIM_X DIRECT 0x81457C /end CHARACTERISTIC
/begin CHARACTERISTIC CDKHSHE "Codewort Kunde: Endstufe Heizung Sonde hinter Kat." VALUE 0x81457E KwUw 65535.00 dez 0.00 65535.00 FUNCTION_LIST DFPM_DEKON IF_DATA DIM_X DIRECT 0x81457E /end CHARACTERISTIC
/begin CHARACTERISTIC CDKHSHE2 "Codewort Kunde: Enstufe Heizung Sonde Hinter Kat. Bank 2" VALUE 0x814580 KwUw 65535.00 dez 0.00 65535.00 FUNCTION_LIST DFPM_DEKON IF_DATA DIM_X DIRECT 0x814580 /end CHARACTERISTIC
/begin CHARACTERISTIC CDKHSV "Codewort Kunde: Lambdasonden-Heizung vor Katalysator" VALUE 0x814582 KwUw 65535.00 dez 0.00 65535.00 FUNCTION_LIST DFPM_DHLSU IF_DATA DIM_X DIRECT 0x814582 /end CHARACTERISTIC
/begin CHARACTERISTIC CDKHSV2 "Codewort Kunde:	Lambdasonden-Heizung vor Katalysator, Bank 2" VALUE 0x814584 KwUw 65535.00 dez 0.00 65535.00 FUNCTION_LIST DFPM_DHLSU IF_DATA DIM_X DIRECT 0x814584 /end CHARACTERISTIC
/begin CHARACTERISTIC CDKHSVSA "" VALUE 0x814586 KwUw 65535.00 dez 0.00 65535.00 FUNCTION_LIST DFPM_DHLSU IF_DATA DIM_X DIRECT 0x814586 /end CHARACTERISTIC
/begin CHARACTERISTIC CDKHSVSA2 "" VALUE 0x814588 KwUw 65535.00 dez 0.00 65535.00 FUNCTION_LIST DFPM_DHLSU IF_DATA DIM_X DIRECT 0x814588 /end CHARACTERISTIC
/begin CHARACTERISTIC CDKKAT "Codewort Kunde:	Katalysator-Konvertierung" VALUE 0x81458A KwUw 65535.00 dez 0.00 65535.00 FUNCTION_LIST DFPM_DKAT IF_DATA DIM_X DIRECT 0x81458A /end CHARACTERISTIC
/begin CHARACTERISTIC CDKKAT2 "Codewort Kunde:	Katalysator-Konvertierung	(Bank 2)" VALUE 0x81458C KwUw 65535.00 dez 0.00 65535.00 FUNCTION_LIST DFPM_DKAT IF_DATA DIM_X DIRECT 0x81458C /end CHARACTERISTIC
/begin CHARACTERISTIC CDKKOS "Codewort Kunde:	Klimakompressorsteuerung" VALUE 0x81458E KwUw 65535.00 dez 0.00 65535.00 FUNCTION_LIST DFPM_DEKON IF_DATA DIM_X DIRECT 0x81458E /end CHARACTERISTIC
/begin CHARACTERISTIC CDKKPE "Codewort Kunde: EKP-Relais Endstufe" VALUE 0x814590 KwUw 65535.00 dez 0.00 65535.00 FUNCTION_LIST DFPM_DEKON IF_DATA DIM_X DIRECT 0x814590 /end CHARACTERISTIC
/begin CHARACTERISTIC CDKKRNT "Codewort Kunde:	Klopfregelung Nulltest" VALUE 0x814592 KwUw 65535.00 dez 0.00 65535.00 FUNCTION_LIST DFPM_DKRNT IF_DATA DIM_X DIRECT 0x814592 /end CHARACTERISTIC
/begin CHARACTERISTIC CDKKROF "Codewort Kunde:	Klopfregelung Offset" VALUE 0x814594 KwUw 65535.00 dez 0.00 65535.00 FUNCTION_LIST DFPM_DKRNT IF_DATA DIM_X DIRECT 0x814594 /end CHARACTERISTIC
/begin CHARACTERISTIC CDKKRTP "Codewort Kunde: Klopfregelung Testimpuls" VALUE 0x814596 KwUw 65535.00 dez 0.00 65535.00 FUNCTION_LIST DFPM_DKRTP IF_DATA DIM_X DIRECT 0x814596 /end CHARACTERISTIC
/begin CHARACTERISTIC CDKKS1 "Codewort Kunde:	Klopfsensor 1" VALUE 0x814598 KwUw 65535.00 dez 0.00 65535.00 FUNCTION_LIST DFPM_DKRS IF_DATA DIM_X DIRECT 0x814598 /end CHARACTERISTIC
/begin CHARACTERISTIC CDKKS2 "Codewort Kunde:	Klopfsensor 2" VALUE 0x81459A KwUw 65535.00 dez 0.00 65535.00 FUNCTION_LIST DFPM_DKRS IF_DATA DIM_X DIRECT 0x81459A /end CHARACTERISTIC
/begin CHARACTERISTIC CDKKS3 "Codewort Kunde:	Klopfsensor 3" VALUE 0x81459C KwUw 65535.00 dez 0.00 65535.00 FUNCTION_LIST DFPM_DKRS IF_DATA DIM_X DIRECT 0x81459C /end CHARACTERISTIC
/begin CHARACTERISTIC CDKKS4 "Codewort Kunde:	Klopfsensor 4" VALUE 0x81459E KwUw 65535.00 dez 0.00 65535.00 FUNCTION_LIST DFPM_DKRS IF_DATA DIM_X DIRECT 0x81459E /end CHARACTERISTIC
/begin CHARACTERISTIC CDKKUPPL "Codewort Kunde: Pedalwertgeber Kupplung" VALUE 0x8145A0 KwUw 65535.00 dez 0.00 65535.00 FUNCTION_LIST DFPM_DKUPPL IF_DATA DIM_X DIRECT 0x8145A0 /end CHARACTERISTIC
/begin CHARACTERISTIC CDKKWAVE "Codewort Kunde: Kühlwasserabsperrventil Endstufe" VALUE 0x8145A2 KwUw 65535.00 dez 0.00 65535.00 FUNCTION_LIST DFPM_DEKON IF_DATA DIM_X DIRECT 0x8145A2 /end CHARACTERISTIC
/begin CHARACTERISTIC CDKLASH "Codewort Kunde: Lambda-Sondenalterung hinter Kat." VALUE 0x8145A4 KwUw 65535.00 dez 0.00 65535.00 FUNCTION_LIST DFPM_DLSAHK IF_DATA DIM_X DIRECT 0x8145A4 /end CHARACTERISTIC
/begin CHARACTERISTIC CDKLASH2 "Codewort Kunde: Lambda-Sondenalterung hinter Kat.  Bank 2" VALUE 0x8145A6 KwUw 65535.00 dez 0.00 65535.00 FUNCTION_LIST DFPM_DLSAHK IF_DATA DIM_X DIRECT 0x8145A6 /end CHARACTERISTIC
/begin CHARACTERISTIC CDKLDE "Codeword Kunde: Ladedrucksteuerventil (Endstufe)" VALUE 0x8145A8 KwUw 65535.00 dez 0.00 65535.00 FUNCTION_LIST DFPM_DEKON IF_DATA DIM_X DIRECT 0x8145A8 /end CHARACTERISTIC
/begin CHARACTERISTIC CDKLDO "Codewort Kunde:	Ladedruckkennlinie; oberer Wert überschritten" VALUE 0x8145AA KwUw 65535.00 dez 0.00 65535.00 FUNCTION_LIST DFPM_DLDR IF_DATA DIM_X DIRECT 0x8145AA /end CHARACTERISTIC
/begin CHARACTERISTIC CDKLDRA "Codewort Kunde:	Ladedruckregelabweichung" VALUE 0x8145AC KwUw 65535.00 dez 0.00 65535.00 FUNCTION_LIST DFPM_DLDR IF_DATA DIM_X DIRECT 0x8145AC /end CHARACTERISTIC
/begin CHARACTERISTIC CDKLF1E "" VALUE 0x8145AE KwUw 65535.00 dez 0.00 65535.00 FUNCTION_LIST DFPM_DEKON IF_DATA DIM_X DIRECT 0x8145AE /end CHARACTERISTIC
/begin CHARACTERISTIC CDKLF2E "" VALUE 0x8145B0 KwUw 65535.00 dez 0.00 65535.00 FUNCTION_LIST DFPM_DEKON IF_DATA DIM_X DIRECT 0x8145B0 /end CHARACTERISTIC
/begin CHARACTERISTIC CDKLF3E "" VALUE 0x8145B2 KwUw 65535.00 dez 0.00 65535.00 FUNCTION_LIST DFPM_DEKON IF_DATA DIM_X DIRECT 0x8145B2 /end CHARACTERISTIC
/begin CHARACTERISTIC CDKLLR "Codewort Kunde: Leerlaufregelung am Anschlag" VALUE 0x8145B4 KwUw 65535.00 dez 0.00 65535.00 FUNCTION_LIST DFPM_DLLR IF_DATA DIM_X DIRECT 0x8145B4 /end CHARACTERISTIC
/begin CHARACTERISTIC CDKLM "Codewort Kunde:	LMM/HLM/HFM" VALUE 0x8145B6 KwUw 65535.00 dez 0.00 65535.00 FUNCTION_LIST DFPM_DHFM IF_DATA DIM_X DIRECT 0x8145B6 /end CHARACTERISTIC
/begin CHARACTERISTIC CDKLSH "Codewort Kunde: Lambda-Sonde hinter Kat" VALUE 0x8145B8 KwUw 65535.00 dez 0.00 65535.00 FUNCTION_LIST DFPM_DLSH IF_DATA DIM_X DIRECT 0x8145B8 /end CHARACTERISTIC
/begin CHARACTERISTIC CDKLSH2 "Codewort Kunde: Lambda-Sonde 2 hinter Kat" VALUE 0x8145BA KwUw 65535.00 dez 0.00 65535.00 FUNCTION_LIST DFPM_DLSH IF_DATA DIM_X DIRECT 0x8145BA /end CHARACTERISTIC
/begin CHARACTERISTIC CDKLSV "Codewort Kunde:	Lambda-Sonde vor Kat" VALUE 0x8145BC KwUw 65535.00 dez 0.00 65535.00 FUNCTION_LIST DFPM_DLSU IF_DATA DIM_X DIRECT 0x8145BC /end CHARACTERISTIC
/begin CHARACTERISTIC CDKLSV2 "Codewort Kunde:	Lambda-Sonde 2 vor Kat" VALUE 0x8145BE KwUw 65535.00 dez 0.00 65535.00 FUNCTION_LIST DFPM_DLSU IF_DATA DIM_X DIRECT 0x8145BE /end CHARACTERISTIC
/begin CHARACTERISTIC CDKLSVV "Codewort Kunde: Vertauschte Lambda- Sonden vor Kat" VALUE 0x8145C0 KwUw 65535.00 dez 0.00 65535.00 FUNCTION_LIST DFPM_LSVV IF_DATA DIM_X DIRECT 0x8145C0 /end CHARACTERISTIC
/begin CHARACTERISTIC CDKMD "Codewort Kunde: Aussetzer, Summenfehler (multiple)" VALUE 0x8145C2 KwUw 65535.00 dez 0.00 65535.00 FUNCTION_LIST DFPM_DMDMIL IF_DATA DIM_X DIRECT 0x8145C2 /end CHARACTERISTIC
/begin CHARACTERISTIC CDKMD00 "Codewort Kunde: Aussetzer Zyl. 0" VALUE 0x8145C4 KwUw 65535.00 dez 0.00 65535.00 FUNCTION_LIST DFPM_DMDMIL IF_DATA DIM_X DIRECT 0x8145C4 /end CHARACTERISTIC
/begin CHARACTERISTIC CDKMD01 "Codewort Kunde: Aussetzer Zyl. 1" VALUE 0x8145C6 KwUw 65535.00 dez 0.00 65535.00 FUNCTION_LIST DFPM_DMDMIL IF_DATA DIM_X DIRECT 0x8145C6 /end CHARACTERISTIC
/begin CHARACTERISTIC CDKMD02 "Codewort Kunde: Aussetzer Zylinder 2" VALUE 0x8145C8 KwUw 65535.00 dez 0.00 65535.00 FUNCTION_LIST DFPM_DMDMIL IF_DATA DIM_X DIRECT 0x8145C8 /end CHARACTERISTIC
/begin CHARACTERISTIC CDKMD03 "Codewort Kunde: Aussetzer Zylinder 3" VALUE 0x8145CA KwUw 65535.00 dez 0.00 65535.00 FUNCTION_LIST DFPM_DMDMIL IF_DATA DIM_X DIRECT 0x8145CA /end CHARACTERISTIC
/begin CHARACTERISTIC CDKMD04 "Codewort Kunde: Aussetzer Zylinder 4" VALUE 0x8145CC KwUw 65535.00 dez 0.00 65535.00 FUNCTION_LIST DFPM_DMDMIL IF_DATA DIM_X DIRECT 0x8145CC /end CHARACTERISTIC
/begin CHARACTERISTIC CDKMD05 "Codewort Kunde: Aussetzer Zylinder 5" VALUE 0x8145CE KwUw 65535.00 dez 0.00 65535.00 FUNCTION_LIST DFPM_DMDMIL IF_DATA DIM_X DIRECT 0x8145CE /end CHARACTERISTIC
/begin CHARACTERISTIC CDKMDB "Codewort Kunde: Momentbegrenzung Sollmoment" VALUE 0x8145D0 KwUw 65535.00 dez 0.00 65535.00 FUNCTION_LIST DFPM_MDKOG IF_DATA DIM_X DIRECT 0x8145D0 /end CHARACTERISTIC
/begin CHARACTERISTIC CDKMSG "" VALUE 0x8145D2 KwUw 65535.00 dez 0.00 65535.00 FUNCTION_LIST DFPM_MLS IF_DATA DIM_X DIRECT 0x8145D2 /end CHARACTERISTIC
/begin CHARACTERISTIC CDKMSGE "" VALUE 0x8145D4 KwUw 65535.00 dez 0.00 65535.00 FUNCTION_LIST DFPM_DEKON IF_DATA DIM_X DIRECT 0x8145D4 /end CHARACTERISTIC
/begin CHARACTERISTIC CDKN "Codewort Kunde: Drehzahlsignalgeber" VALUE 0x8145D6 KwUw 65535.00 dez 0.00 65535.00 FUNCTION_LIST DFPM_DDG IF_DATA DIM_X DIRECT 0x8145D6 /end CHARACTERISTIC
/begin CHARACTERISTIC CDKNWKW "Codewort Kunde: Zuordnung Nockwelle zu Kurbelwelle" VALUE 0x8145D8 KwUw 65535.00 dez 0.00 65535.00 FUNCTION_LIST DFPM_DNWKW IF_DATA DIM_X DIRECT 0x8145D8 /end CHARACTERISTIC
/begin CHARACTERISTIC CDKNWKW2 "Codewort Kunde: Zuordnung Nockwelle 2 zu Kurbelwelle" VALUE 0x8145DA KwUw 65535.00 dez 0.00 65535.00 FUNCTION_LIST DFPM_DNWKW IF_DATA DIM_X DIRECT 0x8145DA /end CHARACTERISTIC
/begin CHARACTERISTIC CDKNWS "Codewort Kunde: Nockenwellensteuerung" VALUE 0x8145DC KwUw 65535.00 dez 0.00 65535.00 FUNCTION_LIST DFPM_DNWS IF_DATA DIM_X DIRECT 0x8145DC /end CHARACTERISTIC
/begin CHARACTERISTIC CDKNWS2 "Codewort Kunde: Nockenwellensteuerung (Bank 2)" VALUE 0x8145DE KwUw 65535.00 dez 0.00 65535.00 FUNCTION_LIST DFPM_DNWS IF_DATA DIM_X DIRECT 0x8145DE /end CHARACTERISTIC
/begin CHARACTERISTIC CDKNWSE "Codewort Kunde: Nockenwellensteuerungsventil Endstufe" VALUE 0x8145E0 KwUw 65535.00 dez 0.00 65535.00 FUNCTION_LIST DFPM_DEKON IF_DATA DIM_X DIRECT 0x8145E0 /end CHARACTERISTIC
/begin CHARACTERISTIC CDKNWSE2 "Codewort Kunde: Nockenwellensteuerungsventil (Endstufe Bank 2)" VALUE 0x8145E2 KwUw 65535.00 dez 0.00 65535.00 FUNCTION_LIST DFPM_DEKON IF_DATA DIM_X DIRECT 0x8145E2 /end CHARACTERISTIC
/begin CHARACTERISTIC CDKPH "Codewort Kunde: Phasensensor" VALUE 0x8145E4 KwUw 65535.00 dez 0.00 65535.00 FUNCTION_LIST DFPM_DPH IF_DATA DIM_X DIRECT 0x8145E4 /end CHARACTERISTIC
/begin CHARACTERISTIC CDKPH2 "Codewort Kunde: Phasensensor 2" VALUE 0x8145E6 KwUw 65535.00 dez 0.00 65535.00 FUNCTION_LIST DFPM_DPH IF_DATA DIM_X DIRECT 0x8145E6 /end CHARACTERISTIC
/begin CHARACTERISTIC CDKRKAT "Codewort Kunde: LR- Adaption pro Zeit" VALUE 0x8145E8 KwUw 65535.00 dez 0.00 65535.00 FUNCTION_LIST DFPM_DKVS IF_DATA DIM_X DIRECT 0x8145E8 /end CHARACTERISTIC
/begin CHARACTERISTIC CDKRKAT2 "Codewort Kunde: LR- Adaption pro Zeit Bank 2" VALUE 0x8145EA KwUw 65535.00 dez 0.00 65535.00 FUNCTION_LIST DFPM_DKVS IF_DATA DIM_X DIRECT 0x8145EA /end CHARACTERISTIC
/begin CHARACTERISTIC CDKRKAZ "Codewort Kunde: LR- Adaption additiv pro Zündung" VALUE 0x8145EC KwUw 65535.00 dez 0.00 65535.00 FUNCTION_LIST DFPM_DKVS IF_DATA DIM_X DIRECT 0x8145EC /end CHARACTERISTIC
/begin CHARACTERISTIC CDKRKAZ2 "Codewort Kunde: Lambdaregelungsadaption Kraftstoff (Bank 2)" VALUE 0x8145EE KwUw 65535.00 dez 0.00 65535.00 FUNCTION_LIST DFPM_DKVS IF_DATA DIM_X DIRECT 0x8145EE /end CHARACTERISTIC
/begin CHARACTERISTIC CDKSGEEP "Codewort Kunde:	Steuergerät defekt (EEPROM)" VALUE 0x8145F0 KwUw 65535.00 dez 0.00 65535.00 FUNCTION_LIST DFPM_DSGEEP IF_DATA DIM_X DIRECT 0x8145F0 /end CHARACTERISTIC
/begin CHARACTERISTIC CDKSLPE "Codewort Kunde: Sekundärluftpumpe  (Endstufe)" VALUE 0x8145F2 KwUw 65535.00 dez 0.00 65535.00 FUNCTION_LIST DFPM_DEKON IF_DATA DIM_X DIRECT 0x8145F2 /end CHARACTERISTIC
/begin CHARACTERISTIC CDKSLS "Codewort Kunde: Sekundärluft-System" VALUE 0x8145F4 KwUw 65535.00 dez 0.00 65535.00 FUNCTION_LIST DFPM_DSLSLRS IF_DATA DIM_X DIRECT 0x8145F4 /end CHARACTERISTIC
/begin CHARACTERISTIC CDKSLS2 "Codewort Kunde: Sekundärluft-System Bank 2" VALUE 0x8145F6 KwUw 65535.00 dez 0.00 65535.00 FUNCTION_LIST DFPM_DSLSLRS IF_DATA DIM_X DIRECT 0x8145F6 /end CHARACTERISTIC
/begin CHARACTERISTIC CDKSLV "Codewort Kunde:	Sekundärluftventil" VALUE 0x8145F8 KwUw 65535.00 dez 0.00 65535.00 FUNCTION_LIST DFPM_DSLSLRS IF_DATA DIM_X DIRECT 0x8145F8 /end CHARACTERISTIC
/begin CHARACTERISTIC CDKSLV2 "Codewort Kunde: Sekundärluftventil Bank 2" VALUE 0x8145FA KwUw 65535.00 dez 0.00 65535.00 FUNCTION_LIST DFPM_DSLSLRS IF_DATA DIM_X DIRECT 0x8145FA /end CHARACTERISTIC
/begin CHARACTERISTIC CDKSLVE "Codewort Kunde:	Sekundärluftventil (Endstufe)" VALUE 0x8145FC KwUw 65535.00 dez 0.00 65535.00 FUNCTION_LIST DFPM_DEKON IF_DATA DIM_X DIRECT 0x8145FC /end CHARACTERISTIC
/begin CHARACTERISTIC CDKSWE "Codewort Kunde:	Beschleunigungssensor der Schlechtwegeerkennung" VALUE 0x8145FE KwUw 65535.00 dez 0.00 65535.00 FUNCTION_LIST DFPM_BGRBS IF_DATA DIM_X DIRECT 0x8145FE /end CHARACTERISTIC
/begin CHARACTERISTIC CDKTA "Codewort Kunde:	TANS" VALUE 0x814600 KwUw 65535.00 dez 0.00 65535.00 FUNCTION_LIST DFPM_GGTFA IF_DATA DIM_X DIRECT 0x814600 /end CHARACTERISTIC
/begin CHARACTERISTIC CDKTES "Codewort Kunde: Tankentlüftungssystem" VALUE 0x814602 KwUw 65535.00 dez 0.00 65535.00 FUNCTION_LIST DFPM_DTEV IF_DATA DIM_X DIRECT 0x814602 /end CHARACTERISTIC
/begin CHARACTERISTIC CDKTEVE "Codewort Kunde:	Tankentlüftungsventil Endstufe" VALUE 0x814604 KwUw 65535.00 dez 0.00 65535.00 FUNCTION_LIST DFPM_DEKON IF_DATA DIM_X DIRECT 0x814604 /end CHARACTERISTIC
/begin CHARACTERISTIC CDKTEVE2 "Codewort Kunde: Tankentlüftungsventil Endstufe Bank 2" VALUE 0x814606 KwUw 65535.00 dez 0.00 65535.00 FUNCTION_LIST DFPM_DUMMY043 IF_DATA DIM_X DIRECT 0x814606 /end CHARACTERISTIC
/begin CHARACTERISTIC CDKTGET "Codewort Kunde: Getriebetemperatur" VALUE 0x814608 KwUw 65535.00 dez 0.00 65535.00 FUNCTION_LIST DFPM_GGTGET IF_DATA DIM_X DIRECT 0x814608 /end CHARACTERISTIC
/begin CHARACTERISTIC CDKTHM "Codewort Kunde: Thermostat-Diagnose THM" VALUE 0x81460A KwUw 65535.00 dez 0.00 65535.00 FUNCTION_LIST DFPM_GGTFM IF_DATA DIM_X DIRECT 0x81460A /end CHARACTERISTIC
/begin CHARACTERISTIC CDKTM "Codewort Kunde: TMOT" VALUE 0x81460C KwUw 65535.00 dez 0.00 65535.00 FUNCTION_LIST DFPM_GGTFM IF_DATA DIM_X DIRECT 0x81460C /end CHARACTERISTIC
/begin CHARACTERISTIC CDKTMKI "Codewort Kunde: Motortemperatur aus Kombiinstrument TMKI" VALUE 0x81460E KwUw 65535.00 dez 0.00 65535.00 FUNCTION_LIST DFPM_DUMMY043 IF_DATA DIM_X DIRECT 0x81460E /end CHARACTERISTIC
/begin CHARACTERISTIC CDKTMR "" VALUE 0x814610 KwUw 65535.00 dez 0.00 65535.00 FUNCTION_LIST DFPM_GGTFMR IF_DATA DIM_X DIRECT 0x814610 /end CHARACTERISTIC
/begin CHARACTERISTIC CDKTOL "Codewort Kunde: Öltemperatur" VALUE 0x814612 KwUw 65535.00 dez 0.00 65535.00 FUNCTION_LIST DFPM_GGTFOL IF_DATA DIM_X DIRECT 0x814612 /end CHARACTERISTIC
/begin CHARACTERISTIC CDKTUM "Codewort Kunde: Umgebungstemperatur" VALUE 0x814614 KwUw 65535.00 dez 0.00 65535.00 FUNCTION_LIST DFPM_GGTFUMG IF_DATA DIM_X DIRECT 0x814614 /end CHARACTERISTIC
/begin CHARACTERISTIC CDKUB "Codewort Kunde:	UB" VALUE 0x814616 KwUw 65535.00 dez 0.00 65535.00 FUNCTION_LIST DFPM_GGUB IF_DATA DIM_X DIRECT 0x814616 /end CHARACTERISTIC
/begin CHARACTERISTIC CDKUFMV "Codewort Kunde: Funktionsüberwachung: Momentenvergleich" VALUE 0x814618 KwUw 65535.00 dez 0.00 65535.00 FUNCTION_LIST DFPM_DUF IF_DATA DIM_X DIRECT 0x814618 /end CHARACTERISTIC
/begin CHARACTERISTIC CDKUFSKA "Codewort Kunde: Funktionsüberwachung: Sicherheits-Kraftstoff-Abschaltung" VALUE 0x81461A KwUw 65535.00 dez 0.00 65535.00 FUNCTION_LIST DFPM_DUF IF_DATA DIM_X DIRECT 0x81461A /end CHARACTERISTIC
/begin CHARACTERISTIC CDKURRAM "Codewort Kunde: Rechnerüberwachung: RAM" VALUE 0x81461C KwUw 65535.00 dez 0.00 65535.00 FUNCTION_LIST DFPM_DUR IF_DATA DIM_X DIRECT 0x81461C /end CHARACTERISTIC
/begin CHARACTERISTIC CDKURROM "Codewort Kunde: Rechnerüberwachung: ROM" VALUE 0x81461E KwUw 65535.00 dez 0.00 65535.00 FUNCTION_LIST DFPM_DUR IF_DATA DIM_X DIRECT 0x81461E /end CHARACTERISTIC
/begin CHARACTERISTIC CDKURRST "Codewort Kunde: Rechnerüberwachung: Reset" VALUE 0x814620 KwUw 65535.00 dez 0.00 65535.00 FUNCTION_LIST DFPM_DUR IF_DATA DIM_X DIRECT 0x814620 /end CHARACTERISTIC
/begin CHARACTERISTIC CDKUVSE "Codeword Kunde: Endstufe Umluftventil turbo" VALUE 0x814622 KwUw 65535.00 dez 0.00 65535.00 FUNCTION_LIST DFPM_DEKON IF_DATA DIM_X DIRECT 0x814622 /end CHARACTERISTIC
/begin CHARACTERISTIC CDKVFZ "Codewort Kunde:	Fahrzeug-Geschwindigkeit" VALUE 0x814624 KwUw 65535.00 dez 0.00 65535.00 FUNCTION_LIST DFPM_DVFZ IF_DATA DIM_X DIRECT 0x814624 /end CHARACTERISTIC
/begin CHARACTERISTIC CDKVS "Codeword DKVS aktiv/inaktiv, CD..=0 -> keine Diagnose" VALUE 0x8198B1 KwUb 255.0 dez 0.00 255.0 FUNCTION_LIST PROKON IF_DATA DIM_X DIRECT 0x8198B1 /end CHARACTERISTIC
/begin CHARACTERISTIC CDKVS01 "" VALUE 0x814626 KwUw 65535.00 dez 0.00 65535.00 FUNCTION_LIST DFPM_DVS IF_DATA DIM_X DIRECT 0x814626 /end CHARACTERISTIC
/begin CHARACTERISTIC CDKVS02 "" VALUE 0x814628 KwUw 65535.00 dez 0.00 65535.00 FUNCTION_LIST DFPM_DVS IF_DATA DIM_X DIRECT 0x814628 /end CHARACTERISTIC
/begin CHARACTERISTIC CDKVS03 "" VALUE 0x81462A KwUw 65535.00 dez 0.00 65535.00 FUNCTION_LIST DFPM_DVS IF_DATA DIM_X DIRECT 0x81462A /end CHARACTERISTIC
/begin CHARACTERISTIC CDKVS04 "" VALUE 0x81462C KwUw 65535.00 dez 0.00 65535.00 FUNCTION_LIST DFPM_DVS IF_DATA DIM_X DIRECT 0x81462C /end CHARACTERISTIC
/begin CHARACTERISTIC CDKVS05 "" VALUE 0x81462E KwUw 65535.00 dez 0.00 65535.00 FUNCTION_LIST DFPM_DVS IF_DATA DIM_X DIRECT 0x81462E /end CHARACTERISTIC
/begin CHARACTERISTIC CDKVS06 "" VALUE 0x814630 KwUw 65535.00 dez 0.00 65535.00 FUNCTION_LIST DFPM_DVS IF_DATA DIM_X DIRECT 0x814630 /end CHARACTERISTIC
/begin CHARACTERISTIC CDKVS1E "" VALUE 0x814632 KwUw 65535.00 dez 0.00 65535.00 FUNCTION_LIST DFPM_DEKON IF_DATA DIM_X DIRECT 0x814632 /end CHARACTERISTIC
/begin CHARACTERISTIC CDKVS2E "" VALUE 0x814634 KwUw 65535.00 dez 0.00 65535.00 FUNCTION_LIST DFPM_DEKON IF_DATA DIM_X DIRECT 0x814634 /end CHARACTERISTIC
/begin CHARACTERISTIC CDKVSB1 "" VALUE 0x814636 KwUw 65535.00 dez 0.00 65535.00 FUNCTION_LIST DFPM_DVS IF_DATA DIM_X DIRECT 0x814636 /end CHARACTERISTIC
/begin CHARACTERISTIC CDKVSB2 "" VALUE 0x814638 KwUw 65535.00 dez 0.00 65535.00 FUNCTION_LIST DFPM_DVS IF_DATA DIM_X DIRECT 0x814638 /end CHARACTERISTIC
/begin CHARACTERISTIC CDKVSS "" VALUE 0x81463A KwUw 65535.00 dez 0.00 65535.00 FUNCTION_LIST DFPM_DVS IF_DATA DIM_X DIRECT 0x81463A /end CHARACTERISTIC
/begin CHARACTERISTIC CDKWFS "Codewort Kunde: Wegfahrsperre" VALUE 0x81463C KwUw 65535.00 dez 0.00 65535.00 FUNCTION_LIST DFPM_WFS IF_DATA DIM_X DIRECT 0x81463C /end CHARACTERISTIC
/begin CHARACTERISTIC CDKZZZ "Dummy: Tabellenendeng" VALUE 0x81463E KwUw 65535.00 dez 0.00 65535.00 FUNCTION_LIST DFPM_DFPM IF_DATA DIM_X DIRECT 0x81463E /end CHARACTERISTIC
/begin CHARACTERISTIC CDLASH "Codewort Lambdasondenalterungsdiagnose (SHK) im OBDII-Mode (invers: Europa-Mode)" VALUE 0x8198B2 KwUb 255.0 dez 0.00 255.0 FUNCTION_LIST PROKON IF_DATA DIM_X DIRECT 0x8198B2 /end CHARACTERISTIC
/begin CHARACTERISTIC CDLATP "Codewort Lambdasondenalterungsdiagnose (TP) im OBDII-Mode (invers: Europa-Mode)" VALUE 0x8198B3 KwUb 255.0 dez 0.00 255.0 FUNCTION_LIST PROKON IF_DATA DIM_X DIRECT 0x8198B3 /end CHARACTERISTIC
/begin CHARACTERISTIC CDLATV "Codewort Lambdasondenalterungsdiagnose (tv) im OBDII-Mode (invers: Europa-Mode)" VALUE 0x8198B4 KwUb 255.0 dez 0.00 255.0 FUNCTION_LIST PROKON IF_DATA DIM_X DIRECT 0x8198B4 /end CHARACTERISTIC
/begin CHARACTERISTIC CDLDP "Codewort LDP-Diagnose im OBDII-Modus (invers: Europa-Modus), CD..=0 -> keine Dia" VALUE 0x8198B5 KwUb 255.0 dez 0.00 255.0 FUNCTION_LIST PROKON IF_DATA DIM_X DIRECT 0x8198B5 /end CHARACTERISTIC
/begin CHARACTERISTIC CDLLR "Codewort DLLR abschalten (EURO-Codierung), CD..=0 -> keine Diagnose" VALUE 0x8198B6 KwUb 255.0 dez 0.00 255.0 FUNCTION_LIST PROKON IF_DATA DIM_X DIRECT 0x8198B6 /end CHARACTERISTIC
/begin CHARACTERISTIC CDLSA "Codewort Lambdasondenalterungsdiagnose, Konfig.-byte, für Applikationszwecke" VALUE 0x8198B7 KwUb 255.0 dez 0.00 255.0 FUNCTION_LIST PROKON IF_DATA DIM_X DIRECT 0x8198B7 /end CHARACTERISTIC
/begin CHARACTERISTIC CDLSH "Codewort Sondendiagnose hinter Kat im OBDII-Mode (invers: Europa-Mode)" VALUE 0x8198B8 KwUb 255.0 dez 0.00 255.0 FUNCTION_LIST PROKON IF_DATA DIM_X DIRECT 0x8198B8 /end CHARACTERISTIC
/begin CHARACTERISTIC CDLSV "Codewort Sondendiagnose vor KAT im OBDII-Mode" VALUE 0x8198B9 KwUb 255.0 dez 0.00 255.0 FUNCTION_LIST PROKON IF_DATA DIM_X DIRECT 0x8198B9 /end CHARACTERISTIC
/begin CHARACTERISTIC CDLSVV "Codewort Diagnose vertauschte Sonden vor Kat im OBDII-Mode (invers: Europa-Mode)" VALUE 0x8198BA KwUb 255.0 dez 0.00 255.0 FUNCTION_LIST PROKON IF_DATA DIM_X DIRECT 0x8198BA /end CHARACTERISTIC
/begin CHARACTERISTIC CDMD "Codewort DMD abschalten (EURO-Codierung), CD..=0 -> keine Diagnose" VALUE 0x8198BB KwUb 255.0 dez 0.00 255.0 FUNCTION_LIST PROKON IF_DATA DIM_X DIRECT 0x8198BB /end CHARACTERISTIC
/begin CHARACTERISTIC CDNWS "Codewort DNWS abschalten (EURO-Codierung), CD..=0 -> keine Diagnose" VALUE 0x8198BC KwUb 255.0 dez 0.00 255.0 FUNCTION_LIST PROKON IF_DATA DIM_X DIRECT 0x8198BC /end CHARACTERISTIC
/begin CHARACTERISTIC CDSLS "Euro-Byte für Diagnose Sekundärluft-System" VALUE 0x8198BD KwUb 255.0 dez 0.00 255.0 FUNCTION_LIST PROKON IF_DATA DIM_X DIRECT 0x8198BD /end CHARACTERISTIC
/begin CHARACTERISTIC CDSLSE "Euro-Byte für Diagnose Endstufe Sekundärluft-Ventil/Pumpe" VALUE 0x8198BE KwUb 255.0 dez 0.00 255.0 FUNCTION_LIST PROKON IF_DATA DIM_X DIRECT 0x8198BE /end CHARACTERISTIC
/begin CHARACTERISTIC CDSWE "Codewort DSWE abschalten (EURO-Codierung), CD..=0 -> keine Diagnose" VALUE 0x8198BF KwUb 255.0 dez 0.00 255.0 FUNCTION_LIST PROKON IF_DATA DIM_X DIRECT 0x8198BF /end CHARACTERISTIC
/begin CHARACTERISTIC CDTAAA "Dummy: Tabellenanfang" VALUE 0x814640 KwUw 65535.00 dez 0.00 65535.00 FUNCTION_LIST DFPM_DFPM IF_DATA DIM_X DIRECT 0x814640 /end CHARACTERISTIC
/begin CHARACTERISTIC CDTAAVE "Codewort Tester: Absperrventil Aktivkohlefilter (Endst.)" VALUE 0x814642 KwUw 65535.00 dez 0.00 65535.00 FUNCTION_LIST DFPM_DEKON IF_DATA DIM_X DIRECT 0x814642 /end CHARACTERISTIC
/begin CHARACTERISTIC CDTAGRE "Codewort Tester: Überwachung AGR-Endstufe" VALUE 0x814644 KwUw 65535.00 dez 0.00 65535.00 FUNCTION_LIST DFPM_DUMMY043 IF_DATA DIM_X DIRECT 0x814644 /end CHARACTERISTIC
/begin CHARACTERISTIC CDTAGRF "Codewort Tester: Überwachung AGR-FLOW" VALUE 0x814646 KwUw 65535.00 dez 0.00 65535.00 FUNCTION_LIST DFPM_DUMMY043 IF_DATA DIM_X DIRECT 0x814646 /end CHARACTERISTIC
/begin CHARACTERISTIC CDTANKL "Codewort DTANKL abschalten (EURO-Codierung), CD..=0 -> keine Diagnose" VALUE 0x8198C0 KwUb 255.0 dez 0.00 255.0 FUNCTION_LIST PROKON IF_DATA DIM_X DIRECT 0x8198C0 /end CHARACTERISTIC
/begin CHARACTERISTIC CDTBM "Codewort Tester: Bezugsmarkengeber" VALUE 0x814648 KwUw 65535.00 dez 0.00 65535.00 FUNCTION_LIST DFPM_DDG IF_DATA DIM_X DIRECT 0x814648 /end CHARACTERISTIC
/begin CHARACTERISTIC CDTBREMS "Fehlerpfadcode: BREMS (Bremsschalter)" VALUE 0x81464A KwUw 65535.00 dez 0.00 65535.00 FUNCTION_LIST DFPM_GGEGAS IF_DATA DIM_X DIRECT 0x81464A /end CHARACTERISTIC
/begin CHARACTERISTIC CDTBWF "Codewort Tester: PWG Bewegung" VALUE 0x81464C KwUw 65535.00 dez 0.00 65535.00 FUNCTION_LIST DFPM_GGPED IF_DATA DIM_X DIRECT 0x81464C /end CHARACTERISTIC
/begin CHARACTERISTIC CDTCAS "Codewort Tester: CAN-Schnittstelle, Timeout ASC" VALUE 0x81464E KwUw 65535.00 dez 0.00 65535.00 FUNCTION_LIST DFPM_DCAS IF_DATA DIM_X DIRECT 0x81464E /end CHARACTERISTIC
/begin CHARACTERISTIC CDTCGE "Codewort Tester: CAN-Schnittstelle, Timeout EGS" VALUE 0x814650 KwUw 65535.00 dez 0.00 65535.00 FUNCTION_LIST DFPM_DCGE IF_DATA DIM_X DIRECT 0x814650 /end CHARACTERISTIC
/begin CHARACTERISTIC CDTCGEGS "Codewort Tester: EGS; Steuergerät" VALUE 0x814652 KwUw 65535.00 dez 0.00 65535.00 FUNCTION_LIST DFPM_DCG IF_DATA DIM_X DIRECT 0x814652 /end CHARACTERISTIC
/begin CHARACTERISTIC CDTCGGGP "Codewort Tester: EGS; Gang unplausibel" VALUE 0x814654 KwUw 65535.00 dez 0.00 65535.00 FUNCTION_LIST DFPM_DCG IF_DATA DIM_X DIRECT 0x814654 /end CHARACTERISTIC
/begin CHARACTERISTIC CDTCGGGV "Codewort Tester: EGS; Gangvergleich negativ" VALUE 0x814656 KwUw 65535.00 dez 0.00 65535.00 FUNCTION_LIST DFPM_DCG IF_DATA DIM_X DIRECT 0x814656 /end CHARACTERISTIC
/begin CHARACTERISTIC CDTCGM1V "Codewort Tester: EGS; Magnetventil 1-2/4-5 Schaltung" VALUE 0x814658 KwUw 65535.00 dez 0.00 65535.00 FUNCTION_LIST DFPM_DCG IF_DATA DIM_X DIRECT 0x814658 /end CHARACTERISTIC
/begin CHARACTERISTIC CDTCGM2V "Codewort Tester: EGS; Magnetventil 2-3 Schaltung" VALUE 0x81465A KwUw 65535.00 dez 0.00 65535.00 FUNCTION_LIST DFPM_DCG IF_DATA DIM_X DIRECT 0x81465A /end CHARACTERISTIC
/begin CHARACTERISTIC CDTCGM3V "Codewort Tester: EGS; Magnetventil 3-4 Schaltung" VALUE 0x81465C KwUw 65535.00 dez 0.00 65535.00 FUNCTION_LIST DFPM_DCG IF_DATA DIM_X DIRECT 0x81465C /end CHARACTERISTIC
/begin CHARACTERISTIC CDTCGMVK "Codewort Tester: EGS; Magnetventil Wandlerkupplung" VALUE 0x81465E KwUw 65535.00 dez 0.00 65535.00 FUNCTION_LIST DFPM_DCG IF_DATA DIM_X DIRECT 0x81465E /end CHARACTERISTIC
/begin CHARACTERISTIC CDTCGRMM "Codewort Tester: EGS; Regelmagnetventil Modulierdruck" VALUE 0x814660 KwUw 65535.00 dez 0.00 65535.00 FUNCTION_LIST DFPM_DCG IF_DATA DIM_X DIRECT 0x814660 /end CHARACTERISTIC
/begin CHARACTERISTIC CDTCGRMS "Codewort Tester: EGS; Regelmagnetventil Schaltdruck" VALUE 0x814662 KwUw 65535.00 dez 0.00 65535.00 FUNCTION_LIST DFPM_DCG IF_DATA DIM_X DIRECT 0x814662 /end CHARACTERISTIC
/begin CHARACTERISTIC CDTCGUDG "Codewort Tester: EGS; Versorgungsspannung Drehzahlsensoren" VALUE 0x814664 KwUw 65535.00 dez 0.00 65535.00 FUNCTION_LIST DFPM_DCG IF_DATA DIM_X DIRECT 0x814664 /end CHARACTERISTIC
/begin CHARACTERISTIC CDTCGUMV "Codewort Tester: EGS; Versorgungsspannung Magnetventile" VALUE 0x814666 KwUw 65535.00 dez 0.00 65535.00 FUNCTION_LIST DFPM_DCG IF_DATA DIM_X DIRECT 0x814666 /end CHARACTERISTIC
/begin CHARACTERISTIC CDTCGVGC "Codewort Tester: EGS; Verteilergetriebestellung unplausibel" VALUE 0x814668 KwUw 65535.00 dez 0.00 65535.00 FUNCTION_LIST DFPM_DCG IF_DATA DIM_X DIRECT 0x814668 /end CHARACTERISTIC
/begin CHARACTERISTIC CDTCGVRC "Codewort Tester: EGS; Raddrehzahl hinten unplausibel" VALUE 0x81466A KwUw 65535.00 dez 0.00 65535.00 FUNCTION_LIST DFPM_DCG IF_DATA DIM_X DIRECT 0x81466A /end CHARACTERISTIC
/begin CHARACTERISTIC CDTCGWK "Codewort Tester: EGS; Wandlerkupplung" VALUE 0x81466C KwUw 65535.00 dez 0.00 65535.00 FUNCTION_LIST DFPM_DCG IF_DATA DIM_X DIRECT 0x81466C /end CHARACTERISTIC
/begin CHARACTERISTIC CDTCKBI "Codewort Tester : Timeout Kombibotschaft" VALUE 0x81466E KwUw 65535.00 dez 0.00 65535.00 FUNCTION_LIST DFPM_DCKBI IF_DATA DIM_X DIRECT 0x81466E /end CHARACTERISTIC
/begin CHARACTERISTIC CDTCMIL "Codewort Tester: Diagnose MIL-Lampe über CAN" VALUE 0x814670 KwUw 65535.00 dez 0.00 65535.00 FUNCTION_LIST DFPM_DCMIL IF_DATA DIM_X DIRECT 0x814670 /end CHARACTERISTIC
/begin CHARACTERISTIC CDTCRA "Codewort Tester: EKP aus bei Crash" VALUE 0x814672 KwUw 65535.00 dez 0.00 65535.00 FUNCTION_LIST DFPM_GGAIRBAG IF_DATA DIM_X DIRECT 0x814672 /end CHARACTERISTIC
/begin CHARACTERISTIC CDTDK "Codewort Tester: DK - Potentiometer" VALUE 0x814674 KwUw 65535.00 dez 0.00 65535.00 FUNCTION_LIST DFPM_DDVE IF_DATA DIM_X DIRECT 0x814674 /end CHARACTERISTIC
/begin CHARACTERISTIC CDTDK1P "Codewort Tester: Drosselklappe 1. Poti" VALUE 0x814676 KwUw 65535.00 dez 0.00 65535.00 FUNCTION_LIST DFPM_DDVE IF_DATA DIM_X DIRECT 0x814676 /end CHARACTERISTIC
/begin CHARACTERISTIC CDTDK2P "Codewort Tester: Drosselklappenpotentiometer 2" VALUE 0x814678 KwUw 65535.00 dez 0.00 65535.00 FUNCTION_LIST DFPM_DDVE IF_DATA DIM_X DIRECT 0x814678 /end CHARACTERISTIC
/begin CHARACTERISTIC CDTDPL "Codewort Tester: Dauerplus" VALUE 0x81467A KwUw 65535.00 dez 0.00 65535.00 FUNCTION_LIST DFPM_DUMMY043 IF_DATA DIM_X DIRECT 0x81467A /end CHARACTERISTIC
/begin CHARACTERISTIC CDTDSL "Codewort Tester: Drucksensor Ladedruck" VALUE 0x81467C KwUw 65535.00 dez 0.00 65535.00 FUNCTION_LIST DFPM_GGDSAS IF_DATA DIM_X DIRECT 0x81467C /end CHARACTERISTIC
/begin CHARACTERISTIC CDTDSU "Codewort Tester: Drucksensor Umgebung" VALUE 0x81467E KwUw 65535.00 dez 0.00 65535.00 FUNCTION_LIST DFPM_GGDSAS IF_DATA DIM_X DIRECT 0x81467E /end CHARACTERISTIC
/begin CHARACTERISTIC CDTDSVLU "Codewort Tester: Drucksensorsignalvergleich (DS-L DS-U)" VALUE 0x814680 KwUw 65535.00 dez 0.00 65535.00 FUNCTION_LIST DFPM_GGDSAS IF_DATA DIM_X DIRECT 0x814680 /end CHARACTERISTIC
/begin CHARACTERISTIC CDTDVEE "Codewort Tester: DV-E Endstufe" VALUE 0x814682 KwUw 65535.00 dez 0.00 65535.00 FUNCTION_LIST DFPM_DDVE IF_DATA DIM_X DIRECT 0x814682 /end CHARACTERISTIC
/begin CHARACTERISTIC CDTDVEF "Codewort Tester: DV-E Fehler bei Federprüfung" VALUE 0x814684 KwUw 65535.00 dez 0.00 65535.00 FUNCTION_LIST DFPM_DDVE IF_DATA DIM_X DIRECT 0x814684 /end CHARACTERISTIC
/begin CHARACTERISTIC CDTDVEFO "" VALUE 0x814686 KwUw 65535.00 dez 0.00 65535.00 FUNCTION_LIST DFPM_DDVE IF_DATA DIM_X DIRECT 0x814686 /end CHARACTERISTIC
/begin CHARACTERISTIC CDTDVEL "Codewort Tester: DV-E Lageabweichung" VALUE 0x814688 KwUw 65535.00 dez 0.00 65535.00 FUNCTION_LIST DFPM_DDVE IF_DATA DIM_X DIRECT 0x814688 /end CHARACTERISTIC
/begin CHARACTERISTIC CDTDVEN "Codewort Tester: DV-E Fehler bei Prüfung Notlufposition" VALUE 0x81468A KwUw 65535.00 dez 0.00 65535.00 FUNCTION_LIST DFPM_DDVE IF_DATA DIM_X DIRECT 0x81468A /end CHARACTERISTIC
/begin CHARACTERISTIC CDTDVER "Codewort Tester: DV-E Regelbereich" VALUE 0x81468C KwUw 65535.00 dez 0.00 65535.00 FUNCTION_LIST DFPM_DDVE IF_DATA DIM_X DIRECT 0x81468C /end CHARACTERISTIC
/begin CHARACTERISTIC CDTDVET "" VALUE 0x81468E KwUw 65535.00 dez 0.00 65535.00 FUNCTION_LIST DFPM_DDVE IF_DATA DIM_X DIRECT 0x81468E /end CHARACTERISTIC
/begin CHARACTERISTIC CDTDVEU "Codewort Tester: DV-E Fehler beim UMA-Lernen" VALUE 0x814690 KwUw 65535.00 dez 0.00 65535.00 FUNCTION_LIST DFPM_DDVE IF_DATA DIM_X DIRECT 0x814690 /end CHARACTERISTIC
/begin CHARACTERISTIC CDTDVEUB "" VALUE 0x814692 KwUw 65535.00 dez 0.00 65535.00 FUNCTION_LIST DFPM_DDVE IF_DATA DIM_X DIRECT 0x814692 /end CHARACTERISTIC
/begin CHARACTERISTIC CDTDVEUW "" VALUE 0x814694 KwUw 65535.00 dez 0.00 65535.00 FUNCTION_LIST DFPM_DDVE IF_DATA DIM_X DIRECT 0x814694 /end CHARACTERISTIC
/begin CHARACTERISTIC CDTDVEV "Codewort Tester: DV-E Fehler bei Verstärkerabgleich" VALUE 0x814696 KwUw 65535.00 dez 0.00 65535.00 FUNCTION_LIST DFPM_DDVE IF_DATA DIM_X DIRECT 0x814696 /end CHARACTERISTIC
/begin CHARACTERISTIC CDTEGFE "Codeowort Tester: Eingangsgröße Füllungserfassung" VALUE 0x814698 KwUw 65535.00 dez 0.00 65535.00 FUNCTION_LIST DFPM_EGFE IF_DATA DIM_X DIRECT 0x814698 /end CHARACTERISTIC
/begin CHARACTERISTIC CDTES "Codewort Tankentlüftungsdiagnose abschalten (EURO-Codierung), CD..=0 ->keine Dia" VALUE 0x8198C1 KwUb 255.0 dez 0.00 255.0 FUNCTION_LIST PROKON IF_DATA DIM_X DIRECT 0x8198C1 /end CHARACTERISTIC
/begin CHARACTERISTIC CDTEV1 "Codewort Tester: EV von Zyl. 1" VALUE 0x81469A KwUw 65535.00 dez 0.00 65535.00 FUNCTION_LIST DFPM_DEKON IF_DATA DIM_X DIRECT 0x81469A /end CHARACTERISTIC
/begin CHARACTERISTIC CDTEV2 "Codewort Tester: EV von Zyl. 2" VALUE 0x81469C KwUw 65535.00 dez 0.00 65535.00 FUNCTION_LIST DFPM_DEKON IF_DATA DIM_X DIRECT 0x81469C /end CHARACTERISTIC
/begin CHARACTERISTIC CDTEV3 "Codewort Tester: EV von Zyl. 3" VALUE 0x81469E KwUw 65535.00 dez 0.00 65535.00 FUNCTION_LIST DFPM_DEKON IF_DATA DIM_X DIRECT 0x81469E /end CHARACTERISTIC
/begin CHARACTERISTIC CDTEV4 "Codewort Tester: EV von Zyl. 4" VALUE 0x8146A0 KwUw 65535.00 dez 0.00 65535.00 FUNCTION_LIST DFPM_DEKON IF_DATA DIM_X DIRECT 0x8146A0 /end CHARACTERISTIC
/begin CHARACTERISTIC CDTEV5 "Codewort Tester: EV von Zyl. 5" VALUE 0x8146A2 KwUw 65535.00 dez 0.00 65535.00 FUNCTION_LIST DFPM_DEKON IF_DATA DIM_X DIRECT 0x8146A2 /end CHARACTERISTIC
/begin CHARACTERISTIC CDTEV6 "Codewort Tester: EV von Zyl. 6" VALUE 0x8146A4 KwUw 65535.00 dez 0.00 65535.00 FUNCTION_LIST DFPM_DEKON IF_DATA DIM_X DIRECT 0x8146A4 /end CHARACTERISTIC
/begin CHARACTERISTIC CDTFGRL "Codewort Tester: FGR-Lampe über CAN" VALUE 0x8146A6 KwUw 65535.00 dez 0.00 65535.00 FUNCTION_LIST DFPM_DCFGRL IF_DATA DIM_X DIRECT 0x8146A6 /end CHARACTERISTIC
/begin CHARACTERISTIC CDTFP1P "Codewort Tester: Poti 1, Fahrpedal" VALUE 0x8146A8 KwUw 65535.00 dez 0.00 65535.00 FUNCTION_LIST DFPM_GGPED IF_DATA DIM_X DIRECT 0x8146A8 /end CHARACTERISTIC
/begin CHARACTERISTIC CDTFP2P "Codewort Tester: Poti 2, Fahrpedal" VALUE 0x8146AA KwUw 65535.00 dez 0.00 65535.00 FUNCTION_LIST DFPM_GGPED IF_DATA DIM_X DIRECT 0x8146AA /end CHARACTERISTIC
/begin CHARACTERISTIC CDTFPP "Codewort Tester: Poti Fahrpedal" VALUE 0x8146AC KwUw 65535.00 dez 0.00 65535.00 FUNCTION_LIST DFPM_GGPED IF_DATA DIM_X DIRECT 0x8146AC /end CHARACTERISTIC
/begin CHARACTERISTIC CDTFRAO "Codewort Tester: LR-Adaption multiplikativ obere Schwelle" VALUE 0x8146AE KwUw 65535.00 dez 0.00 65535.00 FUNCTION_LIST DFPM_DKVS IF_DATA DIM_X DIRECT 0x8146AE /end CHARACTERISTIC
/begin CHARACTERISTIC CDTFRAO2 "Codewort Tester: LR-Adaption multiplikativ obere Schwelle Bank 2" VALUE 0x8146B0 KwUw 65535.00 dez 0.00 65535.00 FUNCTION_LIST DFPM_DKVS IF_DATA DIM_X DIRECT 0x8146B0 /end CHARACTERISTIC
/begin CHARACTERISTIC CDTFRAU "Codewort Tester: LR-Adaption multiplikativ untere Schwelle" VALUE 0x8146B2 KwUw 65535.00 dez 0.00 65535.00 FUNCTION_LIST DFPM_DKVS IF_DATA DIM_X DIRECT 0x8146B2 /end CHARACTERISTIC
/begin CHARACTERISTIC CDTFRAU2 "Codewort Tester: LR-Adaption multiplikativ untere Schwelle Bank 2" VALUE 0x8146B4 KwUw 65535.00 dez 0.00 65535.00 FUNCTION_LIST DFPM_DKVS IF_DATA DIM_X DIRECT 0x8146B4 /end CHARACTERISTIC
/begin CHARACTERISTIC CDTFRST "Codewort Tester: LR-Abweichung" VALUE 0x8146B6 KwUw 65535.00 dez 0.00 65535.00 FUNCTION_LIST DFPM_DKVS IF_DATA DIM_X DIRECT 0x8146B6 /end CHARACTERISTIC
/begin CHARACTERISTIC CDTFRST2 "Codewort Tester: LR-Abweichung Bank 2" VALUE 0x8146B8 KwUw 65535.00 dez 0.00 65535.00 FUNCTION_LIST DFPM_DKVS IF_DATA DIM_X DIRECT 0x8146B8 /end CHARACTERISTIC
/begin CHARACTERISTIC CDTHSH "Codewort Tester: Lambdasonden-Heizung hinter Katalysator" VALUE 0x8146BA KwUw 65535.00 dez 0.00 65535.00 FUNCTION_LIST DFPM_DHLSHK IF_DATA DIM_X DIRECT 0x8146BA /end CHARACTERISTIC
/begin CHARACTERISTIC CDTHSH2 "Codewort Tester: Lambdasonden-Heizung hinter Kat., Bank 2" VALUE 0x8146BC KwUw 65535.00 dez 0.00 65535.00 FUNCTION_LIST DFPM_DHLSHK IF_DATA DIM_X DIRECT 0x8146BC /end CHARACTERISTIC
/begin CHARACTERISTIC CDTHSHE "Codewort Tester: Endstufe Lambdasonden-Heizung hinter Katalysator" VALUE 0x8146BE KwUw 65535.00 dez 0.00 65535.00 FUNCTION_LIST DFPM_DEKON IF_DATA DIM_X DIRECT 0x8146BE /end CHARACTERISTIC
/begin CHARACTERISTIC CDTHSHE2 "Codewort Tester: Endstufe Lambdasonden-Heizung2 hinter Katalysator" VALUE 0x8146C0 KwUw 65535.00 dez 0.00 65535.00 FUNCTION_LIST DFPM_DEKON IF_DATA DIM_X DIRECT 0x8146C0 /end CHARACTERISTIC
/begin CHARACTERISTIC CDTHSV "Codewort Tester: Lambdasonden-Heizung vor Katalysator" VALUE 0x8146C2 KwUw 65535.00 dez 0.00 65535.00 FUNCTION_LIST DFPM_DHLSU IF_DATA DIM_X DIRECT 0x8146C2 /end CHARACTERISTIC
/begin CHARACTERISTIC CDTHSV2 "Codewort Tester: Lambdasonden-Heizung vor Kat., Bank 2" VALUE 0x8146C4 KwUw 65535.00 dez 0.00 65535.00 FUNCTION_LIST DFPM_DHLSU IF_DATA DIM_X DIRECT 0x8146C4 /end CHARACTERISTIC
/begin CHARACTERISTIC CDTHSVSA "Codewort Tester: Lambdasonden-Heizung vor Katalysator" VALUE 0x8146C6 KwUw 65535.00 dez 0.00 65535.00 FUNCTION_LIST DFPM_DHLSU IF_DATA DIM_X DIRECT 0x8146C6 /end CHARACTERISTIC
/begin CHARACTERISTIC CDTHSVSA2 "Codewort Tester: Lambdasonden-Heizung vor Kat., Bank 2" VALUE 0x8146C8 KwUw 65535.00 dez 0.00 65535.00 FUNCTION_LIST DFPM_DHLSU IF_DATA DIM_X DIRECT 0x8146C8 /end CHARACTERISTIC
/begin CHARACTERISTIC CDTKAT "Codewort Tester: Katalysator-Konvertierung" VALUE 0x8146CA KwUw 65535.00 dez 0.00 65535.00 FUNCTION_LIST DFPM_DKAT IF_DATA DIM_X DIRECT 0x8146CA /end CHARACTERISTIC
/begin CHARACTERISTIC CDTKAT2 "Codewort Tester: Katalysator-Konvertierung (Bank 2)" VALUE 0x8146CC KwUw 65535.00 dez 0.00 65535.00 FUNCTION_LIST DFPM_DKAT IF_DATA DIM_X DIRECT 0x8146CC /end CHARACTERISTIC
/begin CHARACTERISTIC CDTKOS "Codewort Tester: Klimakompressorsteuerung" VALUE 0x8146CE KwUw 65535.00 dez 0.00 65535.00 FUNCTION_LIST DFPM_DEKON IF_DATA DIM_X DIRECT 0x8146CE /end CHARACTERISTIC
/begin CHARACTERISTIC CDTKPE "Codewort Tester: EKP-Relais Endstufe" VALUE 0x8146D0 KwUw 65535.00 dez 0.00 65535.00 FUNCTION_LIST DFPM_DEKON IF_DATA DIM_X DIRECT 0x8146D0 /end CHARACTERISTIC
/begin CHARACTERISTIC CDTKRNT "Codewort Tester: Klopfregelung Nulltest" VALUE 0x8146D2 KwUw 65535.00 dez 0.00 65535.00 FUNCTION_LIST DFPM_DKRNT IF_DATA DIM_X DIRECT 0x8146D2 /end CHARACTERISTIC
/begin CHARACTERISTIC CDTKROF "Codewort Tester: Klopfregelung Offset" VALUE 0x8146D4 KwUw 65535.00 dez 0.00 65535.00 FUNCTION_LIST DFPM_DKRNT IF_DATA DIM_X DIRECT 0x8146D4 /end CHARACTERISTIC
/begin CHARACTERISTIC CDTKRTP "Codewort Tester: Klopfregelung Testimpuls" VALUE 0x8146D6 KwUw 65535.00 dez 0.00 65535.00 FUNCTION_LIST DFPM_DKRTP IF_DATA DIM_X DIRECT 0x8146D6 /end CHARACTERISTIC
/begin CHARACTERISTIC CDTKS1 "Codewort Tester: Klopfsensor 1" VALUE 0x8146D8 KwUw 65535.00 dez 0.00 65535.00 FUNCTION_LIST DFPM_DKRS IF_DATA DIM_X DIRECT 0x8146D8 /end CHARACTERISTIC
/begin CHARACTERISTIC CDTKS2 "Codewort Tester: Klopfsensor 2" VALUE 0x8146DA KwUw 65535.00 dez 0.00 65535.00 FUNCTION_LIST DFPM_DKRS IF_DATA DIM_X DIRECT 0x8146DA /end CHARACTERISTIC
/begin CHARACTERISTIC CDTKS3 "Codewort Tester: Klopfsensor 3" VALUE 0x8146DC KwUw 65535.00 dez 0.00 65535.00 FUNCTION_LIST DFPM_DKRS IF_DATA DIM_X DIRECT 0x8146DC /end CHARACTERISTIC
/begin CHARACTERISTIC CDTKS4 "Codewort Tester: Klopfsensor 4" VALUE 0x8146DE KwUw 65535.00 dez 0.00 65535.00 FUNCTION_LIST DFPM_DKRS IF_DATA DIM_X DIRECT 0x8146DE /end CHARACTERISTIC
/begin CHARACTERISTIC CDTKUPPL "Fehlerpfadcode: Pedalwertgeber Kupplung" VALUE 0x8146E0 KwUw 65535.00 dez 0.00 65535.00 FUNCTION_LIST DFPM_DKUPPL IF_DATA DIM_X DIRECT 0x8146E0 /end CHARACTERISTIC
/begin CHARACTERISTIC CDTKWAVE "Codewort Tester: Kühlwasserabsperrventil Endstufe" VALUE 0x8146E2 KwUw 65535.00 dez 0.00 65535.00 FUNCTION_LIST DFPM_DEKON IF_DATA DIM_X DIRECT 0x8146E2 /end CHARACTERISTIC
/begin CHARACTERISTIC CDTLASH "Codewort Tester: Lambda-Sondenalterung hinter Kat" VALUE 0x8146E4 KwUw 65535.00 dez 0.00 65535.00 FUNCTION_LIST DFPM_DLSAHK IF_DATA DIM_X DIRECT 0x8146E4 /end CHARACTERISTIC
/begin CHARACTERISTIC CDTLASH2 "Codewort Tester: Lambda-Sondenalterung hinter Kat. Bank2" VALUE 0x8146E6 KwUw 65535.00 dez 0.00 65535.00 FUNCTION_LIST DFPM_DLSAHK IF_DATA DIM_X DIRECT 0x8146E6 /end CHARACTERISTIC
/begin CHARACTERISTIC CDTLDE "Codewort Tester: Ladedrucksteuerventil (Endstufe)" VALUE 0x8146E8 KwUw 65535.00 dez 0.00 65535.00 FUNCTION_LIST DFPM_DEKON IF_DATA DIM_X DIRECT 0x8146E8 /end CHARACTERISTIC
/begin CHARACTERISTIC CDTLDO "Codewort Tester: Ladedruck; oberer Wert überschritten" VALUE 0x8146EA KwUw 65535.00 dez 0.00 65535.00 FUNCTION_LIST DFPM_DLDR IF_DATA DIM_X DIRECT 0x8146EA /end CHARACTERISTIC
/begin CHARACTERISTIC CDTLDRA "Codewort Tester: Ladedruckregelabweichung" VALUE 0x8146EC KwUw 65535.00 dez 0.00 65535.00 FUNCTION_LIST DFPM_DLDR IF_DATA DIM_X DIRECT 0x8146EC /end CHARACTERISTIC
/begin CHARACTERISTIC CDTLF1E "Codewort Tester: Lüfter Stufe1 (Endstufe)" VALUE 0x8146EE KwUw 65535.00 dez 0.00 65535.00 FUNCTION_LIST DFPM_DEKON IF_DATA DIM_X DIRECT 0x8146EE /end CHARACTERISTIC
/begin CHARACTERISTIC CDTLF2E "Codewort Tester: Lüfter Stufe2 (Endstufe)" VALUE 0x8146F0 KwUw 65535.00 dez 0.00 65535.00 FUNCTION_LIST DFPM_DEKON IF_DATA DIM_X DIRECT 0x8146F0 /end CHARACTERISTIC
/begin CHARACTERISTIC CDTLF3E "Codewort Tester: Lüfter Stufe3 (Endstufe)" VALUE 0x8146F2 KwUw 65535.00 dez 0.00 65535.00 FUNCTION_LIST DFPM_DEKON IF_DATA DIM_X DIRECT 0x8146F2 /end CHARACTERISTIC
/begin CHARACTERISTIC CDTLLR "Codewort Tester: Leerlaufregelung am Anschlag" VALUE 0x8146F4 KwUw 65535.00 dez 0.00 65535.00 FUNCTION_LIST DFPM_DLLR IF_DATA DIM_X DIRECT 0x8146F4 /end CHARACTERISTIC
/begin CHARACTERISTIC CDTLM "Codewort Tester: LMM/HLM/HFM" VALUE 0x8146F6 KwUw 65535.00 dez 0.00 65535.00 FUNCTION_LIST DFPM_DHFM IF_DATA DIM_X DIRECT 0x8146F6 /end CHARACTERISTIC
/begin CHARACTERISTIC CDTLSH "Codewort Tester: Lambda-Sonde hinter Kat" VALUE 0x8146F8 KwUw 65535.00 dez 0.00 65535.00 FUNCTION_LIST DFPM_DLSH IF_DATA DIM_X DIRECT 0x8146F8 /end CHARACTERISTIC
/begin CHARACTERISTIC CDTLSH2 "Codewort Tester: Lambda-Sonde 2 hinter Kat" VALUE 0x8146FA KwUw 65535.00 dez 0.00 65535.00 FUNCTION_LIST DFPM_DLSH IF_DATA DIM_X DIRECT 0x8146FA /end CHARACTERISTIC
/begin CHARACTERISTIC CDTLSV "Codewort Tester: Lambda-Sonde vor Kat" VALUE 0x8146FC KwUw 65535.00 dez 0.00 65535.00 FUNCTION_LIST DFPM_DLSU IF_DATA DIM_X DIRECT 0x8146FC /end CHARACTERISTIC
/begin CHARACTERISTIC CDTLSV2 "Codewort Tester: Lambda-Sonde 2 vor Kat" VALUE 0x8146FE KwUw 65535.00 dez 0.00 65535.00 FUNCTION_LIST DFPM_DLSU IF_DATA DIM_X DIRECT 0x8146FE /end CHARACTERISTIC
/begin CHARACTERISTIC CDTLSVV "Codewort Tester: Vertauschte Lambda-Sonde vor Kat" VALUE 0x814700 KwUw 65535.00 dez 0.00 65535.00 FUNCTION_LIST DFPM_LSVV IF_DATA DIM_X DIRECT 0x814700 /end CHARACTERISTIC
/begin CHARACTERISTIC CDTMD "Codewort Tester: Aussetzer, Summenfehler (multiple)" VALUE 0x814702 KwUw 65535.00 dez 0.00 65535.00 FUNCTION_LIST DFPM_DMDMIL IF_DATA DIM_X DIRECT 0x814702 /end CHARACTERISTIC
/begin CHARACTERISTIC CDTMD00 "Codewort Tester: Aussetzer Zyl. 0" VALUE 0x814704 KwUw 65535.00 dez 0.00 65535.00 FUNCTION_LIST DFPM_DMDMIL IF_DATA DIM_X DIRECT 0x814704 /end CHARACTERISTIC
/begin CHARACTERISTIC CDTMD01 "Codewort Tester: Aussetzer Zyl. 1" VALUE 0x814706 KwUw 65535.00 dez 0.00 65535.00 FUNCTION_LIST DFPM_DMDMIL IF_DATA DIM_X DIRECT 0x814706 /end CHARACTERISTIC
/begin CHARACTERISTIC CDTMD02 "Codewort Tester: Aussetzer Zylinder 2" VALUE 0x814708 KwUw 65535.00 dez 0.00 65535.00 FUNCTION_LIST DFPM_DMDMIL IF_DATA DIM_X DIRECT 0x814708 /end CHARACTERISTIC
/begin CHARACTERISTIC CDTMD03 "Codewort Tester: Aussetzer Zylinder 3" VALUE 0x81470A KwUw 65535.00 dez 0.00 65535.00 FUNCTION_LIST DFPM_DMDMIL IF_DATA DIM_X DIRECT 0x81470A /end CHARACTERISTIC
/begin CHARACTERISTIC CDTMD04 "Codewort Tester: Aussetzer Zylinder 4" VALUE 0x81470C KwUw 65535.00 dez 0.00 65535.00 FUNCTION_LIST DFPM_DMDMIL IF_DATA DIM_X DIRECT 0x81470C /end CHARACTERISTIC
/begin CHARACTERISTIC CDTMD05 "Codewort Tester: Aussetzer Zylinder 5" VALUE 0x81470E KwUw 65535.00 dez 0.00 65535.00 FUNCTION_LIST DFPM_DMDMIL IF_DATA DIM_X DIRECT 0x81470E /end CHARACTERISTIC
/begin CHARACTERISTIC CDTMDB "Codewort Tester: Momentbegrenzung Sollmoment" VALUE 0x814710 KwUw 65535.00 dez 0.00 65535.00 FUNCTION_LIST DFPM_MDKOG IF_DATA DIM_X DIRECT 0x814710 /end CHARACTERISTIC
/begin CHARACTERISTIC CDTMSG "Codeword Tester: Motorraumspülgebläse" VALUE 0x814712 KwUw 65535.00 dez 0.00 65535.00 FUNCTION_LIST DFPM_MLS IF_DATA DIM_X DIRECT 0x814712 /end CHARACTERISTIC
/begin CHARACTERISTIC CDTMSGE "Codeword Tester: Motorraumspülgebläse (Endstufe)" VALUE 0x814714 KwUw 65535.00 dez 0.00 65535.00 FUNCTION_LIST DFPM_DEKON IF_DATA DIM_X DIRECT 0x814714 /end CHARACTERISTIC
/begin CHARACTERISTIC CDTN "Codewort Tester: Drehzahlsignalgeber" VALUE 0x814716 KwUw 65535.00 dez 0.00 65535.00 FUNCTION_LIST DFPM_DDG IF_DATA DIM_X DIRECT 0x814716 /end CHARACTERISTIC
/begin CHARACTERISTIC CDTNWKW "Codewort Tester: Zuordnung Nockenwelle zu Kurbelwelle" VALUE 0x814718 KwUw 65535.00 dez 0.00 65535.00 FUNCTION_LIST DFPM_DNWKW IF_DATA DIM_X DIRECT 0x814718 /end CHARACTERISTIC
/begin CHARACTERISTIC CDTNWKW2 "Codewort Tester: Zuordnung Nockenwelle 2 zu Kurbelwelle" VALUE 0x81471A KwUw 65535.00 dez 0.00 65535.00 FUNCTION_LIST DFPM_DNWKW IF_DATA DIM_X DIRECT 0x81471A /end CHARACTERISTIC
/begin CHARACTERISTIC CDTNWS "Codewort Tester: Nockenwellensteuerung" VALUE 0x81471C KwUw 65535.00 dez 0.00 65535.00 FUNCTION_LIST DFPM_DNWS IF_DATA DIM_X DIRECT 0x81471C /end CHARACTERISTIC
/begin CHARACTERISTIC CDTNWS2 "Codewort Tester: Nockenwellensteuerung (Bank 2)" VALUE 0x81471E KwUw 65535.00 dez 0.00 65535.00 FUNCTION_LIST DFPM_DNWS IF_DATA DIM_X DIRECT 0x81471E /end CHARACTERISTIC
/begin CHARACTERISTIC CDTNWSE "Codewort Tester: Nockenwellensteuerungsventil Endstufe" VALUE 0x814720 KwUw 65535.00 dez 0.00 65535.00 FUNCTION_LIST DFPM_DEKON IF_DATA DIM_X DIRECT 0x814720 /end CHARACTERISTIC
/begin CHARACTERISTIC CDTNWSE2 "Codewort Tester: Nockenwellensteuerventil Endst. Bank 2" VALUE 0x814722 KwUw 65535.00 dez 0.00 65535.00 FUNCTION_LIST DFPM_DEKON IF_DATA DIM_X DIRECT 0x814722 /end CHARACTERISTIC
/begin CHARACTERISTIC CDTPH "Codewort Tester: Phasensensor" VALUE 0x814724 KwUw 65535.00 dez 0.00 65535.00 FUNCTION_LIST DFPM_DPH IF_DATA DIM_X DIRECT 0x814724 /end CHARACTERISTIC
/begin CHARACTERISTIC CDTPH2 "Codewort Tester: Phasensensor Bank 2" VALUE 0x814726 KwUw 65535.00 dez 0.00 65535.00 FUNCTION_LIST DFPM_DPH IF_DATA DIM_X DIRECT 0x814726 /end CHARACTERISTIC
/begin CHARACTERISTIC CDTRKAT "Codewort Tester: LR-Adaption additiv pro Zeit" VALUE 0x814728 KwUw 65535.00 dez 0.00 65535.00 FUNCTION_LIST DFPM_DKVS IF_DATA DIM_X DIRECT 0x814728 /end CHARACTERISTIC
/begin CHARACTERISTIC CDTRKAT2 "Codewort Tester: LR-Adaption additiv pro Zeit bank 2" VALUE 0x81472A KwUw 65535.00 dez 0.00 65535.00 FUNCTION_LIST DFPM_DKVS IF_DATA DIM_X DIRECT 0x81472A /end CHARACTERISTIC
/begin CHARACTERISTIC CDTRKAZ "Codewort Tester: LR-Adaption additiv pro Zündung" VALUE 0x81472C KwUw 65535.00 dez 0.00 65535.00 FUNCTION_LIST DFPM_DKVS IF_DATA DIM_X DIRECT 0x81472C /end CHARACTERISTIC
/begin CHARACTERISTIC CDTRKAZ2 "Codewort Tester: LR-Adaption additiv pro Zündung bank 2" VALUE 0x81472E KwUw 65535.00 dez 0.00 65535.00 FUNCTION_LIST DFPM_DKVS IF_DATA DIM_X DIRECT 0x81472E /end CHARACTERISTIC
/begin CHARACTERISTIC CDTSGEEP "Codewort Tester: Steuergerät defekt (EEPROM)" VALUE 0x814730 KwUw 65535.00 dez 0.00 65535.00 FUNCTION_LIST DFPM_DSGEEP IF_DATA DIM_X DIRECT 0x814730 /end CHARACTERISTIC
/begin CHARACTERISTIC CDTSLPE "Codewort Tester: Sekundärluftpumpe (Endstufe)" VALUE 0x814732 KwUw 65535.00 dez 0.00 65535.00 FUNCTION_LIST DFPM_DEKON IF_DATA DIM_X DIRECT 0x814732 /end CHARACTERISTIC
/begin CHARACTERISTIC CDTSLS "Codewort Tester: Sekundärluft-System" VALUE 0x814734 KwUw 65535.00 dez 0.00 65535.00 FUNCTION_LIST DFPM_DSLSLRS IF_DATA DIM_X DIRECT 0x814734 /end CHARACTERISTIC
/begin CHARACTERISTIC CDTSLS2 "Codewort Tester: Sekundärluft-System, Bank 2" VALUE 0x814736 KwUw 65535.00 dez 0.00 65535.00 FUNCTION_LIST DFPM_DSLSLRS IF_DATA DIM_X DIRECT 0x814736 /end CHARACTERISTIC
/begin CHARACTERISTIC CDTSLV "Codewort Tester: Sekundärluftventil" VALUE 0x814738 KwUw 65535.00 dez 0.00 65535.00 FUNCTION_LIST DFPM_DSLSLRS IF_DATA DIM_X DIRECT 0x814738 /end CHARACTERISTIC
/begin CHARACTERISTIC CDTSLV2 "Codewort Tester: Sekundärluftventil, Bank 2" VALUE 0x81473A KwUw 65535.00 dez 0.00 65535.00 FUNCTION_LIST DFPM_DSLSLRS IF_DATA DIM_X DIRECT 0x81473A /end CHARACTERISTIC
/begin CHARACTERISTIC CDTSLVE "Codewort Tester: Sekundärluftventil (Endstufe)" VALUE 0x81473C KwUw 65535.00 dez 0.00 65535.00 FUNCTION_LIST DFPM_DEKON IF_DATA DIM_X DIRECT 0x81473C /end CHARACTERISTIC
/begin CHARACTERISTIC CDTSWE "Codewort Tester: Beschleunigungssensor Schlechtwegeerk." VALUE 0x81473E KwUw 65535.00 dez 0.00 65535.00 FUNCTION_LIST DFPM_BGRBS IF_DATA DIM_X DIRECT 0x81473E /end CHARACTERISTIC
/begin CHARACTERISTIC CDTTA "Codewort Tester: TANS" VALUE 0x814740 KwUw 65535.00 dez 0.00 65535.00 FUNCTION_LIST DFPM_GGTFA IF_DATA DIM_X DIRECT 0x814740 /end CHARACTERISTIC
/begin CHARACTERISTIC CDTTES "Codewort Tester: Tankentlüftungssystem" VALUE 0x814742 KwUw 65535.00 dez 0.00 65535.00 FUNCTION_LIST DFPM_DTEV IF_DATA DIM_X DIRECT 0x814742 /end CHARACTERISTIC
/begin CHARACTERISTIC CDTTEVE "Codewort Tester: Tankentlüftungsventil Endstufe" VALUE 0x814744 KwUw 65535.00 dez 0.00 65535.00 FUNCTION_LIST DFPM_DEKON IF_DATA DIM_X DIRECT 0x814744 /end CHARACTERISTIC
/begin CHARACTERISTIC CDTTEVE2 "Codewort Tester: Tankentlüftungsventil Endstufe Bank 2" VALUE 0x814746 KwUw 65535.00 dez 0.00 65535.00 FUNCTION_LIST DFPM_DUMMY043 IF_DATA DIM_X DIRECT 0x814746 /end CHARACTERISTIC
/begin CHARACTERISTIC CDTTGET "Codewort Tester: Getriebetemperatur" VALUE 0x814748 KwUw 65535.00 dez 0.00 65535.00 FUNCTION_LIST DFPM_GGTGET IF_DATA DIM_X DIRECT 0x814748 /end CHARACTERISTIC
/begin CHARACTERISTIC CDTTHM "Codewort Tester: Thermostat-Diagnose THM" VALUE 0x81474A KwUw 65535.00 dez 0.00 65535.00 FUNCTION_LIST DFPM_GGTFM IF_DATA DIM_X DIRECT 0x81474A /end CHARACTERISTIC
/begin CHARACTERISTIC CDTTM "Codewort Tester: TMOT" VALUE 0x81474C KwUw 65535.00 dez 0.00 65535.00 FUNCTION_LIST DFPM_GGTFM IF_DATA DIM_X DIRECT 0x81474C /end CHARACTERISTIC
/begin CHARACTERISTIC CDTTMKI "Codewort Tester: Motortemperatur aus Kombiinstrument TMKI" VALUE 0x81474E KwUw 65535.00 dez 0.00 65535.00 FUNCTION_LIST DFPM_DUMMY043 IF_DATA DIM_X DIRECT 0x81474E /end CHARACTERISTIC
/begin CHARACTERISTIC CDTTMR "Codewort Tester: Motorraumtemperatur TMR" VALUE 0x814750 KwUw 65535.00 dez 0.00 65535.00 FUNCTION_LIST DFPM_GGTFMR IF_DATA DIM_X DIRECT 0x814750 /end CHARACTERISTIC
/begin CHARACTERISTIC CDTTOL "Codewort Tester: Öltemperatur" VALUE 0x814752 KwUw 65535.00 dez 0.00 65535.00 FUNCTION_LIST DFPM_GGTFOL IF_DATA DIM_X DIRECT 0x814752 /end CHARACTERISTIC
/begin CHARACTERISTIC CDTTUM "Codewort Tester: Umgebungstemperatur TUM" VALUE 0x814754 KwUw 65535.00 dez 0.00 65535.00 FUNCTION_LIST DFPM_GGTFUMG IF_DATA DIM_X DIRECT 0x814754 /end CHARACTERISTIC
/begin CHARACTERISTIC CDTUB "Codewort Tester: UB" VALUE 0x814756 KwUw 65535.00 dez 0.00 65535.00 FUNCTION_LIST DFPM_GGUB IF_DATA DIM_X DIRECT 0x814756 /end CHARACTERISTIC
/begin CHARACTERISTIC CDTUFMV "Codewort Tester: Funktionsüberwachung: Momentenvergleich" VALUE 0x814758 KwUw 65535.00 dez 0.00 65535.00 FUNCTION_LIST DFPM_DUF IF_DATA DIM_X DIRECT 0x814758 /end CHARACTERISTIC
/begin CHARACTERISTIC CDTUFSKA "Codewort Tester: Funktionsüberwachung: Sicherheits-Kraftstoff-Abschaltung" VALUE 0x81475A KwUw 65535.00 dez 0.00 65535.00 FUNCTION_LIST DFPM_DUF IF_DATA DIM_X DIRECT 0x81475A /end CHARACTERISTIC
/begin CHARACTERISTIC CDTURRAM "Codewort Tester: Rechnerüberwachung: RAM" VALUE 0x81475C KwUw 65535.00 dez 0.00 65535.00 FUNCTION_LIST DFPM_DUR IF_DATA DIM_X DIRECT 0x81475C /end CHARACTERISTIC
/begin CHARACTERISTIC CDTURROM "Codewort Tester: Rechnerüberwachung: ROM" VALUE 0x81475E KwUw 65535.00 dez 0.00 65535.00 FUNCTION_LIST DFPM_DUR IF_DATA DIM_X DIRECT 0x81475E /end CHARACTERISTIC
/begin CHARACTERISTIC CDTURRST "Codewort Tester: Rechnerüberwachung: Reset" VALUE 0x814760 KwUw 65535.00 dez 0.00 65535.00 FUNCTION_LIST DFPM_DUR IF_DATA DIM_X DIRECT 0x814760 /end CHARACTERISTIC
/begin CHARACTERISTIC CDTUVSE "Codewort Tester: Endstufe Umluftventil Turbo" VALUE 0x814762 KwUw 65535.00 dez 0.00 65535.00 FUNCTION_LIST DFPM_DEKON IF_DATA DIM_X DIRECT 0x814762 /end CHARACTERISTIC
/begin CHARACTERISTIC CDTVFZ "Codewort Tester: Fahrzeug-Geschwindigkeit" VALUE 0x814764 KwUw 65535.00 dez 0.00 65535.00 FUNCTION_LIST DFPM_DVFZ IF_DATA DIM_X DIRECT 0x814764 /end CHARACTERISTIC
/begin CHARACTERISTIC CDTVS01 "" VALUE 0x814766 KwUw 65535.00 dez 0.00 65535.00 FUNCTION_LIST DFPM_DVS IF_DATA DIM_X DIRECT 0x814766 /end CHARACTERISTIC
/begin CHARACTERISTIC CDTVS02 "" VALUE 0x814768 KwUw 65535.00 dez 0.00 65535.00 FUNCTION_LIST DFPM_DVS IF_DATA DIM_X DIRECT 0x814768 /end CHARACTERISTIC
/begin CHARACTERISTIC CDTVS03 "" VALUE 0x81476A KwUw 65535.00 dez 0.00 65535.00 FUNCTION_LIST DFPM_DVS IF_DATA DIM_X DIRECT 0x81476A /end CHARACTERISTIC
/begin CHARACTERISTIC CDTVS04 "" VALUE 0x81476C KwUw 65535.00 dez 0.00 65535.00 FUNCTION_LIST DFPM_DVS IF_DATA DIM_X DIRECT 0x81476C /end CHARACTERISTIC
/begin CHARACTERISTIC CDTVS05 "" VALUE 0x81476E KwUw 65535.00 dez 0.00 65535.00 FUNCTION_LIST DFPM_DVS IF_DATA DIM_X DIRECT 0x81476E /end CHARACTERISTIC
/begin CHARACTERISTIC CDTVS06 "" VALUE 0x814770 KwUw 65535.00 dez 0.00 65535.00 FUNCTION_LIST DFPM_DVS IF_DATA DIM_X DIRECT 0x814770 /end CHARACTERISTIC
/begin CHARACTERISTIC CDTVS1E "Codewort Tester: Ventilhubsteuerung 1" VALUE 0x814772 KwUw 65535.00 dez 0.00 65535.00 FUNCTION_LIST DFPM_DEKON IF_DATA DIM_X DIRECT 0x814772 /end CHARACTERISTIC
/begin CHARACTERISTIC CDTVS2E "Codewort Tester: Ventilhubsteuerung 2" VALUE 0x814774 KwUw 65535.00 dez 0.00 65535.00 FUNCTION_LIST DFPM_DEKON IF_DATA DIM_X DIRECT 0x814774 /end CHARACTERISTIC
/begin CHARACTERISTIC CDTVSB1 "" VALUE 0x814776 KwUw 65535.00 dez 0.00 65535.00 FUNCTION_LIST DFPM_DVS IF_DATA DIM_X DIRECT 0x814776 /end CHARACTERISTIC
/begin CHARACTERISTIC CDTVSB2 "" VALUE 0x814778 KwUw 65535.00 dez 0.00 65535.00 FUNCTION_LIST DFPM_DVS IF_DATA DIM_X DIRECT 0x814778 /end CHARACTERISTIC
/begin CHARACTERISTIC CDTVSS "" VALUE 0x81477A KwUw 65535.00 dez 0.00 65535.00 FUNCTION_LIST DFPM_DVS IF_DATA DIM_X DIRECT 0x81477A /end CHARACTERISTIC
/begin CHARACTERISTIC CDTWFS "Codewort Tester: Wegfahrsperre" VALUE 0x81477C KwUw 65535.00 dez 0.00 65535.00 FUNCTION_LIST DFPM_WFS IF_DATA DIM_X DIRECT 0x81477C /end CHARACTERISTIC
/begin CHARACTERISTIC CDTZZZ "Dummy: Tabellenende" VALUE 0x81477E KwUw 65535.00 dez 0.00 65535.00 FUNCTION_LIST DFPM_DFPM IF_DATA DIM_X DIRECT 0x81477E /end CHARACTERISTIC
/begin CHARACTERISTIC CDVSS "Codewort Diagnose Ventilhubsteuerung" VALUE 0x8198C2 KwUb 255.0 dez 0.00 255.0 FUNCTION_LIST PROKON IF_DATA DIM_X DIRECT 0x8198C2 /end CHARACTERISTIC
/begin CHARACTERISTIC CDWVERAD "Codewort : Sperrung Bedarfsadaption dmvadll für AG" VALUE 0x819797 KwUb 255.0 dez 0.00 255.0 FUNCTION_LIST MDVERAD IF_DATA DIM_X DIRECT 0x819797 /end CHARACTERISTIC
/begin CHARACTERISTIC CL30LINE "30. Linie der Klassentabelle" VAL_BLK 0x81B658 KwbUb 255.0 dez 0.00 255.0 NUMBER 13 FUNCTION_LIST DCLA IF_DATA DIM_X DIRECT 0x81B658 /end CHARACTERISTIC
/begin CHARACTERISTIC CL31LINE "31. Linie der Klassentabelle" VAL_BLK 0x81B666 KwbUb 255.0 dez 0.00 255.0 NUMBER 13 FUNCTION_LIST DCLA IF_DATA DIM_X DIRECT 0x81B666 /end CHARACTERISTIC
/begin CHARACTERISTIC CL32LINE "32. Linie der Klassentabelle" VAL_BLK 0x81B674 KwbUb 255.0 dez 0.00 255.0 NUMBER 13 FUNCTION_LIST DCLA IF_DATA DIM_X DIRECT 0x81B674 /end CHARACTERISTIC
/begin CHARACTERISTIC CL33LINE "33. Linie der Klassentabelle" VAL_BLK 0x81B682 KwbUb 255.0 dez 0.00 255.0 NUMBER 13 FUNCTION_LIST DCLA IF_DATA DIM_X DIRECT 0x81B682 /end CHARACTERISTIC
/begin CHARACTERISTIC CL34LINE "34. Linie der Klassentabelle" VAL_BLK 0x81B690 KwbUb 255.0 dez 0.00 255.0 NUMBER 13 FUNCTION_LIST DCLA IF_DATA DIM_X DIRECT 0x81B690 /end CHARACTERISTIC
/begin CHARACTERISTIC CL35LINE "35. Linie der Klassentabelle" VAL_BLK 0x81B69E KwbUb 255.0 dez 0.00 255.0 NUMBER 13 FUNCTION_LIST DCLA IF_DATA DIM_X DIRECT 0x81B69E /end CHARACTERISTIC
/begin CHARACTERISTIC CL36LINE "36. Linie der Klassentabelle" VAL_BLK 0x81B6AC KwbUb 255.0 dez 0.00 255.0 NUMBER 13 FUNCTION_LIST DCLA IF_DATA DIM_X DIRECT 0x81B6AC /end CHARACTERISTIC
/begin CHARACTERISTIC CL37LINE "37. Linie der Klassentabelle" VAL_BLK 0x81B6BA KwbUb 255.0 dez 0.00 255.0 NUMBER 13 FUNCTION_LIST DCLA IF_DATA DIM_X DIRECT 0x81B6BA /end CHARACTERISTIC
/begin CHARACTERISTIC CL38LINE "38. Linie der Klassentabelle" VAL_BLK 0x81B6C8 KwbUb 255.0 dez 0.00 255.0 NUMBER 13 FUNCTION_LIST DCLA IF_DATA DIM_X DIRECT 0x81B6C8 /end CHARACTERISTIC
/begin CHARACTERISTIC CL39LINE "39. Linie der Klassentabelle" VAL_BLK 0x81B6D6 KwbUb 255.0 dez 0.00 255.0 NUMBER 13 FUNCTION_LIST DCLA IF_DATA DIM_X DIRECT 0x81B6D6 /end CHARACTERISTIC
/begin CHARACTERISTIC CLAAAA "Dummy: Tabellenanfang" VALUE 0x8108CF KwUb 255.0 dez 0.00 255.0 FUNCTION_LIST DFPM_DFPM IF_DATA DIM_X DIRECT 0x8108CF /end CHARACTERISTIC
/begin CHARACTERISTIC CLAAAVE "Fehlerklasse: Absperrventil Aktivkohlefilter (Endstufe)" VALUE 0x8108D0 KwUb 255.0 dez 0.00 255.0 FUNCTION_LIST DFPM_DEKON IF_DATA DIM_X DIRECT 0x8108D0 /end CHARACTERISTIC
/begin CHARACTERISTIC CLAAGRE "Fehlerklasse: AGR-Ventil Endstufe" VALUE 0x8108D1 KwUb 255.0 dez 0.00 255.0 FUNCTION_LIST DFPM_DUMMY043 IF_DATA DIM_X DIRECT 0x8108D1 /end CHARACTERISTIC
/begin CHARACTERISTIC CLAAGRF "Fehlerklasse: Überwachung AGR-Flow" VALUE 0x8108D2 KwUb 255.0 dez 0.00 255.0 FUNCTION_LIST DFPM_DUMMY043 IF_DATA DIM_X DIRECT 0x8108D2 /end CHARACTERISTIC
/begin CHARACTERISTIC CLABM "Fehlerklasse: Bezugsmarkengeber" VALUE 0x8108D3 KwUb 255.0 dez 0.00 255.0 FUNCTION_LIST DFPM_DDG IF_DATA DIM_X DIRECT 0x8108D3 /end CHARACTERISTIC
/begin CHARACTERISTIC CLABREMS "Fehlerklasse: BREMS (Bremsschalter)" VALUE 0x8108D4 KwUb 255.0 dez 0.00 255.0 FUNCTION_LIST DFPM_GGEGAS IF_DATA DIM_X DIRECT 0x8108D4 /end CHARACTERISTIC
/begin CHARACTERISTIC CLABWF "Fehlerklasse:  PWG Bewegung" VALUE 0x8108D5 KwUb 255.0 dez 0.00 255.0 FUNCTION_LIST DFPM_GGPED IF_DATA DIM_X DIRECT 0x8108D5 /end CHARACTERISTIC
/begin CHARACTERISTIC CLACAS "Fehlerklasse: CAN-Timeout ASC-Botschaft" VALUE 0x8108D6 KwUb 255.0 dez 0.00 255.0 FUNCTION_LIST DFPM_DCAS IF_DATA DIM_X DIRECT 0x8108D6 /end CHARACTERISTIC
/begin CHARACTERISTIC CLACGE "Fehlerklasse: CAN-Timeout EGS-Botschaft" VALUE 0x8108D7 KwUb 255.0 dez 0.00 255.0 FUNCTION_LIST DFPM_DCGE IF_DATA DIM_X DIRECT 0x8108D7 /end CHARACTERISTIC
/begin CHARACTERISTIC CLACGEGS "Fehlerklasse: EGS; Steuergerät" VALUE 0x8108D8 KwUb 255.0 dez 0.00 255.0 FUNCTION_LIST DFPM_DCG IF_DATA DIM_X DIRECT 0x8108D8 /end CHARACTERISTIC
/begin CHARACTERISTIC CLACGGGP "Fehlerklasse: EGS; Gang unplausibel" VALUE 0x8108D9 KwUb 255.0 dez 0.00 255.0 FUNCTION_LIST DFPM_DCG IF_DATA DIM_X DIRECT 0x8108D9 /end CHARACTERISTIC
/begin CHARACTERISTIC CLACGGGV "Fehlerklasse: EGS; Gangvergleich negativ" VALUE 0x8108DA KwUb 255.0 dez 0.00 255.0 FUNCTION_LIST DFPM_DCG IF_DATA DIM_X DIRECT 0x8108DA /end CHARACTERISTIC
/begin CHARACTERISTIC CLACGM1V "Fehlerklasse: EGS; Magnetventil 1-2/4-5 Schaltung" VALUE 0x8108DB KwUb 255.0 dez 0.00 255.0 FUNCTION_LIST DFPM_DCG IF_DATA DIM_X DIRECT 0x8108DB /end CHARACTERISTIC
/begin CHARACTERISTIC CLACGM2V "Fehlerklasse: EGS; Magnetventil 2-3 Schaltung" VALUE 0x8108DC KwUb 255.0 dez 0.00 255.0 FUNCTION_LIST DFPM_DCG IF_DATA DIM_X DIRECT 0x8108DC /end CHARACTERISTIC
/begin CHARACTERISTIC CLACGM3V "Fehlerklasse: EGS; Magnetventil 3-4 Schaltung" VALUE 0x8108DD KwUb 255.0 dez 0.00 255.0 FUNCTION_LIST DFPM_DCG IF_DATA DIM_X DIRECT 0x8108DD /end CHARACTERISTIC
/begin CHARACTERISTIC CLACGMVK "Fehlerklasse: EGS; Magnetventil Wandlerkupplung" VALUE 0x8108DE KwUb 255.0 dez 0.00 255.0 FUNCTION_LIST DFPM_DCG IF_DATA DIM_X DIRECT 0x8108DE /end CHARACTERISTIC
/begin CHARACTERISTIC CLACGRMM "Fehlerklasse: EGS; Regelmagnetventil Modulierdruck" VALUE 0x8108DF KwUb 255.0 dez 0.00 255.0 FUNCTION_LIST DFPM_DCG IF_DATA DIM_X DIRECT 0x8108DF /end CHARACTERISTIC
/begin CHARACTERISTIC CLACGRMS "Fehlerklasse: EGS; Regelmagnetventil Schaltdruck" VALUE 0x8108E0 KwUb 255.0 dez 0.00 255.0 FUNCTION_LIST DFPM_DCG IF_DATA DIM_X DIRECT 0x8108E0 /end CHARACTERISTIC
/begin CHARACTERISTIC CLACGUDG "Fehlerklasse: EGS; Versorgungsspannung Drehzahlsensoren" VALUE 0x8108E1 KwUb 255.0 dez 0.00 255.0 FUNCTION_LIST DFPM_DCG IF_DATA DIM_X DIRECT 0x8108E1 /end CHARACTERISTIC
/begin CHARACTERISTIC CLACGUMV "Fehlerklasse: EGS; Versorgungsspannung Magnetventile" VALUE 0x8108E2 KwUb 255.0 dez 0.00 255.0 FUNCTION_LIST DFPM_DCG IF_DATA DIM_X DIRECT 0x8108E2 /end CHARACTERISTIC
/begin CHARACTERISTIC CLACGVGC "Fehlerklasse: EGS; Verteilergetriebestellung unplausibel" VALUE 0x8108E3 KwUb 255.0 dez 0.00 255.0 FUNCTION_LIST DFPM_DCG IF_DATA DIM_X DIRECT 0x8108E3 /end CHARACTERISTIC
/begin CHARACTERISTIC CLACGVRC "Fehlerklasse: EGS; Raddrehzahl hinten unplausibel" VALUE 0x8108E4 KwUb 255.0 dez 0.00 255.0 FUNCTION_LIST DFPM_DCG IF_DATA DIM_X DIRECT 0x8108E4 /end CHARACTERISTIC
/begin CHARACTERISTIC CLACGWK "Fehlerklasse: EGS; Wandlerkupplung" VALUE 0x8108E5 KwUb 255.0 dez 0.00 255.0 FUNCTION_LIST DFPM_DCG IF_DATA DIM_X DIRECT 0x8108E5 /end CHARACTERISTIC
/begin CHARACTERISTIC CLACKBI "" VALUE 0x8108E6 KwUb 255.0 dez 0.00 255.0 FUNCTION_LIST DFPM_DCKBI IF_DATA DIM_X DIRECT 0x8108E6 /end CHARACTERISTIC
/begin CHARACTERISTIC CLACMIL "Fehlerklasse: Diagnose FGR-Lampe über CAN" VALUE 0x8108E7 KwUb 255.0 dez 0.00 255.0 FUNCTION_LIST DFPM_DCMIL IF_DATA DIM_X DIRECT 0x8108E7 /end CHARACTERISTIC
/begin CHARACTERISTIC CLACRA "Fehlerklasse: EKP aus bei crash" VALUE 0x8108E8 KwUb 255.0 dez 0.00 255.0 FUNCTION_LIST DFPM_GGAIRBAG IF_DATA DIM_X DIRECT 0x8108E8 /end CHARACTERISTIC
/begin CHARACTERISTIC CLADK "Fehlerklasse: DK- Potentiometer" VALUE 0x8108E9 KwUb 255.0 dez 0.00 255.0 FUNCTION_LIST DFPM_DDVE IF_DATA DIM_X DIRECT 0x8108E9 /end CHARACTERISTIC
/begin CHARACTERISTIC CLADK1P "Fehlerklassse: Drosselklappe 1. Poti" VALUE 0x8108EA KwUb 255.0 dez 0.00 255.0 FUNCTION_LIST DFPM_DDVE IF_DATA DIM_X DIRECT 0x8108EA /end CHARACTERISTIC
/begin CHARACTERISTIC CLADK2P "Fehlerklasse: Drosselklappenpotentiometer 2" VALUE 0x8108EB KwUb 255.0 dez 0.00 255.0 FUNCTION_LIST DFPM_DDVE IF_DATA DIM_X DIRECT 0x8108EB /end CHARACTERISTIC
/begin CHARACTERISTIC CLADPL "Fehlerklasse: Dauerplus" VALUE 0x8108EC KwUb 255.0 dez 0.00 255.0 FUNCTION_LIST DFPM_DUMMY043 IF_DATA DIM_X DIRECT 0x8108EC /end CHARACTERISTIC
/begin CHARACTERISTIC CLADSL "Fehlerklasse: Druchsensor Ladedruck" VALUE 0x8108ED KwUb 255.0 dez 0.00 255.0 FUNCTION_LIST DFPM_GGDSAS IF_DATA DIM_X DIRECT 0x8108ED /end CHARACTERISTIC
/begin CHARACTERISTIC CLADSU "Fehlerklasse: Umgebungsdrucksensor" VALUE 0x8108EE KwUb 255.0 dez 0.00 255.0 FUNCTION_LIST DFPM_GGDSAS IF_DATA DIM_X DIRECT 0x8108EE /end CHARACTERISTIC
/begin CHARACTERISTIC CLADSVLU "Fehlerklasse: Drucksensorsignalvergleich (DS-L DS-U)" VALUE 0x8108EF KwUb 255.0 dez 0.00 255.0 FUNCTION_LIST DFPM_GGDSAS IF_DATA DIM_X DIRECT 0x8108EF /end CHARACTERISTIC
/begin CHARACTERISTIC CLADVEE "Fehlerklasse: DV-E Endstufe" VALUE 0x8108F0 KwUb 255.0 dez 0.00 255.0 FUNCTION_LIST DFPM_DDVE IF_DATA DIM_X DIRECT 0x8108F0 /end CHARACTERISTIC
/begin CHARACTERISTIC CLADVEF "Fehlerklasse: DV-E Fehler bei Federprüfung" VALUE 0x8108F1 KwUb 255.0 dez 0.00 255.0 FUNCTION_LIST DFPM_DDVE IF_DATA DIM_X DIRECT 0x8108F1 /end CHARACTERISTIC
/begin CHARACTERISTIC CLADVEFO "" VALUE 0x8108F2 KwUb 255.0 dez 0.00 255.0 FUNCTION_LIST DFPM_DDVE IF_DATA DIM_X DIRECT 0x8108F2 /end CHARACTERISTIC
/begin CHARACTERISTIC CLADVEL "Fehlerklasse: DV-E Lageabweichung" VALUE 0x8108F3 KwUb 255.0 dez 0.00 255.0 FUNCTION_LIST DFPM_DDVE IF_DATA DIM_X DIRECT 0x8108F3 /end CHARACTERISTIC
/begin CHARACTERISTIC CLADVEN "Fehlerklasse: DV-E Fehler bei Prüfung Notluftposition" VALUE 0x8108F4 KwUb 255.0 dez 0.00 255.0 FUNCTION_LIST DFPM_DDVE IF_DATA DIM_X DIRECT 0x8108F4 /end CHARACTERISTIC
/begin CHARACTERISTIC CLADVER "Fehlerklasse: DV-E Regelbereich" VALUE 0x8108F5 KwUb 255.0 dez 0.00 255.0 FUNCTION_LIST DFPM_DDVE IF_DATA DIM_X DIRECT 0x8108F5 /end CHARACTERISTIC
/begin CHARACTERISTIC CLADVET "" VALUE 0x8108F6 KwUb 255.0 dez 0.00 255.0 FUNCTION_LIST DFPM_DDVE IF_DATA DIM_X DIRECT 0x8108F6 /end CHARACTERISTIC
/begin CHARACTERISTIC CLADVEU "Fehlerklasse: DV-E Fehler beim UMA-Lernen" VALUE 0x8108F7 KwUb 255.0 dez 0.00 255.0 FUNCTION_LIST DFPM_DDVE IF_DATA DIM_X DIRECT 0x8108F7 /end CHARACTERISTIC
/begin CHARACTERISTIC CLADVEUB "" VALUE 0x8108F8 KwUb 255.0 dez 0.00 255.0 FUNCTION_LIST DFPM_DDVE IF_DATA DIM_X DIRECT 0x8108F8 /end CHARACTERISTIC
/begin CHARACTERISTIC CLADVEUW "" VALUE 0x8108F9 KwUb 255.0 dez 0.00 255.0 FUNCTION_LIST DFPM_DDVE IF_DATA DIM_X DIRECT 0x8108F9 /end CHARACTERISTIC
/begin CHARACTERISTIC CLADVEV "Fehlerklasse: DV-E Fehler bei Verstärkerabgleich" VALUE 0x8108FA KwUb 255.0 dez 0.00 255.0 FUNCTION_LIST DFPM_DDVE IF_DATA DIM_X DIRECT 0x8108FA /end CHARACTERISTIC
/begin CHARACTERISTIC CLAEGFE "Fehlerklasse: Lasterfassung" VALUE 0x8108FB KwUb 255.0 dez 0.00 255.0 FUNCTION_LIST DFPM_EGFE IF_DATA DIM_X DIRECT 0x8108FB /end CHARACTERISTIC
/begin CHARACTERISTIC CLAEV1 "Fehlerklasse: EV Endtsufe 1" VALUE 0x8108FC KwUb 255.0 dez 0.00 255.0 FUNCTION_LIST DFPM_DEKON IF_DATA DIM_X DIRECT 0x8108FC /end CHARACTERISTIC
/begin CHARACTERISTIC CLAEV2 "Fehlerklasse: EV Endstufe 2" VALUE 0x8108FD KwUb 255.0 dez 0.00 255.0 FUNCTION_LIST DFPM_DEKON IF_DATA DIM_X DIRECT 0x8108FD /end CHARACTERISTIC
/begin CHARACTERISTIC CLAEV3 "Fehlerklasse: EV Endstufe 3" VALUE 0x8108FE KwUb 255.0 dez 0.00 255.0 FUNCTION_LIST DFPM_DEKON IF_DATA DIM_X DIRECT 0x8108FE /end CHARACTERISTIC
/begin CHARACTERISTIC CLAEV4 "Fehlerklasse: EV Endstufe 4" VALUE 0x8108FF KwUb 255.0 dez 0.00 255.0 FUNCTION_LIST DFPM_DEKON IF_DATA DIM_X DIRECT 0x8108FF /end CHARACTERISTIC
/begin CHARACTERISTIC CLAEV5 "Fehlerklasse: EV Endstufe 5" VALUE 0x810900 KwUb 255.0 dez 0.00 255.0 FUNCTION_LIST DFPM_DEKON IF_DATA DIM_X DIRECT 0x810900 /end CHARACTERISTIC
/begin CHARACTERISTIC CLAEV6 "Fehlerklasse: EV Endstufe 6" VALUE 0x810901 KwUb 255.0 dez 0.00 255.0 FUNCTION_LIST DFPM_DEKON IF_DATA DIM_X DIRECT 0x810901 /end CHARACTERISTIC
/begin CHARACTERISTIC CLAFGRL "Fehlerklasse: FGR-Lampe über CAN" VALUE 0x810902 KwUb 255.0 dez 0.00 255.0 FUNCTION_LIST DFPM_DCFGRL IF_DATA DIM_X DIRECT 0x810902 /end CHARACTERISTIC
/begin CHARACTERISTIC CLAFP1P "Fehlerklasse: Poti 1, Fahrpedal" VALUE 0x810903 KwUb 255.0 dez 0.00 255.0 FUNCTION_LIST DFPM_GGPED IF_DATA DIM_X DIRECT 0x810903 /end CHARACTERISTIC
/begin CHARACTERISTIC CLAFP2P "Fehlerklasse: Poti 2, Fahrpedal" VALUE 0x810904 KwUb 255.0 dez 0.00 255.0 FUNCTION_LIST DFPM_GGPED IF_DATA DIM_X DIRECT 0x810904 /end CHARACTERISTIC
/begin CHARACTERISTIC CLAFPP "Fehlerklasse: Poti Fahrpedal" VALUE 0x810905 KwUb 255.0 dez 0.00 255.0 FUNCTION_LIST DFPM_GGPED IF_DATA DIM_X DIRECT 0x810905 /end CHARACTERISTIC
/begin CHARACTERISTIC CLAFRAO "Fehlerklasse: LR-Adaption oberer Bereich" VALUE 0x810906 KwUb 255.0 dez 0.00 255.0 FUNCTION_LIST DFPM_DKVS IF_DATA DIM_X DIRECT 0x810906 /end CHARACTERISTIC
/begin CHARACTERISTIC CLAFRAO2 "Fehlerklasse: LR-Adaption oberer Bereich Bank 2" VALUE 0x810907 KwUb 255.0 dez 0.00 255.0 FUNCTION_LIST DFPM_DKVS IF_DATA DIM_X DIRECT 0x810907 /end CHARACTERISTIC
/begin CHARACTERISTIC CLAFRAU "Fehlerklasse: LR-Adaption unterer Bereich" VALUE 0x810908 KwUb 255.0 dez 0.00 255.0 FUNCTION_LIST DFPM_DKVS IF_DATA DIM_X DIRECT 0x810908 /end CHARACTERISTIC
/begin CHARACTERISTIC CLAFRAU2 "Fehlerklasse: LR-Adaption unterer Bereich Bank 2" VALUE 0x810909 KwUb 255.0 dez 0.00 255.0 FUNCTION_LIST DFPM_DKVS IF_DATA DIM_X DIRECT 0x810909 /end CHARACTERISTIC
/begin CHARACTERISTIC CLAFRST "Fehlerklasse: LR-Abweichung" VALUE 0x81090A KwUb 255.0 dez 0.00 255.0 FUNCTION_LIST DFPM_DKVS IF_DATA DIM_X DIRECT 0x81090A /end CHARACTERISTIC
/begin CHARACTERISTIC CLAFRST2 "Fehlerklasse : LR-Abweichung Bank 2" VALUE 0x81090B KwUb 255.0 dez 0.00 255.0 FUNCTION_LIST DFPM_DKVS IF_DATA DIM_X DIRECT 0x81090B /end CHARACTERISTIC
/begin CHARACTERISTIC CLAHSH "Fehlerklasse: Heizung Lambdasonde hinter Kat" VALUE 0x81090C KwUb 255.0 dez 0.00 255.0 FUNCTION_LIST DFPM_DHLSHK IF_DATA DIM_X DIRECT 0x81090C /end CHARACTERISTIC
/begin CHARACTERISTIC CLAHSH2 "Fehlerklasse: Heizung Lambdasonde 2 hinter Kat" VALUE 0x81090D KwUb 255.0 dez 0.00 255.0 FUNCTION_LIST DFPM_DHLSHK IF_DATA DIM_X DIRECT 0x81090D /end CHARACTERISTIC
/begin CHARACTERISTIC CLAHSHE "Fehlerklasse: Endstufe Heizung Lambdasonde hinter Kat" VALUE 0x81090E KwUb 255.0 dez 0.00 255.0 FUNCTION_LIST DFPM_DEKON IF_DATA DIM_X DIRECT 0x81090E /end CHARACTERISTIC
/begin CHARACTERISTIC CLAHSHE2 "Fehlerklasse: Endstufe Heizung Lambdasonde 2 hinter Kat" VALUE 0x81090F KwUb 255.0 dez 0.00 255.0 FUNCTION_LIST DFPM_DEKON IF_DATA DIM_X DIRECT 0x81090F /end CHARACTERISTIC
/begin CHARACTERISTIC CLAHSV "Fehlerklasse: Heizung Lambdasonde vor Kat" VALUE 0x810910 KwUb 255.0 dez 0.00 255.0 FUNCTION_LIST DFPM_DHLSU IF_DATA DIM_X DIRECT 0x810910 /end CHARACTERISTIC
/begin CHARACTERISTIC CLAHSV2 "Fehlerklasse: Heizung Lambdasonde 2 vor Kat" VALUE 0x810911 KwUb 255.0 dez 0.00 255.0 FUNCTION_LIST DFPM_DHLSU IF_DATA DIM_X DIRECT 0x810911 /end CHARACTERISTIC
/begin CHARACTERISTIC CLAHSVSA "Fehlerklasse: Heizung Lambdasonde vor Kat" VALUE 0x810912 KwUb 255.0 dez 0.00 255.0 FUNCTION_LIST DFPM_DHLSU IF_DATA DIM_X DIRECT 0x810912 /end CHARACTERISTIC
/begin CHARACTERISTIC CLAHSVSA2 "Fehlerklasse: Heizung Lambdasonde 2 vor Kat" VALUE 0x810913 KwUb 255.0 dez 0.00 255.0 FUNCTION_LIST DFPM_DHLSU IF_DATA DIM_X DIRECT 0x810913 /end CHARACTERISTIC
/begin CHARACTERISTIC CLAKAT "Fehlerklasse: Katalysator" VALUE 0x810914 KwUb 255.0 dez 0.00 255.0 FUNCTION_LIST DFPM_DKAT IF_DATA DIM_X DIRECT 0x810914 /end CHARACTERISTIC
/begin AXIS_PTS SNM08DMUB "SST-Verteilung in DMD, 8 Drehzahl-SST" 0x810097 nmot SstAUbSstUb 10200. nmot_ub_q40 8 0.00 10200. FUNCTION_LIST SSTBER87 DMDDLU DMDDVS DMDLU DMDLUA DMDMIL DMDSTP DEPOSIT ABSOLUT IF_DATA DIM_X DIRECT 0x810097 /end AXIS_PTS
/begin AXIS_PTS SNM16KRUB "Stützstellenverteilung Drehzahl, 16 Sst." 0x81806C nmot SstAUbSstUb 10200. nmot_ub_q40 16 0.00 10200. FUNCTION_LIST SSTBER87 DKRS GGKS KRDY KRKE KRRA DEPOSIT ABSOLUT IF_DATA DIM_X DIRECT 0x81806C /end AXIS_PTS
/begin AXIS_PTS STS06TMUW "Stützstellenverteilung, Abgasmassenfluß" 0x81B828 tabstatm_w SstAUwSstUw 65535.00 t1sxs_uw_q1 6 0.00 65535.00 FUNCTION_LIST ATM DEPOSIT ABSOLUT IF_DATA DIM_X DIRECT 0x81B828 /end AXIS_PTS
/begin AXIS_PTS STS12ESUB "SST-Verteilung für Motorstarttemperatur" 0x8101D9 tmst SstAUbSstUb 191.3 temp_ub_q0p75_o48 12 -48.00 143.3 FUNCTION_LIST SSTBER87 ESNST ESWL DEPOSIT ABSOLUT IF_DATA DIM_X DIRECT 0x8101D9 /end AXIS_PTS
/begin FUNCTION ACIFI "9.60      Ausgabe für zylinderindividuelle Einspritzung" /end FUNCTION
/begin FUNCTION ADC "" /end FUNCTION
/begin FUNCTION ADVE "3.60      Ansteuerung der DV-E mit dem DLR" /end FUNCTION
/begin FUNCTION AEKP "4.10      Ausgabe EKP-Ansteuerung" /end FUNCTION
/begin FUNCTION AES "1.50      Ausgabe Einspritzung" /end FUNCTION
/begin FUNCTION AEVAB "6.10      Ausgabe Einspritzung Ev-Ausblendung" /end FUNCTION
/begin FUNCTION AEVABU "1.10      Ausgabe EV-Abschaltung durch Überwachungsfunktionen bei EGAS" /end FUNCTION
/begin FUNCTION AEVABZK "1.10      Ausgabe Ev-Abschaltung %MDRED + Komplettabschaltung durch Überwachungsfunktionen" /end FUNCTION
/begin FUNCTION AKWAV "1.20      Ansteuerung Kühlwasserabsperrventil" /end FUNCTION
/begin FUNCTION ALE "6.20      Auslauferkennung" /end FUNCTION
/begin FUNCTION AMUENE "4.10      Abspeicherung von Motorüberdrehzahlereignissen" /end FUNCTION
/begin FUNCTION ARMD "12.30     Momentenbasierte Antiruckelfunktion" /end FUNCTION
/begin FUNCTION ASC0F "" /end FUNCTION
/begin FUNCTION ASIC0 "" /end FUNCTION
/begin FUNCTION ATEV "4.40      Ansteuerung Tankentlüftungsventil (Periodendauer)" /end FUNCTION
/begin FUNCTION ATM "36.10     Abgastemperaturmodell" /end FUNCTION
/begin FUNCTION AZUE "5.10      Ausgabe Zündung" /end FUNCTION
/begin FUNCTION BBFGR "2.30      Ein- und Ausschaltbedingungen Fahrgeschwindigkeitsregler" /end FUNCTION
/begin FUNCTION BBGANG "11.20     Betriebsbereich Gang" /end FUNCTION
/begin FUNCTION BBKHZ "11.130    Betriebsbereich motorisches Katheizen" /end FUNCTION
/begin FUNCTION BBLDR "3.10      Betriebsbedingungen LDR" /end FUNCTION
/begin FUNCTION BBSAWE "18.50     Betriebsbereich Schubabschalten/Wiedereinsetzen" /end FUNCTION
/begin FUNCTION BBSTT "11.20     Betriebsbereich: Start" /end FUNCTION
/begin FUNCTION BBTEGA "3.60      Phasensteuerung für Tankentlüftung und Gemischadaption" /end FUNCTION
/begin FUNCTION BGCVN "9.10      Berechnete Größe Calibration Verification Number CVN" /end FUNCTION
/begin FUNCTION BGDVE "3.90      Größen für DV-E-Ansteuerung aus Lern- und Prüfroutinen" /end FUNCTION
/begin FUNCTION BGEVAB "1.11      Berechnung der tatsächlichen Reduzierstufe durch EV-Abschaltung" /end FUNCTION
/begin FUNCTION BGKMKI "1.10      Berechnete Größe: Kilometerstand vom Kombiinstrument" /end FUNCTION
/begin FUNCTION BGKML "1.10      Berechnete Größe: Kilometerstand über Fz.-Lebensdauer" /end FUNCTION
/begin FUNCTION BGKMST "2.10      Berechnete Größe: Kilometerstand" /end FUNCTION
/begin FUNCTION BGLBZ "4.1       Berechnete Größe Ladebilanz der Batterie" /end FUNCTION
/begin FUNCTION BGMSABG "2.10      Berechnung Abgasmassenstrom - bankabhängig" /end FUNCTION
/begin FUNCTION BGMSZS "20.30     Berechnungsgröße Massenströme zum Saugrohr" /end FUNCTION
/begin FUNCTION BGNG "5.20      Berechnete Größe Drehzahlgradient" /end FUNCTION
/begin FUNCTION BGNMOT "5.50      Berechnete Größe Drehzahl" /end FUNCTION
/begin FUNCTION BGRBS "4.40      Berechnete Größe Radbeschleunigung aus Raddrehzahl" /end FUNCTION
/begin FUNCTION BGRLG "1.10      Berechnete Größe RL-GRADIENT" /end FUNCTION
/begin FUNCTION BGRLP "4.40      Berechnungsgröße rlp prädizierte Luftfüllung" /end FUNCTION
/begin FUNCTION BGRML "1.20      Berechnungsgröße relative Luftmasse nach SAE J1979 Mode $01 + $02 PID $04" /end FUNCTION
/begin FUNCTION BGSRM "6.90      Füllungserfassung Saugrohrmodell" /end FUNCTION
/begin FUNCTION BGTABS "1.40      Berechnete Größe Abstellzeit" /end FUNCTION
/begin FUNCTION BGTEV "2.70      Berechnungsgröße Massenstrom TEV" /end FUNCTION
/begin FUNCTION BGTMPK "1.50      Füllungserfassung Berechnung Temperaturkompensation" /end FUNCTION
/begin FUNCTION BGWDKM "1.11      Berechnung Dk-Winkel Modell" /end FUNCTION
/begin FUNCTION CAN "79.100    CAN-Signalliste" /end FUNCTION
/begin FUNCTION CAN_DST "" /end FUNCTION
/begin FUNCTION DCAS "13.20     Diagnose; CAN-Timeout ASC-Schnittstelle" /end FUNCTION
/begin FUNCTION DCDACC "1.10      Diagnose; Zugriff auf Testerdaten" /end FUNCTION
/begin FUNCTION DCFGRL "1.20      Prüfung FGR-Lampe über CAN" /end FUNCTION
/begin FUNCTION DCG "1.30      Diagnose EGS (Getriebesteuergerät): OBDII-Kommunikation" /end FUNCTION
/begin FUNCTION DCGE "14.20     Diagnose; CAN-Timeout GE-Schnittstelle" /end FUNCTION
/begin FUNCTION DCKBI "1.30      Diagnose; CAN-Timeout Kombi-Schnittstelle" /end FUNCTION
/begin FUNCTION DCLA "2.50      OBDII; Klassentabelle" /end FUNCTION
/begin FUNCTION DCMIL "1.20      Diagnose MIL über CAN" /end FUNCTION
/begin FUNCTION DDCY "15.10     OBDII; Erfüllung Bedingung 'driving cycle'" /end FUNCTION
/begin FUNCTION DDG "10.30     Diagnose Drehzahlgeber" /end FUNCTION
/begin FUNCTION DDVE "7.30      Diagnose: EGAS-Steller DV-E" /end FUNCTION
/begin FUNCTION DECJ "16.10     Diagnose; Endstufe CJ4x/9x" /end FUNCTION
/begin FUNCTION DEGFE "2.10      Diagnose der Eingangsgrößen Füllungserfassung" /end FUNCTION
/begin FUNCTION DEKON "13.20     Konfiguration der Endstufendiagnose" /end FUNCTION
/begin FUNCTION DEKON2 "" /end FUNCTION
/begin FUNCTION DEKPE "11.11     Diagnose; Elektrokraftstoffpumpe Endstufe" /end FUNCTION
/begin FUNCTION DEVE "6.40      Diagnose; Einspritzventil - Endstufe" /end FUNCTION
/begin FUNCTION DFFT "1.50      Diagnose; Freeze Frame Auswahltabelle" /end FUNCTION
/begin FUNCTION DFFTCNV "4.70      Diagnose; Freeze Frame Tabelle, Konvertierung zu Bytes" /end FUNCTION
/begin FUNCTION DFFTK "5.60      Diagnose; Kundenspezifische Auswahlliste für Freeze Frame-Werte" /end FUNCTION
/begin FUNCTION DFPM "3.10      OBDII; Fehlerpfadmanager" /end FUNCTION
/begin FUNCTION DFPM_BGRBS "" /end FUNCTION
/begin FUNCTION DFPM_DCAS "" /end FUNCTION
/begin FUNCTION DFPM_DCFGRL "" /end FUNCTION
/begin FUNCTION DFPM_DCG "" /end FUNCTION
/begin FUNCTION DFPM_DCGE "" /end FUNCTION
/begin FUNCTION DFPM_DCKBI "" /end FUNCTION
/begin FUNCTION DFPM_DCMIL "" /end FUNCTION
/begin FUNCTION DFPM_DDG "" /end FUNCTION
/begin FUNCTION DFPM_DDVE "" /end FUNCTION
/begin FUNCTION DFPM_DEKON "" /end FUNCTION
/begin FUNCTION DFPM_DFPM "" /end FUNCTION
/begin FUNCTION DFPM_DHFM "" /end FUNCTION
/begin FUNCTION DFPM_DHLSHK "" /end FUNCTION
/begin FUNCTION DFPM_DHLSU "" /end FUNCTION
/begin FUNCTION DFPM_DKAT "" /end FUNCTION
/begin FUNCTION DFPM_DKRNT "" /end FUNCTION
/begin FUNCTION DFPM_DKRS "" /end FUNCTION
/begin FUNCTION DFPM_DKRTP "" /end FUNCTION
/begin FUNCTION DFPM_DKUPPL "" /end FUNCTION
/begin FUNCTION DFPM_DKVS "" /end FUNCTION
/begin FUNCTION DFPM_DLDR "" /end FUNCTION
/begin FUNCTION DFPM_DLLR "" /end FUNCTION
/begin FUNCTION DFPM_DLSAHK "" /end FUNCTION
/begin FUNCTION DFPM_DLSH "" /end FUNCTION
/begin FUNCTION DFPM_DLSU "" /end FUNCTION
/begin FUNCTION DFPM_DMDMIL "" /end FUNCTION
/begin FUNCTION DFPM_DNWKW "" /end FUNCTION
/begin FUNCTION DFPM_DNWS "" /end FUNCTION
/begin FUNCTION DFPM_DPH "" /end FUNCTION
/begin FUNCTION DFPM_DSGEEP "" /end FUNCTION
/begin FUNCTION DFPM_DSLSLRS "" /end FUNCTION
/begin FUNCTION DFPM_DTEV "" /end FUNCTION
/begin FUNCTION DFPM_DUF "" /end FUNCTION
/begin FUNCTION DFPM_DUMMY043 "" /end FUNCTION
/begin FUNCTION DFPM_DUR "" /end FUNCTION
/begin FUNCTION DFPM_DVFZ "" /end FUNCTION
/begin FUNCTION DFPM_DVS "" /end FUNCTION
/begin FUNCTION DFPM_EGFE "" /end FUNCTION
/begin FUNCTION DFPM_GGAIRBAG "" /end FUNCTION
/begin FUNCTION DFPM_GGDSAS "" /end FUNCTION
/begin FUNCTION DFPM_GGEGAS "" /end FUNCTION
/begin FUNCTION DFPM_GGPED "" /end FUNCTION
/begin FUNCTION DFPM_GGTFA "" /end FUNCTION
/begin FUNCTION DFPM_GGTFM "" /end FUNCTION
/begin FUNCTION DFPM_GGTFMR "" /end FUNCTION
/begin FUNCTION DFPM_GGTFOL "" /end FUNCTION
/begin FUNCTION DFPM_GGTFUMG "" /end FUNCTION
/begin FUNCTION DFPM_GGTGET "" /end FUNCTION
/begin FUNCTION DFPM_GGUB "" /end FUNCTION
/begin FUNCTION DFPM_LSVV "" /end FUNCTION
/begin FUNCTION DFPM_MDKOG "" /end FUNCTION
/begin FUNCTION DFPM_MLS "" /end FUNCTION
/begin FUNCTION DFPM_WFS "" /end FUNCTION
/begin FUNCTION DFRZ "20.20     OBDII; Beschreibung 'freeze frame'" /end FUNCTION
/begin FUNCTION DHFM "76.20     Diagnose; Plausibilitätsprüfung HFM" /end FUNCTION
/begin FUNCTION DHLSHK "4.40      Diagnose Sondenheizung hinter Kat" /end FUNCTION
/begin FUNCTION DHLSHKE "1.10      Diagnose Endstufe Sondenheizung hinter Kat" /end FUNCTION
/begin FUNCTION DHLSU "2.150     Diagnose Heizung LSU" /end FUNCTION
/begin FUNCTION DIAVALVE "" /end FUNCTION
/begin FUNCTION DIMC "34.10     OBDII; inspection/maintenance-ready" /end FUNCTION
/begin FUNCTION DKATLRS "5.100     Eigendiagnose : Katalysatorkonvertierung" /end FUNCTION
/begin FUNCTION DKOSE "6.20      Diagnose Klimakompressor-Endstufe" /end FUNCTION
/begin FUNCTION DKRNT "11.10     Diagnose; Klopfregelung, Nulltest (OBDII)" /end FUNCTION
/begin FUNCTION DKRS "29.50     Diagnose; Klopfsensor (OBDII)" /end FUNCTION
/begin FUNCTION DKRTP "11.10     Diagnose; Klopfregelung, Testimpuls (OBDII)" /end FUNCTION
/begin FUNCTION DKUPPL "3.10      Diagnose Kupplungsschalter" /end FUNCTION
/begin FUNCTION DKVS "17.60     Diagnose; Plausibilitätsprüfung Kraftstoffversorgungssysteme" /end FUNCTION
/begin FUNCTION DKWAVE "1.20      Diagnose Kühlwasserabsperrventil Endstufe" /end FUNCTION
/begin FUNCTION DLDE "Diagnose LDR-Endstufe" /end FUNCTION
/begin FUNCTION DLDR "3.10      Diagnose LDR" /end FUNCTION
/begin FUNCTION DLDUVSE "2.10      Diagnose Endstufe Umluftventil Turbo" /end FUNCTION
/begin FUNCTION DLLR "28.80     Diagnose: Leerlaufregelung Erkennung blockierter Steller" /end FUNCTION
/begin FUNCTION DLSAHK "5.40      Lambdasondenalterungsüberwachung hinter KAT" /end FUNCTION
/begin FUNCTION DLSH "26.70     Diagnose; Sondenbetriebsbereitschaft hinter Kat" /end FUNCTION
/begin FUNCTION DLSSA "14.80     Signalausgabe Lambdasonden" /end FUNCTION
/begin FUNCTION DLSU "30.20     Diagnose stetige Lambdasonde LSU" /end FUNCTION
/begin FUNCTION DLSUV "1.10      Erkennung vertauschte Lambda-Sonden vor Kat" /end FUNCTION
/begin FUNCTION DMDDLU "7.60      Diagnose Misfire Detection Differenzbildung der Laufunruhe" /end FUNCTION
/begin FUNCTION DMDDVS "Fehlererkennung Ventilhubsteuerung über Laufunruhe" /end FUNCTION
/begin FUNCTION DMDFON "6.60      Diagnosis Misfire Detection Fuel-on Adaptation" /end FUNCTION
/begin FUNCTION DMDLAD "5.10      Logic and Delay; Log. Verknüpfung versch. Blöcke zur Aussetzererkennung" /end FUNCTION
/begin FUNCTION DMDLU "4.140     Diagnose misfire detection; Laufunruhe" /end FUNCTION
/begin FUNCTION DMDLUA "4.40      Diagnose Misfire Detection Laufunruhe Abstandsmass" /end FUNCTION
/begin FUNCTION DMDLU_C "" /end FUNCTION
/begin FUNCTION DMDMIL "7.40      Fehlerbehandlung der Aussetzererkennung, Ansteuerung der MIL und Heilung" /end FUNCTION
/begin FUNCTION DMDSTP "Diagnose Misfire Detection; Stopbedingungen" /end FUNCTION
/begin FUNCTION DMDSYK "" /end FUNCTION
/begin FUNCTION DMDTSB "6.20      Diagnosis Misfire Detection Segmentzeitbildung" /end FUNCTION
/begin FUNCTION DMDUE "9.200     Diagnose Misfire Detection Overview (Übersicht)" /end FUNCTION
/begin FUNCTION DMIL "31.50     OBDII; MIL-Ansteuerung" /end FUNCTION
/begin FUNCTION DMLSE "13.20     Diagnose; Endstufenprüfung elektrischer Motorlüfter" /end FUNCTION
/begin FUNCTION DNWKW "6.10      Diagnose Zuordnung der Nockenwelle zur Kurbelwelle" /end FUNCTION
/begin FUNCTION DNWS "15.30     Diagnose Nockenwellensteuerung" /end FUNCTION
/begin FUNCTION DNWSE "7.20      Diagnose; Nockenwellensteuerung Endstufe" /end FUNCTION
/begin FUNCTION DPH "22.10     Diagnose; Plausibilitätsprüfung Phasensensor" /end FUNCTION
/begin FUNCTION DSGEEP "20.10     Diagnose; Plausibilitätsprüfung SG-EEPROM" /end FUNCTION
/begin FUNCTION DSLPE "9.20      Diagnose; Sekundärluftpumpe Endstufe" /end FUNCTION
/begin FUNCTION DSLSLRS "4.170     Diagnose Sekundärluftsystem mit stetiger Lambdaregelung" /end FUNCTION
/begin FUNCTION DSLVE "13.20     Diagnose; Plausibilitätsprüfung Sekundärluftventil-Endstufe" /end FUNCTION
/begin FUNCTION DSWEC "5.11      Schlechtwegerk. aus Rad-Beschl.,-> mittels CAN von ABS SG zu Motronic" /end FUNCTION
/begin FUNCTION DTEV "32.100    Diagnose Tankentlüftungsventil (OBDII)" /end FUNCTION
/begin FUNCTION DTEVE "9.30      Diagnose; Tankentlüftungsventil - Endstufe" /end FUNCTION
/begin FUNCTION DTIP "1.30      OBDII; Tester-Interface Package" /end FUNCTION
/begin FUNCTION DTOP "2.10      Diagnose; Betriebszeit" /end FUNCTION
/begin FUNCTION DTRIG "1.10      OBDII; Auswählbare Trigger für Fehlerpfad-Management" /end FUNCTION
/begin FUNCTION DUF "6.10      Diagnose aus der Funktionsüberwachung" /end FUNCTION
/begin FUNCTION DUMMY_D "" /end FUNCTION
/begin FUNCTION DUMWEX "9.10      Diagose; Erweiterte Umweltbedingumgen" /end FUNCTION
/begin FUNCTION DUR "1.20      Diagnose aus der Rechnerüberwachung" /end FUNCTION
/begin FUNCTION DVFZ "17.10     Diagnose: Plausibilitätsprüfung Fahrzeuggeschwindigkeit" /end FUNCTION
/begin FUNCTION DVS "1.70      Diagnose Ventilhubsteuerung" /end FUNCTION
/begin FUNCTION DVSE "2.10      Endstufendiagnose Ventilhubsteuerung" /end FUNCTION
/begin FUNCTION DWUC "14.20     OBDII; Erfüllung Bedingung 'warm up cycle'" /end FUNCTION
/begin FUNCTION _EEPROM "11.30     EEPROM-Behandlung" /end FUNCTION
/begin FUNCTION ESGRU "29.10     Grundeinspritzungen" /end FUNCTION
/begin FUNCTION ESNST "6.10      Einspritzung Nachstart" /end FUNCTION
/begin FUNCTION ESNWS "2.30      Nockenwellensteuerung Gemischkorrektur" /end FUNCTION
/begin FUNCTION ESSTT "20.40     Einspritzzeit Start" /end FUNCTION
/begin FUNCTION ESUK "4.30      Einspritzung Übergangskompensation" /end FUNCTION
/begin FUNCTION ESUKAS "5.20      Adaption der Übergangskompensation (mit stetiger Lambda-Regelung)" /end FUNCTION
/begin FUNCTION esvs "Gemischkorrektur bei Ventilhubsteuerung" /end FUNCTION
/begin FUNCTION ESVW "3.30      Einspritzung: Berechnung der Vorlagerungswinkel" /end FUNCTION
/begin FUNCTION ESWE "1.60      Einspritzung Schubabschalten Wiedereinsetzen" /end FUNCTION
/begin FUNCTION ESWL "15.10     Einspritzung Warmlauf" /end FUNCTION
/begin FUNCTION EVI "Interruptserviceroutinen bei Einspritzausgabe" /end FUNCTION
/begin FUNCTION FE "2.10      Füllungseingriffe" /end FUNCTION
/begin FUNCTION FGRAUS "1.10      Abschaltung Fahrgeschwindigkeitsregler" /end FUNCTION
/begin FUNCTION FGRLAMP "2.30      Instrumententafelanzeige für Fahrgeschwindigkeitsregler" /end FUNCTION
/begin FUNCTION FGRMD "2.70      Funktionslogik und Regelalgorithmus Fahrgeschwindigkeitsregler" /end FUNCTION
/begin FUNCTION FGRUE "1.10      Übersicht Fahrgeschwindigkeitsregler" /end FUNCTION
/begin FUNCTION FUEDK "21.40     Füllungssteuerung (Berechnung DK-Sollwinkel)" /end FUNCTION
/begin FUNCTION FUEDKSA "1.20      Füllungsbeeinflussung über DK, Sollwertaufbereitung" /end FUNCTION
/begin FUNCTION FUEREG "1.50      Füllungsregelung" /end FUNCTION
/begin FUNCTION GGAIRB "3.30      Gebergröße Airbag" /end FUNCTION
/begin FUNCTION GGDPG "14.30     Gebergröße: Drehzahlgeber und Phasengeber" /end FUNCTION
/begin FUNCTION GGDSAS "4.70      Gebergröße Drucksensoren außerhalb Saugrohr" /end FUNCTION
/begin FUNCTION GGDVE "2.40      Gebergrößen Drosselklappensteller" /end FUNCTION
/begin FUNCTION GGEGAS "6.60      Gebergröße Brems- und Kupplungsschalter" /end FUNCTION
/begin FUNCTION GGFGRH "7.40      Gebergrößen Bedienhebel für Fahrgeschwindigkeitsregler" /end FUNCTION
/begin FUNCTION GGFST "12.20     Gebergröße Tankfüllstand" /end FUNCTION
/begin FUNCTION GGHFM "64.10     Gebersignal HFM" /end FUNCTION
/begin FUNCTION GGKS "4.30      Gebergröße Klopfsensor" /end FUNCTION
/begin FUNCTION GGKS_MF "" /end FUNCTION
/begin FUNCTION GGLSH "3.30      Gebergröße Lambdasondensignal (Nernst-Type) hinter Kat" /end FUNCTION
/begin FUNCTION GGLSU "5.30      Gebersignal LSU" /end FUNCTION
/begin FUNCTION GGPED "4.40      Gebergröße Fahrpedal" /end FUNCTION
/begin FUNCTION GGPEDV "1.10      Aufbereitung Poti-Signale von PWG für GGPED" /end FUNCTION
/begin FUNCTION GGTFA "15.30     Gebergröße TFA Temperaturfühler Ansaugluft" /end FUNCTION
/begin FUNCTION GGTFM "40.152    Gebergröße TFM Temperaturfühler Motor (/-Kühlmittel)" /end FUNCTION
/begin FUNCTION GGTFMR "2.10      Gebergröße TFMR Temperaturfühler Motorraum" /end FUNCTION
/begin FUNCTION GGTFOL "6.30      Gebergröße TFOL Temperaturfühler (Motor-)Oel" /end FUNCTION
/begin FUNCTION GGTFUMG "5.30      Gebergröße TFUMG Temperaturfühler Umgebung (/-sluft)" /end FUNCTION
/begin FUNCTION GGTGET "2.10      Gebergröße TGET Temperatur Getriebe" /end FUNCTION
/begin FUNCTION GGUB "5.10      Gebergröße Batteriespannung, inkl.Diagnose" /end FUNCTION
/begin FUNCTION GGVFZG "13.10     Gebergröße Fahrzeuggeschwindigkeit" /end FUNCTION
/begin FUNCTION GGZDGON "1.30      Gebergröße Klemme 15" /end FUNCTION
/begin FUNCTION GK "6.30      Gemischkontrolle" /end FUNCTION
/begin FUNCTION HLSHK "3.20      Sondenheizung hinter Kat" /end FUNCTION
/begin FUNCTION HLSU "3.70      Heizung stetige Lambdasonde LSU" /end FUNCTION
/begin FUNCTION IMS "" /end FUNCTION
/begin FUNCTION INDEX_BGRBS "" /end FUNCTION
/begin FUNCTION INDEX_DCAS "" /end FUNCTION
/begin FUNCTION INDEX_DCFGRL "" /end FUNCTION
/begin FUNCTION INDEX_DCG "" /end FUNCTION
/begin FUNCTION INDEX_DCGE "" /end FUNCTION
/begin FUNCTION INDEX_DCKBI "" /end FUNCTION
/begin FUNCTION INDEX_DCMIL "" /end FUNCTION
/begin FUNCTION INDEX_DDG "" /end FUNCTION
/begin FUNCTION INDEX_DDVE "" /end FUNCTION
/begin FUNCTION INDEX_DEKON "" /end FUNCTION
/begin FUNCTION INDEX_DFPM "" /end FUNCTION
/begin FUNCTION INDEX_DHFM "" /end FUNCTION
/begin FUNCTION INDEX_DHLSHK "" /end FUNCTION
/begin FUNCTION INDEX_DHLSU "" /end FUNCTION
/begin FUNCTION INDEX_DKAT "" /end FUNCTION
/begin FUNCTION INDEX_DKRNT "" /end FUNCTION
/begin FUNCTION INDEX_DKRS "" /end FUNCTION
/begin FUNCTION INDEX_DKRTP "" /end FUNCTION
/begin FUNCTION INDEX_DKUPPL "" /end FUNCTION
/begin FUNCTION INDEX_DKVS "" /end FUNCTION
/begin FUNCTION INDEX_DLDR "" /end FUNCTION
/begin FUNCTION INDEX_DLLR "" /end FUNCTION
/begin FUNCTION INDEX_DLSAHK "" /end FUNCTION
/begin FUNCTION INDEX_DLSH "" /end FUNCTION
/begin FUNCTION INDEX_DLSU "" /end FUNCTION
/begin FUNCTION INDEX_DLSVV "" /end FUNCTION
/begin FUNCTION INDEX_DMDMIL "" /end FUNCTION
/begin FUNCTION INDEX_DNWKW "" /end FUNCTION
/begin FUNCTION INDEX_DNWS "" /end FUNCTION
/begin FUNCTION INDEX_DPH "" /end FUNCTION
/begin FUNCTION INDEX_DSGEEP "" /end FUNCTION
/begin FUNCTION INDEX_DSLSLRS "" /end FUNCTION
/begin FUNCTION INDEX_DTEV "" /end FUNCTION
/begin FUNCTION INDEX_DUF "" /end FUNCTION
/begin FUNCTION INDEX_DUMMY043 "" /end FUNCTION
/begin FUNCTION INDEX_DUR "" /end FUNCTION
/begin FUNCTION INDEX_DVFZ "" /end FUNCTION
/begin FUNCTION INDEX_DVS "" /end FUNCTION
/begin FUNCTION INDEX_EGFE "" /end FUNCTION
/begin FUNCTION INDEX_GGAIRBAG "" /end FUNCTION
/begin FUNCTION INDEX_GGDSAS "" /end FUNCTION
/begin FUNCTION INDEX_GGEGAS "" /end FUNCTION
/begin FUNCTION INDEX_GGPED "" /end FUNCTION
/begin FUNCTION INDEX_GGTFA "" /end FUNCTION
/begin FUNCTION INDEX_GGTFM "" /end FUNCTION
/begin FUNCTION INDEX_GGTFMR "" /end FUNCTION
/begin FUNCTION INDEX_GGTFOL "" /end FUNCTION
/begin FUNCTION INDEX_GGTFUMG "" /end FUNCTION
/begin FUNCTION INDEX_GGTGET "" /end FUNCTION
/begin FUNCTION INDEX_GGUB "" /end FUNCTION
/begin FUNCTION INDEX_MDKOG "" /end FUNCTION
/begin FUNCTION INDEX_MLS "" /end FUNCTION
/begin FUNCTION INDEX_WFS "" /end FUNCTION
/begin FUNCTION keycheck "" /end FUNCTION
/begin FUNCTION KHMD "1.80      Berechnung Reservemoment für Katheizen" /end FUNCTION
/begin FUNCTION KOLS "5.10      Information Klimakompressor-Last/-Leistung" /end FUNCTION
/begin FUNCTION KOS "112.30    Klimakompressor - Steuerung" /end FUNCTION
/begin FUNCTION KRDY "19.20     Klopfregelung Dynamik" /end FUNCTION
/begin FUNCTION KRKE "11.30     Klopferkennung" /end FUNCTION
/begin FUNCTION KRRA "10.50     Klopfregelung mit Adaption der zylinderindividuellen Spätverstellung" /end FUNCTION
/begin FUNCTION KVA "42.30     Ausgangssignal: Kraftstoff-Verbrauchs-Anzeige" /end FUNCTION
/begin FUNCTION KWP2000F "" /end FUNCTION
/begin FUNCTION KWPSTDA "" /end FUNCTION
/begin FUNCTION LAKH "4.40      Lambda-Koordination bei Katheizen" /end FUNCTION
/begin FUNCTION LAMBTS "2.40      Lambda Bauteileschutz" /end FUNCTION
/begin FUNCTION LAMFAW "2.30      Lambda Fahrerwunsch" /end FUNCTION
/begin FUNCTION LAMKO "3.150     Lambdakoordination" /end FUNCTION
/begin FUNCTION LDOB "31.10     LDR Overboost" /end FUNCTION
/begin FUNCTION LDRLMX "6.60      Berechnung LDR Maximalfuellung rlmax" /end FUNCTION
/begin FUNCTION LDRPID "23.10     LDR PID-Regler" /end FUNCTION
/begin FUNCTION LDRPLS "2.30      Berechnung Druckabfall für LDR-Sollwert" /end FUNCTION
/begin FUNCTION LDTVMA "21.10     Aufbereitung und Ausgabe Tastverhältnis" /end FUNCTION
/begin FUNCTION LDUVST "2.70      LDR-Schubumluftventilsteuerung" /end FUNCTION
/begin FUNCTION LLRBB "4.10      Leerlaufregelung Betriebsbedingungen" /end FUNCTION
/begin FUNCTION LLRMR "7.70      Momentenreserve Leerlaufregelung" /end FUNCTION
/begin FUNCTION LLRNS "511.40    Leerlaufregelung-Solldrehzahl" /end FUNCTION
/begin FUNCTION LLRRM "6.90      Leerlaufregelung Reglereingriff Drehmoment" /end FUNCTION
/begin FUNCTION LRA "93.40     Adaptive Vorsteuerung für Lambdaregelung" /end FUNCTION
/begin FUNCTION LRAEB "4.50      Einschaltbedingungen Gemischadaption" /end FUNCTION
/begin FUNCTION LRS "15.20     Stetige Lambdaregelung" /end FUNCTION
/begin FUNCTION LRSEB "10.70     Einschaltbedingungen stetige Lambdaregelung" /end FUNCTION
/begin FUNCTION LRSHK "7.10      Lambdaregelung (stetig) hinter Katalysator" /end FUNCTION
/begin FUNCTION LRSINI "2.20      Stetige Lambdaregelung, Koordination der Initialisierung" /end FUNCTION
/begin FUNCTION LRSKA "4.60      Stetige Lambdaregelung Zusatzfunktion Katalysator-Ausräumen" /end FUNCTION
/begin FUNCTION MCMESS_PROT "" /end FUNCTION
/begin FUNCTION MDAUTG "5.30      Berechnung des Istmomentes für die Getriebesteuerung" /end FUNCTION
/begin FUNCTION MDBAS "7.20      Berechnung der Basisgrößen für Momentenschnittstelle" /end FUNCTION
/begin FUNCTION MDBGRG "4.40      Momentenbegrenzung nach oben" /end FUNCTION
/begin FUNCTION MDBGV "1.30      Geschwindigkeitsabhängige Momentenaufbaubegrenzung" /end FUNCTION
/begin FUNCTION MDEX "2.40      MD-Koordination: ext. Eingriffe / Schnittst. zur Anzeige Kombiinstr." /end FUNCTION
/begin FUNCTION MDFAW "18.20     Fahrerwunschmoment" /end FUNCTION
/begin FUNCTION MDFUE "8.50      Sollwertvorgabe für Luftmasse aus Sollmoment" /end FUNCTION
/begin FUNCTION MDIST "10.21     Motormomentenberechnung" /end FUNCTION
/begin FUNCTION MDKOG "10.50     Drehmomentenkoordination für Gesamteingriffe" /end FUNCTION
/begin FUNCTION MDKOL "16.20     Momentenkoordination auf Füllungsebene" /end FUNCTION
/begin FUNCTION MDMAX "1.40      Berechnung maximales indiziertes Motormoment" /end FUNCTION
/begin FUNCTION MDMIN "1.50      Minimales Motormoment Koordination" /end FUNCTION
/begin FUNCTION MDNSTAB "1.10      Drehmoment: Drehzahlstabilisierung" /end FUNCTION
/begin FUNCTION MDRED1 "" /end FUNCTION
/begin FUNCTION MDTRIP "1.20      Berechnung der Momentenreserve im Kurztrip" /end FUNCTION
/begin FUNCTION MDVER "8.30      Motor-Verlustmoment" /end FUNCTION
/begin FUNCTION MDVERAD "1.50      Adaption Verlustmoment" /end FUNCTION
/begin FUNCTION MDVERB "10.30     Momentenbedarf der Nebenaggregate (z.B. Klimaanlage, sonst. Verbraucher)" /end FUNCTION
/begin FUNCTION MDWAN "12.10     Drehmomentaufnahme des Wandlers" /end FUNCTION
/begin FUNCTION MDZUL "4.10      Maximal zulässiges Moment" /end FUNCTION
/begin FUNCTION MDZW "1.120     Berechnung Moment in Sollzündwinkel" /end FUNCTION
/begin FUNCTION MLS "57.50     Motorlüfter-Steuerung" /end FUNCTION
/begin FUNCTION MOTAUS "9.20      Motor-Abstellen" /end FUNCTION
/begin FUNCTION NLDG "2.40      Notlauf Drehzahlgeber" /end FUNCTION
/begin FUNCTION NLPH "5.20      Notlauf Phasengeber" /end FUNCTION
/begin FUNCTION NMAXMD "8.90      Drehzahlbegrenzung" /end FUNCTION
/begin FUNCTION NWS "50.100    Nockenwellensteuerung" /end FUNCTION
/begin FUNCTION OBP_CAN "" /end FUNCTION
/begin FUNCTION OBP_EEP "" /end FUNCTION
/begin FUNCTION PHAS "" /end FUNCTION
/begin FUNCTION PK "" /end FUNCTION
/begin FUNCTION PROKON "18.110    Projektkonfiguration" /end FUNCTION
/begin FUNCTION RKTI "4.10      Einspritzdauerberechnung ti aus relativer Kraftstoffmasse rk" /end FUNCTION
/begin FUNCTION rstmon "Reset Monitor" /end FUNCTION
/begin FUNCTION RUNTIME "" /end FUNCTION
/begin FUNCTION SCATT "20.90     SCAN TOOL-Testerschnittstelle" /end FUNCTION
/begin FUNCTION SGAAU "3.20      Störgrößenaufschaltung AU II" /end FUNCTION
/begin FUNCTION SLS "83.80     Sekundärluftsteuerung" /end FUNCTION
/begin FUNCTION SREAKT "7.50      EGAS: Sicherheitskonzept, Fehlerreaktionen" /end FUNCTION
/begin FUNCTION SSTBER87 "" /end FUNCTION
/begin FUNCTION STA "12.20     Startautomatik" /end FUNCTION
/begin FUNCTION STACKMON "" /end FUNCTION
/begin FUNCTION STADAP "6.40      Startmengen-Adaption" /end FUNCTION
/begin FUNCTION STARTUPF "" /end FUNCTION
/begin FUNCTION STMD "5.20      Startmoment" /end FUNCTION
/begin FUNCTION SU "56.30     Saugrohrumschaltung" /end FUNCTION
/begin FUNCTION SWADP "Software-Adapter" /end FUNCTION
/begin FUNCTION SYK "" /end FUNCTION
/begin FUNCTION SYNC71 "" /end FUNCTION
/begin FUNCTION SYSYNC "3.10      System-Synchronisation" /end FUNCTION
/begin FUNCTION SY_DFPM3 "" /end FUNCTION
/begin FUNCTION T2AU "1.10      KWP2000: Abgasuntersuchung" /end FUNCTION
/begin FUNCTION T2DFA "4.30      KWP2000; Diagnosefunktion aktivieren" /end FUNCTION
/begin FUNCTION T2DVE "1.20      KWP2000: Request Service DVE-Lernen" /end FUNCTION
/begin FUNCTION T2LID "2.70      KWP2000: Read/write Data by Local Identifier" /end FUNCTION
/begin FUNCTION T2STA "1.40      KWP2000: Stellgliedansteuerung" /end FUNCTION
/begin FUNCTION TC1MOD "20.120    Testerkommunikation CARB; Mode 1" /end FUNCTION
/begin FUNCTION TC2MOD "20.70     Testerkommunikation CARB; Mode 2" /end FUNCTION
/begin FUNCTION TC5MOD "20.30     Testerkommunikation CARB; Mode 5, Ausgabe Sondenmeßwerte" /end FUNCTION
/begin FUNCTION TC6MOD "22.70     Testerkommunikation CARB/EOBD; Mode/Service 6, Ausgabe Prüfschwellen" /end FUNCTION
/begin FUNCTION TC8MOD "20.20     Testerkommunikation CARB; Mode 8, Funktionsaktivierungen" /end FUNCTION
/begin FUNCTION TC9MOD "11.10     Testerkommunikation CARB; Mode 9, Request Vehicle Information" /end FUNCTION
/begin FUNCTION TCSORT "3.30      Testerkommunikation CARB; Sortierfunktion" /end FUNCTION
/begin FUNCTION TEB "95.60     Tankentlüftung beladungsabhängig" /end FUNCTION
/begin FUNCTION TEBEB "4.70      Einschaltbedingungen Tankentlüftung" /end FUNCTION
/begin FUNCTION TEMPKON "3.10      Temperatur-Konvertermodul" /end FUNCTION
/begin FUNCTION TIMU "Timerumschaltung im Start bei Einspritzausgabe" /end FUNCTION
/begin FUNCTION TN "3.10      Drehzahlmesser Signal" /end FUNCTION
/begin FUNCTION TNOT "" /end FUNCTION
/begin FUNCTION TREV_OV "" /end FUNCTION
/begin FUNCTION UFEING "4.10      EGAS Überwachungskonzept: Eing.sig.überw. für Funktionsüberwachung" /end FUNCTION
/begin FUNCTION UFEINS "" /end FUNCTION
/begin FUNCTION UFFGRC "1.30      EGAS Überwachungskonzept: FGR-Überwachung der Funktionsüberwachung" /end FUNCTION
/begin FUNCTION UFFGRE "9.40      EGAS Überwachungskonzept: FGR-Eingangsinfos für die Funktionsüberwachung" /end FUNCTION
/begin FUNCTION UFMIST "2.10      EGAS Überwachungskonzept: Ist-Moment der Funktionsüberwachung" /end FUNCTION
/begin FUNCTION UFMSRC "14.10     EGAS Überwachungskonzept: MSR-Eingriff-Überwachung für die Funktionsüberwachung" /end FUNCTION
/begin FUNCTION UFMVER "2.10      EGAS Überwachungskonzept: Momentenvergleich der Funktionsüberwachung" /end FUNCTION
/begin FUNCTION UFMZF "1.10      EGAS Überwachungskonzept: Momentenfilter für die Funktionsüberwachung" /end FUNCTION
/begin FUNCTION UFMZUL "5.10      EGAS Überwachungskonzept: zulässiges Moment der Funktionsüberwachung" /end FUNCTION
/begin FUNCTION UFNC "3.10      EGAS Überwachungskonzept: N-Überwachung für die Funktionsüberwachung" /end FUNCTION
/begin FUNCTION UFNSC "2.10      EGAS Überwachungskonzept: Nachstartüberwachung für die Funktionsüberwachung" /end FUNCTION
/begin FUNCTION UFREAC "4.30      EGAS Überwachungskonzept: Fehlerreaktionsüberw.d.Funktionsüberwachung" /end FUNCTION
/begin FUNCTION UFRLC "5.10      EGAS Überwachungskonzept: Lastsignalüberw. für Funktionsüberwachung" /end FUNCTION
/begin FUNCTION UFSPSC "3.11      EGAS Überwachungskonzept: Pedal-Sollwert-Ü. für Funktionsüberwachung" /end FUNCTION
/begin FUNCTION UFURAM "" /end FUNCTION
/begin FUNCTION UFZWC "2.20      EGAS Überwachungskonzept: ZW-Überwachung für Funktionsüberwachung" /end FUNCTION
/begin FUNCTION UMKOMF "" /end FUNCTION
/begin FUNCTION URADCC "2.20      EGAS Überwachungskonzept: AD-Wandler-Test" /end FUNCTION
/begin FUNCTION URAUSG "" /end FUNCTION
/begin FUNCTION URCAUS "" /end FUNCTION
/begin FUNCTION URCEIN "" /end FUNCTION
/begin FUNCTION URCEINS "" /end FUNCTION
/begin FUNCTION URCFGRC "" /end FUNCTION
/begin FUNCTION URCMIST "" /end FUNCTION
/begin FUNCTION URCMSRC "" /end FUNCTION
/begin FUNCTION URCMVER "" /end FUNCTION
/begin FUNCTION URCMZF "" /end FUNCTION
/begin FUNCTION URCMZUL "" /end FUNCTION
/begin FUNCTION URCRAM "" /end FUNCTION
/begin FUNCTION URCREAC "" /end FUNCTION
/begin FUNCTION URCREF "" /end FUNCTION
/begin FUNCTION URDELAY "" /end FUNCTION
/begin FUNCTION URMEM "3.10      EGAS Überwachungskonzept: Zyklischer Speichertest" /end FUNCTION
/begin FUNCTION URROM "2.20      EGAS Überwachungskonzept: ROM-Test" /end FUNCTION
/begin FUNCTION V7804X_T "" /end FUNCTION
/begin FUNCTION VHW "" /end FUNCTION
/begin FUNCTION VMAXMD "1.30      Drehmomentanforderung von VMAX-Regelung" /end FUNCTION
/begin FUNCTION VS "1.100     Ventilhubsteuerung" /end FUNCTION
/begin FUNCTION VSST "2.10      Ventilhubumschaltung Timing für Schaltventile" /end FUNCTION
/begin FUNCTION VS_VERST "2.40      Verstellparameter für McMess" /end FUNCTION
/begin FUNCTION WANWKW "13.30     Winkeladaption der Nockenwelle zur Kurbelwelle" /end FUNCTION
/begin FUNCTION WFS "22.20     Wegfahrsperre" /end FUNCTION
/begin FUNCTION WK "1.10      Wandlerkupplung" /end FUNCTION
/begin FUNCTION ZIF "" /end FUNCTION
/begin FUNCTION ZUE "303.30    Grundfunktion - Zündung" /end FUNCTION
/begin FUNCTION ZUESZ "1.30      Zündung, Berechnung Schließzeit" /end FUNCTION
/begin FUNCTION ZWBTSK "1.10      Zündwinkel Bauteileschutz Kolben" /end FUNCTION
/begin FUNCTION ZWGRU "24.20     Grundzündwinkel" /end FUNCTION
/begin FUNCTION ZWMIN "3.100     Berechnung des spätest erlaubten Zündwinkels" /end FUNCTION
/begin FUNCTION ZWSTT "4.10      Zündung im Start" /end FUNCTION
/begin FUNCTION ZWVS "1.20      Zündungsrücknahme durch Ventilhubsteuerung" /end FUNCTION
/begin FUNCTION ZWWL "4.10      Warmlauf Zündwinkel" /end FUNCTION
/begin COMPU_METHOD aimv_ul_sy "" RAT_FUNC "%13.0" "" COEFFS 0 0 1 0 1.44676e-012 0 /end COMPU_METHOD
/begin COMPU_METHOD bfzg_sb_q0p217 "" RAT_FUNC "%6.3" "m/s^2" COEFFS 0 1 0 0 0 0.217 /end COMPU_METHOD
/begin COMPU_METHOD bfzg_ub_b27p67 "" RAT_FUNC "%6.3" "m/s^2" COEFFS 0 256 0 0 0 27.67 /end COMPU_METHOD
/begin COMPU_METHOD bfzg_uw_q0p1085 "" RAT_FUNC "%6.3" "m/s^2" COEFFS 0 1 0 0 0 0.1085 /end COMPU_METHOD
/begin COMPU_METHOD dez "1 : 1 Umrechnug (dez/hex)" RAT_FUNC "%6.2" "" COEFFS 0 1 0 0 0 1 /end COMPU_METHOD
/begin COMPU_METHOD dezsub1 "" RAT_FUNC "%6.2" "-" COEFFS 0 1 -1 0 0 1 /end COMPU_METHOD
/begin COMPU_METHOD dtsegn_b720divZyl "" RAT_FUNC "%6.4" "grad/KW" COEFFS 0 273.067 0 0 0 1 /end COMPU_METHOD
/begin COMPU_METHOD fak_sw_b0p0625 "" RAT_FUNC "%8.7" "-" COEFFS 0 65536 0 0 0 0.125 /end COMPU_METHOD
/begin COMPU_METHOD fak_sw_b2 "" RAT_FUNC "%7.6" "-" COEFFS 0 65536 0 0 0 4 /end COMPU_METHOD
/begin COMPU_METHOD fak_ub_b0p25 "" RAT_FUNC "%10.7" "-" COEFFS 0 256 0 0 0 0.25 /end COMPU_METHOD
/begin COMPU_METHOD fak_ub_b1 "" RAT_FUNC "%6.4" "-" COEFFS 0 256 0 0 0 1 /end COMPU_METHOD
/begin COMPU_METHOD fak_ub_b2 "" RAT_FUNC "%6.4" "-" COEFFS 0 256 0 0 0 2 /end COMPU_METHOD
/begin COMPU_METHOD nmot_ub_q40 "" RAT_FUNC "%6.1" "Upm" COEFFS 0 1 0 0 0 40 /end COMPU_METHOD
/begin COMPU_METHOD nw_dmdstp_sy "" RAT_FUNC "%6.3" "NwU" COEFFS 0 6 0 0 0 1 /end COMPU_METHOD
/begin COMPU_METHOD rel_ub_q0p3906 "" RAT_FUNC "%6.3" "%" COEFFS 0 256 0 0 0 100 /end COMPU_METHOD
/begin COMPU_METHOD spg_ub_b24 "" RAT_FUNC "%6.3" "1/V" COEFFS 0 1 0 0 0 0.09362 /end COMPU_METHOD
/begin COMPU_METHOD t10msxs_ub_b2p55 "" RAT_FUNC "%6.4" "s" COEFFS 0 1 0 0 0 0.01 /end COMPU_METHOD
/begin COMPU_METHOD t1sxs_uw_q1 "" RAT_FUNC "%6.2" "s" COEFFS 0 1 0 0 0 1 /end COMPU_METHOD
/begin COMPU_METHOD t20usxus_q20 "" RAT_FUNC "%6.1" "us" COEFFS 0 1 0 0 0 20 /end COMPU_METHOD
/begin COMPU_METHOD t40ms_ub_b10200 "" RAT_FUNC "%7.2" "ms" COEFFS 0 1 0 0 0 40 /end COMPU_METHOD
/begin COMPU_METHOD t50msxs_uw_b3276p75 "" RAT_FUNC "%6.4" "s" COEFFS 0 1 0 0 0 0.05 /end COMPU_METHOD
/begin COMPU_METHOD temp_q5 "" RAT_FUNC "%6.2" "Grad C" COEFFS 0 1 0 0 0 5 /end COMPU_METHOD
/begin COMPU_METHOD temp_ub_q0p75_o48 "" RAT_FUNC "%6.2" "Grad C" COEFFS 0 1 48 0 0 0.75 /end COMPU_METHOD
/begin COMPU_METHOD temp_ub_q5_o50 "" RAT_FUNC "%6.2" "Grad C" COEFFS 0 1 50 0 0 5 /end COMPU_METHOD
/begin COMPU_METHOD vfzg_uw_b512 "" RAT_FUNC "%6.4" "km/h" COEFFS 0 65536 0 0 0 512 /end COMPU_METHOD
/begin COMPU_METHOD zue_dmdstp "" RAT_FUNC "%6.2" "Zuendungen" COEFFS 0 1 0 0 0 1 /end COMPU_METHOD
/begin RECORD_LAYOUT GklWUb FNC_VALUES 1 UBYTE COLUMN_DIR DIRECT /end RECORD_LAYOUT
/begin RECORD_LAYOUT GklWUw FNC_VALUES 1 UWORD COLUMN_DIR DIRECT /end RECORD_LAYOUT
/begin RECORD_LAYOUT KlAUbSstUbWSb NO_AXIS_PTS_X 1 UBYTE AXIS_PTS_X 2 UBYTE INDEX_INCR DIRECT FNC_VALUES 3 SBYTE COLUMN_DIR DIRECT /end RECORD_LAYOUT
/begin RECORD_LAYOUT KlAUbSstUbWUb NO_AXIS_PTS_X 1 UBYTE AXIS_PTS_X 2 UBYTE INDEX_INCR DIRECT FNC_VALUES 3 UBYTE COLUMN_DIR DIRECT /end RECORD_LAYOUT
/begin RECORD_LAYOUT KlAUwSstUwWUw NO_AXIS_PTS_X 1 UWORD AXIS_PTS_X 2 UWORD INDEX_INCR DIRECT FNC_VALUES 3 UWORD COLUMN_DIR DIRECT /end RECORD_LAYOUT
/begin RECORD_LAYOUT KwbUb FNC_VALUES 1 UBYTE COLUMN_DIR DIRECT /end RECORD_LAYOUT
/begin RECORD_LAYOUT KwbUw FNC_VALUES 1 UWORD COLUMN_DIR DIRECT /end RECORD_LAYOUT
/begin RECORD_LAYOUT KwSb FNC_VALUES 1 SBYTE COLUMN_DIR DIRECT /end RECORD_LAYOUT
/begin RECORD_LAYOUT KwSw FNC_VALUES 1 SWORD COLUMN_DIR DIRECT /end RECORD_LAYOUT
/begin RECORD_LAYOUT KwUb FNC_VALUES 1 UBYTE COLUMN_DIR DIRECT /end RECORD_LAYOUT
/begin RECORD_LAYOUT KwUl FNC_VALUES 1 ULONG COLUMN_DIR DIRECT /end RECORD_LAYOUT
/begin RECORD_LAYOUT KwUw FNC_VALUES 1 UWORD COLUMN_DIR DIRECT /end RECORD_LAYOUT
/begin RECORD_LAYOUT SstAUbSstUb NO_AXIS_PTS_X 1 UBYTE AXIS_PTS_X 2 UBYTE INDEX_INCR DIRECT /end RECORD_LAYOUT
/begin RECORD_LAYOUT SstAUwSstUw NO_AXIS_PTS_X 1 UWORD AXIS_PTS_X 2 UWORD INDEX_INCR DIRECT /end RECORD_LAYOUT
/end MODULE
/end PROJECT
