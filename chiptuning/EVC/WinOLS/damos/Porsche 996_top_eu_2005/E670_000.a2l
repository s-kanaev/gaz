/begin PROJECT _7804367 "156"
/begin HEADER "" VERSION "_7804367" PROJECT_NO _7804367 /end HEADER
/begin MODULE DIM ""
/begin MOD_COMMON "" BYTE_ORDER BIG_ENDIAN S_REC_LAYOUT DAMOS /end MOD_COMMON
/begin AXIS_PTS SML06TEUB "ml abhängige Stützstellen (Anzahl 6)" 0x818023 ml SstAUbSstUb 1020. m_ub_b1020 6 0.00 1020. FUNCTION_LIST SSTBER87 TEB DEPOSIT ABSOLUT IF_DATA DIM_X DIRECT 0x818023 /end AXIS_PTS
/begin AXIS_PTS SML07TMUW "Stützstellenverteilung, Luftmasse, 7 Stützstellen" 0x819F9A ml_w SstAUwSstUw 6553.500 m_uw_b6553p5 7 0.00 6553.500 FUNCTION_LIST SSTBER87 ATM DEPOSIT ABSOLUT IF_DATA DIM_X DIRECT 0x819F9A /end AXIS_PTS
/begin AXIS_PTS SNM08GKUB "Stützstellenverteilung Gemischkontrolle 8 nmot Stützstellen" 0x818BE2 nmot SstAUbSstUb 10200. nmot_ub_q40 8 0.00 10200. FUNCTION_LIST ESVW DEPOSIT ABSOLUT IF_DATA DIM_X DIRECT 0x818BE2 /end AXIS_PTS
/begin AXIS_PTS SNM08LDUW "Stützstellenverteilung für Ladedruckregelung" 0x81360C nmot_w SstAUwSstUw 16383.75 nmot_uw_q0p25 8 0.00 16383.75 FUNCTION_LIST SSTBER87 LDRLMX LDRPID DEPOSIT ABSOLUT IF_DATA DIM_X DIRECT 0x81360C /end AXIS_PTS
/begin AXIS_PTS SNM08__UB "Stützstellenverteilung Drehzahl, 8 Sst." 0x8100BB nmot SstAUbSstUb 10200. nmot_ub_q40 8 0.00 10200. FUNCTION_LIST SSTBER87 BBSAWE ZUE DEPOSIT ABSOLUT IF_DATA DIM_X DIRECT 0x8100BB /end AXIS_PTS
/begin AXIS_PTS SNM12FEUB "Stützstellen für WDKSMX, WDKUGDN" 0x8100E7 nmot SstAUbSstUb 10200. nmot_ub_q40 12 0.00 10200. FUNCTION_LIST SSTBER87 BGMSZS MDFUE DEPOSIT ABSOLUT IF_DATA DIM_X DIRECT 0x8100E7 /end AXIS_PTS
/begin AXIS_PTS SNM16KRUB "Stützstellenverteilung Drehzahl, 16 Sst." 0x81806C nmot SstAUbSstUb 10200. nmot_ub_q40 16 0.00 10200. FUNCTION_LIST SSTBER87 DKRS GGKS KRDY KRKE KRRA DEPOSIT ABSOLUT IF_DATA DIM_X DIRECT 0x81806C /end AXIS_PTS
/begin AXIS_PTS STM05SAUB "Stützstellenverteilung" 0x8180BB tmot SstAUbSstUb 191.3 temp_ub_q0p75_o48 5 -48.00 143.3 FUNCTION_LIST SSTBER87 BBSAWE DEPOSIT ABSOLUT IF_DATA DIM_X DIRECT 0x8180BB /end AXIS_PTS
/begin AXIS_PTS STM09ESUB "Stützstellenverteilung Motortemperatur, 9 Sst." 0x8180D8 tmot SstAUbSstUb 191.3 temp_ub_q0p75_o48 9 -48.00 143.3 FUNCTION_LIST SSTBER87 ESUK DEPOSIT ABSOLUT IF_DATA DIM_X DIRECT 0x8180D8 /end AXIS_PTS
/begin AXIS_PTS STW06MDUB "6 twan-Stützstellen für ?" 0x8197B9 twan_kge SstAUbSstUb 255.0 temp_ub_q1_o50 6 -50.00 205.0 FUNCTION_LIST MDWAN DEPOSIT ABSOLUT IF_DATA DIM_X DIRECT 0x8197B9 /end AXIS_PTS
/begin CHARACTERISTIC TMIGSL "Zeitdauer für Eingriff Luftpfad bei Getriebeeingriff" CURVE 0x813800 KlAUwSstUwWUw 655.3500 t10msxs_uw_b655p35 0.00 655.3500 FUNCTION_LIST MDEX IF_DATA DIM_X DIRECT 0x813800 /begin AXIS_DESCR STD_AXIS ml_w m_uw_b6553p5 8 0.00 6553.500 DEPOSIT ABSOLUT /end AXIS_DESCR /end CHARACTERISTIC
/begin CHARACTERISTIC TMINKAT "Minimale Kat-Temperatur für Überwachung" VALUE 0x8183DD KwUb 1275. temp_ub_q5_o50 -50.00 1225. FUNCTION_LIST DKATLRS IF_DATA DIM_X DIRECT 0x8183DD /end CHARACTERISTIC
/begin CHARACTERISTIC TMK "Motortemperatur - Schwelle kalt" VALUE 0x811330 KwUb 191.3 temp_ub_q0p75_o48 -48.00 143.3 FUNCTION_LIST ESSTT IF_DATA DIM_X DIRECT 0x811330 /end CHARACTERISTIC
/begin CHARACTERISTIC TMKOAO "Obere Motortemperaturschwelle für Kompressorabschaltung" VALUE 0x812BAA KwUb 191.3 temp_ub_q0p75_o48 -48.00 143.3 FUNCTION_LIST KOS IF_DATA DIM_X DIRECT 0x812BAA /end CHARACTERISTIC
/begin CHARACTERISTIC TMKOAU "Untere Motortemperaturschwelle für Kompressorabschaltung" VALUE 0x812BAB KwUb 191.3 temp_ub_q0p75_o48 -48.00 143.3 FUNCTION_LIST KOS IF_DATA DIM_X DIRECT 0x812BAB /end CHARACTERISTIC
/begin CHARACTERISTIC TMKOM "Motortemperaturschwelle zur Ansteuerung Kombi-Warnleuchte" VALUE 0x8197F7 KwUb 191.3 temp_ub_q0p75_o48 -48.00 143.3 FUNCTION_LIST MLS IF_DATA DIM_X DIRECT 0x8197F7 /end CHARACTERISTIC
/begin CHARACTERISTIC TMKR "Motortemperaturschwelle für Klopfregelung aktiv" VALUE 0x819332 KwUb 191.3 temp_ub_q0p75_o48 -48.00 143.3 FUNCTION_LIST KRRA GGKS IF_DATA DIM_X DIRECT 0x819332 /end CHARACTERISTIC
/begin CHARACTERISTIC TMKRA "Motortemperaturschwelle für adaptive Klopfregelung" VALUE 0x819333 KwUb 191.3 temp_ub_q0p75_o48 -48.00 143.3 FUNCTION_LIST KRRA IF_DATA DIM_X DIRECT 0x819333 /end CHARACTERISTIC
/begin CHARACTERISTIC TMLAST "Sperrzeit bis zum Auslösen des Ini der AR beim Verzögern" VALUE 0x8116AC KwUb 2.550 t10msxs_ub_b2p55 0.00 2.550 FUNCTION_LIST ARMD IF_DATA DIM_X DIRECT 0x8116AC /end CHARACTERISTIC
/begin CHARACTERISTIC TMLF1 "Motortemperaturschwelle 1 für Motorlüftersteuerung" VALUE 0x8197F8 KwUb 191.3 temp_ub_q0p75_o48 -48.00 143.3 FUNCTION_LIST MLS IF_DATA DIM_X DIRECT 0x8197F8 /end CHARACTERISTIC
/begin CHARACTERISTIC TMLF2 "Motortemperaturschwelle 2 für Motorlüftersteuerung" VALUE 0x8197F9 KwUb 191.3 temp_ub_q0p75_o48 -48.00 143.3 FUNCTION_LIST MLS IF_DATA DIM_X DIRECT 0x8197F9 /end CHARACTERISTIC
/begin CHARACTERISTIC TMLF3 "Motortemperaturschwelle 3 für Motorlüftersteuerung" VALUE 0x8197FA KwUb 191.3 temp_ub_q0p75_o48 -48.00 143.3 FUNCTION_LIST MLS IF_DATA DIM_X DIRECT 0x8197FA /end CHARACTERISTIC
/begin CHARACTERISTIC TMLIM "TMOT Schwelle für  KSTAA aktiv im Nachstart" VALUE 0x811461 KwUb 191.3 temp_ub_q0p75_o48 -48.00 143.3 FUNCTION_LIST STADAP IF_DATA DIM_X DIRECT 0x811461 /end CHARACTERISTIC
/begin CHARACTERISTIC TMLRTMS "Motortemperaturschwelle für LR ein abh. von Starttemperatur" CURVE 0x819050 KlAUbSstUbWUb 191.3 temp_ub_q0p75_o48 -48.00 143.3 FUNCTION_LIST GGTFM IF_DATA DIM_X DIRECT 0x819050
 /begin AXIS_DESCR STD_AXIS tmst temp_ub_q0p75_o48 4 -48.00 143.3 DEPOSIT ABSOLUT /end AXIS_DESCR
/end CHARACTERISTIC
/begin CHARACTERISTIC TMMDBGV "Motortemperaturschwelle für geschw.-abhängige Momentenaufbaubegrenzung" VALUE 0x811B46 KwUb 191.3 temp_ub_q0p75_o48 -48.00 143.3 FUNCTION_LIST MDBGV IF_DATA DIM_X DIRECT 0x811B46 /end CHARACTERISTIC
/begin CHARACTERISTIC TMMIBGR "tmot-Schwelle für Freigabe Momentenbegrenzung" VALUE 0x819806 KwUb 191.3 temp_ub_q0p75_o48 -48.00 143.3 FUNCTION_LIST MDBGRG IF_DATA DIM_X DIRECT 0x819806 /end CHARACTERISTIC
/begin CHARACTERISTIC TMMSG "Motortemperaturschwelle für Motorraumspülgebläse" VALUE 0x8197FB KwUb 191.3 temp_ub_q0p75_o48 -48.00 143.3 FUNCTION_LIST MLS IF_DATA DIM_X DIRECT 0x8197FB /end CHARACTERISTIC
/begin CHARACTERISTIC TMMXGET "Motortemperaturschwelle für Ausblendung Diagnose TGET" VALUE 0x8190F1 KwUb 191.3 temp_ub_q0p75_o48 -48.00 143.3 FUNCTION_LIST GGTGET IF_DATA DIM_X DIRECT 0x8190F1 /end CHARACTERISTIC
/begin CHARACTERISTIC TMMXRT "max. Motortemperatur f. Retrigg. Modelle (Blockheater-Erkennung)" VALUE 0x819059 KwUb 191.3 temp_ub_q0p75_o48 -48.00 143.3 FUNCTION_LIST GGTFM IF_DATA DIM_X DIRECT 0x819059 /end CHARACTERISTIC
/begin CHARACTERISTIC TMNKATT "Minimale Kat-Temperatur für Überwachung bei Testerbetrieb" VALUE 0x8183DE KwUb 1275. temp_ub_q5_o50 -50.00 1225. FUNCTION_LIST DKATLRS T2DFA T2LID IF_DATA DIM_X DIRECT 0x8183DE /end CHARACTERISTIC
/begin CHARACTERISTIC TMNMSG "Mindestmotorbetriebszeit für Motorraumspülgebläsesteuerung" VALUE 0x81DAF8 KwUw 655.3500 t10msxs_uw_b655p35 0.00 655.3500 FUNCTION_LIST MLS IF_DATA DIM_X DIRECT 0x81DAF8 /end CHARACTERISTIC
/begin CHARACTERISTIC TMNSMN "Motortemperaturschwelle für die Nachstartaufweitung" VALUE 0x811C1F KwUb 191.3 temp_ub_q0p75_o48 -48.00 143.3 FUNCTION_LIST MDZUL IF_DATA DIM_X DIRECT 0x811C1F /end CHARACTERISTIC
/begin CHARACTERISTIC TMNSMN_UM "Motortemperaturschwelle für die Nachstartaufweitung in der FKT.-Überwachung" VALUE 0x817D10 KwUb 191.3 temp_ub_q0p75_o48 -48.00 143.3 FUNCTION_LIST UFNSC IF_DATA DIM_X DIRECT 0x817D10 /end CHARACTERISTIC
/begin CHARACTERISTIC TMNUUKA "Minimalzeit zwischen 2 Adaptionsvorgängen (ÜK-Adaption)" VALUE 0x81134A KwUb 1.850 t10msxs_ub_b2p55 0.7000 2.550 FUNCTION_LIST ESUKAS IF_DATA DIM_X DIRECT 0x81134A /end CHARACTERISTIC
/begin CHARACTERISTIC TMOTELI "Temperatur Motor Erfassung u. Linearisierung, Inverskennlinie" CURVE 0x81CF20 KlAUwSstUwWUw 191.9970 temp_uw_q0p75_o48 -48.00000 143.9970 FUNCTION_LIST GGTFM IF_DATA DIM_X DIRECT 0x81CF20
 /begin AXIS_DESCR STD_AXIS wtmot_w spg_q0p00488 20 0.00 319.9951 DEPOSIT ABSOLUT /end AXIS_DESCR
/end CHARACTERISTIC
/begin CHARACTERISTIC TMOTNLDG "Temperaturschwelle für Drehzahlgeber-Notlauf" VALUE 0x8181B9 KwUb 191.3 temp_ub_q0p75_o48 -48.00 143.3 FUNCTION_LIST DDG IF_DATA DIM_X DIRECT 0x8181B9 /end CHARACTERISTIC
/begin CHARACTERISTIC TMOTOB "obere Temperaturschwelle Ansteuerung KWAV" VALUE 0x819DBC KwUb 191.3 temp_ub_q0p75_o48 -48.00 143.3 FUNCTION_LIST AKWAV IF_DATA DIM_X DIRECT 0x819DBC /end CHARACTERISTIC
/begin CHARACTERISTIC TMOTSH "Motortemperaturschwelle für die Sondenheizung LSU" VALUE 0x8121B2 KwUb 191.3 temp_ub_q0p75_o48 -48.00 143.3 FUNCTION_LIST HLSU IF_DATA DIM_X DIRECT 0x8121B2 /end CHARACTERISTIC
/begin CHARACTERISTIC TMOTU "untere Temperaturschwelle Ansteuerung KWAV" VALUE 0x819DBD KwUb 191.3 temp_ub_q0p75_o48 -48.00 143.3 FUNCTION_LIST AKWAV IF_DATA DIM_X DIRECT 0x819DBD /end CHARACTERISTIC
/begin CHARACTERISTIC TMOTWRM "Motortemperatur für warmen Motor" VALUE 0x81862B KwUb 191.3 temp_ub_q0p75_o48 -48.00 143.3 FUNCTION_LIST BGTMPK IF_DATA DIM_X DIRECT 0x81862B /end CHARACTERISTIC
/begin CHARACTERISTIC TMPUPOFF "untere Motortemperaturschwelle für pullup-Abschaltung" VALUE 0x81905A KwUb 191.3 temp_ub_q0p75_o48 -48.00 143.3 FUNCTION_LIST GGTFM IF_DATA DIM_X DIRECT 0x81905A /end CHARACTERISTIC
/begin CHARACTERISTIC TMPUPON "obere Motortemperaturschwelle für pullup-Zuschaltung" VALUE 0x81905B KwUb 191.3 temp_ub_q0p75_o48 -48.00 143.3 FUNCTION_LIST GGTFM IF_DATA DIM_X DIRECT 0x81905B /end CHARACTERISTIC
/begin CHARACTERISTIC TMQSYN "Motortemperaturschwelle zur Freigabe PG-Schnellstart" VALUE 0x810C04 KwUb 191.3 temp_ub_q0p75_o48 -48.00 143.3 FUNCTION_LIST GGDPG IF_DATA DIM_X DIRECT 0x810C04 /end CHARACTERISTIC
/begin CHARACTERISTIC TMRA1 "Ausschaltbedingung (S_LL = 0)" VALUE 0x812130 KwUb 191.3 temp_ub_q0p75_o48 -48.00 143.3 FUNCTION_LIST LRSEB IF_DATA DIM_X DIRECT 0x812130 /end CHARACTERISTIC
/begin CHARACTERISTIC TMRA2 "Ausschaltbedingung (S_LL = 1)" VALUE 0x812131 KwUb 191.3 temp_ub_q0p75_o48 -48.00 143.3 FUNCTION_LIST LRSEB IF_DATA DIM_X DIRECT 0x812131 /end CHARACTERISTIC
/begin CHARACTERISTIC TMRAA "Einschalttemperatur LRA" VALUE 0x811417 KwUb 191.3 temp_ub_q0p75_o48 -48.00 143.3 FUNCTION_LIST LRAEB IF_DATA DIM_X DIRECT 0x811417 /end CHARACTERISTIC
/begin CHARACTERISTIC TMRAK "Ausschaltschwelle der Lambda - Regelung bei niedriger Starttemperatur" VALUE 0x812132 KwUb 191.3 temp_ub_q0p75_o48 -48.00 143.3 FUNCTION_LIST LRSEB IF_DATA DIM_X DIRECT 0x812132 /end CHARACTERISTIC
/begin CHARACTERISTIC TMRDMN "untere Diagnoseschwelle Motorraumtemperatur" VALUE 0x811482 KwUb 191.3 temp_ub_q0p75_o48 -48.00 143.3 FUNCTION_LIST GGTFMR IF_DATA DIM_X DIRECT 0x811482 /end CHARACTERISTIC
/begin CHARACTERISTIC TMRDMX "obere Diagnoseschwelle Motorraumtemperatur" VALUE 0x811483 KwUb 191.3 temp_ub_q0p75_o48 -48.00 143.3 FUNCTION_LIST GGTFMR IF_DATA DIM_X DIRECT 0x811483 /end CHARACTERISTIC
/begin CHARACTERISTIC TMRELI "Temperatur Motorraum, Erfassung u. Linearisierung, Inverskennlinie" CURVE 0x81906B KlAUbSstUbWUb 191.3 temp_ub_q0p75_o48 -48.00 143.3 FUNCTION_LIST GGTFMR IF_DATA DIM_X DIRECT 0x81906B /begin AXIS_DESCR STD_AXIS wtmr spg_ub_b5 15 0.00 4.980 DEPOSIT ABSOLUT /end AXIS_DESCR /end CHARACTERISTIC
/begin CHARACTERISTIC TMRMGOF "Motorraumtemperaturschwelle: Aktivierung Fkt. Fehlerinfolampe Motorraumspülgebl." VALUE 0x8197FC KwUb 191.3 temp_ub_q0p75_o48 -48.00 143.3 FUNCTION_LIST MLS IF_DATA DIM_X DIRECT 0x8197FC /end CHARACTERISTIC
/begin CHARACTERISTIC TMRMSG "Motorraumtemperaturschwelle für Motorraumspülgebläse" VALUE 0x8197FD KwUb 191.3 temp_ub_q0p75_o48 -48.00 143.3 FUNCTION_LIST MLS IF_DATA DIM_X DIRECT 0x8197FD /end CHARACTERISTIC
/begin CHARACTERISTIC TMRMSGF "Motorraumtemperaturschwelle für Motorraumspülgebläse defekt" VALUE 0x8197FE KwSb 191.3 temp_sb_q0p75 -96.00 95.25 FUNCTION_LIST MLS IF_DATA DIM_X DIRECT 0x8197FE /end CHARACTERISTIC
/begin CHARACTERISTIC TMRNLMSG "Motorraumtemperaturschwelle für Motorraumspülgebläsenachlauf" VALUE 0x8197FF KwUb 191.3 temp_ub_q0p75_o48 -48.00 143.3 FUNCTION_LIST MLS IF_DATA DIM_X DIRECT 0x8197FF /end CHARACTERISTIC
/begin CHARACTERISTIC TMRNLSG "Motorraumtemperaturschwelle für Steuergerätenachlauf" VALUE 0x819800 KwUb 191.3 temp_ub_q0p75_o48 -48.00 143.3 FUNCTION_LIST MLS IF_DATA DIM_X DIRECT 0x819800 /end CHARACTERISTIC
/begin CHARACTERISTIC TMSDTHMO "obere Motorstart-Temp.-Schwelle für Thermostatdiagnose" VALUE 0x81905C KwUb 191.3 temp_ub_q0p75_o48 -48.00 143.3 FUNCTION_LIST GGTFM IF_DATA DIM_X DIRECT 0x81905C /end CHARACTERISTIC
/begin CHARACTERISTIC TMSDTHMU "untere Motorstart-Temp.-Schwelle für Thermostatdiagnose" VALUE 0x81905D KwUb 191.3 temp_ub_q0p75_o48 -48.00 143.3 FUNCTION_LIST GGTFM IF_DATA DIM_X DIRECT 0x81905D /end CHARACTERISTIC
/begin CHARACTERISTIC TMSGD "Zeitdauer für Motorraumspülgebläse ein" VALUE 0x81DAFA KwUw 6553.500 t100msxs_uw_b6553p6 0.00 6553.500 FUNCTION_LIST MLS IF_DATA DIM_X DIRECT 0x81DAFA /end CHARACTERISTIC
/begin CHARACTERISTIC TMSGI "Abfrageintervall für Motorraumspülgebläse ein" VALUE 0x81DAFC KwUw 6553.500 t100msxs_uw_b6553p6 0.00 6553.500 FUNCTION_LIST MLS IF_DATA DIM_X DIRECT 0x81DAFC /end CHARACTERISTIC
/begin CHARACTERISTIC TMSH "Motortemperaturschwelle für Erkennung Kaltstart für Messung Sonde hinter KAT" VALUE 0x8183F8 KwUb 191.3 temp_ub_q0p75_o48 -48.00 143.3 FUNCTION_LIST DLSH IF_DATA DIM_X DIRECT 0x8183F8 /end CHARACTERISTIC
/begin CHARACTERISTIC TMSHA "Motorabstelltemperaturschwelle für Messung Abkühlung Sonde hinter KAT" VALUE 0x8183F9 KwUb 191.3 temp_ub_q0p75_o48 -48.00 143.3 FUNCTION_LIST DLSH IF_DATA DIM_X DIRECT 0x8183F9 /end CHARACTERISTIC
/begin CHARACTERISTIC TMSHS "Schwelle Motortemp. für Auslösung TLRHS - Sperrzeit LR bei Heißstart" VALUE 0x812133 KwUb 191.3 temp_ub_q0p75_o48 -48.00 143.3 FUNCTION_LIST LRSEB IF_DATA DIM_X DIRECT 0x812133 /end CHARACTERISTIC
/begin CHARACTERISTIC TMSLADAP "Sperrzeit für Wiederholung Adaption" VALUE 0x81A026 KwUw 6553.500 t100msxs_uw_b6553p5 0.00 6553.500 FUNCTION_LIST DSLSLRS IF_DATA DIM_X DIRECT 0x81A026 /end CHARACTERISTIC
/begin CHARACTERISTIC TMSLIFT "Wartezeit für für mslift-Filter (Aufbau Drehmomentenreserve)" VALUE 0x81A028 KwUw 6553.500 t100msxs_uw_b6553p5 0.00 6553.500 FUNCTION_LIST DSLSLRS IF_DATA DIM_X DIRECT 0x81A028 /end CHARACTERISTIC
/begin CHARACTERISTIC TMSLIFT1 "Wartezeit für mslift-Filter (Aufbau Drehmomentenreserve) in Phase 1" VALUE 0x81A02A KwUw 6553.500 t100msxs_uw_b6553p5 0.00 6553.500 FUNCTION_LIST DSLSLRS IF_DATA DIM_X DIRECT 0x81A02A /end CHARACTERISTIC
/begin CHARACTERISTIC TMSLIFTK "Wartezeit für mslift-Filter (Aufbau Drehmomentenreserve) in Phase 1 während Kurz" VALUE 0x81A02C KwUw 6553.500 t100msxs_uw_b6553p5 0.00 6553.500 FUNCTION_LIST DSLSLRS IF_DATA DIM_X DIRECT 0x81A02C /end CHARACTERISTIC
/begin CHARACTERISTIC TMSLOF "Motortemperaturschwelle für Sperre Sekundärluft" VALUE 0x81913B KwUb 191.3 temp_ub_q0p75_o48 -48.00 143.3 FUNCTION_LIST BBKHZ IF_DATA DIM_X DIRECT 0x81913B /end CHARACTERISTIC
/begin CHARACTERISTIC TMSNOGA "Schwelle tms für Dauerspülen nach Fahrzyklus mit erfolgter Gemischadaption" VALUE 0x818802 KwUb 191.3 temp_ub_q0p75_o48 -48.00 143.3 FUNCTION_LIST BBTEGA IF_DATA DIM_X DIRECT 0x818802 /end CHARACTERISTIC
/begin CHARACTERISTIC TMSSLO "obere Starttemperaturschwelle für Sekundärluft" VALUE 0x818176 KwUb 191.3 temp_ub_q0p75_o48 -48.00 143.3 FUNCTION_LIST SLS IF_DATA DIM_X DIRECT 0x818176 /end CHARACTERISTIC
/begin CHARACTERISTIC TMSSLSTO "obere Temperaturschwelle für Sekundärluft im Start" VALUE 0x818177 KwUb 191.3 temp_ub_q0p75_o48 -48.00 143.3 FUNCTION_LIST SLS IF_DATA DIM_X DIRECT 0x818177 /end CHARACTERISTIC
/begin CHARACTERISTIC TMSSLSTU "untere Temperaturschwelle für Sekundärluft im Start" VALUE 0x818178 KwUb 191.3 temp_ub_q0p75_o48 -48.00 143.3 FUNCTION_LIST SLS IF_DATA DIM_X DIRECT 0x818178 /end CHARACTERISTIC
/begin CHARACTERISTIC TMSSLU "untere Starttemperaturschwelle für Sekundärluft" VALUE 0x818179 KwUb 191.3 temp_ub_q0p75_o48 -48.00 143.3 FUNCTION_LIST SLS IF_DATA DIM_X DIRECT 0x818179 /end CHARACTERISTIC
/begin CHARACTERISTIC TMSTEV "Tmot-Schwelle für Stellgliedansteuerung EV" VALUE 0x818189 KwUb 191.3 temp_ub_q0p75_o48 -48.00 143.3 FUNCTION_LIST T2STA T2LID IF_DATA DIM_X DIRECT 0x818189 /end CHARACTERISTIC
/begin CHARACTERISTIC TMSUKTD "Minimale tmot-Start-Temperatur für Katdiagnose" VALUE 0x8183DF KwUb 191.3 temp_ub_q0p75_o48 -48.00 143.3 FUNCTION_LIST DKATLRS IF_DATA DIM_X DIRECT 0x8183DF /end CHARACTERISTIC
/begin CHARACTERISTIC TMSUS "Temperaturschwelle für Saugrohrumschaltung" VALUE 0x8187E2 KwUb 191.3 temp_ub_q0p75_o48 -48.00 143.3 FUNCTION_LIST SU IF_DATA DIM_X DIRECT 0x8187E2 /end CHARACTERISTIC
/begin CHARACTERISTIC TMSUSV "Temperaturschwelle für Saugrohrumschaltung mit nachgeschalteter Verzögerung" VALUE 0x8187E3 KwUb 191.3 temp_ub_q0p75_o48 -48.00 143.3 FUNCTION_LIST SU IF_DATA DIM_X DIRECT 0x8187E3 /end CHARACTERISTIC
/begin CHARACTERISTIC TMSUTMUMA "untere Tmot-Schwelle für temporäre UMA-Adaption" VALUE 0x810D3F KwUb 191.3 temp_ub_q0p75_o48 -48.00 143.3 FUNCTION_LIST BGDVE IF_DATA DIM_X DIRECT 0x810D3F /end CHARACTERISTIC
/begin CHARACTERISTIC TMTE "TMOT - Schwelle für Tankentlüftung" VALUE 0x8121F9 KwUb 191.3 temp_ub_q0p75_o48 -48.00 143.3 FUNCTION_LIST TEBEB IF_DATA DIM_X DIRECT 0x8121F9 /end CHARACTERISTIC
/begin CHARACTERISTIC TMUKAK "Temperaturbereich kalter Motor für ÜK-Adaption" VALUE 0x81134B KwUb 191.3 temp_ub_q0p75_o48 -48.00 143.3 FUNCTION_LIST ESUKAS IF_DATA DIM_X DIRECT 0x81134B /end CHARACTERISTIC
/begin CHARACTERISTIC TMUKAU "untere Motortemperatur-Grenze für ÜK-Adaption" VALUE 0x81134C KwUb 191.3 temp_ub_q0p75_o48 -48.00 143.3 FUNCTION_LIST ESUKAS IF_DATA DIM_X DIRECT 0x81134C /end CHARACTERISTIC
/begin CHARACTERISTIC TMUKAW "Temperaturbereich warmer Motor für ÜK-Adaption" VALUE 0x81134D KwUb 191.3 temp_ub_q0p75_o48 -48.00 143.3 FUNCTION_LIST ESUKAS IF_DATA DIM_X DIRECT 0x81134D /end CHARACTERISTIC
/begin CHARACTERISTIC TMVDBS "Entprellzeit Beschleunigungssignaldiagnose" VALUE 0x8121C9 KwUb 25.50 t100msxs_ub_b25p5 0.00 25.50 FUNCTION_LIST BGRBS IF_DATA DIM_X DIRECT 0x8121C9 /end CHARACTERISTIC
/begin CHARACTERISTIC TMVER "Entprellzeit zur Erkennung einer dauerhaften Momentenbegrenzung" VALUE 0x81BFFC KwUw 65535.00 t1sxs_uw_b65535 0.00 65535.00 FUNCTION_LIST MDKOG IF_DATA DIM_X DIRECT 0x81BFFC /end CHARACTERISTIC
/begin CHARACTERISTIC TMWAFMN "Minimale Motortemperatur für Winkeladaption Nockenwelle" VALUE 0x810C5C KwUb 191.3 temp_ub_q0p75_o48 -48.00 143.3 FUNCTION_LIST WANWKW IF_DATA DIM_X DIRECT 0x810C5C /end CHARACTERISTIC
/begin CHARACTERISTIC TMWUC "Motortemperaturschwelle für Erfüllung 'warm up cycle'" VALUE 0x810BF6 KwUb 191.3 temp_ub_q0p75_o48 -48.00 143.3 FUNCTION_LIST DWUC DMDMIL IF_DATA DIM_X DIRECT 0x810BF6 /end CHARACTERISTIC
/begin CHARACTERISTIC TMWUCST "max. Motortemperatur im Start für Erfüllung 'warm up cycle'" VALUE 0x810BF7 KwUb 191.3 temp_ub_q0p75_o48 -48.00 143.3 FUNCTION_LIST DWUC IF_DATA DIM_X DIRECT 0x810BF7 /end CHARACTERISTIC
/begin CHARACTERISTIC TN2FGRGA "Doppelte Nennerzeitkonstante für FGR-Regler" CURVE 0x81BA8A KlAUwSstUwWUw 1310.700 t20msxs_uw_q0p02 0.00 1310.700 FUNCTION_LIST FGRMD IF_DATA DIM_X DIRECT 0x81BA8A /begin AXIS_DESCR STD_AXIS gangi dez 8 0.00 65535.00 DEPOSIT ABSOLUT /end AXIS_DESCR /end CHARACTERISTIC
/begin CHARACTERISTIC TNACMX "Maximale Zeit für Drehzahl nac nach S_ko = 0" VALUE 0x812BAC KwUb 25.50 t100msxs_ub_b25p5 0.00 25.50 FUNCTION_LIST KOS IF_DATA DIM_X DIRECT 0x812BAC /end CHARACTERISTIC
/begin CHARACTERISTIC TNALU "Testphasenlänge nach erkanntem Aussetzer" VALUE 0x81080A KwUb 255.0 dez 0.00 255.0 FUNCTION_LIST DMDLU IF_DATA DIM_X DIRECT 0x81080A /end CHARACTERISTIC
/begin CHARACTERISTIC TNLATM "Minimale SG-Nachlaufzeit für ATM - Abstellzeit" VALUE 0x81B836 KwUw 65535.00 t1sxs_uw_q1 0.00 65535.00 FUNCTION_LIST ATM IF_DATA DIM_X DIRECT 0x81B836 /end CHARACTERISTIC
/begin CHARACTERISTIC TNLATMTM "bei tmot > Schwellert  SG-Nachlauf-Anforderung B_nlatm = 1" VALUE 0x818359 KwUb 191.3 temp_ub_q0p75_o48 -48.00 143.3 FUNCTION_LIST ATM IF_DATA DIM_X DIRECT 0x818359 /end CHARACTERISTIC
/begin CHARACTERISTIC TNLATMTU "bei tumg (tatu -ATM) > Schwellwert SG-Nachlauf-Anforderung" VALUE 0x81835A KwUb 191.3 temp_ub_q0p75_o48 -48.00 143.3 FUNCTION_LIST ATM IF_DATA DIM_X DIRECT 0x81835A /end CHARACTERISTIC
/begin CHARACTERISTIC TNLDHLSU "SG-Nachlaufzeit für DHLSU" VALUE 0x81B892 KwUw 65535.00 t1sxs_uw_q1 0.00 65535.00 FUNCTION_LIST DHLSU IF_DATA DIM_X DIRECT 0x81B892 /end CHARACTERISTIC
/begin CHARACTERISTIC TNLEKPVL "Schwelle SG-Nachlaufzeit für EKP-Vorlauf" VALUE 0x812B4D KwUb 255.0 t1sxs_ub_b255 0.00 255.0 FUNCTION_LIST AEKP IF_DATA DIM_X DIRECT 0x812B4D /end CHARACTERISTIC
/begin CHARACTERISTIC TNLETM "Nachlaufzeitverlaengerung fuer E_tm" VALUE 0x81CF72 KwUw 65535.00 t1sxs_uw_q1 0.00 65535.00 FUNCTION_LIST GGTFM IF_DATA DIM_X DIRECT 0x81CF72 /end CHARACTERISTIC
/begin CHARACTERISTIC TNLPHWAIT "Zeit für Zahnaufweitung bei B_rphsp" VALUE 0x81B706 KwUw 30000.00 t5usxus_q5 0.00 30000.00 FUNCTION_LIST NLDG IF_DATA DIM_X DIRECT 0x81B706 /end CHARACTERISTIC
/begin CHARACTERISTIC TNLSG "Zeit für SG-Nachlauf" VALUE 0x81DAFE KwUw 6553.500 t100msxs_uw_b6553p6 0.00 6553.500 FUNCTION_LIST MLS IF_DATA DIM_X DIRECT 0x81DAFE /end CHARACTERISTIC
/begin CHARACTERISTIC TNLSGM "Nachlaufzeit für SG abschalten" CURVE 0x81C76A KlAUbSstUbWUw 65535.00 t1sxs_uw_b65535 0.00 65535.00 FUNCTION_LIST BGTABS IF_DATA DIM_X DIRECT 0x81C76A
 /begin AXIS_DESCR STD_AXIS tmotab temp_ub_q0p75_o48 6 -48.00 143.3 DEPOSIT ABSOLUT /end AXIS_DESCR
/end CHARACTERISTIC
/begin CHARACTERISTIC TNLSGMN "Minimale Zeit für SG-Nachlauf" VALUE 0x81DF48 KwUw 6553.300 t100msxs_uw_b6553p6 0.2000000 6553.500 FUNCTION_LIST MOTAUS IF_DATA DIM_X DIRECT 0x81DF48 /end CHARACTERISTIC
/begin CHARACTERISTIC TNLSGMX "Maximale Zeit für SG-Nachlauf" VALUE 0x81DF4A KwUw 6553.500 t100msxs_uw_b6553p6 0.00 6553.500 FUNCTION_LIST MOTAUS IF_DATA DIM_X DIRECT 0x81DF4A /end CHARACTERISTIC
/begin CHARACTERISTIC TNLSYNMN "Maximalwert der Phasenperiodendauer für Synchronisationsfreigabe" VALUE 0x813B8E KwUw 2615400. t40usxus_q40 6000.000 2621400. FUNCTION_LIST NLDG IF_DATA DIM_X DIRECT 0x813B8E /end CHARACTERISTIC
/begin CHARACTERISTIC TNLSYNMX "Minimalwert der Phasenperiodendauer für Synchronisationsfreigabe" VALUE 0x813B90 KwUw 400000.0 t40usxus_q40 0.00 400000.0 FUNCTION_LIST NLDG IF_DATA DIM_X DIRECT 0x813B90 /end CHARACTERISTIC
/begin CHARACTERISTIC TNMAXP "Verweilzeit in NMAX bis zur Umschaltung der Abstimmung" VALUE 0x816718 KwUw 655.3500 t10msxs_uw_b655p35 0.00 655.3500 FUNCTION_LIST NMAXMD IF_DATA DIM_X DIRECT 0x816718 /end CHARACTERISTIC
/begin CHARACTERISTIC TNMXPR "Drehzahl-Prädiktionshorizont für NMAX-Regelung" VALUE 0x811C30 KwUb 2.540 t10msxs_ub_b2p55 0.01000 2.550 FUNCTION_LIST NMAXMD IF_DATA DIM_X DIRECT 0x811C30 /end CHARACTERISTIC
/begin CHARACTERISTIC TNOMF2 "zulässige Zeit außerhalb Meßfenster, Phase 2" VALUE 0x818128 KwUb 25.50 t100msxs_ub_b25p5 0.00 25.50 FUNCTION_LIST DSLSLRS IF_DATA DIM_X DIRECT 0x818128 /end CHARACTERISTIC
/begin CHARACTERISTIC TNOMF3 "zulässige Zeit außerhalb Meßfenster, Phase 3" VALUE 0x818129 KwUb 25.50 t100msxs_ub_b25p5 0.00 25.50 FUNCTION_LIST DSLSLRS IF_DATA DIM_X DIRECT 0x818129 /end CHARACTERISTIC
/begin CHARACTERISTIC TNOMF5 "zulässige Zeit außerhalb Meßfenster, Phase 5" VALUE 0x81812A KwUb 25.50 t100msxs_ub_b25p5 0.00 25.50 FUNCTION_LIST DSLSLRS IF_DATA DIM_X DIRECT 0x81812A /end CHARACTERISTIC
/begin CHARACTERISTIC TNSC "Nachstartüberwachungszeit" VALUE 0x8166FA KwUw 1310.700 t20msxs_uw_q0p02 0.00 1310.700 FUNCTION_LIST MDZUL IF_DATA DIM_X DIRECT 0x8166FA /end CHARACTERISTIC
/begin CHARACTERISTIC TNSOF "Entprellzeit zur Abschaltung der Nachstartaufweitung" VALUE 0x811C20 KwUb 5.100 t20msxs_ub_b5p1 0.00 5.100 FUNCTION_LIST MDZUL IF_DATA DIM_X DIRECT 0x811C20 /end CHARACTERISTIC
/begin CHARACTERISTIC TNSRT "Max.-Zeit ab Start für Retriggerung Berechnung Motortemperaturmodell" VALUE 0x81905E KwUb 255.0 t1sxs_ub_b255 0.00 255.0 FUNCTION_LIST GGTFM IF_DATA DIM_X DIRECT 0x81905E /end CHARACTERISTIC
/begin CHARACTERISTIC TNSTAU "Sperrzeit Abgasuntersuchung nach Start" VALUE 0x81A044 KwUw 6553.500 t100msxs_uw_b6553p5 0.00 6553.500 FUNCTION_LIST SGAAU IF_DATA DIM_X DIRECT 0x81A044 /end CHARACTERISTIC
/begin CHARACTERISTIC TNSTDNH "Zeit nach Start für Diagnose Adernschluß (Monoflop)" VALUE 0x810C69 KwUb 5.100 t20msxs_ub_b5p1 0.00 5.100 FUNCTION_LIST DLSH IF_DATA DIM_X DIRECT 0x810C69 /end CHARACTERISTIC
/begin CHARACTERISTIC TNSTDSL "Schwelle Zeit nach Start für aktivieren Phase 4" VALUE 0x81A02E KwUw 655.3500 t10msxs_uw_b655p35 0.00 655.3500 FUNCTION_LIST DSLSLRS IF_DATA DIM_X DIRECT 0x81A02E /end CHARACTERISTIC
/begin CHARACTERISTIC TNSTFON "Zeit nach Start Adaptionsstop (Heilung) freigegeben" VALUE 0x813854 KwUw 655.3500 t10msxs_uw_b655p35 0.00 655.3500 FUNCTION_LIST DMDFON IF_DATA DIM_X DIRECT 0x813854 /end CHARACTERISTIC
/begin CHARACTERISTIC TNSURLP "Zeit rl-Praediktions-Unterdrueckung im Nachstart" VALUE 0x8110EE KwUb 25.50 t100msxs_ub_b25p5 0.00 25.50 FUNCTION_LIST BGRLP IF_DATA DIM_X DIRECT 0x8110EE /end CHARACTERISTIC
/begin CHARACTERISTIC TNSUUK "Zeit UK-Unterdrückung im Nachstart" VALUE 0x811334 KwUb 25.50 t100msxs_ub_b25p5 0.00 25.50 FUNCTION_LIST ESUK IF_DATA DIM_X DIRECT 0x811334 /end CHARACTERISTIC
/begin CHARACTERISTIC TNSUUKA "Verbotszeit ÜK-Adaption im Nachstart" VALUE 0x813FE0 KwUw 655.3500 t10msxs_uw_b655p35 0.00 655.3500 FUNCTION_LIST ESUKAS IF_DATA DIM_X DIRECT 0x813FE0 /end CHARACTERISTIC
/begin CHARACTERISTIC TOLDE "Ersatzgröße Öltemperatur im Fehlerfall" VALUE 0x81909A KwUb 191.3 temp_ub_q0p75_o48 -48.00 143.3 FUNCTION_LIST GGTFOL IF_DATA DIM_X DIRECT 0x81909A /end CHARACTERISTIC
/begin CHARACTERISTIC TOLDMNE "Ersatzwert für minimale Öltemperatur" VALUE 0x81909B KwUb 191.3 temp_ub_q0p75_o48 -48.00 143.3 FUNCTION_LIST GGTFOL IF_DATA DIM_X DIRECT 0x81909B /end CHARACTERISTIC
/begin CHARACTERISTIC TOLDMX "Öltemperatur max." VALUE 0x81909C KwUb 191.3 temp_ub_q0p75_o48 -48.00 143.3 FUNCTION_LIST GGTFOL IF_DATA DIM_X DIRECT 0x81909C /end CHARACTERISTIC
/begin CHARACTERISTIC TOLELI "(Motor-)Oeltemperatur Erfassung u. Linearisierung, Inverskennlinie" CURVE 0x81909D KlAUbSstUbWUb 191.3 temp_ub_q0p75_o48 -48.00 143.3 FUNCTION_LIST GGTFOL IF_DATA DIM_X DIRECT 0x81909D /begin AXIS_DESCR STD_AXIS wtol spg_ub_b5 18 0.00 4.980 DEPOSIT ABSOLUT /end AXIS_DESCR /end CHARACTERISTIC
/begin CHARACTERISTIC TOLSTNWO "obere Tol-Schwelle für Stellgliedansteuerung Nockenwelle" VALUE 0x81818A KwUb 191.3 temp_ub_q0p75_o48 -48.00 143.3 FUNCTION_LIST T2STA T2LID IF_DATA DIM_X DIRECT 0x81818A /end CHARACTERISTIC
/begin CHARACTERISTIC TOLSTNWU "untere Tol-Schwelle für Stellgliedansteuerung Nockenwelle" VALUE 0x81818B KwUb 191.3 temp_ub_q0p75_o48 -48.00 143.3 FUNCTION_LIST T2STA T2LID IF_DATA DIM_X DIRECT 0x81818B /end CHARACTERISTIC
/begin CHARACTERISTIC TOLT1O "Öltemperaturbereich 1 oben" VALUE 0x819D0D KwUb 191.3 temp_ub_q0p75_o48 -48.00 143.3 FUNCTION_LIST VS IF_DATA DIM_X DIRECT 0x819D0D /end CHARACTERISTIC
/begin CHARACTERISTIC TOLT1U "Öltemperaturbereich 1 unten" VALUE 0x819D0E KwUb 191.3 temp_ub_q0p75_o48 -48.00 143.3 FUNCTION_LIST VS IF_DATA DIM_X DIRECT 0x819D0E /end CHARACTERISTIC
/begin CHARACTERISTIC TOLT2O "Öltemperaturbereich 2 oben" VALUE 0x819D0F KwUb 191.3 temp_ub_q0p75_o48 -48.00 143.3 FUNCTION_LIST VS IF_DATA DIM_X DIRECT 0x819D0F /end CHARACTERISTIC
/begin CHARACTERISTIC TOLT2U "Öltemperaturbereich 2 unten" VALUE 0x819D10 KwUb 191.3 temp_ub_q0p75_o48 -48.00 143.3 FUNCTION_LIST VS IF_DATA DIM_X DIRECT 0x819D10 /end CHARACTERISTIC
/begin CHARACTERISTIC TOLT3O "Öltemperaturbereich 3 oben" VALUE 0x819D11 KwUb 191.3 temp_ub_q0p75_o48 -48.00 143.3 FUNCTION_LIST VS IF_DATA DIM_X DIRECT 0x819D11 /end CHARACTERISTIC
/begin CHARACTERISTIC TOLT3U "Öltemperaturbereich 3 unten" VALUE 0x819D12 KwUb 191.3 temp_ub_q0p75_o48 -48.00 143.3 FUNCTION_LIST VS IF_DATA DIM_X DIRECT 0x819D12 /end CHARACTERISTIC
/begin CHARACTERISTIC TONW "Öltemperaturschwelle für Nockenwellenverstellung" VALUE 0x818763 KwUb 191.3 temp_ub_q0p75_o48 -48.00 143.3 FUNCTION_LIST NWS IF_DATA DIM_X DIRECT 0x818763 /end CHARACTERISTIC
/begin CHARACTERISTIC TPERDTE "Zeit für Wiederholung DTEV bei Dauerleerlauf" VALUE 0x819B9E KwUb 25.50 t100msxs_ub_b25p5 0.00 25.50 FUNCTION_LIST DTEV IF_DATA DIM_X DIRECT 0x819B9E /end CHARACTERISTIC
/begin CHARACTERISTIC TPHERKMN "minimale Motortemperatur für Phasensuche" VALUE 0x810C56 KwUb 191.3 temp_ub_q0p75_o48 -48.00 143.3 FUNCTION_LIST NLPH IF_DATA DIM_X DIRECT 0x810C56 /end CHARACTERISTIC
/begin CHARACTERISTIC TPHSABSP "Sperrzeit für die Phasensuche, wenn der geeignete Betriebsbereich verl. wurde" VALUE 0x810C57 KwUb 255.0 t1sxs_ub_b255 0.00 255.0 FUNCTION_LIST NLPH IF_DATA DIM_X DIRECT 0x810C57 /end CHARACTERISTIC
/begin CHARACTERISTIC TPHSSP "Sperrzeit für Phasensuche nach erfolgloser Suche" VALUE 0x810C58 KwUb 255.0 t1sxs_ub_b255 0.00 255.0 FUNCTION_LIST NLPH IF_DATA DIM_X DIRECT 0x810C58 /end CHARACTERISTIC
/begin CHARACTERISTIC TPLSUIV "Anzahl der Fahrzyklen für Fehlerentprellung B_nplsv bei vermuteter HC-Vergiftung" VALUE 0x818407 KwUb 255.0 dez 0.00 255.0 FUNCTION_LIST DLSU IF_DATA DIM_X DIRECT 0x818407 /end CHARACTERISTIC
/begin CHARACTERISTIC TPLSUPWF "Anzahl der Fahrzyklen für Fehlerentprellung B_nplsv bei C_pwf" VALUE 0x818408 KwUb 255.0 dez 0.00 255.0 FUNCTION_LIST DLSU IF_DATA DIM_X DIRECT 0x818408 /end CHARACTERISTIC
/begin CHARACTERISTIC TPLSUSET "Zeit für Erkennung ""Möglichkeit einer HC-Vergiftung""" VALUE 0x81B906 KwUw 6553.500 t100msxs_uw_b6553p5 0.00 6553.500 FUNCTION_LIST DLSU IF_DATA DIM_X DIRECT 0x81B906 /end CHARACTERISTIC
/begin CHARACTERISTIC TPNSE "Prüfzeit nach Startende für DVE-Diagnose" VALUE 0x818494 KwUb 25.40 t100msxs_ub_b25p5 0.1000 25.50 FUNCTION_LIST DDVE GGPED IF_DATA DIM_X DIRECT 0x818494 /end CHARACTERISTIC
/begin CHARACTERISTIC TPNSMD "Prüfzeit nach Startende für Diagnose Momentenbegrenzung" VALUE 0x81BFFE KwUw 65535.00 t1sxs_uw_b65535 0.00 65535.00 FUNCTION_LIST MDKOG IF_DATA DIM_X DIRECT 0x81BFFE /end CHARACTERISTIC
/begin CHARACTERISTIC TPREL "Zahnentprellzeit in der Initialisierung" VALUE 0x810C05 KwUb 0.1000 t10msxs_ub_b2p55 0.00 0.1000 FUNCTION_LIST GGDPG IF_DATA DIM_X DIRECT 0x810C05 /end CHARACTERISTIC
/begin CHARACTERISTIC TPUKUKA "Entprellzeit für Erkennung ÜK-Eingriff (ÜK-Adaption)" VALUE 0x81134E KwUb 2.550 t10msxs_ub_b2p55 0.00 2.550 FUNCTION_LIST ESUKAS IF_DATA DIM_X DIRECT 0x81134E /end CHARACTERISTIC
/begin CHARACTERISTIC TPVL "Zeit für Pumpenvorlauf" VALUE 0x812B4E KwUb 2.550 t10msxs_ub_b2p55 0.00 2.550 FUNCTION_LIST AEKP IF_DATA DIM_X DIRECT 0x812B4E /end CHARACTERISTIC
/begin CHARACTERISTIC TPWRSV "Wartezeit bis DV-E Powersave aktiv wird" VALUE 0x813D58 KwUw 655.3500 t10msxs_uw_b655p35 0.00 655.3500 FUNCTION_LIST ADVE IF_DATA DIM_X DIRECT 0x813D58 /end CHARACTERISTIC
/begin CHARACTERISTIC TQTEAB "Zeit für Absteuerung Spülrate Tankentlüftung" VALUE 0x8121EA KwUb 81.28 t20msxs_ub_q0p32 0.3200 81.60 FUNCTION_LIST TEB IF_DATA DIM_X DIRECT 0x8121EA /end CHARACTERISTIC
/begin CHARACTERISTIC TQTEDAB "Zeit für schnelle Absteuerung Spülrate Tankentlüftung" VALUE 0x8121EB KwUb 81.28 t20msxs_ub_q0p32 0.3200 81.60 FUNCTION_LIST TEB IF_DATA DIM_X DIRECT 0x8121EB /end CHARACTERISTIC
/begin CHARACTERISTIC TRAU "Überwachungszeit für untere Lastschwelle der Lambdaregelung" VALUE 0x8198ED KwUb 25.50 t100msxs_ub_b25p5 0.00 25.50 FUNCTION_LIST LRSEB IF_DATA DIM_X DIRECT 0x8198ED /end CHARACTERISTIC
/begin CHARACTERISTIC TRD "Zahnperiodenzeit für Rückdrehen im Auslauf" VALUE 0x810BFA KwUb 100.0 t1msxms_q1 0.00 100.0 FUNCTION_LIST ALE IF_DATA DIM_X DIRECT 0x810BFA /end CHARACTERISTIC
/begin CHARACTERISTIC TRIAKTH "Zeitdauer für Ri-Berechnung aktuell hinter KAT" VALUE 0x813C24 KwUw 6553.500 t100msxs_uw_b6553p5 0.00 6553.500 FUNCTION_LIST GGLSH IF_DATA DIM_X DIRECT 0x813C24 /end CHARACTERISTIC
/begin CHARACTERISTIC TRIIMPH "Zeitdauer für Pumpimpuls für beide Bänke hinter KAT" VALUE 0x813C26 KwUw 655.3500 t10msxs_uw_b655p35 0.00 655.3500 FUNCTION_LIST GGLSH IF_DATA DIM_X DIRECT 0x813C26 /end CHARACTERISTIC
/begin CHARACTERISTIC TRIPFASH "Mindest Zeitdauer für aktive Lamda Regelung vor KAT" VALUE 0x81B8D0 KwUw 6553.500 t100msxs_uw_b6553p5 0.00 6553.500 FUNCTION_LIST DLSAHK IF_DATA DIM_X DIRECT 0x81B8D0 /end CHARACTERISTIC
/begin CHARACTERISTIC TRKA "Erkennungszeit für eingeschwungene Grundadaption von rkat bzw. rkaz" VALUE 0x818811 KwUb 51.00 t200msxs_ub_b51 0.00 51.00 FUNCTION_LIST DKVS IF_DATA DIM_X DIRECT 0x818811 /end CHARACTERISTIC
/begin CHARACTERISTIC TRKATZ "Aktivierungszeit von rkat bis Setzen Zyklusflag, wenn B_gae = FALSE" VALUE 0x818812 KwUb 51.00 t200msxs_ub_b51 0.00 51.00 FUNCTION_LIST DKVS IF_DATA DIM_X DIRECT 0x818812 /end CHARACTERISTIC
/begin CHARACTERISTIC TRKAZZ "Aktivierungszeit von rkaz bis Setzen Zyklusflag, wenn B_gae = FALSE" VALUE 0x818813 KwUb 51.00 t200msxs_ub_b51 0.00 51.00 FUNCTION_LIST DKVS IF_DATA DIM_X DIRECT 0x818813 /end CHARACTERISTIC
/begin CHARACTERISTIC TRMDBGV "Zeit bis zum Selbstabschalten der geschw.-abh. Momentenaufbaubegrenzung" VALUE 0x819808 KwUb 25.50 t100msxs_ub_b25p5 0.00 25.50 FUNCTION_LIST MDBGV IF_DATA DIM_X DIRECT 0x819808 /end CHARACTERISTIC
/begin CHARACTERISTIC TRSAFA "Überwachungszeit Kabelbruch hinter KAT: Funktions Anforderung für Kurz-Trip-Test" VALUE 0x81B8E0 KwUw 6553.500 t100msxs_uw_q100 0.00 6553.500 FUNCTION_LIST DLSH IF_DATA DIM_X DIRECT 0x81B8E0 /end CHARACTERISTIC
/begin CHARACTERISTIC TRSAH "Überwachungszeit für Kabelbruch (Spg. im Band) für Sonde hinter KAT" VALUE 0x81B8E2 KwUw 6553.500 t100msxs_uw_q100 0.00 6553.500 FUNCTION_LIST DLSH IF_DATA DIM_X DIRECT 0x81B8E2 /end CHARACTERISTIC
/begin CHARACTERISTIC TRSE "Überwachungszeit -> Regelung ein" VALUE 0x8183FA KwUb 25.50 t100msxs_ub_b25p5 0.00 25.50 FUNCTION_LIST DLSH IF_DATA DIM_X DIRECT 0x8183FA /end CHARACTERISTIC
/begin CHARACTERISTIC TRWVLS "Zeitschwelle f. sofortige Wiederaufn. VL-Zündw. spät Motorschutz" VALUE 0x81E36E KwUw 6553.500 t100msxs_uw_b6553p5 0.00 6553.500 FUNCTION_LIST ZWBTSK IF_DATA DIM_X DIRECT 0x81E36E /end CHARACTERISTIC
/begin CHARACTERISTIC TSAKAMN "Mindestdauer SA für Funktion Katalysator-Ausräumen" VALUE 0x811FEC KwUb 5.100 t20msxs_ub_b5p1 0.00 5.100 FUNCTION_LIST LRSKA IF_DATA DIM_X DIRECT 0x811FEC /end CHARACTERISTIC
/begin CHARACTERISTIC TSAKAMN2 "Mindestdauer SA für Funktion Katalysator-Ausräumen Bank2" VALUE 0x811FED KwUb 5.100 t20msxs_ub_b5p1 0.00 5.100 FUNCTION_LIST LRSKA IF_DATA DIM_X DIRECT 0x811FED /end CHARACTERISTIC
/begin CHARACTERISTIC TSALASH "Zeit nach Schub für Überprüfung Sonde hinter KAT" VALUE 0x8183ED KwUb 25.50 t100msxs_ub_b25p5 0.00 25.50 FUNCTION_LIST DLSAHK IF_DATA DIM_X DIRECT 0x8183ED /end CHARACTERISTIC
/begin CHARACTERISTIC TSBVDSLTMS "Verzögerung Messbeginn DSLSLRS nach Sondenbetriebsbereitschaft" CURVE 0x81A030 KlAUbSstUbWUw 6553.500 t100msxs_uw_b6553p5 0.00 6553.500 FUNCTION_LIST DSLSLRS IF_DATA DIM_X DIRECT 0x81A030
 /begin AXIS_DESCR STD_AXIS tmst temp_ub_q0p75_o48 6 -48.00 143.3 DEPOSIT ABSOLUT /end AXIS_DESCR
/end CHARACTERISTIC
/begin CHARACTERISTIC TSFAAA "Dummy: Tabellenanfang" VALUE 0x810B4F KwUb 255.0 dez 0.00 255.0 FUNCTION_LIST DFPM_DFPM IF_DATA DIM_X DIRECT 0x810B4F /end CHARACTERISTIC
/begin CHARACTERISTIC TSFAAVE "Fehlersummenzeit: Absperrventil Aktivkohlefilter (Endstufe)" VALUE 0x810B50 KwUb 255.0 dez 0.00 255.0 FUNCTION_LIST DFPM_DEKON IF_DATA DIM_X DIRECT 0x810B50 /end CHARACTERISTIC
/begin CHARACTERISTIC TSFAGRE "Fehlersummenzeit: Überwachung AGR-Endstufe" VALUE 0x810B51 KwUb 255.0 dez 0.00 255.0 FUNCTION_LIST DFPM_DUMMY043 IF_DATA DIM_X DIRECT 0x810B51 /end CHARACTERISTIC
/begin CHARACTERISTIC TSFAGRF "Fehlersummenzeit: Überwachung AGR-FLOW" VALUE 0x810B52 KwUb 255.0 dez 0.00 255.0 FUNCTION_LIST DFPM_DUMMY043 IF_DATA DIM_X DIRECT 0x810B52 /end CHARACTERISTIC
/begin CHARACTERISTIC TSFBM "Fehlersummenzeit: Bezugsmarkengeber" VALUE 0x810B53 KwUb 255.0 dez 0.00 255.0 FUNCTION_LIST DFPM_DDG IF_DATA DIM_X DIRECT 0x810B53 /end CHARACTERISTIC
/begin CHARACTERISTIC TSFBREMS "Fehlersummenzeit: BREMS (Bremsschalter)" VALUE 0x810B54 KwUb 255.0 dez 0.00 255.0 FUNCTION_LIST DFPM_GGEGAS IF_DATA DIM_X DIRECT 0x810B54 /end CHARACTERISTIC
/begin CHARACTERISTIC TSFBWF "Fehlersummenzeit: PWG Bewegung" VALUE 0x810B55 KwUb 255.0 dez 0.00 255.0 FUNCTION_LIST DFPM_GGPED IF_DATA DIM_X DIRECT 0x810B55 /end CHARACTERISTIC
/begin CHARACTERISTIC TSFCAS "Fehlersummenzeit: CAN-Schnittstelle, Timeout ASC" VALUE 0x810B56 KwUb 255.0 dez 0.00 255.0 FUNCTION_LIST DFPM_DCAS IF_DATA DIM_X DIRECT 0x810B56 /end CHARACTERISTIC
/begin CHARACTERISTIC TSFCGE "Fehlersummenzeit: CAN-Schnittstelle, Timeout EGS" VALUE 0x810B57 KwUb 255.0 dez 0.00 255.0 FUNCTION_LIST DFPM_DCGE IF_DATA DIM_X DIRECT 0x810B57 /end CHARACTERISTIC
/begin CHARACTERISTIC TSFCGEGS "Fehlersummenzeit: EGS; Steuergerät" VALUE 0x810B58 KwUb 255.0 dez 0.00 255.0 FUNCTION_LIST DFPM_DCG IF_DATA DIM_X DIRECT 0x810B58 /end CHARACTERISTIC
/begin CHARACTERISTIC TSFCGGGP "Fehlersummenzeit: EGS; Gang unplausibel" VALUE 0x810B59 KwUb 255.0 dez 0.00 255.0 FUNCTION_LIST DFPM_DCG IF_DATA DIM_X DIRECT 0x810B59 /end CHARACTERISTIC
/begin CHARACTERISTIC TSFCGGGV "Fehlersummenzeit: EGS; Gangvergleich negativ" VALUE 0x810B5A KwUb 255.0 dez 0.00 255.0 FUNCTION_LIST DFPM_DCG IF_DATA DIM_X DIRECT 0x810B5A /end CHARACTERISTIC
/begin CHARACTERISTIC TSFCGM1V "Fehlersummenzeit: EGS; Magnetventil 1-2/4-5 Schaltung" VALUE 0x810B5B KwUb 255.0 dez 0.00 255.0 FUNCTION_LIST DFPM_DCG IF_DATA DIM_X DIRECT 0x810B5B /end CHARACTERISTIC
/begin CHARACTERISTIC TSFCGM2V "Fehlersummenzeit: EGS; Magnetventil 2-3 Schaltung" VALUE 0x810B5C KwUb 255.0 dez 0.00 255.0 FUNCTION_LIST DFPM_DCG IF_DATA DIM_X DIRECT 0x810B5C /end CHARACTERISTIC
/begin CHARACTERISTIC TSFCGM3V "Fehlersummenzeit: EGS; Magnetventil 3-4 Schaltung" VALUE 0x810B5D KwUb 255.0 dez 0.00 255.0 FUNCTION_LIST DFPM_DCG IF_DATA DIM_X DIRECT 0x810B5D /end CHARACTERISTIC
/begin CHARACTERISTIC TSFCGMVK "Fehlersummenzeit: EGS; Magnetventil Wandlerkupplung" VALUE 0x810B5E KwUb 255.0 dez 0.00 255.0 FUNCTION_LIST DFPM_DCG IF_DATA DIM_X DIRECT 0x810B5E /end CHARACTERISTIC
/begin CHARACTERISTIC TSFCGRMM "Fehlersummenzeit: EGS; Regelmagnetventil Modulierdruck" VALUE 0x810B5F KwUb 255.0 dez 0.00 255.0 FUNCTION_LIST DFPM_DCG IF_DATA DIM_X DIRECT 0x810B5F /end CHARACTERISTIC
/begin CHARACTERISTIC TSFCGRMS "Fehlersummenzeit: EGS; Regelmagnetventil Schaltdruck" VALUE 0x810B60 KwUb 255.0 dez 0.00 255.0 FUNCTION_LIST DFPM_DCG IF_DATA DIM_X DIRECT 0x810B60 /end CHARACTERISTIC
/begin CHARACTERISTIC TSFCGUDG "Fehlersummenzeit: EGS; Versorgungsspannung Drehzahlsensoren" VALUE 0x810B61 KwUb 255.0 dez 0.00 255.0 FUNCTION_LIST DFPM_DCG IF_DATA DIM_X DIRECT 0x810B61 /end CHARACTERISTIC
/begin CHARACTERISTIC TSFCGUMV "Fehlersummenzeit: EGS; Versorgungsspannung Magnetventile" VALUE 0x810B62 KwUb 255.0 dez 0.00 255.0 FUNCTION_LIST DFPM_DCG IF_DATA DIM_X DIRECT 0x810B62 /end CHARACTERISTIC
/begin CHARACTERISTIC TSFCGVGC "Fehlersummenzeit: EGS; Verteilergetr.-Stellung unplausibel" VALUE 0x810B63 KwUb 255.0 dez 0.00 255.0 FUNCTION_LIST DFPM_DCG IF_DATA DIM_X DIRECT 0x810B63 /end CHARACTERISTIC
/begin CHARACTERISTIC TSFCGVRC "Fehlersummenzeit: EGS; Raddrehzahl hinten unplausibel" VALUE 0x810B64 KwUb 255.0 dez 0.00 255.0 FUNCTION_LIST DFPM_DCG IF_DATA DIM_X DIRECT 0x810B64 /end CHARACTERISTIC
/begin CHARACTERISTIC TSFCGWK "Fehlersummenzeit: EGS; Wandlerkupplung" VALUE 0x810B65 KwUb 255.0 dez 0.00 255.0 FUNCTION_LIST DFPM_DCG IF_DATA DIM_X DIRECT 0x810B65 /end CHARACTERISTIC
/begin CHARACTERISTIC TSFCKBI "" VALUE 0x810B66 KwUb 255.0 dez 0.00 255.0 FUNCTION_LIST DFPM_DCKBI IF_DATA DIM_X DIRECT 0x810B66 /end CHARACTERISTIC
/begin CHARACTERISTIC TSFCMIL "Fehlersummenzeit: Diagnose FGR-Lampe über CAN" VALUE 0x810B67 KwUb 255.0 dez 0.00 255.0 FUNCTION_LIST DFPM_DCMIL IF_DATA DIM_X DIRECT 0x810B67 /end CHARACTERISTIC
/begin CHARACTERISTIC TSFCRA "Fehlersummenzeit: EKP aus bei Crash" VALUE 0x810B68 KwUb 255.0 dez 0.00 255.0 FUNCTION_LIST DFPM_GGAIRBAG IF_DATA DIM_X DIRECT 0x810B68 /end CHARACTERISTIC
/begin CHARACTERISTIC TSFDK "Fehlersummenzeit: DK - Potentiometer" VALUE 0x810B69 KwUb 255.0 dez 0.00 255.0 FUNCTION_LIST DFPM_DDVE IF_DATA DIM_X DIRECT 0x810B69 /end CHARACTERISTIC
/begin CHARACTERISTIC TSFDK1P "Fehlersummenzeit: Drosselklappe 1. Poti" VALUE 0x810B6A KwUb 255.0 dez 0.00 255.0 FUNCTION_LIST DFPM_DDVE IF_DATA DIM_X DIRECT 0x810B6A /end CHARACTERISTIC
/begin CHARACTERISTIC TSFDK2P "Fehlersummenzeit: Drosselklappenpotentiometer 2" VALUE 0x810B6B KwUb 255.0 dez 0.00 255.0 FUNCTION_LIST DFPM_DDVE IF_DATA DIM_X DIRECT 0x810B6B /end CHARACTERISTIC
/begin CHARACTERISTIC TSFDPL "Fehlersummenzeit: Dauerplus" VALUE 0x810B6C KwUb 255.0 dez 0.00 255.0 FUNCTION_LIST DFPM_DUMMY043 IF_DATA DIM_X DIRECT 0x810B6C /end CHARACTERISTIC
/begin CHARACTERISTIC TSFDSL "Fehlersummenzeit: Drucksensor Ladedruck" VALUE 0x810B6D KwUb 255.0 dez 0.00 255.0 FUNCTION_LIST DFPM_GGDSAS IF_DATA DIM_X DIRECT 0x810B6D /end CHARACTERISTIC
/begin CHARACTERISTIC TSFDSU "Fehlersummenzeit: Drucksensor Umgebung" VALUE 0x810B6E KwUb 255.0 dez 0.00 255.0 FUNCTION_LIST DFPM_GGDSAS IF_DATA DIM_X DIRECT 0x810B6E /end CHARACTERISTIC
/begin CHARACTERISTIC TSFDSVLU "Fehlersummenzeit: Drucksensorsignalvergleich (DS-L DS-U)" VALUE 0x810B6F KwUb 255.0 dez 0.00 255.0 FUNCTION_LIST DFPM_GGDSAS IF_DATA DIM_X DIRECT 0x810B6F /end CHARACTERISTIC
/begin CHARACTERISTIC TSFDVEE "Fehlersummenzeit: DV-E Endstufe" VALUE 0x810B70 KwUb 255.0 dez 0.00 255.0 FUNCTION_LIST DFPM_DDVE IF_DATA DIM_X DIRECT 0x810B70 /end CHARACTERISTIC
/begin CHARACTERISTIC TSFDVEF "Fehlersummenzeit: DV-E Fehler bei Federprüfung" VALUE 0x810B71 KwUb 255.0 dez 0.00 255.0 FUNCTION_LIST DFPM_DDVE IF_DATA DIM_X DIRECT 0x810B71 /end CHARACTERISTIC
/begin CHARACTERISTIC TSFDVEFO "" VALUE 0x810B72 KwUb 255.0 dez 0.00 255.0 FUNCTION_LIST DFPM_DDVE IF_DATA DIM_X DIRECT 0x810B72 /end CHARACTERISTIC
/begin CHARACTERISTIC TSFDVEL "Fehlersummenzeit: DV-E Lageabweichung" VALUE 0x810B73 KwUb 255.0 dez 0.00 255.0 FUNCTION_LIST DFPM_DDVE IF_DATA DIM_X DIRECT 0x810B73 /end CHARACTERISTIC
/begin CHARACTERISTIC TSFDVEN "Fehlersummenzeit: DV-E Fehler bei Prüfung Notluftposition" VALUE 0x810B74 KwUb 255.0 dez 0.00 255.0 FUNCTION_LIST DFPM_DDVE IF_DATA DIM_X DIRECT 0x810B74 /end CHARACTERISTIC
/begin CHARACTERISTIC TSFDVER "Fehlersummenzeit: DV-E Regelbereich" VALUE 0x810B75 KwUb 255.0 dez 0.00 255.0 FUNCTION_LIST DFPM_DDVE IF_DATA DIM_X DIRECT 0x810B75 /end CHARACTERISTIC
/begin CHARACTERISTIC TSFDVET "" VALUE 0x810B76 KwUb 255.0 dez 0.00 255.0 FUNCTION_LIST DFPM_DDVE IF_DATA DIM_X DIRECT 0x810B76 /end CHARACTERISTIC
/begin CHARACTERISTIC TSFDVEU "Fehlersummenzeit: DV-E Fehler beim UMA-Lernen" VALUE 0x810B77 KwUb 255.0 dez 0.00 255.0 FUNCTION_LIST DFPM_DDVE IF_DATA DIM_X DIRECT 0x810B77 /end CHARACTERISTIC
/begin CHARACTERISTIC TSFDVEUB "" VALUE 0x810B78 KwUb 255.0 dez 0.00 255.0 FUNCTION_LIST DFPM_DDVE IF_DATA DIM_X DIRECT 0x810B78 /end CHARACTERISTIC
/begin CHARACTERISTIC TSFDVEUW "" VALUE 0x810B79 KwUb 255.0 dez 0.00 255.0 FUNCTION_LIST DFPM_DDVE IF_DATA DIM_X DIRECT 0x810B79 /end CHARACTERISTIC
/begin CHARACTERISTIC TSFDVEV "Fehlersummenzeit: DV-E Fehler bei Verstärkerabgleich" VALUE 0x810B7A KwUb 255.0 dez 0.00 255.0 FUNCTION_LIST DFPM_DDVE IF_DATA DIM_X DIRECT 0x810B7A /end CHARACTERISTIC
/begin CHARACTERISTIC TSFEGFE "Fehlersummenzeit: Eingangsgröße Füllunserfassung" VALUE 0x810B7B KwUb 255.0 dez 0.00 255.0 FUNCTION_LIST DFPM_EGFE IF_DATA DIM_X DIRECT 0x810B7B /end CHARACTERISTIC
/begin CHARACTERISTIC TSFEV1 "Fehlersummenzeit: EV von Zyl. 1" VALUE 0x810B7C KwUb 255.0 dez 0.00 255.0 FUNCTION_LIST DFPM_DEKON IF_DATA DIM_X DIRECT 0x810B7C /end CHARACTERISTIC
/begin CHARACTERISTIC TSFEV2 "Fehlersummenzeit: EV von Zyl. 2" VALUE 0x810B7D KwUb 255.0 dez 0.00 255.0 FUNCTION_LIST DFPM_DEKON IF_DATA DIM_X DIRECT 0x810B7D /end CHARACTERISTIC
/begin CHARACTERISTIC TSFEV3 "Fehlersummenzeit: EV von Zyl. 3" VALUE 0x810B7E KwUb 255.0 dez 0.00 255.0 FUNCTION_LIST DFPM_DEKON IF_DATA DIM_X DIRECT 0x810B7E /end CHARACTERISTIC
/begin CHARACTERISTIC TSFEV4 "Fehlersummenzeit: EV von Zyl. 4" VALUE 0x810B7F KwUb 255.0 dez 0.00 255.0 FUNCTION_LIST DFPM_DEKON IF_DATA DIM_X DIRECT 0x810B7F /end CHARACTERISTIC
/begin CHARACTERISTIC TSFEV5 "Fehlersummenzeit: EV von Zyl. 5" VALUE 0x810B80 KwUb 255.0 dez 0.00 255.0 FUNCTION_LIST DFPM_DEKON IF_DATA DIM_X DIRECT 0x810B80 /end CHARACTERISTIC
/begin CHARACTERISTIC TSFEV6 "Fehlersummenzeit: EV von Zyl. 6" VALUE 0x810B81 KwUb 255.0 dez 0.00 255.0 FUNCTION_LIST DFPM_DEKON IF_DATA DIM_X DIRECT 0x810B81 /end CHARACTERISTIC
/begin CHARACTERISTIC TSFFGRL "Fehlersummenzeit: FGR-Lampe über CAN" VALUE 0x810B82 KwUb 255.0 dez 0.00 255.0 FUNCTION_LIST DFPM_DCFGRL IF_DATA DIM_X DIRECT 0x810B82 /end CHARACTERISTIC
/begin CHARACTERISTIC TSFFP1P "Fehlersummenzeit: Poti 1, Fahrpedal" VALUE 0x810B83 KwUb 255.0 dez 0.00 255.0 FUNCTION_LIST DFPM_GGPED IF_DATA DIM_X DIRECT 0x810B83 /end CHARACTERISTIC
/begin CHARACTERISTIC TSFFP2P "Fehlersummenzeit: Poti 2, Fahrpedal" VALUE 0x810B84 KwUb 255.0 dez 0.00 255.0 FUNCTION_LIST DFPM_GGPED IF_DATA DIM_X DIRECT 0x810B84 /end CHARACTERISTIC
/begin CHARACTERISTIC TSFFPP "Fehlersummenzeit: Poti Fahrpedal" VALUE 0x810B85 KwUb 255.0 dez 0.00 255.0 FUNCTION_LIST DFPM_GGPED IF_DATA DIM_X DIRECT 0x810B85 /end CHARACTERISTIC
/begin CHARACTERISTIC TSFFRAO "Fehlersummenzeit: LR-Adaption oberer Bereich" VALUE 0x810B86 KwUb 255.0 dez 0.00 255.0 FUNCTION_LIST DFPM_DKVS IF_DATA DIM_X DIRECT 0x810B86 /end CHARACTERISTIC
/begin CHARACTERISTIC TSFFRAO2 "Fehlersummenzeit: LR-Adaption oberer Bereich Bank 2" VALUE 0x810B87 KwUb 255.0 dez 0.00 255.0 FUNCTION_LIST DFPM_DKVS IF_DATA DIM_X DIRECT 0x810B87 /end CHARACTERISTIC
/begin CHARACTERISTIC TSFFRAU "Fehlersummenzeit: LR-Adaption unterer Bereich" VALUE 0x810B88 KwUb 255.0 dez 0.00 255.0 FUNCTION_LIST DFPM_DKVS IF_DATA DIM_X DIRECT 0x810B88 /end CHARACTERISTIC
/begin CHARACTERISTIC TSFFRAU2 "Fehlersummenzeit: LR-Adaption unterer Bereich Bank 2" VALUE 0x810B89 KwUb 255.0 dez 0.00 255.0 FUNCTION_LIST DFPM_DKVS IF_DATA DIM_X DIRECT 0x810B89 /end CHARACTERISTIC
/begin CHARACTERISTIC TSFFRST "Fehlersummenzeit: LR-Abweichung" VALUE 0x810B8A KwUb 255.0 dez 0.00 255.0 FUNCTION_LIST DFPM_DKVS IF_DATA DIM_X DIRECT 0x810B8A /end CHARACTERISTIC
/begin CHARACTERISTIC TSFFRST2 "Fehlersummenzeit: LR-Abweichung Bank 2" VALUE 0x810B8B KwUb 255.0 dez 0.00 255.0 FUNCTION_LIST DFPM_DKVS IF_DATA DIM_X DIRECT 0x810B8B /end CHARACTERISTIC
/begin CHARACTERISTIC TSFHSH "Fehlersummenzeit: Lambdasonden-Heizung hinter Katalysator" VALUE 0x810B8C KwUb 255.0 dez 0.00 255.0 FUNCTION_LIST DFPM_DHLSHK IF_DATA DIM_X DIRECT 0x810B8C /end CHARACTERISTIC
/begin CHARACTERISTIC TSFHSH2 "Fehlersummenzeit: Lambdasonden-Heizung hinter Katalysator, Bank 2" VALUE 0x810B8D KwUb 255.0 dez 0.00 255.0 FUNCTION_LIST DFPM_DHLSHK IF_DATA DIM_X DIRECT 0x810B8D /end CHARACTERISTIC
/begin CHARACTERISTIC TSFHSHE "Fehlersummenzeit: Endstufe Heizung Sonde hinter Kat." VALUE 0x810B8E KwUb 255.0 dez 0.00 255.0 FUNCTION_LIST DFPM_DEKON IF_DATA DIM_X DIRECT 0x810B8E /end CHARACTERISTIC
/begin CHARACTERISTIC TSFHSHE2 "Fehlersummenzeit: Endstufe Heizung Sonde hinter Kat. Bank 2" VALUE 0x810B8F KwUb 255.0 dez 0.00 255.0 FUNCTION_LIST DFPM_DEKON IF_DATA DIM_X DIRECT 0x810B8F /end CHARACTERISTIC
/begin CHARACTERISTIC TSFHSV "Fehlersummenzeit: Lambdasonden-Heizung vor Katalysator" VALUE 0x810B90 KwUb 255.0 dez 0.00 255.0 FUNCTION_LIST DFPM_DHLSU IF_DATA DIM_X DIRECT 0x810B90 /end CHARACTERISTIC
/begin CHARACTERISTIC TSFHSV2 "Fehlersummenzeit: Lambdasonden-Heizung vor Katalysator, Bank 2" VALUE 0x810B91 KwUb 255.0 dez 0.00 255.0 FUNCTION_LIST DFPM_DHLSU IF_DATA DIM_X DIRECT 0x810B91 /end CHARACTERISTIC
/begin CHARACTERISTIC TSFHSVSA "Fehlersummenzeit: Lambdasonden-Heizung vor Katalysator" VALUE 0x810B92 KwUb 255.0 dez 0.00 255.0 FUNCTION_LIST DFPM_DHLSU IF_DATA DIM_X DIRECT 0x810B92 /end CHARACTERISTIC
/begin CHARACTERISTIC TSFHSVSA2 "Fehlersummenzeit: Lambdasonden-Heizung vor Katalysator, Bank 2" VALUE 0x810B93 KwUb 255.0 dez 0.00 255.0 FUNCTION_LIST DFPM_DHLSU IF_DATA DIM_X DIRECT 0x810B93 /end CHARACTERISTIC
/begin CHARACTERISTIC TSFKAT "Fehlersummenzeit: Katalysator-Konvertierung" VALUE 0x810B94 KwUb 255.0 dez 0.00 255.0 FUNCTION_LIST DFPM_DKAT IF_DATA DIM_X DIRECT 0x810B94 /end CHARACTERISTIC
/begin CHARACTERISTIC TSFKAT2 "Fehlersummenzeit: Katalysator-Konvertierung (Bank 2)" VALUE 0x810B95 KwUb 255.0 dez 0.00 255.0 FUNCTION_LIST DFPM_DKAT IF_DATA DIM_X DIRECT 0x810B95 /end CHARACTERISTIC
/begin CHARACTERISTIC TSFKOS "Fehlersummenzeit: Klimakompressorsteuerung" VALUE 0x810B96 KwUb 255.0 dez 0.00 255.0 FUNCTION_LIST DFPM_DEKON IF_DATA DIM_X DIRECT 0x810B96 /end CHARACTERISTIC
/begin CHARACTERISTIC TSFKPE "Fehlersummenzeit: EKP-Relais Endstufe" VALUE 0x810B97 KwUb 255.0 dez 0.00 255.0 FUNCTION_LIST DFPM_DEKON IF_DATA DIM_X DIRECT 0x810B97 /end CHARACTERISTIC
/begin CHARACTERISTIC TSFKRNT "Fehlersummenzeit: Klopfregelung Nulltest" VALUE 0x810B98 KwUb 255.0 dez 0.00 255.0 FUNCTION_LIST DFPM_DKRNT IF_DATA DIM_X DIRECT 0x810B98 /end CHARACTERISTIC
/begin CHARACTERISTIC TSFKROF "Fehlersummenzeit: Klopfregelung Offset" VALUE 0x810B99 KwUb 255.0 dez 0.00 255.0 FUNCTION_LIST DFPM_DKRNT IF_DATA DIM_X DIRECT 0x810B99 /end CHARACTERISTIC
/begin CHARACTERISTIC TSFKRTP "Fehlersummenzeit: Klopfregelung Testimpuls" VALUE 0x810B9A KwUb 255.0 dez 0.00 255.0 FUNCTION_LIST DFPM_DKRTP IF_DATA DIM_X DIRECT 0x810B9A /end CHARACTERISTIC
/begin CHARACTERISTIC TSFKS1 "Fehlersummenzeit: Klopfsensor 1" VALUE 0x810B9B KwUb 255.0 dez 0.00 255.0 FUNCTION_LIST DFPM_DKRS IF_DATA DIM_X DIRECT 0x810B9B /end CHARACTERISTIC
/begin CHARACTERISTIC TSFKS2 "Fehlersummenzeit: Klopfsensor 2" VALUE 0x810B9C KwUb 255.0 dez 0.00 255.0 FUNCTION_LIST DFPM_DKRS IF_DATA DIM_X DIRECT 0x810B9C /end CHARACTERISTIC
/begin CHARACTERISTIC TSFKS3 "Fehlersummenzeit: Klopfsensor 3" VALUE 0x810B9D KwUb 255.0 dez 0.00 255.0 FUNCTION_LIST DFPM_DKRS IF_DATA DIM_X DIRECT 0x810B9D /end CHARACTERISTIC
/begin CHARACTERISTIC TSFKS4 "Fehlersummenzeit: Klopfsensor 4" VALUE 0x810B9E KwUb 255.0 dez 0.00 255.0 FUNCTION_LIST DFPM_DKRS IF_DATA DIM_X DIRECT 0x810B9E /end CHARACTERISTIC
/begin CHARACTERISTIC TSFKUPPL "Fehlersummenzeit: Pedalwertgeber Kupplung" VALUE 0x810B9F KwUb 255.0 dez 0.00 255.0 FUNCTION_LIST DFPM_DKUPPL IF_DATA DIM_X DIRECT 0x810B9F /end CHARACTERISTIC
/begin CHARACTERISTIC TSFKWAVE "Fehlersummenzeit: Kühlwasserabsperrventil Endstufe" VALUE 0x810BA0 KwUb 255.0 dez 0.00 255.0 FUNCTION_LIST DFPM_DEKON IF_DATA DIM_X DIRECT 0x810BA0 /end CHARACTERISTIC
/begin CHARACTERISTIC TSFLASH "Fehlersummenzeit: Lambda-Sondenalterung hinter Kat." VALUE 0x810BA1 KwUb 255.0 dez 0.00 255.0 FUNCTION_LIST DFPM_DLSAHK IF_DATA DIM_X DIRECT 0x810BA1 /end CHARACTERISTIC
/begin CHARACTERISTIC TSFLASH2 "Fehlersummenzeit: Lambda-Sondenalterung hinter Kat. (Bank 2)" VALUE 0x810BA2 KwUb 255.0 dez 0.00 255.0 FUNCTION_LIST DFPM_DLSAHK IF_DATA DIM_X DIRECT 0x810BA2 /end CHARACTERISTIC
/begin CHARACTERISTIC TSFLDE "Fehlersummenzeit: Ladedrucksteuerventil (Endstufe)" VALUE 0x810BA3 KwUb 255.0 dez 0.00 255.0 FUNCTION_LIST DFPM_DEKON IF_DATA DIM_X DIRECT 0x810BA3 /end CHARACTERISTIC
/begin CHARACTERISTIC TSFLDO "Fehlersummenzeit: Ladedruckkennlinie; oberer Wert überschritten" VALUE 0x810BA4 KwUb 255.0 dez 0.00 255.0 FUNCTION_LIST DFPM_DLDR IF_DATA DIM_X DIRECT 0x810BA4 /end CHARACTERISTIC
/begin CHARACTERISTIC TSFLDRA "Fehlersummenzeit: Ladedruckregelabweichung" VALUE 0x810BA5 KwUb 255.0 dez 0.00 255.0 FUNCTION_LIST DFPM_DLDR IF_DATA DIM_X DIRECT 0x810BA5 /end CHARACTERISTIC
/begin CHARACTERISTIC TSFLF1E "Fehlersummenzeit: Lüfter1 (Endstufe)" VALUE 0x810BA6 KwUb 255.0 dez 0.00 255.0 FUNCTION_LIST DFPM_DEKON IF_DATA DIM_X DIRECT 0x810BA6 /end CHARACTERISTIC
/begin CHARACTERISTIC TSFLF2E "Fehlersummenzeit: Lüfter2 (Endstufe)" VALUE 0x810BA7 KwUb 255.0 dez 0.00 255.0 FUNCTION_LIST DFPM_DEKON IF_DATA DIM_X DIRECT 0x810BA7 /end CHARACTERISTIC
/begin CHARACTERISTIC TSFLF3E "Fehlersummenzeit: Lüfter3 (Endstufe)" VALUE 0x810BA8 KwUb 255.0 dez 0.00 255.0 FUNCTION_LIST DFPM_DEKON IF_DATA DIM_X DIRECT 0x810BA8 /end CHARACTERISTIC
/begin CHARACTERISTIC TSFLLR "Fehlersummenzeit: Leerlaufregelung am Anschlag" VALUE 0x810BA9 KwUb 255.0 dez 0.00 255.0 FUNCTION_LIST DFPM_DLLR IF_DATA DIM_X DIRECT 0x810BA9 /end CHARACTERISTIC
/begin CHARACTERISTIC TSFLM "Fehlersummenzeit: LMM/HLM/HFM" VALUE 0x810BAA KwUb 255.0 dez 0.00 255.0 FUNCTION_LIST DFPM_DHFM IF_DATA DIM_X DIRECT 0x810BAA /end CHARACTERISTIC
/begin CHARACTERISTIC TSFLSH "Fehlersummenzeit: Lambda-Sonde hinter Kat" VALUE 0x810BAB KwUb 255.0 dez 0.00 255.0 FUNCTION_LIST DFPM_DLSH IF_DATA DIM_X DIRECT 0x810BAB /end CHARACTERISTIC
/begin CHARACTERISTIC TSFLSH2 "Fehlersummenzeit: Lambda-Sonde 2 hinter Kat" VALUE 0x810BAC KwUb 255.0 dez 0.00 255.0 FUNCTION_LIST DFPM_DLSH IF_DATA DIM_X DIRECT 0x810BAC /end CHARACTERISTIC
/begin CHARACTERISTIC TSFLSV "Fehlersummenzeit: Lambda-Sonde vor Kat" VALUE 0x810BAD KwUb 255.0 dez 0.00 255.0 FUNCTION_LIST DFPM_DLSU IF_DATA DIM_X DIRECT 0x810BAD /end CHARACTERISTIC
/begin CHARACTERISTIC TSFLSV2 "Fehlersummenzeit: Lambda-Sonde 2 vor Kat" VALUE 0x810BAE KwUb 255.0 dez 0.00 255.0 FUNCTION_LIST DFPM_DLSU IF_DATA DIM_X DIRECT 0x810BAE /end CHARACTERISTIC
/begin CHARACTERISTIC TSFLSVV "Fehlersummenzeit: Vertauschte Lambda-Sonden vor Kat" VALUE 0x810BAF KwUb 255.0 dez 0.00 255.0 FUNCTION_LIST DFPM_LSVV IF_DATA DIM_X DIRECT 0x810BAF /end CHARACTERISTIC
/begin CHARACTERISTIC TSFMD "Fehlersummenzeit: Aussetzer, Summenfehler (multiple)" VALUE 0x810BB0 KwUb 255.0 dez 0.00 255.0 FUNCTION_LIST DFPM_DMDMIL IF_DATA DIM_X DIRECT 0x810BB0 /end CHARACTERISTIC
/begin CHARACTERISTIC TSFMD00 "Fehlersummenzeit: Aussetzer Zyl. 0" VALUE 0x810BB1 KwUb 255.0 dez 0.00 255.0 FUNCTION_LIST DFPM_DMDMIL IF_DATA DIM_X DIRECT 0x810BB1 /end CHARACTERISTIC
/begin CHARACTERISTIC TSFMD01 "Fehlersummenzeit: Aussetzer Zyl. 1" VALUE 0x810BB2 KwUb 255.0 dez 0.00 255.0 FUNCTION_LIST DFPM_DMDMIL IF_DATA DIM_X DIRECT 0x810BB2 /end CHARACTERISTIC
/begin CHARACTERISTIC TSFMD02 "Fehlersummenzeit: Aussetzer Zylinder 2" VALUE 0x810BB3 KwUb 255.0 dez 0.00 255.0 FUNCTION_LIST DFPM_DMDMIL IF_DATA DIM_X DIRECT 0x810BB3 /end CHARACTERISTIC
/begin CHARACTERISTIC TSFMD03 "Fehlersummenzeit: Aussetzer Zylinder 3" VALUE 0x810BB4 KwUb 255.0 dez 0.00 255.0 FUNCTION_LIST DFPM_DMDMIL IF_DATA DIM_X DIRECT 0x810BB4 /end CHARACTERISTIC
/begin CHARACTERISTIC TSFMD04 "Fehlersummenzeit: Aussetzer Zylinder 4" VALUE 0x810BB5 KwUb 255.0 dez 0.00 255.0 FUNCTION_LIST DFPM_DMDMIL IF_DATA DIM_X DIRECT 0x810BB5 /end CHARACTERISTIC
/begin CHARACTERISTIC TSFMD05 "Fehlersummenzeit: Aussetzer Zylinder 5" VALUE 0x810BB6 KwUb 255.0 dez 0.00 255.0 FUNCTION_LIST DFPM_DMDMIL IF_DATA DIM_X DIRECT 0x810BB6 /end CHARACTERISTIC
/begin CHARACTERISTIC TSFMDB "Fehlersummenzeit: Momentbegrenzung Sollmoment" VALUE 0x810BB7 KwUb 255.0 dez 0.00 255.0 FUNCTION_LIST DFPM_MDKOG IF_DATA DIM_X DIRECT 0x810BB7 /end CHARACTERISTIC
/begin CHARACTERISTIC TSFMSG "Fehlersummenzeit: Motorraumspülgebläse" VALUE 0x810BB8 KwUb 255.0 dez 0.00 255.0 FUNCTION_LIST DFPM_MLS IF_DATA DIM_X DIRECT 0x810BB8 /end CHARACTERISTIC
/begin CHARACTERISTIC TSFMSGE "Fehlersummenzeit: Motorraumspülgebläse (Endstufe)" VALUE 0x810BB9 KwUb 255.0 dez 0.00 255.0 FUNCTION_LIST DFPM_DEKON IF_DATA DIM_X DIRECT 0x810BB9 /end CHARACTERISTIC
/begin CHARACTERISTIC TSFN "Fehlersummenzeit: Drehzahlgeber" VALUE 0x810BBA KwUb 255.0 dez 0.00 255.0 FUNCTION_LIST DFPM_DDG IF_DATA DIM_X DIRECT 0x810BBA /end CHARACTERISTIC
/begin CHARACTERISTIC TSFNWKW "Fehlersummenzeit: Zuordnung Nockenwelle zu Kurbelwelle" VALUE 0x810BBB KwUb 255.0 dez 0.00 255.0 FUNCTION_LIST DFPM_DNWKW IF_DATA DIM_X DIRECT 0x810BBB /end CHARACTERISTIC
/begin CHARACTERISTIC TSFNWKW2 "Fehlersummenzeit: Zuordnung Nockenwelle 2 zu Kurbelwelle" VALUE 0x810BBC KwUb 255.0 dez 0.00 255.0 FUNCTION_LIST DFPM_DNWKW IF_DATA DIM_X DIRECT 0x810BBC /end CHARACTERISTIC
/begin CHARACTERISTIC TSFNWS "Fehlersummenzeit: Nockenwellensteuerung" VALUE 0x810BBD KwUb 255.0 dez 0.00 255.0 FUNCTION_LIST DFPM_DNWS IF_DATA DIM_X DIRECT 0x810BBD /end CHARACTERISTIC
/begin CHARACTERISTIC TSFNWS2 "Fehlersummenzeit: Nockenwellensteuerung Bank2" VALUE 0x810BBE KwUb 255.0 dez 0.00 255.0 FUNCTION_LIST DFPM_DNWS IF_DATA DIM_X DIRECT 0x810BBE /end CHARACTERISTIC
/begin CHARACTERISTIC TSFNWSE "Fehlersummenzeit: Nockenwellensteuerungsventil Endstufe" VALUE 0x810BBF KwUb 255.0 dez 0.00 255.0 FUNCTION_LIST DFPM_DEKON IF_DATA DIM_X DIRECT 0x810BBF /end CHARACTERISTIC
/begin CHARACTERISTIC TSFNWSE2 "Fehlersummenzeit: Nockenwellensteuerungsventil Endstufe" VALUE 0x810BC0 KwUb 255.0 dez 0.00 255.0 FUNCTION_LIST DFPM_DEKON IF_DATA DIM_X DIRECT 0x810BC0 /end CHARACTERISTIC
/begin CHARACTERISTIC TSFPH "Fehlersummenzeit: Phasensensor" VALUE 0x810BC1 KwUb 255.0 dez 0.00 255.0 FUNCTION_LIST DFPM_DPH IF_DATA DIM_X DIRECT 0x810BC1 /end CHARACTERISTIC
/begin CHARACTERISTIC TSFPH2 "Fehlersummenzeit: Phasensensor 2" VALUE 0x810BC2 KwUb 255.0 dez 0.00 255.0 FUNCTION_LIST DFPM_DPH IF_DATA DIM_X DIRECT 0x810BC2 /end CHARACTERISTIC
/begin CHARACTERISTIC TSFRKAT "Fehlersummenzeit: LR-Adaption additiver Bereich pro Zeit" VALUE 0x810BC3 KwUb 255.0 dez 0.00 255.0 FUNCTION_LIST DFPM_DKVS IF_DATA DIM_X DIRECT 0x810BC3 /end CHARACTERISTIC
/begin CHARACTERISTIC TSFRKAT2 "Fehlersummenzeit: LR-Adaption additiver Bereich pro Zeit Bank 2" VALUE 0x810BC4 KwUb 255.0 dez 0.00 255.0 FUNCTION_LIST DFPM_DKVS IF_DATA DIM_X DIRECT 0x810BC4 /end CHARACTERISTIC
/begin CHARACTERISTIC TSFRKAZ "Fehlersummenzeit: LR-Adaption additiver Bereich pro Zündung" VALUE 0x810BC5 KwUb 255.0 dez 0.00 255.0 FUNCTION_LIST DFPM_DKVS IF_DATA DIM_X DIRECT 0x810BC5 /end CHARACTERISTIC
/begin CHARACTERISTIC TSFRKAZ2 "Fehlersummenzeit: LR-Adaption additiver Bereich pro Zündung Bank 2" VALUE 0x810BC6 KwUb 255.0 dez 0.00 255.0 FUNCTION_LIST DFPM_DKVS IF_DATA DIM_X DIRECT 0x810BC6 /end CHARACTERISTIC
/begin CHARACTERISTIC TSFSGEEP "Fehlersummenzeit: Steuergerät defekt (EEPROM)" VALUE 0x810BC7 KwUb 255.0 dez 0.00 255.0 FUNCTION_LIST DFPM_DSGEEP IF_DATA DIM_X DIRECT 0x810BC7 /end CHARACTERISTIC
/begin CHARACTERISTIC TSFSLPE "Fehlersummenzeit: Sekundärluftpumpe (Endstufe)" VALUE 0x810BC8 KwUb 255.0 dez 0.00 255.0 FUNCTION_LIST DFPM_DEKON IF_DATA DIM_X DIRECT 0x810BC8 /end CHARACTERISTIC
/begin CHARACTERISTIC TSFSLS "Fehlersummenzeit: Sekundärluft-System" VALUE 0x810BC9 KwUb 255.0 dez 0.00 255.0 FUNCTION_LIST DFPM_DSLSLRS IF_DATA DIM_X DIRECT 0x810BC9 /end CHARACTERISTIC
/begin CHARACTERISTIC TSFSLS2 "Fehlersummenzeit: Sekundärluft-System Bank 2" VALUE 0x810BCA KwUb 255.0 dez 0.00 255.0 FUNCTION_LIST DFPM_DSLSLRS IF_DATA DIM_X DIRECT 0x810BCA /end CHARACTERISTIC
/begin CHARACTERISTIC TSFSLV "Fehlersummenzeit: Sekundärluftventil" VALUE 0x810BCB KwUb 255.0 dez 0.00 255.0 FUNCTION_LIST DFPM_DSLSLRS IF_DATA DIM_X DIRECT 0x810BCB /end CHARACTERISTIC
/begin CHARACTERISTIC TSFSLV2 "Fehlersummenzeit: Sekundärluftventil, Bank 2" VALUE 0x810BCC KwUb 255.0 dez 0.00 255.0 FUNCTION_LIST DFPM_DSLSLRS IF_DATA DIM_X DIRECT 0x810BCC /end CHARACTERISTIC
/begin CHARACTERISTIC TSFSLVE "Fehlersummenzeit: Sekundärluftventil (Endstufe)" VALUE 0x810BCD KwUb 255.0 dez 0.00 255.0 FUNCTION_LIST DFPM_DEKON IF_DATA DIM_X DIRECT 0x810BCD /end CHARACTERISTIC
/begin CHARACTERISTIC TSFSWE "Fehlersummenzeit: Beschleunigungssensor der Schlechtwegeerkennung" VALUE 0x810BCE KwUb 255.0 dez 0.00 255.0 FUNCTION_LIST DFPM_BGRBS IF_DATA DIM_X DIRECT 0x810BCE /end CHARACTERISTIC
/begin CHARACTERISTIC TSFTA "Fehlersummenzeit: Ansauglufttemperatur TANS" VALUE 0x810BCF KwUb 255.0 dez 0.00 255.0 FUNCTION_LIST DFPM_GGTFA IF_DATA DIM_X DIRECT 0x810BCF /end CHARACTERISTIC
/begin CHARACTERISTIC TSFTES "Fehlersummenzeit: Tankentlüftungssystem" VALUE 0x810BD0 KwUb 255.0 dez 0.00 255.0 FUNCTION_LIST DFPM_DTEV IF_DATA DIM_X DIRECT 0x810BD0 /end CHARACTERISTIC
/begin CHARACTERISTIC TSFTEVE "Fehlersummenzeit: Tankentlüftungsventil Endstufe" VALUE 0x810BD1 KwUb 255.0 dez 0.00 255.0 FUNCTION_LIST DFPM_DEKON IF_DATA DIM_X DIRECT 0x810BD1 /end CHARACTERISTIC
/begin CHARACTERISTIC TSFTEVE2 "Fehlersummenzeit: Tankentlüftungsventil Endstufe  Bank2" VALUE 0x810BD2 KwUb 255.0 dez 0.00 255.0 FUNCTION_LIST DFPM_DUMMY043 IF_DATA DIM_X DIRECT 0x810BD2 /end CHARACTERISTIC
/begin CHARACTERISTIC TSFTGET "Fehlersummenzeit: Getriebetemperatur" VALUE 0x810BD3 KwUb 255.0 dez 0.00 255.0 FUNCTION_LIST DFPM_GGTGET IF_DATA DIM_X DIRECT 0x810BD3 /end CHARACTERISTIC
/begin CHARACTERISTIC TSFTHM "Fehlersummenzeit: Thermostat-Diagnose THM" VALUE 0x810BD4 KwUb 255.0 dez 0.00 255.0 FUNCTION_LIST DFPM_GGTFM IF_DATA DIM_X DIRECT 0x810BD4 /end CHARACTERISTIC
/begin CHARACTERISTIC TSFTM "Fehlersummenzeit: Motortemperatur TMOT" VALUE 0x810BD5 KwUb 255.0 dez 0.00 255.0 FUNCTION_LIST DFPM_GGTFM IF_DATA DIM_X DIRECT 0x810BD5 /end CHARACTERISTIC
/begin CHARACTERISTIC TSFTMKI "Fehlersummenzeit: Motortemperatur aus Kombiinstrument TMKI" VALUE 0x810BD6 KwUb 255.0 dez 0.00 255.0 FUNCTION_LIST DFPM_DUMMY043 IF_DATA DIM_X DIRECT 0x810BD6 /end CHARACTERISTIC
/begin CHARACTERISTIC TSFTMR "Fehlersummenzeit: Motorraumtemperatur TMR" VALUE 0x810BD7 KwUb 255.0 dez 0.00 255.0 FUNCTION_LIST DFPM_GGTFMR IF_DATA DIM_X DIRECT 0x810BD7 /end CHARACTERISTIC
/begin CHARACTERISTIC TSFTOL "Fehlersummenzeit: Öltemperatur" VALUE 0x810BD8 KwUb 255.0 dez 0.00 255.0 FUNCTION_LIST DFPM_GGTFOL IF_DATA DIM_X DIRECT 0x810BD8 /end CHARACTERISTIC
/begin CHARACTERISTIC TSFTUM "Fehlersummenzeit: Umgebungstemperatur TUM" VALUE 0x810BD9 KwUb 255.0 dez 0.00 255.0 FUNCTION_LIST DFPM_GGTFUMG IF_DATA DIM_X DIRECT 0x810BD9 /end CHARACTERISTIC
/begin CHARACTERISTIC TSFUB "Fehlersummenzeit: Batteriespannung UB (Bordnetz)" VALUE 0x810BDA KwUb 255.0 dez 0.00 255.0 FUNCTION_LIST DFPM_GGUB IF_DATA DIM_X DIRECT 0x810BDA /end CHARACTERISTIC
/begin CHARACTERISTIC TSFUFMV "Fehlersummenzeit: Funktionsüberwachung: Momentenvergleich" VALUE 0x810BDB KwUb 255.0 dez 0.00 255.0 FUNCTION_LIST DFPM_DUF IF_DATA DIM_X DIRECT 0x810BDB /end CHARACTERISTIC
/begin CHARACTERISTIC TSFUFSKA "Fehlersummenzeit: Funktionsüberwachung: Sicherheits-Kraftstoff-Abschaltung" VALUE 0x810BDC KwUb 255.0 dez 0.00 255.0 FUNCTION_LIST DFPM_DUF IF_DATA DIM_X DIRECT 0x810BDC /end CHARACTERISTIC
/begin CHARACTERISTIC TSFURRAM "Fehlersummenzeit: Rechnerüberwachung: RAM" VALUE 0x810BDD KwUb 255.0 dez 0.00 255.0 FUNCTION_LIST DFPM_DUR IF_DATA DIM_X DIRECT 0x810BDD /end CHARACTERISTIC
/begin CHARACTERISTIC TSFURROM "Fehlersummenzeit: Rechnerüberwachung: ROM" VALUE 0x810BDE KwUb 255.0 dez 0.00 255.0 FUNCTION_LIST DFPM_DUR IF_DATA DIM_X DIRECT 0x810BDE /end CHARACTERISTIC
/begin CHARACTERISTIC TSFURRST "Fehlersummenzeit: Rechnerüberwachung: Reset" VALUE 0x810BDF KwUb 255.0 dez 0.00 255.0 FUNCTION_LIST DFPM_DUR IF_DATA DIM_X DIRECT 0x810BDF /end CHARACTERISTIC
/begin CHARACTERISTIC TSFUVSE "Fehlersummenzeit: Endstufe Umluftventil Turbo" VALUE 0x810BE0 KwUb 255.0 dez 0.00 255.0 FUNCTION_LIST DFPM_DEKON IF_DATA DIM_X DIRECT 0x810BE0 /end CHARACTERISTIC
/begin CHARACTERISTIC TSFVFZ "Fehlersummenzeit: Fahrzeug-Geschwindigkeit" VALUE 0x810BE1 KwUb 255.0 dez 0.00 255.0 FUNCTION_LIST DFPM_DVFZ IF_DATA DIM_X DIRECT 0x810BE1 /end CHARACTERISTIC
/begin CHARACTERISTIC TSFVS01 "" VALUE 0x810BE2 KwUb 255.0 dez 0.00 255.0 FUNCTION_LIST DFPM_DVS IF_DATA DIM_X DIRECT 0x810BE2 /end CHARACTERISTIC
/begin CHARACTERISTIC TSFVS02 "" VALUE 0x810BE3 KwUb 255.0 dez 0.00 255.0 FUNCTION_LIST DFPM_DVS IF_DATA DIM_X DIRECT 0x810BE3 /end CHARACTERISTIC
/begin CHARACTERISTIC TSFVS03 "" VALUE 0x810BE4 KwUb 255.0 dez 0.00 255.0 FUNCTION_LIST DFPM_DVS IF_DATA DIM_X DIRECT 0x810BE4 /end CHARACTERISTIC
/begin CHARACTERISTIC TSFVS04 "" VALUE 0x810BE5 KwUb 255.0 dez 0.00 255.0 FUNCTION_LIST DFPM_DVS IF_DATA DIM_X DIRECT 0x810BE5 /end CHARACTERISTIC
/begin CHARACTERISTIC TSFVS05 "" VALUE 0x810BE6 KwUb 255.0 dez 0.00 255.0 FUNCTION_LIST DFPM_DVS IF_DATA DIM_X DIRECT 0x810BE6 /end CHARACTERISTIC
/begin CHARACTERISTIC TSFVS06 "" VALUE 0x810BE7 KwUb 255.0 dez 0.00 255.0 FUNCTION_LIST DFPM_DVS IF_DATA DIM_X DIRECT 0x810BE7 /end CHARACTERISTIC
/begin CHARACTERISTIC TSFVS1E "Fehlersummenzeit: Endstufe Ventilhubsteuerung 1" VALUE 0x810BE8 KwUb 255.0 dez 0.00 255.0 FUNCTION_LIST DFPM_DEKON IF_DATA DIM_X DIRECT 0x810BE8 /end CHARACTERISTIC
/begin CHARACTERISTIC TSFVS2E "Fehlersummenzeit: Endstufe Ventilhubsteuerung 2" VALUE 0x810BE9 KwUb 255.0 dez 0.00 255.0 FUNCTION_LIST DFPM_DEKON IF_DATA DIM_X DIRECT 0x810BE9 /end CHARACTERISTIC
/begin CHARACTERISTIC TSFVSB1 "" VALUE 0x810BEA KwUb 255.0 dez 0.00 255.0 FUNCTION_LIST DFPM_DVS IF_DATA DIM_X DIRECT 0x810BEA /end CHARACTERISTIC
/begin CHARACTERISTIC TSFVSB2 "" VALUE 0x810BEB KwUb 255.0 dez 0.00 255.0 FUNCTION_LIST DFPM_DVS IF_DATA DIM_X DIRECT 0x810BEB /end CHARACTERISTIC
/begin CHARACTERISTIC TSFVSS "" VALUE 0x810BEC KwUb 255.0 dez 0.00 255.0 FUNCTION_LIST DFPM_DVS IF_DATA DIM_X DIRECT 0x810BEC /end CHARACTERISTIC
/begin CHARACTERISTIC TSFWFS "Fehlersummenzeit: Wegfahrsperre" VALUE 0x810BED KwUb 255.0 dez 0.00 255.0 FUNCTION_LIST DFPM_WFS IF_DATA DIM_X DIRECT 0x810BED /end CHARACTERISTIC
/begin CHARACTERISTIC TSFZZZ "Dummy: Tabellenende" VALUE 0x810BEE KwUb 255.0 dez 0.00 255.0 FUNCTION_LIST DFPM_DFPM IF_DATA DIM_X DIRECT 0x810BEE /end CHARACTERISTIC
/begin CHARACTERISTIC TSKRLDAB "Zeitkonstante für schnelle LDR-Absenkung" CURVE 0x81D714 GklWUw 64.2009796 zk50msxs_uw_b3276p8 0.0500007630 64.2509804 FUNCTION_LIST LDRLMX IF_DATA DIM_X DIRECT 0x81D714
 /begin AXIS_DESCR COM_AXIS nmot_w nmot_uw_q0p25 8 0.00 16383.75 AXIS_PTS_REF SNM08LDUW /end AXIS_DESCR
/end CHARACTERISTIC
/begin CHARACTERISTIC TSKRLDAU "Zeitkonstante für schnelle LDR-Aufregelung" CURVE 0x81D724 GklWUw 64.2009796 zk50msxs_uw_b3276p8 0.0500007630 64.2509804 FUNCTION_LIST LDRLMX IF_DATA DIM_X DIRECT 0x81D724
 /begin AXIS_DESCR COM_AXIS nmot_w nmot_uw_q0p25 8 0.00 16383.75 AXIS_PTS_REF SNM08LDUW /end AXIS_DESCR
/end CHARACTERISTIC
/begin CHARACTERISTIC TSLABB "Verweilzeit für Sekundärluft- Abbruchbedingung" VALUE 0x81817A KwUb 25.40 t100msxs_ub_b25p5 0.1000 25.50 FUNCTION_LIST SLS IF_DATA DIM_X DIRECT 0x81817A /end CHARACTERISTIC
/begin CHARACTERISTIC TSLPMN "Mindesteinschaltdauer der Sekundärluftpumpe" VALUE 0x81817B KwUb 25.40 t100msxs_ub_b25p5 0.1000 25.50 FUNCTION_LIST SLS IF_DATA DIM_X DIRECT 0x81817B /end CHARACTERISTIC
/begin CHARACTERISTIC TSLUBST "Entprellzeit für Sekundärluft ein im Start bei UBSLSTMN" VALUE 0x81817C KwUb 25.50 t100msxs_ub_b25p5 0.00 25.50 FUNCTION_LIST SLS IF_DATA DIM_X DIRECT 0x81817C /end CHARACTERISTIC
/begin CHARACTERISTIC TSPUUKA "Sperrzeit fuer Freigabe UK-Adaption" VALUE 0x81134F KwUb 24.50 t100msxs_ub_b25p5 1.000 25.50 FUNCTION_LIST ESUKAS IF_DATA DIM_X DIRECT 0x81134F /end CHARACTERISTIC
/begin CHARACTERISTIC TSTBB "Störunterdrückungszeit für Erkennung Betriebsbereitschaft LSU" VALUE 0x810C75 KwUb 2.550 t10msxs_ub_b2p55 0.00 2.550 FUNCTION_LIST GGLSU IF_DATA DIM_X DIRECT 0x810C75 /end CHARACTERISTIC
/begin CHARACTERISTIC TSTCRATS "Zeit zwischen Startende und Auswertung Crashsignal" VALUE 0x817A50 KwUw 655.3500 t10msxs_uw_b655p35 0.00 655.3500 FUNCTION_LIST GGAIRB IF_DATA DIM_X DIRECT 0x817A50 /end CHARACTERISTIC
/begin CHARACTERISTIC TSTE3VS "Verzugszeit Ventilumsch. nach Startende im Toel-Bereich3 f. B_bmvst3" VALUE 0x819D13 KwUb 5.100 t20msxs_ub_b5p1 0.00 5.100 FUNCTION_LIST VS IF_DATA DIM_X DIRECT 0x819D13 /end CHARACTERISTIC
/begin CHARACTERISTIC TSTEAA "Sperrzeit nach B_te (TEA aktiv)" VALUE 0x81996F KwUb 25.50 t100msxs_ub_b25p5 0.00 25.50 FUNCTION_LIST SWADP IF_DATA DIM_X DIRECT 0x81996F /end CHARACTERISTIC
/begin CHARACTERISTIC TSWKNBGA "Zeit bis Setzwertkorrektur nach Ende Beschleunigen" CURVE 0x81BAAC KlAUwSstUwWUw 1310.700 t20msxs_uw_q0p02 0.00 1310.700 FUNCTION_LIST FGRMD IF_DATA DIM_X DIRECT 0x81BAAC /begin AXIS_DESCR STD_AXIS gangi dez 8 0.00 65535.00 DEPOSIT ABSOLUT /end AXIS_DESCR /end CHARACTERISTIC
/begin CHARACTERISTIC TSWKNVGA "Zeit bis Setzwertkorrektur nach Ende Verzögern" CURVE 0x81BACE KlAUwSstUwWUw 1310.700 t20msxs_uw_q0p02 0.00 1310.700 FUNCTION_LIST FGRMD IF_DATA DIM_X DIRECT 0x81BACE /begin AXIS_DESCR STD_AXIS gangi dez 8 0.00 65535.00 DEPOSIT ABSOLUT /end AXIS_DESCR /end CHARACTERISTIC
/begin CHARACTERISTIC TTBMH "Zeit für theoretische Sondenbetriebsbereitschaft mit Heizung" VALUE 0x81B8E4 KwUw 6553.500 t100msxs_uw_q100 0.00 6553.500 FUNCTION_LIST DLSH IF_DATA DIM_X DIRECT 0x81B8E4 /end CHARACTERISTIC
/begin CHARACTERISTIC TTE "Zeit für Tankentlüftungsphase" VALUE 0x81C708 KwUw 6553.500 t100msxs_uw_b6553p6 0.00 6553.500 FUNCTION_LIST BBTEGA IF_DATA DIM_X DIRECT 0x81C708 /end CHARACTERISTIC
/begin CHARACTERISTIC TTEAE "Zeit für Tankentlüftungsphase bei eingeschwungener Gemischadaption" VALUE 0x81C70A KwUw 6553.500 t100msxs_uw_b6553p6 0.00 6553.500 FUNCTION_LIST BBTEGA IF_DATA DIM_X DIRECT 0x81C70A /end CHARACTERISTIC
/begin CHARACTERISTIC TTEAUS "Zeit nach Start bis TEB aktiv wird" VALUE 0x817678 KwUw 195.0000 t100msxs_uw_q100 5.000000 200.0000 FUNCTION_LIST TEBEB IF_DATA DIM_X DIRECT 0x817678 /end CHARACTERISTIC
/begin CHARACTERISTIC TTEBSTP "Maximal Zeit für TE-Stop im Leerlauf bei nicht gesetzten Zyklusflags" VALUE 0x81C70C KwUw 6553.500 t100msxs_uw_b6553p6 0.00 6553.500 FUNCTION_LIST BBTEGA IF_DATA DIM_X DIRECT 0x81C70C /end CHARACTERISTIC
/begin CHARACTERISTIC TTEGA "Zeit bei der Tankentlüftung für Grundadaption" VALUE 0x81C70E KwUw 6553.500 t100msxs_uw_b6553p6 0.00 6553.500 FUNCTION_LIST BBTEGA IF_DATA DIM_X DIRECT 0x81C70E /end CHARACTERISTIC
/begin CHARACTERISTIC TTEGAI "Zeitdauer der ersten  Gemischadaptionsphase" VALUE 0x81C710 KwUw 6553.500 t100msxs_uw_b6553p6 0.00 6553.500 FUNCTION_LIST BBTEGA IF_DATA DIM_X DIRECT 0x81C710 /end CHARACTERISTIC
/begin CHARACTERISTIC TTEGAZO "Zeit für Tankentlüftungsstop wg. Gemischadaption, obere Schwelle" VALUE 0x81C712 KwUw 6553.500 t100msxs_uw_b6553p6 0.00 6553.500 FUNCTION_LIST BBTEGA IF_DATA DIM_X DIRECT 0x81C712 /end CHARACTERISTIC
/begin CHARACTERISTIC TTEGAZU "Zeit für Tankentlüftungsstop wg. Gemischadaption, untere Schwelle" VALUE 0x81C714 KwUw 6553.500 t100msxs_uw_b6553p6 0.00 6553.500 FUNCTION_LIST BBTEGA IF_DATA DIM_X DIRECT 0x81C714 /end CHARACTERISTIC
/begin CHARACTERISTIC TTEINI "Zeit für Tankentlüftung in erster TE-Phase nach Initialisierung (B_ini)" VALUE 0x81C716 KwUw 6553.500 t100msxs_uw_b6553p6 0.00 6553.500 FUNCTION_LIST BBTEGA IF_DATA DIM_X DIRECT 0x81C716 /end CHARACTERISTIC
/begin CHARACTERISTIC TTEMN "Zeit für Tankentlüftungsphase minimal" VALUE 0x81C718 KwUw 6553.500 t100msxs_uw_b6553p6 0.00 6553.500 FUNCTION_LIST BBTEGA IF_DATA DIM_X DIRECT 0x81C718 /end CHARACTERISTIC
/begin CHARACTERISTIC TTEPRIO "Zeit ab Start für Umschalten auf Dauertankentlüftung" VALUE 0x81C71A KwUw 6553.500 t100msxs_uw_b6553p6 0.00 6553.500 FUNCTION_LIST BBTEGA IF_DATA DIM_X DIRECT 0x81C71A /end CHARACTERISTIC
/begin CHARACTERISTIC TTEVAZ "Verweilzeit für TEV Aufsteuern bei nicht eingeschwungen frm" VALUE 0x819B9F KwUb 10.00 t100msxs_ub_b25p5 0.00 10.00 FUNCTION_LIST DTEV IF_DATA DIM_X DIRECT 0x819B9F /end CHARACTERISTIC
/begin CHARACTERISTIC TTEZAO "Zeit für Tankentlüftung Daueraktivierung, obere Schwelle" VALUE 0x81C71C KwUw 6553.500 t100msxs_uw_b6553p6 0.00 6553.500 FUNCTION_LIST BBTEGA IF_DATA DIM_X DIRECT 0x81C71C /end CHARACTERISTIC
/begin CHARACTERISTIC TTEZAU "Zeit für Tankentlüftung Daueraktivierung, untere Schwelle" VALUE 0x81C71E KwUw 6553.500 t100msxs_uw_b6553p6 0.00 6553.500 FUNCTION_LIST BBTEGA IF_DATA DIM_X DIRECT 0x81C71E /end CHARACTERISTIC
/begin CHARACTERISTIC TTLASH "Zeit für Verweildauer der Sonde hinter KAT unter/oberhalb des Sollwertes" VALUE 0x81B8D2 KwUw 6553.500 t100msxs_uw_b6553p5 0.00 6553.500 FUNCTION_LIST DLSAHK IF_DATA DIM_X DIRECT 0x81B8D2 /end CHARACTERISTIC
/begin CHARACTERISTIC TTMUMASTA "Zeitdauer für Stationärzustand bei temp. UMA-Adaption" VALUE 0x813D8C KwUw 3276.750 t50msxs_q0p05 0.00 3276.750 FUNCTION_LIST BGDVE IF_DATA DIM_X DIRECT 0x813D8C /end CHARACTERISTIC
/begin CHARACTERISTIC TTNST "Schwellwert für Zeit nach Startende bei Halbautomatikstart" VALUE 0x817582 KwUw 655.3500 t_q0p01 0.00 655.3500 FUNCTION_LIST STA IF_DATA DIM_X DIRECT 0x817582 /end CHARACTERISTIC
/begin CHARACTERISTIC TUBKL15 "Filterzeit für redundante KL15-Erfassung" VALUE 0x8198A5 KwUb 2.550 t10msxs_ub_b2p55 0.00 2.550 FUNCTION_LIST GGZDGON IF_DATA DIM_X DIRECT 0x8198A5 /end CHARACTERISTIC
/begin CHARACTERISTIC TULV1 "Verzögerung Überladeabschneiden, ti-Ausblengung Stufe 1" VALUE 0x8193F6 KwUb 12.75 t50msxs_ub_b12p75 0.00 12.75 FUNCTION_LIST DLDR IF_DATA DIM_X DIRECT 0x8193F6 /end CHARACTERISTIC
/begin CHARACTERISTIC TULV3 "Verzögerungszeit für Heilung Überladefehler" VALUE 0x8193F7 KwUb 12.75 t50msxs_ub_b12p75 0.00 12.75 FUNCTION_LIST DLDR IF_DATA DIM_X DIRECT 0x8193F7 /end CHARACTERISTIC
/begin CHARACTERISTIC TUMDETM "Umgebungslufttemperatur-Ersatzwert für Motortemperatur-Modell" VALUE 0x81905F KwUb 191.3 temp_ub_q0p75_o48 -48.00 143.3 FUNCTION_LIST GGTFM IF_DATA DIM_X DIRECT 0x81905F /end CHARACTERISTIC
/begin CHARACTERISTIC TUMGTAI "Initialisierungswert Umgebungstemperatur" VALUE 0x8190C6 KwUb 191.3 temp_ub_q0p75_o48 -48.00 143.3 FUNCTION_LIST GGTFUMG IF_DATA DIM_X DIRECT 0x8190C6 /end CHARACTERISTIC
/begin CHARACTERISTIC TUMTAI "Initialisierungswert Umgebungstemperatur" VALUE 0x818806 KwUb 191.3 temp_ub_q0p75_o48 -48.00 143.3 FUNCTION_LIST BGTABS IF_DATA DIM_X DIRECT 0x818806 /end CHARACTERISTIC
/begin CHARACTERISTIC TUMTAIT "Initialisierungswert Umgebungstemperatur aus TANS" VALUE 0x81835B KwUb 191.3 temp_ub_q0p75_o48 -48.00 143.3 FUNCTION_LIST ATM IF_DATA DIM_X DIRECT 0x81835B /end CHARACTERISTIC
/begin CHARACTERISTIC TUPWBWF "Fehlerzeit bei Bewegungserkennung" VALUE 0x810E34 KwUb 2.550 t10msxs_ub_b2p55 0.00 2.550 FUNCTION_LIST GGPED IF_DATA DIM_X DIRECT 0x810E34 /end CHARACTERISTIC
/begin CHARACTERISTIC TUPWBWV "Zeitverzögerung zum Einspeichern eines neuen Poti 2 Wertes" VALUE 0x810E35 KwUb 2.550 t10msxs_ub_b2p55 0.00 2.550 FUNCTION_LIST GGPED IF_DATA DIM_X DIRECT 0x810E35 /end CHARACTERISTIC
/begin CHARACTERISTIC TUPWG12 "Fehlerzeit bei Vergleich von PWG-Poti 1 und 2" VALUE 0x810E36 KwUb 2.550 t10msxs_ub_b2p55 0.00 2.550 FUNCTION_LIST GGPED IF_DATA DIM_X DIRECT 0x810E36 /end CHARACTERISTIC
/begin CHARACTERISTIC TUPWG1O "Fehlerzeit bei Bereichsverletzung von PWG-Poti 1 nach oben" VALUE 0x810E37 KwUb 2.550 t10msxs_ub_b2p55 0.00 2.550 FUNCTION_LIST GGPED IF_DATA DIM_X DIRECT 0x810E37 /end CHARACTERISTIC
/begin CHARACTERISTIC TUPWG1U "Fehlerzeit bei Bereichsverletzung von PWG-Poti 1 nach unten" VALUE 0x810E38 KwUb 2.550 t10msxs_ub_b2p55 0.00 2.550 FUNCTION_LIST GGPED IF_DATA DIM_X DIRECT 0x810E38 /end CHARACTERISTIC
/begin CHARACTERISTIC TUPWG2O "Fehlerzeit bei Bereichsverletzung von PWG-Poti 2 nach oben" VALUE 0x810E39 KwUb 2.550 t10msxs_ub_b2p55 0.00 2.550 FUNCTION_LIST GGPED IF_DATA DIM_X DIRECT 0x810E39 /end CHARACTERISTIC
/begin CHARACTERISTIC TUPWG2U "Fehlerzeit bei Bereichsverletzung von PWG-Poti 2 nach unten" VALUE 0x810E3A KwUb 2.550 t10msxs_ub_b2p55 0.00 2.550 FUNCTION_LIST GGPED IF_DATA DIM_X DIRECT 0x810E3A /end CHARACTERISTIC
/begin CHARACTERISTIC TUSBELH "Zeit für Festhaltung der Sondenspannung nach Impulsbelastung  hinter KAT" VALUE 0x810C71 KwUb 2.550 t10msxs_ub_b2p55 0.00 2.550 FUNCTION_LIST GGLSH IF_DATA DIM_X DIRECT 0x810C71 /end CHARACTERISTIC
/begin CHARACTERISTIC TUSCHUB "Verzögerungszeit für Störspitzen bei Schubprüfung der Sonde hinter KAT" VALUE 0x8183EE KwUb 25.50 t100msxs_ub_b25p5 0.00 25.50 FUNCTION_LIST DLSAHK IF_DATA DIM_X DIRECT 0x8183EE /end CHARACTERISTIC
/begin CHARACTERISTIC TUSDUFA "Verzögerunszeit für Erk. Adernschl. Lamdasonde h.KAT (Funkt. Anford. Kurz-Trip)" VALUE 0x81B8E6 KwUw 6553.500 t100msxs_uw_q100 0.00 6553.500 FUNCTION_LIST DLSH IF_DATA DIM_X DIRECT 0x81B8E6 /end CHARACTERISTIC
/begin CHARACTERISTIC TUSDUH "Verzögerungszeit für Erkennung Adernschluß Lambdasonde hinter KAT" VALUE 0x81B8E8 KwUw 6553.500 t100msxs_uw_q100 0.00 6553.500 FUNCTION_LIST DLSH IF_DATA DIM_X DIRECT 0x81B8E8 /end CHARACTERISTIC
/begin CHARACTERISTIC TUSENLASH "Zeitdauer bis Sonden Mager/Fett Erkennung erlaubt" VALUE 0x81B8D4 KwUw 6553.500 t100msxs_uw_b6553p5 0.00 6553.500 FUNCTION_LIST DLSAHK IF_DATA DIM_X DIRECT 0x81B8D4 /end CHARACTERISTIC
/begin CHARACTERISTIC TUSHSMIN "Mindestdauer für Steigungsmessung für enable Filter" VALUE 0x8183EF KwUb 25.50 t100msxs_ub_b25p5 0.00 25.50 FUNCTION_LIST DLSAHK IF_DATA DIM_X DIRECT 0x8183EF /end CHARACTERISTIC
/begin CHARACTERISTIC TUSKS "Entstörzeit für Abschalten einzelner Funktionen Sonde hinter KAT" VALUE 0x810C6A KwUb 5.100 t20msxs_ub_b5p1 0.00 5.100 FUNCTION_LIST DLSH IF_DATA DIM_X DIRECT 0x810C6A /end CHARACTERISTIC
/begin CHARACTERISTIC TUSLASH "Testzeit füt Dauer Anfettung/Abmagerung hinter KAT" VALUE 0x81B8D6 KwUw 6553.500 t100msxs_uw_b6553p5 0.00 6553.500 FUNCTION_LIST DLSAHK IF_DATA DIM_X DIRECT 0x81B8D6 /end CHARACTERISTIC
/begin CHARACTERISTIC TUSMAX "Überwachungszeit für Usmax" VALUE 0x8183FB KwUb 25.50 t100msxs_ub_b25p5 0.00 25.50 FUNCTION_LIST DLSH IF_DATA DIM_X DIRECT 0x8183FB /end CHARACTERISTIC
/begin CHARACTERISTIC TUSSA "Verzögerungszeit nach Über/Unterschreiten der Regelschwelle hinter KAT" VALUE 0x8183F0 KwUb 25.50 t100msxs_ub_b25p5 0.00 25.50 FUNCTION_LIST DLSAHK IF_DATA DIM_X DIRECT 0x8183F0 /end CHARACTERISTIC
/begin CHARACTERISTIC TUSTAL "Verzög.zeit für Erkennung Adernschluß nach ""Tank leer"" fahren für Sonde h. KAT" VALUE 0x81B8EA KwUw 6553.500 t100msxs_uw_q100 0.00 6553.500 FUNCTION_LIST DLSH IF_DATA DIM_X DIRECT 0x81B8EA /end CHARACTERISTIC
/begin CHARACTERISTIC TV1DVS "Verzugszeit Aktivierung Diagnose Ventilhub bei kleinem Ventilhub" VALUE 0x812301 KwUb 5.100 t20msxs_ub_b5p1 0.00 5.100 FUNCTION_LIST DVS IF_DATA DIM_X DIRECT 0x812301 /end CHARACTERISTIC
/begin CHARACTERISTIC TV2DVS "Verzugszeit Aktivierung Diagnose Ventilhub bei kleinem Ventilhub" VALUE 0x812302 KwUb 5.100 t20msxs_ub_b5p1 0.00 5.100 FUNCTION_LIST DVS IF_DATA DIM_X DIRECT 0x812302 /end CHARACTERISTIC
/begin CHARACTERISTIC TVAUAK "Verzögerungszeit für Rücknahme Bedingung Abgasuntersuchung aktiv" VALUE 0x818133 KwUb 25.50 t100msxs_ub_b25p5 0.00 25.50 FUNCTION_LIST SGAAU IF_DATA DIM_X DIRECT 0x818133 /end CHARACTERISTIC
/begin CHARACTERISTIC TVAUS "Sperrzeit Abgasuntersuchung Störgrößenaufschaltung n. Abbruch" VALUE 0x81A046 KwUw 6553.500 t100msxs_uw_b6553p5 0.00 6553.500 FUNCTION_LIST SGAAU IF_DATA DIM_X DIRECT 0x81A046 /end CHARACTERISTIC
/begin CHARACTERISTIC TVBNMSTA "Einschaltverzögerung für B_nmot zur Starterrelaissteuerung" VALUE 0x8121BE KwUb 2.550 t10msxs_ub_b2p55 0.00 2.550 FUNCTION_LIST STA IF_DATA DIM_X DIRECT 0x8121BE /end CHARACTERISTIC
/begin CHARACTERISTIC TVCJLSU "Verzögerungszeit für Fehler CJ110" VALUE 0x818409 KwUb 25.50 t100msxs_ub_b25p5 0.00 25.50 FUNCTION_LIST DLSU IF_DATA DIM_X DIRECT 0x818409 /end CHARACTERISTIC
/begin CHARACTERISTIC TVDECKOF "Verzugszeit zur Wiederaktivierung Motorraumspülgebläsediagnose" VALUE 0x81DB00 KwUw 6553.500 t100msxs_uw_b6553p6 0.00 6553.500 FUNCTION_LIST MLS IF_DATA DIM_X DIRECT 0x81DB00 /end CHARACTERISTIC
/begin CHARACTERISTIC TVDK "Verzögerungszeit nach Schließen der Drosselklappe" VALUE 0x8114CC KwUb 5.100 t20msxs_ub_b5p1 0.00 5.100 FUNCTION_LIST LLRBB IF_DATA DIM_X DIRECT 0x8114CC /end CHARACTERISTIC
/begin CHARACTERISTIC TVDKBZ_UM "Entprellung Kombi-Botschaftszähler" VALUE 0x817D08 KwUb 10200.0 t40ms_ub_b10200 0.00 10200.0 FUNCTION_LIST UFFGRE IF_DATA DIM_X DIRECT 0x817D08 /end CHARACTERISTIC
/begin CHARACTERISTIC TVDNWS "Wartezeit ab Startende bis DNWS zugelassen" VALUE 0x81BF9E KwUw 655.3500 t10msxs_uw_b655p35 0.00 655.3500 FUNCTION_LIST DNWS IF_DATA DIM_X DIRECT 0x81BF9E /end CHARACTERISTIC
/begin CHARACTERISTIC TVDRL "Verzögerungszeit für Dynamikmessung LSU" VALUE 0x81840A KwUb 25.50 t100msxs_ub_b25p5 0.00 25.50 FUNCTION_LIST DLSU IF_DATA DIM_X DIRECT 0x81840A /end CHARACTERISTIC
/begin CHARACTERISTIC TVDSLOFF "Zeitverzögerung Schließen Sekundärluftventil bei Adaption/Kurztrip" VALUE 0x81817D KwUb 25.50 t100msxs_ub_b25p5 0.00 25.50 FUNCTION_LIST SLS IF_DATA DIM_X DIRECT 0x81817D /end CHARACTERISTIC
/begin CHARACTERISTIC TVDTEABG "Verzögerungszeit zwischen Motor und Lambdasonde" VALUE 0x819BA0 KwUb 2.000 t100msxs_ub_b25p5 0.00 2.000 FUNCTION_LIST DTEV IF_DATA DIM_X DIRECT 0x819BA0 /end CHARACTERISTIC
/begin CHARACTERISTIC TVDTEB "Verzögerungszeit ab TEV offen für Aussage TEV i.O./defekt in Diagnose DTEV" VALUE 0x819BA1 KwUb 10.00 t100msxs_ub_b25p5 0.00 10.00 FUNCTION_LIST DTEV IF_DATA DIM_X DIRECT 0x819BA1 /end CHARACTERISTIC
/begin CHARACTERISTIC TVDTEE "Zeitdauer ab TEV offen für Prüfung DTEV" VALUE 0x819BA2 KwUb 12.00 t100msxs_ub_b25p5 3.000 15.00 FUNCTION_LIST DTEV IF_DATA DIM_X DIRECT 0x819BA2 /end CHARACTERISTIC
/begin CHARACTERISTIC TVDTELLA "Mindestzzeit für Aktivierungsbedingungen für Aufsteuerprüfung DTEV erfüllt" VALUE 0x819BA3 KwUb 9.500 t100msxs_ub_b25p5 0.5000 10.00 FUNCTION_LIST DTEV IF_DATA DIM_X DIRECT 0x819BA3 /end CHARACTERISTIC
/begin CHARACTERISTIC TVDTEVP "Entprellung für Setzen Flip-Flop Passiv-Prüfung DTEV i.O." VALUE 0x819BA4 KwUb 19.00 t100msxs_ub_b25p5 1.000 20.00 FUNCTION_LIST DTEV IF_DATA DIM_X DIRECT 0x819BA4 /end CHARACTERISTIC
/begin CHARACTERISTIC TVDTEVPM "Entprellung für Setzen Flip-Flop ""Diagnose passiv möglich""" VALUE 0x819BA5 KwUb 19.00 t100msxs_ub_b25p5 1.000 20.00 FUNCTION_LIST DTEV IF_DATA DIM_X DIRECT 0x819BA5 /end CHARACTERISTIC
/begin CHARACTERISTIC TVDTEVZ "Verzögerungszeit für Schließen TEV für Aufsteuerprüfung DTEV" VALUE 0x819BA6 KwUb 10.00 t100msxs_ub_b25p5 0.00 10.00 FUNCTION_LIST DTEV IF_DATA DIM_X DIRECT 0x819BA6 /end CHARACTERISTIC
/begin CHARACTERISTIC TVDVSF "Verzugszeit Fehlereintrag Diagnose Ventilhub" VALUE 0x812303 KwUb 5.100 t20msxs_ub_b5p1 0.00 5.100 FUNCTION_LIST DVS IF_DATA DIM_X DIRECT 0x812303 /end CHARACTERISTIC
/begin CHARACTERISTIC TVEBMDBV "Verzugszeit bei Aktivierung Einschaltbed. bei geschw.-abh. MD-Aufbaubegrenzung" VALUE 0x811B47 KwUb 5.100 t20msxs_ub_b5p1 0.00 5.100 FUNCTION_LIST MDBGV IF_DATA DIM_X DIRECT 0x811B47 /end CHARACTERISTIC
/begin CHARACTERISTIC TVERBR "Verzögerungszeit für Bremsschalter-Plausibilitätsprüfung" VALUE 0x818495 KwUb 25.50 t100msxs_ub_b25p5 0.00 25.50 FUNCTION_LIST GGEGAS IF_DATA DIM_X DIRECT 0x818495 /end CHARACTERISTIC
/begin CHARACTERISTIC TVFRG "Verzögerundszeit nach Satrtende bis zur Freigabe des Füllungsreglers" VALUE 0x818645 KwUb 12.75 t50msxs_ub_b12p75 0.00 12.75 FUNCTION_LIST FUEREG IF_DATA DIM_X DIRECT 0x818645 /end CHARACTERISTIC
/begin CHARACTERISTIC TVFRMVS "Verzugszeit für Abfrage dvfrmvs" VALUE 0x81768E KwUw 1310.700 t20msxs_uw_b1310 0.00 1310.700 FUNCTION_LIST DVS IF_DATA DIM_X DIRECT 0x81768E /end CHARACTERISTIC
/begin CHARACTERISTIC TVFSAM "Temperaturabhängige Verzögerungszeit für Fahrstufe AUS" CURVE 0x8197C0 GklWUb 5.100 t20msxs_ub_b5p1 0.00 5.100 FUNCTION_LIST MDWAN IF_DATA DIM_X DIRECT 0x8197C0
 /begin AXIS_DESCR COM_AXIS twan_kge temp_ub_q1_o50 6 -50.00 205.0 AXIS_PTS_REF STW06MDUB /end AXIS_DESCR
/end CHARACTERISTIC
/begin CHARACTERISTIC TVFSAWE "Verzögerungszeit für Rücksetzen von B_fil" VALUE 0x811B4A KwUb 2.540 t10msxs_ub_b2p55 0.01000 2.550 FUNCTION_LIST MDFAW IF_DATA DIM_X DIRECT 0x811B4A /end CHARACTERISTIC
/begin CHARACTERISTIC TVFSEM "Temperaturabhängige Verzögerungszeit für Fahrstufe EIN" CURVE 0x8197C6 GklWUb 5.100 t20msxs_ub_b5p1 0.00 5.100 FUNCTION_LIST MDWAN IF_DATA DIM_X DIRECT 0x8197C6
 /begin AXIS_DESCR COM_AXIS twan_kge temp_ub_q1_o50 6 -50.00 205.0 AXIS_PTS_REF STW06MDUB /end AXIS_DESCR
/end CHARACTERISTIC
/begin CHARACTERISTIC TVFUE "Verzögerungszeit für den Aufbau der Füllung" VALUE 0x811672 KwUb 1.992 fak_ub_b2 0.00 1.992 FUNCTION_LIST MDWAN IF_DATA DIM_X DIRECT 0x811672 /end CHARACTERISTIC
/begin CHARACTERISTIC TVFZNW "Vezögerungszeit für Aktivierung der CIFI-Faktoren nach NoWe-Umschaltung" VALUE 0x810F13 KwUb 2.550 t10msxs_ub_b2p55 0.00 2.550 FUNCTION_LIST ACIFI IF_DATA DIM_X DIRECT 0x810F13 /end CHARACTERISTIC
/begin CHARACTERISTIC TVGWK "Verzögerungszeit bei Gangwechsel während Kupplungsbetätiung" VALUE 0x819D14 KwUb 5.100 t20msxs_ub_b5p1 0.00 5.100 FUNCTION_LIST VS IF_DATA DIM_X DIRECT 0x819D14 /end CHARACTERISTIC
/begin CHARACTERISTIC TVGWKNW "Verzögerungszeit bei Gangwechsel während Kupplungsbetätigung" VALUE 0x818764 KwUb 12.75 t50msxs_ub_b12p75 0.00 12.75 FUNCTION_LIST NWS IF_DATA DIM_X DIRECT 0x818764 /end CHARACTERISTIC
/begin CHARACTERISTIC TVGWNK "Verzögerungszeit bei Gangwechsel nach Kupplungsbetätigung" VALUE 0x819D15 KwUb 5.100 t20msxs_ub_b5p1 0.00 5.100 FUNCTION_LIST VS IF_DATA DIM_X DIRECT 0x819D15 /end CHARACTERISTIC
/begin CHARACTERISTIC TVGWNKNW "Verzögerungszeit bei Gangwechsel nach Kupplungsbetätigung" VALUE 0x818765 KwUb 12.75 t50msxs_ub_b12p75 0.00 12.75 FUNCTION_LIST NWS IF_DATA DIM_X DIRECT 0x818765 /end CHARACTERISTIC
/begin CHARACTERISTIC TVGWP "Verzögerungszeit bei Gangwechsel permanent" VALUE 0x819D16 KwUb 5.100 t20msxs_ub_b5p1 0.00 5.100 FUNCTION_LIST VS IF_DATA DIM_X DIRECT 0x819D16 /end CHARACTERISTIC
/begin CHARACTERISTIC TVGWPNW "Verzögerungszeit bei Gangwechsel permanent" VALUE 0x818766 KwUb 12.75 t50msxs_ub_b12p75 0.00 12.75 FUNCTION_LIST NWS IF_DATA DIM_X DIRECT 0x818766 /end CHARACTERISTIC
/begin CHARACTERISTIC TVHKLSU "Verzögerungszeit für Diagnose Heizerkopplung" VALUE 0x81B908 KwUw 30.00000 t10msxs_uw_b655p35 0.00 30.00000 FUNCTION_LIST DLSU IF_DATA DIM_X DIRECT 0x81B908 /end CHARACTERISTIC
/begin CHARACTERISTIC TVHKLSUV "Zeit für Diagnose Heizerkopplung" VALUE 0x81840B KwUb 2.550 t10msxs_ub_b2p55 0.00 2.550 FUNCTION_LIST DLSU IF_DATA DIM_X DIRECT 0x81840B /end CHARACTERISTIC
/begin CHARACTERISTIC TVHSH "Einschaltverzögerung der Sondenheizung hinter Kat" VALUE 0x81847C KwUb 25.50 t100msxs_ub_b25p5 0.00 25.50 FUNCTION_LIST HLSHK IF_DATA DIM_X DIRECT 0x81847C /end CHARACTERISTIC
/begin CHARACTERISTIC TVKOE "Verzögerungszeit für Kompressor EIN" VALUE 0x812BAD KwUb 51.00 t200msxs_ub_b51 0.00 51.00 FUNCTION_LIST KOS IF_DATA DIM_X DIRECT 0x812BAD /end CHARACTERISTIC
/begin CHARACTERISTIC TVKRNW "Verzögerungszeit nach Umschalten Nockenwelle" VALUE 0x81149D KwUb 5.100 t20msxs_ub_b5p1 0.00 5.100 FUNCTION_LIST KRKE IF_DATA DIM_X DIRECT 0x81149D /end CHARACTERISTIC
/begin CHARACTERISTIC TVKRVS "Verzögerungszeit nach Umschalten Ventilhub" VALUE 0x81149E KwUb 5.100 t20msxs_ub_b5p1 0.00 5.100 FUNCTION_LIST KRKE IF_DATA DIM_X DIRECT 0x81149E /end CHARACTERISTIC
/begin CHARACTERISTIC TVKUP "Verzögerungszeit für B_kupplv" VALUE 0x810E2C KwUb 5.100 t20msxs_ub_b5p1 0.00 5.100 FUNCTION_LIST GGEGAS IF_DATA DIM_X DIRECT 0x810E2C /end CHARACTERISTIC
/begin CHARACTERISTIC TVKUPHS "Verzögerungszeit Kupplungsschalter beim Hochschalten" CURVE 0x816086 FklWUw 655.3500 t10msxs_ub_b2p55 0.00 655.3500 FUNCTION_LIST ARMD IF_DATA DIM_X DIRECT 0x816086 /begin AXIS_DESCR FIX_AXIS gangi dez 6 1.000 6.000 FIX_AXIS_PAR 1 0 6 /end AXIS_DESCR /end CHARACTERISTIC
/begin CHARACTERISTIC TVKUPPL "Verzögerungszeit für die Information des Kupplungsschalter" VALUE 0x8114CD KwUb 5.100 t20msxs_ub_b5p1 0.00 5.100 FUNCTION_LIST LLRBB IF_DATA DIM_X DIRECT 0x8114CD /end CHARACTERISTIC
/begin CHARACTERISTIC TVKUPRS "Verzögerungszeit Kupplungsschalter beim Runterschalten" CURVE 0x816092 FklWUw 655.3500 t10msxs_ub_b2p55 0.00 655.3500 FUNCTION_LIST ARMD IF_DATA DIM_X DIRECT 0x816092 /begin AXIS_DESCR FIX_AXIS gangi dez 6 1.000 6.000 FIX_AXIS_PAR 1 0 6 /end AXIS_DESCR /end CHARACTERISTIC
/begin CHARACTERISTIC TVKUPV "Verzögerungszeit für Rücksetzen von B_kupplv" VALUE 0x813DD2 KwUw 1310.700 t20msxs_uw_b1310 0.00 1310.700 FUNCTION_LIST GGEGAS IF_DATA DIM_X DIRECT 0x813DD2 /end CHARACTERISTIC
/begin CHARACTERISTIC TVLADV "Zeitkonstante für Integrator bei vlast-Berechnung" CURVE 0x81489E KlAUwSstSwWUw 1310.70000 zk20msxs_uw_b1310 0.0200003052 1310.72000 FUNCTION_LIST FGRMD IF_DATA DIM_X DIRECT 0x81489E
 /begin AXIS_DESCR STD_AXIS dvzvi_w vfzg_sw_q0p00781 8 -256.0000 255.9922 DEPOSIT ABSOLUT /end AXIS_DESCR
/end CHARACTERISTIC
/begin CHARACTERISTIC TVLDIMX "Tastverhältnisschwelle für I-Anteil Adaptionswert in DLDR zum Setzen von LDRA" VALUE 0x81BFFA KwSw 327.6750 tv_sw_q0p005 -163.8400 163.8350 FUNCTION_LIST DLDR IF_DATA DIM_X DIRECT 0x81BFFA /end CHARACTERISTIC
/begin CHARACTERISTIC TVLDMN "Untere Tastverhältnisbegrenzung für LDR" VALUE 0x8196AB KwUb 99.61 tv_ub_b100 0.00 99.61 FUNCTION_LIST LDTVMA IF_DATA DIM_X DIRECT 0x8196AB /end CHARACTERISTIC
/begin CHARACTERISTIC TVLDMX "Obere Tastverhältnisbegrenzung für LDR" VALUE 0x81DA56 KwSw 100.0000 tv_sw_q0p005 0.00 100.0000 FUNCTION_LIST LDRPID LDTVMA IF_DATA DIM_X DIRECT 0x81DA56 /end CHARACTERISTIC
/begin CHARACTERISTIC TVLENA "Verzögerungszeit für Lambdakorrektur" VALUE 0x810C76 KwUb 2.550 t10msxs_ub_b2p55 0.00 2.550 FUNCTION_LIST GGLSU IF_DATA DIM_X DIRECT 0x810C76 /end CHARACTERISTIC
/begin CHARACTERISTIC TVLFA "Verzögerungszeit bis Lüfter abschaltet" VALUE 0x819801 KwUb 25.50 t100msxs_ub_b25p5 0.00 25.50 FUNCTION_LIST MLS IF_DATA DIM_X DIRECT 0x819801 /end CHARACTERISTIC
/begin CHARACTERISTIC TVLFE "Verzögerungszeit bis Lüfter einschaltet" VALUE 0x819802 KwUb 25.50 t100msxs_ub_b25p5 0.00 25.50 FUNCTION_LIST MLS IF_DATA DIM_X DIRECT 0x819802 /end CHARACTERISTIC
/begin CHARACTERISTIC TVLFSE "Zeitverzögerung Einschalten Endstufen nach Anforderung" VALUE 0x819803 KwUb 25.50 t100msxs_ub_b25p5 0.00 25.50 FUNCTION_LIST MLS IF_DATA DIM_X DIRECT 0x819803 /end CHARACTERISTIC
/begin CHARACTERISTIC TVLISTU "Verbotszeit für negativen Integratoranteil nach Start" VALUE 0x81164F KwUb 5.100 t20msxs_ub_b5p1 0.00 5.100 FUNCTION_LIST LLRRM IF_DATA DIM_X DIRECT 0x81164F /end CHARACTERISTIC
/begin CHARACTERISTIC TVLLLF3 "Verzögerungszeit für Ausschalten Lüfterstufe 3 bei LL" VALUE 0x819804 KwUb 25.50 t100msxs_ub_b25p5 0.00 25.50 FUNCTION_LIST MLS IF_DATA DIM_X DIRECT 0x819804 /end CHARACTERISTIC
/begin CHARACTERISTIC TVLRA "Verzögerungszeit für Aktivierung Gemischadaption nach Lambdaregelung aktiv" VALUE 0x811418 KwUb 25.40 t100msxs_ub_b25p5 0.1000 25.50 FUNCTION_LIST LRAEB IF_DATA DIM_X DIRECT 0x811418 /end CHARACTERISTIC
/begin CHARACTERISTIC TVLSUBM "maximal zul. Verzögerungszeit für Betriebsbereitschaft stetige Lambdasonde LSU" VALUE 0x81B894 KwUw 3276.750 t50msxs_uw_b3276p75 0.00 3276.750 FUNCTION_LIST DHLSU IF_DATA DIM_X DIRECT 0x81B894 /end CHARACTERISTIC
/begin CHARACTERISTIC TVLSUEE "Verzögerungszeit für LSU Heizerendstufenfehler" VALUE 0x8183AB KwUb 12.75 t50msxs_ub_b12p75 0.00 12.75 FUNCTION_LIST DHLSU IF_DATA DIM_X DIRECT 0x8183AB /end CHARACTERISTIC
/begin CHARACTERISTIC TVLSUEK "Verzögerungszeit für Fehlerkorrektur stetige Lambdasonde LSU" VALUE 0x81B90A KwUw 65535.00 t1sxs_uw_b65535 0.00 65535.00 FUNCTION_LIST DLSU IF_DATA DIM_X DIRECT 0x81B90A /end CHARACTERISTIC
/begin CHARACTERISTIC TVLSUHK "Verzögerungszeit nach Start für Diagnose Heizerkopplung" VALUE 0x81B90C KwUw 655.3500 t10msxs_uw_b655p35 0.00 655.3500 FUNCTION_LIST DLSU IF_DATA DIM_X DIRECT 0x81B90C /end CHARACTERISTIC
/begin CHARACTERISTIC TVLSUNP "Verzögerungszeit für Fehler stetige Lambdasonde LSU" VALUE 0x81B896 KwUw 3276.750 t50msxs_uw_b3276p75 0.00 3276.750 FUNCTION_LIST DHLSU IF_DATA DIM_X DIRECT 0x81B896 /end CHARACTERISTIC
/begin CHARACTERISTIC TVLSUOF "Verzögerungszeit für Fehler stetige Lambdasonde LSU ""Offset""" VALUE 0x81840C KwUb 255.0 t1sxs_ub_b255 0.00 255.0 FUNCTION_LIST DLSU IF_DATA DIM_X DIRECT 0x81840C /end CHARACTERISTIC
/begin CHARACTERISTIC TVLSUSA "Verzögerungszeit für Funktionsprüfung während B_sa" VALUE 0x81B898 KwUw 1310.700 t20msxs_uw_q0p02 0.00 1310.700 FUNCTION_LIST DHLSU IF_DATA DIM_X DIRECT 0x81B898 /end CHARACTERISTIC
/begin CHARACTERISTIC TVLSUSAE "Verzögerungszeit für Fehlereintrag während B_sa" VALUE 0x81B89A KwUw 1310.700 t20msxs_uw_q0p02 0.00 1310.700 FUNCTION_LIST DHLSU IF_DATA DIM_X DIRECT 0x81B89A /end CHARACTERISTIC
/begin CHARACTERISTIC TVLSUSAH "Verzögerungszeit für Fehlerheilung während B_sa" VALUE 0x81B89C KwUw 1310.700 t20msxs_uw_q0p02 0.00 1310.700 FUNCTION_LIST DHLSU IF_DATA DIM_X DIRECT 0x81B89C /end CHARACTERISTIC
/begin CHARACTERISTIC TVLSUST "Verzögerungszeit für Endstufendiagnose Heizung LSU" VALUE 0x8183AC KwUb 25.50 t100msxs_ub_b25p5 0.00 25.50 FUNCTION_LIST DHLSU IF_DATA DIM_X DIRECT 0x8183AC /end CHARACTERISTIC
/begin CHARACTERISTIC TVLSUWU "maximale Zeit für ""warm up"" stetige Lambdasonde LSU" VALUE 0x8121B3 KwUb 25.50 t100msxs_ub_b25p5 0.00 25.50 FUNCTION_LIST HLSU IF_DATA DIM_X DIRECT 0x8121B3 /end CHARACTERISTIC
/begin CHARACTERISTIC TVMDBGNW "Ausschaltverzögerung bei Erzwingen NW-Stellung spät" VALUE 0x811B48 KwUb 5.100 t20msxs_ub_b5p1 0.00 5.100 FUNCTION_LIST MDBGV IF_DATA DIM_X DIRECT 0x811B48 /end CHARACTERISTIC
/begin CHARACTERISTIC TVMRFT "Verzögerungszeit für Lambdasonde hinter Kat mager oder fett" VALUE 0x81840D KwUb 25.50 t100msxs_ub_b25p5 0.00 25.50 FUNCTION_LIST DLSU IF_DATA DIM_X DIRECT 0x81840D /end CHARACTERISTIC
/begin CHARACTERISTIC TVMSGF "Verzögerungszeit Motorraumspülgebläse ein bis Fehlererkennung" VALUE 0x81DB02 KwUw 6553.500 t100msxs_uw_b6553p6 0.00 6553.500 FUNCTION_LIST MLS IF_DATA DIM_X DIRECT 0x81DB02 /end CHARACTERISTIC
/begin CHARACTERISTIC TVMXPR "Geschwindigkeit-Prädiktionshorizont für VMAX-Regelung" VALUE 0x811C3E KwUb 2.550 t10msxs_ub_b2p55 0.00 2.550 FUNCTION_LIST VMAXMD IF_DATA DIM_X DIRECT 0x811C3E /end CHARACTERISTIC
/begin CHARACTERISTIC TVNOLSU "Verzögerungszeit für LSU OK" VALUE 0x81840E KwUb 25.50 t100msxs_ub_b25p5 0.00 25.50 FUNCTION_LIST DLSU IF_DATA DIM_X DIRECT 0x81840E /end CHARACTERISTIC
/begin CHARACTERISTIC TVNWF "Verzugszeit zur NW-Umschaltfreigabe nach früh" VALUE 0x818767 KwUb 12.75 t50msxs_ub_b12p75 0.00 12.75 FUNCTION_LIST NWS IF_DATA DIM_X DIRECT 0x818767 /end CHARACTERISTIC
/begin CHARACTERISTIC TVNWS "Verzögerungszeit für Nockenwellenverstellung" VALUE 0x818768 KwUb 12.75 t50msxs_ub_b12p75 0.00 12.75 FUNCTION_LIST NWS IF_DATA DIM_X DIRECT 0x818768 /end CHARACTERISTIC
/begin CHARACTERISTIC TVNWTMST "Verzugszeit zur NW-Umschaltfreigabe Abhängig von Motorstarttemp." CURVE 0x818769 KlAUbSstUbWUb 12.75 t50msxs_ub_b12p75 0.00 12.75 FUNCTION_LIST NWS IF_DATA DIM_X DIRECT 0x818769
 /begin AXIS_DESCR STD_AXIS tmst temp_ub_q0p75_o48 4 -48.00 143.3 DEPOSIT ABSOLUT /end AXIS_DESCR
/end CHARACTERISTIC
/begin CHARACTERISTIC TVNW_S "Verzögerungszeit nach der das Einlaßventil sicher in Spätstellung ist" VALUE 0x818772 KwUb 12.75 t50msxs_ub_b12p75 0.00 12.75 FUNCTION_LIST NWS IF_DATA DIM_X DIRECT 0x818772 /end CHARACTERISTIC
/begin CHARACTERISTIC TVPDKP1 "Fehlertoleranzzeit bei Bereichsprüfung DK-Poti 1" VALUE 0x810E05 KwUb 2.540 t10msxs_ub_b2p55 0.01000 2.550 FUNCTION_LIST GGDVE IF_DATA DIM_X DIRECT 0x810E05 /end CHARACTERISTIC
/begin CHARACTERISTIC TVPDKP2 "Fehlertoleranzzeit bei Bereichsprüfung DK-Poti 2" VALUE 0x810E06 KwUb 2.540 t10msxs_ub_b2p55 0.01000 2.550 FUNCTION_LIST GGDVE IF_DATA DIM_X DIRECT 0x810E06 /end CHARACTERISTIC
/begin CHARACTERISTIC TVPLMSA "Verzögerungszeit für Erkennung Unplausibilität LSU" CURVE 0x81840F KlAUbSstUbWUb 25.50 t100msxs_ub_b25p5 0.00 25.50 FUNCTION_LIST DLSU IF_DATA DIM_X DIRECT 0x81840F /begin AXIS_DESCR STD_AXIS msabg m_ub_b1020 4 0.00 1020. DEPOSIT ABSOLUT /end AXIS_DESCR /end CHARACTERISTIC
/begin CHARACTERISTIC TVPLMSA2 "Verzögerungszeit für Erkennung Unplausibilität LSU2" CURVE 0x818418 KlAUbSstUbWUb 25.50 t100msxs_ub_b25p5 0.00 25.50 FUNCTION_LIST DLSU IF_DATA DIM_X DIRECT 0x818418 /begin AXIS_DESCR STD_AXIS msabg2 m_ub_b1020 4 0.00 1020. DEPOSIT ABSOLUT /end AXIS_DESCR /end CHARACTERISTIC
/begin CHARACTERISTIC TVPWDK12 "Fehlertoleranzzeit bei Gleichlaufprüfung der DK-Potis" VALUE 0x810E07 KwUb 2.540 t10msxs_ub_b2p55 0.01000 2.550 FUNCTION_LIST GGDVE IF_DATA DIM_X DIRECT 0x810E07 /end CHARACTERISTIC
/begin CHARACTERISTIC TVPWDK13 "Fehlertoleranzzeit bei Gleichlaufprüfung DK-Poti 1 und Ersatzwert aus Füllung" VALUE 0x810E08 KwUb 2.540 t10msxs_ub_b2p55 0.01000 2.550 FUNCTION_LIST GGDVE IF_DATA DIM_X DIRECT 0x810E08 /end CHARACTERISTIC
/begin CHARACTERISTIC TVPWDK23 "Fehlertoleranzzeit bei Gleichlaufprüfung DK-Poti 2 und Ersatzwert aus Füllung" VALUE 0x810E09 KwUb 2.540 t10msxs_ub_b2p55 0.01000 2.550 FUNCTION_LIST GGDVE IF_DATA DIM_X DIRECT 0x810E09 /end CHARACTERISTIC
/begin CHARACTERISTIC TVRESLL "Haltezeit für die erhöhte Momentenrerserve nach Drehzahleinbruch" VALUE 0x8196E6 KwUb 51.00 t200msxs_ub_b51 0.00 51.00 FUNCTION_LIST LLRMR IF_DATA DIM_X DIRECT 0x8196E6 /end CHARACTERISTIC
/begin CHARACTERISTIC TVRIF "Verzögerungszeit für Ri-Fehler" VALUE 0x8183A9 KwUb 255.0 t1sxs_ub_b255 0.00 255.0 FUNCTION_LIST DHLSHK IF_DATA DIM_X DIRECT 0x8183A9 /end CHARACTERISTIC
/begin CHARACTERISTIC TVSATEM "Verzögerungszeit für TEV zu nach SA-Bereitschaft" CURVE 0x8121EC KlAUbSstUbWUb 5.100 t20msxs_ub_b5p1 0.00 5.100 FUNCTION_LIST TEB IF_DATA DIM_X DIRECT 0x8121EC
 /begin AXIS_DESCR STD_AXIS tmot temp_ub_q0p75_o48 6 -48.00 143.3 DEPOSIT ABSOLUT /end AXIS_DESCR
/end CHARACTERISTIC
/begin CHARACTERISTIC TVSATM "Sperrzeit Schubabschalten nach Startende" CURVE 0x8196D9 GklWUb 255.0 t1sxs_ub_b255 0.00 255.0 FUNCTION_LIST BBSAWE IF_DATA DIM_X DIRECT 0x8196D9
 /begin AXIS_DESCR COM_AXIS tmot temp_ub_q0p75_o48 5 -48.00 143.3 AXIS_PTS_REF STM05SAUB /end AXIS_DESCR
/end CHARACTERISTIC
/begin CHARACTERISTIC TVSLR "Dauer LRS-Ausschaltung über Ventilhubsteuerung" CURVE 0x8198EE KlAUbSstUbWUb 5.100 t20msxs_ub_b5p1 0.00 5.100 FUNCTION_LIST LRSEB IF_DATA DIM_X DIRECT 0x8198EE /begin AXIS_DESCR STD_AXIS nmot nmot_ub_q40 8 0.00 10200. DEPOSIT ABSOLUT /end AXIS_DESCR /end CHARACTERISTIC
/begin CHARACTERISTIC TVSLVOFF "Zeitverzögerung Schließen Sekundärluftventil" VALUE 0x81817E KwUb 25.50 t100msxs_ub_b25p5 0.00 25.50 FUNCTION_LIST SLS IF_DATA DIM_X DIRECT 0x81817E /end CHARACTERISTIC
/begin CHARACTERISTIC TVSLVON "Zeitverzögerung Öffnen Sekundärluftventil" VALUE 0x81817F KwUb 25.40 t100msxs_ub_b25p5 0.1000 25.50 FUNCTION_LIST SLS IF_DATA DIM_X DIRECT 0x81817F /end CHARACTERISTIC
/begin CHARACTERISTIC TVSTMRP "Haltezeit für Startbit zur Umschaltung mrped_w auf 0" VALUE 0x8166F2 KwUw 655.3500 t10msxs_uw_b655p35 0.00 655.3500 FUNCTION_LIST MDFAW IF_DATA DIM_X DIRECT 0x8166F2 /end CHARACTERISTIC
/begin CHARACTERISTIC TVSU "Verzögerungszeit für Saugrohrumschaltung" VALUE 0x8187E4 KwUb 25.50 t100msxs_ub_b25p5 0.00 25.50 FUNCTION_LIST SU IF_DATA DIM_X DIRECT 0x8187E4 /end CHARACTERISTIC
/begin CHARACTERISTIC TVSU2 "Verzögerungszeit für Saugrohrumschaltung Klappe 2" VALUE 0x8187E5 KwUb 25.50 t100msxs_ub_b25p5 0.00 25.50 FUNCTION_LIST SU IF_DATA DIM_X DIRECT 0x8187E5 /end CHARACTERISTIC
/begin CHARACTERISTIC TVSUM "Zeitverzögerung der Saugrohrumschaltung in Abhängigkeit von der Motortemperatur" CURVE 0x8187E6 KlAUbSstUbWUb 25.50 t100msxs_ub_b25p5 0.00 25.50 FUNCTION_LIST SU IF_DATA DIM_X DIRECT 0x8187E6
 /begin AXIS_DESCR STD_AXIS tmot temp_ub_q0p75_o48 6 -48.00 143.3 DEPOSIT ABSOLUT /end AXIS_DESCR
/end CHARACTERISTIC
/begin CHARACTERISTIC TVSUST "Sperrzeit für Freigabe SU nach Start" VALUE 0x8187F3 KwUb 25.50 t100msxs_ub_b25p5 0.00 25.50 FUNCTION_LIST SU IF_DATA DIM_X DIRECT 0x8187F3 /end CHARACTERISTIC
/begin CHARACTERISTIC TVTEVPS "Druckabhängige Verzugszeit Tankentlüftungsventil" CURVE 0x8199DA KlAUbSstUbWUb 127.5 t500usxms_ub_q0p5 0.00 127.5 FUNCTION_LIST ATEV IF_DATA DIM_X DIRECT 0x8199DA /begin AXIS_DESCR STD_AXIS pspu fak_ub_b2 5 0.00 1.992 DEPOSIT ABSOLUT /end AXIS_DESCR /end CHARACTERISTIC
/begin CHARACTERISTIC TVTPDEC "Verzögerungszeit für Dekrementierung tplsu" VALUE 0x81B90E KwUw 6553.500 t100msxs_uw_b6553p5 0.00 6553.500 FUNCTION_LIST DLSU IF_DATA DIM_X DIRECT 0x81B90E /end CHARACTERISTIC
/begin CHARACTERISTIC TVTPSET "typische Startzeit bis Motor läuft" VALUE 0x81B910 KwUw 6553.500 t100msxs_uw_b6553p5 0.00 6553.500 FUNCTION_LIST DLSU IF_DATA DIM_X DIRECT 0x81B910 /end CHARACTERISTIC
/begin CHARACTERISTIC TVUB "Spannungskorrektur" CURVE 0x813F74 KlAUbSstUbWUw 174.7600 tinjection_sy 0.00 174.7600 FUNCTION_LIST AES IF_DATA DIM_X DIRECT 0x813F74 /begin AXIS_DESCR STD_AXIS ub spg_ubatt 5 0.00 19.38 DEPOSIT ABSOLUT /end AXIS_DESCR /end CHARACTERISTIC
/begin CHARACTERISTIC TVVFZG "Verzugszeit bis VFZG gültig erkannt" VALUE 0x81CF9E KwUw 6553.500 t100msxs_uw_b6553p5 0.00 6553.500 FUNCTION_LIST GGTGET IF_DATA DIM_X DIRECT 0x81CF9E /end CHARACTERISTIC
/begin CHARACTERISTIC TVVFZGMX "Verzugszeit bis vfzg zur Ausblendung max Fehler führt" VALUE 0x81CFA0 KwUw 6553.500 t100msxs_uw_b6553p5 0.00 6553.500 FUNCTION_LIST GGTGET IF_DATA DIM_X DIRECT 0x81CFA0 /end CHARACTERISTIC
/begin CHARACTERISTIC TVVS "Verzögerungszeit Drosselklappeneingriff bei Ventilumschaltung klein nach groß" CURVE 0x819D17 KlAUbSstUbWUb 5.100 t20msxs_ub_b5p1 0.00 5.100 FUNCTION_LIST VS IF_DATA DIM_X DIRECT 0x819D17 /begin AXIS_DESCR STD_AXIS nmot nmot_ub_q40 8 0.00 10200. DEPOSIT ABSOLUT /end AXIS_DESCR /end CHARACTERISTIC
/begin CHARACTERISTIC TVVSES "Verzögerungszeit Einspritzungskorrektur bei Wechsel von klein --> groß" CURVE 0x8122AF KlAUbSstUbWUb 2.550 t10msxs_ub_b2p55 0.00 2.550 FUNCTION_LIST esvs ESWL IF_DATA DIM_X DIRECT 0x8122AF /begin AXIS_DESCR STD_AXIS nmot nmot_ub_q40 8 0.00 10200. DEPOSIT ABSOLUT /end AXIS_DESCR /end CHARACTERISTIC
/begin CHARACTERISTIC TVVSESL "Verzögerungszeit Gemischkorrektur bei Wechsel von groß --> klein" CURVE 0x8122C0 KlAUbSstUbWUb 2.550 t10msxs_ub_b2p55 0.00 2.550 FUNCTION_LIST esvs ESWL IF_DATA DIM_X DIRECT 0x8122C0 /begin AXIS_DESCR STD_AXIS nmot nmot_ub_q40 8 0.00 10200. DEPOSIT ABSOLUT /end AXIS_DESCR /end CHARACTERISTIC
/begin CHARACTERISTIC TVVSL "Verzögerungszeit Drosselklappeneingriff bei Ventilumschaltung groß nach klein" CURVE 0x819D28 KlAUbSstUbWUb 5.100 t20msxs_ub_b5p1 0.00 5.100 FUNCTION_LIST VS IF_DATA DIM_X DIRECT 0x819D28 /begin AXIS_DESCR STD_AXIS nmot nmot_ub_q40 8 0.00 10200. DEPOSIT ABSOLUT /end AXIS_DESCR /end CHARACTERISTIC
/begin CHARACTERISTIC TVVSLSRM "Umschaltverzögerung Paramtersatz zur Füllungsberechnung bei Wechsel gr. nach kl." CURVE 0x819D39 KlAUbSstUbWUb 5.100 t20msxs_ub_b5p1 0.00 5.100 FUNCTION_LIST VS IF_DATA DIM_X DIRECT 0x819D39 /begin AXIS_DESCR STD_AXIS nmot nmot_ub_q40 8 0.00 10200. DEPOSIT ABSOLUT /end AXIS_DESCR /end CHARACTERISTIC
/begin CHARACTERISTIC TVVSSRM "Umschaltverzögerung Paramtersatz zur Füllungsberechnung bei Wechsel kl. nach gr." CURVE 0x819D4A KlAUbSstUbWUb 5.100 t20msxs_ub_b5p1 0.00 5.100 FUNCTION_LIST VS IF_DATA DIM_X DIRECT 0x819D4A /begin AXIS_DESCR STD_AXIS nmot nmot_ub_q40 8 0.00 10200. DEPOSIT ABSOLUT /end AXIS_DESCR /end CHARACTERISTIC
/begin CHARACTERISTIC TVVSST "Verzögerungszeit für Freigabebit Ventilhubsteuerung nach Startende" VALUE 0x819D5B KwUb 5.100 t20msxs_ub_b5p1 0.00 5.100 FUNCTION_LIST VS IF_DATA DIM_X DIRECT 0x819D5B /end CHARACTERISTIC
/begin CHARACTERISTIC TVVSTOL2 "Verzugszeit Ventilumsch. nach Startende im Toel-Bereich 2 f. B_bmvst2" VALUE 0x819D5C KwUb 5.100 t20msxs_ub_b5p1 0.00 5.100 FUNCTION_LIST VS IF_DATA DIM_X DIRECT 0x819D5C /end CHARACTERISTIC
/begin CHARACTERISTIC TVVSTOL3 "Verzugszeit Ventilumsch. nach Startende im Toel-Bereich 3 f. B_tol3vsa" VALUE 0x819D5D KwUb 5.100 t20msxs_ub_b5p1 0.00 5.100 FUNCTION_LIST VS IF_DATA DIM_X DIRECT 0x819D5D /end CHARACTERISTIC
/begin CHARACTERISTIC TVVSV "Verzögerungszeit zur Betätigung Schaltventile bei Wechsel von klein --> groß" CURVE 0x819D5E KlAUbSstUbWUb 5.100 t20msxs_ub_b5p1 0.00 5.100 FUNCTION_LIST VS IF_DATA DIM_X DIRECT 0x819D5E /begin AXIS_DESCR STD_AXIS nmot nmot_ub_q40 8 0.00 10200. DEPOSIT ABSOLUT /end AXIS_DESCR /end CHARACTERISTIC
/begin CHARACTERISTIC TVVSVL "Verzögerungszeit zur Betätigung Schaltventile bei Wechsel von groß --> klein" CURVE 0x819D6F KlAUbSstUbWUb 5.100 t20msxs_ub_b5p1 0.00 5.100 FUNCTION_LIST VS IF_DATA DIM_X DIRECT 0x819D6F /begin AXIS_DESCR STD_AXIS nmot nmot_ub_q40 8 0.00 10200. DEPOSIT ABSOLUT /end AXIS_DESCR /end CHARACTERISTIC
/begin CHARACTERISTIC TVWDKS "Verzögerungszeit für Drosselklappen-Sollwinkel" VALUE 0x8110AD KwUb 2.550 t10msxs_ub_b2p55 0.00 2.550 FUNCTION_LIST FUEDKSA IF_DATA DIM_X DIRECT 0x8110AD /end CHARACTERISTIC
/begin CHARACTERISTIC TVZWMSA "Zeit bis zum Übergehen auf Dauerspätbegrenzung" VALUE 0x8179A0 KwUw 655.3500 t10msxs_uw_b655p35 0.00 655.3500 FUNCTION_LIST ZWMIN IF_DATA DIM_X DIRECT 0x8179A0 /end CHARACTERISTIC
/begin CHARACTERISTIC TVZWMSE "Zeit bis zum Übergehen auf Dynamikspätbegrenzung" VALUE 0x8179A2 KwUw 655.3500 t10msxs_uw_b655p35 0.00 655.3500 FUNCTION_LIST ZWMIN IF_DATA DIM_X DIRECT 0x8179A2 /end CHARACTERISTIC
/begin CHARACTERISTIC TVZWSVLS "Verzögerungszeit für Erlaubnis Setzen ZW-Absteuerung bei Motorschutz" VALUE 0x819D8F KwUb 5.100 t20msxs_ub_b5p1 0.00 5.100 FUNCTION_LIST ZWBTSK IF_DATA DIM_X DIRECT 0x819D8F /end CHARACTERISTIC
/begin CHARACTERISTIC TVZWVS1 "Einschaltverzögerung ZW-Einfluß bei Ventilhubumschaltung" CURVE 0x819D96 KlAUbSstUbWUb 5.100 t20msxs_ub_q0p02 0.00 5.100 FUNCTION_LIST ZWVS IF_DATA DIM_X DIRECT 0x819D96 /begin AXIS_DESCR STD_AXIS nmot nmot_ub_q40 8 0.00 10200. DEPOSIT ABSOLUT /end AXIS_DESCR /end CHARACTERISTIC
/begin CHARACTERISTIC TVZWVS2 "Einschaltdauer ZW-EInfluß bei Ventilhubumschaltung" CURVE 0x819DA7 KlAUbSstUbWUb 5.100 t20msxs_ub_q0p02 0.00 5.100 FUNCTION_LIST ZWVS IF_DATA DIM_X DIRECT 0x819DA7 /begin AXIS_DESCR STD_AXIS nmot nmot_ub_q40 8 0.00 10200. DEPOSIT ABSOLUT /end AXIS_DESCR /end CHARACTERISTIC
/begin CHARACTERISTIC TWBDCY "Wartezeit für Erkennung Bedingung 'driving cycle'" VALUE 0x81B6E4 KwUw 13107.00 t200msxs_uw_q0p2 0.00 13107.00 FUNCTION_LIST DDCY IF_DATA DIM_X DIRECT 0x81B6E4 /end CHARACTERISTIC
/begin CHARACTERISTIC TWDKATST "Wartezeit nach Stoppbedingung für Filter und Integrator" VALUE 0x8183E0 KwUb 12.75 t50msxs_ub_b12p75 0.00 12.75 FUNCTION_LIST DKATLRS IF_DATA DIM_X DIRECT 0x8183E0 /end CHARACTERISTIC
/begin CHARACTERISTIC TWDKSV "Zeitkonstante für Drosselklappensollwinkelfilterung" CURVE 0x8152DC KlAUwSstUwWUw 655.350000 zk10msxs_uw_b655 0.0100001526 655.360000 FUNCTION_LIST FUEDK IF_DATA DIM_X DIRECT 0x8152DC
 /begin AXIS_DESCR STD_AXIS pspvmin_w fak_uw_b2 6 0.00 1.999969 DEPOSIT ABSOLUT /end AXIS_DESCR
/end CHARACTERISTIC
/begin CHARACTERISTIC TWDLSSA "Mindestprüfzeit für DLSSA-Extremwertbestimmung" VALUE 0x81BB14 KwUw 3276.750 t50msxs_uw_b3276p75 0.00 3276.750 FUNCTION_LIST DLSSA IF_DATA DIM_X DIRECT 0x81BB14 /end CHARACTERISTIC
/begin CHARACTERISTIC TWDMAD "Wartezeit bis Freigabe der Adaption des Verlustmoments" VALUE 0x8197A5 KwUb 51.00 t200msxs_ub_b51 0.00 51.00 FUNCTION_LIST MDVERAD IF_DATA DIM_X DIRECT 0x8197A5 /end CHARACTERISTIC
/begin CHARACTERISTIC TWDSLTM "tmot- Entprellzeit für Adaption/Zusatudiagnose" VALUE 0x81812B KwUb 25.40 t100msxs_ub_b25p5 0.1000 25.50 FUNCTION_LIST DSLSLRS IF_DATA DIM_X DIRECT 0x81812B /end CHARACTERISTIC
/begin CHARACTERISTIC TWFS1PU "Zeit 1 für vorläufige Funktionsfreigabe ab Kl.15 ein (Power-up-Reset)" VALUE 0x811C45 KwUb 2.550 t10msxs_ub_b2p55 0.00 2.550 FUNCTION_LIST WFS IF_DATA DIM_X DIRECT 0x811C45 /end CHARACTERISTIC
/begin CHARACTERISTIC TWFSSRX "Max. Summenzeitintegral für Reset-Vorfreigaben bei Verriegelung" VALUE 0x811C46 KwUb 25.50 t100msxs_ub_b25p5 0.00 25.50 FUNCTION_LIST WFS IF_DATA DIM_X DIRECT 0x811C46 /end CHARACTERISTIC
/begin CHARACTERISTIC TWFSVNN "Wartezeit bei Motorstillstand bis Wiederverriegelung nach Freigabe" VALUE 0x811C47 KwUb 326.4 t1280msxs_ub_b255 0.00 326.4 FUNCTION_LIST WFS IF_DATA DIM_X DIRECT 0x811C47 /end CHARACTERISTIC
/begin CHARACTERISTIC TWHLSLP "Wartezeit für Hochlauf Sekundärluftpumpe" VALUE 0x81812C KwUb 25.50 t100msxs_ub_b25p5 0.00 25.50 FUNCTION_LIST DSLSLRS IF_DATA DIM_X DIRECT 0x81812C /end CHARACTERISTIC
/begin CHARACTERISTIC TWKTDLP "Wartezeit nach Parameterumschaltung in Lambdaregelung" VALUE 0x8183E1 KwUb 12.75 t50msxs_ub_b12p75 0.00 12.75 FUNCTION_LIST DKATLRS IF_DATA DIM_X DIRECT 0x8183E1 /end CHARACTERISTIC
/begin CHARACTERISTIC TWKTDTK "Temperaturabhängige Wartezeit für Katdiagnose" CURVE 0x813BF8 KlAUbSstUbWUw 3276.750 t50msxs_uw_b3276p75 0.00 3276.750 FUNCTION_LIST DKATLRS IF_DATA DIM_X DIRECT 0x813BF8 /begin AXIS_DESCR STD_AXIS tkdkth temp_ub_q5 4 0.00 1275. DEPOSIT ABSOLUT /end AXIS_DESCR /end CHARACTERISTIC
/begin CHARACTERISTIC TWLRTMS "Wartezeit für Diagnose TMOT-Einschaltbedingung lambda-Regelung" CURVE 0x819060 KlAUbSstUbWUb 5100.0000 t100msxs_ub_q20 0.00 5100.0000 FUNCTION_LIST GGTFM IF_DATA DIM_X DIRECT 0x819060
 /begin AXIS_DESCR STD_AXIS tmst temp_ub_q0p75_o48 4 -48.00 143.3 DEPOSIT ABSOLUT /end AXIS_DESCR
/end CHARACTERISTIC
/begin CHARACTERISTIC TWMLFE "Mindestzeit für ml im Diagnosebereich" VALUE 0x81812D KwUb 25.50 t100msxs_ub_b25p5 0.00 25.50 FUNCTION_LIST DSLSLRS IF_DATA DIM_X DIRECT 0x81812D /end CHARACTERISTIC
/begin CHARACTERISTIC TWMSLMIN "Entprellzeit für Fehlermeldung B_mslmin" VALUE 0x81812E KwUb 25.50 t100msxs_ub_b25p5 0.00 25.50 FUNCTION_LIST DSLSLRS IF_DATA DIM_X DIRECT 0x81812E /end CHARACTERISTIC
/begin CHARACTERISTIC TWNSTA "Wartezeit nach Motorstart" VALUE 0x81B992 KwUw 655.3500 t10msxs_uw_b655p35 0.00 655.3500 FUNCTION_LIST GGFST IF_DATA DIM_X DIRECT 0x81B992 /end CHARACTERISTIC
/begin CHARACTERISTIC TWNTAL "Wartezeit bis Nicht-Tankleer-Signal gültig ist" VALUE 0x81B994 KwUw 13107.00 t200msxs_uw_q0p2 0.00 13107.00 FUNCTION_LIST GGFST IF_DATA DIM_X DIRECT 0x81B994 /end CHARACTERISTIC
/begin CHARACTERISTIC TWPMBBR "Verzögerungszeit für Pedalwertbegrenzung bei betätigter Bremse" VALUE 0x810E3B KwUb 2.550 t10msxs_ub_b2p55 0.00 2.550 FUNCTION_LIST GGPED IF_DATA DIM_X DIRECT 0x810E3B /end CHARACTERISTIC
/begin CHARACTERISTIC TWSTT "Schwelle Abstellzeit für Wiederholstart" CURVE 0x81569E KlAUwSstUwWUw 65535.00 t1sxs_uw_q1 0.00 65535.00 FUNCTION_LIST ESSTT IF_DATA DIM_X DIRECT 0x81569E
 /begin AXIS_DESCR STD_AXIS tmotab temp_ub_q0p75_o48 12 -48.00000 49103.25 DEPOSIT ABSOLUT /end AXIS_DESCR
/end CHARACTERISTIC
/begin CHARACTERISTIC TWTMNHST "Wartezeit für tmot-Max-Diagnose nach Heißstart" VALUE 0x819069 KwUb 255.0 t1sxs_ub_b255 0.00 255.0 FUNCTION_LIST GGTFM IF_DATA DIM_X DIRECT 0x819069 /end CHARACTERISTIC
/begin CHARACTERISTIC TWVLS "Verzögerungszeit f. Vollastzündw. spät Motorschutz" VALUE 0x81E370 KwUw 6553.500 t100msxs_uw_b6553p5 0.00 6553.500 FUNCTION_LIST ZWBTSK IF_DATA DIM_X DIRECT 0x81E370 /end CHARACTERISTIC
/begin CHARACTERISTIC TZ2FGRGA "Doppelte Zählerzeitkonstante für FGR-Regler" CURVE 0x81BAF0 KlAUwSstUwWUw 1310.700 t20msxs_uw_q0p02 0.00 1310.700 FUNCTION_LIST FGRMD IF_DATA DIM_X DIRECT 0x81BAF0 /begin AXIS_DESCR STD_AXIS gangi dez 8 0.00 65535.00 DEPOSIT ABSOLUT /end AXIS_DESCR /end CHARACTERISTIC
/begin CHARACTERISTIC TZLRKTD "Periodendauer für Lambdaregelung aus Kat-Diagnose" VALUE 0x81B8B4 KwUw 655.3500 t10msxs_uw_b655p35 0.00 655.3500 FUNCTION_LIST DKATLRS IF_DATA DIM_X DIRECT 0x81B8B4 /end CHARACTERISTIC
/begin CHARACTERISTIC TZLRKTT "Periodendauer für Lambdaregelung aus Kat-Diagnose b. Testerbetreib" VALUE 0x81B8B6 KwUw 655.3500 t10msxs_uw_b655p35 0.00 655.3500 FUNCTION_LIST DKATLRS IF_DATA DIM_X DIRECT 0x81B8B6 /end CHARACTERISTIC
/begin CHARACTERISTIC TZMIN "Zeitfenster für Zahnerkennung nach UBatt-Einbruch" VALUE 0x812B4F KwUb 2.550 t10msxs_ub_b2p55 0.00 2.550 FUNCTION_LIST AEKP IF_DATA DIM_X DIRECT 0x812B4F /end CHARACTERISTIC
/begin CHARACTERISTIC TZSPINI "Sperrzeit fuer Filterinitialisierung" VALUE 0x8116AD KwUb 2.550 t10msxs_ub_b2p55 0.00 2.550 FUNCTION_LIST ARMD IF_DATA DIM_X DIRECT 0x8116AD /end CHARACTERISTIC
/begin CHARACTERISTIC TZTOL_UM "Toleranz zwischen Zeit- und Zahnzählererfassung in Timerinkrementen" VALUE 0x817F1A KwUw 65535.00 dez 0.00 65535.00 FUNCTION_LIST UFNC IF_DATA DIM_X DIRECT 0x817F1A /end CHARACTERISTIC
/begin CHARACTERISTIC UADHFMMN "min. Spannungswert für Diagnose HFM im Start" VALUE 0x8184DA KwUb 4.9805 spg_ub_q0p019 0.00 4.9805 FUNCTION_LIST DHFM IF_DATA DIM_X DIRECT 0x8184DA /end CHARACTERISTIC
/begin CHARACTERISTIC UADHFMMX "max. Spannungswert für Diagnose HFM im Start" VALUE 0x8184DB KwUb 4.9805 spg_ub_q0p019 0.00 4.9805 FUNCTION_LIST DHFM IF_DATA DIM_X DIRECT 0x8184DB /end CHARACTERISTIC
/begin CHARACTERISTIC UADPLMN "min. Spannungswert für Diagnose Drucksensor Ladedruck" VALUE 0x8184E7 KwUb 4.980 spg_ub_b5 0.00 4.980 FUNCTION_LIST GGDSAS IF_DATA DIM_X DIRECT 0x8184E7 /end CHARACTERISTIC
/begin CHARACTERISTIC UADPLMX "max. Spannungswert für Diagnose Drucksensor Ladedruck" VALUE 0x8184E8 KwUb 4.980 spg_ub_b5 0.00 4.980 FUNCTION_LIST GGDSAS IF_DATA DIM_X DIRECT 0x8184E8 /end CHARACTERISTIC
/begin CHARACTERISTIC UADPUMN "min. Spannungswert für Diagnose Drucksensor" VALUE 0x8184E9 KwUb 4.9805 spg_ub_q0p019 0.00 4.9805 FUNCTION_LIST GGDSAS IF_DATA DIM_X DIRECT 0x8184E9 /end CHARACTERISTIC
/begin CHARACTERISTIC UADPUMX "max. Spannungswert für Diagnose Drucksensor" VALUE 0x8184EA KwUb 4.9805 spg_ub_q0p019 0.00 4.9805 FUNCTION_LIST GGDSAS IF_DATA DIM_X DIRECT 0x8184EA /end CHARACTERISTIC
/begin CHARACTERISTIC UANAUFRP "Schrittweite für AUF-Rampe" VALUE 0x813D8E KwUw 0.9994659 relDK_uw_b100 0.00 0.9994659 FUNCTION_LIST BGDVE IF_DATA DIM_X DIRECT 0x813D8E /end CHARACTERISTIC
/begin CHARACTERISTIC UANNMAX "Motordrehzahlschwelle für Freigabe UMA-Lernen und Verstärkerabgleich" VALUE 0x810D40 KwUb 2550. nmot_ub_q10 0.00 2550. FUNCTION_LIST BGDVE T2DVE IF_DATA DIM_X DIRECT 0x810D40 /end CHARACTERISTIC
/begin CHARACTERISTIC UANPEDMAX "Pedalschwelle für UMA-Lernen erlaubt" VALUE 0x810D41 KwUb 100.0 relDK_ub_b100 0.00 100.0 FUNCTION_LIST BGDVE T2DVE IF_DATA DIM_X DIRECT 0x810D41 /end CHARACTERISTIC
/begin CHARACTERISTIC UANPIDMIN "Abbruchschwelle PID-Summe für ZU-Rampe" VALUE 0x813D90 KwUw 99.99847 rel_uw_b100 0.00 99.99847 FUNCTION_LIST BGDVE IF_DATA DIM_X DIRECT 0x813D90 /end CHARACTERISTIC
/begin CHARACTERISTIC UANPIDMINA "Abbruchschwelle PID-Summe für AUF-Rampe" VALUE 0x813D92 KwUw 99.99847 rel_uw_b100 0.00 99.99847 FUNCTION_LIST BGDVE IF_DATA DIM_X DIRECT 0x813D92 /end CHARACTERISTIC
/begin CHARACTERISTIC UANUATS "untere Ansauglufttemperaturschwelle für Lernfreigabe" VALUE 0x810D42 KwUb 191.3 temp_ub_q0p75_o48 -48.00 143.3 FUNCTION_LIST BGDVE T2DVE IF_DATA DIM_X DIRECT 0x810D42 /end CHARACTERISTIC
/begin CHARACTERISTIC UANVFZG "Geschwindigkeitssschelle für DV-E-Prüfung/Lernroutine" VALUE 0x810D43 KwUb 318.8 vfzg_ub_q1p25 0.00 318.8 FUNCTION_LIST BGDVE IF_DATA DIM_X DIRECT 0x810D43 /end CHARACTERISTIC
/begin CHARACTERISTIC UANZURP "Schrittweite für ZU-Rampe" VALUE 0x813D94 KwUw 0.05004883 spg_q1p221_mV 0.00 0.05004883 FUNCTION_LIST BGDVE IF_DATA DIM_X DIRECT 0x813D94 /end CHARACTERISTIC
/begin CHARACTERISTIC UAN_O_MT "obere Motortemperaturschwelle für Anschlag" VALUE 0x810D44 KwUb 191.3 temp_ub_q0p75_o48 -48.00 143.3 FUNCTION_LIST BGDVE T2DVE IF_DATA DIM_X DIRECT 0x810D44 /end CHARACTERISTIC
/begin CHARACTERISTIC UAN_STORE "Schwelle für Abspeicherung neuer Lernwerte" VALUE 0x813D96 KwUw 0.05004883 spg_q1p221_mV 0.00 0.05004883 FUNCTION_LIST BGDVE IF_DATA DIM_X DIRECT 0x813D96 /end CHARACTERISTIC
/begin CHARACTERISTIC UAN_U_MT "untere Motortemperaturschwelle für Anschlag" VALUE 0x810D45 KwUb 191.3 temp_ub_q0p75_o48 -48.00 143.3 FUNCTION_LIST BGDVE T2DVE IF_DATA DIM_X DIRECT 0x810D45 /end CHARACTERISTIC
/begin CHARACTERISTIC UBCJMN "Minimale UBat-Schwelle für Freigabe der CJ400-Endstufendiagnose" VALUE 0x810F18 KwUb 19.38 spg_ubatt 0.00 19.38 FUNCTION_LIST DECJ IF_DATA DIM_X DIRECT 0x810F18 /end CHARACTERISTIC
/begin CHARACTERISTIC UBCJMX "Maximale UBat-Schwelle für Freigabe der CJ400-Endstufendiagnose" VALUE 0x810F19 KwUb 19.38 spg_ubatt 0.00 19.38 FUNCTION_LIST DECJ IF_DATA DIM_X DIRECT 0x810F19 /end CHARACTERISTIC
/begin CHARACTERISTIC UBCJTJ "UBat-Schwelle für CJ450-Endstufendiagnose zur Erreichung der IC Übertemperatur" VALUE 0x810F1A KwUb 19.38 spg_ubatt 0.00 19.38 FUNCTION_LIST DECJ IF_DATA DIM_X DIRECT 0x810F1A /end CHARACTERISTIC
/begin CHARACTERISTIC UBDCAN "UBatt-Schwelle für Diagnose CAN-Timeout" VALUE 0x810237 KwUb 19.38 spg_ubatt 0.00 19.38 FUNCTION_LIST DCGE DCAS DCKBI IF_DATA DIM_X DIRECT 0x810237 /end CHARACTERISTIC
/begin CHARACTERISTIC UBDE "Ubatt - Ersatzwert bei defektem AD - Kanal" VALUE 0x810C79 KwUb 19.38 spg_ubatt 0.00 19.38 FUNCTION_LIST GGUB IF_DATA DIM_X DIRECT 0x810C79 /end CHARACTERISTIC
/begin CHARACTERISTIC UBDLS "Batteriespannungsschwelle zur Freigabe der Sonden-Diagnose" VALUE 0x8183FC KwUb 19.38 spg_ubatt 0.00 19.38 FUNCTION_LIST DLSH DHLSHK DHLSU T2DFA T2LID IF_DATA DIM_X DIRECT 0x8183FC /end CHARACTERISTIC
/begin CHARACTERISTIC UBDLSMX "obere Batteriespannungsschwelle für die  Sonden-Diagnose" VALUE 0x8183AA KwUb 19.38 spg_ubatt 0.00 19.38 FUNCTION_LIST DHLSHK DHLSU IF_DATA DIM_X DIRECT 0x8183AA /end CHARACTERISTIC
/begin CHARACTERISTIC UBDMN1 "Batteriespannung min. (Netz)" VALUE 0x810C7A KwUb 19.38 spg_ubatt 0.00 19.38 FUNCTION_LIST GGUB IF_DATA DIM_X DIRECT 0x810C7A /end CHARACTERISTIC
/begin CHARACTERISTIC UBDMN2 "Batteriespannung min. (ADC)" VALUE 0x810C7B KwUb 19.38 spg_ubatt 0.00 19.38 FUNCTION_LIST GGUB IF_DATA DIM_X DIRECT 0x810C7B /end CHARACTERISTIC
/begin CHARACTERISTIC UBDMX "Batteriespannung max." VALUE 0x810C7C KwUb 19.38 spg_ubatt 0.00 19.38 FUNCTION_LIST GGUB IF_DATA DIM_X DIRECT 0x810C7C /end CHARACTERISTIC
/begin CHARACTERISTIC UBGGLSU "Batteriespannungsschwelle zur Freigabe B_sbbvk LSU" VALUE 0x818476 KwUb 19.38 spg_ubatt 0.00 19.38 FUNCTION_LIST GGLSU IF_DATA DIM_X DIRECT 0x818476 /end CHARACTERISTIC
/begin CHARACTERISTIC UBHFM "Batteriespannungsschwelle zur Umschaltung auf Ersatzlastsignal" VALUE 0x8184DC KwUb 19.38 spg_ubatt 0.00 19.38 FUNCTION_LIST DHFM IF_DATA DIM_X DIRECT 0x8184DC /end CHARACTERISTIC
/begin CHARACTERISTIC UBHS "Batteriespannungsschwelle für Abschalten der Sondenheizung" VALUE 0x81847D KwUb 19.38 spg_ubatt 0.00 19.38 FUNCTION_LIST HLSHK HLSU IF_DATA DIM_X DIRECT 0x81847D /end CHARACTERISTIC
/begin CHARACTERISTIC UBKL15 "Ub-Schwelle für redundaten KL15-Erfassung" VALUE 0x8198A6 KwUb 5.396 spg_ubatt 0.00 5.396 FUNCTION_LIST GGZDGON IF_DATA DIM_X DIRECT 0x8198A6 /end CHARACTERISTIC
/begin CHARACTERISTIC UBKST "Ubat-Schwelle für ZUBKSTMX" VALUE 0x811462 KwUb 19.38 spg_ubatt 0.00 19.38 FUNCTION_LIST STADAP IF_DATA DIM_X DIRECT 0x811462 /end CHARACTERISTIC
/begin CHARACTERISTIC UBKSTMX "Anzahlschwelle Ubat unter UBKST für Adaptionssperrung" VALUE 0x811463 KwUb 255.0 dez 0.00 255.0 FUNCTION_LIST STADAP IF_DATA DIM_X DIRECT 0x811463 /end CHARACTERISTIC
/begin CHARACTERISTIC UBMAX "Max. Batteriespannung" VALUE 0x819D80 KwUb 19.38 spg_ubatt 0.00 19.38 FUNCTION_LIST VS IF_DATA DIM_X DIRECT 0x819D80 /end CHARACTERISTIC
/begin CHARACTERISTIC UBMIN "Min. Batteriespannung" VALUE 0x819D81 KwUb 19.38 spg_ubatt 0.00 19.38 FUNCTION_LIST VS IF_DATA DIM_X DIRECT 0x819D81 /end CHARACTERISTIC
/begin CHARACTERISTIC UBMNPUP "Mindest-Bordspannung für pullup-Ansteuerung" VALUE 0x81906A KwUb 25.50 spg_q0p1 0.00 25.50 FUNCTION_LIST GGTFM IF_DATA DIM_X DIRECT 0x81906A /end CHARACTERISTIC
/begin CHARACTERISTIC UBNLMN "Minimale Batterie-Sollspannung" VALUE 0x8198A7 KwUb 19.38 spg_ubatt 0.00 19.38 FUNCTION_LIST MOTAUS IF_DATA DIM_X DIRECT 0x8198A7 /end CHARACTERISTIC
/begin CHARACTERISTIC UBSLMN "min. Spannung für Sekundärluft ein" VALUE 0x818180 KwUb 19.38 spg_ubatt 0.00 19.38 FUNCTION_LIST SLS T2DFA T2LID IF_DATA DIM_X DIRECT 0x818180 /end CHARACTERISTIC
/begin CHARACTERISTIC UBSLMX "max. Spannung für Sekundärluft ein" VALUE 0x818181 KwUb 19.38 spg_ubatt 0.00 19.38 FUNCTION_LIST SLS IF_DATA DIM_X DIRECT 0x818181 /end CHARACTERISTIC
/begin CHARACTERISTIC UBSLSTMN "min.Spannung für Sekundärluft ein im Start" VALUE 0x818182 KwUb 19.38 spg_ubatt 0.00 19.38 FUNCTION_LIST SLS IF_DATA DIM_X DIRECT 0x818182 /end CHARACTERISTIC
/begin CHARACTERISTIC UBSOLMN "Minimale Batterie-Sollspannung" VALUE 0x818481 KwUb 19.38 spg_ubatt 0.00 19.38 FUNCTION_LIST BGLBZ IF_DATA DIM_X DIRECT 0x818481 /end CHARACTERISTIC
/begin CHARACTERISTIC UBSOLMX "Maximale Batterie-Sollspannung" VALUE 0x818482 KwUb 19.38 spg_ubatt 0.00 19.38 FUNCTION_LIST BGLBZ IF_DATA DIM_X DIRECT 0x818482 /end CHARACTERISTIC
/begin CHARACTERISTIC UBSTS "Schwelle zur Erkennung UBatt-Einbruch im Start" VALUE 0x812B50 KwUb 19.38 spg_ubatt 0.00 19.38 FUNCTION_LIST AEKP IF_DATA DIM_X DIRECT 0x812B50 /end CHARACTERISTIC
/begin CHARACTERISTIC UBVDKPO "Batteriespannungsschwelle für Umschaltung auf verstärktes Signal von DK-Poti 1" VALUE 0x810E0A KwUb 19.38 spg_ubatt 0.00 19.38 FUNCTION_LIST GGDVE IF_DATA DIM_X DIRECT 0x810E0A /end CHARACTERISTIC
/begin CHARACTERISTIC UBVDKPU "Batteriespannungsschwelle für Umschaltung auf unverstärktes Signal von DK-Poti 1" VALUE 0x810E0B KwUb 19.38 spg_ubatt 0.00 19.38 FUNCTION_LIST GGDVE IF_DATA DIM_X DIRECT 0x810E0B /end CHARACTERISTIC
/begin CHARACTERISTIC UB_UANL "Batteriespannungsschwelle für Lernfreigabe" VALUE 0x810D46 KwUb 19.38 spg_ubatt 0.00 19.38 FUNCTION_LIST BGDVE T2DVE IF_DATA DIM_X DIRECT 0x810D46 /end CHARACTERISTIC
/begin CHARACTERISTIC UDKNLP1N "Nennwert-Spannung DK-Poti 1 in NLP-Stellung" VALUE 0x813D98 KwUw 4.998779 spg_q1p221_mV 0.00 4.998779 FUNCTION_LIST BGDVE IF_DATA DIM_X DIRECT 0x813D98 /end CHARACTERISTIC
/begin CHARACTERISTIC UDKNLP2N "Nennwert-Spannung DK-Poti 2 in NLP-Stellung" VALUE 0x813D9A KwUw 4.998779 spg_q1p221_mV 0.00 4.998779 FUNCTION_LIST BGDVE IF_DATA DIM_X DIRECT 0x813D9A /end CHARACTERISTIC
/begin CHARACTERISTIC UDKNLPTOL "zulässige Potispannungs-Toleranz des NLP" VALUE 0x813D5A KwUw 80.08377 spg_uw_q0p001222 0.00 80.08377 FUNCTION_LIST ADVE IF_DATA DIM_X DIRECT 0x813D5A /end CHARACTERISTIC
/begin CHARACTERISTIC UDKP1AMAX "max. Spannung DK-Poti 1 am unteren DK-Anschlag" VALUE 0x813D9C KwUw 4.998779 spg_q1p221_mV 0.00 4.998779 FUNCTION_LIST BGDVE IF_DATA DIM_X DIRECT 0x813D9C /end CHARACTERISTIC
/begin CHARACTERISTIC UDKP1AMIN "min. Spannung DK-Poti 1 am unteren DK-Anschlag" VALUE 0x813D9E KwUw 4.998779 spg_q1p221_mV 0.00 4.998779 FUNCTION_LIST BGDVE IF_DATA DIM_X DIRECT 0x813D9E /end CHARACTERISTIC
/begin CHARACTERISTIC UDKP1AURI "Spannung DK-Poti 1 am unt. DK-Anschlag, Initial. Wert" VALUE 0x813DA0 KwUw 4.998779 spg_q1p221_mV 0.00 4.998779 FUNCTION_LIST BGDVE IF_DATA DIM_X DIRECT 0x813DA0 /end CHARACTERISTIC
/begin CHARACTERISTIC UDKP1DUS "Nennumschaltschwelle zur DK-Poti-1-Umschaltung" VALUE 0x810D47 KwUb 4.9805 spg_ub_q0p019 0.00 4.9805 FUNCTION_LIST BGDVE IF_DATA DIM_X DIRECT 0x810D47 /end CHARACTERISTIC
/begin CHARACTERISTIC UDKP1NHUB "Nennhub der Drosselklappe im DV-E, (Poti 1)" VALUE 0x813DA2 KwUw 4.998779 spg_q1p221_mV 0.00 4.998779 FUNCTION_LIST BGDVE IF_DATA DIM_X DIRECT 0x813DA2 /end CHARACTERISTIC
/begin CHARACTERISTIC UDKP1O "Maximale zulässige Spannung von DK-Poti 1" VALUE 0x810E0C KwUb 4.980 spg_ub_b5 0.00 4.980 FUNCTION_LIST GGDVE IF_DATA DIM_X DIRECT 0x810E0C /end CHARACTERISTIC
/begin CHARACTERISTIC UDKP1U "Minimale zulässige Spannung von DK-Poti 1" VALUE 0x810E0D KwUb 4.980 spg_ub_b5 0.00 4.980 FUNCTION_LIST GGDVE IF_DATA DIM_X DIRECT 0x810E0D /end CHARACTERISTIC
/begin CHARACTERISTIC UDKP1VID "Nennverstärkung für DK-Poti 1" VALUE 0x813DA4 KwUw 7.996094 fak_q0p0039 0.00 7.996094 FUNCTION_LIST BGDVE IF_DATA DIM_X DIRECT 0x813DA4 /end CHARACTERISTIC
/begin CHARACTERISTIC UDKP1VOMA "max. Offsetfehler für DK-Poti-1-Verstärker" VALUE 0x813DA6 KwSw 5.004090 spg_sw_q0p001222 0.00 5.004090 FUNCTION_LIST BGDVE IF_DATA DIM_X DIRECT 0x813DA6 /end CHARACTERISTIC
/begin CHARACTERISTIC UDKP1VOMI "min. Offsetfehler für DK-Poti-1-Verstärker" VALUE 0x813DA8 KwSw 5.004090 spg_sw_q0p001222 -5.004090 0.00 FUNCTION_LIST BGDVE IF_DATA DIM_X DIRECT 0x813DA8 /end CHARACTERISTIC
/begin CHARACTERISTIC UDKP1VOSC "unt. Grenze für ob. Abgleichpkt. DK-Poti 1" VALUE 0x813DAA KwUw 4.995117 spg_uw_q0p00488 0.00 4.995117 FUNCTION_LIST BGDVE IF_DATA DIM_X DIRECT 0x813DAA /end CHARACTERISTIC
/begin CHARACTERISTIC UDKP1VUSC "ob. Grenze für unt. Abgleichpkt. DK-Poti 1" VALUE 0x813DAC KwUw 4.995117 spg_uw_q0p00488 0.00 4.995117 FUNCTION_LIST BGDVE IF_DATA DIM_X DIRECT 0x813DAC /end CHARACTERISTIC
/begin CHARACTERISTIC UDKP1VVMA "ob. Wert Verstärkungsfehler für Verstärker" VALUE 0x813DAE KwUw 7.996094 fak_q0p0039 0.00 7.996094 FUNCTION_LIST BGDVE IF_DATA DIM_X DIRECT 0x813DAE /end CHARACTERISTIC
/begin CHARACTERISTIC UDKP1VVMI "unt. Wert Verstärkungsfehler für Verstärker" VALUE 0x813DB0 KwUw 7.996094 fak_q0p0039 0.00 7.996094 FUNCTION_LIST BGDVE IF_DATA DIM_X DIRECT 0x813DB0 /end CHARACTERISTIC
/begin CHARACTERISTIC UDKP2AMAX "max. Spannung DK-Poti 2 am unteren DK-Anschlag" VALUE 0x813DB2 KwUw 4.998779 spg_q1p221_mV 0.00 4.998779 FUNCTION_LIST BGDVE IF_DATA DIM_X DIRECT 0x813DB2 /end CHARACTERISTIC
/begin CHARACTERISTIC UDKP2AMIN "min. Spannung DK-Poti 2 am unteren DK-Anschlag" VALUE 0x813DB4 KwUw 4.998779 spg_q1p221_mV 0.00 4.998779 FUNCTION_LIST BGDVE IF_DATA DIM_X DIRECT 0x813DB4 /end CHARACTERISTIC
/begin CHARACTERISTIC UDKP2AURI "Spannung DK-Poti 2 am unt. DK-Anschlag, Initial. Wert" VALUE 0x813DB6 KwUw 4.998779 spg_q1p221_mV 0.00 4.998779 FUNCTION_LIST BGDVE IF_DATA DIM_X DIRECT 0x813DB6 /end CHARACTERISTIC
/begin CHARACTERISTIC UDKP2O "Maximale zulässige Spannung von DK-Poti 2" VALUE 0x810E0E KwUb 4.980 spg_ub_b5 0.00 4.980 FUNCTION_LIST GGDVE IF_DATA DIM_X DIRECT 0x810E0E /end CHARACTERISTIC
/begin CHARACTERISTIC UDKP2U "Minimale zulässige Spannung von DK-Poti 2" VALUE 0x810E0F KwUb 4.980 spg_ub_b5 0.00 4.980 FUNCTION_LIST GGDVE IF_DATA DIM_X DIRECT 0x810E0F /end CHARACTERISTIC
/begin CHARACTERISTIC UDKPALOS "Spannungsoffset zur Erkennung des Loslösens" VALUE 0x813DB8 KwUw 0.4003906 spg_q1p221_mV 0.00 0.4003906 FUNCTION_LIST BGDVE IF_DATA DIM_X DIRECT 0x813DB8 /end CHARACTERISTIC
/begin CHARACTERISTIC UDKPAOFF "Spannungsoffset am unteren Anschlag" VALUE 0x813DBA KwUw 0.05004883 spg_q1p221_mV 0.00 0.05004883 FUNCTION_LIST BGDVE IF_DATA DIM_X DIRECT 0x813DBA /end CHARACTERISTIC
/begin CHARACTERISTIC UDKPATMX "max. möglicher Offset der temp. UMA-Adaption" VALUE 0x813DBC KwUw 4.998779 spg_q1p221_mV 0.00 4.998779 FUNCTION_LIST BGDVE IF_DATA DIM_X DIRECT 0x813DBC /end CHARACTERISTIC
/begin CHARACTERISTIC UDKRGOFS "Spannungsschwelle für DIA/KR Grundoffset Verstärker" VALUE 0x811488 KwUb 4.980 spg_ub_b5 0.00 4.980 FUNCTION_LIST DKRNT IF_DATA DIM_X DIRECT 0x811488 /end CHARACTERISTIC
/begin CHARACTERISTIC UDKRTP "Integratorspannungsschwelle für Dia KS - Auswerteschaltung Testimpuls" VALUE 0x81148A KwUb 4.980 spg_ub_b5 0.00 4.980 FUNCTION_LIST DKRTP IF_DATA DIM_X DIRECT 0x81148A /end CHARACTERISTIC
/begin CHARACTERISTIC UDKSNO "Obere Referenzspannungsschwelle DIA KS" CURVE 0x81D3CC GklWUw 319.9813 spg_uw_b1280 0.00 319.9813 FUNCTION_LIST DKRS IF_DATA DIM_X DIRECT 0x81D3CC
 /begin AXIS_DESCR COM_AXIS nmot nmot_ub_q40 16 0.00 10200. AXIS_PTS_REF SNM16KRUB /end AXIS_DESCR
/end CHARACTERISTIC
/begin CHARACTERISTIC UDKSNU "untere Referenzspannungsschwelle DIA KS" CURVE 0x81D3EC GklWUw 319.9813 spg_uw_b1280 0.00 319.9813 FUNCTION_LIST DKRS IF_DATA DIM_X DIRECT 0x81D3EC
 /begin AXIS_DESCR COM_AXIS nmot nmot_ub_q40 16 0.00 10200. AXIS_PTS_REF SNM16KRUB /end AXIS_DESCR
/end CHARACTERISTIC
/begin CHARACTERISTIC UEVERG "Übersetzungsverhältnis abh. vom eingelegten Gang" CURVE 0x811673 KlAUbSstUbWUb 15.94 fak_ub_b16 0.00 15.94 FUNCTION_LIST MDWAN IF_DATA DIM_X DIRECT 0x811673 /begin AXIS_DESCR STD_AXIS gangi dez 14 0.00 255.0 DEPOSIT ABSOLUT /end AXIS_DESCR /end CHARACTERISTIC
/begin CHARACTERISTIC UHEMN "Schwellwert für bestromte Heizerendstufe" VALUE 0x810C64 KwUb 4.9805 spg_ub_q0p019 0.00 4.9805 FUNCTION_LIST DHLSU IF_DATA DIM_X DIRECT 0x810C64 /end CHARACTERISTIC
/begin CHARACTERISTIC UHEMX "Schwellwert für stromlose Heizerendstufe" VALUE 0x810C65 KwUb 4.9805 spg_ub_q0p019 0.00 4.9805 FUNCTION_LIST DHLSU IF_DATA DIM_X DIRECT 0x810C65 /end CHARACTERISTIC
/begin CHARACTERISTIC UHSN "Nennspannung für die Sondenheizung" VALUE 0x81847E KwUb 19.38 spg_ubatt 0.00 19.38 FUNCTION_LIST HLSHK IF_DATA DIM_X DIRECT 0x81847E /end CHARACTERISTIC
/begin CHARACTERISTIC ULSUAMN "Minimale Spannung der LSU während Abgleich" VALUE 0x813D08 KwUw 319.9951 spg_uw_q0p00488 0.00 319.9951 FUNCTION_LIST GGLSU IF_DATA DIM_X DIRECT 0x813D08 /end CHARACTERISTIC
/begin CHARACTERISTIC ULSUAMX "Maximale Spannung der LSU während Abgleich" VALUE 0x813D0A KwUw 319.9951 spg_uw_q0p00488 0.00 319.9951 FUNCTION_LIST GGLSU IF_DATA DIM_X DIRECT 0x813D0A /end CHARACTERISTIC
/begin CHARACTERISTIC UMDYLDR "Umschaltschwelle Dynamik LDR" VALUE 0x819628 KwSb 1270. p_sb_q10 0.00 1270. FUNCTION_LIST LDRPID IF_DATA DIM_X DIRECT 0x819628 /end CHARACTERISTIC
/begin CHARACTERISTIC UMECRST_TV_UM "" VALUE 0x817D01 KwUb 255.0 dez 0.00 255.0 FUNCTION_LIST UFURAM IF_DATA DIM_X DIRECT 0x817D01 /end CHARACTERISTIC
/begin CHARACTERISTIC UMRST_TV_UM "" VALUE 0x817D02 KwUb 255.0 dez 0.00 255.0 FUNCTION_LIST UFURAM UMKOMF IF_DATA DIM_X DIRECT 0x817D02 /end CHARACTERISTIC
/begin CHARACTERISTIC UNWDHFM "Umdrehungen Nockenwelle für Fehlerentprellung Diagnose HFM" VALUE 0x81BDBE KwUw 65535.00 dez 0.00 65535.00 FUNCTION_LIST DHFM IF_DATA DIM_X DIRECT 0x81BDBE /end CHARACTERISTIC
/begin CHARACTERISTIC UNWDNWS "Umdrehungen Nockenwelle für Fehlerentprellung Diagnose NWS" VALUE 0x818631 KwUb 255.0 nwu_q1 0.00 255.0 FUNCTION_LIST DNWS IF_DATA DIM_X DIRECT 0x818631 /end CHARACTERISTIC
/begin CHARACTERISTIC UPVGNENN "Nennwert für DV-E Potiversorgungsspannung" VALUE 0x81B99A KwUw 1.000000 dez 65534.00 65535.00 FUNCTION_LIST BGDVE IF_DATA DIM_X DIRECT 0x81B99A /end CHARACTERISTIC
/begin CHARACTERISTIC UPW1BE "Spannung PWG-Poti 1 für Durchführung der Bewegungserkennung" VALUE 0x810E3C KwUb 4.980 spg_ub_b5 0.00 4.980 FUNCTION_LIST GGPED IF_DATA DIM_X DIRECT 0x810E3C /end CHARACTERISTIC
/begin CHARACTERISTIC UPW1LLMX "Maximale Spannung von Poti 1 im Leergaspunkt" VALUE 0x810E3D KwUb 4.980 spg_ub_b5 0.00 4.980 FUNCTION_LIST GGPED IF_DATA DIM_X DIRECT 0x810E3D /end CHARACTERISTIC
/begin CHARACTERISTIC UPWG12U "Untere Begrenzung PWG-Poti-Spannung vor Vergleich Poti 1 und 2" VALUE 0x810E3E KwUb 4.980 spg_ub_b5 0.00 4.980 FUNCTION_LIST GGPED IF_DATA DIM_X DIRECT 0x810E3E /end CHARACTERISTIC
/begin CHARACTERISTIC UPWG1O "Obere Schranke für PWG-Poti-1-Spannung" VALUE 0x810E3F KwUb 4.980 spg_ub_b5 0.00 4.980 FUNCTION_LIST GGPED IF_DATA DIM_X DIRECT 0x810E3F /end CHARACTERISTIC
/begin CHARACTERISTIC UPWG1U "Untere Schranke für PWG-Poti-1-Spannung" VALUE 0x810E40 KwUb 4.980 spg_ub_b5 0.00 4.980 FUNCTION_LIST GGPED IF_DATA DIM_X DIRECT 0x810E40 /end CHARACTERISTIC
/begin CHARACTERISTIC UPWG2O "Obere Schranke für PWG-Poti-2-Spannung" VALUE 0x810E41 KwUb 4.980 spg_ub_b5 0.00 4.980 FUNCTION_LIST GGPED IF_DATA DIM_X DIRECT 0x810E41 /end CHARACTERISTIC
/begin CHARACTERISTIC UPWG2U "Untere Schranke für PWG-Poti-2-Spannung" VALUE 0x810E42 KwUb 4.980 spg_ub_b5 0.00 4.980 FUNCTION_LIST GGPED IF_DATA DIM_X DIRECT 0x810E42 /end CHARACTERISTIC
/begin CHARACTERISTIC UPWGKDO "Oberer Hysterese-Schaltpunkt zur Kick-Down-Erkennung aus Potispannung" VALUE 0x810E43 KwUb 4.980 spg_ub_b5 0.00 4.980 FUNCTION_LIST GGPED IF_DATA DIM_X DIRECT 0x810E43 /end CHARACTERISTIC
/begin CHARACTERISTIC UPWGKDU "Unterer Hysterese-Schaltpunkt zur Kick-Down-Erkennung aus Potispannung" VALUE 0x810E44 KwUb 4.980 spg_ub_b5 0.00 4.980 FUNCTION_LIST GGPED IF_DATA DIM_X DIRECT 0x810E44 /end CHARACTERISTIC
/begin CHARACTERISTIC UPWGO "Oberer PWG-Spannungswert für Umnormierung auf Pedalwert" VALUE 0x810E45 KwUb 4.980 spg_ub_b5 0.00 4.980 FUNCTION_LIST GGPED IF_DATA DIM_X DIRECT 0x810E45 /end CHARACTERISTIC
/begin CHARACTERISTIC UPWGTG "PWG-Spannungsschwelle für Teilgasbereich" VALUE 0x810E46 KwUb 4.980 spg_ub_b5 0.00 4.980 FUNCTION_LIST GGPED IF_DATA DIM_X DIRECT 0x810E46 /end CHARACTERISTIC
/begin CHARACTERISTIC UPWGTL "Teillastschwelle der PWG-Spannung in Hochohmigkeitsprüfung" VALUE 0x810E47 KwUb 4.980 spg_ub_b5 0.00 4.980 FUNCTION_LIST GGPED IF_DATA DIM_X DIRECT 0x810E47 /end CHARACTERISTIC
/begin CHARACTERISTIC UPWGU "Unterer PWG-Spannungswert für Umnormierung auf Pedalwert" VALUE 0x810E48 KwUb 4.980 spg_ub_b5 0.00 4.980 FUNCTION_LIST GGPED IF_DATA DIM_X DIRECT 0x810E48 /end CHARACTERISTIC
/begin CHARACTERISTIC UPWGUBF "Unterer Spannungswert zur Umnormierung bei erkanntem Bewegungsfehler" VALUE 0x810E49 KwUb 4.980 spg_ub_b5 0.00 4.980 FUNCTION_LIST GGPED IF_DATA DIM_X DIRECT 0x810E49 /end CHARACTERISTIC
/begin CHARACTERISTIC UPWGUR "Reduzierter unterer PWG-Spannungswert für Umnormierung auf Pedalwert" VALUE 0x810E4A KwUb 4.980 spg_ub_b5 0.00 4.980 FUNCTION_LIST GGPED IF_DATA DIM_X DIRECT 0x810E4A /end CHARACTERISTIC
/begin CHARACTERISTIC UPWGVG "PWG-Spannungsschwelle für Vollgasbereich" VALUE 0x810E4B KwUb 4.980 spg_ub_b5 0.00 4.980 FUNCTION_LIST GGPED IF_DATA DIM_X DIRECT 0x810E4B /end CHARACTERISTIC
/begin CHARACTERISTIC USABGL "LSU-Spannung bei Pumpstrom Null" VALUE 0x813D0C KwUw 319.9951 spg_uw_q0p00488 0.00 319.9951 FUNCTION_LIST GGLSU IF_DATA DIM_X DIRECT 0x813D0C /end CHARACTERISTIC
/begin CHARACTERISTIC USHKAMX "Sondenspannung hinter Kat für Abbruch Kat-Ausräumen" VALUE 0x811FEE KwUb 1.330 spg_ub_q0p0052_o0p2 -0.2000 1.130 FUNCTION_LIST LRSKA IF_DATA DIM_X DIRECT 0x811FEE /end CHARACTERISTIC
/begin CHARACTERISTIC USHKAMX2 "Sondenspannung hinter Kat für Abbruch Kat-Ausräumen Bank2" VALUE 0x811FEF KwUb 1.330 spg_ub_q0p0052_o0p2 -0.2000 1.130 FUNCTION_LIST LRSKA IF_DATA DIM_X DIRECT 0x811FEF /end CHARACTERISTIC
/begin CHARACTERISTIC USHKFT "Sondenspannungs-Schwelle für Erkennung ""Abgas fett"" hinter Kat" VALUE 0x818421 KwUb 1.330 spg_ub_q0p0052_o0p2 -0.2000 1.130 FUNCTION_LIST DLSU IF_DATA DIM_X DIRECT 0x818421 /end CHARACTERISTIC
/begin CHARACTERISTIC USHKMR "Sondenspannungs-Schwelle für Erkennung ""Abgas mager"" hinter Kat" VALUE 0x818422 KwUb 1.330 spg_ub_q0p0052_o0p2 -0.2000 1.130 FUNCTION_LIST DLSU IF_DATA DIM_X DIRECT 0x818422 /end CHARACTERISTIC
/begin CHARACTERISTIC USHLEAN "Schwelle für Magerspannung für Reset Dynamikmessung der Sonde hinter KAT" VALUE 0x8183F1 KwUb 1.330 spg_ub_q0p0052_o0p2 -0.2000 1.130 FUNCTION_LIST DLSAHK IF_DATA DIM_X DIRECT 0x8183F1 /end CHARACTERISTIC
/begin CHARACTERISTIC USHRICH "Schwelle für Fettspannung für gültige Dynamikmessung der Sonde hinter KAT" VALUE 0x8183F2 KwUb 1.330 spg_ub_q0p0052_o0p2 -0.2000 1.130 FUNCTION_LIST DLSAHK IF_DATA DIM_X DIRECT 0x8183F2 /end CHARACTERISTIC
/begin CHARACTERISTIC USHSTGMX "Wert für maximale Steigung für Startwert Filter" VALUE 0x8183F3 KwUb 132.6 spgg_q0p52 0.00 132.6 FUNCTION_LIST DLSAHK IF_DATA DIM_X DIRECT 0x8183F3 /end CHARACTERISTIC
/begin CHARACTERISTIC USHSTSOLL "Schwelle für zulässige Steigung der Sondenspannung hinter KAT" VALUE 0x8183F4 KwUb 132.6 spgg_q0p52 0.00 132.6 FUNCTION_LIST DLSAHK IF_DATA DIM_X DIRECT 0x8183F4 /end CHARACTERISTIC
/begin CHARACTERISTIC USIVMAXH "Init value für max.Sondenspg. hinter Kat nach Powerfail u. Fehlersp. löschen" VALUE 0x8184BF KwUb 1.330 spg_ub_b1p33 0.00 1.330 FUNCTION_LIST DLSSA IF_DATA DIM_X DIRECT 0x8184BF /end CHARACTERISTIC
/begin CHARACTERISTIC USIVMINH "Init value für min.Sondenspg. hinter Kat nach Powerfail u. Fehlersp. löschen" VALUE 0x8184C0 KwUb 1.330 spg_ub_b1p33 0.00 1.330 FUNCTION_LIST DLSSA IF_DATA DIM_X DIRECT 0x8184C0 /end CHARACTERISTIC
/begin CHARACTERISTIC USMAX "Schwelle für Sondenkurzschluß nach Ubat" VALUE 0x813C06 KwUw 319.9951 spg_uw_q0p00488_o1 -1.000000 318.9951 FUNCTION_LIST DLSH IF_DATA DIM_X DIRECT 0x813C06 /end CHARACTERISTIC
/begin CHARACTERISTIC USMIN "Schwelle für Sondenkurzschluß nach Masse" VALUE 0x813C08 KwUw 319.9951 spg_uw_q0p00488_o1 -1.000000 318.9951 FUNCTION_LIST DLSH IF_DATA DIM_X DIRECT 0x813C08 /end CHARACTERISTIC
/begin CHARACTERISTIC USMNSHMN "min. erkannte Sondenspannung hinter Kat für Signalausgabe (min. plaus. Wert)" VALUE 0x8184C1 KwUb 1.330 spg_ub_b1p33 0.00 1.330 FUNCTION_LIST DLSSA TC5MOD IF_DATA DIM_X DIRECT 0x8184C1 /end CHARACTERISTIC
/begin CHARACTERISTIC USMNSHMX "min. erkannte Sondenspannung hinter Kat für Signalausgabe (max. plaus. Wert)" VALUE 0x8184C2 KwUb 1.330 spg_ub_b1p33 0.00 1.330 FUNCTION_LIST DLSSA TC5MOD IF_DATA DIM_X DIRECT 0x8184C2 /end CHARACTERISTIC
/begin CHARACTERISTIC USMXSHMN "max. erkannte Sondenspannung hinter Kat für Signalausgabe (min. plaus. Wert)" VALUE 0x8184C3 KwUb 1.330 spg_ub_b1p33 0.00 1.330 FUNCTION_LIST DLSSA TC5MOD IF_DATA DIM_X DIRECT 0x8184C3 /end CHARACTERISTIC
/begin CHARACTERISTIC USMXSHMX "max. erkannte Sondenspannung hinter Kat für Signalausgabe (max. plaus. Wert)" VALUE 0x8184C4 KwUb 1.330 spg_ub_b1p33 0.00 1.330 FUNCTION_LIST DLSSA TC5MOD IF_DATA DIM_X DIRECT 0x8184C4 /end CHARACTERISTIC
/begin CHARACTERISTIC USREFH "Schwelle für Sondenbetriebsbereitschaft hinter KAT bei fettem Gemisch" VALUE 0x813C0A KwUw 319.9951 spg_uw_q0p00488_o1 -1.000000 318.9951 FUNCTION_LIST DLSH IF_DATA DIM_X DIRECT 0x813C0A /end CHARACTERISTIC
/begin CHARACTERISTIC USREMH "Schwelle für Sondenbetriebsbereitschaft hinter KAT bei magerem Gemisch" VALUE 0x813C0C KwUw 319.9951 spg_uw_q0p00488_o1 -1.000000 318.9951 FUNCTION_LIST DLSH IF_DATA DIM_X DIRECT 0x813C0C /end CHARACTERISTIC
/begin CHARACTERISTIC USRHKSHJ "Regelschwelle für Regelung hinter Kat, DLSSA-Ausgabe umgerechn. Wert" VALUE 0x8184C5 KwUb 1.330 spg_ub_b1p33 0.00 1.330 FUNCTION_LIST DLSSA TC5MOD IF_DATA DIM_X DIRECT 0x8184C5 /end CHARACTERISTIC
/begin CHARACTERISTIC USRIMINH "Mindest Spannungs-Schwelle für Ri-Messung der Sonde hinter KAT" VALUE 0x813C28 KwUw 319.9951 spg_uw_q0p00488_o1 -1.000000 318.9951 FUNCTION_LIST GGLSH IF_DATA DIM_X DIRECT 0x813C28 /end CHARACTERISTIC
/begin CHARACTERISTIC USRIOH "Obere Spannungs-Schwelle für Ri-Messung der Sonde hinter KAT" VALUE 0x813C2A KwUw 319.9951 spg_uw_q0p00488_o1 -1.000000 318.9951 FUNCTION_LIST GGLSH IF_DATA DIM_X DIRECT 0x813C2A /end CHARACTERISTIC
/begin CHARACTERISTIC USRIUH "Untere Spannungs-Schwelle für Ri-Messung der Sonde hinter KAT" VALUE 0x813C2C KwUw 319.9951 spg_uw_q0p00488_o1 -1.000000 318.9951 FUNCTION_LIST GGLSH IF_DATA DIM_X DIRECT 0x813C2C /end CHARACTERISTIC
/begin CHARACTERISTIC USRJ "" VALUE 0x8184C6 KwUb 1.330 spg_ub_b1p33 0.00 1.330 FUNCTION_LIST DLSSA IF_DATA DIM_X DIRECT 0x8184C6 /end CHARACTERISTIC
/begin CHARACTERISTIC USSCHUB "Schwelle für Sondenspannung hinter KAT nach Schub" VALUE 0x8183F5 KwUb 1.330 spg_ub_q0p0052_o0p2 -0.2000 1.130 FUNCTION_LIST DLSAHK IF_DATA DIM_X DIRECT 0x8183F5 /end CHARACTERISTIC
/begin CHARACTERISTIC VABSCH "Vmax-Regler-Abschaltschwelle, variantenkodiert" VALUE 0x816722 KwUw 511.9922 vfzg_uw_q0p00781 0.00 511.9922 FUNCTION_LIST VMAXMD IF_DATA DIM_X DIRECT 0x816722 /end CHARACTERISTIC
/begin CHARACTERISTIC VANF "Geschwindigkeitsschwelle für Anfahrhilfe" VALUE 0x8159A8 KwUw 511.9922 vfzg_uw_b512 0.00 511.9922 FUNCTION_LIST LLRMR IF_DATA DIM_X DIRECT 0x8159A8 /end CHARACTERISTIC
/begin CHARACTERISTIC VANFSK "vfzg-Schwelle: Anfahren mit schleifender Kupplung" VALUE 0x819D82 KwUb 318.8 vfzg_ub_q1p25 0.00 318.8 FUNCTION_LIST VS IF_DATA DIM_X DIRECT 0x819D82 /end CHARACTERISTIC
/begin CHARACTERISTIC VANFU "Geschw.abhängige Umschaltschwelle Momenentenreserve" VALUE 0x8159AA KwUw 511.9922 vfzg_uw_b512 0.00 511.9922 FUNCTION_LIST LLRMR IF_DATA DIM_X DIRECT 0x8159AA /end CHARACTERISTIC
/begin CHARACTERISTIC VARAU "minimale Fahrzeuggeschwindigkeit für ARA - Funktion" VALUE 0x8116AE KwUb 317.5 fak_ub_b318p75 0.00 317.5 FUNCTION_LIST ARMD IF_DATA DIM_X DIRECT 0x8116AE /end CHARACTERISTIC
/begin CHARACTERISTIC VASRM "Geschwindigkeitsschwelle für Schlechtwegerkennung" VALUE 0x8121CA KwUb 318.8 vfzg_ub_q1p25 0.00 318.8 FUNCTION_LIST BGRBS IF_DATA DIM_X DIRECT 0x8121CA /end CHARACTERISTIC
/begin CHARACTERISTIC VBGFGRAQ "Geschwindigkeit Bereichsgrenze bei Aquaplaningerkennung" VALUE 0x813EE2 KwUw 511.9922 vfzg_uw_b512 0.00 511.9922 FUNCTION_LIST BBFGR IF_DATA DIM_X DIRECT 0x813EE2 /end CHARACTERISTIC
/begin CHARACTERISTIC VBSMX "obere Plausibilitätsschwelle für Radgeschwindigkeit" VALUE 0x8175C4 KwUw 324.9950 vfzg_uw_b325 0.00 324.9950 FUNCTION_LIST BGRBS IF_DATA DIM_X DIRECT 0x8175C4 /end CHARACTERISTIC
/begin CHARACTERISTIC VDKUPPLMN "min. vfzg-Schwelle für Diagnose Kupplungsschalter" VALUE 0x818487 KwUb 318.8 vfzg_ub_q1p25 0.00 318.8 FUNCTION_LIST DKUPPL IF_DATA DIM_X DIRECT 0x818487 /end CHARACTERISTIC
/begin CHARACTERISTIC VDMN "Geschwindigkeitsschwelle; Fehlererkennung Geschwindigkeitssignal" VALUE 0x81B990 KwUw 511.9922 vfzg_uw_b512 0.00 511.9922 FUNCTION_LIST DVFZ IF_DATA DIM_X DIRECT 0x81B990 /end CHARACTERISTIC
/begin CHARACTERISTIC VER_CAN "CAN-Version" VALUE 0x810222 KwUb 255.0 dez 0.00 255.0 FUNCTION_LIST CAN IF_DATA DIM_X DIRECT 0x810222 /end CHARACTERISTIC
/begin CHARACTERISTIC VER_MOT "Motorversion" VALUE 0x810223 KwUb 255.0 dez 0.00 255.0 FUNCTION_LIST CAN IF_DATA DIM_X DIRECT 0x810223 /end CHARACTERISTIC
/begin CHARACTERISTIC VFGRMAX "Maximal zulässige Geschwindigkeit im FGR-Betrieb" VALUE 0x813EE4 KwUw 511.9922 vfzg_uw_b512 0.00 511.9922 FUNCTION_LIST BBFGR FGRMD IF_DATA DIM_X DIRECT 0x813EE4 /end CHARACTERISTIC
/begin CHARACTERISTIC VFGRMIN "Minimal zulässige Geschwindigkeit im FGR-Betrieb" VALUE 0x813EE6 KwUw 511.9922 vfzg_uw_b512 0.00 511.9922 FUNCTION_LIST BBFGR FGRMD IF_DATA DIM_X DIRECT 0x813EE6 /end CHARACTERISTIC
/begin CHARACTERISTIC VFNMAXANM "Geschwindigkeitsschwelle Anfahrvorgang" VALUE 0x811C31 KwUb 318.8 vfzg_ub_q1p25 0.00 318.8 FUNCTION_LIST NMAXMD IF_DATA DIM_X DIRECT 0x811C31 /end CHARACTERISTIC
/begin CHARACTERISTIC VFZGADMD "Fahrzeuggeschw.schwelle zum Ausblenden DMD bei aktivem Bremseingriff" VALUE 0x81818D KwUb 318.8 vfzg_ub_q1p25 0.00 318.8 FUNCTION_LIST DMDSTP IF_DATA DIM_X DIRECT 0x81818D /end CHARACTERISTIC
/begin CHARACTERISTIC VFZGMAX "obere Geschwindifkeitsschwelle für Ausblendung TGET max-Diagnose" VALUE 0x8190F2 KwUb 318.8 vfzg_ub_q1p25 0.00 318.8 FUNCTION_LIST GGTGET IF_DATA DIM_X DIRECT 0x8190F2 /end CHARACTERISTIC
/begin CHARACTERISTIC VFZGMN "minimale Fahrzeuggeschwindigkeit für Freigabe Diagnose TGET" VALUE 0x8190F3 KwUb 318.8 vfzg_ub_q1p25 0.00 318.8 FUNCTION_LIST GGTGET IF_DATA DIM_X DIRECT 0x8190F3 /end CHARACTERISTIC
/begin CHARACTERISTIC VFZG_DAT_UC "" VAL_BLK 0x81698A KwbUw 511.9922 vfzg_uw_q0p00781 0.00 511.9922 NUMBER 16 FUNCTION_LIST URCEIN IF_DATA DIM_X DIRECT 0x81698A /end CHARACTERISTIC
/begin CHARACTERISTIC VFZMN "Erkennen Fahren-Stehen" VALUE 0x813D1A KwUw 511.9922 vfzg_uw_b512 0.00 511.9922 FUNCTION_LIST GGVFZG IF_DATA DIM_X DIRECT 0x813D1A /end CHARACTERISTIC
/begin CHARACTERISTIC VHYST "Vmax-Hystereseschwelle, variantenkodiert" VALUE 0x816724 KwUw 511.9922 vfzg_uw_q0p00781 0.00 511.9922 FUNCTION_LIST VMAXMD IF_DATA DIM_X DIRECT 0x816724 /end CHARACTERISTIC
/begin CHARACTERISTIC VKOAO "Obere Geschwindigkeitsschwelle für Kompressorabschaltung" VALUE 0x812BAE KwUb 318.8 vfzg_ub_q1p25 0.00 318.8 FUNCTION_LIST KOS IF_DATA DIM_X DIRECT 0x812BAE /end CHARACTERISTIC
/begin CHARACTERISTIC VLF3 "Fahrgeschwindigkeitsschwelle 3 für Motorlüftersteuerung" VALUE 0x819805 KwUb 318.8 vfzg_ub_q1p25 0.00 318.8 FUNCTION_LIST MLS IF_DATA DIM_X DIRECT 0x819805 /end CHARACTERISTIC
/begin CHARACTERISTIC VLLR "Fahrzeuggeschwindigkeitsschwelle für Leerlaufregelung" VALUE 0x813FFA KwUw 511.9922 vfzg_uw_b512 0.00 511.9922 FUNCTION_LIST LLRBB IF_DATA DIM_X DIRECT 0x813FFA /end CHARACTERISTIC
/begin CHARACTERISTIC VLMXVZ "Maximalwert für vlast_w" CURVE 0x8148C0 KlAUwSstUwWUw 511.9844 vfzg_uw_b512 0.007812500 511.9922 FUNCTION_LIST FGRMD IF_DATA DIM_X DIRECT 0x8148C0
 /begin AXIS_DESCR STD_AXIS vziel_w vfzg_uw_b512 6 0.00 511.9922 DEPOSIT ABSOLUT /end AXIS_DESCR
/end CHARACTERISTIC
/begin CHARACTERISTIC VMAXO "Vmax-Begrenzungswert (Linie mit 16 Varianten)" VALUE 0x816726 KwUw 511.9922 vfzg_uw_q0p00781 0.00 511.9922 FUNCTION_LIST VMAXMD IF_DATA DIM_X DIRECT 0x816726 /end CHARACTERISTIC
/begin CHARACTERISTIC VMAXP "P-Glied bei VMAX-Regelung" VALUE 0x811C3F KwUb 99.70 rel_ub_q0p391 0.00 99.70 FUNCTION_LIST VMAXMD IF_DATA DIM_X DIRECT 0x811C3F /end CHARACTERISTIC
/begin CHARACTERISTIC VMDBGVO "obere Geschwindigkeitsschwelle für Momentenaufbaubegrenzung" VALUE 0x8162FE KwUw 511.9922 vfzg_uw_b512 0.00 511.9922 FUNCTION_LIST MDBGV IF_DATA DIM_X DIRECT 0x8162FE /end CHARACTERISTIC
/begin CHARACTERISTIC VMDBGVU "untere Geschwindigkeitsschwelle für Momentenaufbaubegrenzung" VALUE 0x816300 KwUw 511.9922 vfzg_uw_b512 0.00 511.9922 FUNCTION_LIST MDBGV IF_DATA DIM_X DIRECT 0x816300 /end CHARACTERISTIC
/begin CHARACTERISTIC VMIBGR "v-Schwelle für Freigabe Momentenbegrenzung" VALUE 0x819807 KwUb 318.8 vfzg_ub_q1p25 0.00 318.8 FUNCTION_LIST MDBGRG IF_DATA DIM_X DIRECT 0x819807 /end CHARACTERISTIC
/begin CHARACTERISTIC VMIN_UC "Minimalgeschwindigkeit für FGR-Betrieb im Befehlstest" VALUE 0x8169AA KwUw 511.9922 vfzg_uw_q0p00781 0.00 511.9922 FUNCTION_LIST URCFGRC IF_DATA DIM_X DIRECT 0x8169AA /end CHARACTERISTIC
/begin CHARACTERISTIC VMIN_UM "Minimalgeschwindigkeit für FGR-Betrieb in der Funktionsüberwachung" VALUE 0x817F1E KwUw 511.9922 vfzg_uw_q0p00781 0.00 511.9922 FUNCTION_LIST UFFGRC IF_DATA DIM_X DIRECT 0x817F1E /end CHARACTERISTIC
/begin CHARACTERISTIC VNMAXPNR "Geschwindigkeitsschwelle zum Rücksetzen der NMAX-Begrenzung bei P / N" VALUE 0x811C32 KwUb 318.8 vfzg_ub_q1p25 0.00 318.8 FUNCTION_LIST NMAXMD IF_DATA DIM_X DIRECT 0x811C32 /end CHARACTERISTIC
/begin CHARACTERISTIC VRADF "Geschwindigkeitsschwelle für Fehlereintrag" VALUE 0x8175C6 KwUw 324.9950 vfzg_uw_b325 0.00 324.9950 FUNCTION_LIST BGRBS IF_DATA DIM_X DIRECT 0x8175C6 /end CHARACTERISTIC
/begin CHARACTERISTIC VREGLMAX "Maximal zulässige Sollgeschwindigkeit für FGR" VALUE 0x813EE8 KwUw 511.9922 vfzg_uw_b512 0.00 511.9922 FUNCTION_LIST BBFGR FGRMD IF_DATA DIM_X DIRECT 0x813EE8 /end CHARACTERISTIC
/begin CHARACTERISTIC VREGLMIN "Minimal zulässige Sollgeschwindigkeit für FGR" VALUE 0x813EEA KwUw 511.9922 vfzg_uw_b512 0.00 511.9922 FUNCTION_LIST BBFGR FGRMD IF_DATA DIM_X DIRECT 0x813EEA /end CHARACTERISTIC
/begin CHARACTERISTIC VSAA "Geschwindigkeitsschwelle für SA-Drehzahlanhebung" VALUE 0x8114C9 KwUb 318.8 vfzg_ub_q1p25 0.00 318.8 FUNCTION_LIST BBSAWE IF_DATA DIM_X DIRECT 0x8114C9 /end CHARACTERISTIC
/begin CHARACTERISTIC VSLS "Schwelle Fahrzeuggeschwindigkeit für SLS ein" VALUE 0x818183 KwUb 318.8 vfzg_ub_q1p25 0.00 318.8 FUNCTION_LIST SLS IF_DATA DIM_X DIRECT 0x818183 /end CHARACTERISTIC
/begin CHARACTERISTIC VTUMGTA "Schwelle Fahrzeuggeschwindigkeit für TANS -> Umgebungstemperatur" VALUE 0x8190C7 KwUb 318.8 vfzg_ub_q1p25 0.00 318.8 FUNCTION_LIST GGTFUMG IF_DATA DIM_X DIRECT 0x8190C7 /end CHARACTERISTIC
/begin CHARACTERISTIC VTUMTA "Schwelle Fahrzeuggeschwindigkeit für Bestimmung Umgebungstemperatur" VALUE 0x818807 KwUb 318.8 vfzg_ub_q1p25 0.00 318.8 FUNCTION_LIST BGTABS IF_DATA DIM_X DIRECT 0x818807 /end CHARACTERISTIC
/begin CHARACTERISTIC VTUMTAT "Schwelle Fahrzeuggeschwindigkeit für TANS -> Umgebungstemperatur" VALUE 0x81835C KwUb 318.8 vfzg_ub_q1p25 0.00 318.8 FUNCTION_LIST ATM IF_DATA DIM_X DIRECT 0x81835C /end CHARACTERISTIC
/begin CHARACTERISTIC VVORH "Vmax-Vorhaltschwelle, variantenkodiert" VALUE 0x816728 KwUw 511.9922 vfzg_uw_q0p00781 0.00 511.9922 FUNCTION_LIST VMAXMD IF_DATA DIM_X DIRECT 0x816728 /end CHARACTERISTIC
/begin CHARACTERISTIC VWFSMX "Max. Fahrzeuggeschwindigkeit für Aktivierung Wegfahrsperre (nach reset)" VALUE 0x813FFE KwUw 511.9922 vfzg_uw_b512 0.00 511.9922 FUNCTION_LIST WFS IF_DATA DIM_X DIRECT 0x813FFE /end CHARACTERISTIC
/begin CHARACTERISTIC VWPMBBR "Mindestgeschwindigkeit für Pedalwertbegrenzung bei betätigter Bremse" VALUE 0x810E4C KwUb 318.8 vfzg_ub_q1p25 0.00 318.8 FUNCTION_LIST GGPED IF_DATA DIM_X DIRECT 0x810E4C /end CHARACTERISTIC
/begin CHARACTERISTIC VZK1MDBV "Umschaltschwelle Fahrzeuggeschw. f. Integratorzeitkonstante ZK1MDBGV" VALUE 0x816302 KwUw 511.9922 vfzg_uw_b512 0.00 511.9922 FUNCTION_LIST MDBGV IF_DATA DIM_X DIRECT 0x816302 /end CHARACTERISTIC
/begin CHARACTERISTIC WABREGEL "Abregelgeschwindigkeit des ASR im Fehlerfalls" VALUE 0x813822 KwUw 0.9999847 fak_uw_b1 0.00 0.9999847 FUNCTION_LIST MDEX IF_DATA DIM_X DIRECT 0x813822 /end CHARACTERISTIC
/begin CHARACTERISTIC WAD0T1 "Wichtungsfaktor Adaptionsbereich 0 zu 1" VALUE 0x811464 KwUb 15.94 fak_ub_b16 0.00 15.94 FUNCTION_LIST STADAP IF_DATA DIM_X DIRECT 0x811464 /end CHARACTERISTIC
/begin CHARACTERISTIC WAD0T2 "Wichtungsfaktor Adaptionsbereich 0 zu 2" VALUE 0x811465 KwUb 15.94 fak_ub_b16 0.00 15.94 FUNCTION_LIST STADAP IF_DATA DIM_X DIRECT 0x811465 /end CHARACTERISTIC
/begin CHARACTERISTIC WAD1T0 "Wichtungsfaktor Adaptionsbereich 1 zu 0" VALUE 0x811466 KwUb 15.94 fak_ub_b16 0.00 15.94 FUNCTION_LIST STADAP IF_DATA DIM_X DIRECT 0x811466 /end CHARACTERISTIC
/begin CHARACTERISTIC WAD1T2 "Wichtungsfaktor Adaptionsbereich 1 zu 2" VALUE 0x811467 KwUb 15.94 fak_ub_b16 0.00 15.94 FUNCTION_LIST STADAP IF_DATA DIM_X DIRECT 0x811467 /end CHARACTERISTIC
/begin CHARACTERISTIC WAD2T0 "Wichtungsfaktor Adaptionsbereich 2 zu 0" VALUE 0x811468 KwUb 15.94 fak_ub_b16 0.00 15.94 FUNCTION_LIST STADAP IF_DATA DIM_X DIRECT 0x811468 /end CHARACTERISTIC
/begin CHARACTERISTIC WAD2T1 "Wichtungsfaktor Adaptionsbereich 2 zu 1" VALUE 0x811469 KwUb 15.94 fak_ub_b16 0.00 15.94 FUNCTION_LIST STADAP IF_DATA DIM_X DIRECT 0x811469 /end CHARACTERISTIC
/begin CHARACTERISTIC WAIT_T_UM "Wartezeit für Reset-Tastverhältnis aus der Funktionsüberwachung" VALUE 0x817F18 KwUw 8332.629 t_wdt_high 0.00 8332.629 FUNCTION_LIST UFURAM URDELAY IF_DATA DIM_X DIRECT 0x817F18 /end CHARACTERISTIC
/begin CHARACTERISTIC WDKARN "DK-Winkel-Schwelle für Gemischadaption aktiv" CURVE 0x818FA7 KlAUbSstUbWUb 99.61 rel_ub_b99p6 0.00 99.61 FUNCTION_LIST LRAEB IF_DATA DIM_X DIRECT 0x818FA7 /begin AXIS_DESCR STD_AXIS nmot nmot_ub_q40 10 0.00 10200. DEPOSIT ABSOLUT /end AXIS_DESCR /end CHARACTERISTIC
/begin CHARACTERISTIC WDKBEWS "Schwelle zur DK-Bewegungserkennung (I-Klein)" VALUE 0x813D5C KwSw 1599.976 relDK_q0p02441 -800.0000 799.9756 FUNCTION_LIST ADVE IF_DATA DIM_X DIRECT 0x813D5C /end CHARACTERISTIC
/begin CHARACTERISTIC WDKDSVLU "Drosselklappenschwelle für Drucksensorplausibilisierung" CURVE 0x8184EB KlAUbSstUbWUb 100.0 relDK_ub_b100 0.00 100.0 FUNCTION_LIST GGDSAS IF_DATA DIM_X DIRECT 0x8184EB /begin AXIS_DESCR STD_AXIS nmot nmot_ub_q40 6 0.00 10200. DEPOSIT ABSOLUT /end AXIS_DESCR /end CHARACTERISTIC
/begin CHARACTERISTIC WDKFPRO1 "Aschaltschwelle DK-Istwert für öffnende DV-E-Federprüfung" VALUE 0x813DBE KwSw 1599.976 relDK_q0p02441 -800.0000 799.9756 FUNCTION_LIST BGDVE IF_DATA DIM_X DIRECT 0x813DBE /end CHARACTERISTIC
/begin CHARACTERISTIC WDKFPRO2 "Prüfschwelle DK-Istwert für öffnende DV-E-Federprüfung" VALUE 0x813DC0 KwSw 1599.976 relDK_q0p02441 -800.0000 799.9756 FUNCTION_LIST BGDVE IF_DATA DIM_X DIRECT 0x813DC0 /end CHARACTERISTIC
/begin CHARACTERISTIC WDKFPRZ1 "Abschaltschwelle DK-Istwert für DV-E-Rückstellfederprüfung" VALUE 0x813DC2 KwUw 100.0000 relDK_uw_b100 0.00 100.0000 FUNCTION_LIST BGDVE IF_DATA DIM_X DIRECT 0x813DC2 /end CHARACTERISTIC
/begin CHARACTERISTIC WDKFPRZ2 "Prüfschwelle DK-Istwert für DV-E-Rückstellfederprüfung" VALUE 0x813DC4 KwUw 100.0000 relDK_uw_b100 0.00 100.0000 FUNCTION_LIST BGDVE IF_DATA DIM_X DIRECT 0x813DC4 /end CHARACTERISTIC
/begin CHARACTERISTIC WDKNLPMA "oberer erlaubter Istwert für NLP-Stellung" VALUE 0x813DC6 KwUw 100.0000 relDK_uw_b100 0.00 100.0000 FUNCTION_LIST BGDVE IF_DATA DIM_X DIRECT 0x813DC6 /end CHARACTERISTIC
/begin CHARACTERISTIC WDKNLPMI "unterer erlaubter Istwert für NLP-Stellung" VALUE 0x813DC8 KwUw 100.0000 relDK_uw_b100 0.00 100.0000 FUNCTION_LIST BGDVE IF_DATA DIM_X DIRECT 0x813DC8 /end CHARACTERISTIC
/begin CHARACTERISTIC WDKNLPTOL "zulässige DK-Winkel-Toleranz des NLP" VALUE 0x813D5E KwUw 100.0000 relDK_uw_b100 0.00 100.0000 FUNCTION_LIST ADVE IF_DATA DIM_X DIRECT 0x813D5E /end CHARACTERISTIC
/begin CHARACTERISTIC WDKPMXN "Maximaler Drosselklappenwinkel für Plausibilisierung mit Füllungssignal" CURVE 0x810E10 KlAUbSstUbWUb 100.0 relDK_ub_b100 0.00 100.0 FUNCTION_LIST GGDVE IF_DATA DIM_X DIRECT 0x810E10 /begin AXIS_DESCR STD_AXIS nmot nmot_ub_q40 12 0.00 10200. DEPOSIT ABSOLUT /end AXIS_DESCR /end CHARACTERISTIC
/begin CHARACTERISTIC WDKREIB "Haftreibungsanteil der DK für I-Klein" VALUE 0x810D2D KwUb 0.9961 fak_ub_b1 0.00 0.9961 FUNCTION_LIST ADVE IF_DATA DIM_X DIRECT 0x810D2D /end CHARACTERISTIC
/begin CHARACTERISTIC WDKSAPNOL "DK-Sollwert bei Applikationshilfe DK-Notluftfahren" VALUE 0x813D60 KwUw 99.99847 relDK_q0p00152 0.00 99.99847 FUNCTION_LIST ADVE IF_DATA DIM_X DIRECT 0x813D60 /end CHARACTERISTIC
/begin CHARACTERISTIC WDKSAPP "Drosselklappensollwert für Applikationszwecke" VALUE 0x8152F6 KwUw 99.99847 rel_uw_b100 0.00 99.99847 FUNCTION_LIST FUEDK IF_DATA DIM_X DIRECT 0x8152F6 /end CHARACTERISTIC
/begin CHARACTERISTIC WDKSFPR "DK-Sollwert für DV-E-Rückstellfederprüfung" VALUE 0x813DCA KwUw 100.0000 relDK_uw_b100 0.00 100.0000 FUNCTION_LIST BGDVE IF_DATA DIM_X DIRECT 0x813DCA /end CHARACTERISTIC
/begin CHARACTERISTIC WDKSFPRO "DK-Sollwert für öffnende DV-E-Federprüfung" VALUE 0x813DCC KwUw 100.0000 relDK_uw_b100 0.00 100.0000 FUNCTION_LIST BGDVE IF_DATA DIM_X DIRECT 0x813DCC /end CHARACTERISTIC
/begin CHARACTERISTIC WDKSOFS "Offset zu appl. DK-Sollwinkel bei niedrigen Temperaturen" VALUE 0x8152F8 KwUw 99.99847 rel_uw_b100 0.00 99.99847 FUNCTION_LIST FUEDK IF_DATA DIM_X DIRECT 0x8152F8 /end CHARACTERISTIC
/begin CHARACTERISTIC WDKSTFEIN "Schwelle zur Stationaritätserkennung (verstärkter Bereich)" VALUE 0x813D62 KwSw 1599.976 relDK_q0p02441 -800.0000 799.9756 FUNCTION_LIST ADVE IF_DATA DIM_X DIRECT 0x813D62 /end CHARACTERISTIC
/begin CHARACTERISTIC WDKSTGROB "Schwelle zur Stationaritätserkennung (unverstärkter Bereich)" VALUE 0x813D64 KwSw 1599.976 relDK_q0p02441 -800.0000 799.9756 FUNCTION_LIST ADVE IF_DATA DIM_X DIRECT 0x813D64 /end CHARACTERISTIC
/begin CHARACTERISTIC WDKSTMUMA "DK-Winkel-Schwelle für temporäre UMA-Adaption" VALUE 0x813DCE KwUw 100.0000 relDK_uw_b100 0.00 100.0000 FUNCTION_LIST BGDVE IF_DATA DIM_X DIRECT 0x813DCE /end CHARACTERISTIC
/begin CHARACTERISTIC WDKUGDN "KL Drosselklappenwinkel, ab der keine Drosselung mehr erfolgt" CURVE 0x814DD8 GklWUw 99.99847 rel_uw_b100 0.00 99.99847 FUNCTION_LIST BGMSZS IF_DATA DIM_X DIRECT 0x814DD8
 /begin AXIS_DESCR COM_AXIS nmot nmot_ub_q40 12 0.00 10200. AXIS_PTS_REF SNM12FEUB /end AXIS_DESCR
/end CHARACTERISTIC
/begin CHARACTERISTIC WEAN "Winkel Einspritzabbruch" CURVE 0x818BF4 GklWUb 1530. zw_ub_q6 0.00 1530. FUNCTION_LIST ESVW IF_DATA DIM_X DIRECT 0x818BF4
 /begin AXIS_DESCR COM_AXIS nmot nmot_ub_q40 8 0.00 10200. AXIS_PTS_REF SNM08GKUB /end AXIS_DESCR
/end CHARACTERISTIC
/begin CHARACTERISTIC WEEM "Vorlagerungswinkel - Korrektur" CURVE 0x818BFC KlAUbSstUbWUb 1530. zw_ub_q6 0.00 1530. FUNCTION_LIST ESVW IF_DATA DIM_X DIRECT 0x818BFC
 /begin AXIS_DESCR STD_AXIS tmot temp_ub_q0p75_o48 8 -48.00 143.3 DEPOSIT ABSOLUT /end AXIS_DESCR
/end CHARACTERISTIC
/begin CHARACTERISTIC WEEMRFAN "Winkel Einspritzende bei maximalem Fahrerwunsch" CURVE 0x818C0D GklWUb 1530. zw_ub_q6 0.00 1530. FUNCTION_LIST ESVW IF_DATA DIM_X DIRECT 0x818C0D
 /begin AXIS_DESCR COM_AXIS nmot nmot_ub_q40 8 0.00 10200. AXIS_PTS_REF SNM08GKUB /end AXIS_DESCR
/end CHARACTERISTIC
/begin CHARACTERISTIC WEESTATI "Offset für Winkel Einspritzende in Richtung früh" CURVE 0x811351 KlAUbSstUbWUb 1530. zw_ub_q6 0.00 1530. FUNCTION_LIST ESVW IF_DATA DIM_X DIRECT 0x811351 /begin AXIS_DESCR STD_AXIS anztib dez 6 0.00 255.0 DEPOSIT ABSOLUT /end AXIS_DESCR /end CHARACTERISTIC
/begin CHARACTERISTIC WEESTM "Vorlagerunswinkel-Korrektur im Start" CURVE 0x818C15 KlAUbSstUbWUb 1530. zw_ub_q6 0.00 1530. FUNCTION_LIST ESVW IF_DATA DIM_X DIRECT 0x818C15
 /begin AXIS_DESCR STD_AXIS tmot temp_ub_q0p75_o48 8 -48.00 143.3 DEPOSIT ABSOLUT /end AXIS_DESCR
/end CHARACTERISTIC
/begin CHARACTERISTIC WEESTN "Winkel Einspritzende im Start" CURVE 0x818C26 KlAUbSstUbWUb 1530. zw_ub_q6 0.00 1530. FUNCTION_LIST ESVW IF_DATA DIM_X DIRECT 0x818C26 /begin AXIS_DESCR STD_AXIS nmot nmot_ub_q40 4 0.00 10200. DEPOSIT ABSOLUT /end AXIS_DESCR /end CHARACTERISTIC
/begin CHARACTERISTIC WEESTS "Winkelgrenze Einspritzende für sim. Startauslösungen" VALUE 0x810F14 KwUb 717.2 kw_q2p8125 0.00 717.2 FUNCTION_LIST ACIFI IF_DATA DIM_X DIRECT 0x810F14 /end CHARACTERISTIC
/begin CHARACTERISTIC WESBM "Winkel Einlaß-schließt vor SW-Bezugsmarke (tR)" VALUE 0x810F15 KwUb 717.2 kw_q2p8125 0.00 717.2 FUNCTION_LIST ACIFI IF_DATA DIM_X DIRECT 0x810F15 /end CHARACTERISTIC
/begin CHARACTERISTIC WESSTO "Offsetwinkel Einspritzung für Schnellstart" VALUE 0x810F16 KwUb 717.2 kw_q2p8125 0.00 717.2 FUNCTION_LIST ACIFI IF_DATA DIM_X DIRECT 0x810F16 /end CHARACTERISTIC
/begin CHARACTERISTIC WEVS "Winkelkorrektur bei Ventilhubverstellung" VALUE 0x81135E KwSb 191.3 zw_sb_q0p75 -96.00 95.25 FUNCTION_LIST ESVW IF_DATA DIM_X DIRECT 0x81135E /end CHARACTERISTIC
/begin CHARACTERISTIC WFRL "Kraftstoffwandfilmkennlinie" CURVE 0x8156D6 FklWUw 6143.906 rel_uw_b6144 0.00 6143.906 FUNCTION_LIST ESUK IF_DATA DIM_X DIRECT 0x8156D6
 /begin AXIS_DESCR FIX_AXIS rlp_w rel_uw_q0p0234 26 0.00 155.9766 FIX_AXIS_PAR 0 8 26 /end AXIS_DESCR
/end CHARACTERISTIC
/begin CHARACTERISTIC WHLSUKOR "Korrekturwert für die  LSU-Heizleistung" VALUE 0x81996B KwUb 1.992 fak_ub_b2 0.00 1.992 FUNCTION_LIST HLSU IF_DATA DIM_X DIRECT 0x81996B /end CHARACTERISTIC
/begin CHARACTERISTIC WIMAX "ObererSchranke interne Reglerzustände stetige Lambdaregelung" VALUE 0x816D84 KwSw 7.999878 fak_sw_b4 -4.000000 3.999878 FUNCTION_LIST LRS IF_DATA DIM_X DIRECT 0x816D84 /end CHARACTERISTIC
/begin CHARACTERISTIC WIMIN "Untere Schranke interne Reglerzustaende stetige Lambdaregelung" VALUE 0x816D86 KwSw 7.999878 fak_sw_b4 -4.000000 3.999878 FUNCTION_LIST LRS IF_DATA DIM_X DIRECT 0x816D86 /end CHARACTERISTIC
/begin CHARACTERISTIC WMABGKH "Faktor für Wärmemengenkorrektur bei Katheizen für Taupunktende" VALUE 0x81835D KwUb 0.9961 fak_ub_b1 0.00 0.9961 FUNCTION_LIST ATM IF_DATA DIM_X DIRECT 0x81835D /end CHARACTERISTIC
/begin CHARACTERISTIC WMABGKH2 "Faktor für Wärmemengenkorrektur bei Katheizen für Taupunktende Bank2" VALUE 0x81835E KwUb 0.9961 fak_ub_b1 0.00 0.9961 FUNCTION_LIST ATM IF_DATA DIM_X DIRECT 0x81835E /end CHARACTERISTIC
/begin CHARACTERISTIC WNWA "Grenzwinkel für Nockenwellensteller aktiv" VALUE 0x818632 KwSb 255.0 kw_q1 -128.0 127.0 FUNCTION_LIST DNWS IF_DATA DIM_X DIRECT 0x818632 /end CHARACTERISTIC
/begin CHARACTERISTIC WNWAFMX "Begrenzung Adaption Spätanschlag nach 'früh'" VALUE 0x810C5D KwSb 255.0 kw_q1 -128.0 127.0 FUNCTION_LIST WANWKW IF_DATA DIM_X DIRECT 0x810C5D /end CHARACTERISTIC
/begin CHARACTERISTIC WNWASA "Winkel Auslaßventil schließt am NW-Anschlag" VALUE 0x818773 KwSb 255.0 kw_q1 -128.0 127.0 FUNCTION_LIST NWS IF_DATA DIM_X DIRECT 0x818773 /end CHARACTERISTIC
/begin CHARACTERISTIC WNWASMX "Obere Begrenzung Adaption NW-Spätanschlag (Richtung spät)" VALUE 0x810C5E KwSb 255.0 kw_q1 -128.0 127.0 FUNCTION_LIST WANWKW IF_DATA DIM_X DIRECT 0x810C5E /end CHARACTERISTIC
/begin CHARACTERISTIC WNWEOA "Winkel Einlaßventil öffnet am NW-Anschlag" VALUE 0x818774 KwSb 255.0 kw_q1 -128.0 127.0 FUNCTION_LIST NWS IF_DATA DIM_X DIRECT 0x818774 /end CHARACTERISTIC
/begin CHARACTERISTIC WNWIMXT "theoretisch maximaler wnwi (Winkel Nockenwelle ist)" VALUE 0x818775 KwUb 127.5 kw_ub_q0p5 0.00 127.5 FUNCTION_LIST NWS IF_DATA DIM_X DIRECT 0x818775 /end CHARACTERISTIC
/begin CHARACTERISTIC WNWP "Grenzwinkel für Nockenwellensteller passiv" VALUE 0x818633 KwSb 255.0 kw_q1 -128.0 127.0 FUNCTION_LIST DNWS IF_DATA DIM_X DIRECT 0x818633 /end CHARACTERISTIC
/begin CHARACTERISTIC WNWSPMN "Grenzwinkel Spätverschiebung für Zuordnung Nockenwelle zu Kurbelwelle" VALUE 0x81B6E8 KwSw 1023.984 kw_q0p0156 -512.0000 511.9844 FUNCTION_LIST DNWKW IF_DATA DIM_X DIRECT 0x81B6E8 /end CHARACTERISTIC
/begin CHARACTERISTIC WNWSPMX "Grenzwinkel Frühverschiebung für Zuordnung Nockenwelle zu Kurbelwelle" VALUE 0x81B6EA KwSw 1023.984 kw_q0p0156 -512.0000 511.9844 FUNCTION_LIST DNWKW IF_DATA DIM_X DIRECT 0x81B6EA /end CHARACTERISTIC
/begin CHARACTERISTIC WNWSPS2_0 "Sollwinkel der Flanke 0 der Nockenwelle 2 in Referenzposition" VALUE 0x813B92 KwUw 1023.984 kw_q0p0156 0.00 1023.984 FUNCTION_LIST WANWKW DNWKW IF_DATA DIM_X DIRECT 0x813B92 /end CHARACTERISTIC
/begin CHARACTERISTIC WNWSPS2_1 "Sollwinkel der Flanke 1 der Nockenwelle 2 in Referenzposition" VALUE 0x813B94 KwUw 1023.984 kw_q0p0156 0.00 1023.984 FUNCTION_LIST WANWKW IF_DATA DIM_X DIRECT 0x813B94 /end CHARACTERISTIC
/begin CHARACTERISTIC WNWSPS2_2 "Sollwinkel der Flanke 2 der Nockenwelle 2 in Referenzposition" VALUE 0x813B96 KwUw 1023.984 kw_q0p0156 0.00 1023.984 FUNCTION_LIST WANWKW IF_DATA DIM_X DIRECT 0x813B96 /end CHARACTERISTIC
/begin CHARACTERISTIC WNWSPS2_3 "Sollwinkel der Flanke 3 der Nockenwelle 2 in Referenzposition" VALUE 0x813B98 KwUw 1023.984 kw_q0p0156 0.00 1023.984 FUNCTION_LIST WANWKW IF_DATA DIM_X DIRECT 0x813B98 /end CHARACTERISTIC
/begin CHARACTERISTIC WNWSPS_0 "Sollwinkel der Flanke 0 der Nockenwelle in Referenzposition" VALUE 0x813B9A KwUw 1023.984 kw_q0p0156 0.00 1023.984 FUNCTION_LIST WANWKW DNWKW IF_DATA DIM_X DIRECT 0x813B9A /end CHARACTERISTIC
/begin CHARACTERISTIC WNWSPS_1 "Sollwinkel der Flanke 1 der Nockenwelle in Referenzposition" VALUE 0x813B9C KwUw 1023.984 kw_q0p0156 0.00 1023.984 FUNCTION_LIST WANWKW IF_DATA DIM_X DIRECT 0x813B9C /end CHARACTERISTIC
/begin CHARACTERISTIC WNWSPS_2 "Sollwinkel der Flanke 2 der Nockenwelle in Referenzposition" VALUE 0x813B9E KwUw 1023.984 kw_q0p0156 0.00 1023.984 FUNCTION_LIST WANWKW IF_DATA DIM_X DIRECT 0x813B9E /end CHARACTERISTIC
/begin CHARACTERISTIC WNWSPS_3 "Sollwinkel der Flanke 3 der Nockenwelle in Referenzposition" VALUE 0x813BA0 KwUw 1023.984 kw_q0p0156 0.00 1023.984 FUNCTION_LIST WANWKW IF_DATA DIM_X DIRECT 0x813BA0 /end CHARACTERISTIC
/begin CHARACTERISTIC WNWUEMXT "theoretisch maximaler Nockenwellenüberschneidungswinkel" VALUE 0x818776 KwUb 127.5 kw_ub_q0p5 0.00 127.5 FUNCTION_LIST NWS NLDG IF_DATA DIM_X DIRECT 0x818776 /end CHARACTERISTIC
/begin CHARACTERISTIC WPHN "Phasengang" CURVE 0x819D85 GklWSb 191.3 zw_sb_q0p75 -96.00 95.25 FUNCTION_LIST ZUE IF_DATA DIM_X DIRECT 0x819D85
 /begin AXIS_DESCR COM_AXIS nmot nmot_ub_q40 8 0.00 10200. AXIS_PTS_REF SNM08__UB /end AXIS_DESCR
/end CHARACTERISTIC
/begin CHARACTERISTIC WPKDMN "Minimaler Pedalwert für Kick-Down-Erkennung" VALUE 0x813DDE KwUw 100.0000 relPED_uw_b100 0.00 100.0000 FUNCTION_LIST GGPED IF_DATA DIM_X DIRECT 0x813DDE /end CHARACTERISTIC
/begin CHARACTERISTIC WPLWUGD "Schwelle Pedalwert für Deaktivierung Pedalüberweg über B_lwugd" VALUE 0x8166F4 KwUw 99.99847 rel_uw_b100 0.00 99.99847 FUNCTION_LIST MDFAW IF_DATA DIM_X DIRECT 0x8166F4 /end CHARACTERISTIC
/begin CHARACTERISTIC WPMXBR "Maximal zulässiger Pedalwert bei betätigter Bremse (vor Erkennung wped = 0)" VALUE 0x813DE0 KwUw 100.0000 relPED_uw_b100 0.00 100.0000 FUNCTION_LIST GGPED IF_DATA DIM_X DIRECT 0x813DE0 /end CHARACTERISTIC
/begin CHARACTERISTIC WPMXNOT "Maximal zulässiger Fahrpedalwert im PWG-Notfahren" VALUE 0x810E4D KwUb 100.0 relPED_ub_b100 0.00 100.0 FUNCTION_LIST GGPED IF_DATA DIM_X DIRECT 0x810E4D /end CHARACTERISTIC
/begin CHARACTERISTIC WPRMDBGV "Pedalwinkel Resetschwelle f. geschw.-abh. Momentenaufbaubegrenzung" VALUE 0x816304 KwUw 100.0000 relPED_uw_b100 0.00 100.0000 FUNCTION_LIST MDBGV IF_DATA DIM_X DIRECT 0x816304 /end CHARACTERISTIC
/begin CHARACTERISTIC WPRMX "maximaler Prädiktionswinkel" VALUE 0x8110EF KwUb 1530. kw_q6 0.00 1530. FUNCTION_LIST BGRLP IF_DATA DIM_X DIRECT 0x8110EF /end CHARACTERISTIC
/begin CHARACTERISTIC XIMAX "ObererSchranke interne Reglerzustände stetige Lambdaregelung" VALUE 0x816D88 KwSw 1.999969 fak_sw_b1 -1.000000 0.9999695 FUNCTION_LIST LRS IF_DATA DIM_X DIRECT 0x816D88 /end CHARACTERISTIC
/begin CHARACTERISTIC XIMIN "Untere [Bhranke interne Reglerzustaende stetige Lambdaregelung" VALUE 0x816D8A KwSw 1.999969 fak_sw_b1 -1.000000 0.9999695 FUNCTION_LIST LRS IF_DATA DIM_X DIRECT 0x816D8A /end CHARACTERISTIC
/begin CHARACTERISTIC Y2MAX "Obere Schranke Integralanteil LRS" VALUE 0x816D8C KwSw 1.999969 fak_sw_b1 -1.000000 0.9999695 FUNCTION_LIST LRS IF_DATA DIM_X DIRECT 0x816D8C /end CHARACTERISTIC
/begin CHARACTERISTIC Y2MIN "Untere Schranke Integralanteil LRS" VALUE 0x816D8E KwSw 1.999969 fak_sw_b1 -1.000000 0.9999695 FUNCTION_LIST LRS IF_DATA DIM_X DIRECT 0x816D8E /end CHARACTERISTIC
/begin CHARACTERISTIC ZASMASK "Zylinderabschaltmaske für CIFI aus ZAS" VALUE 0x810291 KwUb 255.0 dez 0.00 255.0 FUNCTION_LIST DMDFON IF_DATA DIM_X DIRECT 0x810291 /end CHARACTERISTIC
/begin CHARACTERISTIC ZATMAML "Zeitkonstante fuer Abgastemperaturmodell" CURVE 0x81B838 GklWUw 13107.0000 zk200msxs_uw_b13107 0.200003052 13107.2000 FUNCTION_LIST ATM IF_DATA DIM_X DIRECT 0x81B838
 /begin AXIS_DESCR COM_AXIS ml_w m_uw_b6553p5 7 0.00 6553.500 AXIS_PTS_REF SML07TMUW /end AXIS_DESCR
/end CHARACTERISTIC
/begin CHARACTERISTIC ZATMAML2 "Zeitkonstante fuer Abgastemperaturmodell Bank2" CURVE 0x81B846 GklWUw 13107.0000 zk200msxs_uw_b13107 0.200003052 13107.2000 FUNCTION_LIST ATM IF_DATA DIM_X DIRECT 0x81B846
 /begin AXIS_DESCR COM_AXIS ml_w m_uw_b6553p5 7 0.00 6553.500 AXIS_PTS_REF SML07TMUW /end AXIS_DESCR
/end CHARACTERISTIC
/begin CHARACTERISTIC ZATMKML "Zeitkonstante fuer Katalysatortemperaturmodell - Kat-Temperatur tkatm" CURVE 0x81B854 GklWUw 13107.0000 zk200msxs_uw_b13107 0.200003052 13107.2000 FUNCTION_LIST ATM IF_DATA DIM_X DIRECT 0x81B854
 /begin AXIS_DESCR COM_AXIS ml_w m_uw_b6553p5 7 0.00 6553.500 AXIS_PTS_REF SML07TMUW /end AXIS_DESCR
/end CHARACTERISTIC
/begin CHARACTERISTIC ZATMKML2 "Zeitkonstante fuer Katalysatortemperaturmodell - Kat-Temperatur Bank2" CURVE 0x81B862 GklWUw 13107.0000 zk200msxs_uw_b13107 0.200003052 13107.2000 FUNCTION_LIST ATM IF_DATA DIM_X DIRECT 0x81B862
 /begin AXIS_DESCR COM_AXIS ml_w m_uw_b6553p5 7 0.00 6553.500 AXIS_PTS_REF SML07TMUW /end AXIS_DESCR
/end CHARACTERISTIC
/begin CHARACTERISTIC ZATMRML "Zeitkonstante fuer Abgastemperaturmodell - Rohrwandtemperatur" CURVE 0x81B870 GklWUw 13107.0000 zk200msxs_uw_b13107 0.200003052 13107.2000 FUNCTION_LIST ATM IF_DATA DIM_X DIRECT 0x81B870
 /begin AXIS_DESCR COM_AXIS ml_w m_uw_b6553p5 7 0.00 6553.500 AXIS_PTS_REF SML07TMUW /end AXIS_DESCR
/end CHARACTERISTIC
/begin CHARACTERISTIC ZATMRML2 "Zeitkonstante fuer Abgastemperaturmodell - Rohrwandtemperatur Bank2" CURVE 0x81B87E GklWUw 13107.0000 zk200msxs_uw_b13107 0.200003052 13107.2000 FUNCTION_LIST ATM IF_DATA DIM_X DIRECT 0x81B87E
 /begin AXIS_DESCR COM_AXIS ml_w m_uw_b6553p5 7 0.00 6553.500 AXIS_PTS_REF SML07TMUW /end AXIS_DESCR
/end CHARACTERISTIC
/begin CHARACTERISTIC ZBALM "Abregelfaktor L-Speicher (tmot) BA" CURVE 0x818B4F GklWUb 0.1245 fak_ub_b0p125 0.00 0.1245 FUNCTION_LIST ESUK IF_DATA DIM_X DIRECT 0x818B4F
 /begin AXIS_DESCR COM_AXIS tmot temp_ub_q0p75_o48 9 -48.00 143.3 AXIS_PTS_REF STM09ESUB /end AXIS_DESCR
/end CHARACTERISTIC
/begin CHARACTERISTIC ZBFIL "Zeitkonstante für Beschleunigungsfilter" VALUE 0x811C40 KwUb 2.54000 zk10msxs_ub_b2p55 0.0100000 2.55000 FUNCTION_LIST VMAXMD IF_DATA DIM_X DIRECT 0x811C40 /end CHARACTERISTIC
/begin CHARACTERISTIC ZBRT "Zeitkonstante für Brennraumtempmodell" VALUE 0x81862C KwUb 25.4996 zk100msxs_ub_b25p5 0.100392 25.6000 FUNCTION_LIST BGTMPK IF_DATA DIM_X DIRECT 0x81862C /end CHARACTERISTIC
/begin CHARACTERISTIC ZBTEML "Integrationsgeschwindigkeit Beladungsfaktor" CURVE 0x819B2E GklWUb 6.101 perio_ub_b6p125 0.00 6.101 FUNCTION_LIST TEB IF_DATA DIM_X DIRECT 0x819B2E /begin AXIS_DESCR COM_AXIS ml m_ub_b1020 6 0.00 1020. AXIS_PTS_REF SML06TEUB /end AXIS_DESCR /end CHARACTERISTIC
/begin CHARACTERISTIC ZBURNABR "Verbrennungsanzahl für Entscheidung Adaptionsabbruch" VALUE 0x81146A KwUb 255.0 dez 0.00 255.0 FUNCTION_LIST STADAP IF_DATA DIM_X DIRECT 0x81146A /end CHARACTERISTIC
/begin CHARACTERISTIC ZBURNDEC "Zu überschreitende Verbrennungsanzahl für ""Abmagern""" VALUE 0x81146B KwUb 255.0 dez 0.00 255.0 FUNCTION_LIST STADAP IF_DATA DIM_X DIRECT 0x81146B /end CHARACTERISTIC
/begin CHARACTERISTIC ZBURNLIM "Schwelle erkannte Verbrennungen für Wiederholstart" VALUE 0x811331 KwUb 255.0 dez 0.00 255.0 FUNCTION_LIST ESSTT IF_DATA DIM_X DIRECT 0x811331 /end CHARACTERISTIC
/begin CHARACTERISTIC ZBURNSOL "Erforderliche Verbrennungsanzahl für ""keine Anreicherung""" VALUE 0x81146C KwUb 255.0 dez 0.00 255.0 FUNCTION_LIST STADAP IF_DATA DIM_X DIRECT 0x81146C /end CHARACTERISTIC
/begin CHARACTERISTIC ZBWF "Zählerstand für Fehlereintrag Bewegungserkennung" VALUE 0x810E4E KwUb 255.0 dez 0.00 255.0 FUNCTION_LIST GGPED IF_DATA DIM_X DIRECT 0x810E4E /end CHARACTERISTIC
/begin CHARACTERISTIC ZDELBMSRCH "Zusätzlicher Zahnoffset beim Warten auf BM im Schnellstart" VALUE 0x810C06 KwUb 6.000 dez 0.00 6.000 FUNCTION_LIST GGDPG IF_DATA DIM_X DIRECT 0x810C06 /end CHARACTERISTIC
/begin CHARACTERISTIC ZDGZA1 "Zündungszahl Abregelung Bereich 1" VALUE 0x811148 KwUb 255.0 dez 0.00 255.0 FUNCTION_LIST ESNST IF_DATA DIM_X DIRECT 0x811148 /end CHARACTERISTIC
/begin CHARACTERISTIC ZDGZA2 "Zündungszahl Abregelung Bereich 2" VALUE 0x811149 KwUb 255.0 dez 0.00 255.0 FUNCTION_LIST ESNST IF_DATA DIM_X DIRECT 0x811149 /end CHARACTERISTIC
/begin CHARACTERISTIC ZDKATAD "Filterzeitkonstante der Differenzierer für Signalamplitude" VALUE 0x8183E2 KwUb 12.7498039 zk50msxs_ub_b12p8 0.0501960784 12.8000000 FUNCTION_LIST DKATLRS IF_DATA DIM_X DIRECT 0x8183E2 /end CHARACTERISTIC
/begin CHARACTERISTIC ZDKATAF "Zeitkonstante Betrags-Filter für Signalamplitude" VALUE 0x8183E3 KwUb 12.7498039 zk50msxs_ub_b12p8 0.0501960784 12.8000000 FUNCTION_LIST DKATLRS IF_DATA DIM_X DIRECT 0x8183E3 /end CHARACTERISTIC
/begin CHARACTERISTIC ZDKATSH "Zeitkonstante Tiefpaß, Regellagendifferenz" VALUE 0x8183E4 KwUb 12.7498039 zk50msxs_ub_b12p8 0.0501960784 12.8000000 FUNCTION_LIST DKATLRS IF_DATA DIM_X DIRECT 0x8183E4 /end CHARACTERISTIC
/begin CHARACTERISTIC ZDKTBD "Zeitkonstante der Differenzierer für FR-Wechselanteil" VALUE 0x8183E5 KwUb 12.7498039 zk50msxs_ub_b12p8 0.0501960784 12.8000000 FUNCTION_LIST DKATLRS IF_DATA DIM_X DIRECT 0x8183E5 /end CHARACTERISTIC
/begin CHARACTERISTIC ZDKTBF "Zeitkonstante für Gasvermischungsvorgang vor Katalysator" VALUE 0x8183E6 KwUb 12.7498039 zk50msxs_ub_b12p8 0.0501960784 12.8000000 FUNCTION_LIST DKATLRS IF_DATA DIM_X DIRECT 0x8183E6 /end CHARACTERISTIC
/begin CHARACTERISTIC ZDLBTS "Zeitkonstante Delta Lambda Bauteileschutz" VALUE 0x81C924 KwUw 6553.50000 zk100msxs_uw_b6553 0.100001526 6553.60000 FUNCTION_LIST LAMBTS IF_DATA DIM_X DIRECT 0x81C924 /end CHARACTERISTIC
/begin CHARACTERISTIC ZDSLAMX "Maximale Anzahl Wiederholungen aktive Zusatzdiagnose (Phasen 4+5)" VALUE 0x81812F KwUb 255.0 dez 0.00 255.0 FUNCTION_LIST DSLSLRS IF_DATA DIM_X DIRECT 0x81812F /end CHARACTERISTIC
/begin CHARACTERISTIC ZDSU "Zeitkonstante für Filterung von pu und fho in GGDSU" VALUE 0x8184F8 KwUb 25.4996 zk100msxs_ub_b25p5 0.100392 25.6000 FUNCTION_LIST GGDSAS IF_DATA DIM_X DIRECT 0x8184F8 /end CHARACTERISTIC
/begin CHARACTERISTIC ZDVS "Entprellung Fehlereintrag Ventlihubsteuerung" VALUE 0x812304 KwUb 255.0 dez 0.00 255.0 FUNCTION_LIST DVS IF_DATA DIM_X DIRECT 0x812304 /end CHARACTERISTIC
/begin CHARACTERISTIC ZDVSEGH "Entprellung Fehlereintrag Ventilhubsteuerung, Hub gross, Ventil hängt auf klein" VALUE 0x812305 KwUb 255.0 dez 0.00 255.0 FUNCTION_LIST DVS IF_DATA DIM_X DIRECT 0x812305 /end CHARACTERISTIC
/begin CHARACTERISTIC ZDVSEKH "Entprellung Fehlereintrag Ventilhubsteuerung, Hub klein, Ventil hängt auf gross" VALUE 0x812306 KwUb 255.0 dez 0.00 255.0 FUNCTION_LIST DVS IF_DATA DIM_X DIRECT 0x812306 /end CHARACTERISTIC
/begin CHARACTERISTIC ZDVSMOGH "Verzögerte Ausgabe Fehlereintrag Ventilhubsteuerung, Fehler grosser Hub" VALUE 0x817690 KwUw 65535.00 dez 0.00 65535.00 FUNCTION_LIST DVS IF_DATA DIM_X DIRECT 0x817690 /end CHARACTERISTIC
/begin CHARACTERISTIC ZDVSMOKH "Verzögerte Ausgabe Fehlereintrag Ventilhubsteuerung, Fehler kleiner Hub" VALUE 0x817692 KwUw 65535.00 dez 0.00 65535.00 FUNCTION_LIST DVS IF_DATA DIM_X DIRECT 0x817692 /end CHARACTERISTIC
/begin CHARACTERISTIC ZDYNFA "Zählerwert für Dynamikmessung LSU bei Kurztest" VALUE 0x810C6B KwUb 255.0 dez 0.00 255.0 FUNCTION_LIST DLSU IF_DATA DIM_X DIRECT 0x810C6B /end CHARACTERISTIC
/begin CHARACTERISTIC ZDYNLSU "Zählerwert für Dynamikmessung LSU" VALUE 0x810C6C KwUb 255.0 dez 0.00 255.0 FUNCTION_LIST DLSU IF_DATA DIM_X DIRECT 0x810C6C /end CHARACTERISTIC
/begin CHARACTERISTIC ZEHK "Fehlerzähler für Heizerkopplung auf das Lambdasignal" VALUE 0x810C6D KwUb 255.0 dez 0.00 255.0 FUNCTION_LIST DLSU IF_DATA DIM_X DIRECT 0x810C6D /end CHARACTERISTIC
/begin CHARACTERISTIC ZERLKO "Zeitkonstante für Filterung Lastanforderung Klimakompressor" VALUE 0x812B6C KwUb 255.0 dez 0.00 255.0 FUNCTION_LIST KOLS IF_DATA DIM_X DIRECT 0x812B6C /end CHARACTERISTIC
/begin CHARACTERISTIC ZETATE "Rampensteilheit für Veränderung Motorwirkungsgrad durch Tankentlüftung" VALUE 0x81E2EC KwUw 1279.590 rgrad_uw_b1280 0.3906250 1279.980 FUNCTION_LIST TEB IF_DATA DIM_X DIRECT 0x81E2EC /end CHARACTERISTIC
/begin CHARACTERISTIC ZFDUSVK "Filterzeitkonstante für LSU-Spannungsabgleich vor Kat" VALUE 0x813D0E KwUw 655.350000 zk10msxs_uw_b655 0.0100001526 655.360000 FUNCTION_LIST GGLSU IF_DATA DIM_X DIRECT 0x813D0E /end CHARACTERISTIC
/begin CHARACTERISTIC ZFLASKH "Zeitkonstante für Übergang auf Lambda-Abgas-Vorgabe" VALUE 0x819164 KwUb 25.4996 zk100msxs_ub_b25p5 0.100392 25.6000 FUNCTION_LIST LAKH IF_DATA DIM_X DIRECT 0x819164 /end CHARACTERISTIC
/begin CHARACTERISTIC ZFLMSSL "Zeitkonstante Gemischanteil Sekundärluft" VALUE 0x818184 KwUb 25.4996 zk100msxs_ub_b25p5 0.100392 25.6000 FUNCTION_LIST SLS IF_DATA DIM_X DIRECT 0x818184 /end CHARACTERISTIC
/begin CHARACTERISTIC ZFMDVERL "Zeitkonstante für Filterung Verlustmoment" VALUE 0x811691 KwUb 2.53000 zk20msxs_ub_b5p1 0.0200000 2.55000 FUNCTION_LIST MDVER IF_DATA DIM_X DIRECT 0x811691 /end CHARACTERISTIC
/begin CHARACTERISTIC ZFRIH "Abschwächungsfaktor für Innenwiderstand Ri-Nernst-Filter hinter KAT" VALUE 0x813C2E KwUw 0.9999847 fak_uw_b1 0.00 0.9999847 FUNCTION_LIST GGLSH IF_DATA DIM_X DIRECT 0x813C2E /end CHARACTERISTIC
/begin CHARACTERISTIC ZFRMFIL "Filterzeitkonstante Lambdareglergrößen" VALUE 0x81E32E KwUw 5.90696456 zk100msxs_uw_b6553 0.100001526 6.00696609 FUNCTION_LIST DTEV IF_DATA DIM_X DIRECT 0x81E32E /end CHARACTERISTIC
/begin CHARACTERISTIC ZFRMST "Zeitkonstante für frm-Filter (short test)" VALUE 0x818814 KwUb 50.8000 zk200msxs_ub_b51p2 0.200000 51.0000 FUNCTION_LIST DKVS IF_DATA DIM_X DIRECT 0x818814 /end CHARACTERISTIC
/begin CHARACTERISTIC ZFRMXAF "Filterzeitkonstante für frmxa_w Signal" VALUE 0x81E330 KwUw 6553.50000 zk100msxs_uw_b6553 0.100001526 6553.60000 FUNCTION_LIST DTEV IF_DATA DIM_X DIRECT 0x81E330 /end CHARACTERISTIC
/begin CHARACTERISTIC ZFUULSU "Filterzeitkonstante für Lambda" VALUE 0x813D10 KwUw 655.350000 zk10msxs_uw_b655 0.0100001526 655.360000 FUNCTION_LIST GGLSU IF_DATA DIM_X DIRECT 0x813D10 /end CHARACTERISTIC
/begin CHARACTERISTIC ZFV "Zeitkonstante für Filterung des Geschwindigkeitssignals" VALUE 0x813D1C KwUw 655.350000 zk10msxs_uw_b655 0.0100001526 655.360000 FUNCTION_LIST GGVFZG IF_DATA DIM_X DIRECT 0x813D1C /end CHARACTERISTIC
/begin CHARACTERISTIC ZHDVS "Entprellung Fehlerheilung Ventlihubsteuerung" VALUE 0x812307 KwUb 255.0 dez 0.00 255.0 FUNCTION_LIST DVS IF_DATA DIM_X DIRECT 0x812307 /end CHARACTERISTIC
/begin CHARACTERISTIC ZIVMAX "I-Steigung für VMAX-Regelung" VALUE 0x811C41 KwUb 25.4996 zk100msxs_ub_b25p5 0.100392 25.6000 FUNCTION_LIST VMAXMD IF_DATA DIM_X DIRECT 0x811C41 /end CHARACTERISTIC
/begin CHARACTERISTIC ZK1MDBGV "Zeitkonstante 1 f. Integrator bei geschw.-abh. Momentenaufbaubegrenzung" VALUE 0x816306 KwUw 99.99847 rel_uw_b100 0.00 99.99847 FUNCTION_LIST MDBGV IF_DATA DIM_X DIRECT 0x816306 /end CHARACTERISTIC
/begin CHARACTERISTIC ZK2MDBGV "Zeitkonstante 2 f. Integrator bei geschw.-abh. Momentenaufbaubegrenzung" VALUE 0x816308 KwUw 99.99847 rel_uw_b100 0.00 99.99847 FUNCTION_LIST MDBGV IF_DATA DIM_X DIRECT 0x816308 /end CHARACTERISTIC
/begin CHARACTERISTIC ZKARIH "Filterzeitkonst.für Nachbildung Dynamik der Keramiktemp. aus Abgastemp. h.Kat" VALUE 0x81B88C KwUw 6553.50000 zk100msxs_uw_b6553 0.100001526 6553.60000 FUNCTION_LIST DHLSHK IF_DATA DIM_X DIRECT 0x81B88C /end CHARACTERISTIC
/begin CHARACTERISTIC ZKBKVAB "Zeitkonstante Absteuerung Momentenreserve Katheizen für BKV" VALUE 0x81914F KwUb 25.4996 zk100msxs_ub_b25p5 0.100392 25.6000 FUNCTION_LIST KHMD IF_DATA DIM_X DIRECT 0x81914F /end CHARACTERISTIC
/begin CHARACTERISTIC ZKDMADFK "Zeitkonstante für Adaption des Verlustmoments Fahrstufe und Kompressor ein" VALUE 0x81DAC8 KwUw 816.000000 zk200msxs_uw_b13107 3.20000000 819.200000 FUNCTION_LIST MDVERAD IF_DATA DIM_X DIRECT 0x81DAC8 /end CHARACTERISTIC
/begin CHARACTERISTIC ZKDMADFS "Zeitkonstante für Adaption des Verlustmoments Fahrstufe ein" VALUE 0x81DACA KwUw 816.000000 zk200msxs_uw_b13107 3.20000000 819.200000 FUNCTION_LIST MDVERAD IF_DATA DIM_X DIRECT 0x81DACA /end CHARACTERISTIC
/begin CHARACTERISTIC ZKDMADKO "Zeitkonstante für Adaption des Verlustmoments Klimakompressor ein" VALUE 0x81DACC KwUw 816.000000 zk200msxs_uw_b13107 3.20000000 819.200000 FUNCTION_LIST MDVERAD IF_DATA DIM_X DIRECT 0x81DACC /end CHARACTERISTIC
/begin CHARACTERISTIC ZKDMADLL "Zeitkonstante für Adaption des Verlustmoments ohne Last" VALUE 0x81DACE KwUw 816.000000 zk200msxs_uw_b13107 3.20000000 819.200000 FUNCTION_LIST MDVERAD IF_DATA DIM_X DIRECT 0x81DACE /end CHARACTERISTIC
/begin CHARACTERISTIC ZKDRLSOL "Zeitkonstante für drlsol-Integrator" VALUE 0x81555C KwUw 655.350000 zk10msxs_uw_b655 0.0100001526 655.360000 FUNCTION_LIST MDFUE IF_DATA DIM_X DIRECT 0x81555C /end CHARACTERISTIC
/begin CHARACTERISTIC ZKFRAO "Zeitkonstante für frao-Integrator" VALUE 0x81C9B4 KwUw 4.999924 zk200msxs_uw_b5 0.00 4.999924 FUNCTION_LIST LRA IF_DATA DIM_X DIRECT 0x81C9B4 /end CHARACTERISTIC
/begin CHARACTERISTIC ZKFRAU "Zeitkonstante für frau-Integrator" VALUE 0x81C9B6 KwUw 4.999924 zk200msxs_uw_b5 0.00 4.999924 FUNCTION_LIST LRA IF_DATA DIM_X DIRECT 0x81C9B6 /end CHARACTERISTIC
/begin CHARACTERISTIC ZKFTEAD "Zeitkonstante gefilteter Faktor Beladung Spülstrom bei Tankentlüftung" VALUE 0x81E2EE KwUw 6553.50000 zk100msxs_uw_b6553 0.100001526 6553.60000 FUNCTION_LIST TEB IF_DATA DIM_X DIRECT 0x81E2EE /end CHARACTERISTIC
/begin CHARACTERISTIC ZKFUB "Filterzeitkonstante für Batteriespannung" VALUE 0x818483 KwUb 50.8000 zk200msxs_ub_b51p2 0.200000 51.0000 FUNCTION_LIST BGLBZ IF_DATA DIM_X DIRECT 0x818483 /end CHARACTERISTIC
/begin CHARACTERISTIC ZKHABB "Zeitkonstante für Abbruch-Tiefpass Katheizen" VALUE 0x81913C KwUb 25.4996 zk100msxs_ub_b25p5 0.100392 25.6000 FUNCTION_LIST BBKHZ IF_DATA DIM_X DIRECT 0x81913C /end CHARACTERISTIC
/begin CHARACTERISTIC ZKLAMKH "Zeitkonstante Lambda-Motor-Soll bei Katheizen" VALUE 0x815720 KwUw 655.350000 zk10msxs_uw_b655 0.0100001526 655.360000 FUNCTION_LIST BBKHZ IF_DATA DIM_X DIRECT 0x815720 /end CHARACTERISTIC
/begin CHARACTERISTIC ZKLANSWL "Zeitkonstante Filterung lamnswl_w" VALUE 0x813FE2 KwUw 655.350000 zk10msxs_uw_b655 0.0100001526 655.360000 FUNCTION_LIST ESWL IF_DATA DIM_X DIRECT 0x813FE2 /end CHARACTERISTIC
/begin CHARACTERISTIC ZKLBZ "Zeitkonstante des LBZ-Integrators" VALUE 0x81B98E KwUw 13107.0000 zk200msxs_uw_b13107 0.200003052 13107.2000 FUNCTION_LIST BGLBZ IF_DATA DIM_X DIRECT 0x81B98E /end CHARACTERISTIC
/begin CHARACTERISTIC ZKLLRD "Zeitkonstante für die Abregelung des D-Anteils" VALUE 0x811650 KwUb 5.08000 zk20msxs_ub_b5p1 0.0200000 5.10000 FUNCTION_LIST LLRRM IF_DATA DIM_X DIRECT 0x811650 /end CHARACTERISTIC
/begin CHARACTERISTIC ZKLSU "Filterzeitkonst.für Nachbildung Dynamik der LSU-Keramiktemp. aus Abgastemp.v.Kat" VALUE 0x813BA4 KwUw 6553.50000 zk100msxs_uw_b6553 0.100000000 6553.60000 FUNCTION_LIST DHLSU IF_DATA DIM_X DIRECT 0x813BA4 /end CHARACTERISTIC
/begin CHARACTERISTIC ZKMDKH "Filterzeitkonstante bei Wechsel von Teillast nach LL und umgekehrt" VALUE 0x819150 KwUb 25.4996 zk100msxs_ub_b25p5 0.100392 25.6000 FUNCTION_LIST KHMD IF_DATA DIM_X DIRECT 0x819150 /end CHARACTERISTIC
/begin CHARACTERISTIC ZKMDKO "Zeitkonstante Klimakompressor-Lastabregelung" VALUE 0x81166F KwUb 5.08000 zk20msxs_ub_b5p1 0.0200000 5.10000 FUNCTION_LIST MDVERB IF_DATA DIM_X DIRECT 0x81166F /end CHARACTERISTIC
/begin CHARACTERISTIC ZKMDWA "Zeitkonstante Drehmomentaufnahme des Wandlers" VALUE 0x811690 KwUb 5.08000 zk20msxs_ub_b5p1 0.0200000 5.10000 FUNCTION_LIST MDWAN IF_DATA DIM_X DIRECT 0x811690 /end CHARACTERISTIC
/begin CHARACTERISTIC ZKMSDKT "Zeitkonstante schnelle Massenstromadaption" CURVE 0x814DF0 KlAUwSstUwWUw 655.350000 zk10msxs_uw_b655 0.0100001526 655.360000 FUNCTION_LIST BGMSZS IF_DATA DIM_X DIRECT 0x814DF0
 /begin AXIS_DESCR STD_AXIS pspvds_w fak_uw_b2 8 0.00 1.999969 DEPOSIT ABSOLUT /end AXIS_DESCR
/end CHARACTERISTIC
/begin CHARACTERISTIC ZKNS "Zeitkonstante für Solldrehzahl bei Umschaltung" VALUE 0x8115D7 KwUb 5.08000 zk20msxs_ub_b5p1 0.0200000 5.10000 FUNCTION_LIST LLRNS IF_DATA DIM_X DIRECT 0x8115D7 /end CHARACTERISTIC
/begin CHARACTERISTIC ZKPRIH "Filter für Nachbildung Dynamik der Sondenkeramiktemp.aus el.Heizleistung h.Kat" VALUE 0x81B88E KwUw 6553.50000 zk100msxs_uw_b6553 0.100001526 6553.60000 FUNCTION_LIST DHLSHK IF_DATA DIM_X DIRECT 0x81B88E /end CHARACTERISTIC
/begin CHARACTERISTIC ZKPVDKT "Zeitkonstante für langsame Massenstromadaption" CURVE 0x814E12 KlAUwSstUwWUw 65534.000000 zk1sxs_uw_b65535 1.0000000000 65535.000000 FUNCTION_LIST BGMSZS IF_DATA DIM_X DIRECT 0x814E12
 /begin AXIS_DESCR STD_AXIS pspvds_w fak_uw_b2 8 0.00 1.999969 DEPOSIT ABSOLUT /end AXIS_DESCR
/end CHARACTERISTIC
/begin CHARACTERISTIC ZKRKAT "Integrationsgeschwindigkeit Integrator rkat" VALUE 0x81C9B8 KwUw 959.9854 zk200msxs_uw_b960 0.00 959.9854 FUNCTION_LIST LRA IF_DATA DIM_X DIRECT 0x81C9B8 /end CHARACTERISTIC
/begin CHARACTERISTIC ZKRKAZ "Integrationsgeschwindigkeit Integrator rkaz" VALUE 0x81C9BA KwUw 959.9854 zk200msxs_uw_b960 0.00 959.9854 FUNCTION_LIST LRA IF_DATA DIM_X DIRECT 0x81C9BA /end CHARACTERISTIC
/begin CHARACTERISTIC ZKRMSTEV "Zeitkonstante Tiefpaßfilterung für Mode 6 DTEV" VALUE 0x81E332 KwUw 60.0247691 zk100msxs_uw_b6553 0.100001526 60.1247706 FUNCTION_LIST DTEV IF_DATA DIM_X DIRECT 0x81E332 /end CHARACTERISTIC
/begin CHARACTERISTIC ZKSLPOFF "Zeitkonstante Runterlauf Sekundärluftgebläse" VALUE 0x818185 KwUb 25.4996 zk100msxs_ub_b25p5 0.100392 25.6000 FUNCTION_LIST SLS IF_DATA DIM_X DIRECT 0x818185 /end CHARACTERISTIC
/begin CHARACTERISTIC ZKSLPON "Zeitkonstante Hochlauf Sekundärluftgebläse" VALUE 0x818186 KwUb 25.4996 zk100msxs_ub_b25p5 0.100392 25.6000 FUNCTION_LIST SLS IF_DATA DIM_X DIRECT 0x818186 /end CHARACTERISTIC
/begin CHARACTERISTIC ZKSLSOFF "Zeitkonstante Ausräumen der Sekundärluft nach Ventil schließen" VALUE 0x818187 KwUb 25.4996 zk100msxs_ub_b25p5 0.100392 25.6000 FUNCTION_LIST SLS IF_DATA DIM_X DIRECT 0x818187 /end CHARACTERISTIC
/begin CHARACTERISTIC ZKSLSON "Zeitkonstante Einbringen der Sekundärluft nach Ventil öffnen" VALUE 0x818188 KwUb 25.4996 zk100msxs_ub_b25p5 0.100392 25.6000 FUNCTION_LIST SLS IF_DATA DIM_X DIRECT 0x818188 /end CHARACTERISTIC
/begin CHARACTERISTIC ZKTABTU "Zeitkonstante für Motorabkühlung" CURVE 0x81C77E KlAUwSstUwWUw 65535.00 t1sxs_uw_q1 0.00 65535.00 FUNCTION_LIST BGTABS IF_DATA DIM_X DIRECT 0x81C77E
 /begin AXIS_DESCR STD_AXIS tum_ein temp_ub_q0p75_o48 4 -48.00000 49103.25 DEPOSIT ABSOLUT /end AXIS_DESCR
/end CHARACTERISTIC
/begin CHARACTERISTIC ZKTDRL "Zeitkonstante Tiefpaß, rl-Filterung" VALUE 0x8183E7 KwUb 12.7498039 zk50msxs_ub_b12p8 0.0501960784 12.8000000 FUNCTION_LIST DKATLRS IF_DATA DIM_X DIRECT 0x8183E7 /end CHARACTERISTIC
/begin CHARACTERISTIC ZKTDTKM "Tiefpaß-Filterzeitkonstante für tkatm-Filterung" VALUE 0x81B8B8 KwUw 3276.75000 zk50msxs_uw_b3276p8 0.0500007630 3276.80000 FUNCTION_LIST DKATLRS IF_DATA DIM_X DIRECT 0x81B8B8 /end CHARACTERISTIC
/begin CHARACTERISTIC ZKUBDLR "DLR, Zeitkonstante für Filterung von Ubatt" VALUE 0x818493 KwUb 0.4980 fak_ub_b0p5 0.00 0.4980 FUNCTION_LIST ADVE IF_DATA DIM_X DIRECT 0x818493 /end CHARACTERISTIC
/begin CHARACTERISTIC ZKWDKSPT1 "Zeitkonstante für Prädiktion DK-Winkel aus Sollwert" VALUE 0x810D2E KwUb 0.6973 fak_q0p00273 0.00 0.6973 FUNCTION_LIST ADVE IF_DATA DIM_X DIRECT 0x810D2E /end CHARACTERISTIC
/begin CHARACTERISTIC ZKWNWI "Zeitkonstante für die Filterung von wnwi" VALUE 0x818777 KwUb 12.7498039 zk50msxs_ub_b12p8 0.0501960784 12.8000000 FUNCTION_LIST NWS IF_DATA DIM_X DIRECT 0x818777 /end CHARACTERISTIC
/begin CHARACTERISTIC ZKZWSVLS "Zeitkonstante bei ZW - Absteuerung Vollast nach spät (Motorschutz)" VALUE 0x8176B2 KwUw 0.7499886 fvzw_q1p144ne5 0.00 0.7499886 FUNCTION_LIST ZWBTSK IF_DATA DIM_X DIRECT 0x8176B2 /end CHARACTERISTIC
/begin CHARACTERISTIC ZLAMHP "Filterzeitkonstante für lamsoni_w Hochpass" VALUE 0x813C14 KwUw 655.350000 zk10msxs_uw_b655 0.0100001526 655.360000 FUNCTION_LIST DLSU IF_DATA DIM_X DIRECT 0x813C14 /end CHARACTERISTIC
/begin CHARACTERISTIC ZLAMLP "Filterzeitkonstante für lamsoni_w Tiefpass" VALUE 0x813C16 KwUw 655.350000 zk10msxs_uw_b655 0.0100001526 655.360000 FUNCTION_LIST DLSU IF_DATA DIM_X DIRECT 0x813C16 /end CHARACTERISTIC
/begin CHARACTERISTIC ZLASHKAB "Zeitkonstante für Abregelung der dyn. Sollwertanhebung (dlasohkab) rin der LRHK" VALUE 0x816EA8 KwUw 655.350000 zk10msxs_uw_b655 0.0100001526 655.360000 FUNCTION_LIST LRSHK IF_DATA DIM_X DIRECT 0x816EA8 /end CHARACTERISTIC
/begin CHARACTERISTIC ZLASOHML "Zeitkonstante für PT1-Filter des Pseudo-Lambda hinter Kat" CURVE 0x816EAA KlAUwSstUwWUw 655.350000 zk10msxs_uw_b655 0.0100001526 655.360000 FUNCTION_LIST LRSHK IF_DATA DIM_X DIRECT 0x816EAA /begin AXIS_DESCR STD_AXIS ml_w m_uw_b6553p5 8 0.00 6553.500 DEPOSIT ABSOLUT /end AXIS_DESCR /end CHARACTERISTIC
/begin CHARACTERISTIC ZLIBG "Filterzeitkonstante für die Nachführung der Integratorgrenzen" VALUE 0x811651 KwUb 5.08000 zk20msxs_ub_b5p1 0.0200000 5.10000 FUNCTION_LIST LLRRM IF_DATA DIM_X DIRECT 0x811651 /end CHARACTERISTIC
/begin CHARACTERISTIC ZLSDHK "Zeitkonstante PT2-Filter Lastschlagdämpfung bei hohem Kupplungsmoment" VALUE 0x8166F6 KwUw 655.350000 zk10msxs_uw_b655 0.0100001526 655.360000 FUNCTION_LIST MDFAW IF_DATA DIM_X DIRECT 0x8166F6 /end CHARACTERISTIC
/begin COMPU_METHOD dez "1 : 1 Umrechnug (dez/hex)" RAT_FUNC "%6.2" "" COEFFS 0 1 0 0 0 1 /end COMPU_METHOD
/begin COMPU_METHOD fak_q0p00273 "" RAT_FUNC "%6.4" "-" COEFFS 0 256 0 0 0 0.7 /end COMPU_METHOD
/begin COMPU_METHOD fak_q0p0039 "" RAT_FUNC "%6.4" "-" COEFFS 0 256 0 0 0 1 /end COMPU_METHOD
/begin COMPU_METHOD fak_sw_b1 "" RAT_FUNC "%7.6" "-" COEFFS 0 65536 0 0 0 2 /end COMPU_METHOD
/begin COMPU_METHOD fak_sw_b4 "" RAT_FUNC "%6.5" "-" COEFFS 0 65536 0 0 0 8 /end COMPU_METHOD
/begin COMPU_METHOD fak_ub_b0p125 "" RAT_FUNC "%6.5" "-" COEFFS 0 256 0 0 0 0.125 /end COMPU_METHOD
/begin COMPU_METHOD fak_ub_b0p5 "" RAT_FUNC "%6.4" "-" COEFFS 0 256 0 0 0 0.5 /end COMPU_METHOD
/begin COMPU_METHOD fak_ub_b1 "" RAT_FUNC "%6.4" "-" COEFFS 0 256 0 0 0 1 /end COMPU_METHOD
/begin COMPU_METHOD fak_ub_b16 "" RAT_FUNC "%6.4" "-" COEFFS 0 256 0 0 0 16 /end COMPU_METHOD
/begin COMPU_METHOD fak_ub_b2 "" RAT_FUNC "%6.4" "-" COEFFS 0 256 0 0 0 2 /end COMPU_METHOD
/begin COMPU_METHOD fak_ub_b318p75 "" RAT_FUNC "%6.2" "-" COEFFS 0 256 0 0 0 318.75 /end COMPU_METHOD
/begin COMPU_METHOD fak_uw_b1 "" RAT_FUNC "%7.6" "-" COEFFS 0 65536 0 0 0 1 /end COMPU_METHOD
/begin COMPU_METHOD fak_uw_b2 "" RAT_FUNC "%7.6" "-" COEFFS 0 65536 0 0 0 2 /end COMPU_METHOD
/begin COMPU_METHOD fvzw_q1p144ne5 "" RAT_FUNC "%7.6" "°ZW/ignition" COEFFS 0 65536 0 0 0 0.75 /end COMPU_METHOD
/begin COMPU_METHOD kw_q0p0156 "" RAT_FUNC "%6.4" "°KW" COEFFS 0 64 0 0 0 1 /end COMPU_METHOD
/begin COMPU_METHOD kw_q1 "" RAT_FUNC "%6.2" "°KW" COEFFS 0 1 0 0 0 1 /end COMPU_METHOD
/begin COMPU_METHOD kw_q2p8125 "" RAT_FUNC "%6.2" "°KW" COEFFS 0 1 0 0 0 2.8125 /end COMPU_METHOD
/begin COMPU_METHOD kw_q6 "" RAT_FUNC "%6.2" "°KW" COEFFS 0 1 0 0 0 6 /end COMPU_METHOD
/begin COMPU_METHOD kw_ub_q0p5 "" RAT_FUNC "%6.3" "°KW" COEFFS 0 256 0 0 0 128 /end COMPU_METHOD
/begin COMPU_METHOD m_ub_b1020 "" RAT_FUNC "%6.2" "kg/h" COEFFS 0 1 0 0 0 4 /end COMPU_METHOD
/begin COMPU_METHOD m_uw_b6553p5 "" RAT_FUNC "%6.3" "kg/h" COEFFS 0 1 0 0 0 0.1 /end COMPU_METHOD
/begin COMPU_METHOD nmot_ub_q10 "" RAT_FUNC "%6.1" "U/min" COEFFS 0 1 0 0 0 10 /end COMPU_METHOD
/begin COMPU_METHOD nmot_ub_q40 "" RAT_FUNC "%6.1" "Upm" COEFFS 0 1 0 0 0 40 /end COMPU_METHOD
/begin COMPU_METHOD nmot_uw_q0p25 "" RAT_FUNC "%6.3" "U/min" COEFFS 0 1 0 0 0 0.25 /end COMPU_METHOD
/begin COMPU_METHOD nwu_q1 "" RAT_FUNC "%6.2" "" COEFFS 0 1 0 0 0 1 /end COMPU_METHOD
/begin COMPU_METHOD perio_ub_b6p125 "" RAT_FUNC "%6.4" "1/s" COEFFS 0 256 0 0 0 6.125 /end COMPU_METHOD
/begin COMPU_METHOD p_sb_q10 "" RAT_FUNC "%6.1" "hPa" COEFFS 0 1 0 0 0 10 /end COMPU_METHOD
/begin COMPU_METHOD relDK_q0p00152 "" RAT_FUNC "%6.4" "%DK" COEFFS 0 65536 0 0 0 100 /end COMPU_METHOD
/begin COMPU_METHOD relDK_q0p02441 "" RAT_FUNC "%6.4" "% DK" COEFFS 0 65536 0 0 0 1600 /end COMPU_METHOD
/begin COMPU_METHOD relDK_ub_b100 "" RAT_FUNC "%6.3" "% DK" COEFFS 0 255 0 0 0 100 /end COMPU_METHOD
/begin COMPU_METHOD relDK_uw_b100 "" RAT_FUNC "%6.4" "% DK" COEFFS 0 65535 0 0 0 100 /end COMPU_METHOD
/begin COMPU_METHOD relPED_ub_b100 "" RAT_FUNC "%6.3" "% PED" COEFFS 0 255 0 0 0 100 /end COMPU_METHOD
/begin COMPU_METHOD relPED_uw_b100 "" RAT_FUNC "%6.4" "% PED" COEFFS 0 65535 0 0 0 100 /end COMPU_METHOD
/begin COMPU_METHOD rel_ub_b99p6 "" RAT_FUNC "%6.3" "%" COEFFS 0 256 0 0 0 100 /end COMPU_METHOD
/begin COMPU_METHOD rel_ub_q0p391 "" RAT_FUNC "%6.3" "%/km/h" COEFFS 0 1 0 0 0 0.391 /end COMPU_METHOD
/begin COMPU_METHOD rel_uw_b100 "" RAT_FUNC "%6.4" "%" COEFFS 0 65536 0 0 0 100 /end COMPU_METHOD
/begin COMPU_METHOD rel_uw_b6144 "" RAT_FUNC "%6.3" "%" COEFFS 0 65536 0 0 0 6144 /end COMPU_METHOD
/begin COMPU_METHOD rel_uw_q0p0234 "" RAT_FUNC "%6.4" "%" COEFFS 0 32 0 0 0 0.75 /end COMPU_METHOD
/begin COMPU_METHOD rgrad_uw_b1280 "" RAT_FUNC "%6.4" "%/s" COEFFS 0 65536 0 0 0 1280 /end COMPU_METHOD
/begin COMPU_METHOD spgg_q0p52 "" RAT_FUNC "%6.3" "mV/ms" COEFFS 0 1 0 0 0 0.52 /end COMPU_METHOD
/begin COMPU_METHOD spg_q0p00488 "" RAT_FUNC "%6.4" "V" COEFFS 0 1024 0 0 0 5 /end COMPU_METHOD
/begin COMPU_METHOD spg_q0p1 "" RAT_FUNC "%6.3" "V" COEFFS 0 1 0 0 0 0.1 /end COMPU_METHOD
/begin COMPU_METHOD spg_q1p221_mV "" RAT_FUNC "%6.4" "V" COEFFS 0 65536 0 0 0 80 /end COMPU_METHOD
/begin COMPU_METHOD spg_sw_q0p001222 "" RAT_FUNC "%6.4" "V" COEFFS 0 1 0 0 0 0.001222 /end COMPU_METHOD
/begin COMPU_METHOD spg_ubatt "" RAT_FUNC "%6.4" "V" COEFFS 0 1 0 0 0 0.076 /end COMPU_METHOD
/begin COMPU_METHOD spg_ub_b1p33 "" RAT_FUNC "%6.4" "V" COEFFS 0 255 0 0 0 1.33 /end COMPU_METHOD
/begin COMPU_METHOD spg_ub_b5 "" RAT_FUNC "%6.4" "V" COEFFS 0 256 0 0 0 5 /end COMPU_METHOD
/begin COMPU_METHOD spg_ub_q0p0052_o0p2 "" RAT_FUNC "%6.3" "V" COEFFS 0 255 51 0 0 1.33 /end COMPU_METHOD
/begin COMPU_METHOD spg_ub_q0p019 "" RAT_FUNC "%6.4" "V" COEFFS 0 256 0 0 0 5 /end COMPU_METHOD
/begin COMPU_METHOD spg_uw_b1280 "" RAT_FUNC "%6.4" "V" COEFFS 0 1000 0 0 0 19.5313 /end COMPU_METHOD
/begin COMPU_METHOD spg_uw_q0p001222 "" RAT_FUNC "%6.4" "V" COEFFS 0 1 0 0 0 0.001222 /end COMPU_METHOD
/begin COMPU_METHOD spg_uw_q0p00488 "" RAT_FUNC "%6.4" "V" COEFFS 0 1024 0 0 0 5 /end COMPU_METHOD
/begin COMPU_METHOD spg_uw_q0p00488_o1 "" RAT_FUNC "%6.3" "V" COEFFS 0 1024 1024 0 0 5 /end COMPU_METHOD
/begin COMPU_METHOD t100msxs_ub_b25p5 "" RAT_FUNC "%6.3" "s" COEFFS 0 1 0 0 0 0.1 /end COMPU_METHOD
/begin COMPU_METHOD t100msxs_ub_q20 "" RAT_FUNC "%9.3" "s" COEFFS 0 1 0 0 0 20 /end COMPU_METHOD
/begin COMPU_METHOD t100msxs_uw_b6553p5 "" RAT_FUNC "%6.3" "s" COEFFS 0 1 0 0 0 0.1 /end COMPU_METHOD
/begin COMPU_METHOD t100msxs_uw_b6553p6 "" RAT_FUNC "%6.3" "s" COEFFS 0 10 0 0 0 1 /end COMPU_METHOD
/begin COMPU_METHOD t100msxs_uw_q100 "" RAT_FUNC "%6.3" "s" COEFFS 0 1 0 0 0 0.1 /end COMPU_METHOD
/begin COMPU_METHOD t10msxs_ub_b2p55 "" RAT_FUNC "%6.4" "s" COEFFS 0 1 0 0 0 0.01 /end COMPU_METHOD
/begin COMPU_METHOD t10msxs_uw_b655p35 "" RAT_FUNC "%6.4" "s" COEFFS 0 1 0 0 0 0.01 /end COMPU_METHOD
/begin COMPU_METHOD t1280msxs_ub_b255 "" RAT_FUNC "%6.2" "Sek" COEFFS 0 1 0 0 0 1.28 /end COMPU_METHOD
/begin COMPU_METHOD t1msxms_q1 "" RAT_FUNC "%6.2" "ms" COEFFS 0 1 0 0 0 1 /end COMPU_METHOD
/begin COMPU_METHOD t1sxs_ub_b255 "" RAT_FUNC "%6.2" "s" COEFFS 0 1 0 0 0 1 /end COMPU_METHOD
/begin COMPU_METHOD t1sxs_uw_b65535 "" RAT_FUNC "%6.2" "s" COEFFS 0 1 0 0 0 1 /end COMPU_METHOD
/begin COMPU_METHOD t1sxs_uw_q1 "" RAT_FUNC "%6.2" "s" COEFFS 0 1 0 0 0 1 /end COMPU_METHOD
/begin COMPU_METHOD t200msxs_ub_b51 "" RAT_FUNC "%6.3" "s" COEFFS 0 1 0 0 0 0.2 /end COMPU_METHOD
/begin COMPU_METHOD t200msxs_uw_q0p2 "" RAT_FUNC "%6.3" "s" COEFFS 0 1 0 0 0 0.2 /end COMPU_METHOD
/begin COMPU_METHOD t20msxs_ub_b5p1 "" RAT_FUNC "%6.4" "s" COEFFS 0 1 0 0 0 0.02 /end COMPU_METHOD
/begin COMPU_METHOD t20msxs_ub_q0p02 "" RAT_FUNC "%6.4" "s" COEFFS 0 50 0 0 0 1 /end COMPU_METHOD
/begin COMPU_METHOD t20msxs_ub_q0p32 "" RAT_FUNC "%6.3" "s" COEFFS 0 256 0 0 0 81.92 /end COMPU_METHOD
/begin COMPU_METHOD t20msxs_uw_b1310 "" RAT_FUNC "%6.4" "s" COEFFS 0 1 0 0 0 0.02 /end COMPU_METHOD
/begin COMPU_METHOD t20msxs_uw_q0p02 "" RAT_FUNC "%6.4" "s" COEFFS 0 1 0 0 0 0.02 /end COMPU_METHOD
/begin COMPU_METHOD t40ms_ub_b10200 "" RAT_FUNC "%7.2" "ms" COEFFS 0 1 0 0 0 40 /end COMPU_METHOD
/begin COMPU_METHOD t40usxus_q40 "" RAT_FUNC "%6.1" "us" COEFFS 0 1 0 0 0 40 /end COMPU_METHOD
/begin COMPU_METHOD t500usxms_ub_q0p5 "" RAT_FUNC "%6.3" "ms" COEFFS 0 1 0 0 0 0.5 /end COMPU_METHOD
/begin COMPU_METHOD t50msxs_q0p05 "" RAT_FUNC "%6.4" "s" COEFFS 0 1 0 0 0 0.05 /end COMPU_METHOD
/begin COMPU_METHOD t50msxs_ub_b12p75 "" RAT_FUNC "%6.4" "s" COEFFS 0 1 0 0 0 0.05 /end COMPU_METHOD
/begin COMPU_METHOD t50msxs_uw_b3276p75 "" RAT_FUNC "%6.4" "s" COEFFS 0 1 0 0 0 0.05 /end COMPU_METHOD
/begin COMPU_METHOD t5usxus_q5 "" RAT_FUNC "%6.2" "us" COEFFS 0 1 0 0 0 5 /end COMPU_METHOD
/begin COMPU_METHOD temp_sb_q0p75 "" RAT_FUNC "%6.3" "Grad C" COEFFS 0 1 0 0 0 0.75 /end COMPU_METHOD
/begin COMPU_METHOD temp_ub_q0p75_o48 "" RAT_FUNC "%6.2" "Grad C" COEFFS 0 1 48 0 0 0.75 /end COMPU_METHOD
/begin COMPU_METHOD temp_ub_q1_o50 "" RAT_FUNC "%6.2" "Grad C" COEFFS 0 1 50 0 0 1 /end COMPU_METHOD
/begin COMPU_METHOD temp_ub_q5 "" RAT_FUNC "%6.2" "Grad C" COEFFS 0 1 0 0 0 5 /end COMPU_METHOD
/begin COMPU_METHOD temp_ub_q5_o50 "" RAT_FUNC "%6.2" "Grad C" COEFFS 0 1 50 0 0 5 /end COMPU_METHOD
/begin COMPU_METHOD temp_uw_q0p75_o48 "" RAT_FUNC "%6.2" "Grad C" COEFFS 0 1 48 0 0 0.00292969 /end COMPU_METHOD
/begin COMPU_METHOD tinjection_sy "" RAT_FUNC "%6.4" "ms" COEFFS 0 375 0 0 0 1 /end COMPU_METHOD
/begin COMPU_METHOD tv_sw_q0p005 "" RAT_FUNC "%6.4" "%" COEFFS 0 1 0 0 0 0.005 /end COMPU_METHOD
/begin COMPU_METHOD tv_ub_b100 "" RAT_FUNC "%6.3" "%" COEFFS 0 256 0 0 0 100 /end COMPU_METHOD
/begin COMPU_METHOD t_q0p01 "" RAT_FUNC "%6.4" "s" COEFFS 0 100 0 0 0 1 /end COMPU_METHOD
/begin COMPU_METHOD t_wdt_high "" RAT_FUNC "%6.2" "ms" COEFFS 0 0.732422 0 0 0 1 /end COMPU_METHOD
/begin COMPU_METHOD vfzg_sw_q0p00781 "" RAT_FUNC "%6.4" "km/h" COEFFS 0 1 0 0 0 0.0078125 /end COMPU_METHOD
/begin COMPU_METHOD vfzg_ub_q1p25 "" RAT_FUNC "%6.2" "km/h" COEFFS 0 1 0 0 0 1.25 /end COMPU_METHOD
/begin COMPU_METHOD vfzg_uw_b325 "" RAT_FUNC "%6.4" "km/h" COEFFS 0 65536 0 0 0 325 /end COMPU_METHOD
/begin COMPU_METHOD vfzg_uw_b512 "" RAT_FUNC "%6.4" "km/h" COEFFS 0 65536 0 0 0 512 /end COMPU_METHOD
/begin COMPU_METHOD vfzg_uw_q0p00781 "" RAT_FUNC "%6.4" "km/h" COEFFS 0 1 0 0 0 0.0078125 /end COMPU_METHOD
/begin COMPU_METHOD zk100msxs_ub_b25p5 "" RAT_FUNC "%6.3" "s" COEFFS 0 0 256 0 10 0 /end COMPU_METHOD
/begin COMPU_METHOD zk100msxs_uw_b6553 "" RAT_FUNC "%10.3" "s" COEFFS 0 0 65536 0 10 0 /end COMPU_METHOD
/begin COMPU_METHOD zk10msxs_ub_b2p55 "" RAT_FUNC "%6.4" "s" COEFFS 0 0 255 0 100 0 /end COMPU_METHOD
/begin COMPU_METHOD zk10msxs_uw_b655 "" RAT_FUNC "%10.4" "s" COEFFS 0 0 65536 0 100 0 /end COMPU_METHOD
/begin COMPU_METHOD zk1sxs_uw_b65535 "" RAT_FUNC "%6.0" "s" COEFFS 0 0 65535 0 1 0 /end COMPU_METHOD
/begin COMPU_METHOD zk200msxs_ub_b51p2 "" RAT_FUNC "%6.3" "s" COEFFS 0 0 255 0 5 0 /end COMPU_METHOD
/begin COMPU_METHOD zk200msxs_uw_b13107 "" RAT_FUNC "%10.2" "s" COEFFS 0 0 13107.2 0 1 0 /end COMPU_METHOD
/begin COMPU_METHOD zk200msxs_uw_b5 "" RAT_FUNC "%7.6" "1/s" COEFFS 0 65536 0 0 0 5 /end COMPU_METHOD
/begin COMPU_METHOD zk200msxs_uw_b960 "" RAT_FUNC "%6.4" "%/s" COEFFS 0 65536 0 0 0 960 /end COMPU_METHOD
/begin COMPU_METHOD zk20msxs_ub_b5p1 "" RAT_FUNC "%6.4" "s" COEFFS 0 0 5.1 0 1 0 /end COMPU_METHOD
/begin COMPU_METHOD zk20msxs_uw_b1310 "" RAT_FUNC "%10.3" "s" COEFFS 0 0 65536 0 50 0 /end COMPU_METHOD
/begin COMPU_METHOD zk50msxs_ub_b12p8 "" RAT_FUNC "%10.5" "s" COEFFS 0 0 128 0 10 0 /end COMPU_METHOD
/begin COMPU_METHOD zk50msxs_uw_b3276p8 "" RAT_FUNC "%10.3" "s" COEFFS 0 0 65536 0 20 0 /end COMPU_METHOD
/begin COMPU_METHOD zw_sb_q0p75 "" RAT_FUNC "%6.3" "grad KW" COEFFS 0 255 0 0 0 191.25 /end COMPU_METHOD
/begin COMPU_METHOD zw_ub_q6 "" RAT_FUNC "%6.2" "Grad KW" COEFFS 0 255 0 0 0 1530 /end COMPU_METHOD
/begin RECORD_LAYOUT FklWUw FNC_VALUES 1 UWORD COLUMN_DIR DIRECT /end RECORD_LAYOUT
/begin RECORD_LAYOUT GklWSb FNC_VALUES 1 SBYTE COLUMN_DIR DIRECT /end RECORD_LAYOUT
/begin RECORD_LAYOUT GklWUb FNC_VALUES 1 UBYTE COLUMN_DIR DIRECT /end RECORD_LAYOUT
/begin RECORD_LAYOUT GklWUw FNC_VALUES 1 UWORD COLUMN_DIR DIRECT /end RECORD_LAYOUT
/begin RECORD_LAYOUT KlAUbSstUbWUb NO_AXIS_PTS_X 1 UBYTE AXIS_PTS_X 2 UBYTE INDEX_INCR DIRECT FNC_VALUES 3 UBYTE COLUMN_DIR DIRECT /end RECORD_LAYOUT
/begin RECORD_LAYOUT KlAUbSstUbWUw NO_AXIS_PTS_X 1 UBYTE AXIS_PTS_X 2 UBYTE INDEX_INCR DIRECT FNC_VALUES 3 UWORD COLUMN_DIR DIRECT /end RECORD_LAYOUT
/begin RECORD_LAYOUT KlAUwSstSwWUw NO_AXIS_PTS_X 1 UWORD AXIS_PTS_X 2 SWORD INDEX_INCR DIRECT FNC_VALUES 3 UWORD COLUMN_DIR DIRECT /end RECORD_LAYOUT
/begin RECORD_LAYOUT KlAUwSstUwWUw NO_AXIS_PTS_X 1 UWORD AXIS_PTS_X 2 UWORD INDEX_INCR DIRECT FNC_VALUES 3 UWORD COLUMN_DIR DIRECT /end RECORD_LAYOUT
/begin RECORD_LAYOUT KwbUw FNC_VALUES 1 UWORD COLUMN_DIR DIRECT /end RECORD_LAYOUT
/begin RECORD_LAYOUT KwSb FNC_VALUES 1 SBYTE COLUMN_DIR DIRECT /end RECORD_LAYOUT
/begin RECORD_LAYOUT KwSw FNC_VALUES 1 SWORD COLUMN_DIR DIRECT /end RECORD_LAYOUT
/begin RECORD_LAYOUT KwUb FNC_VALUES 1 UBYTE COLUMN_DIR DIRECT /end RECORD_LAYOUT
/begin RECORD_LAYOUT KwUw FNC_VALUES 1 UWORD COLUMN_DIR DIRECT /end RECORD_LAYOUT
/begin RECORD_LAYOUT SstAUbSstUb NO_AXIS_PTS_X 1 UBYTE AXIS_PTS_X 2 UBYTE INDEX_INCR DIRECT /end RECORD_LAYOUT
/begin RECORD_LAYOUT SstAUwSstUw NO_AXIS_PTS_X 1 UWORD AXIS_PTS_X 2 UWORD INDEX_INCR DIRECT /end RECORD_LAYOUT
/end MODULE
/end PROJECT
