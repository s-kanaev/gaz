/begin PROJECT _7804367 "156"
/begin HEADER "" VERSION "_7804367" PROJECT_NO _7804367 /end HEADER
/begin MODULE DIM ""
/begin MOD_COMMON "" BYTE_ORDER BIG_ENDIAN S_REC_LAYOUT DAMOS /end MOD_COMMON
/begin MEASUREMENT B_mnph2 "Fehlerart: Kurzschluß Masse Phasengeber 2" UWORD B_TRUE 1 100 0 1 BIT_MASK 0x200 FUNCTION_LIST DFPM_DPH IF_DATA DIM_X 0x3838FA EXTERN BYTE IF_DATA MCMESS 0x3838FA EXTERN /end MEASUREMENT
/begin MEASUREMENT B_mnrkat "Bedingung untere Plausibilitätsschwelle unterschritten (add. pro Zeit)" UWORD B_TRUE 1 100 0 1 BIT_MASK 0x200 FUNCTION_LIST DFPM_DKVS IF_DATA DIM_X 0x3838FC EXTERN BYTE IF_DATA MCMESS 0x3838FC EXTERN /end MEASUREMENT
/begin MEASUREMENT B_mnrkat2 "Bedingung untere Plausibilitätsschwelle unterschritten (Stereo)" UWORD B_TRUE 1 100 0 1 BIT_MASK 0x200 FUNCTION_LIST DFPM_DKVS IF_DATA DIM_X 0x3838FE EXTERN BYTE IF_DATA MCMESS 0x3838FE EXTERN /end MEASUREMENT
/begin MEASUREMENT B_mnrkaz "Bedingung untere Plausibilitätsschwelle unterschritten (add. pro Zündung)" UWORD B_TRUE 1 100 0 1 BIT_MASK 0x200 FUNCTION_LIST DFPM_DKVS IF_DATA DIM_X 0x383900 EXTERN BYTE IF_DATA MCMESS 0x383900 EXTERN /end MEASUREMENT
/begin MEASUREMENT B_mnrkaz2 "Bedingung untere Plausibilitätsschwelle unterschritten (Stereo)" UWORD B_TRUE 1 100 0 1 BIT_MASK 0x200 FUNCTION_LIST DFPM_DKVS IF_DATA DIM_X 0x383902 EXTERN BYTE IF_DATA MCMESS 0x383902 EXTERN /end MEASUREMENT
/begin MEASUREMENT B_mnsgeep "" UWORD B_TRUE 1 100 0 1 BIT_MASK 0x200 FUNCTION_LIST DFPM_DSGEEP IF_DATA DIM_X 0x383904 EXTERN BYTE IF_DATA MCMESS 0x383904 EXTERN /end MEASUREMENT
/begin MEASUREMENT B_mnslpe "Fehlertype: Kurzschluß nach Masse Endstufe Sekundärluftpumpe" UWORD B_TRUE 1 100 0 1 BIT_MASK 0x200 FUNCTION_LIST DFPM_DEKON IF_DATA DIM_X 0x383906 EXTERN BYTE IF_DATA MCMESS 0x383906 EXTERN /end MEASUREMENT
/begin MEASUREMENT B_mnsls "Fehlerart: Sekundärluftmasse zu gering" UWORD B_TRUE 1 100 0 1 BIT_MASK 0x200 FUNCTION_LIST DFPM_DSLSLRS IF_DATA DIM_X 0x383908 EXTERN BYTE IF_DATA MCMESS 0x383908 EXTERN /end MEASUREMENT
/begin MEASUREMENT B_mnsls2 "Fehlerart: Sekundärluftmasse zu gering, Bank 2" UWORD B_TRUE 1 100 0 1 BIT_MASK 0x200 FUNCTION_LIST DFPM_DSLSLRS IF_DATA DIM_X 0x38390A EXTERN BYTE IF_DATA MCMESS 0x38390A EXTERN /end MEASUREMENT
/begin MEASUREMENT B_mnslspr "Fehlerart lokal: Sekundärluftmasse zu gering" UBYTE B_TRUE 1 100 0 1 BIT_MASK 0x8 FUNCTION_LIST DSLSLRS IF_DATA DIM_X 0x380905 EXTERN BYTE IF_DATA MCMESS 0x380905 EXTERN /end MEASUREMENT
/begin MEASUREMENT B_mnslspr2 "Fehlerart lokal: Sekundärluftmasse zu gering, Bank 2" UBYTE B_TRUE 1 100 0 1 BIT_MASK 0x4 FUNCTION_LIST DSLSLRS IF_DATA DIM_X 0x380906 EXTERN BYTE IF_DATA MCMESS 0x380906 EXTERN /end MEASUREMENT
/begin MEASUREMENT B_mnslv "Fehlerart:" UWORD B_TRUE 1 100 0 1 BIT_MASK 0x200 FUNCTION_LIST DFPM_DSLSLRS IF_DATA DIM_X 0x38390C EXTERN BYTE IF_DATA MCMESS 0x38390C EXTERN /end MEASUREMENT
/begin MEASUREMENT B_mnslv2 "Fehlerart:" UWORD B_TRUE 1 100 0 1 BIT_MASK 0x200 FUNCTION_LIST DFPM_DSLSLRS IF_DATA DIM_X 0x38390E EXTERN BYTE IF_DATA MCMESS 0x38390E EXTERN /end MEASUREMENT
/begin MEASUREMENT B_mnslve "Fehlertype: Kurzschluß nach Masse Endstufe Sekundärluftventil" UWORD B_TRUE 1 100 0 1 BIT_MASK 0x200 FUNCTION_LIST DFPM_DEKON IF_DATA DIM_X 0x383910 EXTERN BYTE IF_DATA MCMESS 0x383910 EXTERN /end MEASUREMENT
/begin MEASUREMENT B_mnswe "Beschleunigungssensorsignal kleiner als Plausibilitätsschwelle" UWORD B_TRUE 1 100 0 1 BIT_MASK 0x200 FUNCTION_LIST DFPM_BGRBS IF_DATA DIM_X 0x383912 EXTERN BYTE IF_DATA MCMESS 0x383912 EXTERN /end MEASUREMENT
/begin MEASUREMENT B_mnta "Fehlertyp: Minimalwertunterschreitung Ansauglufttemperatur TANS" UWORD B_TRUE 1 100 0 1 BIT_MASK 0x200 FUNCTION_LIST DFPM_GGTFA IF_DATA DIM_X 0x383914 EXTERN BYTE IF_DATA MCMESS 0x383914 EXTERN /end MEASUREMENT
/begin MEASUREMENT B_mntes "Fehlertyp 'Minimalwert' erkannt" UWORD B_TRUE 1 100 0 1 BIT_MASK 0x200 FUNCTION_LIST DFPM_DTEV IF_DATA DIM_X 0x383916 EXTERN BYTE IF_DATA MCMESS 0x383916 EXTERN /end MEASUREMENT
/begin MEASUREMENT B_mnteve "Fehlertyp: Kurzschluß Masse Tankentlüftungsventil Endstufe" UWORD B_TRUE 1 100 0 1 BIT_MASK 0x200 FUNCTION_LIST DFPM_DEKON IF_DATA DIM_X 0x383918 EXTERN BYTE IF_DATA MCMESS 0x383918 EXTERN /end MEASUREMENT
/begin MEASUREMENT B_mntget "Fehlertyp: Minimalwertunterschreitung Getriebetemperatur" UWORD B_TRUE 1 100 0 1 BIT_MASK 0x200 FUNCTION_LIST DFPM_GGTGET IF_DATA DIM_X 0x38391C EXTERN BYTE IF_DATA MCMESS 0x38391C EXTERN /end MEASUREMENT
/begin MEASUREMENT B_mnthm "" UWORD B_TRUE 1 100 0 1 BIT_MASK 0x200 FUNCTION_LIST DFPM_GGTFM IF_DATA DIM_X 0x38391E EXTERN BYTE IF_DATA MCMESS 0x38391E EXTERN /end MEASUREMENT
/begin MEASUREMENT B_mntm "Fehlertyp: Minimalwertunterschreitung Motortemperatur" UWORD B_TRUE 1 100 0 1 BIT_MASK 0x200 FUNCTION_LIST DFPM_GGTFM IF_DATA DIM_X 0x383920 EXTERN BYTE IF_DATA MCMESS 0x383920 EXTERN /end MEASUREMENT
/begin MEASUREMENT B_mntmki "Bedingung: Min-Fehler Motortemperatur aus Kombiinstrument" UWORD B_TRUE 1 100 0 1 BIT_MASK 0x200 FUNCTION_LIST DFPM_DUMMY043 IF_DATA DIM_X 0x383922 EXTERN BYTE IF_DATA MCMESS 0x383922 EXTERN /end MEASUREMENT
/begin MEASUREMENT B_mntmr "Fehlertyp: Minimalwertunterschreitung Motorraumtemperatur TMR" UWORD B_TRUE 1 100 0 1 BIT_MASK 0x200 FUNCTION_LIST DFPM_GGTFMR IF_DATA DIM_X 0x383924 EXTERN BYTE IF_DATA MCMESS 0x383924 EXTERN /end MEASUREMENT
/begin MEASUREMENT B_mntol "Fehlertyp: Minimalwertunterschreitung (Motor-) Oeltemperatur" UWORD B_TRUE 1 100 0 1 BIT_MASK 0x200 FUNCTION_LIST DFPM_GGTFOL IF_DATA DIM_X 0x383926 EXTERN BYTE IF_DATA MCMESS 0x383926 EXTERN /end MEASUREMENT
/begin MEASUREMENT B_mntum "Fehlertyp: Minimalwertunterschreitung Umgebungstemperatur" UWORD B_TRUE 1 100 0 1 BIT_MASK 0x200 FUNCTION_LIST DFPM_GGTFUMG IF_DATA DIM_X 0x383928 EXTERN BYTE IF_DATA MCMESS 0x383928 EXTERN /end MEASUREMENT
/begin MEASUREMENT B_mnub "Fehlertyp: Minimalwertunterschreitung Batteriespannung (Bordnetz)" UWORD B_TRUE 1 100 0 1 BIT_MASK 0x200 FUNCTION_LIST DFPM_GGUB IF_DATA DIM_X 0x38392A EXTERN BYTE IF_DATA MCMESS 0x38392A EXTERN /end MEASUREMENT
/begin MEASUREMENT B_mnufmv "Fehlertyp min.: Funktionsüberwachung: Momentenvergleich" UWORD B_TRUE 1 100 0 1 BIT_MASK 0x200 FUNCTION_LIST DFPM_DUF IF_DATA DIM_X 0x38392C EXTERN BYTE IF_DATA MCMESS 0x38392C EXTERN /end MEASUREMENT
/begin MEASUREMENT B_mnufska "Fehlertyp min.: Funktionsüberwachung: Sicherheits-Kraftstoff-Abschaltung" UWORD B_TRUE 1 100 0 1 BIT_MASK 0x200 FUNCTION_LIST DFPM_DUF IF_DATA DIM_X 0x38392E EXTERN BYTE IF_DATA MCMESS 0x38392E EXTERN /end MEASUREMENT
/begin MEASUREMENT B_mnurram "Fehlertyp min.: Rechnerüberwachung: RAM" UWORD B_TRUE 1 100 0 1 BIT_MASK 0x200 FUNCTION_LIST DFPM_DUR IF_DATA DIM_X 0x383930 EXTERN BYTE IF_DATA MCMESS 0x383930 EXTERN /end MEASUREMENT
/begin MEASUREMENT B_mnurrom "Fehlertyp min.: Rechnerüberwachung: ROM" UWORD B_TRUE 1 100 0 1 BIT_MASK 0x200 FUNCTION_LIST DFPM_DUR IF_DATA DIM_X 0x383932 EXTERN BYTE IF_DATA MCMESS 0x383932 EXTERN /end MEASUREMENT
/begin MEASUREMENT B_mnurrst "Fehlertyp min.: Rechnerüberwachung: Reset" UWORD B_TRUE 1 100 0 1 BIT_MASK 0x200 FUNCTION_LIST DFPM_DUR IF_DATA DIM_X 0x383934 EXTERN BYTE IF_DATA MCMESS 0x383934 EXTERN /end MEASUREMENT
/begin MEASUREMENT B_mnuvse "Fehlertyp: Kurzschluß Masse Umluftventil Turbo" UWORD B_TRUE 1 100 0 1 BIT_MASK 0x200 FUNCTION_LIST DFPM_DEKON IF_DATA DIM_X 0x383936 EXTERN BYTE IF_DATA MCMESS 0x383936 EXTERN /end MEASUREMENT
/begin MEASUREMENT B_mnvfz "Fehlertyp min,: Fahrzeuggeschwindigkeit" UWORD B_TRUE 1 100 0 1 BIT_MASK 0x200 FUNCTION_LIST DFPM_DVFZ IF_DATA DIM_X 0x383938 EXTERN BYTE IF_DATA MCMESS 0x383938 EXTERN /end MEASUREMENT
/begin MEASUREMENT B_mnvs01 "Fehlerart: Ventilhub Zdg.1 bleibt auf klein" UWORD B_TRUE 1 100 0 1 BIT_MASK 0x200 FUNCTION_LIST DFPM_DVS IF_DATA DIM_X 0x38393A EXTERN BYTE IF_DATA MCMESS 0x38393A EXTERN /end MEASUREMENT
/begin MEASUREMENT B_mnvs02 "Fehlerart: Ventilhub Zdg.2 bleibt auf klein" UWORD B_TRUE 1 100 0 1 BIT_MASK 0x200 FUNCTION_LIST DFPM_DVS IF_DATA DIM_X 0x38393C EXTERN BYTE IF_DATA MCMESS 0x38393C EXTERN /end MEASUREMENT
/begin MEASUREMENT B_mnvs03 "Fehlerart: Ventilhub Zdg.3 bleibt auf klein" UWORD B_TRUE 1 100 0 1 BIT_MASK 0x200 FUNCTION_LIST DFPM_DVS IF_DATA DIM_X 0x38393E EXTERN BYTE IF_DATA MCMESS 0x38393E EXTERN /end MEASUREMENT
/begin MEASUREMENT B_mnvs04 "Fehlerart: Ventilhub Zdg.4 bleibt auf klein" UWORD B_TRUE 1 100 0 1 BIT_MASK 0x200 FUNCTION_LIST DFPM_DVS IF_DATA DIM_X 0x383940 EXTERN BYTE IF_DATA MCMESS 0x383940 EXTERN /end MEASUREMENT
/begin MEASUREMENT B_mnvs05 "Fehlerart: Ventilhub Zdg.5 bleibt auf klein" UWORD B_TRUE 1 100 0 1 BIT_MASK 0x200 FUNCTION_LIST DFPM_DVS IF_DATA DIM_X 0x383942 EXTERN BYTE IF_DATA MCMESS 0x383942 EXTERN /end MEASUREMENT
/begin MEASUREMENT B_mnvs06 "Fehlerart: Ventilhub Zdg.6 bleibt auf klein" UWORD B_TRUE 1 100 0 1 BIT_MASK 0x200 FUNCTION_LIST DFPM_DVS IF_DATA DIM_X 0x383944 EXTERN BYTE IF_DATA MCMESS 0x383944 EXTERN /end MEASUREMENT
/begin MEASUREMENT B_mnvs1e "Fehlertype: Kurzschluß nach Masse Endstufe Ventilhub 1" UWORD B_TRUE 1 100 0 1 BIT_MASK 0x200 FUNCTION_LIST DFPM_DEKON IF_DATA DIM_X 0x383946 EXTERN BYTE IF_DATA MCMESS 0x383946 EXTERN /end MEASUREMENT
/begin MEASUREMENT B_mnvs2e "Fehlertype: Kurzschluß nach Masse Endstufe Ventilhub 2" UWORD B_TRUE 1 100 0 1 BIT_MASK 0x200 FUNCTION_LIST DFPM_DEKON IF_DATA DIM_X 0x383948 EXTERN BYTE IF_DATA MCMESS 0x383948 EXTERN /end MEASUREMENT
/begin MEASUREMENT B_mnvsb1 "Fehlertype: Ventilhub bleibt auf klein (Bankselektiv)" UWORD B_TRUE 1 100 0 1 BIT_MASK 0x200 FUNCTION_LIST DFPM_DVS IF_DATA DIM_X 0x38394A EXTERN BYTE IF_DATA MCMESS 0x38394A EXTERN /end MEASUREMENT
/begin MEASUREMENT B_mnvsb2 "Fehlertype: Ventilhub bleibt auf klein (Bankselektiv)" UWORD B_TRUE 1 100 0 1 BIT_MASK 0x200 FUNCTION_LIST DFPM_DVS IF_DATA DIM_X 0x38394C EXTERN BYTE IF_DATA MCMESS 0x38394C EXTERN /end MEASUREMENT
/begin MEASUREMENT B_mnvss "Fehlerart: Ventilhub bleibt auf klein (Summenfehler)" UWORD B_TRUE 1 100 0 1 BIT_MASK 0x200 FUNCTION_LIST DFPM_DVS IF_DATA DIM_X 0x38394E EXTERN BYTE IF_DATA MCMESS 0x38394E EXTERN /end MEASUREMENT
/begin MEASUREMENT B_mnwfs "Fehlertyp min.: Wegfahrsperre" UWORD B_TRUE 1 100 0 1 BIT_MASK 0x200 FUNCTION_LIST DFPM_WFS IF_DATA DIM_X 0x383950 EXTERN BYTE IF_DATA MCMESS 0x383950 EXTERN /end MEASUREMENT
/begin MEASUREMENT B_mrfamx "Vorlagerungswinkel über maximales Fahrerwunschmomment aktiv" UWORD B_TRUE 1 100 0 1 BIT_MASK 0x10 FUNCTION_LIST ESVW IF_DATA DIM_X 0xFD58 INTERN BYTE IF_DATA MCMESS 0xFD58 INTERN /end MEASUREMENT
/begin MEASUREMENT B_msg "Bedingung Motorraumspülgebläse ein" UWORD B_TRUE 1 100 0 1 BIT_MASK 0x1 FUNCTION_LIST MLS DMLSE MDVERB VHW IF_DATA DIM_X 0xFD6C INTERN BYTE IF_DATA MCMESS 0xFD6C INTERN /end MEASUREMENT
/begin MEASUREMENT B_msgnbres "Bedingung für Aufbau Drehmomentereserve bei Motorspülgebläse ein" UWORD B_TRUE 1 100 0 1 BIT_MASK 0x2 FUNCTION_LIST MLS MDVERB IF_DATA DIM_X 0xFD6C INTERN BYTE IF_DATA MCMESS 0xFD6C INTERN /end MEASUREMENT
/begin MEASUREMENT B_msgnl "Bedingung Motorraumspülgebläse im SG-Nachlauf" UWORD B_TRUE 1 100 0 1 BIT_MASK 0x4 FUNCTION_LIST MLS DMLSE VHW IF_DATA DIM_X 0xFD6C INTERN BYTE IF_DATA MCMESS 0xFD6C INTERN /end MEASUREMENT
/begin MEASUREMENT B_msgof "Bedingung Übertragung Fehlerinfo von Motor-SG an Kombiinstrument" UWORD B_TRUE 1 100 0 1 BIT_MASK 0x8 FUNCTION_LIST MLS CAN VHW IF_DATA DIM_X 0xFD6C INTERN BYTE IF_DATA MCMESS 0xFD6C INTERN /end MEASUREMENT
/begin MEASUREMENT B_msgp "Bedingung Motorraumspülgebläse Pause" UWORD B_TRUE 1 100 0 1 BIT_MASK 0x10 FUNCTION_LIST MLS IF_DATA DIM_X 0xFD6C INTERN BYTE IF_DATA MCMESS 0xFD6C INTERN /end MEASUREMENT
/begin MEASUREMENT B_mslmin "Bedingung sehr geringe Sekundärluftmasse aus Meßphase" UBYTE B_TRUE 1 100 0 1 BIT_MASK 0x2 FUNCTION_LIST DSLSLRS IF_DATA DIM_X 0x380900 EXTERN BYTE IF_DATA MCMESS 0x380900 EXTERN /end MEASUREMENT
/begin MEASUREMENT B_mslmin2 "Bedingung sehr geringe Sekundärluftmasse aus Meßphase (Bank 2)" UBYTE B_TRUE 1 100 0 1 BIT_MASK 0x2 FUNCTION_LIST DSLSLRS IF_DATA DIM_X 0x380906 EXTERN BYTE IF_DATA MCMESS 0x380906 EXTERN /end MEASUREMENT
/begin MEASUREMENT B_mslmn "Bedingung zu wenig Sekundärluftmasse" UWORD B_TRUE 1 100 0 1 BIT_MASK 0x20 FUNCTION_LIST DSLSLRS SLS IF_DATA DIM_X 0xFD02 INTERN BYTE IF_DATA MCMESS 0xFD02 INTERN /end MEASUREMENT
/begin MEASUREMENT B_msloff "Sekundärluftmasse ausgeräumt nach Sekundärluftphase" UBYTE B_TRUE 1 100 0 1 BIT_MASK 0x2 FUNCTION_LIST SLS BBKHZ IF_DATA DIM_X 0x38091F EXTERN BYTE IF_DATA MCMESS 0x38091F EXTERN /end MEASUREMENT
/begin MEASUREMENT B_mslon "Sekundärluftmasse eingeschwungen nach Start der Sekundärluft" UBYTE B_TRUE 1 100 0 1 BIT_MASK 0x4 FUNCTION_LIST SLS IF_DATA DIM_X 0x38091F EXTERN BYTE IF_DATA MCMESS 0x38091F EXTERN /end MEASUREMENT
/begin MEASUREMENT B_mslpmn "Fehlerbedingung: keine Sekundärluftpumpe, nur Pulse Air" UWORD B_TRUE 1 100 0 1 BIT_MASK 0x40 FUNCTION_LIST DSLSLRS IF_DATA DIM_X 0xFD02 INTERN BYTE IF_DATA MCMESS 0xFD02 INTERN /end MEASUREMENT
/begin MEASUREMENT B_mslpmn2 "Fehlerbedingung: keine Sekundärluftpumpe, nur Pulse Air, Bank 2" UWORD B_TRUE 1 100 0 1 BIT_MASK 0x80 FUNCTION_LIST DSLSLRS IF_DATA DIM_X 0xFD02 INTERN BYTE IF_DATA MCMESS 0xFD02 INTERN /end MEASUREMENT
/begin MEASUREMENT B_msr "Bedingung für Momentenschlupfregelung" UWORD B_TRUE 1 100 0 1 BIT_MASK 0x80 FUNCTION_LIST MDKOG BBFGR DUF MDRED1 MDZUL IF_DATA DIM_X 0xFD6E INTERN BYTE IF_DATA MCMESS 0xFD6E INTERN /end MEASUREMENT
/begin MEASUREMENT B_mt "Bedingung Handschaltgetriebe" UWORD B_TRUE 1 100 0 1 BIT_MASK 0x2 FUNCTION_LIST PROKON IF_DATA DIM_X 0xFD76 INTERN BYTE IF_DATA MCMESS 0xFD76 INTERN /end MEASUREMENT
/begin MEASUREMENT B_mxaave "Fehlerart: Kurzschluß Ubat Absperrventil Aktivkohlefilter (Endstufe)" UWORD B_TRUE 1 100 0 1 BIT_MASK 0x100 FUNCTION_LIST DFPM_DEKON IF_DATA DIM_X 0x383816 EXTERN BYTE IF_DATA MCMESS 0x383816 EXTERN /end MEASUREMENT
/begin MEASUREMENT B_mxagre "Fehlertype: Kurzschluß nach Ubat Endstufe AGR-Ventil" UWORD B_TRUE 1 100 0 1 BIT_MASK 0x100 FUNCTION_LIST DFPM_DUMMY043 IF_DATA DIM_X 0x383818 EXTERN BYTE IF_DATA MCMESS 0x383818 EXTERN /end MEASUREMENT
/begin MEASUREMENT B_mxaok "Bedingung Fehlerpfad ldra o.k." UWORD B_TRUE 1 100 0 1 BIT_MASK 0x200 FUNCTION_LIST DLDR IF_DATA DIM_X 0xFD66 INTERN BYTE IF_DATA MCMESS 0xFD66 INTERN /end MEASUREMENT
/begin MEASUREMENT B_mxbm "Fehlertyp: häufige Korrektur bei einem Zahn zuviel" UWORD B_TRUE 1 100 0 1 BIT_MASK 0x100 FUNCTION_LIST DFPM_DDG IF_DATA DIM_X 0x38381C EXTERN BYTE IF_DATA MCMESS 0x38381C EXTERN /end MEASUREMENT
/begin MEASUREMENT B_mxbrems "Fehlertyp BREMS (Bremsschalter): Maximalwert überschritten" UWORD B_TRUE 1 100 0 1 BIT_MASK 0x100 FUNCTION_LIST DFPM_GGEGAS IF_DATA DIM_X 0x38381E EXTERN BYTE IF_DATA MCMESS 0x38381E EXTERN /end MEASUREMENT
/begin MEASUREMENT B_mxbwf "Fehlertyp max.: PWG Bewegung" UWORD B_TRUE 1 100 0 1 BIT_MASK 0x100 FUNCTION_LIST DFPM_GGPED IF_DATA DIM_X 0x383820 EXTERN BYTE IF_DATA MCMESS 0x383820 EXTERN /end MEASUREMENT
/begin MEASUREMENT B_mxcas "Fehlertyp max.: CAN-Schnittstelle, Timeout Botschaft ASC" UWORD B_TRUE 1 100 0 1 BIT_MASK 0x100 FUNCTION_LIST DFPM_DCAS IF_DATA DIM_X 0x383822 EXTERN BYTE IF_DATA MCMESS 0x383822 EXTERN /end MEASUREMENT
/begin MEASUREMENT B_mxcge "Fehlertyp max.: CAN-Schnittstelle, Timeout EGS" UWORD B_TRUE 1 100 0 1 BIT_MASK 0x100 FUNCTION_LIST DFPM_DCGE IF_DATA DIM_X 0x383824 EXTERN BYTE IF_DATA MCMESS 0x383824 EXTERN /end MEASUREMENT
/begin MEASUREMENT B_mxcgegs "Fehlertype: Max-Fehler EGS; Steuergerät" UWORD B_TRUE 1 100 0 1 BIT_MASK 0x100 FUNCTION_LIST DFPM_DCG IF_DATA DIM_X 0x383826 EXTERN BYTE IF_DATA MCMESS 0x383826 EXTERN /end MEASUREMENT
/begin MEASUREMENT B_mxcgggp "Fehlertype: Max-Fehler EGS; Gang unplausibel" UWORD B_TRUE 1 100 0 1 BIT_MASK 0x100 FUNCTION_LIST DFPM_DCG IF_DATA DIM_X 0x383828 EXTERN BYTE IF_DATA MCMESS 0x383828 EXTERN /end MEASUREMENT
/begin MEASUREMENT B_mxcgggv "Fehlertype: Max-Fehler EGS; Gangvergleich negativ" UWORD B_TRUE 1 100 0 1 BIT_MASK 0x100 FUNCTION_LIST DFPM_DCG IF_DATA DIM_X 0x38382A EXTERN BYTE IF_DATA MCMESS 0x38382A EXTERN /end MEASUREMENT
/begin MEASUREMENT B_mxcgm1v "Fehlertype: Max-Fehler EGS; Magnetventil 1-2/4-5 Schaltung" UWORD B_TRUE 1 100 0 1 BIT_MASK 0x100 FUNCTION_LIST DFPM_DCG IF_DATA DIM_X 0x38382C EXTERN BYTE IF_DATA MCMESS 0x38382C EXTERN /end MEASUREMENT
/begin MEASUREMENT B_mxcgm2v "Fehlertype: Max-Fehler EGS; Magnetventil 2-3 Schaltung" UWORD B_TRUE 1 100 0 1 BIT_MASK 0x100 FUNCTION_LIST DFPM_DCG IF_DATA DIM_X 0x38382E EXTERN BYTE IF_DATA MCMESS 0x38382E EXTERN /end MEASUREMENT
/begin MEASUREMENT B_mxcgm3v "Fehlertype: Max-Fehler EGS; Magnetventil 3-4 Schaltung" UWORD B_TRUE 1 100 0 1 BIT_MASK 0x100 FUNCTION_LIST DFPM_DCG IF_DATA DIM_X 0x383830 EXTERN BYTE IF_DATA MCMESS 0x383830 EXTERN /end MEASUREMENT
/begin MEASUREMENT B_mxcgmvk "Fehlertype: Max-Fehler EGS; Magnetventil Wandlerkupplung" UWORD B_TRUE 1 100 0 1 BIT_MASK 0x100 FUNCTION_LIST DFPM_DCG IF_DATA DIM_X 0x383832 EXTERN BYTE IF_DATA MCMESS 0x383832 EXTERN /end MEASUREMENT
/begin MEASUREMENT B_mxcgrmm "Fehlertype: Max-Fehler EGS; Regelmagnetventil Modulierdruck" UWORD B_TRUE 1 100 0 1 BIT_MASK 0x100 FUNCTION_LIST DFPM_DCG IF_DATA DIM_X 0x383834 EXTERN BYTE IF_DATA MCMESS 0x383834 EXTERN /end MEASUREMENT
/begin MEASUREMENT B_mxcgrms "Fehlertype: Max-Fehler EGS; Regelmagnetventil Schaltdruck" UWORD B_TRUE 1 100 0 1 BIT_MASK 0x100 FUNCTION_LIST DFPM_DCG IF_DATA DIM_X 0x383836 EXTERN BYTE IF_DATA MCMESS 0x383836 EXTERN /end MEASUREMENT
/begin MEASUREMENT B_mxcgudg "Fehlertype: Max-Fehler EGS; Versorgungsspannung Drehzahlsensoren" UWORD B_TRUE 1 100 0 1 BIT_MASK 0x100 FUNCTION_LIST DFPM_DCG IF_DATA DIM_X 0x383838 EXTERN BYTE IF_DATA MCMESS 0x383838 EXTERN /end MEASUREMENT
/begin MEASUREMENT B_mxcgumv "Fehlertype: Max-Fehler EGS; Versorgungsspannung Magnetventile" UWORD B_TRUE 1 100 0 1 BIT_MASK 0x100 FUNCTION_LIST DFPM_DCG IF_DATA DIM_X 0x38383A EXTERN BYTE IF_DATA MCMESS 0x38383A EXTERN /end MEASUREMENT
/begin MEASUREMENT B_mxcgvgc "Fehlertype: Max-Fehler EGS; Verteilergetr.-Stellung unplaus." UWORD B_TRUE 1 100 0 1 BIT_MASK 0x100 FUNCTION_LIST DFPM_DCG IF_DATA DIM_X 0x38383C EXTERN BYTE IF_DATA MCMESS 0x38383C EXTERN /end MEASUREMENT
/begin MEASUREMENT B_mxcgvrc "Fehlertype: Max-Fehler EGS; Raddrehzahl hinten unplausibel" UWORD B_TRUE 1 100 0 1 BIT_MASK 0x100 FUNCTION_LIST DFPM_DCG IF_DATA DIM_X 0x38383E EXTERN BYTE IF_DATA MCMESS 0x38383E EXTERN /end MEASUREMENT
/begin MEASUREMENT B_mxcgwk "Fehlertype: Max-Fehler EGS; Wandlerkupplung" UWORD B_TRUE 1 100 0 1 BIT_MASK 0x100 FUNCTION_LIST DFPM_DCG IF_DATA DIM_X 0x383840 EXTERN BYTE IF_DATA MCMESS 0x383840 EXTERN /end MEASUREMENT
/begin MEASUREMENT B_mxckbi "Fehlertyp max.: CAN-Schnittstelle, Timeout Botschaft Kombi" UWORD B_TRUE 1 100 0 1 BIT_MASK 0x100 FUNCTION_LIST DFPM_DCKBI IF_DATA DIM_X 0x383842 EXTERN BYTE IF_DATA MCMESS 0x383842 EXTERN /end MEASUREMENT
/begin MEASUREMENT B_mxcmil "Fehlerart:MIL über CAN max.-Fehler" UWORD B_TRUE 1 100 0 1 BIT_MASK 0x100 FUNCTION_LIST DFPM_DCMIL IF_DATA DIM_X 0x383844 EXTERN BYTE IF_DATA MCMESS 0x383844 EXTERN /end MEASUREMENT
/begin MEASUREMENT B_mxcra "" UWORD B_TRUE 1 100 0 1 BIT_MASK 0x100 FUNCTION_LIST DFPM_GGAIRBAG IF_DATA DIM_X 0x383846 EXTERN BYTE IF_DATA MCMESS 0x383846 EXTERN /end MEASUREMENT
/begin MEASUREMENT B_mxdk "Fehlertype: Kurzschluß nach Ubat Drosselklappenpoti" UWORD B_TRUE 1 100 0 1 BIT_MASK 0x100 FUNCTION_LIST DFPM_DDVE IF_DATA DIM_X 0x383848 EXTERN BYTE IF_DATA MCMESS 0x383848 EXTERN /end MEASUREMENT
/begin MEASUREMENT B_mxdk1p "Fehlertyp max.: Drosselklappe 1. Poti" UWORD B_TRUE 1 100 0 1 BIT_MASK 0x100 FUNCTION_LIST DFPM_DDVE IF_DATA DIM_X 0x38384A EXTERN BYTE IF_DATA MCMESS 0x38384A EXTERN /end MEASUREMENT
/begin MEASUREMENT B_mxdk2p "Fehlertyp max.: Drosselklappe 2. Poti" UWORD B_TRUE 1 100 0 1 BIT_MASK 0x100 FUNCTION_LIST DFPM_DDVE IF_DATA DIM_X 0x38384C EXTERN BYTE IF_DATA MCMESS 0x38384C EXTERN /end MEASUREMENT
/begin MEASUREMENT B_mxdsl "Bedingung max. Fehler Ladedrucksensor" UWORD B_TRUE 1 100 0 1 BIT_MASK 0x100 FUNCTION_LIST DFPM_GGDSAS IF_DATA DIM_X 0x383850 EXTERN BYTE IF_DATA MCMESS 0x383850 EXTERN /end MEASUREMENT
/begin MEASUREMENT B_mxdsu "Bedingung: max-Fehler Umgebungsdrucksensor" UWORD B_TRUE 1 100 0 1 BIT_MASK 0x100 FUNCTION_LIST DFPM_GGDSAS IF_DATA DIM_X 0x383852 EXTERN BYTE IF_DATA MCMESS 0x383852 EXTERN /end MEASUREMENT
/begin MEASUREMENT B_mxdsvlu "Fehlertyp 'Maximalwert' erkannt: Drucksensorsignalvergleich (DS-L DS-U)" UWORD B_TRUE 1 100 0 1 BIT_MASK 0x100 FUNCTION_LIST DFPM_GGDSAS IF_DATA DIM_X 0x383854 EXTERN BYTE IF_DATA MCMESS 0x383854 EXTERN /end MEASUREMENT
/begin MEASUREMENT B_mxdvee "Fehlertyp max.: DV-E Endstufe" UWORD B_TRUE 1 100 0 1 BIT_MASK 0x100 FUNCTION_LIST DFPM_DDVE IF_DATA DIM_X 0x383856 EXTERN BYTE IF_DATA MCMESS 0x383856 EXTERN /end MEASUREMENT
/begin MEASUREMENT B_mxdvef "Fehlertyp max.: DV-E Fehler bei Prüfung der Rückstellfeder" UWORD B_TRUE 1 100 0 1 BIT_MASK 0x100 FUNCTION_LIST DFPM_DDVE IF_DATA DIM_X 0x383858 EXTERN BYTE IF_DATA MCMESS 0x383858 EXTERN /end MEASUREMENT
/begin MEASUREMENT B_mxdvefo "Fehlertyp max.: Fehler bei Federprüfung ""Öffnen""" UWORD B_TRUE 1 100 0 1 BIT_MASK 0x100 FUNCTION_LIST DFPM_DDVE IF_DATA DIM_X 0x38385A EXTERN BYTE IF_DATA MCMESS 0x38385A EXTERN /end MEASUREMENT
/begin MEASUREMENT B_mxdvel "Fehlerzyp max.: DV-E Lageabweichung" UWORD B_TRUE 1 100 0 1 BIT_MASK 0x100 FUNCTION_LIST DFPM_DDVE IF_DATA DIM_X 0x38385C EXTERN BYTE IF_DATA MCMESS 0x38385C EXTERN /end MEASUREMENT
/begin MEASUREMENT B_mxdven "Fehlertyp max.: DV-E Fehler bei Prüfung Notluftposition" UWORD B_TRUE 1 100 0 1 BIT_MASK 0x100 FUNCTION_LIST DFPM_DDVE IF_DATA DIM_X 0x38385E EXTERN BYTE IF_DATA MCMESS 0x38385E EXTERN /end MEASUREMENT
/begin MEASUREMENT B_mxdver "Fehlertyp max.: DV-E Regelbereich, langfristig verletzt" UWORD B_TRUE 1 100 0 1 BIT_MASK 0x100 FUNCTION_LIST DFPM_DDVE IF_DATA DIM_X 0x383860 EXTERN BYTE IF_DATA MCMESS 0x383860 EXTERN /end MEASUREMENT
/begin MEASUREMENT B_mxdvet "" UWORD B_TRUE 1 100 0 1 BIT_MASK 0x100 FUNCTION_LIST DFPM_DDVE IF_DATA DIM_X 0x383862 EXTERN BYTE IF_DATA MCMESS 0x383862 EXTERN /end MEASUREMENT
/begin MEASUREMENT B_mxdveu "Fehlertyp max.: DV-E Fehler beim UMA-Lernen" UWORD B_TRUE 1 100 0 1 BIT_MASK 0x100 FUNCTION_LIST DFPM_DDVE IF_DATA DIM_X 0x383864 EXTERN BYTE IF_DATA MCMESS 0x383864 EXTERN /end MEASUREMENT
/begin MEASUREMENT B_mxdveub "Fehlertyp max.: DV-E-Adaption Abbruch wg. Umweltbedingung" UWORD B_TRUE 1 100 0 1 BIT_MASK 0x100 FUNCTION_LIST DFPM_DDVE IF_DATA DIM_X 0x383866 EXTERN BYTE IF_DATA MCMESS 0x383866 EXTERN /end MEASUREMENT
/begin MEASUREMENT B_mxdveuw "" UWORD B_TRUE 1 100 0 1 BIT_MASK 0x100 FUNCTION_LIST DFPM_DDVE IF_DATA DIM_X 0x383868 EXTERN BYTE IF_DATA MCMESS 0x383868 EXTERN /end MEASUREMENT
/begin MEASUREMENT B_mxdvev "Fehlertyp max.: DV-E Fehler bei Verstärkerabgleich" UWORD B_TRUE 1 100 0 1 BIT_MASK 0x100 FUNCTION_LIST DFPM_DDVE IF_DATA DIM_X 0x38386A EXTERN BYTE IF_DATA MCMESS 0x38386A EXTERN /end MEASUREMENT
/begin MEASUREMENT B_mxegfe "Bedingung: MAX-Fehler Eingangsgrößen Füllungserfassung" UWORD B_TRUE 1 100 0 1 BIT_MASK 0x100 FUNCTION_LIST DFPM_EGFE IF_DATA DIM_X 0x38386C EXTERN BYTE IF_DATA MCMESS 0x38386C EXTERN /end MEASUREMENT
/begin MEASUREMENT B_mxev1 "Fehlerart: Kurzschluß UBat an Endstufe EV1" UWORD B_TRUE 1 100 0 1 BIT_MASK 0x100 FUNCTION_LIST DFPM_DEKON IF_DATA DIM_X 0x38386E EXTERN BYTE IF_DATA MCMESS 0x38386E EXTERN /end MEASUREMENT
/begin MEASUREMENT B_mxev2 "Fehlerart: Kurzschluß UBat an Endstufe EV2" UWORD B_TRUE 1 100 0 1 BIT_MASK 0x100 FUNCTION_LIST DFPM_DEKON IF_DATA DIM_X 0x383870 EXTERN BYTE IF_DATA MCMESS 0x383870 EXTERN /end MEASUREMENT
/begin MEASUREMENT B_mxev3 "Fehlerart: Kurzschluß UBat an Endstufe EV3" UWORD B_TRUE 1 100 0 1 BIT_MASK 0x100 FUNCTION_LIST DFPM_DEKON IF_DATA DIM_X 0x383872 EXTERN BYTE IF_DATA MCMESS 0x383872 EXTERN /end MEASUREMENT
/begin MEASUREMENT B_mxev4 "Fehlerart: Kurzschluß UBat an Endstufe EV4" UWORD B_TRUE 1 100 0 1 BIT_MASK 0x100 FUNCTION_LIST DFPM_DEKON IF_DATA DIM_X 0x383874 EXTERN BYTE IF_DATA MCMESS 0x383874 EXTERN /end MEASUREMENT
/begin MEASUREMENT B_mxev5 "Fehlerart: Kurzschluß UBat an Endstufe EV5" UWORD B_TRUE 1 100 0 1 BIT_MASK 0x100 FUNCTION_LIST DFPM_DEKON IF_DATA DIM_X 0x383876 EXTERN BYTE IF_DATA MCMESS 0x383876 EXTERN /end MEASUREMENT
/begin MEASUREMENT B_mxev6 "Fehlerart: Kurzschluß UBat an Endstufe EV6" UWORD B_TRUE 1 100 0 1 BIT_MASK 0x100 FUNCTION_LIST DFPM_DEKON IF_DATA DIM_X 0x383878 EXTERN BYTE IF_DATA MCMESS 0x383878 EXTERN /end MEASUREMENT
/begin MEASUREMENT B_mxfgrl "Fehlertyp max.: FGR-Lampe über CAN" UWORD B_TRUE 1 100 0 1 BIT_MASK 0x100 FUNCTION_LIST DFPM_DCFGRL IF_DATA DIM_X 0x38387A EXTERN BYTE IF_DATA MCMESS 0x38387A EXTERN /end MEASUREMENT
/begin MEASUREMENT B_mxfp1p "Fehlertyp max.: Fahrpedal 1. Poti" UWORD B_TRUE 1 100 0 1 BIT_MASK 0x100 FUNCTION_LIST DFPM_GGPED IF_DATA DIM_X 0x38387C EXTERN BYTE IF_DATA MCMESS 0x38387C EXTERN /end MEASUREMENT
/begin MEASUREMENT B_mxfp2p "Fehlertyp max.: Fahrpedal 2. Poti" UWORD B_TRUE 1 100 0 1 BIT_MASK 0x100 FUNCTION_LIST DFPM_GGPED IF_DATA DIM_X 0x38387E EXTERN BYTE IF_DATA MCMESS 0x38387E EXTERN /end MEASUREMENT
/begin MEASUREMENT B_mxfpp "Fehlertyp max.: Fahrpedal Potentiometer" UWORD B_TRUE 1 100 0 1 BIT_MASK 0x100 FUNCTION_LIST DFPM_GGPED IF_DATA DIM_X 0x383880 EXTERN BYTE IF_DATA MCMESS 0x383880 EXTERN /end MEASUREMENT
/begin MEASUREMENT B_mxfrao "Bedingung obere Plausibilitätsschwelle überschritten (obere Multipl.)" UWORD B_TRUE 1 100 0 1 BIT_MASK 0x100 FUNCTION_LIST DFPM_DKVS IF_DATA DIM_X 0x383882 EXTERN BYTE IF_DATA MCMESS 0x383882 EXTERN /end MEASUREMENT
/begin MEASUREMENT B_mxfrao2 "Bedingung obere Plausibilitätsschwelle überschritten (Stereo)" UWORD B_TRUE 1 100 0 1 BIT_MASK 0x100 FUNCTION_LIST DFPM_DKVS IF_DATA DIM_X 0x383884 EXTERN BYTE IF_DATA MCMESS 0x383884 EXTERN /end MEASUREMENT
/begin MEASUREMENT B_mxfrau "Bedingung obere Plausiblitätsschwelle überschritten (untere Multipl.)" UWORD B_TRUE 1 100 0 1 BIT_MASK 0x100 FUNCTION_LIST DFPM_DKVS IF_DATA DIM_X 0x383886 EXTERN BYTE IF_DATA MCMESS 0x383886 EXTERN /end MEASUREMENT
/begin MEASUREMENT B_mxfrau2 "Bedingung obere Plausibilitätsschwelle überschritten (mult. 2. Bank)" UWORD B_TRUE 1 100 0 1 BIT_MASK 0x100 FUNCTION_LIST DFPM_DKVS IF_DATA DIM_X 0x383888 EXTERN BYTE IF_DATA MCMESS 0x383888 EXTERN /end MEASUREMENT
/begin MEASUREMENT B_mxfrst "Bedingung obere Plausiblitätsschwelle überschritten (short test" UWORD B_TRUE 1 100 0 1 BIT_MASK 0x100 FUNCTION_LIST DFPM_DKVS IF_DATA DIM_X 0x38388A EXTERN BYTE IF_DATA MCMESS 0x38388A EXTERN /end MEASUREMENT
/begin MEASUREMENT B_mxfrst2 "Bedingung obere Plausiblitätsschwelle überschritten (short test Stereo" UWORD B_TRUE 1 100 0 1 BIT_MASK 0x100 FUNCTION_LIST DFPM_DKVS IF_DATA DIM_X 0x38388C EXTERN BYTE IF_DATA MCMESS 0x38388C EXTERN /end MEASUREMENT
/begin MEASUREMENT B_mxhfm "Bedingung obere Plausibilitätsschwelle HFM überschritten" UWORD B_TRUE 1 100 0 1 BIT_MASK 0x80 FUNCTION_LIST DHFM IF_DATA DIM_X 0xFD48 INTERN BYTE IF_DATA MCMESS 0xFD48 INTERN /end MEASUREMENT
/begin MEASUREMENT B_mxhlsu "Kurzschluß Heizung LSU1 nach UB" UWORD B_TRUE 1 100 0 1 BIT_MASK 0x8000 FUNCTION_LIST DHLSU IF_DATA DIM_X 0xFD1C INTERN BYTE IF_DATA MCMESS 0xFD1C INTERN /end MEASUREMENT
/begin MEASUREMENT B_mxhlsu2 "Kurzschluß Heizung LSU2 nach UB" UWORD B_TRUE 1 100 0 1 BIT_MASK 0x1 FUNCTION_LIST DHLSU IF_DATA DIM_X 0xFD1E INTERN BYTE IF_DATA MCMESS 0xFD1E INTERN /end MEASUREMENT
/begin MEASUREMENT B_mxhsh "Kurzschluß Heizung Lambdasonde hinter Kat nach UB" UWORD B_TRUE 1 100 0 1 BIT_MASK 0x100 FUNCTION_LIST DFPM_DHLSHK IF_DATA DIM_X 0x38388E EXTERN BYTE IF_DATA MCMESS 0x38388E EXTERN /end MEASUREMENT
/begin MEASUREMENT B_mxhsh2 "Kurzschluß Heizung Lambdasonde2 hinter Kat nach UB" UWORD B_TRUE 1 100 0 1 BIT_MASK 0x100 FUNCTION_LIST DFPM_DHLSHK IF_DATA DIM_X 0x383890 EXTERN BYTE IF_DATA MCMESS 0x383890 EXTERN /end MEASUREMENT
/begin MEASUREMENT B_mxhshe "Kurzschluß Heizung Lambdasonde hinter Kat nach UB (Endstufe)" UWORD B_TRUE 1 100 0 1 BIT_MASK 0x100 FUNCTION_LIST DFPM_DEKON IF_DATA DIM_X 0x383892 EXTERN BYTE IF_DATA MCMESS 0x383892 EXTERN /end MEASUREMENT
/begin MEASUREMENT B_mxhshe2 "Kurzschluß Heizung Lambdasonde2 hinter Kat nach UB (Endstufe)" UWORD B_TRUE 1 100 0 1 BIT_MASK 0x100 FUNCTION_LIST DFPM_DEKON IF_DATA DIM_X 0x383894 EXTERN BYTE IF_DATA MCMESS 0x383894 EXTERN /end MEASUREMENT
/begin MEASUREMENT B_mxhsv "Kurzschluß Heizung Lambdasonde vor Kat nach UB" UWORD B_TRUE 1 100 0 1 BIT_MASK 0x100 FUNCTION_LIST DFPM_DHLSU IF_DATA DIM_X 0x383896 EXTERN BYTE IF_DATA MCMESS 0x383896 EXTERN /end MEASUREMENT
/begin MEASUREMENT B_mxhsv2 "Kurzschluß Heizung Lambdasonde2 vor Kat nach UB" UWORD B_TRUE 1 100 0 1 BIT_MASK 0x100 FUNCTION_LIST DFPM_DHLSU IF_DATA DIM_X 0x383898 EXTERN BYTE IF_DATA MCMESS 0x383898 EXTERN /end MEASUREMENT
/begin MEASUREMENT B_mxhsvsa "Max-Fehler erkannt" UWORD B_TRUE 1 100 0 1 BIT_MASK 0x100 FUNCTION_LIST DFPM_DHLSU IF_DATA DIM_X 0x38389A EXTERN BYTE IF_DATA MCMESS 0x38389A EXTERN /end MEASUREMENT
/begin MEASUREMENT B_mxhsvsa2 "Max-Fehler erkannt Bank 2" UWORD B_TRUE 1 100 0 1 BIT_MASK 0x100 FUNCTION_LIST DFPM_DHLSU IF_DATA DIM_X 0x38389C EXTERN BYTE IF_DATA MCMESS 0x38389C EXTERN /end MEASUREMENT
/begin MEASUREMENT B_mxkat "Bedingung obere Plausibilitätsschwelle überschritten" UWORD B_TRUE 1 100 0 1 BIT_MASK 0x100 FUNCTION_LIST DFPM_DKAT IF_DATA DIM_X 0x38389E EXTERN BYTE IF_DATA MCMESS 0x38389E EXTERN /end MEASUREMENT
/begin MEASUREMENT B_mxkat2 "Bedingung obere Plausibilitätsschwelle überschritten (Stereo)" UWORD B_TRUE 1 100 0 1 BIT_MASK 0x100 FUNCTION_LIST DFPM_DKAT IF_DATA DIM_X 0x3838A0 EXTERN BYTE IF_DATA MCMESS 0x3838A0 EXTERN /end MEASUREMENT
/begin MEASUREMENT B_mxkos "Fehlertype: Kurzschluß nach Ubatt Endstufe Klimakompressor" UWORD B_TRUE 1 100 0 1 BIT_MASK 0x100 FUNCTION_LIST DFPM_DEKON IF_DATA DIM_X 0x3838A2 EXTERN BYTE IF_DATA MCMESS 0x3838A2 EXTERN /end MEASUREMENT
/begin MEASUREMENT B_mxkpe "Fehlertyp Kurzschluß nach Ubat für EKP-Relais Endstufe erkannt" UWORD B_TRUE 1 100 0 1 BIT_MASK 0x100 FUNCTION_LIST DFPM_DEKON IF_DATA DIM_X 0x3838A4 EXTERN BYTE IF_DATA MCMESS 0x3838A4 EXTERN /end MEASUREMENT
/begin MEASUREMENT B_mxkrnt "Fehlertyp max.: Klopfregelung Nulltest" UWORD B_TRUE 1 100 0 1 BIT_MASK 0x100 FUNCTION_LIST DFPM_DKRNT IF_DATA DIM_X 0x3838A6 EXTERN BYTE IF_DATA MCMESS 0x3838A6 EXTERN /end MEASUREMENT
/begin MEASUREMENT B_mxkrof "Fehlertyp max.: Klopfregelung Offset" UWORD B_TRUE 1 100 0 1 BIT_MASK 0x100 FUNCTION_LIST DFPM_DKRNT IF_DATA DIM_X 0x3838A8 EXTERN BYTE IF_DATA MCMESS 0x3838A8 EXTERN /end MEASUREMENT
/begin MEASUREMENT B_mxkrtp "Fehlertyp max.: Klopfregelung Testimpuls" UWORD B_TRUE 1 100 0 1 BIT_MASK 0x100 FUNCTION_LIST DFPM_DKRTP IF_DATA DIM_X 0x3838AA EXTERN BYTE IF_DATA MCMESS 0x3838AA EXTERN /end MEASUREMENT
/begin MEASUREMENT B_mxks1 "Bedingung: Max-Fehler Klopfsensor 1" UWORD B_TRUE 1 100 0 1 BIT_MASK 0x100 FUNCTION_LIST DFPM_DKRS IF_DATA DIM_X 0x3838AC EXTERN BYTE IF_DATA MCMESS 0x3838AC EXTERN /end MEASUREMENT
/begin MEASUREMENT B_mxks2 "Bedingung: Max-Fehler Klopfsensor 2" UWORD B_TRUE 1 100 0 1 BIT_MASK 0x100 FUNCTION_LIST DFPM_DKRS IF_DATA DIM_X 0x3838AE EXTERN BYTE IF_DATA MCMESS 0x3838AE EXTERN /end MEASUREMENT
/begin MEASUREMENT B_mxks3 "Bedingung: Max-Fehler Klopfsensor 3" UWORD B_TRUE 1 100 0 1 BIT_MASK 0x100 FUNCTION_LIST DFPM_DKRS IF_DATA DIM_X 0x3838B0 EXTERN BYTE IF_DATA MCMESS 0x3838B0 EXTERN /end MEASUREMENT
/begin MEASUREMENT B_mxks4 "Bedingung: Max-Fehler Klopfsensor 4" UWORD B_TRUE 1 100 0 1 BIT_MASK 0x100 FUNCTION_LIST DFPM_DKRS IF_DATA DIM_X 0x3838B2 EXTERN BYTE IF_DATA MCMESS 0x3838B2 EXTERN /end MEASUREMENT
/begin MEASUREMENT B_mxkuppl "Fehlertyp KUPPL: Maximalwert überschritten" UWORD B_TRUE 1 100 0 1 BIT_MASK 0x100 FUNCTION_LIST DFPM_DKUPPL IF_DATA DIM_X 0x3838B4 EXTERN BYTE IF_DATA MCMESS 0x3838B4 EXTERN /end MEASUREMENT
/begin MEASUREMENT B_mxkwave "Fehlertype: Kurzschluß nach Ubat Kühlwasserabsperrventil Endstufe" UWORD B_TRUE 1 100 0 1 BIT_MASK 0x100 FUNCTION_LIST DFPM_DEKON IF_DATA DIM_X 0x3838B6 EXTERN BYTE IF_DATA MCMESS 0x3838B6 EXTERN /end MEASUREMENT
/begin MEASUREMENT B_mxlash "Fehlertyp 'Maximalwert' für Schwingungs-Prüfung hinter KAT erkannt" UWORD B_TRUE 1 100 0 1 BIT_MASK 0x100 FUNCTION_LIST DFPM_DLSAHK IF_DATA DIM_X 0x3838B8 EXTERN BYTE IF_DATA MCMESS 0x3838B8 EXTERN /end MEASUREMENT
/begin MEASUREMENT B_mxlash2 "Fehlertyp 'Maximalwert' für Schwingungs-Prüfung hinter KAT erkannt Bank2" UWORD B_TRUE 1 100 0 1 BIT_MASK 0x100 FUNCTION_LIST DFPM_DLSAHK IF_DATA DIM_X 0x3838BA EXTERN BYTE IF_DATA MCMESS 0x3838BA EXTERN /end MEASUREMENT
/begin MEASUREMENT B_mxlde "Fehlertyp: Kurzschluß Ubat LDR-Taktventil" UWORD B_TRUE 1 100 0 1 BIT_MASK 0x100 FUNCTION_LIST DFPM_DEKON IF_DATA DIM_X 0x3838BC EXTERN BYTE IF_DATA MCMESS 0x3838BC EXTERN /end MEASUREMENT
/begin MEASUREMENT B_mxldo "Bedingung MAX-Fehler Fehlerpfad ldo" UWORD B_TRUE 1 100 0 1 BIT_MASK 0x100 FUNCTION_LIST DFPM_DLDR IF_DATA DIM_X 0x3838BE EXTERN BYTE IF_DATA MCMESS 0x3838BE EXTERN /end MEASUREMENT
/begin MEASUREMENT B_mxldra "Bedingung Max-Fehler Fehlerpfad ldra" UWORD B_TRUE 1 100 0 1 BIT_MASK 0x100 FUNCTION_LIST DFPM_DLDR IF_DATA DIM_X 0x3838C0 EXTERN BYTE IF_DATA MCMESS 0x3838C0 EXTERN /end MEASUREMENT
/begin MEASUREMENT B_mxlf1e "Fehlertype: Kurzschluß nach Ubat Lüfter1 Endstufe" UWORD B_TRUE 1 100 0 1 BIT_MASK 0x100 FUNCTION_LIST DFPM_DEKON IF_DATA DIM_X 0x3838C2 EXTERN BYTE IF_DATA MCMESS 0x3838C2 EXTERN /end MEASUREMENT
/begin MEASUREMENT B_mxlf2e "Fehlertype: Kurzschluß nach Ubat Lüfter2 Endstufe" UWORD B_TRUE 1 100 0 1 BIT_MASK 0x100 FUNCTION_LIST DFPM_DEKON IF_DATA DIM_X 0x3838C4 EXTERN BYTE IF_DATA MCMESS 0x3838C4 EXTERN /end MEASUREMENT
/begin MEASUREMENT B_mxlf3e "Fehlertype: Kurzschluß nach Ubat Lüfter3 Endstufe" UWORD B_TRUE 1 100 0 1 BIT_MASK 0x100 FUNCTION_LIST DFPM_DEKON IF_DATA DIM_X 0x3838C6 EXTERN BYTE IF_DATA MCMESS 0x3838C6 EXTERN /end MEASUREMENT
/begin MEASUREMENT B_mxllr "Fehler 'Leerlaufdrehzahl zu groß'" UWORD B_TRUE 1 100 0 1 BIT_MASK 0x100 FUNCTION_LIST DFPM_DLLR IF_DATA DIM_X 0x3838C8 EXTERN BYTE IF_DATA MCMESS 0x3838C8 EXTERN /end MEASUREMENT
/begin MEASUREMENT B_mxlm "Bedingung: max-Fehler Hauptfüllungssensor" UWORD B_TRUE 1 100 0 1 BIT_MASK 0x100 FUNCTION_LIST DFPM_DHFM IF_DATA DIM_X 0x3838CA EXTERN BYTE IF_DATA MCMESS 0x3838CA EXTERN /end MEASUREMENT
/begin MEASUREMENT B_mxlsh "Fehlertyp 'Maximalwert' hinter KAT erkannt" UWORD B_TRUE 1 100 0 1 BIT_MASK 0x100 FUNCTION_LIST DFPM_DLSH IF_DATA DIM_X 0x3838CC EXTERN BYTE IF_DATA MCMESS 0x3838CC EXTERN /end MEASUREMENT
/begin MEASUREMENT B_mxlsh2 "Fehlertyp 'Maximalwert' hinter KAT erkannt Bank2" UWORD B_TRUE 1 100 0 1 BIT_MASK 0x100 FUNCTION_LIST DFPM_DLSH IF_DATA DIM_X 0x3838CE EXTERN BYTE IF_DATA MCMESS 0x3838CE EXTERN /end MEASUREMENT
/begin MEASUREMENT B_mxlsv "Fehlertyp 'Maximalwert' vor KAT erkannt" UWORD B_TRUE 1 100 0 1 BIT_MASK 0x100 FUNCTION_LIST DFPM_DLSU IF_DATA DIM_X 0x3838D0 EXTERN BYTE IF_DATA MCMESS 0x3838D0 EXTERN /end MEASUREMENT
/begin MEASUREMENT B_mxlsv2 "Fehlertyp 'Maximalwert' vor KAT erkannt Bank2" UWORD B_TRUE 1 100 0 1 BIT_MASK 0x100 FUNCTION_LIST DFPM_DLSU IF_DATA DIM_X 0x3838D2 EXTERN BYTE IF_DATA MCMESS 0x3838D2 EXTERN /end MEASUREMENT
/begin MEASUREMENT B_mxlsvv "MAX-Fehler: Vertauschte Lambda-Sonden" UWORD B_TRUE 1 100 0 1 BIT_MASK 0x100 FUNCTION_LIST DFPM_LSVV IF_DATA DIM_X 0x3838D4 EXTERN BYTE IF_DATA MCMESS 0x3838D4 EXTERN /end MEASUREMENT
/begin MEASUREMENT B_mxmd "Fehlertyp max.: Aussetzer, Summenfehler (multiple)" UWORD B_TRUE 1 100 0 1 BIT_MASK 0x100 FUNCTION_LIST DFPM_DMDMIL IF_DATA DIM_X 0x3838D6 EXTERN BYTE IF_DATA MCMESS 0x3838D6 EXTERN /end MEASUREMENT
/begin MEASUREMENT B_mxmd00 "Fehlertyp max.: Aussetzer Zündung 0" UWORD B_TRUE 1 100 0 1 BIT_MASK 0x100 FUNCTION_LIST DFPM_DMDMIL IF_DATA DIM_X 0x3838D8 EXTERN BYTE IF_DATA MCMESS 0x3838D8 EXTERN /end MEASUREMENT
/begin MEASUREMENT B_mxmd01 "Fehlertyp max.: Aussetzer Zündung 1" UWORD B_TRUE 1 100 0 1 BIT_MASK 0x100 FUNCTION_LIST DFPM_DMDMIL IF_DATA DIM_X 0x3838DA EXTERN BYTE IF_DATA MCMESS 0x3838DA EXTERN /end MEASUREMENT
/begin MEASUREMENT B_mxmd02 "Fehlertyp max.: Aussetzer Zündung 2" UWORD B_TRUE 1 100 0 1 BIT_MASK 0x100 FUNCTION_LIST DFPM_DMDMIL IF_DATA DIM_X 0x3838DC EXTERN BYTE IF_DATA MCMESS 0x3838DC EXTERN /end MEASUREMENT
/begin MEASUREMENT B_mxmd03 "Fehlertyp max.: Aussetzer Zündung 3" UWORD B_TRUE 1 100 0 1 BIT_MASK 0x100 FUNCTION_LIST DFPM_DMDMIL IF_DATA DIM_X 0x3838DE EXTERN BYTE IF_DATA MCMESS 0x3838DE EXTERN /end MEASUREMENT
/begin MEASUREMENT B_mxmd04 "Fehlertyp max.: Aussetzer Zündung 4" UWORD B_TRUE 1 100 0 1 BIT_MASK 0x100 FUNCTION_LIST DFPM_DMDMIL IF_DATA DIM_X 0x3838E0 EXTERN BYTE IF_DATA MCMESS 0x3838E0 EXTERN /end MEASUREMENT
/begin MEASUREMENT B_mxmd05 "Fehlertyp max.: Aussetzer Zündung 5" UWORD B_TRUE 1 100 0 1 BIT_MASK 0x100 FUNCTION_LIST DFPM_DMDMIL IF_DATA DIM_X 0x3838E2 EXTERN BYTE IF_DATA MCMESS 0x3838E2 EXTERN /end MEASUREMENT
/begin MEASUREMENT B_mxmdb "Fehlerart: Maximal zulässiges Sollmoment wird dauerhaft überschritten" UWORD B_TRUE 1 100 0 1 BIT_MASK 0x100 FUNCTION_LIST DFPM_MDKOG IF_DATA DIM_X 0x3838E4 EXTERN BYTE IF_DATA MCMESS 0x3838E4 EXTERN /end MEASUREMENT
/begin MEASUREMENT B_mxmsg "Fehlertype: Wert überschritten Motorraumspülgebläse" UWORD B_TRUE 1 100 0 1 BIT_MASK 0x100 FUNCTION_LIST DFPM_MLS IF_DATA DIM_X 0x3838E6 EXTERN BYTE IF_DATA MCMESS 0x3838E6 EXTERN /end MEASUREMENT
/begin MEASUREMENT B_mxmsge "Fehlertype:Kurzschluß nach Ubat Motorraumspülgebläse Endstufe" UWORD B_TRUE 1 100 0 1 BIT_MASK 0x100 FUNCTION_LIST DFPM_DEKON IF_DATA DIM_X 0x3838E8 EXTERN BYTE IF_DATA MCMESS 0x3838E8 EXTERN /end MEASUREMENT
/begin MEASUREMENT B_mxn "Fehlerart: häufiger Lückenverlust beim Lückencheck" UWORD B_TRUE 1 100 0 1 BIT_MASK 0x100 FUNCTION_LIST DFPM_DDG IF_DATA DIM_X 0x3838EA EXTERN BYTE IF_DATA MCMESS 0x3838EA EXTERN /end MEASUREMENT
/begin MEASUREMENT B_mxnwkw "Fehlerart: Nockenwelle frühverstellt" UWORD B_TRUE 1 100 0 1 BIT_MASK 0x100 FUNCTION_LIST DFPM_DNWKW IF_DATA DIM_X 0x3838EC EXTERN BYTE IF_DATA MCMESS 0x3838EC EXTERN /end MEASUREMENT
/begin MEASUREMENT B_mxnwkw2 "Fehlerart: Nockenwelle 2 frühverstellt" UWORD B_TRUE 1 100 0 1 BIT_MASK 0x100 FUNCTION_LIST DFPM_DNWKW IF_DATA DIM_X 0x3838EE EXTERN BYTE IF_DATA MCMESS 0x3838EE EXTERN /end MEASUREMENT
/begin MEASUREMENT B_mxnws "Fehlerart: Nockenwellenverstellung Spätposition nicht erreicht" UWORD B_TRUE 1 100 0 1 BIT_MASK 0x100 FUNCTION_LIST DFPM_DNWS IF_DATA DIM_X 0x3838F0 EXTERN BYTE IF_DATA MCMESS 0x3838F0 EXTERN /end MEASUREMENT
/begin MEASUREMENT B_mxnws2 "Fehlerart: Nockenwellenverstellung 2 Spätposition nicht erreicht" UWORD B_TRUE 1 100 0 1 BIT_MASK 0x100 FUNCTION_LIST DFPM_DNWS IF_DATA DIM_X 0x3838F2 EXTERN BYTE IF_DATA MCMESS 0x3838F2 EXTERN /end MEASUREMENT
/begin MEASUREMENT B_mxnwse "Fehlerart: Kurzschluß Ubat Nockenwellensteuerungsventil Endstufe" UWORD B_TRUE 1 100 0 1 BIT_MASK 0x100 FUNCTION_LIST DFPM_DEKON IF_DATA DIM_X 0x3838F4 EXTERN BYTE IF_DATA MCMESS 0x3838F4 EXTERN /end MEASUREMENT
/begin MEASUREMENT B_mxnwse2 "Fehlertype: Kurzschluss nach Ubat Nockenwellensteuerung Bank2 Endstufe" UWORD B_TRUE 1 100 0 1 BIT_MASK 0x100 FUNCTION_LIST DFPM_DEKON IF_DATA DIM_X 0x3838F6 EXTERN BYTE IF_DATA MCMESS 0x3838F6 EXTERN /end MEASUREMENT
/begin MEASUREMENT B_mxph "Fehlerart: Kurzschluß Ubat Phasengeber" UWORD B_TRUE 1 100 0 1 BIT_MASK 0x100 FUNCTION_LIST DFPM_DPH IF_DATA DIM_X 0x3838F8 EXTERN BYTE IF_DATA MCMESS 0x3838F8 EXTERN /end MEASUREMENT
/begin MEASUREMENT B_mxph2 "Fehlerart: Kurzschluß  Ubat Phasengeber 2" UWORD B_TRUE 1 100 0 1 BIT_MASK 0x100 FUNCTION_LIST DFPM_DPH IF_DATA DIM_X 0x3838FA EXTERN BYTE IF_DATA MCMESS 0x3838FA EXTERN /end MEASUREMENT
/begin MEASUREMENT B_mxrkat "Bedingung obere Plausibilitätsschwelle überschritten (add. pro Zeit)" UWORD B_TRUE 1 100 0 1 BIT_MASK 0x100 FUNCTION_LIST DFPM_DKVS IF_DATA DIM_X 0x3838FC EXTERN BYTE IF_DATA MCMESS 0x3838FC EXTERN /end MEASUREMENT
/begin MEASUREMENT B_mxrkat2 "Bedingung obere Plausibilitätsschwelle überschritten (Stereo)" UWORD B_TRUE 1 100 0 1 BIT_MASK 0x100 FUNCTION_LIST DFPM_DKVS IF_DATA DIM_X 0x3838FE EXTERN BYTE IF_DATA MCMESS 0x3838FE EXTERN /end MEASUREMENT
/begin MEASUREMENT B_mxrkaz "Bedingung obere Plausibilitätsschwelle überschritten (add. pro Zündung)" UWORD B_TRUE 1 100 0 1 BIT_MASK 0x100 FUNCTION_LIST DFPM_DKVS IF_DATA DIM_X 0x383900 EXTERN BYTE IF_DATA MCMESS 0x383900 EXTERN /end MEASUREMENT
/begin MEASUREMENT B_mxrkaz2 "Bedingung obere Plausibilitätsschwelle überschritten (Stereo)" UWORD B_TRUE 1 100 0 1 BIT_MASK 0x100 FUNCTION_LIST DFPM_DKVS IF_DATA DIM_X 0x383902 EXTERN BYTE IF_DATA MCMESS 0x383902 EXTERN /end MEASUREMENT
/begin MEASUREMENT B_mxrlroh "Bedingung maximal Auswahl für rlroh ist erfüllt" UWORD B_TRUE 1 100 0 1 BIT_MASK 0x2000 FUNCTION_LIST BGMSZS BGSRM IF_DATA DIM_X 0xFD46 INTERN BYTE IF_DATA MCMESS 0xFD46 INTERN /end MEASUREMENT
/begin MEASUREMENT B_mxsgeep "" UWORD B_TRUE 1 100 0 1 BIT_MASK 0x100 FUNCTION_LIST DFPM_DSGEEP IF_DATA DIM_X 0x383904 EXTERN BYTE IF_DATA MCMESS 0x383904 EXTERN /end MEASUREMENT
/begin MEASUREMENT B_mxslpe "Fehlertype: Kurzschluß nach Ubatt Endstufe Sekundärluftpumpe" UWORD B_TRUE 1 100 0 1 BIT_MASK 0x100 FUNCTION_LIST DFPM_DEKON IF_DATA DIM_X 0x383906 EXTERN BYTE IF_DATA MCMESS 0x383906 EXTERN /end MEASUREMENT
/begin MEASUREMENT B_mxsls "Fehlerart:Sekundärluftsystem" UWORD B_TRUE 1 100 0 1 BIT_MASK 0x100 FUNCTION_LIST DFPM_DSLSLRS IF_DATA DIM_X 0x383908 EXTERN BYTE IF_DATA MCMESS 0x383908 EXTERN /end MEASUREMENT
/begin MEASUREMENT B_mxsls2 "Fehlerart:Sekundärluftsystem Bank 2" UWORD B_TRUE 1 100 0 1 BIT_MASK 0x100 FUNCTION_LIST DFPM_DSLSLRS IF_DATA DIM_X 0x38390A EXTERN BYTE IF_DATA MCMESS 0x38390A EXTERN /end MEASUREMENT
/begin MEASUREMENT B_mxslv "Fehlerart: Sekundärluftmasse bei Ventildichtheitsprüfung zu groß" UWORD B_TRUE 1 100 0 1 BIT_MASK 0x100 FUNCTION_LIST DFPM_DSLSLRS IF_DATA DIM_X 0x38390C EXTERN BYTE IF_DATA MCMESS 0x38390C EXTERN /end MEASUREMENT
/begin MEASUREMENT B_mxslv2 "Fehlerart: Sekundärluftmasse bei Ventildichtheitsprüfung zu groß, Bank 2" UWORD B_TRUE 1 100 0 1 BIT_MASK 0x100 FUNCTION_LIST DFPM_DSLSLRS IF_DATA DIM_X 0x38390E EXTERN BYTE IF_DATA MCMESS 0x38390E EXTERN /end MEASUREMENT
/begin MEASUREMENT B_mxslve "Fehlertype: Kurzschluß nach Masse Endstufe Sekundärluftventil" UWORD B_TRUE 1 100 0 1 BIT_MASK 0x100 FUNCTION_LIST DFPM_DEKON IF_DATA DIM_X 0x383910 EXTERN BYTE IF_DATA MCMESS 0x383910 EXTERN /end MEASUREMENT
/begin MEASUREMENT B_mxslvpr "Fehlerart lokal: Sekundärluftmasse bei Ventildichtheitsprüfung zu groß" UBYTE B_TRUE 1 100 0 1 BIT_MASK 0x40 FUNCTION_LIST DSLSLRS IF_DATA DIM_X 0x380905 EXTERN BYTE IF_DATA MCMESS 0x380905 EXTERN /end MEASUREMENT
/begin MEASUREMENT B_mxslvpr2 "Fehlerart lokal: Sekundärluftmasse bei Ventildichtheitsprüfung zu groß, Bank 2" UBYTE B_TRUE 1 100 0 1 BIT_MASK 0x20 FUNCTION_LIST DSLSLRS IF_DATA DIM_X 0x380906 EXTERN BYTE IF_DATA MCMESS 0x380906 EXTERN /end MEASUREMENT
/begin MEASUREMENT B_mxswe "Beschleunigungssensorsignal größer als Plausibilitätsschwelle" UWORD B_TRUE 1 100 0 1 BIT_MASK 0x100 FUNCTION_LIST DFPM_BGRBS IF_DATA DIM_X 0x383912 EXTERN BYTE IF_DATA MCMESS 0x383912 EXTERN /end MEASUREMENT
/begin MEASUREMENT B_mxta "Fehlertyp: Maximalwertüberschreitung Ansauglufttemperatur TANS" UWORD B_TRUE 1 100 0 1 BIT_MASK 0x100 FUNCTION_LIST DFPM_GGTFA IF_DATA DIM_X 0x383914 EXTERN BYTE IF_DATA MCMESS 0x383914 EXTERN /end MEASUREMENT
/begin MEASUREMENT B_mxtes "Fehlertyp 'Maximalwert' erkannt (Tankentlüftungsventil)" UWORD B_TRUE 1 100 0 1 BIT_MASK 0x100 FUNCTION_LIST DFPM_DTEV IF_DATA DIM_X 0x383916 EXTERN BYTE IF_DATA MCMESS 0x383916 EXTERN /end MEASUREMENT
/begin MEASUREMENT B_mxteve "Fehlertyp: Kurzschluß Ubat Tankentlüftungsventil Endstufe" UWORD B_TRUE 1 100 0 1 BIT_MASK 0x100 FUNCTION_LIST DFPM_DEKON IF_DATA DIM_X 0x383918 EXTERN BYTE IF_DATA MCMESS 0x383918 EXTERN /end MEASUREMENT
/begin MEASUREMENT B_mxtget "Fehlertyp: Maximalwertüberschreitung Getriebetemperatur" UWORD B_TRUE 1 100 0 1 BIT_MASK 0x100 FUNCTION_LIST DFPM_GGTGET IF_DATA DIM_X 0x38391C EXTERN BYTE IF_DATA MCMESS 0x38391C EXTERN /end MEASUREMENT
/begin MEASUREMENT B_mxthm "" UWORD B_TRUE 1 100 0 1 BIT_MASK 0x100 FUNCTION_LIST DFPM_GGTFM IF_DATA DIM_X 0x38391E EXTERN BYTE IF_DATA MCMESS 0x38391E EXTERN /end MEASUREMENT
/begin MEASUREMENT B_mxtm "Fehlertyp: Maximalwertüberschreitung Motortemperatur" UWORD B_TRUE 1 100 0 1 BIT_MASK 0x100 FUNCTION_LIST DFPM_GGTFM IF_DATA DIM_X 0x383920 EXTERN BYTE IF_DATA MCMESS 0x383920 EXTERN /end MEASUREMENT
/begin MEASUREMENT B_mxtmki "Bedingung: Max-Fehler Motortemperatur aus Kombiinstrument" UWORD B_TRUE 1 100 0 1 BIT_MASK 0x100 FUNCTION_LIST DFPM_DUMMY043 IF_DATA DIM_X 0x383922 EXTERN BYTE IF_DATA MCMESS 0x383922 EXTERN /end MEASUREMENT
/begin MEASUREMENT B_mxtmr "Fehlertyp: Maximalwertüberschreitung Motorraumtemperatur TMR" UWORD B_TRUE 1 100 0 1 BIT_MASK 0x100 FUNCTION_LIST DFPM_GGTFMR IF_DATA DIM_X 0x383924 EXTERN BYTE IF_DATA MCMESS 0x383924 EXTERN /end MEASUREMENT
/begin MEASUREMENT B_mxtol "Fehlertyp: Maximalwertüberschreitung (Motor-) Oeltemperatur" UWORD B_TRUE 1 100 0 1 BIT_MASK 0x100 FUNCTION_LIST DFPM_GGTFOL IF_DATA DIM_X 0x383926 EXTERN BYTE IF_DATA MCMESS 0x383926 EXTERN /end MEASUREMENT
/begin MEASUREMENT B_mxtum "Fehlertyp: Maximalwertüberschreitung Umgebungstemperatur" UWORD B_TRUE 1 100 0 1 BIT_MASK 0x100 FUNCTION_LIST DFPM_GGTFUMG IF_DATA DIM_X 0x383928 EXTERN BYTE IF_DATA MCMESS 0x383928 EXTERN /end MEASUREMENT
/begin MEASUREMENT B_mxub "Fehlertyp: Maximalwertüberschreitung Batteriespannung (Bordnetz)" UWORD B_TRUE 1 100 0 1 BIT_MASK 0x100 FUNCTION_LIST DFPM_GGUB IF_DATA DIM_X 0x38392A EXTERN BYTE IF_DATA MCMESS 0x38392A EXTERN /end MEASUREMENT
/begin MEASUREMENT B_mxufmv "Fehlertyp max.: Funktionsüberwachung: Momentenvergleich" UWORD B_TRUE 1 100 0 1 BIT_MASK 0x100 FUNCTION_LIST DFPM_DUF IF_DATA DIM_X 0x38392C EXTERN BYTE IF_DATA MCMESS 0x38392C EXTERN /end MEASUREMENT
/begin MEASUREMENT B_mxufska "Fehlertyp max.: Funktionsüberwachung: Sicherheits-Kraftstoff-Abschaltung" UWORD B_TRUE 1 100 0 1 BIT_MASK 0x100 FUNCTION_LIST DFPM_DUF IF_DATA DIM_X 0x38392E EXTERN BYTE IF_DATA MCMESS 0x38392E EXTERN /end MEASUREMENT
/begin MEASUREMENT B_mxurram "Fehlertyp max.: Rechnerüberwachung: RAM" UWORD B_TRUE 1 100 0 1 BIT_MASK 0x100 FUNCTION_LIST DFPM_DUR IF_DATA DIM_X 0x383930 EXTERN BYTE IF_DATA MCMESS 0x383930 EXTERN /end MEASUREMENT
/begin MEASUREMENT B_mxurrom "Fehlertyp max.: Rechnerüberwachung: ROM" UWORD B_TRUE 1 100 0 1 BIT_MASK 0x100 FUNCTION_LIST DFPM_DUR IF_DATA DIM_X 0x383932 EXTERN BYTE IF_DATA MCMESS 0x383932 EXTERN /end MEASUREMENT
/begin MEASUREMENT B_mxurrst "Fehlertyp max.: Rechnerüberwachung: Reset" UWORD B_TRUE 1 100 0 1 BIT_MASK 0x100 FUNCTION_LIST DFPM_DUR IF_DATA DIM_X 0x383934 EXTERN BYTE IF_DATA MCMESS 0x383934 EXTERN /end MEASUREMENT
/begin MEASUREMENT B_mxuvse "Fehlertyp: Kurzschluß Ubat Umluftventil Turbo" UWORD B_TRUE 1 100 0 1 BIT_MASK 0x100 FUNCTION_LIST DFPM_DEKON IF_DATA DIM_X 0x383936 EXTERN BYTE IF_DATA MCMESS 0x383936 EXTERN /end MEASUREMENT
/begin MEASUREMENT B_mxvfz "Fehlertyp max.: Fahrzeuggeschwindigkeit" UWORD B_TRUE 1 100 0 1 BIT_MASK 0x100 FUNCTION_LIST DFPM_DVFZ IF_DATA DIM_X 0x383938 EXTERN BYTE IF_DATA MCMESS 0x383938 EXTERN /end MEASUREMENT
/begin MEASUREMENT B_mxvs01 "Fehlerart: Ventilhub Zdg.1 bleibt auf groß" UWORD B_TRUE 1 100 0 1 BIT_MASK 0x100 FUNCTION_LIST DFPM_DVS IF_DATA DIM_X 0x38393A EXTERN BYTE IF_DATA MCMESS 0x38393A EXTERN /end MEASUREMENT
/begin MEASUREMENT B_mxvs02 "Fehlerart: Ventilhub Zdg.2 bleibt auf groß" UWORD B_TRUE 1 100 0 1 BIT_MASK 0x100 FUNCTION_LIST DFPM_DVS IF_DATA DIM_X 0x38393C EXTERN BYTE IF_DATA MCMESS 0x38393C EXTERN /end MEASUREMENT
/begin MEASUREMENT B_mxvs03 "Fehlerart: Ventilhub Zdg.3 bleibt auf groß" UWORD B_TRUE 1 100 0 1 BIT_MASK 0x100 FUNCTION_LIST DFPM_DVS IF_DATA DIM_X 0x38393E EXTERN BYTE IF_DATA MCMESS 0x38393E EXTERN /end MEASUREMENT
/begin MEASUREMENT B_mxvs04 "Fehlerart: Ventilhub Zdg.4 bleibt auf groß" UWORD B_TRUE 1 100 0 1 BIT_MASK 0x100 FUNCTION_LIST DFPM_DVS IF_DATA DIM_X 0x383940 EXTERN BYTE IF_DATA MCMESS 0x383940 EXTERN /end MEASUREMENT
/begin MEASUREMENT B_mxvs05 "Fehlerart: Ventilhub Zdg.5 bleibt auf groß" UWORD B_TRUE 1 100 0 1 BIT_MASK 0x100 FUNCTION_LIST DFPM_DVS IF_DATA DIM_X 0x383942 EXTERN BYTE IF_DATA MCMESS 0x383942 EXTERN /end MEASUREMENT
/begin MEASUREMENT B_mxvs06 "Fehlerart: Ventilhub Zdg.6 bleibt auf groß" UWORD B_TRUE 1 100 0 1 BIT_MASK 0x100 FUNCTION_LIST DFPM_DVS IF_DATA DIM_X 0x383944 EXTERN BYTE IF_DATA MCMESS 0x383944 EXTERN /end MEASUREMENT
/begin MEASUREMENT B_mxvs1e "Fehlertype: Kurzschluß nach Ubat Endstufe Ventilstuerung 1" UWORD B_TRUE 1 100 0 1 BIT_MASK 0x100 FUNCTION_LIST DFPM_DEKON IF_DATA DIM_X 0x383946 EXTERN BYTE IF_DATA MCMESS 0x383946 EXTERN /end MEASUREMENT
/begin MEASUREMENT B_mxvs2e "Fehlertype: Kurzschluß nach Ubat Endstufe Ventilsteurung 2" UWORD B_TRUE 1 100 0 1 BIT_MASK 0x100 FUNCTION_LIST DFPM_DEKON IF_DATA DIM_X 0x383948 EXTERN BYTE IF_DATA MCMESS 0x383948 EXTERN /end MEASUREMENT
/begin MEASUREMENT B_mxvsb1 "Fehlertype: Ventilhub bleibt auf gross (Bankselektiv)" UWORD B_TRUE 1 100 0 1 BIT_MASK 0x100 FUNCTION_LIST DFPM_DVS IF_DATA DIM_X 0x38394A EXTERN BYTE IF_DATA MCMESS 0x38394A EXTERN /end MEASUREMENT
/begin MEASUREMENT B_mxvsb2 "Fehlertype: Ventilhub bleibt auf gross (Bankselektiv)" UWORD B_TRUE 1 100 0 1 BIT_MASK 0x100 FUNCTION_LIST DFPM_DVS IF_DATA DIM_X 0x38394C EXTERN BYTE IF_DATA MCMESS 0x38394C EXTERN /end MEASUREMENT
/begin MEASUREMENT B_mxvss "Fehlertype: Ventilhub bleibt auf groß (Summenfehler)" UWORD B_TRUE 1 100 0 1 BIT_MASK 0x100 FUNCTION_LIST DFPM_DVS IF_DATA DIM_X 0x38394E EXTERN BYTE IF_DATA MCMESS 0x38394E EXTERN /end MEASUREMENT
/begin MEASUREMENT B_mxwfs "Fehlertyp max.: Wegfahrsperre" UWORD B_TRUE 1 100 0 1 BIT_MASK 0x100 FUNCTION_LIST DFPM_WFS IF_DATA DIM_X 0x383950 EXTERN BYTE IF_DATA MCMESS 0x383950 EXTERN /end MEASUREMENT
/begin MEASUREMENT B_mzns "Nachstartaufweitung des zul. Moments aktiv" UWORD B_TRUE 1 100 0 1 BIT_MASK 0x1 FUNCTION_LIST MDZUL IF_DATA DIM_X 0xFD70 INTERN BYTE IF_DATA MCMESS 0xFD70 INTERN /end MEASUREMENT
/begin MEASUREMENT b_mzns_c "Bedingung Nachstartaufweitung des Momentenvergleichs im Master-SG (über CAN)" UBYTE B_TRUE 1 100 0 1 BIT_MASK 0x20 FUNCTION_LIST UFURAM IF_DATA DIM_X 0x382E44 EXTERN WORD IF_DATA MCMESS 0x382E44 EXTERN /end MEASUREMENT
/begin MEASUREMENT B_mzns_um "Nachstartaufweitung des zuläsigen Moments in der Funktonsüberwachung aktiv" UWORD B_TRUE 1 100 0 1 BIT_MASK 0x4000 FUNCTION_LIST UFNSC MDZUL IF_DATA DIM_X 0xFD76 INTERN BYTE IF_DATA MCMESS 0xFD76 INTERN /end MEASUREMENT
/begin MEASUREMENT B_nac "Bedingung für erhöhte LL-Drehzahl bei Klimaanlage" UWORD B_TRUE 1 100 0 1 BIT_MASK 0x800 FUNCTION_LIST KOS LLRNS IF_DATA DIM_X 0xFD90 INTERN BYTE IF_DATA MCMESS 0xFD90 INTERN /end MEASUREMENT
/begin MEASUREMENT B_nachl "Steuerung SG-Nachlauf" UWORD B_TRUE 1 100 0 1 BIT_MASK 0x8000 FUNCTION_LIST MOTAUS AZUE V7804X_T WANWKW IF_DATA DIM_X 0x383A22 EXTERN BYTE IF_DATA MCMESS 0x383A22 EXTERN /end MEASUREMENT
/begin MEASUREMENT B_nachlend "Bedingung SG-Nachlauf regulär beendet" UWORD B_TRUE 1 100 0 1 BIT_MASK 0x4000 FUNCTION_LIST MOTAUS AEKP ATM IF_DATA DIM_X 0x383A22 EXTERN BYTE IF_DATA MCMESS 0x383A22 EXTERN /end MEASUREMENT
/begin MEASUREMENT B_nachlram "Steuerung SG-Nachlauf mit Systemcheck" UWORD B_TRUE 1 100 0 1 BIT_MASK 0x400 FUNCTION_LIST MOTAUS IF_DATA DIM_X 0xFD70 INTERN BYTE IF_DATA MCMESS 0xFD70 INTERN /end MEASUREMENT
/begin MEASUREMENT B_nachlstp "Bedingung SG-Nachlauf beendet" UWORD B_TRUE 1 100 0 1 BIT_MASK 0x2000 FUNCTION_LIST MOTAUS BGTABS IF_DATA DIM_X 0x383A22 EXTERN BYTE IF_DATA MCMESS 0x383A22 EXTERN /end MEASUREMENT
/begin MEASUREMENT B_nesch "Bedingung Sondenspannung keinen Fehler (no Error) im Schub" UBYTE B_TRUE 1 100 0 1 BIT_MASK 0x8 FUNCTION_LIST DLSAHK IF_DATA DIM_X 0x380A7B EXTERN BYTE IF_DATA MCMESS 0x380A7B EXTERN /end MEASUREMENT
/begin MEASUREMENT B_nesch2 "Bedingung Sondenspannung keinen Fehler (no Error) im Schub Bank2" UBYTE B_TRUE 1 100 0 1 BIT_MASK 0x10 FUNCTION_LIST DLSAHK IF_DATA DIM_X 0x380A7B EXTERN BYTE IF_DATA MCMESS 0x380A7B EXTERN /end MEASUREMENT
/begin MEASUREMENT B_nftev "Bedingung Drehzahlanhebung für erhöhte TE-Spülrate" UWORD B_TRUE 1 100 0 1 BIT_MASK 0x400 FUNCTION_LIST SWADP LLRNS IF_DATA DIM_X 0xFD84 INTERN BYTE IF_DATA MCMESS 0xFD84 INTERN /end MEASUREMENT
/begin MEASUREMENT B_ngasok "Bedingung Ringspeicher für ngas-Berechnung ok" UWORD B_TRUE 1 100 0 1 BIT_MASK 0x400 FUNCTION_LIST BGNG BGRLG IF_DATA DIM_X 0xFD10 INTERN BYTE IF_DATA MCMESS 0xFD10 INTERN /end MEASUREMENT
/begin MEASUREMENT B_nlacls "Anforderung Steuergerätenachlauf von AC-Lüftersteuerung" UWORD B_TRUE 1 100 0 1 BIT_MASK 0x2 FUNCTION_LIST MOTAUS IF_DATA DIM_X 0x383A22 EXTERN BYTE IF_DATA MCMESS 0x383A22 EXTERN /end MEASUREMENT
/begin MEASUREMENT B_nlale "Anforderung Steuergerätenachlauf von Funktion ALE" UWORD B_TRUE 1 100 0 1 BIT_MASK 0x1 FUNCTION_LIST MOTAUS ALE IF_DATA DIM_X 0x383A22 EXTERN BYTE IF_DATA MCMESS 0x383A22 EXTERN /end MEASUREMENT
/begin MEASUREMENT B_nlatm "Anforderung Steuergerätenachlauf für Abgastemp.Modell Sondenschutz" UWORD B_TRUE 1 100 0 1 BIT_MASK 0x800 FUNCTION_LIST MOTAUS ATM IF_DATA DIM_X 0x383A22 EXTERN BYTE IF_DATA MCMESS 0x383A22 EXTERN /end MEASUREMENT
/begin MEASUREMENT B_nlbm "Bedingung für NLDG wenn Bezugsmarke häufig verloren wird" UWORD B_TRUE 1 100 0 1 BIT_MASK 0x1000 FUNCTION_LIST DDG IF_DATA DIM_X 0xFD10 INTERN BYTE IF_DATA MCMESS 0xFD10 INTERN /end MEASUREMENT
/begin MEASUREMENT B_nlcan "Bedingung für SG-Nachlauf von CAN" UWORD B_TRUE 1 100 0 1 BIT_MASK 0x200 FUNCTION_LIST MOTAUS IF_DATA DIM_X 0x383A22 EXTERN BYTE IF_DATA MCMESS 0x383A22 EXTERN /end MEASUREMENT
/begin MEASUREMENT B_nldg "Bedingung Drehzahlgeber-Notlauf" UWORD B_TRUE 1 100 0 1 BIT_MASK 0x2000 FUNCTION_LIST DDG ALE DKRS DLLR DMDSTP DPH DTEV ESUKAS GGDPG LLRNS MDEX NLDG NLPH NMAXMD NWS PHAS WANWKW IF_DATA DIM_X 0xFD10 INTERN BYTE IF_DATA MCMESS 0xFD10 INTERN /end MEASUREMENT
/begin MEASUREMENT B_nldte "Anforderung Steuergerätenachlauf Diagnose Tankentlüftung" UWORD B_TRUE 1 100 0 1 BIT_MASK 0x100 FUNCTION_LIST MOTAUS IF_DATA DIM_X 0x383A22 EXTERN BYTE IF_DATA MCMESS 0x383A22 EXTERN /end MEASUREMENT
/begin MEASUREMENT B_nlEEPR "Bedingung Nachlauf EEPROM schreiben" UWORD B_TRUE 1 100 0 1 BIT_MASK 0x20 FUNCTION_LIST MOTAUS _EEPROM IF_DATA DIM_X 0x383A22 EXTERN BYTE IF_DATA MCMESS 0x383A22 EXTERN /end MEASUREMENT
/begin MEASUREMENT B_nletm "Bedingung Nachlauf tmot-Fehler" UWORD B_TRUE 1 100 0 1 BIT_MASK 0x1000 FUNCTION_LIST MOTAUS GGTFM IF_DATA DIM_X 0x383A22 EXTERN BYTE IF_DATA MCMESS 0x383A22 EXTERN /end MEASUREMENT
/begin MEASUREMENT B_nlmls "Anforderung Steuergerätenachlauf von Motor-Lüftersteuerung" UWORD B_TRUE 1 100 0 1 BIT_MASK 0x8 FUNCTION_LIST MOTAUS MLS IF_DATA DIM_X 0x383A22 EXTERN BYTE IF_DATA MCMESS 0x383A22 EXTERN /end MEASUREMENT
/begin MEASUREMENT B_nlnlpl "Bedingung: Verriegelungsbit NLP-Lernen im SG-Nachlauf" UWORD B_TRUE 1 100 0 1 BIT_MASK 0x4000 FUNCTION_LIST BGDVE IF_DATA DIM_X 0xFD36 INTERN BYTE IF_DATA MCMESS 0xFD36 INTERN /end MEASUREMENT
/begin MEASUREMENT B_nlnobm "Bedingung für NLDG wenn keine Bezugsmarke gefunden wurde" UWORD B_TRUE 1 100 0 1 BIT_MASK 0x4000 FUNCTION_LIST DDG IF_DATA DIM_X 0xFD10 INTERN BYTE IF_DATA MCMESS 0xFD10 INTERN /end MEASUREMENT
/begin MEASUREMENT B_nlnon "Bedingung für NLDG wenn keine Zahnsignale vorhanden sind" UWORD B_TRUE 1 100 0 1 BIT_MASK 0x8000 FUNCTION_LIST DDG IF_DATA DIM_X 0xFD10 INTERN BYTE IF_DATA MCMESS 0xFD10 INTERN /end MEASUREMENT
/begin MEASUREMENT B_nlobd "Anforderung Steuergerätenachlauf von OBD" UWORD B_TRUE 1 100 0 1 BIT_MASK 0x10 FUNCTION_LIST MOTAUS IF_DATA DIM_X 0x383A22 EXTERN BYTE IF_DATA MCMESS 0x383A22 EXTERN /end MEASUREMENT
/begin MEASUREMENT B_nlpe "Bedingung: Fehler in NLP-Prüfung u. -Lernen" UWORD B_TRUE 1 100 0 1 BIT_MASK 0x8000 FUNCTION_LIST BGDVE DDVE T2DVE IF_DATA DIM_X 0xFD36 INTERN BYTE IF_DATA MCMESS 0xFD36 INTERN /end MEASUREMENT
/begin MEASUREMENT B_nlperf "Dauer-RAM, Bedingung: NLP-Erfassung erfolgreich" UBYTE B_TRUE 1 100 0 1 BIT_MASK 0x2 FUNCTION_LIST BGDVE DDVE IF_DATA DIM_X 0x382FF7 EXTERN BYTE IF_DATA MCMESS 0x382FF7 EXTERN /end MEASUREMENT
/begin MEASUREMENT B_nlperft "Dauer-RAM, Bedingung: NLP-Erfassung teilweise erfolgreich, temp. Zustand" UBYTE B_TRUE 1 100 0 1 BIT_MASK 0x4 FUNCTION_LIST BGDVE IF_DATA DIM_X 0x382FF7 EXTERN BYTE IF_DATA MCMESS 0x382FF7 EXTERN /end MEASUREMENT
/begin MEASUREMENT B_nlph "Bedingung kein Phasensignal von den Phasengebern" UWORD B_TRUE 1 100 0 1 BIT_MASK 0x1 FUNCTION_LIST NLPH GGDPG IF_DATA DIM_X 0xFD1A INTERN BYTE IF_DATA MCMESS 0xFD1A INTERN /end MEASUREMENT
/begin MEASUREMENT B_nlphdly "Bed. Verzögerung für Stimulibit bei Notlauf Phasengeber (für Trommeleintrag)" UWORD B_TRUE 1 100 0 1 BIT_MASK 0x200 FUNCTION_LIST DMDTSB IF_DATA DIM_X 0xFD0E INTERN BYTE IF_DATA MCMESS 0xFD0E INTERN /end MEASUREMENT
/begin MEASUREMENT B_nlphea "Ev-Abschaltung für Notlauf Phasensynchronisation aktiv" UWORD B_TRUE 1 100 0 1 BIT_MASK 0x200 FUNCTION_LIST AEVAB NLPH IF_DATA DIM_X 0xFD4C INTERN BYTE IF_DATA MCMESS 0xFD4C INTERN /end MEASUREMENT
/begin MEASUREMENT B_nlpheai "Ev-Abschaltung für Notlauf Phasensynchronisation aktiv AEVAB intern" UWORD B_TRUE 1 100 0 1 BIT_MASK 0x400 FUNCTION_LIST AEVAB IF_DATA DIM_X 0xFD4C INTERN BYTE IF_DATA MCMESS 0xFD4C INTERN /end MEASUREMENT
/begin MEASUREMENT B_nlpne "Bedingung: Bei gefordertem DK-Notluftfahren wurde NLP nicht erreicht" UWORD B_TRUE 1 100 0 1 BIT_MASK 0x4000 FUNCTION_LIST ADVE SREAKT IF_DATA DIM_X 0xFD32 INTERN BYTE IF_DATA MCMESS 0xFD32 INTERN /end MEASUREMENT
/begin MEASUREMENT B_nlpnew "Bedingung: NLP-Position ist noch nicht bekannt" UWORD B_TRUE 1 100 0 1 BIT_MASK 0x1 FUNCTION_LIST BGDVE DDVE IF_DATA DIM_X 0xFD38 INTERN BYTE IF_DATA MCMESS 0xFD38 INTERN /end MEASUREMENT
/begin MEASUREMENT B_nlpreq "Bedingung: NLP-Lernen anfordern" UWORD B_TRUE 1 100 0 1 BIT_MASK 0x2 FUNCTION_LIST BGDVE IF_DATA DIM_X 0xFD38 INTERN BYTE IF_DATA MCMESS 0xFD38 INTERN /end MEASUREMENT
/begin MEASUREMENT B_nlsg1 "Erkennung auf SG-Nachlauf, 1. Durchlauf" UWORD B_TRUE 1 100 0 1 BIT_MASK 0x2 FUNCTION_LIST MLS IF_DATA DIM_X 0xFDE8 INTERN BYTE IF_DATA MCMESS 0xFDE8 INTERN /end MEASUREMENT
/begin MEASUREMENT B_nlsgls "Anforderung Steuergerätenachlauf von Steuergeräte-Lüftersteuerung" UWORD B_TRUE 1 100 0 1 BIT_MASK 0x40 FUNCTION_LIST MOTAUS IF_DATA DIM_X 0x383A22 EXTERN BYTE IF_DATA MCMESS 0x383A22 EXTERN /end MEASUREMENT
/begin MEASUREMENT B_nlsiko "Bedingung Nachlauf EGAS-Überwachung" UWORD B_TRUE 1 100 0 1 BIT_MASK 0x80 FUNCTION_LIST MOTAUS URROM IF_DATA DIM_X 0x383A22 EXTERN BYTE IF_DATA MCMESS 0x383A22 EXTERN /end MEASUREMENT
/begin MEASUREMENT B_nlwfs "SG-Bedingung SG-Nachlauf durch Wegfahrsperrensteuergerät" UWORD B_TRUE 1 100 0 1 BIT_MASK 0x400 FUNCTION_LIST MOTAUS WFS IF_DATA DIM_X 0x383A22 EXTERN BYTE IF_DATA MCMESS 0x383A22 EXTERN /end MEASUREMENT
/begin MEASUREMENT B_nlwst "Anforderung Steuergerätenachlauf für Wiederholstarterkennung" UWORD B_TRUE 1 100 0 1 BIT_MASK 0x4 FUNCTION_LIST MOTAUS BGTABS IF_DATA DIM_X 0x383A22 EXTERN BYTE IF_DATA MCMESS 0x383A22 EXTERN /end MEASUREMENT
/begin MEASUREMENT B_nmax "Bedingung Drehzahlbegrenzung aktiv" UWORD B_TRUE 1 100 0 1 BIT_MASK 0x8 FUNCTION_LIST NMAXMD MDRED1 IF_DATA DIM_X 0xFD70 INTERN BYTE IF_DATA MCMESS 0xFD70 INTERN /end MEASUREMENT
/begin MEASUREMENT B_nmaxanm "Drehzahl begrenzt bei Anfahrvorgang Handschalter" UWORD B_TRUE 1 100 0 1 BIT_MASK 0x10 FUNCTION_LIST NMAXMD IF_DATA DIM_X 0xFD70 INTERN BYTE IF_DATA MCMESS 0xFD70 INTERN /end MEASUREMENT
/begin MEASUREMENT B_nmaxd "Bedingung Drehzahlbegrenzung mit Einspritzausblendung an allen Zylindern" UWORD B_TRUE 1 100 0 1 BIT_MASK 0x20 FUNCTION_LIST NMAXMD AEVABU IF_DATA DIM_X 0xFD70 INTERN BYTE IF_DATA MCMESS 0xFD70 INTERN /end MEASUREMENT
/begin MEASUREMENT B_nmaxkns "Drehzahl durch Knallstart begrenzt" UWORD B_TRUE 1 100 0 1 BIT_MASK 0x40 FUNCTION_LIST NMAXMD IF_DATA DIM_X 0xFD70 INTERN BYTE IF_DATA MCMESS 0xFD70 INTERN /end MEASUREMENT
/begin MEASUREMENT B_nmaxo "Bedingung Maximaldrehzahl obere Schwelle überschritten" UWORD B_TRUE 1 100 0 1 BIT_MASK 0x80 FUNCTION_LIST AMUENE IF_DATA DIM_X 0xFD10 INTERN BYTE IF_DATA MCMESS 0xFD10 INTERN /end MEASUREMENT
/begin MEASUREMENT B_nmaxpn "Drehzahl begrenzt während Gang einlegen Automat" UWORD B_TRUE 1 100 0 1 BIT_MASK 0x80 FUNCTION_LIST NMAXMD IF_DATA DIM_X 0xFD70 INTERN BYTE IF_DATA MCMESS 0xFD70 INTERN /end MEASUREMENT
/begin MEASUREMENT B_nmaxu "Bedingung Maximaldrehzahl untere Schwelle überschritten" UWORD B_TRUE 1 100 0 1 BIT_MASK 0x100 FUNCTION_LIST AMUENE IF_DATA DIM_X 0xFD10 INTERN BYTE IF_DATA MCMESS 0xFD10 INTERN /end MEASUREMENT
/begin MEASUREMENT B_nmin "Bedingung Unterdrehzahl: n < NMIN" UWORD B_TRUE 1 100 0 1 BIT_MASK 0x1000 FUNCTION_LIST GGDPG AEKP BGNMOT BGTABS DDG ESSTT GGTFM IF_DATA DIM_X 0xFD12 INTERN BYTE IF_DATA MCMESS 0xFD12 INTERN /end MEASUREMENT
/begin MEASUREMENT B_nmot "Bedingung Motordrehzahl: n > NMIN" UWORD B_TRUE 1 100 0 1 BIT_MASK 0x2000 FUNCTION_LIST GGDPG ADVE ALE ATM BBKHZ BBSTT BBTEGA BGTMPK DCGE DHLSHK DLLR DLSH DLSU DMIL DSLSLRS DTOP GGDSAS GGTFM HLSU LLRBB MDFAW MLS SLS STA T2DFA TEB IF_DATA DIM_X 0xFD12 INTERN BYTE IF_DATA MCMESS 0xFD12 INTERN /end MEASUREMENT
/begin MEASUREMENT B_nnot "Bedingung Drehzahlanhebung im Notlauf" UWORD B_TRUE 1 100 0 1 BIT_MASK 0x800 FUNCTION_LIST SWADP LLRNS IF_DATA DIM_X 0xFD84 INTERN BYTE IF_DATA MCMESS 0xFD84 INTERN /end MEASUREMENT
/begin MEASUREMENT B_no "unendlich-Trigger für Fehlerpfadmanagement" UBYTE B_TRUE 1 100 0 1 BIT_MASK 0x1 FUNCTION_LIST DFPM IF_DATA DIM_X 0x382FC7 EXTERN WORD IF_DATA MCMESS 0x382FC7 EXTERN /end MEASUREMENT
/begin MEASUREMENT B_noadsh "Bedingung kein Adernschluß bei Lambdasonden hinter Kat" UBYTE B_TRUE 1 100 0 1 BIT_MASK 0x40 FUNCTION_LIST DLSH IF_DATA DIM_X 0x380A81 EXTERN BYTE IF_DATA MCMESS 0x380A81 EXTERN /end MEASUREMENT
/begin MEASUREMENT B_noadsh2 "Bedingung kein Adernschluß bei Lambdasonden hinter Kat Bank2" UBYTE B_TRUE 1 100 0 1 BIT_MASK 0x80 FUNCTION_LIST DLSH IF_DATA DIM_X 0x380A81 EXTERN BYTE IF_DATA MCMESS 0x380A81 EXTERN /end MEASUREMENT
/begin MEASUREMENT B_noasr "Bedingung ASR/MSR-eingriff verboten" UWORD B_TRUE 1 100 0 1 BIT_MASK 0x1000 FUNCTION_LIST SWADP CAN IF_DATA DIM_X 0xFD84 INTERN BYTE IF_DATA MCMESS 0xFD84 INTERN /end MEASUREMENT
/begin MEASUREMENT B_nobm "Bedingung BM-Lücke nach > 60 Zähnen nicht gefunden" UWORD B_TRUE 1 100 0 1 BIT_MASK 0x4000 FUNCTION_LIST GGDPG IF_DATA DIM_X 0xFD12 INTERN BYTE IF_DATA MCMESS 0xFD12 INTERN /end MEASUREMENT
/begin MEASUREMENT B_nobm1 "Bedingung 1. BM-Lücke nach Synchronisation nicht gefunden" UBYTE B_TRUE 1 100 0 1 BIT_MASK 0x1 FUNCTION_LIST GGDPG IF_DATA DIM_X 0x382FDB EXTERN BYTE IF_DATA MCMESS 0x382FDB EXTERN /end MEASUREMENT
/begin MEASUREMENT B_nobmflr1 "Es liegen keine Bezugsmarkenverluste vor" UWORD B_TRUE 1 100 0 1 BIT_MASK 0x1 FUNCTION_LIST DDG IF_DATA DIM_X 0xFD12 INTERN BYTE IF_DATA MCMESS 0xFD12 INTERN /end MEASUREMENT
/begin MEASUREMENT B_nobmflr2 "Bezugsmarke wurde im Start richtig erkannt" UWORD B_TRUE 1 100 0 1 BIT_MASK 0x2 FUNCTION_LIST DDG IF_DATA DIM_X 0xFD12 INTERN BYTE IF_DATA MCMESS 0xFD12 INTERN /end MEASUREMENT
/begin MEASUREMENT B_nobrs_um "Bremsenbotschaft in der Funktionsüberwachung nicht übernommen" UBYTE B_TRUE 1 100 0 1 BIT_MASK 0x2 FUNCTION_LIST UFURAM IF_DATA DIM_X 0x382E40 EXTERN WORD IF_DATA MCMESS 0x382E40 EXTERN /end MEASUREMENT
/begin MEASUREMENT B_nocorflr "Es wurden keine Zahnkorrekturen vorgenommen" UWORD B_TRUE 1 100 0 1 BIT_MASK 0x4 FUNCTION_LIST DDG IF_DATA DIM_X 0xFD12 INTERN BYTE IF_DATA MCMESS 0xFD12 INTERN /end MEASUREMENT
/begin MEASUREMENT B_nodec "Bedingung kein Dekrementieren des Startadaptionsfactors innerhalb dieses Starts" UWORD B_TRUE 1 100 0 1 BIT_MASK 0x400 FUNCTION_LIST STADAP IF_DATA DIM_X 0x382370 EXTERN BYTE IF_DATA MCMESS 0x382370 EXTERN /end MEASUREMENT
/begin MEASUREMENT B_nofra "Bedingung Sperren der multiplikativen Gemischkorrektur" UWORD B_TRUE 1 100 0 1 BIT_MASK 0x2000 FUNCTION_LIST LRA DKVS IF_DATA DIM_X 0xFD5A INTERN BYTE IF_DATA MCMESS 0xFD5A INTERN /end MEASUREMENT
/begin MEASUREMENT B_noinc "Bedingung kein Inkrementieren des Startadaptionsfaktors innerhalb dieses Starts" UWORD B_TRUE 1 100 0 1 BIT_MASK 0x800 FUNCTION_LIST STADAP IF_DATA DIM_X 0x382370 EXTERN BYTE IF_DATA MCMESS 0x382370 EXTERN /end MEASUREMENT
/begin MEASUREMENT B_nokatfz "Bedingung Nicht-KAT Fahrzeug" UWORD B_TRUE 1 100 0 1 BIT_MASK 0x2000 FUNCTION_LIST SWADP GGTFM IF_DATA DIM_X 0xFD84 INTERN BYTE IF_DATA MCMESS 0xFD84 INTERN /end MEASUREMENT
/begin MEASUREMENT B_noknldg "Drehzahl ist in zulässigem Fenster für Synchronisation im Notlauf" UWORD B_TRUE 1 100 0 1 BIT_MASK 0x2 FUNCTION_LIST NLDG IF_DATA DIM_X 0xFD18 INTERN BYTE IF_DATA MCMESS 0xFD18 INTERN /end MEASUREMENT
/begin MEASUREMENT B_nolash "Bedingung Diagnosefunktion Schwingungs-Prüfung. i.O.-Meldung beendet." UWORD B_TRUE 1 100 0 1 BIT_MASK 0x200 FUNCTION_LIST DLSAHK IF_DATA DIM_X 0xFD26 INTERN BYTE IF_DATA MCMESS 0xFD26 INTERN /end MEASUREMENT
/begin MEASUREMENT B_nolash2 "Bedingung Diagnosefunktion Schwingungs-Prüfung. i.O.-Meldung beendet. Bank2" UWORD B_TRUE 1 100 0 1 BIT_MASK 0x400 FUNCTION_LIST DLSAHK IF_DATA DIM_X 0xFD26 INTERN BYTE IF_DATA MCMESS 0xFD26 INTERN /end MEASUREMENT
/begin MEASUREMENT B_noll "Bedingung B_ll wird nicht in die Bildung der Drehzahldynamik eingerechnet" UWORD B_TRUE 1 100 0 1 BIT_MASK 0x1000 FUNCTION_LIST KRDY IF_DATA DIM_X 0xFD62 INTERN BYTE IF_DATA MCMESS 0xFD62 INTERN /end MEASUREMENT
/begin MEASUREMENT B_nollrflr "Bedingung LLR-Diagnosefunktion mit i.O.-Meldung beendet." UWORD B_TRUE 1 100 0 1 BIT_MASK 0x80 FUNCTION_LIST DLLR IF_DATA DIM_X 0xFD68 INTERN BYTE IF_DATA MCMESS 0xFD68 INTERN /end MEASUREMENT
/begin MEASUREMENT B_nolrb "CARB FREEZE FRAME, Bank1 Bit 2, LR: Steuerbetrieb durch Betriebsbedingungen" UBYTE B_TRUE 1 100 0 1 BIT_MASK 0x4 FUNCTION_LIST LRSEB IF_DATA DIM_X 0x380C8A EXTERN BYTE IF_DATA MCMESS 0x380C8A EXTERN /end MEASUREMENT
/begin MEASUREMENT B_nolrb2 "CARB FREEZE FRAME, Bank2 Bit 2, LR: Steuerung durch Betriebsbedingung" UBYTE B_TRUE 1 100 0 1 BIT_MASK 0x4 FUNCTION_LIST LRSEB IF_DATA DIM_X 0x380C8B EXTERN BYTE IF_DATA MCMESS 0x380C8B EXTERN /end MEASUREMENT
/begin MEASUREMENT B_nolre "CARB FREEZE FRAME, Bank1 Bit 3, LR: Steuerung nach Systemfehler" UBYTE B_TRUE 1 100 0 1 BIT_MASK 0x8 FUNCTION_LIST LRSEB IF_DATA DIM_X 0x380C8A EXTERN BYTE IF_DATA MCMESS 0x380C8A EXTERN /end MEASUREMENT
/begin MEASUREMENT B_nolre2 "CARB FREEZE FRAME, Bank2 Bit 3, LR: Steuerung nach Systemfehler" UBYTE B_TRUE 1 100 0 1 BIT_MASK 0x8 FUNCTION_LIST LRSEB IF_DATA DIM_X 0x380C8B EXTERN BYTE IF_DATA MCMESS 0x380C8B EXTERN /end MEASUREMENT
/begin MEASUREMENT B_nolrw "CARB FREEZE FRAME, Bank1 Bit 0, LR: Steuerbetrieb, Startbed. noch nicht erfüllt" UBYTE B_TRUE 1 100 0 1 BIT_MASK 0x1 FUNCTION_LIST LRSEB IF_DATA DIM_X 0x380C8A EXTERN BYTE IF_DATA MCMESS 0x380C8A EXTERN /end MEASUREMENT
/begin MEASUREMENT B_nolrw2 "CARB FREEZE FRAME, Bank2 Bit 0, LR: Steuerbetrieb, Startbed. noch nicht erfüllt" UBYTE B_TRUE 1 100 0 1 BIT_MASK 0x1 FUNCTION_LIST LRSEB IF_DATA DIM_X 0x380C8B EXTERN BYTE IF_DATA MCMESS 0x380C8B EXTERN /end MEASUREMENT
/begin MEASUREMENT B_nolsh "Bedingung Diagnosefunktion mit i.O.-Meldung hinter KAT beendet." UWORD B_TRUE 1 100 0 1 BIT_MASK 0x400 FUNCTION_LIST DLSH IF_DATA DIM_X 0xFD28 INTERN BYTE IF_DATA MCMESS 0xFD28 INTERN /end MEASUREMENT
/begin MEASUREMENT B_nolsh2 "Bedingung Diagnosefunktion mit i.O.-Meldung hinter KAT beendet Bank2" UWORD B_TRUE 1 100 0 1 BIT_MASK 0x800 FUNCTION_LIST DLSH IF_DATA DIM_X 0xFD28 INTERN BYTE IF_DATA MCMESS 0xFD28 INTERN /end MEASUREMENT
/begin MEASUREMENT B_nomsr_uc "MSR-Momentenvorgabe im Befehlstest nicht übernommen" UWORD B_TRUE 1 100 0 1 BIT_MASK 0x2000 FUNCTION_LIST URCMSRC IF_DATA DIM_X 0xFD78 INTERN BYTE IF_DATA MCMESS 0xFD78 INTERN /end MEASUREMENT
/begin MEASUREMENT B_nomsr_um "MSR-Momentenvorgabe in der Funktionsüberwachung nicht übernommen" UWORD B_TRUE 1 100 0 1 BIT_MASK 0x40 FUNCTION_LIST UFMSRC CAN DUF MDEX IF_DATA DIM_X 0xFD78 INTERN BYTE IF_DATA MCMESS 0xFD78 INTERN /end MEASUREMENT
/begin MEASUREMENT B_nonwsmdb "Bedingung NW-Stellung spät erzwungen wegen Momentenaufbaubegr. vfzg-abh." UWORD B_TRUE 1 100 0 1 BIT_MASK 0x200 FUNCTION_LIST MDBGV NWS IF_DATA DIM_X 0xFD6C INTERN BYTE IF_DATA MCMESS 0xFD6C INTERN /end MEASUREMENT
/begin MEASUREMENT B_noph "Phasengebersignal nicht gefunden" UWORD B_TRUE 1 100 0 1 BIT_MASK 0x8000 FUNCTION_LIST GGDPG IF_DATA DIM_X 0xFD12 INTERN BYTE IF_DATA MCMESS 0xFD12 INTERN /end MEASUREMENT
/begin MEASUREMENT B_noph2 "2. Phasengebersignal nicht gefunden" UWORD B_TRUE 1 100 0 1 BIT_MASK 0x1 FUNCTION_LIST GGDPG IF_DATA DIM_X 0xFD14 INTERN BYTE IF_DATA MCMESS 0xFD14 INTERN /end MEASUREMENT
/begin MEASUREMENT B_nophnldg "Bedingung kein Phasengebersignal für Notlauf Drehzahlgeber verwendbar" UWORD B_TRUE 1 100 0 1 BIT_MASK 0x8 FUNCTION_LIST DPH DDG IF_DATA DIM_X 0xFD12 INTERN BYTE IF_DATA MCMESS 0xFD12 INTERN /end MEASUREMENT
/begin MEASUREMENT B_norkam "Bedingung additive Korrektur der Adaption pro Zeit oder Zündung abgeschaltet" UWORD B_TRUE 1 100 0 1 BIT_MASK 0x80 FUNCTION_LIST DKVS IF_DATA DIM_X 0xFD52 INTERN BYTE IF_DATA MCMESS 0xFD52 INTERN /end MEASUREMENT
/begin MEASUREMENT B_norkat "Bedingung additive Korrektur der Gemischadaption pro Zeit abgeschaltet" UWORD B_TRUE 1 100 0 1 BIT_MASK 0x4000 FUNCTION_LIST LRA DKVS IF_DATA DIM_X 0xFD5A INTERN BYTE IF_DATA MCMESS 0xFD5A INTERN /end MEASUREMENT
/begin MEASUREMENT B_norkaz "Bedingung additive Korrektur der Gemischadaption pro Zündung abgeschaltet" UWORD B_TRUE 1 100 0 1 BIT_MASK 0x8000 FUNCTION_LIST LRA DKVS IF_DATA DIM_X 0xFD5A INTERN BYTE IF_DATA MCMESS 0xFD5A INTERN /end MEASUREMENT
/begin MEASUREMENT B_nosynph "Flag für falsche Zylinderzuordnung bei Synchronisierlücke" UWORD B_TRUE 1 100 0 1 BIT_MASK 0x2 FUNCTION_LIST NLPH GGDPG SYNC71 IF_DATA DIM_X 0xFD1A INTERN BYTE IF_DATA MCMESS 0xFD1A INTERN /end MEASUREMENT
/begin MEASUREMENT B_notlu "Anforderung Notluftfahren aus der Funktion" UBYTE B_TRUE 1 100 0 1 BIT_MASK 0x8 FUNCTION_LIST UFURAM IF_DATA DIM_X 0x382E42 EXTERN WORD IF_DATA MCMESS 0x382E42 EXTERN /end MEASUREMENT
/begin MEASUREMENT B_notlu_fr "Anforderung Notluftfahren vom Funktionsrechner" UWORD B_TRUE 1 100 0 1 BIT_MASK 0x4 FUNCTION_LIST SREAKT DUF UFEING URADCC IF_DATA DIM_X 0xFD3E INTERN BYTE IF_DATA MCMESS 0xFD3E INTERN /end MEASUREMENT
/begin MEASUREMENT B_nowuc "Bedingung 'kein warm up cycle' erkannt" UWORD B_TRUE 1 100 0 1 BIT_MASK 0x4 FUNCTION_LIST DWUC IF_DATA DIM_X 0xFD10 INTERN BYTE IF_DATA MCMESS 0xFD10 INTERN /end MEASUREMENT
/begin MEASUREMENT B_nozwe "Bedingung kein Zündwinkeleingriff der Drehmomentstruktur" UWORD B_TRUE 1 100 0 1 BIT_MASK 0x400 FUNCTION_LIST MDZW ZUE IF_DATA DIM_X 0xFD8E INTERN BYTE IF_DATA MCMESS 0xFD8E INTERN /end MEASUREMENT
/begin MEASUREMENT B_npaave "Fehlertyp 'unplausibles Prüfresultat' erkannt (Endstufe AAV)" UWORD B_TRUE 1 100 0 1 BIT_MASK 0x800 FUNCTION_LIST DFPM_DEKON IF_DATA DIM_X 0x383816 EXTERN BYTE IF_DATA MCMESS 0x383816 EXTERN /end MEASUREMENT
/begin MEASUREMENT B_npagre "Fehlerart: Abgasrückführungsventil Endstufe" UWORD B_TRUE 1 100 0 1 BIT_MASK 0x800 FUNCTION_LIST DFPM_DUMMY043 IF_DATA DIM_X 0x383818 EXTERN BYTE IF_DATA MCMESS 0x383818 EXTERN /end MEASUREMENT
/begin MEASUREMENT B_npbm "Fehlertyp: Bezugsmarkenfehler beim Lückencheck" UWORD B_TRUE 1 100 0 1 BIT_MASK 0x800 FUNCTION_LIST DFPM_DDG IF_DATA DIM_X 0x38381C EXTERN BYTE IF_DATA MCMESS 0x38381C EXTERN /end MEASUREMENT
/begin MEASUREMENT B_npbrems "Fehlertyp BREMS (Bremsschalter): Prüfresultat nicht plausibel" UWORD B_TRUE 1 100 0 1 BIT_MASK 0x800 FUNCTION_LIST DFPM_GGEGAS IF_DATA DIM_X 0x38381E EXTERN BYTE IF_DATA MCMESS 0x38381E EXTERN /end MEASUREMENT
/begin MEASUREMENT B_npbwf "Fehlertyp unplaus.: PWG Bewegung" UWORD B_TRUE 1 100 0 1 BIT_MASK 0x800 FUNCTION_LIST DFPM_GGPED IF_DATA DIM_X 0x383820 EXTERN BYTE IF_DATA MCMESS 0x383820 EXTERN /end MEASUREMENT
/begin MEASUREMENT B_npcas "Fehlertyp: CAN-Schnittstelle, Timeout ASC" UWORD B_TRUE 1 100 0 1 BIT_MASK 0x800 FUNCTION_LIST DFPM_DCAS IF_DATA DIM_X 0x383822 EXTERN BYTE IF_DATA MCMESS 0x383822 EXTERN /end MEASUREMENT
/begin MEASUREMENT B_npcge "Fehlerart:CAN-Schnittstelle, Timeout EGS" UWORD B_TRUE 1 100 0 1 BIT_MASK 0x800 FUNCTION_LIST DFPM_DCGE IF_DATA DIM_X 0x383824 EXTERN BYTE IF_DATA MCMESS 0x383824 EXTERN /end MEASUREMENT
/begin MEASUREMENT B_npcgegs "Fehlertype: Plaus.-Fehler EGS; Steuergerät" UWORD B_TRUE 1 100 0 1 BIT_MASK 0x800 FUNCTION_LIST DFPM_DCG IF_DATA DIM_X 0x383826 EXTERN BYTE IF_DATA MCMESS 0x383826 EXTERN /end MEASUREMENT
/begin MEASUREMENT B_npcgggp "Fehlertype: Plaus.-Fehler EGS; Gang unplausibel" UWORD B_TRUE 1 100 0 1 BIT_MASK 0x800 FUNCTION_LIST DFPM_DCG IF_DATA DIM_X 0x383828 EXTERN BYTE IF_DATA MCMESS 0x383828 EXTERN /end MEASUREMENT
/begin MEASUREMENT B_npcgggv "Fehlertype: Plaus.-Fehler EGS; Gangvergleich negativ" UWORD B_TRUE 1 100 0 1 BIT_MASK 0x800 FUNCTION_LIST DFPM_DCG IF_DATA DIM_X 0x38382A EXTERN BYTE IF_DATA MCMESS 0x38382A EXTERN /end MEASUREMENT
/begin MEASUREMENT B_npcgm1v "Fehlertype: Plaus.-Fehler EGS; Magnetventil 1-2/4-5 Schaltung" UWORD B_TRUE 1 100 0 1 BIT_MASK 0x800 FUNCTION_LIST DFPM_DCG IF_DATA DIM_X 0x38382C EXTERN BYTE IF_DATA MCMESS 0x38382C EXTERN /end MEASUREMENT
/begin MEASUREMENT B_npcgm2v "Fehlertype: Plaus.-Fehler EGS; Magnetventil 2-3 Schaltung" UWORD B_TRUE 1 100 0 1 BIT_MASK 0x800 FUNCTION_LIST DFPM_DCG IF_DATA DIM_X 0x38382E EXTERN BYTE IF_DATA MCMESS 0x38382E EXTERN /end MEASUREMENT
/begin MEASUREMENT B_npcgm3v "Fehlertype: Plaus.-Fehler EGS; Magnetventil 3-4 Schaltung" UWORD B_TRUE 1 100 0 1 BIT_MASK 0x800 FUNCTION_LIST DFPM_DCG IF_DATA DIM_X 0x383830 EXTERN BYTE IF_DATA MCMESS 0x383830 EXTERN /end MEASUREMENT
/begin MEASUREMENT B_npcgmvk "Fehlertype: Plaus.-Fehler EGS; Magnetventil Wandlerkupplung" UWORD B_TRUE 1 100 0 1 BIT_MASK 0x800 FUNCTION_LIST DFPM_DCG IF_DATA DIM_X 0x383832 EXTERN BYTE IF_DATA MCMESS 0x383832 EXTERN /end MEASUREMENT
/begin MEASUREMENT B_npcgrmm "Fehlertype: Plaus.-Fehler EGS; Regelmagnetventil Modulierdruck" UWORD B_TRUE 1 100 0 1 BIT_MASK 0x800 FUNCTION_LIST DFPM_DCG IF_DATA DIM_X 0x383834 EXTERN BYTE IF_DATA MCMESS 0x383834 EXTERN /end MEASUREMENT
/begin MEASUREMENT B_npcgrms "Fehlertype: Plaus.-Fehler EGS; Regelmagnetventil Schaltdruck" UWORD B_TRUE 1 100 0 1 BIT_MASK 0x800 FUNCTION_LIST DFPM_DCG IF_DATA DIM_X 0x383836 EXTERN BYTE IF_DATA MCMESS 0x383836 EXTERN /end MEASUREMENT
/begin MEASUREMENT B_npcgudg "Fehlertype: Plaus.-Fehler EGS; Versorgungsspannung Drehzahlsensoren" UWORD B_TRUE 1 100 0 1 BIT_MASK 0x800 FUNCTION_LIST DFPM_DCG IF_DATA DIM_X 0x383838 EXTERN BYTE IF_DATA MCMESS 0x383838 EXTERN /end MEASUREMENT
/begin MEASUREMENT B_npcgumv "Fehlertype: Plaus.-Fehler EGS; Versorgungsspannung Magnetventile" UWORD B_TRUE 1 100 0 1 BIT_MASK 0x800 FUNCTION_LIST DFPM_DCG IF_DATA DIM_X 0x38383A EXTERN BYTE IF_DATA MCMESS 0x38383A EXTERN /end MEASUREMENT
/begin MEASUREMENT B_npcgvgc "Fehlertype: Plaus.-Fehler EGS; Verteilergetr.-Stellung unplaus." UWORD B_TRUE 1 100 0 1 BIT_MASK 0x800 FUNCTION_LIST DFPM_DCG IF_DATA DIM_X 0x38383C EXTERN BYTE IF_DATA MCMESS 0x38383C EXTERN /end MEASUREMENT
/begin MEASUREMENT B_npcgvrc "Fehlertype: Plaus.-Fehler EGS; Raddrehzahl hinten unplausibel" UWORD B_TRUE 1 100 0 1 BIT_MASK 0x800 FUNCTION_LIST DFPM_DCG IF_DATA DIM_X 0x38383E EXTERN BYTE IF_DATA MCMESS 0x38383E EXTERN /end MEASUREMENT
/begin MEASUREMENT B_npcgwk "Fehlertype: Plaus.-Fehler EGS; Wandlerkupplung" UWORD B_TRUE 1 100 0 1 BIT_MASK 0x800 FUNCTION_LIST DFPM_DCG IF_DATA DIM_X 0x383840 EXTERN BYTE IF_DATA MCMESS 0x383840 EXTERN /end MEASUREMENT
/begin MEASUREMENT B_npckbi "Fehlertyp npl.: CAN-Schnittstelle, Timeout Botschaft Kombi" UWORD B_TRUE 1 100 0 1 BIT_MASK 0x800 FUNCTION_LIST DFPM_DCKBI IF_DATA DIM_X 0x383842 EXTERN BYTE IF_DATA MCMESS 0x383842 EXTERN /end MEASUREMENT
/begin MEASUREMENT B_npcmil "Fehlerart:MIL über CAN nicht plausibel" UWORD B_TRUE 1 100 0 1 BIT_MASK 0x800 FUNCTION_LIST DFPM_DCMIL IF_DATA DIM_X 0x383844 EXTERN BYTE IF_DATA MCMESS 0x383844 EXTERN /end MEASUREMENT
/begin MEASUREMENT B_npcra "Fehlertyp: nicht plausibles Signal vom Airbagsteuergerät" UWORD B_TRUE 1 100 0 1 BIT_MASK 0x800 FUNCTION_LIST DFPM_GGAIRBAG IF_DATA DIM_X 0x383846 EXTERN BYTE IF_DATA MCMESS 0x383846 EXTERN /end MEASUREMENT
/begin MEASUREMENT B_npdk "Bedingung unplausible Potisignale von der Drosselklappe" UWORD B_TRUE 1 100 0 1 BIT_MASK 0x800 FUNCTION_LIST DFPM_DDVE IF_DATA DIM_X 0x383848 EXTERN BYTE IF_DATA MCMESS 0x383848 EXTERN /end MEASUREMENT
/begin MEASUREMENT B_npdk1p "Fehlertyp unplaus.: Drosselklappe 1. Poti" UWORD B_TRUE 1 100 0 1 BIT_MASK 0x800 FUNCTION_LIST DFPM_DDVE IF_DATA DIM_X 0x38384A EXTERN BYTE IF_DATA MCMESS 0x38384A EXTERN /end MEASUREMENT
/begin MEASUREMENT B_npdk2p "Fehlertyp unplaus.: Drosselklappe 2. Poti" UWORD B_TRUE 1 100 0 1 BIT_MASK 0x800 FUNCTION_LIST DFPM_DDVE IF_DATA DIM_X 0x38384C EXTERN BYTE IF_DATA MCMESS 0x38384C EXTERN /end MEASUREMENT
/begin MEASUREMENT B_npdsl "Bedingung: Ladedrucksensor nicht plausibel" UWORD B_TRUE 1 100 0 1 BIT_MASK 0x800 FUNCTION_LIST DFPM_GGDSAS IF_DATA DIM_X 0x383850 EXTERN BYTE IF_DATA MCMESS 0x383850 EXTERN /end MEASUREMENT
/begin MEASUREMENT B_npdsu "Bedingung: Umgebungsdrucksensor nicht plausibel" UWORD B_TRUE 1 100 0 1 BIT_MASK 0x800 FUNCTION_LIST DFPM_GGDSAS IF_DATA DIM_X 0x383852 EXTERN BYTE IF_DATA MCMESS 0x383852 EXTERN /end MEASUREMENT
/begin MEASUREMENT B_npdsvlu "Bedingung: Drucksensorsignalvergleich nicht plausibel (DS-L DS-U)" UWORD B_TRUE 1 100 0 1 BIT_MASK 0x800 FUNCTION_LIST DFPM_GGDSAS IF_DATA DIM_X 0x383854 EXTERN BYTE IF_DATA MCMESS 0x383854 EXTERN /end MEASUREMENT
/begin MEASUREMENT B_npdvee "Fehlerzyp unplaus.: DV-E Endstufe" UWORD B_TRUE 1 100 0 1 BIT_MASK 0x800 FUNCTION_LIST DFPM_DDVE IF_DATA DIM_X 0x383856 EXTERN BYTE IF_DATA MCMESS 0x383856 EXTERN /end MEASUREMENT
/begin MEASUREMENT B_npdvef "Fehlertyp unplaus.: DV-E Fehler bei Federprüfung" UWORD B_TRUE 1 100 0 1 BIT_MASK 0x800 FUNCTION_LIST DFPM_DDVE IF_DATA DIM_X 0x383858 EXTERN BYTE IF_DATA MCMESS 0x383858 EXTERN /end MEASUREMENT
/begin MEASUREMENT B_npdvefo "" UWORD B_TRUE 1 100 0 1 BIT_MASK 0x800 FUNCTION_LIST DFPM_DDVE IF_DATA DIM_X 0x38385A EXTERN BYTE IF_DATA MCMESS 0x38385A EXTERN /end MEASUREMENT
/begin MEASUREMENT B_npdvel "Fehlerzyp unplaus.: DV-E Lageabweichung" UWORD B_TRUE 1 100 0 1 BIT_MASK 0x800 FUNCTION_LIST DFPM_DDVE IF_DATA DIM_X 0x38385C EXTERN BYTE IF_DATA MCMESS 0x38385C EXTERN /end MEASUREMENT
/begin MEASUREMENT B_npdven "Fehlertyp unplaus.: DV-E Fehler bei Prüfung Notluftposition" UWORD B_TRUE 1 100 0 1 BIT_MASK 0x800 FUNCTION_LIST DFPM_DDVE IF_DATA DIM_X 0x38385E EXTERN BYTE IF_DATA MCMESS 0x38385E EXTERN /end MEASUREMENT
/begin MEASUREMENT B_npdver "Fehlerzyp unplaus.: DV-E Regelbereich" UWORD B_TRUE 1 100 0 1 BIT_MASK 0x800 FUNCTION_LIST DFPM_DDVE IF_DATA DIM_X 0x383860 EXTERN BYTE IF_DATA MCMESS 0x383860 EXTERN /end MEASUREMENT
/begin MEASUREMENT B_npdvet "Fehlertyp ""unplausibel"": DV-E-Tauscherkennung ohne Adaption" UWORD B_TRUE 1 100 0 1 BIT_MASK 0x800 FUNCTION_LIST DFPM_DDVE IF_DATA DIM_X 0x383862 EXTERN BYTE IF_DATA MCMESS 0x383862 EXTERN /end MEASUREMENT
/begin MEASUREMENT B_npdveu "Fehlertyp unplaus.: DV-E Fehler beim UMA-Lernen" UWORD B_TRUE 1 100 0 1 BIT_MASK 0x800 FUNCTION_LIST DFPM_DDVE IF_DATA DIM_X 0x383864 EXTERN BYTE IF_DATA MCMESS 0x383864 EXTERN /end MEASUREMENT
/begin MEASUREMENT B_npdveub "" UWORD B_TRUE 1 100 0 1 BIT_MASK 0x800 FUNCTION_LIST DFPM_DDVE IF_DATA DIM_X 0x383866 EXTERN BYTE IF_DATA MCMESS 0x383866 EXTERN /end MEASUREMENT
/begin MEASUREMENT B_npdveuw "Fehlertyp ""unplausibel"" bei UMA-Wiederlernen" UWORD B_TRUE 1 100 0 1 BIT_MASK 0x800 FUNCTION_LIST DFPM_DDVE IF_DATA DIM_X 0x383868 EXTERN BYTE IF_DATA MCMESS 0x383868 EXTERN /end MEASUREMENT
/begin MEASUREMENT B_npdvev "Fehlertyp unplaus.: DV-E Fehler bei Verstärkerabgleich" UWORD B_TRUE 1 100 0 1 BIT_MASK 0x800 FUNCTION_LIST DFPM_DDVE IF_DATA DIM_X 0x38386A EXTERN BYTE IF_DATA MCMESS 0x38386A EXTERN /end MEASUREMENT
/begin MEASUREMENT B_npegfe "Bedingung: unplausibler Wert bei den Eingangsgrößen der Füllungserfassung" UWORD B_TRUE 1 100 0 1 BIT_MASK 0x800 FUNCTION_LIST DFPM_EGFE IF_DATA DIM_X 0x38386C EXTERN BYTE IF_DATA MCMESS 0x38386C EXTERN /end MEASUREMENT
/begin MEASUREMENT B_npev1 "Fehlerart: Zustand nicht plausibel EV1" UWORD B_TRUE 1 100 0 1 BIT_MASK 0x800 FUNCTION_LIST DFPM_DEKON IF_DATA DIM_X 0x38386E EXTERN BYTE IF_DATA MCMESS 0x38386E EXTERN /end MEASUREMENT
/begin MEASUREMENT B_npev2 "Fehlerart: Zustand nicht plausibel EV2" UWORD B_TRUE 1 100 0 1 BIT_MASK 0x800 FUNCTION_LIST DFPM_DEKON IF_DATA DIM_X 0x383870 EXTERN BYTE IF_DATA MCMESS 0x383870 EXTERN /end MEASUREMENT
/begin MEASUREMENT B_npev3 "Fehlerart: Zustand nicht plausibel EV3" UWORD B_TRUE 1 100 0 1 BIT_MASK 0x800 FUNCTION_LIST DFPM_DEKON IF_DATA DIM_X 0x383872 EXTERN BYTE IF_DATA MCMESS 0x383872 EXTERN /end MEASUREMENT
/begin MEASUREMENT B_npev4 "Fehlerart: Zustand nicht plausibel EV4" UWORD B_TRUE 1 100 0 1 BIT_MASK 0x800 FUNCTION_LIST DFPM_DEKON IF_DATA DIM_X 0x383874 EXTERN BYTE IF_DATA MCMESS 0x383874 EXTERN /end MEASUREMENT
/begin MEASUREMENT B_npev5 "Fehlerart: Zustand nicht plausibel EV5" UWORD B_TRUE 1 100 0 1 BIT_MASK 0x800 FUNCTION_LIST DFPM_DEKON IF_DATA DIM_X 0x383876 EXTERN BYTE IF_DATA MCMESS 0x383876 EXTERN /end MEASUREMENT
/begin MEASUREMENT B_npev6 "Fehlerart: Zustand nicht plausibel EV6" UWORD B_TRUE 1 100 0 1 BIT_MASK 0x800 FUNCTION_LIST DFPM_DEKON IF_DATA DIM_X 0x383878 EXTERN BYTE IF_DATA MCMESS 0x383878 EXTERN /end MEASUREMENT
/begin MEASUREMENT B_npfgrl "Fehlerart:FGR-Lampe über CAN nicht plausibel" UWORD B_TRUE 1 100 0 1 BIT_MASK 0x800 FUNCTION_LIST DFPM_DCFGRL IF_DATA DIM_X 0x38387A EXTERN BYTE IF_DATA MCMESS 0x38387A EXTERN /end MEASUREMENT
/begin MEASUREMENT B_npfp1p "Fehlertyp unplaus.: Fahrpedal 1. Poti" UWORD B_TRUE 1 100 0 1 BIT_MASK 0x800 FUNCTION_LIST DFPM_GGPED IF_DATA DIM_X 0x38387C EXTERN BYTE IF_DATA MCMESS 0x38387C EXTERN /end MEASUREMENT
/begin MEASUREMENT B_npfp2p "Fehlertyp unplaus.: Fahrpedal 2. Poti" UWORD B_TRUE 1 100 0 1 BIT_MASK 0x800 FUNCTION_LIST DFPM_GGPED IF_DATA DIM_X 0x38387E EXTERN BYTE IF_DATA MCMESS 0x38387E EXTERN /end MEASUREMENT
/begin MEASUREMENT B_npfpp "Bedingung unplausible Potisignale vom Fahrpedal" UWORD B_TRUE 1 100 0 1 BIT_MASK 0x800 FUNCTION_LIST DFPM_GGPED IF_DATA DIM_X 0x383880 EXTERN BYTE IF_DATA MCMESS 0x383880 EXTERN /end MEASUREMENT
/begin MEASUREMENT B_npfrao "Bedingung FRAO ist unplausibel" UWORD B_TRUE 1 100 0 1 BIT_MASK 0x800 FUNCTION_LIST DFPM_DKVS IF_DATA DIM_X 0x383882 EXTERN BYTE IF_DATA MCMESS 0x383882 EXTERN /end MEASUREMENT
/begin MEASUREMENT B_npfrao2 "Bedingung FRAO ist unplausibel Bank 2" UWORD B_TRUE 1 100 0 1 BIT_MASK 0x800 FUNCTION_LIST DFPM_DKVS IF_DATA DIM_X 0x383884 EXTERN BYTE IF_DATA MCMESS 0x383884 EXTERN /end MEASUREMENT
/begin MEASUREMENT B_npfrau "Bedingung FRAU ist unplausibel" UWORD B_TRUE 1 100 0 1 BIT_MASK 0x800 FUNCTION_LIST DFPM_DKVS IF_DATA DIM_X 0x383886 EXTERN BYTE IF_DATA MCMESS 0x383886 EXTERN /end MEASUREMENT
/begin MEASUREMENT B_npfrau2 "Bedingung FRAU ist unplausibel Bank 2" UWORD B_TRUE 1 100 0 1 BIT_MASK 0x800 FUNCTION_LIST DFPM_DKVS IF_DATA DIM_X 0x383888 EXTERN BYTE IF_DATA MCMESS 0x383888 EXTERN /end MEASUREMENT
/begin MEASUREMENT B_npfrst "Fehlertyp 'unplausibles Prüfresultat' erkannt (DKVS Kurztest)" UWORD B_TRUE 1 100 0 1 BIT_MASK 0x800 FUNCTION_LIST DFPM_DKVS IF_DATA DIM_X 0x38388A EXTERN BYTE IF_DATA MCMESS 0x38388A EXTERN /end MEASUREMENT
/begin MEASUREMENT B_npfrst2 "Fehlertyp 'unplausibles Prüfresultat' erkannt (DKVS Kurztest Bank 2)" UWORD B_TRUE 1 100 0 1 BIT_MASK 0x800 FUNCTION_LIST DFPM_DKVS IF_DATA DIM_X 0x38388C EXTERN BYTE IF_DATA MCMESS 0x38388C EXTERN /end MEASUREMENT
/begin MEASUREMENT B_nphlsu "Bedingung Signal LSU1 ist unplausibel" UWORD B_TRUE 1 100 0 1 BIT_MASK 0x2 FUNCTION_LIST DHLSU IF_DATA DIM_X 0xFD1E INTERN BYTE IF_DATA MCMESS 0xFD1E INTERN /end MEASUREMENT
/begin MEASUREMENT B_nphlsu2 "Bedingung Signal LSU2 ist unplausibel" UWORD B_TRUE 1 100 0 1 BIT_MASK 0x4 FUNCTION_LIST DHLSU IF_DATA DIM_X 0xFD1E INTERN BYTE IF_DATA MCMESS 0xFD1E INTERN /end MEASUREMENT
/begin MEASUREMENT B_nphsh "Nernstwiderstand Sonde hinter Kat zu groß" UWORD B_TRUE 1 100 0 1 BIT_MASK 0x800 FUNCTION_LIST DFPM_DHLSHK IF_DATA DIM_X 0x38388E EXTERN BYTE IF_DATA MCMESS 0x38388E EXTERN /end MEASUREMENT
/begin MEASUREMENT B_nphsh2 "Nernstwiderstand Sonde 2 hinter Kat zu groß" UWORD B_TRUE 1 100 0 1 BIT_MASK 0x800 FUNCTION_LIST DFPM_DHLSHK IF_DATA DIM_X 0x383890 EXTERN BYTE IF_DATA MCMESS 0x383890 EXTERN /end MEASUREMENT
/begin MEASUREMENT B_nphshe "Nicht plausibler Fehler: Lambda-Sonden Heizung hinter Kat. (Endstufe)" UWORD B_TRUE 1 100 0 1 BIT_MASK 0x800 FUNCTION_LIST DFPM_DEKON IF_DATA DIM_X 0x383892 EXTERN BYTE IF_DATA MCMESS 0x383892 EXTERN /end MEASUREMENT
/begin MEASUREMENT B_nphshe2 "Nicht plausibler Fehler: Lambda-Sonden Heizung 2 hinter Kat. (Endstufe)" UWORD B_TRUE 1 100 0 1 BIT_MASK 0x800 FUNCTION_LIST DFPM_DEKON IF_DATA DIM_X 0x383894 EXTERN BYTE IF_DATA MCMESS 0x383894 EXTERN /end MEASUREMENT
/begin MEASUREMENT B_nphsv "Nernstwiderstand Sonde vor Kat zu groß" UWORD B_TRUE 1 100 0 1 BIT_MASK 0x800 FUNCTION_LIST DFPM_DHLSU IF_DATA DIM_X 0x383896 EXTERN BYTE IF_DATA MCMESS 0x383896 EXTERN /end MEASUREMENT
/begin MEASUREMENT B_nphsv2 "Nernstwiderstand Sonde 2 vor Kat zu groß" UWORD B_TRUE 1 100 0 1 BIT_MASK 0x800 FUNCTION_LIST DFPM_DHLSU IF_DATA DIM_X 0x383898 EXTERN BYTE IF_DATA MCMESS 0x383898 EXTERN /end MEASUREMENT
/begin MEASUREMENT B_nphsvsa "  reduzierte  LSU-Heizung oder LSU-Kennlinie abgeflacht" UWORD B_TRUE 1 100 0 1 BIT_MASK 0x800 FUNCTION_LIST DFPM_DHLSU IF_DATA DIM_X 0x38389A EXTERN BYTE IF_DATA MCMESS 0x38389A EXTERN /end MEASUREMENT
/begin MEASUREMENT B_nphsvsa2 "  reduzierte  LSU_2-Heizung oder LSU_2-Kennlinie abgeflacht" UWORD B_TRUE 1 100 0 1 BIT_MASK 0x800 FUNCTION_LIST DFPM_DHLSU IF_DATA DIM_X 0x38389C EXTERN BYTE IF_DATA MCMESS 0x38389C EXTERN /end MEASUREMENT
/begin MEASUREMENT B_npkat "Fehlertyp 'unplausibles Prüfresultat' erkannt (Katalysator)" UWORD B_TRUE 1 100 0 1 BIT_MASK 0x800 FUNCTION_LIST DFPM_DKAT IF_DATA DIM_X 0x38389E EXTERN BYTE IF_DATA MCMESS 0x38389E EXTERN /end MEASUREMENT
/begin MEASUREMENT B_npkat2 "Fehlertyp 'unplausibles Prüfresultat' erkannt (Katalysator)2" UWORD B_TRUE 1 100 0 1 BIT_MASK 0x800 FUNCTION_LIST DFPM_DKAT IF_DATA DIM_X 0x3838A0 EXTERN BYTE IF_DATA MCMESS 0x3838A0 EXTERN /end MEASUREMENT
/begin MEASUREMENT B_npkos "" UWORD B_TRUE 1 100 0 1 BIT_MASK 0x800 FUNCTION_LIST DFPM_DEKON IF_DATA DIM_X 0x3838A2 EXTERN BYTE IF_DATA MCMESS 0x3838A2 EXTERN /end MEASUREMENT
/begin MEASUREMENT B_npkpe "Bedingung für Fehlertyp 'Wert unplausibel' für EKP-Relais Endstufe erkannt" UWORD B_TRUE 1 100 0 1 BIT_MASK 0x800 FUNCTION_LIST DFPM_DEKON IF_DATA DIM_X 0x3838A4 EXTERN BYTE IF_DATA MCMESS 0x3838A4 EXTERN /end MEASUREMENT
/begin MEASUREMENT B_npkrnt "Bedingung Plausibilitätsfehler der KR-Diagnose Integratorsteigung" UWORD B_TRUE 1 100 0 1 BIT_MASK 0x800 FUNCTION_LIST DFPM_DKRNT IF_DATA DIM_X 0x3838A6 EXTERN BYTE IF_DATA MCMESS 0x3838A6 EXTERN /end MEASUREMENT
/begin MEASUREMENT B_npkrof "Bedingung Plausibilitätsfehler der KR-Diagnose Resetwert" UWORD B_TRUE 1 100 0 1 BIT_MASK 0x800 FUNCTION_LIST DFPM_DKRNT IF_DATA DIM_X 0x3838A8 EXTERN BYTE IF_DATA MCMESS 0x3838A8 EXTERN /end MEASUREMENT
/begin MEASUREMENT B_npkrtp "Bedingung Plausibilitätsfehler der KR-Diagnose Testimpuls" UWORD B_TRUE 1 100 0 1 BIT_MASK 0x800 FUNCTION_LIST DFPM_DKRTP IF_DATA DIM_X 0x3838AA EXTERN BYTE IF_DATA MCMESS 0x3838AA EXTERN /end MEASUREMENT
/begin MEASUREMENT B_npks1 "Nicht plausibler Fehler: Klopfsensor 1" UWORD B_TRUE 1 100 0 1 BIT_MASK 0x800 FUNCTION_LIST DFPM_DKRS IF_DATA DIM_X 0x3838AC EXTERN BYTE IF_DATA MCMESS 0x3838AC EXTERN /end MEASUREMENT
/begin MEASUREMENT B_npks2 "Nicht plausibler Fehler: Klopfsensor 2" UWORD B_TRUE 1 100 0 1 BIT_MASK 0x800 FUNCTION_LIST DFPM_DKRS IF_DATA DIM_X 0x3838AE EXTERN BYTE IF_DATA MCMESS 0x3838AE EXTERN /end MEASUREMENT
/begin MEASUREMENT B_npks3 "Nicht plausibler Fehler: Klopfsensor 3" UWORD B_TRUE 1 100 0 1 BIT_MASK 0x800 FUNCTION_LIST DFPM_DKRS IF_DATA DIM_X 0x3838B0 EXTERN BYTE IF_DATA MCMESS 0x3838B0 EXTERN /end MEASUREMENT
/begin MEASUREMENT B_npks4 "Nicht plausibler Fehler: Klopfsensor 4" UWORD B_TRUE 1 100 0 1 BIT_MASK 0x800 FUNCTION_LIST DFPM_DKRS IF_DATA DIM_X 0x3838B2 EXTERN BYTE IF_DATA MCMESS 0x3838B2 EXTERN /end MEASUREMENT
/begin MEASUREMENT B_npkuppl "Fehlertyp KUPPL: Prüfresultat nicht plausibel" UWORD B_TRUE 1 100 0 1 BIT_MASK 0x800 FUNCTION_LIST DFPM_DKUPPL IF_DATA DIM_X 0x3838B4 EXTERN BYTE IF_DATA MCMESS 0x3838B4 EXTERN /end MEASUREMENT
/begin MEASUREMENT B_npkwave "Fehlertype: nicht plausibles Signal Kühlwasserabsperrventil Endstufe" UWORD B_TRUE 1 100 0 1 BIT_MASK 0x800 FUNCTION_LIST DFPM_DEKON IF_DATA DIM_X 0x3838B6 EXTERN BYTE IF_DATA MCMESS 0x3838B6 EXTERN /end MEASUREMENT
/begin MEASUREMENT B_nplash "Fehlertyp 'Wert unplausibel' für Schwingungs-Prüfung hinter KAT erkannt" UWORD B_TRUE 1 100 0 1 BIT_MASK 0x800 FUNCTION_LIST DFPM_DLSAHK IF_DATA DIM_X 0x3838B8 EXTERN BYTE IF_DATA MCMESS 0x3838B8 EXTERN /end MEASUREMENT
/begin MEASUREMENT B_nplash2 "Fehlertyp 'Wert unplausibel' für Schwingungs-Prüfung hinter KAT erkannt Bank2" UWORD B_TRUE 1 100 0 1 BIT_MASK 0x800 FUNCTION_LIST DFPM_DLSAHK IF_DATA DIM_X 0x3838BA EXTERN BYTE IF_DATA MCMESS 0x3838BA EXTERN /end MEASUREMENT
/begin MEASUREMENT B_nplde "Nicht plausibler Fehler: Ladedrucksteuerventil Endstufe" UWORD B_TRUE 1 100 0 1 BIT_MASK 0x800 FUNCTION_LIST DFPM_DEKON IF_DATA DIM_X 0x3838BC EXTERN BYTE IF_DATA MCMESS 0x3838BC EXTERN /end MEASUREMENT
/begin MEASUREMENT B_npldo "Bedingung Plausfehler ldo" UWORD B_TRUE 1 100 0 1 BIT_MASK 0x800 FUNCTION_LIST DFPM_DLDR IF_DATA DIM_X 0x3838BE EXTERN BYTE IF_DATA MCMESS 0x3838BE EXTERN /end MEASUREMENT
/begin MEASUREMENT B_npldra "Bedingung Plausfehler LDRA" UWORD B_TRUE 1 100 0 1 BIT_MASK 0x800 FUNCTION_LIST DFPM_DLDR IF_DATA DIM_X 0x3838C0 EXTERN BYTE IF_DATA MCMESS 0x3838C0 EXTERN /end MEASUREMENT
/begin MEASUREMENT B_nplf1e "" UWORD B_TRUE 1 100 0 1 BIT_MASK 0x800 FUNCTION_LIST DFPM_DEKON IF_DATA DIM_X 0x3838C2 EXTERN BYTE IF_DATA MCMESS 0x3838C2 EXTERN /end MEASUREMENT
/begin MEASUREMENT B_nplf2e "" UWORD B_TRUE 1 100 0 1 BIT_MASK 0x800 FUNCTION_LIST DFPM_DEKON IF_DATA DIM_X 0x3838C4 EXTERN BYTE IF_DATA MCMESS 0x3838C4 EXTERN /end MEASUREMENT
/begin MEASUREMENT B_nplf3e "" UWORD B_TRUE 1 100 0 1 BIT_MASK 0x800 FUNCTION_LIST DFPM_DEKON IF_DATA DIM_X 0x3838C6 EXTERN BYTE IF_DATA MCMESS 0x3838C6 EXTERN /end MEASUREMENT
/begin MEASUREMENT B_nplflsh "Adernschluß bei Sonde hinter KAT erkannt" UBYTE B_TRUE 1 100 0 1 BIT_MASK 0x40 FUNCTION_LIST DLSH IF_DATA DIM_X 0x380A80 EXTERN BYTE IF_DATA MCMESS 0x380A80 EXTERN /end MEASUREMENT
/begin MEASUREMENT B_nplflsh2 "Adernschluß hinter KAT erkannt Bank2" UBYTE B_TRUE 1 100 0 1 BIT_MASK 0x80 FUNCTION_LIST DLSH IF_DATA DIM_X 0x380A80 EXTERN BYTE IF_DATA MCMESS 0x380A80 EXTERN /end MEASUREMENT
/begin MEASUREMENT B_nplflsu "Lambdasignal nicht plausibel, Bank1" UWORD B_TRUE 1 100 0 1 BIT_MASK 0x8 FUNCTION_LIST DLSU IF_DATA DIM_X 0x381D14 EXTERN BYTE IF_DATA MCMESS 0x381D14 EXTERN /end MEASUREMENT
/begin MEASUREMENT B_nplflsu2 "Lambdasignal nicht plausibel, Bank2" UWORD B_TRUE 1 100 0 1 BIT_MASK 0x80 FUNCTION_LIST DLSU IF_DATA DIM_X 0x381D14 EXTERN BYTE IF_DATA MCMESS 0x381D14 EXTERN /end MEASUREMENT
/begin MEASUREMENT B_npllr "Nicht plausibler Fehler: Leerlaufregelung" UWORD B_TRUE 1 100 0 1 BIT_MASK 0x800 FUNCTION_LIST DFPM_DLLR IF_DATA DIM_X 0x3838C8 EXTERN BYTE IF_DATA MCMESS 0x3838C8 EXTERN /end MEASUREMENT
/begin MEASUREMENT B_nplm "Bedingung Plausfehler Hauptfüllungssensor" UWORD B_TRUE 1 100 0 1 BIT_MASK 0x800 FUNCTION_LIST DFPM_DHFM IF_DATA DIM_X 0x3838CA EXTERN BYTE IF_DATA MCMESS 0x3838CA EXTERN /end MEASUREMENT
/begin MEASUREMENT B_nplsh "Fehlertyp 'Wert unplausibel' hinter KAT erkannt" UWORD B_TRUE 1 100 0 1 BIT_MASK 0x800 FUNCTION_LIST DFPM_DLSH IF_DATA DIM_X 0x3838CC EXTERN BYTE IF_DATA MCMESS 0x3838CC EXTERN /end MEASUREMENT
/begin MEASUREMENT B_nplsh2 "Fehlertyp 'Wert unplausibel' hinter KAT erkannt Bank2" UWORD B_TRUE 1 100 0 1 BIT_MASK 0x800 FUNCTION_LIST DFPM_DLSH IF_DATA DIM_X 0x3838CE EXTERN BYTE IF_DATA MCMESS 0x3838CE EXTERN /end MEASUREMENT
/begin MEASUREMENT B_nplsusa "Bedingung Signal LSU1 ist unplausibel während B_sa" UWORD B_TRUE 1 100 0 1 BIT_MASK 0x8 FUNCTION_LIST DHLSU HLSU IF_DATA DIM_X 0xFD1E INTERN BYTE IF_DATA MCMESS 0xFD1E INTERN /end MEASUREMENT
/begin MEASUREMENT B_nplsusa2 "Bedingung Signal LSU2 ist unplausibel während B_sa" UWORD B_TRUE 1 100 0 1 BIT_MASK 0x10 FUNCTION_LIST DHLSU HLSU IF_DATA DIM_X 0xFD1E INTERN BYTE IF_DATA MCMESS 0xFD1E INTERN /end MEASUREMENT
/begin MEASUREMENT B_nplsv "Fehlertyp 'Wert unplausibel' erkannt" UWORD B_TRUE 1 100 0 1 BIT_MASK 0x800 FUNCTION_LIST DFPM_DLSU IF_DATA DIM_X 0x3838D0 EXTERN BYTE IF_DATA MCMESS 0x3838D0 EXTERN /end MEASUREMENT
/begin MEASUREMENT B_nplsv2 "Fehlertyp 'Wert unplausibel' erkannt Bank2" UWORD B_TRUE 1 100 0 1 BIT_MASK 0x800 FUNCTION_LIST DFPM_DLSU IF_DATA DIM_X 0x3838D2 EXTERN BYTE IF_DATA MCMESS 0x3838D2 EXTERN /end MEASUREMENT
/begin MEASUREMENT B_nplsvv "Plausibilitäts-Fehler: Vertauschte Lambda-Sonden" UWORD B_TRUE 1 100 0 1 BIT_MASK 0x800 FUNCTION_LIST DFPM_LSVV IF_DATA DIM_X 0x3838D4 EXTERN BYTE IF_DATA MCMESS 0x3838D4 EXTERN /end MEASUREMENT
/begin MEASUREMENT B_npmd "Fehlertyp unplaus.: Aussetzer, Summenfehler (multiple)" UWORD B_TRUE 1 100 0 1 BIT_MASK 0x800 FUNCTION_LIST DFPM_DMDMIL IF_DATA DIM_X 0x3838D6 EXTERN BYTE IF_DATA MCMESS 0x3838D6 EXTERN /end MEASUREMENT
/begin MEASUREMENT B_npmd00 "Fehlertyp unplaus.: Aussetzer Zündung 0" UWORD B_TRUE 1 100 0 1 BIT_MASK 0x800 FUNCTION_LIST DFPM_DMDMIL IF_DATA DIM_X 0x3838D8 EXTERN BYTE IF_DATA MCMESS 0x3838D8 EXTERN /end MEASUREMENT
/begin MEASUREMENT B_npmd01 "Fehlertyp unplaus.: Aussetzer Zündung 1" UWORD B_TRUE 1 100 0 1 BIT_MASK 0x800 FUNCTION_LIST DFPM_DMDMIL IF_DATA DIM_X 0x3838DA EXTERN BYTE IF_DATA MCMESS 0x3838DA EXTERN /end MEASUREMENT
/begin MEASUREMENT B_npmd02 "Fehlertyp unplaus.: Aussetzer Zündung 2" UWORD B_TRUE 1 100 0 1 BIT_MASK 0x800 FUNCTION_LIST DFPM_DMDMIL IF_DATA DIM_X 0x3838DC EXTERN BYTE IF_DATA MCMESS 0x3838DC EXTERN /end MEASUREMENT
/begin MEASUREMENT B_npmd03 "Fehlertyp unplaus.: Aussetzer Zündung 3" UWORD B_TRUE 1 100 0 1 BIT_MASK 0x800 FUNCTION_LIST DFPM_DMDMIL IF_DATA DIM_X 0x3838DE EXTERN BYTE IF_DATA MCMESS 0x3838DE EXTERN /end MEASUREMENT
/begin MEASUREMENT B_npmd04 "Fehlertyp unplaus.: Aussetzer Zündung 4" UWORD B_TRUE 1 100 0 1 BIT_MASK 0x800 FUNCTION_LIST DFPM_DMDMIL IF_DATA DIM_X 0x3838E0 EXTERN BYTE IF_DATA MCMESS 0x3838E0 EXTERN /end MEASUREMENT
/begin MEASUREMENT B_npmd05 "Fehlertyp unplaus.: Aussetzer Zündung 5" UWORD B_TRUE 1 100 0 1 BIT_MASK 0x800 FUNCTION_LIST DFPM_DMDMIL IF_DATA DIM_X 0x3838E2 EXTERN BYTE IF_DATA MCMESS 0x3838E2 EXTERN /end MEASUREMENT
/begin MEASUREMENT B_npmdb "Nicht plausibler Fehler: Momentanüberwachung begrenzt dauerhaft" UWORD B_TRUE 1 100 0 1 BIT_MASK 0x800 FUNCTION_LIST DFPM_MDKOG IF_DATA DIM_X 0x3838E4 EXTERN BYTE IF_DATA MCMESS 0x3838E4 EXTERN /end MEASUREMENT
/begin MEASUREMENT B_npmsg "Fehlertype: Signal unplausibel Motorraumspülgebläse" UWORD B_TRUE 1 100 0 1 BIT_MASK 0x800 FUNCTION_LIST DFPM_MLS IF_DATA DIM_X 0x3838E6 EXTERN BYTE IF_DATA MCMESS 0x3838E6 EXTERN /end MEASUREMENT
/begin MEASUREMENT B_npmsge "" UWORD B_TRUE 1 100 0 1 BIT_MASK 0x800 FUNCTION_LIST DFPM_DEKON IF_DATA DIM_X 0x3838E8 EXTERN BYTE IF_DATA MCMESS 0x3838E8 EXTERN /end MEASUREMENT
/begin MEASUREMENT B_npn "Fehlerart: häufiger Bezugsmarkenfehler beim Lückencheck" UWORD B_TRUE 1 100 0 1 BIT_MASK 0x800 FUNCTION_LIST DFPM_DDG IF_DATA DIM_X 0x3838EA EXTERN BYTE IF_DATA MCMESS 0x3838EA EXTERN /end MEASUREMENT
/begin MEASUREMENT B_npnwkw "Nicht plausibler Fehler: Zuordnung Nockenwelle zu Kurbelwelle" UWORD B_TRUE 1 100 0 1 BIT_MASK 0x800 FUNCTION_LIST DFPM_DNWKW IF_DATA DIM_X 0x3838EC EXTERN BYTE IF_DATA MCMESS 0x3838EC EXTERN /end MEASUREMENT
/begin MEASUREMENT B_npnwkw2 "Nicht plausibler Fehler: Zuordnung Nockenwelle 2 zu Kurbelwelle" UWORD B_TRUE 1 100 0 1 BIT_MASK 0x800 FUNCTION_LIST DFPM_DNWKW IF_DATA DIM_X 0x3838EE EXTERN BYTE IF_DATA MCMESS 0x3838EE EXTERN /end MEASUREMENT
/begin MEASUREMENT B_npnws "Fehlerart Nockenwellenverstellung unplausible Position" UWORD B_TRUE 1 100 0 1 BIT_MASK 0x800 FUNCTION_LIST DFPM_DNWS IF_DATA DIM_X 0x3838F0 EXTERN BYTE IF_DATA MCMESS 0x3838F0 EXTERN /end MEASUREMENT
/begin MEASUREMENT B_npnws2 "Fehlerart Nockenwellenverstellung 2 unplausible Position" UWORD B_TRUE 1 100 0 1 BIT_MASK 0x800 FUNCTION_LIST DFPM_DNWS IF_DATA DIM_X 0x3838F2 EXTERN BYTE IF_DATA MCMESS 0x3838F2 EXTERN /end MEASUREMENT
/begin MEASUREMENT B_npnwse "Nicht plausibler Fehler: Nockenwellenverstellung Endstufe" UWORD B_TRUE 1 100 0 1 BIT_MASK 0x800 FUNCTION_LIST DFPM_DEKON IF_DATA DIM_X 0x3838F4 EXTERN BYTE IF_DATA MCMESS 0x3838F4 EXTERN /end MEASUREMENT
/begin MEASUREMENT B_npnwse2 "Fehlertype: nicht plausibles Signal Nockenwellensteuerung Bank2 Endstufe" UWORD B_TRUE 1 100 0 1 BIT_MASK 0x800 FUNCTION_LIST DFPM_DEKON IF_DATA DIM_X 0x3838F6 EXTERN BYTE IF_DATA MCMESS 0x3838F6 EXTERN /end MEASUREMENT
/begin MEASUREMENT B_npotm "Bedingung: Motortemperatursignal im oberen Bereich nicht plausibel" UBYTE B_TRUE 1 100 0 1 BIT_MASK 0x2 FUNCTION_LIST GGTFM IF_DATA DIM_X 0x380B55 EXTERN BYTE IF_DATA MCMESS 0x380B55 EXTERN /end MEASUREMENT
/begin MEASUREMENT B_npph "Bedingung Phasengebersignal ist unplausibel (ph)" UWORD B_TRUE 1 100 0 1 BIT_MASK 0x800 FUNCTION_LIST DFPM_DPH IF_DATA DIM_X 0x3838F8 EXTERN BYTE IF_DATA MCMESS 0x3838F8 EXTERN /end MEASUREMENT
/begin MEASUREMENT B_npph2 "Bedingung Phasengebersignal ist unplausibel (ph2)" UWORD B_TRUE 1 100 0 1 BIT_MASK 0x800 FUNCTION_LIST DFPM_DPH IF_DATA DIM_X 0x3838FA EXTERN BYTE IF_DATA MCMESS 0x3838FA EXTERN /end MEASUREMENT
/begin MEASUREMENT B_nprkat "Bedingung RKAT ist unplausibel" UWORD B_TRUE 1 100 0 1 BIT_MASK 0x800 FUNCTION_LIST DFPM_DKVS IF_DATA DIM_X 0x3838FC EXTERN BYTE IF_DATA MCMESS 0x3838FC EXTERN /end MEASUREMENT
/begin MEASUREMENT B_nprkat2 "Bedingung RKAT ist unplausibel Bank 2" UWORD B_TRUE 1 100 0 1 BIT_MASK 0x800 FUNCTION_LIST DFPM_DKVS IF_DATA DIM_X 0x3838FE EXTERN BYTE IF_DATA MCMESS 0x3838FE EXTERN /end MEASUREMENT
/begin MEASUREMENT B_nprkaz "Bedingung RKAZ ist unplausibel" UWORD B_TRUE 1 100 0 1 BIT_MASK 0x800 FUNCTION_LIST DFPM_DKVS IF_DATA DIM_X 0x383900 EXTERN BYTE IF_DATA MCMESS 0x383900 EXTERN /end MEASUREMENT
/begin MEASUREMENT B_nprkaz2 "Bedingung RKAZ ist unplausibel Bank 2" UWORD B_TRUE 1 100 0 1 BIT_MASK 0x800 FUNCTION_LIST DFPM_DKVS IF_DATA DIM_X 0x383902 EXTERN BYTE IF_DATA MCMESS 0x383902 EXTERN /end MEASUREMENT
/begin MEASUREMENT B_npsgeep "" UWORD B_TRUE 1 100 0 1 BIT_MASK 0x800 FUNCTION_LIST DFPM_DSGEEP IF_DATA DIM_X 0x383904 EXTERN BYTE IF_DATA MCMESS 0x383904 EXTERN /end MEASUREMENT
/begin MEASUREMENT B_npslpe "Nicht plausibler Fehler: Sekundärluftpumpe Endstufe" UWORD B_TRUE 1 100 0 1 BIT_MASK 0x800 FUNCTION_LIST DFPM_DEKON IF_DATA DIM_X 0x383906 EXTERN BYTE IF_DATA MCMESS 0x383906 EXTERN /end MEASUREMENT
/begin MEASUREMENT B_npsls "Fehlerart: Offsetwert Sekundärluftmasse zu groß" UWORD B_TRUE 1 100 0 1 BIT_MASK 0x800 FUNCTION_LIST DFPM_DSLSLRS IF_DATA DIM_X 0x383908 EXTERN BYTE IF_DATA MCMESS 0x383908 EXTERN /end MEASUREMENT
/begin MEASUREMENT B_npsls2 "Fehlerart: Offsetwert Sekundärluftmasse zu groß, Bank 2" UWORD B_TRUE 1 100 0 1 BIT_MASK 0x800 FUNCTION_LIST DFPM_DSLSLRS IF_DATA DIM_X 0x38390A EXTERN BYTE IF_DATA MCMESS 0x38390A EXTERN /end MEASUREMENT
/begin MEASUREMENT B_npslv "Fehlerart: Offsetwert Sekundärluftmasse zu groß" UWORD B_TRUE 1 100 0 1 BIT_MASK 0x800 FUNCTION_LIST DFPM_DSLSLRS IF_DATA DIM_X 0x38390C EXTERN BYTE IF_DATA MCMESS 0x38390C EXTERN /end MEASUREMENT
/begin MEASUREMENT B_npslv2 "Fehlerart: Offsetwert Sekundärluftmasse zu groß, Bank 2" UWORD B_TRUE 1 100 0 1 BIT_MASK 0x800 FUNCTION_LIST DFPM_DSLSLRS IF_DATA DIM_X 0x38390E EXTERN BYTE IF_DATA MCMESS 0x38390E EXTERN /end MEASUREMENT
/begin MEASUREMENT B_npslve "Fehlerart: Offsetwert Sekundärluftmasse Endstufe" UWORD B_TRUE 1 100 0 1 BIT_MASK 0x800 FUNCTION_LIST DFPM_DEKON IF_DATA DIM_X 0x383910 EXTERN BYTE IF_DATA MCMESS 0x383910 EXTERN /end MEASUREMENT
/begin MEASUREMENT B_npswe "Beschleunigungssensorsignal ist nicht plausibel" UWORD B_TRUE 1 100 0 1 BIT_MASK 0x800 FUNCTION_LIST DFPM_BGRBS IF_DATA DIM_X 0x383912 EXTERN BYTE IF_DATA MCMESS 0x383912 EXTERN /end MEASUREMENT
/begin MEASUREMENT B_npta "Fehlertyp unplaus.: Ansauglufttemperatur TANS (-Ladeluft)" UWORD B_TRUE 1 100 0 1 BIT_MASK 0x800 FUNCTION_LIST DFPM_GGTFA IF_DATA DIM_X 0x383914 EXTERN BYTE IF_DATA MCMESS 0x383914 EXTERN /end MEASUREMENT
/begin MEASUREMENT B_nptes "Fehlertyp 'unplausibles Prüfresultat' erkannt (TEV offen)" UWORD B_TRUE 1 100 0 1 BIT_MASK 0x800 FUNCTION_LIST DFPM_DTEV IF_DATA DIM_X 0x383916 EXTERN BYTE IF_DATA MCMESS 0x383916 EXTERN /end MEASUREMENT
/begin MEASUREMENT B_npteve "Nicht plausibler Fehler: Tankentlüftungsventil Endstufe" UWORD B_TRUE 1 100 0 1 BIT_MASK 0x800 FUNCTION_LIST DFPM_DEKON IF_DATA DIM_X 0x383918 EXTERN BYTE IF_DATA MCMESS 0x383918 EXTERN /end MEASUREMENT
/begin MEASUREMENT B_nptget "" UWORD B_TRUE 1 100 0 1 BIT_MASK 0x800 FUNCTION_LIST DFPM_GGTGET IF_DATA DIM_X 0x38391C EXTERN BYTE IF_DATA MCMESS 0x38391C EXTERN /end MEASUREMENT
/begin MEASUREMENT B_npthm "Fehlerart: Motortemperatursignal nicht plausibel ggü. Thermostat-Modellierung" UWORD B_TRUE 1 100 0 1 BIT_MASK 0x800 FUNCTION_LIST DFPM_GGTFM IF_DATA DIM_X 0x38391E EXTERN BYTE IF_DATA MCMESS 0x38391E EXTERN /end MEASUREMENT
/begin MEASUREMENT B_nptm "Fehlerart: Motortemperatursignal nicht plausibel ggü. Modell" UWORD B_TRUE 1 100 0 1 BIT_MASK 0x800 FUNCTION_LIST DFPM_GGTFM IF_DATA DIM_X 0x383920 EXTERN BYTE IF_DATA MCMESS 0x383920 EXTERN /end MEASUREMENT
/begin MEASUREMENT B_nptmki "Bedingung: Unplausible Motortemperatur aus Kombiinstrument" UWORD B_TRUE 1 100 0 1 BIT_MASK 0x800 FUNCTION_LIST DFPM_DUMMY043 IF_DATA DIM_X 0x383922 EXTERN BYTE IF_DATA MCMESS 0x383922 EXTERN /end MEASUREMENT
/begin MEASUREMENT B_nptmr "Fehlerart: Motorraumtemperatursignal nicht plausibel ggü. Modell" UWORD B_TRUE 1 100 0 1 BIT_MASK 0x800 FUNCTION_LIST DFPM_GGTFMR IF_DATA DIM_X 0x383924 EXTERN BYTE IF_DATA MCMESS 0x383924 EXTERN /end MEASUREMENT
/begin MEASUREMENT B_nptol "Nicht plausibler Fehler: Öltemperatur" UWORD B_TRUE 1 100 0 1 BIT_MASK 0x800 FUNCTION_LIST DFPM_GGTFOL IF_DATA DIM_X 0x383926 EXTERN BYTE IF_DATA MCMESS 0x383926 EXTERN /end MEASUREMENT
/begin MEASUREMENT B_nptum "Fehlerart: Signal Umgebungstemperatur unplausibel" UWORD B_TRUE 1 100 0 1 BIT_MASK 0x800 FUNCTION_LIST DFPM_GGTFUMG IF_DATA DIM_X 0x383928 EXTERN BYTE IF_DATA MCMESS 0x383928 EXTERN /end MEASUREMENT
/begin MEASUREMENT B_npub "Fehlerart: Batteriespannungssignal nicht plausibel" UWORD B_TRUE 1 100 0 1 BIT_MASK 0x800 FUNCTION_LIST DFPM_GGUB IF_DATA DIM_X 0x38392A EXTERN BYTE IF_DATA MCMESS 0x38392A EXTERN /end MEASUREMENT
/begin MEASUREMENT B_npufmv "Fehlertyp unplaus.: Funktionsüberwachung: Momentenvergleich" UWORD B_TRUE 1 100 0 1 BIT_MASK 0x800 FUNCTION_LIST DFPM_DUF IF_DATA DIM_X 0x38392C EXTERN BYTE IF_DATA MCMESS 0x38392C EXTERN /end MEASUREMENT
/begin MEASUREMENT B_npufska "Fehlertyp unplaus.: Funktionsüberwachung: Sicherheits-Kraftstoff-Abschaltung" UWORD B_TRUE 1 100 0 1 BIT_MASK 0x800 FUNCTION_LIST DFPM_DUF IF_DATA DIM_X 0x38392E EXTERN BYTE IF_DATA MCMESS 0x38392E EXTERN /end MEASUREMENT
/begin MEASUREMENT B_npurram "Fehlertyp unplaus: Rechnerüberwachung: RAM" UWORD B_TRUE 1 100 0 1 BIT_MASK 0x800 FUNCTION_LIST DFPM_DUR IF_DATA DIM_X 0x383930 EXTERN BYTE IF_DATA MCMESS 0x383930 EXTERN /end MEASUREMENT
/begin MEASUREMENT B_npurrom "Fehlertyp unplaus.: Rechnerüberwachung: ROM" UWORD B_TRUE 1 100 0 1 BIT_MASK 0x800 FUNCTION_LIST DFPM_DUR IF_DATA DIM_X 0x383932 EXTERN BYTE IF_DATA MCMESS 0x383932 EXTERN /end MEASUREMENT
/begin MEASUREMENT B_npurrst "Fehlertyp unplaus: Rechnerüberwachung: Reset" UWORD B_TRUE 1 100 0 1 BIT_MASK 0x800 FUNCTION_LIST DFPM_DUR IF_DATA DIM_X 0x383934 EXTERN BYTE IF_DATA MCMESS 0x383934 EXTERN /end MEASUREMENT
/begin MEASUREMENT B_nputm "Bedingung: Motortemperatursignal im unteren Bereich nicht plausibel ggü. Modell" UBYTE B_TRUE 1 100 0 1 BIT_MASK 0x8 FUNCTION_LIST GGTFM IF_DATA DIM_X 0x380B55 EXTERN BYTE IF_DATA MCMESS 0x380B55 EXTERN /end MEASUREMENT
/begin MEASUREMENT B_npuvse "Nicht plausibler  Fehler: Endstufe Umluftventil Turbo" UWORD B_TRUE 1 100 0 1 BIT_MASK 0x800 FUNCTION_LIST DFPM_DEKON IF_DATA DIM_X 0x383936 EXTERN BYTE IF_DATA MCMESS 0x383936 EXTERN /end MEASUREMENT
/begin MEASUREMENT B_npvfz "Fehlerart: Fahrzeuggeschwindigkeit nicht plausibel" UWORD B_TRUE 1 100 0 1 BIT_MASK 0x800 FUNCTION_LIST DFPM_DVFZ IF_DATA DIM_X 0x383938 EXTERN BYTE IF_DATA MCMESS 0x383938 EXTERN /end MEASUREMENT
/begin MEASUREMENT B_npvs01 "Fehlerart: Ventilhub Zyl.1 nicht plausibel" UWORD B_TRUE 1 100 0 1 BIT_MASK 0x800 FUNCTION_LIST DFPM_DVS IF_DATA DIM_X 0x38393A EXTERN BYTE IF_DATA MCMESS 0x38393A EXTERN /end MEASUREMENT
/begin MEASUREMENT B_npvs02 "Fehlerart: Ventilhub Zyl.6 nicht plausibel" UWORD B_TRUE 1 100 0 1 BIT_MASK 0x800 FUNCTION_LIST DFPM_DVS IF_DATA DIM_X 0x38393C EXTERN BYTE IF_DATA MCMESS 0x38393C EXTERN /end MEASUREMENT
/begin MEASUREMENT B_npvs03 "Fehlerart: Ventilhub Zyl.2 nicht plausibel" UWORD B_TRUE 1 100 0 1 BIT_MASK 0x800 FUNCTION_LIST DFPM_DVS IF_DATA DIM_X 0x38393E EXTERN BYTE IF_DATA MCMESS 0x38393E EXTERN /end MEASUREMENT
/begin MEASUREMENT B_npvs04 "Fehlerart: Ventilhub Zyl.4 nicht plausibel" UWORD B_TRUE 1 100 0 1 BIT_MASK 0x800 FUNCTION_LIST DFPM_DVS IF_DATA DIM_X 0x383940 EXTERN BYTE IF_DATA MCMESS 0x383940 EXTERN /end MEASUREMENT
/begin MEASUREMENT B_npvs05 "Fehlerart: Ventilhub Zyl.3 nicht plausibel" UWORD B_TRUE 1 100 0 1 BIT_MASK 0x800 FUNCTION_LIST DFPM_DVS IF_DATA DIM_X 0x383942 EXTERN BYTE IF_DATA MCMESS 0x383942 EXTERN /end MEASUREMENT
/begin MEASUREMENT B_npvs06 "Fehlerart: Ventilhub Zyl.5 nicht plausibel" UWORD B_TRUE 1 100 0 1 BIT_MASK 0x800 FUNCTION_LIST DFPM_DVS IF_DATA DIM_X 0x383944 EXTERN BYTE IF_DATA MCMESS 0x383944 EXTERN /end MEASUREMENT
/begin MEASUREMENT B_npvs1e "" UWORD B_TRUE 1 100 0 1 BIT_MASK 0x800 FUNCTION_LIST DFPM_DEKON IF_DATA DIM_X 0x383946 EXTERN BYTE IF_DATA MCMESS 0x383946 EXTERN /end MEASUREMENT
/begin MEASUREMENT B_npvs2e "" UWORD B_TRUE 1 100 0 1 BIT_MASK 0x800 FUNCTION_LIST DFPM_DEKON IF_DATA DIM_X 0x383948 EXTERN BYTE IF_DATA MCMESS 0x383948 EXTERN /end MEASUREMENT
/begin MEASUREMENT B_npvsb1 "Fehlerart: Ventilhub nicht plausibel (Bankselektiv)" UWORD B_TRUE 1 100 0 1 BIT_MASK 0x800 FUNCTION_LIST DFPM_DVS IF_DATA DIM_X 0x38394A EXTERN BYTE IF_DATA MCMESS 0x38394A EXTERN /end MEASUREMENT
/begin MEASUREMENT B_npvsb2 "Fehlerart: Ventilhub nicht plausibel (Bankselektiv)" UWORD B_TRUE 1 100 0 1 BIT_MASK 0x800 FUNCTION_LIST DFPM_DVS IF_DATA DIM_X 0x38394C EXTERN BYTE IF_DATA MCMESS 0x38394C EXTERN /end MEASUREMENT
/begin MEASUREMENT B_npvss "Fehlerart: Ventilhub nicht plausibel (Summenfehler)" UWORD B_TRUE 1 100 0 1 BIT_MASK 0x800 FUNCTION_LIST DFPM_DVS IF_DATA DIM_X 0x38394E EXTERN BYTE IF_DATA MCMESS 0x38394E EXTERN /end MEASUREMENT
/begin MEASUREMENT B_npwfs "Fehlerart: Wegfahrsperre" UWORD B_TRUE 1 100 0 1 BIT_MASK 0x800 FUNCTION_LIST DFPM_WFS IF_DATA DIM_X 0x383950 EXTERN BYTE IF_DATA MCMESS 0x383950 EXTERN /end MEASUREMENT
/begin MEASUREMENT B_nsakt "Nachstart aktiv für Nachstartaufweitung" UWORD B_TRUE 1 100 0 1 BIT_MASK 0x2 FUNCTION_LIST MDZUL IF_DATA DIM_X 0xFD70 INTERN BYTE IF_DATA MCMESS 0xFD70 INTERN /end MEASUREMENT
/begin MEASUREMENT b_nsakt_um "Nachstart aktiv für die Fkt.-Überwachung" UBYTE B_TRUE 1 100 0 1 BIT_MASK 0x4 FUNCTION_LIST UFURAM IF_DATA DIM_X 0x382E41 EXTERN WORD IF_DATA MCMESS 0x382E41 EXTERN /end MEASUREMENT
/begin MEASUREMENT B_nsend "Nachstartüberwachungszeit abgelaufen" UWORD B_TRUE 1 100 0 1 BIT_MASK 0x4 FUNCTION_LIST MDZUL IF_DATA DIM_X 0xFD70 INTERN BYTE IF_DATA MCMESS 0xFD70 INTERN /end MEASUREMENT
/begin MEASUREMENT b_nsend_um "Nachstartüberwachungszeit abgelaufen für die Fkt.-Überwachung" UBYTE B_TRUE 1 100 0 1 BIT_MASK 0x1 FUNCTION_LIST UFURAM IF_DATA DIM_X 0x382E41 EXTERN WORD IF_DATA MCMESS 0x382E41 EXTERN /end MEASUREMENT
/begin MEASUREMENT B_nsp "Bedingung Nachspritzer" UWORD B_TRUE 1 100 0 1 BIT_MASK 0x100 FUNCTION_LIST BGRLP ACIFI IF_DATA DIM_X 0xFD4E INTERN BYTE IF_DATA MCMESS 0xFD4E INTERN /end MEASUREMENT
/begin MEASUREMENT B_nswo1 "Bedingung Drehzahl > NSWO1" UWORD B_TRUE 1 100 0 1 BIT_MASK 0x4 FUNCTION_LIST PROKON DLLR DTEV ESUKAS FUEDK LLRMR LLRNS LLRRM LRS MDBGV MDVERAD TEB IF_DATA DIM_X 0xFD76 INTERN BYTE IF_DATA MCMESS 0xFD76 INTERN /end MEASUREMENT
/begin MEASUREMENT B_nswo2 "Bedingung Drehzahl > NSWO2" UWORD B_TRUE 1 100 0 1 BIT_MASK 0x8 FUNCTION_LIST PROKON BGRLP ESUK IF_DATA DIM_X 0xFD76 INTERN BYTE IF_DATA MCMESS 0xFD76 INTERN /end MEASUREMENT
/begin MEASUREMENT B_ntini "KR: Bedingung für Initialisierungs-Nulltest" UWORD B_TRUE 1 100 0 1 BIT_MASK 0x4 FUNCTION_LIST GGKS IF_DATA DIM_X 0xFD62 INTERN BYTE IF_DATA MCMESS 0xFD62 INTERN /end MEASUREMENT
/begin MEASUREMENT B_ntolvs "Bedingung Drehzahlschwelle für Ventilhubumsch. Bereich1 ." UWORD B_TRUE 1 100 0 1 BIT_MASK 0x20 FUNCTION_LIST VS IF_DATA DIM_X 0x382CBC EXTERN BYTE IF_DATA MCMESS 0x382CBC EXTERN /end MEASUREMENT
/begin MEASUREMENT B_nvstol "Bedingung Drehzahlschwelle für Ventilhubumsch. Bereich2 überschr." UWORD B_TRUE 1 100 0 1 BIT_MASK 0x40 FUNCTION_LIST VS IF_DATA DIM_X 0x382CBC EXTERN BYTE IF_DATA MCMESS 0x382CBC EXTERN /end MEASUREMENT
/begin MEASUREMENT B_nvstol3 "Bedingung Drehzahlschwelle für Ventilhubumsch. Bereich3 überschritten" UWORD B_TRUE 1 100 0 1 BIT_MASK 0x8000 FUNCTION_LIST VS IF_DATA DIM_X 0x382CBC EXTERN BYTE IF_DATA MCMESS 0x382CBC EXTERN /end MEASUREMENT
/begin MEASUREMENT B_nws "Bedingung Nockenwellensteuerung" UWORD B_TRUE 1 100 0 1 BIT_MASK 0x8000 FUNCTION_LIST NWS DMDSTP DNWKW DNWS DNWSE ESNWS KRKE LRSEB MDVER RKTI T2LID VHW VS IF_DATA DIM_X 0xFD4A INTERN BYTE IF_DATA MCMESS 0xFD4A INTERN /end MEASUREMENT
/begin MEASUREMENT B_nws2 "Ansteuerung NWS-Ventil 2" UWORD B_TRUE 1 100 0 1 BIT_MASK 0x1 FUNCTION_LIST NWS DMDSTP DNWKW DNWS DNWSE T2LID VHW IF_DATA DIM_X 0xFD4C INTERN BYTE IF_DATA MCMESS 0xFD4C INTERN /end MEASUREMENT
/begin MEASUREMENT B_nws2an "Bedingung Nockenwellensteuerung aktiv (Bank2), Fehlermaßnahmen berücksichtigt" UBYTE B_TRUE 1 100 0 1 BIT_MASK 0x2 FUNCTION_LIST NWS IF_DATA DIM_X 0x380B06 EXTERN BYTE IF_DATA MCMESS 0x380B06 EXTERN /end MEASUREMENT
/begin MEASUREMENT B_nwsa "Bedingung Nockenwellensteuerung aktiv (Auslaß,Bank1)" UBYTE B_TRUE 1 100 0 1 BIT_MASK 0x4 FUNCTION_LIST NWS LDRLMX IF_DATA DIM_X 0x380B06 EXTERN BYTE IF_DATA MCMESS 0x380B06 EXTERN /end MEASUREMENT
/begin MEASUREMENT B_nwsaktiv "" UWORD B_TRUE 1 100 0 1 BIT_MASK 0x20 FUNCTION_LIST ACIFI IF_DATA DIM_X 0xFD3E INTERN BYTE IF_DATA MCMESS 0xFD3E INTERN /end MEASUREMENT
/begin MEASUREMENT B_nwsalt "" UWORD B_TRUE 1 100 0 1 BIT_MASK 0x40 FUNCTION_LIST ACIFI IF_DATA DIM_X 0xFD3E INTERN BYTE IF_DATA MCMESS 0xFD3E INTERN /end MEASUREMENT
/begin MEASUREMENT B_nwsan "Bedingung Nockenwellensteuerung aktiv (Bank1), Fehlermaßnahmen berücksichtigt" UBYTE B_TRUE 1 100 0 1 BIT_MASK 0x8 FUNCTION_LIST NWS IF_DATA DIM_X 0x380B06 EXTERN BYTE IF_DATA MCMESS 0x380B06 EXTERN /end MEASUREMENT
/begin MEASUREMENT B_nwsfa "Bedingung Fehler NWS-Stellerdiagnose in Aktiv-Position" UWORD B_TRUE 1 100 0 1 BIT_MASK 0x8 FUNCTION_LIST DNWS IF_DATA DIM_X 0xFD4A INTERN BYTE IF_DATA MCMESS 0xFD4A INTERN /end MEASUREMENT
/begin MEASUREMENT B_nwsfa2 "Bedingung Fehler NWS-Stellerdiagnose in Aktiv-Position der Nockenwelle 2" UWORD B_TRUE 1 100 0 1 BIT_MASK 0x10 FUNCTION_LIST DNWS IF_DATA DIM_X 0xFD4A INTERN BYTE IF_DATA MCMESS 0xFD4A INTERN /end MEASUREMENT
/begin MEASUREMENT B_nwsfp "Bedingung Fehler NWS-Stellerdiagnose in Passiv-Position" UWORD B_TRUE 1 100 0 1 BIT_MASK 0x20 FUNCTION_LIST DNWS IF_DATA DIM_X 0xFD4A INTERN BYTE IF_DATA MCMESS 0xFD4A INTERN /end MEASUREMENT
/begin MEASUREMENT B_nwsfp2 "Bedingung Fehler NWS-Stellerdiagnose in Passiv-Position der Nockenwelle 2" UWORD B_TRUE 1 100 0 1 BIT_MASK 0x40 FUNCTION_LIST DNWS IF_DATA DIM_X 0xFD4A INTERN BYTE IF_DATA MCMESS 0xFD4A INTERN /end MEASUREMENT
/begin MEASUREMENT B_nwsfu "Nockenwellensteuerung Funktional erlaubt (ohne Bedingung B_nwsa)" UBYTE B_TRUE 1 100 0 1 BIT_MASK 0x10 FUNCTION_LIST NWS IF_DATA DIM_X 0x380B06 EXTERN BYTE IF_DATA MCMESS 0x380B06 EXTERN /end MEASUREMENT
/begin MEASUREMENT B_nwsl "Lokale Bedingung Ventilbestromung" UBYTE B_TRUE 1 100 0 1 BIT_MASK 0x20 FUNCTION_LIST NWS IF_DATA DIM_X 0x380B06 EXTERN BYTE IF_DATA MCMESS 0x380B06 EXTERN /end MEASUREMENT
/begin MEASUREMENT B_nwsl2 "Lokale Bedingung Ventilbestromung 2" UBYTE B_TRUE 1 100 0 1 BIT_MASK 0x40 FUNCTION_LIST NWS IF_DATA DIM_X 0x380B06 EXTERN BYTE IF_DATA MCMESS 0x380B06 EXTERN /end MEASUREMENT
/begin MEASUREMENT B_nwslra "Bedingung LR ábschalten durch NWS" UWORD B_TRUE 1 100 0 1 BIT_MASK 0x2000 FUNCTION_LIST ESNWS IF_DATA DIM_X 0xFD52 INTERN BYTE IF_DATA MCMESS 0xFD52 INTERN /end MEASUREMENT
/begin MEASUREMENT B_nwslst "Bedingung Ventilbestromung vor Gangverzögerung" UBYTE B_TRUE 1 100 0 1 BIT_MASK 0x80 FUNCTION_LIST NWS IF_DATA DIM_X 0x380B06 EXTERN BYTE IF_DATA MCMESS 0x380B06 EXTERN /end MEASUREMENT
/begin MEASUREMENT B_nwslst2 "Bedingung Ventilbestromung 2 vor Gangverzögerung" UBYTE B_TRUE 1 100 0 1 BIT_MASK 0x1 FUNCTION_LIST NWS IF_DATA DIM_X 0x380B07 EXTERN BYTE IF_DATA MCMESS 0x380B07 EXTERN /end MEASUREMENT
/begin MEASUREMENT B_nwsta "Bedingung NWS-Stelleransteuerung Diagnose" UWORD B_TRUE 1 100 0 1 BIT_MASK 0x100 FUNCTION_LIST T2STA DMDSTP NWS IF_DATA DIM_X 0xFD06 INTERN BYTE IF_DATA MCMESS 0xFD06 INTERN /end MEASUREMENT
/begin MEASUREMENT B_nwsta2 "Bedingung NWS-Stelleransteuerung Diagnose Nockenwelle 2" UWORD B_TRUE 1 100 0 1 BIT_MASK 0x200 FUNCTION_LIST T2STA DMDSTP NWS IF_DATA DIM_X 0xFD06 INTERN BYTE IF_DATA MCMESS 0xFD06 INTERN /end MEASUREMENT
/begin MEASUREMENT B_nwsvf "Bedingung NWS-Verstellung im Frühanschlag" UWORD B_TRUE 1 100 0 1 BIT_MASK 0x80 FUNCTION_LIST DNWS WANWKW IF_DATA DIM_X 0xFD4A INTERN BYTE IF_DATA MCMESS 0xFD4A INTERN /end MEASUREMENT
/begin MEASUREMENT B_nwsvf2 "Bedingung NWS-Verstellung 2 im Frühanschlag" UWORD B_TRUE 1 100 0 1 BIT_MASK 0x100 FUNCTION_LIST DNWS WANWKW IF_DATA DIM_X 0xFD4A INTERN BYTE IF_DATA MCMESS 0xFD4A INTERN /end MEASUREMENT
/begin MEASUREMENT B_nwsvs "Bedingung NWS-Verstellung im Spätanschlag" UWORD B_TRUE 1 100 0 1 BIT_MASK 0x200 FUNCTION_LIST DNWS IF_DATA DIM_X 0xFD4A INTERN BYTE IF_DATA MCMESS 0xFD4A INTERN /end MEASUREMENT
/begin MEASUREMENT B_nwsvs2 "Bedingung NWS-Verstellung 2 im Spätanschlag" UWORD B_TRUE 1 100 0 1 BIT_MASK 0x400 FUNCTION_LIST DNWS IF_DATA DIM_X 0xFD4A INTERN BYTE IF_DATA MCMESS 0xFD4A INTERN /end MEASUREMENT
/begin MEASUREMENT B_nwsvsa "Bedingung NWS verbietet Ventilhubumschaltung" UWORD B_TRUE 1 100 0 1 BIT_MASK 0x10 FUNCTION_LIST VS IF_DATA DIM_X 0x382CBC EXTERN BYTE IF_DATA MCMESS 0x382CBC EXTERN /end MEASUREMENT
/begin MEASUREMENT B_nwsvsan "Bedingung NWS-Verstellung im Fühanschlag" UWORD B_TRUE 1 100 0 1 BIT_MASK 0x1 FUNCTION_LIST VS IF_DATA DIM_X 0xFD8E INTERN BYTE IF_DATA MCMESS 0xFD8E INTERN /end MEASUREMENT
/begin MEASUREMENT B_nwvls "Bedingung Drehzahlkriterium für Vollastzündwinkel Motorschutz erfüllt." UWORD B_TRUE 1 100 0 1 BIT_MASK 0x8000 FUNCTION_LIST ZWBTSK IF_DATA DIM_X 0xFD8E INTERN BYTE IF_DATA MCMESS 0xFD8E INTERN /end MEASUREMENT
/begin MEASUREMENT B_nwzwangs "Bedingung NW-Zwangsverstellung nach spät wegen erkanntem Fehler" UWORD B_TRUE 1 100 0 1 BIT_MASK 0x2 FUNCTION_LIST NWS LDRLMX IF_DATA DIM_X 0xFD4C INTERN BYTE IF_DATA MCMESS 0xFD4C INTERN /end MEASUREMENT
/begin MEASUREMENT B_nw_s "Zustandsinformation NW sicher in Spätstellung" UWORD B_TRUE 1 100 0 1 BIT_MASK 0x4 FUNCTION_LIST NWS WANWKW IF_DATA DIM_X 0xFD4C INTERN BYTE IF_DATA MCMESS 0xFD4C INTERN /end MEASUREMENT
/begin MEASUREMENT B_optpherk "Bedingung geeigneter Motorbetriebszustand für Phasenerkennung" UWORD B_TRUE 1 100 0 1 BIT_MASK 0x4 FUNCTION_LIST NLPH IF_DATA DIM_X 0xFD1A INTERN BYTE IF_DATA MCMESS 0xFD1A INTERN /end MEASUREMENT
/begin MEASUREMENT B_pegpos "Bedingung: Positiover Flankenwechsel im Crashsignal erkannt" UBYTE B_TRUE 1 100 0 1 BIT_MASK 0x80 FUNCTION_LIST GGAIRB IF_DATA DIM_X 0x380D21 EXTERN BYTE IF_DATA MCMESS 0x380D21 EXTERN /end MEASUREMENT
/begin MEASUREMENT B_pgxqsyn "Umschaltbedingung Phasengeber PG/PG2 für Schnellstart" UWORD B_TRUE 1 100 0 1 BIT_MASK 0x2 FUNCTION_LIST GGDPG IF_DATA DIM_X 0xFD14 INTERN BYTE IF_DATA MCMESS 0xFD14 INTERN /end MEASUREMENT
/begin MEASUREMENT B_pha2act "Bedingung Signal Phasensensor 2 high activ" UWORD B_TRUE 1 100 0 1 BIT_MASK 0x4 FUNCTION_LIST GGDPG NLPH IF_DATA DIM_X 0xFD14 INTERN BYTE IF_DATA MCMESS 0xFD14 INTERN /end MEASUREMENT
/begin MEASUREMENT B_phaact "Bedingung Signal Phasensensor 1 high activ" UWORD B_TRUE 1 100 0 1 BIT_MASK 0x8 FUNCTION_LIST GGDPG NLPH IF_DATA DIM_X 0xFD14 INTERN BYTE IF_DATA MCMESS 0xFD14 INTERN /end MEASUREMENT
/begin MEASUREMENT B_phad "Adaption Kurbel/Nockenwelle erfolgt" UBYTE B_TRUE 1 100 0 1 BIT_MASK 0x1 FUNCTION_LIST WANWKW DNWS DPH GGDPG NLDG IF_DATA DIM_X 0x382FDC EXTERN BYTE IF_DATA MCMESS 0x382FDC EXTERN /end MEASUREMENT
/begin MEASUREMENT B_phad2 "Adaption Kurbel-/Nockenwelle 2 erfolgt" UBYTE B_TRUE 1 100 0 1 BIT_MASK 0x2 FUNCTION_LIST WANWKW DNWS DPH GGDPG NLDG IF_DATA DIM_X 0x382FDC EXTERN BYTE IF_DATA MCMESS 0x382FDC EXTERN /end MEASUREMENT
/begin MEASUREMENT B_phas2 "Bedingung Phase 2 low/high" UWORD B_TRUE 1 100 0 1 BIT_MASK 0x10 FUNCTION_LIST GGDPG DPH PHAS IF_DATA DIM_X 0xFD14 INTERN BYTE IF_DATA MCMESS 0xFD14 INTERN /end MEASUREMENT
/begin MEASUREMENT B_phase "Bedingung Phase low/high" UWORD B_TRUE 1 100 0 1 BIT_MASK 0x20 FUNCTION_LIST GGDPG DPH PHAS IF_DATA DIM_X 0xFD14 INTERN BYTE IF_DATA MCMESS 0xFD14 INTERN /end MEASUREMENT
/begin MEASUREMENT B_phexor "Zwei unterste Bits von phph sind ungleich" UBYTE B_TRUE 1 100 0 1 BIT_MASK 0x1 FUNCTION_LIST DPH IF_DATA DIM_X 0x380A22 EXTERN BYTE IF_DATA MCMESS 0x380A22 EXTERN /end MEASUREMENT
/begin MEASUREMENT B_phexor2 "Zwei unterste Bits von phpw2 sind ungleich" UBYTE B_TRUE 1 100 0 1 BIT_MASK 0x10 FUNCTION_LIST DPH IF_DATA DIM_X 0x380A22 EXTERN BYTE IF_DATA MCMESS 0x380A22 EXTERN /end MEASUREMENT
/begin MEASUREMENT B_phfalse "SW generierte Phasenpegelinformation ist unplausibel" UWORD B_TRUE 1 100 0 1 BIT_MASK 0x4 FUNCTION_LIST NLDG IF_DATA DIM_X 0xFD18 INTERN BYTE IF_DATA MCMESS 0xFD18 INTERN /end MEASUREMENT
/begin MEASUREMENT B_phnegtiv "Bedingung gibt an, ob der Interrupt von einer negativen Flanke ausgelöst wurde" UWORD B_TRUE 1 100 0 1 BIT_MASK 0x8 FUNCTION_LIST NLDG PHAS IF_DATA DIM_X 0xFD18 INTERN BYTE IF_DATA MCMESS 0xFD18 INTERN /end MEASUREMENT
/begin MEASUREMENT B_phnldg "Phasenlage aus Notlauf DG" UWORD B_TRUE 1 100 0 1 BIT_MASK 0x10 FUNCTION_LIST NLDG GGDPG IF_DATA DIM_X 0xFD18 INTERN BYTE IF_DATA MCMESS 0xFD18 INTERN /end MEASUREMENT
/begin MEASUREMENT B_phregok "Kein Fehlmuster im Phasenregister 1" UBYTE B_TRUE 1 100 0 1 BIT_MASK 0x2 FUNCTION_LIST DPH IF_DATA DIM_X 0x380A22 EXTERN BYTE IF_DATA MCMESS 0x380A22 EXTERN /end MEASUREMENT
/begin MEASUREMENT B_phregok2 "Kein Fehlmuster im Phasenregister 2" UBYTE B_TRUE 1 100 0 1 BIT_MASK 0x20 FUNCTION_LIST DPH IF_DATA DIM_X 0x380A22 EXTERN BYTE IF_DATA MCMESS 0x380A22 EXTERN /end MEASUREMENT
/begin MEASUREMENT B_phsnl "Bedingung Phasensuche während PG-Notlauf" UWORD B_TRUE 1 100 0 1 BIT_MASK 0x8 FUNCTION_LIST NLPH AEVAB DMDSTP IF_DATA DIM_X 0xFD1A INTERN BYTE IF_DATA MCMESS 0xFD1A INTERN /end MEASUREMENT
/begin MEASUREMENT B_phsnlab "Bedingung Phasensuche während PG-Notlauf abgeschlossen" UWORD B_TRUE 1 100 0 1 BIT_MASK 0x10 FUNCTION_LIST NLPH IF_DATA DIM_X 0xFD1A INTERN BYTE IF_DATA MCMESS 0xFD1A INTERN /end MEASUREMENT
/begin MEASUREMENT B_phsnlinv "Bedingung Phaselage invertieren" UWORD B_TRUE 1 100 0 1 BIT_MASK 0x20 FUNCTION_LIST NLPH ALE IF_DATA DIM_X 0xFD1A INTERN BYTE IF_DATA MCMESS 0xFD1A INTERN /end MEASUREMENT
/begin MEASUREMENT B_phsnlok "Bedingung Phasensuche während PG-Notlauf erfolgreich" UWORD B_TRUE 1 100 0 1 BIT_MASK 0x40 FUNCTION_LIST NLPH IF_DATA DIM_X 0xFD1A INTERN BYTE IF_DATA MCMESS 0xFD1A INTERN /end MEASUREMENT
/begin MEASUREMENT B_phsok "Bedingung Phasensignal ok" UWORD B_TRUE 1 100 0 1 BIT_MASK 0x10 FUNCTION_LIST DPH GGDPG NLDG NLPH IF_DATA DIM_X 0xFD12 INTERN BYTE IF_DATA MCMESS 0xFD12 INTERN /end MEASUREMENT
/begin MEASUREMENT B_phsok2 "Bedingung Phasensignal 2 ok" UWORD B_TRUE 1 100 0 1 BIT_MASK 0x20 FUNCTION_LIST DPH GGDPG NLDG NLPH IF_DATA DIM_X 0xFD12 INTERN BYTE IF_DATA MCMESS 0xFD12 INTERN /end MEASUREMENT
/begin MEASUREMENT B_phw "Bedingung Phasenwechsel seit letztem Zahn während BM-Suche" UWORD B_TRUE 1 100 0 1 BIT_MASK 0x40 FUNCTION_LIST GGDPG IF_DATA DIM_X 0xFD14 INTERN BYTE IF_DATA MCMESS 0xFD14 INTERN /end MEASUREMENT
/begin MEASUREMENT B_phw2 "Bedingung Phasenwechsel 2. PG während letztem Zahn in BM-Suche" UWORD B_TRUE 1 100 0 1 BIT_MASK 0x80 FUNCTION_LIST GGDPG IF_DATA DIM_X 0xFD14 INTERN BYTE IF_DATA MCMESS 0xFD14 INTERN /end MEASUREMENT
/begin MEASUREMENT B_phwneg "Bedingung negative Phasenflanke im Schnellstart ausgewertet" UWORD B_TRUE 1 100 0 1 BIT_MASK 0x100 FUNCTION_LIST GGDPG IF_DATA DIM_X 0xFD14 INTERN BYTE IF_DATA MCMESS 0xFD14 INTERN /end MEASUREMENT
/begin MEASUREMENT B_phwok "Bedingung Phasenwechsel erkannt" UWORD B_TRUE 1 100 0 1 BIT_MASK 0x200 FUNCTION_LIST GGDPG IF_DATA DIM_X 0xFD14 INTERN BYTE IF_DATA MCMESS 0xFD14 INTERN /end MEASUREMENT
/begin MEASUREMENT B_phwok2 "Bedingung Phasenwechsel PG2 erkannt" UWORD B_TRUE 1 100 0 1 BIT_MASK 0x400 FUNCTION_LIST GGDPG IF_DATA DIM_X 0xFD14 INTERN BYTE IF_DATA MCMESS 0xFD14 INTERN /end MEASUREMENT
/begin MEASUREMENT B_phwpos "Bedingung positive Phasenflanke im Schnellstart ausgewertet" UWORD B_TRUE 1 100 0 1 BIT_MASK 0x800 FUNCTION_LIST GGDPG IF_DATA DIM_X 0xFD14 INTERN BYTE IF_DATA MCMESS 0xFD14 INTERN /end MEASUREMENT
/begin MEASUREMENT B_plok "Plausibilität der FSE-Werte in allen Drehzahlbereichen gegeben" UWORD B_TRUE 1 100 0 1 BIT_MASK 0x10 FUNCTION_LIST DMDFON IF_DATA DIM_X 0xFD0C INTERN BYTE IF_DATA MCMESS 0xFD0C INTERN /end MEASUREMENT
/begin MEASUREMENT B_plok01 "Plausibilität der FSE-Werte im Drehzahlbereich 01 gegeben" UBYTE B_TRUE 1 100 0 1 BIT_MASK 0x1 FUNCTION_LIST DMDFON IF_DATA DIM_X 0x382F14 EXTERN WORD IF_DATA MCMESS 0x382F14 EXTERN /end MEASUREMENT
/begin MEASUREMENT B_plok02 "Plausibilität der FSE-Werte im Drehzahlbereich 02 gegeben" UBYTE B_TRUE 1 100 0 1 BIT_MASK 0x2 FUNCTION_LIST DMDFON IF_DATA DIM_X 0x382F14 EXTERN WORD IF_DATA MCMESS 0x382F14 EXTERN /end MEASUREMENT
/begin MEASUREMENT B_plok03 "Plausibilität der FSE-Werte im Drehzahlbereich 03 gegeben" UBYTE B_TRUE 1 100 0 1 BIT_MASK 0x4 FUNCTION_LIST DMDFON IF_DATA DIM_X 0x382F14 EXTERN WORD IF_DATA MCMESS 0x382F14 EXTERN /end MEASUREMENT
/begin MEASUREMENT B_plok04 "Plausibilität der FSE-Werte im Drehzahlbereich 04 gegeben" UBYTE B_TRUE 1 100 0 1 BIT_MASK 0x8 FUNCTION_LIST DMDFON IF_DATA DIM_X 0x382F14 EXTERN WORD IF_DATA MCMESS 0x382F14 EXTERN /end MEASUREMENT
/begin MEASUREMENT B_plok05 "Plausibilität der FSE-Werte im Drehzahlbereich 05 gegeben" UBYTE B_TRUE 1 100 0 1 BIT_MASK 0x10 FUNCTION_LIST DMDFON IF_DATA DIM_X 0x382F14 EXTERN WORD IF_DATA MCMESS 0x382F14 EXTERN /end MEASUREMENT
/begin MEASUREMENT B_plok06 "Plausibilität der FSE-Werte im Drehzahlbereich 06 gegeben" UBYTE B_TRUE 1 100 0 1 BIT_MASK 0x20 FUNCTION_LIST DMDFON IF_DATA DIM_X 0x382F14 EXTERN WORD IF_DATA MCMESS 0x382F14 EXTERN /end MEASUREMENT
/begin MEASUREMENT B_plok07 "Plausibilität der FSE-Werte im Drehzahlbereich 07 gegeben" UBYTE B_TRUE 1 100 0 1 BIT_MASK 0x40 FUNCTION_LIST DMDFON IF_DATA DIM_X 0x382F14 EXTERN WORD IF_DATA MCMESS 0x382F14 EXTERN /end MEASUREMENT
/begin MEASUREMENT B_plok08 "Plausibilität der FSE-Werte im Drehzahlbereich 08 gegeben" UBYTE B_TRUE 1 100 0 1 BIT_MASK 0x80 FUNCTION_LIST DMDFON IF_DATA DIM_X 0x382F14 EXTERN WORD IF_DATA MCMESS 0x382F14 EXTERN /end MEASUREMENT
/begin MEASUREMENT B_plokn_m "Monitor, Plausibilität der FSE-Werte im aktuellen Drehzahlbereich gegeben" UBYTE B_TRUE 1 100 0 1 BIT_MASK 0x80 FUNCTION_LIST DMDFON IF_DATA DIM_X 0xE3F0 INTERN WORD IF_DATA MCMESS 0xE3F0 INTERN /end MEASUREMENT
/begin MEASUREMENT B_plra "Bedingung für Umschaltung DKVS von HFM- auf P-System" UWORD B_TRUE 1 100 0 1 BIT_MASK 0x100 FUNCTION_LIST DKVS IF_DATA DIM_X 0xFD52 INTERN BYTE IF_DATA MCMESS 0xFD52 INTERN /end MEASUREMENT
/begin MEASUREMENT B_plsolap "Umschaltbedingung: Soll-Ladedruck auf Applikationssolladedruck" UWORD B_TRUE 1 100 0 1 BIT_MASK 0x10 FUNCTION_LIST PROKON FUEDK IF_DATA DIM_X 0xFD76 INTERN BYTE IF_DATA MCMESS 0xFD76 INTERN /end MEASUREMENT
/begin MEASUREMENT B_pltab "Bedingung Plausibilitätsprüfung Abstellzeit möglich" UWORD B_TRUE 1 100 0 1 BIT_MASK 0x4000 FUNCTION_LIST BGTABS IF_DATA DIM_X 0xFD4E INTERN BYTE IF_DATA MCMESS 0xFD4E INTERN /end MEASUREMENT
/begin MEASUREMENT B_pn "Bedingung für Fahrstufe P oder N" UWORD B_TRUE 1 100 0 1 BIT_MASK 0x4000 FUNCTION_LIST SWADP LLRNS IF_DATA DIM_X 0xFD84 INTERN BYTE IF_DATA MCMESS 0xFD84 INTERN /end MEASUREMENT
/begin MEASUREMENT B_polvs "" UWORD B_TRUE 1 100 0 1 BIT_MASK 0x80 FUNCTION_LIST VS IF_DATA DIM_X 0x382CBC EXTERN BYTE IF_DATA MCMESS 0x382CBC EXTERN /end MEASUREMENT
/begin MEASUREMENT B_priph "Bedingung Port schalten für Pumpimpuls hinter KAT" UWORD B_TRUE 1 100 0 1 BIT_MASK 0x40 FUNCTION_LIST GGLSH VHW IF_DATA DIM_X 0xFD2C INTERN BYTE IF_DATA MCMESS 0xFD2C INTERN /end MEASUREMENT
/begin MEASUREMENT B_priph2 "Bedingung Port schalten für Pumpimpuls hinter KAT Bank2" UWORD B_TRUE 1 100 0 1 BIT_MASK 0x80 FUNCTION_LIST GGLSH VHW IF_DATA DIM_X 0xFD2C INTERN BYTE IF_DATA MCMESS 0xFD2C INTERN /end MEASUREMENT
/begin MEASUREMENT B_pspaus "Bedingung LR inaktiv bei projektspez. AUS-Bedingungen" UWORD B_TRUE 1 100 0 1 BIT_MASK 0x10 FUNCTION_LIST LRSEB IF_DATA DIM_X 0xFD7E INTERN BYTE IF_DATA MCMESS 0xFD7E INTERN /end MEASUREMENT
/begin MEASUREMENT B_pspwl "Bedingung LR inaktiv bei projektspez. Warmlauf-Bedingungen" UWORD B_TRUE 1 100 0 1 BIT_MASK 0x20 FUNCTION_LIST LRSEB IF_DATA DIM_X 0xFD7E INTERN BYTE IF_DATA MCMESS 0xFD7E INTERN /end MEASUREMENT
/begin MEASUREMENT B_pssngrd "Bedingung negativer Gradient des Soll-Saugrohrdrucks" UWORD B_TRUE 1 100 0 1 BIT_MASK 0x4000 FUNCTION_LIST BGMSZS IF_DATA DIM_X 0xFD46 INTERN BYTE IF_DATA MCMESS 0xFD46 INTERN /end MEASUREMENT
/begin MEASUREMENT B_psspgrd "Bedingung positiver Gradient des Soll-Saugrohrdrucks" UWORD B_TRUE 1 100 0 1 BIT_MASK 0x8000 FUNCTION_LIST BGMSZS IF_DATA DIM_X 0xFD46 INTERN BYTE IF_DATA MCMESS 0xFD46 INTERN /end MEASUREMENT
/begin MEASUREMENT B_pullup "Bedingung Pullup-Widerstand für NTC zugeschaltet" UBYTE B_TRUE 1 100 0 1 BIT_MASK 0x1 FUNCTION_LIST GGTFM IF_DATA DIM_X 0x380B55 EXTERN BYTE IF_DATA MCMESS 0x380B55 EXTERN /end MEASUREMENT
/begin MEASUREMENT B_pump "Bedingung Starten des Timers TTGLS" UWORD B_TRUE 1 100 0 1 BIT_MASK 0x100 FUNCTION_LIST GGLSH IF_DATA DIM_X 0xFD2C INTERN BYTE IF_DATA MCMESS 0xFD2C INTERN /end MEASUREMENT
/begin MEASUREMENT B_pvl1 "Bedingung Pumpenvorlauf bei Systemen mit Uhr" UBYTE B_TRUE 1 100 0 1 BIT_MASK 0x1 FUNCTION_LIST AEKP IF_DATA DIM_X 0x380D1F EXTERN BYTE IF_DATA MCMESS 0x380D1F EXTERN /end MEASUREMENT
/begin MEASUREMENT B_pvl2 "Bedingung Pumpenvorlauf bei Systemen ohne Uhr" UBYTE B_TRUE 1 100 0 1 BIT_MASK 0x2 FUNCTION_LIST AEKP IF_DATA DIM_X 0x380D1F EXTERN BYTE IF_DATA MCMESS 0x380D1F EXTERN /end MEASUREMENT
/begin MEASUREMENT B_pvlnl "Bedingung EKP-Vorlauf aus Nachlaufzeitüberschreitung" UBYTE B_TRUE 1 100 0 1 BIT_MASK 0x1 FUNCTION_LIST AEKP IF_DATA DIM_X 0x38311D EXTERN BYTE IF_DATA MCMESS 0x38311D EXTERN /end MEASUREMENT
/begin MEASUREMENT B_pwf "Bedingung Powerfail" UWORD B_TRUE 1 100 0 1 BIT_MASK 0x1 FUNCTION_LIST STARTUPF ADVE AMUENE ATM BGCVN BGDVE BGMSZS BGTABS DDCY DDG DDVE DEKON2 DFPM DHLSU DIMC DKATLRS DKRNT DKRS DKRTP DKVS DLSAHK DLSH DLSSA DLSU DMDMIL DPH DSLSLRS DTEV DTOP DWUC _EEPROM ESSTT ESUKAS GGDPG GGEGAS GGFST GGLSU GGPED GGTFA GGTFM GGTFOL GGTFUMG HLSU KRDY KRRA LDRLMX LDRPID LRA LRSHK MDVERAD MOTAUS STA STADAP WANWKW WFS IF_DATA DIM_X 0xFD82 INTERN BYTE IF_DATA MCMESS 0xFD82 INTERN /end MEASUREMENT
/begin MEASUREMENT B_pwgbwf "Bedingung PWG-Bewegungsfehler" UBYTE B_TRUE 1 100 0 1 BIT_MASK 0x80 FUNCTION_LIST GGPED IF_DATA DIM_X 0x380AC2 EXTERN BYTE IF_DATA MCMESS 0x380AC2 EXTERN /end MEASUREMENT
/begin MEASUREMENT B_pwgnotfr "FR-Fehlerreaktion PWG-Notfahren" UWORD B_TRUE 1 100 0 1 BIT_MASK 0x10 FUNCTION_LIST GGPED BBFGR DUF MDEX T2LID UFSPSC IF_DATA DIM_X 0xFD3C INTERN BYTE IF_DATA MCMESS 0xFD3C INTERN /end MEASUREMENT
/begin MEASUREMENT B_pwgnotum "= b_pwgnot_um Funktionsüberwachungs-Fehlerreaktion PWG-Leerlauf (= b_pwgnot_sr)" UWORD B_TRUE 1 100 0 1 BIT_MASK 0x8 FUNCTION_LIST UFSPSC GGPED URADCC IF_DATA DIM_X 0xFD78 INTERN BYTE IF_DATA MCMESS 0xFD78 INTERN /end MEASUREMENT
/begin MEASUREMENT B_pwmaca "" UWORD B_TRUE 1 100 0 1 BIT_MASK 0x1 FUNCTION_LIST VHW KOLS IF_DATA DIM_X 0xFD5E INTERN BYTE IF_DATA MCMESS 0xFD5E INTERN /end MEASUREMENT
/begin MEASUREMENT B_pwrsv "Bedingung: DV-E-powersave ist aktiv" UWORD B_TRUE 1 100 0 1 BIT_MASK 0x8000 FUNCTION_LIST ADVE IF_DATA DIM_X 0xFD32 INTERN BYTE IF_DATA MCMESS 0xFD32 INTERN /end MEASUREMENT
/begin MEASUREMENT B_pyhshe "" UWORD B_TRUE 1 100 0 1 BIT_MASK 0x2000 FUNCTION_LIST DFPM_DEKON IF_DATA DIM_X 0x383892 EXTERN BYTE IF_DATA MCMESS 0x383892 EXTERN /end MEASUREMENT
/begin MEASUREMENT B_pyhshe2 "" UWORD B_TRUE 1 100 0 1 BIT_MASK 0x2000 FUNCTION_LIST DFPM_DEKON IF_DATA DIM_X 0x383894 EXTERN BYTE IF_DATA MCMESS 0x383894 EXTERN /end MEASUREMENT
/begin MEASUREMENT B_pykwave "" UWORD B_TRUE 1 100 0 1 BIT_MASK 0x2000 FUNCTION_LIST DFPM_DEKON IF_DATA DIM_X 0x3838B6 EXTERN BYTE IF_DATA MCMESS 0x3838B6 EXTERN /end MEASUREMENT
/begin MEASUREMENT B_pylde "" UWORD B_TRUE 1 100 0 1 BIT_MASK 0x2000 FUNCTION_LIST DFPM_DEKON IF_DATA DIM_X 0x3838BC EXTERN BYTE IF_DATA MCMESS 0x3838BC EXTERN /end MEASUREMENT
/begin MEASUREMENT B_pynwse "" UWORD B_TRUE 1 100 0 1 BIT_MASK 0x2000 FUNCTION_LIST DFPM_DEKON IF_DATA DIM_X 0x3838F4 EXTERN BYTE IF_DATA MCMESS 0x3838F4 EXTERN /end MEASUREMENT
/begin MEASUREMENT B_pynwse2 "" UWORD B_TRUE 1 100 0 1 BIT_MASK 0x2000 FUNCTION_LIST DFPM_DEKON IF_DATA DIM_X 0x3838F6 EXTERN BYTE IF_DATA MCMESS 0x3838F6 EXTERN /end MEASUREMENT
/begin MEASUREMENT B_pytes "Leckdiagnose ist physikalisch freigegeben" UWORD B_TRUE 1 100 0 1 BIT_MASK 0x2000 FUNCTION_LIST DFPM_DTEV IF_DATA DIM_X 0x383916 EXTERN BYTE IF_DATA MCMESS 0x383916 EXTERN /end MEASUREMENT
/begin MEASUREMENT B_qsyn "Bedingung Schnelle Synchronisation (quick)" UWORD B_TRUE 1 100 0 1 BIT_MASK 0x1000 FUNCTION_LIST GGDPG IF_DATA DIM_X 0xFD14 INTERN BYTE IF_DATA MCMESS 0xFD14 INTERN /end MEASUREMENT
/begin MEASUREMENT B_qtedab "Bedingung schnelle Absteuerung der Spülrate" UWORD B_TRUE 1 100 0 1 BIT_MASK 0x40 FUNCTION_LIST TEBEB TEB IF_DATA DIM_X 0xFD88 INTERN BYTE IF_DATA MCMESS 0xFD88 INTERN /end MEASUREMENT
/begin MEASUREMENT B_ralectr "Bedingung letzte Zahnzeit > TRD" UWORD B_TRUE 1 100 0 1 BIT_MASK 0x10 FUNCTION_LIST ALE IF_DATA DIM_X 0xFD10 INTERN BYTE IF_DATA MCMESS 0xFD10 INTERN /end MEASUREMENT
/begin MEASUREMENT B_raleok "Bedingung letzter Zahn liegt im plausiblen Rückdrehbereich" UWORD B_TRUE 1 100 0 1 BIT_MASK 0x20 FUNCTION_LIST ALE IF_DATA DIM_X 0xFD10 INTERN BYTE IF_DATA MCMESS 0xFD10 INTERN /end MEASUREMENT
/begin MEASUREMENT B_redkl "Freigabe Reduzierung ÜK-K- und -L-Anteil" UWORD B_TRUE 1 100 0 1 BIT_MASK 0x40 FUNCTION_LIST ESUK IF_DATA DIM_X 0xFD54 INTERN BYTE IF_DATA MCMESS 0xFD54 INTERN /end MEASUREMENT
/begin MEASUREMENT B_rehs "Restart Sondenheizung" UWORD B_TRUE 1 100 0 1 BIT_MASK 0x200 FUNCTION_LIST HLSHK IF_DATA DIM_X 0xFD30 INTERN BYTE IF_DATA MCMESS 0xFD30 INTERN /end MEASUREMENT
/begin MEASUREMENT B_resetsyn "Rücksetzbedingung für die Notlaufsynchronisation" UWORD B_TRUE 1 100 0 1 BIT_MASK 0x20 FUNCTION_LIST NLDG IF_DATA DIM_X 0xFD18 INTERN BYTE IF_DATA MCMESS 0xFD18 INTERN /end MEASUREMENT
/begin MEASUREMENT B_res_um "" UBYTE B_TRUE 1 100 0 1 BIT_MASK 0x2 FUNCTION_LIST UFURAM IF_DATA DIM_X 0x382E43 EXTERN WORD IF_DATA MCMESS 0x382E43 EXTERN /end MEASUREMENT
/begin MEASUREMENT B_rfkuka "Bedingung Korrekturfaktor rücksetzen (ÜK-Adaption)" UWORD B_TRUE 1 100 0 1 BIT_MASK 0x100 FUNCTION_LIST ESUKAS IF_DATA DIM_X 0xFD56 INTERN BYTE IF_DATA MCMESS 0xFD56 INTERN /end MEASUREMENT
/begin MEASUREMENT B_rfkuka2 "Bedingung Korrekturfaktor rücksetzen (Bank 2) (ÜK-Adaption)" UWORD B_TRUE 1 100 0 1 BIT_MASK 0x200 FUNCTION_LIST ESUKAS IF_DATA DIM_X 0xFD56 INTERN BYTE IF_DATA MCMESS 0xFD56 INTERN /end MEASUREMENT
/begin MEASUREMENT B_riakh "Bedingung für Strom-Pumpen aktualisiert hinter KAT" UWORD B_TRUE 1 100 0 1 BIT_MASK 0x200 FUNCTION_LIST GGLSH IF_DATA DIM_X 0xFD2C INTERN BYTE IF_DATA MCMESS 0xFD2C INTERN /end MEASUREMENT
/begin MEASUREMENT B_riakh2 "Bedingung für Strom-Pumpen aktualisiert hinter KAT Bank2" UWORD B_TRUE 1 100 0 1 BIT_MASK 0x400 FUNCTION_LIST GGLSH IF_DATA DIM_X 0xFD2C INTERN BYTE IF_DATA MCMESS 0xFD2C INTERN /end MEASUREMENT
/begin MEASUREMENT B_ribeh "Bedingung Innenwiderstand Ri berechnen für Sonde hinter KAT" UWORD B_TRUE 1 100 0 1 BIT_MASK 0x800 FUNCTION_LIST GGLSH IF_DATA DIM_X 0xFD2C INTERN BYTE IF_DATA MCMESS 0xFD2C INTERN /end MEASUREMENT
/begin MEASUREMENT B_ribeh2 "Bedingung Innenwiderstand Ri berechnen für Sonde hinter KAT Bank2" UWORD B_TRUE 1 100 0 1 BIT_MASK 0x1000 FUNCTION_LIST GGLSH IF_DATA DIM_X 0xFD2C INTERN BYTE IF_DATA MCMESS 0xFD2C INTERN /end MEASUREMENT
/begin MEASUREMENT B_riibh "Bedingung Sondenspannung im zulässigen Band für Strompumpen hinter KAT" UWORD B_TRUE 1 100 0 1 BIT_MASK 0x2000 FUNCTION_LIST GGLSH IF_DATA DIM_X 0xFD2C INTERN BYTE IF_DATA MCMESS 0xFD2C INTERN /end MEASUREMENT
/begin MEASUREMENT B_riibh2 "Bedingung Sondenspannung im zulässigen Band für Strompumpen hinter KAT Bank2" UWORD B_TRUE 1 100 0 1 BIT_MASK 0x4000 FUNCTION_LIST GGLSH IF_DATA DIM_X 0xFD2C INTERN BYTE IF_DATA MCMESS 0xFD2C INTERN /end MEASUREMENT
/begin MEASUREMENT B_riimph "Bedingung Impuls für Strom-Pumpen hinter KAT" UWORD B_TRUE 1 100 0 1 BIT_MASK 0x8000 FUNCTION_LIST GGLSH IF_DATA DIM_X 0xFD2C INTERN BYTE IF_DATA MCMESS 0xFD2C INTERN /end MEASUREMENT
/begin MEASUREMENT B_rimh "Bedingung (ADC-Trigger) für Messen belastete Sondenspannung hinter KAT" UWORD B_TRUE 1 100 0 1 BIT_MASK 0x1 FUNCTION_LIST GGLSH IF_DATA DIM_X 0xFD2E INTERN BYTE IF_DATA MCMESS 0xFD2E INTERN /end MEASUREMENT
/begin MEASUREMENT B_rimh2 "Bedingung (ADC-Trigger) für Messen belastete Sondenspannung hinter KAT Bank2" UWORD B_TRUE 1 100 0 1 BIT_MASK 0x2 FUNCTION_LIST GGLSH IF_DATA DIM_X 0xFD2E INTERN BYTE IF_DATA MCMESS 0xFD2E INTERN /end MEASUREMENT
/begin MEASUREMENT B_rinh "Bedingung Innenwiderstand Ri-Messung der Nernstsonde aktiv hinter Kat" UWORD B_TRUE 1 100 0 1 BIT_MASK 0x4 FUNCTION_LIST GGLSH DHLSHK T2LID IF_DATA DIM_X 0xFD2E INTERN BYTE IF_DATA MCMESS 0xFD2E INTERN /end MEASUREMENT
/begin MEASUREMENT B_rinh2 "Bedingung Innenwiderstand Ri-Messung der Nernstsonde aktiv hinter KAT Bank2" UWORD B_TRUE 1 100 0 1 BIT_MASK 0x8 FUNCTION_LIST GGLSH DHLSHK T2LID IF_DATA DIM_X 0xFD2E INTERN BYTE IF_DATA MCMESS 0xFD2E INTERN /end MEASUREMENT
/begin MEASUREMENT B_ripuh "Bedingung Strom-Pumpen für Sonde hinter KAT" UWORD B_TRUE 1 100 0 1 BIT_MASK 0x10 FUNCTION_LIST GGLSH IF_DATA DIM_X 0xFD2E INTERN BYTE IF_DATA MCMESS 0xFD2E INTERN /end MEASUREMENT
/begin MEASUREMENT B_ripuh2 "Bedingung Strom-Pumpen für Sonde hinter KAT Bank2" UWORD B_TRUE 1 100 0 1 BIT_MASK 0x20 FUNCTION_LIST GGLSH IF_DATA DIM_X 0xFD2E INTERN BYTE IF_DATA MCMESS 0xFD2E INTERN /end MEASUREMENT
/begin MEASUREMENT B_ripuv "Bedingung Strom-Pumpen für Sonde vor KAT" UWORD B_TRUE 1 100 0 1 BIT_MASK 0x8000 FUNCTION_LIST SWADP GGLSH IF_DATA DIM_X 0xFD84 INTERN BYTE IF_DATA MCMESS 0xFD84 INTERN /end MEASUREMENT
/begin MEASUREMENT B_ripuv2 "Bedingung Strom-Pumpen für Sonde vor KAT Bank2" UWORD B_TRUE 1 100 0 1 BIT_MASK 0x1 FUNCTION_LIST SWADP GGLSH IF_DATA DIM_X 0xFD86 INTERN BYTE IF_DATA MCMESS 0xFD86 INTERN /end MEASUREMENT
/begin MEASUREMENT B_rireh "Bedingung Resultat für Innenwiderstand Ri für Sonde hinter KAT" UWORD B_TRUE 1 100 0 1 BIT_MASK 0x40 FUNCTION_LIST GGLSH IF_DATA DIM_X 0xFD2E INTERN BYTE IF_DATA MCMESS 0xFD2E INTERN /end MEASUREMENT
/begin MEASUREMENT B_rireh2 "Bedingung Resultat für Innenwiderstand Ri für Sonde hinter KAT Bank2" UWORD B_TRUE 1 100 0 1 BIT_MASK 0x80 FUNCTION_LIST GGLSH IF_DATA DIM_X 0xFD2E INTERN BYTE IF_DATA MCMESS 0xFD2E INTERN /end MEASUREMENT
/begin MEASUREMENT B_risigh "Bedingung Signalunterbrechung Sondenmasse mit Ri-Diagnose hinter KAT" UWORD B_TRUE 1 100 0 1 BIT_MASK 0x1000 FUNCTION_LIST DLSH IF_DATA DIM_X 0xFD28 INTERN BYTE IF_DATA MCMESS 0xFD28 INTERN /end MEASUREMENT
/begin MEASUREMENT B_risigh2 "Bedingung Signalunterbrechung Sondenmasse mit Ri-Diagnose hinter KAT Bank2" UWORD B_TRUE 1 100 0 1 BIT_MASK 0x2000 FUNCTION_LIST DLSH IF_DATA DIM_X 0xFD28 INTERN BYTE IF_DATA MCMESS 0xFD28 INTERN /end MEASUREMENT
/begin MEASUREMENT B_risph "Bedingung Sondensprung hinter KAT" UWORD B_TRUE 1 100 0 1 BIT_MASK 0x100 FUNCTION_LIST GGLSH IF_DATA DIM_X 0xFD2E INTERN BYTE IF_DATA MCMESS 0xFD2E INTERN /end MEASUREMENT
/begin MEASUREMENT B_risph2 "Bedingung Sondensprung hinter KAT Bank2" UWORD B_TRUE 1 100 0 1 BIT_MASK 0x200 FUNCTION_LIST GGLSH IF_DATA DIM_X 0xFD2E INTERN BYTE IF_DATA MCMESS 0xFD2E INTERN /end MEASUREMENT
/begin MEASUREMENT B_rkam "Bedingung einer der beiden additiven Bereiche aktiv" UWORD B_TRUE 1 100 0 1 BIT_MASK 0x200 FUNCTION_LIST DKVS IF_DATA DIM_X 0xFD52 INTERN BYTE IF_DATA MCMESS 0xFD52 INTERN /end MEASUREMENT
/begin MEASUREMENT B_rkamr "Bedingung rkat oder rkaz außerhalb reduzierter Schwellen" UWORD B_TRUE 1 100 0 1 BIT_MASK 0x400 FUNCTION_LIST DKVS IF_DATA DIM_X 0xFD52 INTERN BYTE IF_DATA MCMESS 0xFD52 INTERN /end MEASUREMENT
/begin MEASUREMENT B_rkamr2 "Bedingung rkat2 oder rkaz2 außerhalb reduzierter Schwellen" UWORD B_TRUE 1 100 0 1 BIT_MASK 0x800 FUNCTION_LIST DKVS IF_DATA DIM_X 0xFD52 INTERN BYTE IF_DATA MCMESS 0xFD52 INTERN /end MEASUREMENT
/begin MEASUREMENT B_rkat "Bedingung Lernbereich additive Korrektur pro Zeit aktiv" UWORD B_TRUE 1 100 0 1 BIT_MASK 0x1 FUNCTION_LIST LRA DKVS IF_DATA DIM_X 0xFD5C INTERN BYTE IF_DATA MCMESS 0xFD5C INTERN /end MEASUREMENT
/begin MEASUREMENT B_rkatr "Bedingung rkat-Integrator außerhalb reduzierten Bereich" UWORD B_TRUE 1 100 0 1 BIT_MASK 0x2 FUNCTION_LIST LRA DKVS IF_DATA DIM_X 0xFD5C INTERN BYTE IF_DATA MCMESS 0xFD5C INTERN /end MEASUREMENT
/begin MEASUREMENT B_rkatr2 "Bedingung rkat2-Integrator außerhalb reduzierten Bereich" UWORD B_TRUE 1 100 0 1 BIT_MASK 0x4 FUNCTION_LIST LRA DKVS IF_DATA DIM_X 0xFD5C INTERN BYTE IF_DATA MCMESS 0xFD5C INTERN /end MEASUREMENT
/begin MEASUREMENT B_rkaz "Bedingung Lernbereich additive Korrektur pro Zündung aktiv" UWORD B_TRUE 1 100 0 1 BIT_MASK 0x8 FUNCTION_LIST LRA DKVS IF_DATA DIM_X 0xFD5C INTERN BYTE IF_DATA MCMESS 0xFD5C INTERN /end MEASUREMENT
/begin MEASUREMENT B_rkazr "Bedingung rkaz-Integrator außerhalb reduzierten Bereich" UWORD B_TRUE 1 100 0 1 BIT_MASK 0x10 FUNCTION_LIST LRA DKVS IF_DATA DIM_X 0xFD5C INTERN BYTE IF_DATA MCMESS 0xFD5C INTERN /end MEASUREMENT
/begin MEASUREMENT B_rkazr2 "Bedingung rkaz2-Integrator außerhalb reduzierten Bereich" UWORD B_TRUE 1 100 0 1 BIT_MASK 0x20 FUNCTION_LIST LRA DKVS IF_DATA DIM_X 0xFD5C INTERN BYTE IF_DATA MCMESS 0xFD5C INTERN /end MEASUREMENT
/begin MEASUREMENT B_rlp "Bedingung Lastpraediktion aktiv" UWORD B_TRUE 1 100 0 1 BIT_MASK 0x200 FUNCTION_LIST BGRLP IF_DATA DIM_X 0xFD4E INTERN BYTE IF_DATA MCMESS 0xFD4E INTERN /end MEASUREMENT
/begin MEASUREMENT B_rlpns "Einschaltbedingung Lastpraediktion nach Start" UWORD B_TRUE 1 100 0 1 BIT_MASK 0x400 FUNCTION_LIST BGRLP IF_DATA DIM_X 0xFD4E INTERN BYTE IF_DATA MCMESS 0xFD4E INTERN /end MEASUREMENT
/begin MEASUREMENT B_rmsval "Bedingung relativer Massenstrom TEV fültig" UBYTE B_TRUE 1 100 0 1 BIT_MASK 0x1 FUNCTION_LIST DTEV IF_DATA DIM_X 0x38311B EXTERN BYTE IF_DATA MCMESS 0x38311B EXTERN /end MEASUREMENT
/begin MEASUREMENT B_rphsp "Bedingung für Zahnsignale zu schnell ausgegeben" UWORD B_TRUE 1 100 0 1 BIT_MASK 0x40 FUNCTION_LIST NLDG IF_DATA DIM_X 0xFD18 INTERN BYTE IF_DATA MCMESS 0xFD18 INTERN /end MEASUREMENT
/begin MEASUREMENT B_sa "Bedingung Schubabschalten" UWORD B_TRUE 1 100 0 1 BIT_MASK 0x8000 FUNCTION_LIST MDRED1 ACIFI ARMD ATM DEVE DHLSU DKVS DLLR DLSAHK DLSU DVFZ ESUK ESWE GGLSH GGTFA GGTFM LLRBB LRSEB MDFAW MDFUE MDVER MLS RUNTIME ZUE ZWMIN IF_DATA DIM_X 0xFD6E INTERN BYTE IF_DATA MCMESS 0xFD6E INTERN /end MEASUREMENT
/begin MEASUREMENT B_sab "Bedingung Schubabschaltebereitschaft" UWORD B_TRUE 1 100 0 1 BIT_MASK 0x8 FUNCTION_LIST BBSAWE LLRBB MDAUTG MDFAW MDMIN MDRED1 TEB IF_DATA DIM_X 0xFD68 INTERN BYTE IF_DATA MCMESS 0xFD68 INTERN /end MEASUREMENT
/begin MEASUREMENT B_sabt "Bedingung Schubabschaltebereitschaft" UBYTE B_TRUE 1 100 0 1 BIT_MASK 0x2 FUNCTION_LIST BBSAWE IF_DATA DIM_X 0x380BFF EXTERN BYTE IF_DATA MCMESS 0x380BFF EXTERN /end MEASUREMENT
/begin MEASUREMENT B_sacvt "Bedingung Schubabschaltunterstützung für CVT-Getriebe" UWORD B_TRUE 1 100 0 1 BIT_MASK 0x2 FUNCTION_LIST SWADP BBSAWE IF_DATA DIM_X 0xFD86 INTERN BYTE IF_DATA MCMESS 0xFD86 INTERN /end MEASUREMENT
/begin MEASUREMENT B_savacc "Bedingung: Schubabschalteverbot von ACC" UWORD B_TRUE 1 100 0 1 BIT_MASK 0x4 FUNCTION_LIST SWADP FGRUE IF_DATA DIM_X 0xFD86 INTERN BYTE IF_DATA MCMESS 0xFD86 INTERN /end MEASUREMENT
/begin MEASUREMENT B_savfgr "Bedingung: Schubabschalteverbot durch FGR" UWORD B_TRUE 1 100 0 1 BIT_MASK 0x4000 FUNCTION_LIST FGRUE BBSAWE MDFAW IF_DATA DIM_X 0xFD44 INTERN BYTE IF_DATA MCMESS 0xFD44 INTERN /end MEASUREMENT
/begin MEASUREMENT B_savm "Bedingung: Schubabschalteverbot durch FGR (aus ME)" UWORD B_TRUE 1 100 0 1 BIT_MASK 0x400 FUNCTION_LIST FGRMD FGRUE IF_DATA DIM_X 0xFD44 INTERN BYTE IF_DATA MCMESS 0xFD44 INTERN /end MEASUREMENT
/begin MEASUREMENT B_sbbhk "Bedingung Sonde betriebsbereit hinter Kat" UWORD B_TRUE 1 100 0 1 BIT_MASK 0x4000 FUNCTION_LIST DLSH DKATLRS DLSAHK DLSU LRSHK LRSKA T2DFA IF_DATA DIM_X 0xFD28 INTERN BYTE IF_DATA MCMESS 0xFD28 INTERN /end MEASUREMENT
/begin MEASUREMENT B_sbbhk2 "Bedingung Sonde betriebsbereit hinter Kat Bank2" UWORD B_TRUE 1 100 0 1 BIT_MASK 0x8000 FUNCTION_LIST DLSH DKATLRS DLSAHK DLSU LRSHK LRSKA T2DFA IF_DATA DIM_X 0xFD28 INTERN BYTE IF_DATA MCMESS 0xFD28 INTERN /end MEASUREMENT
/begin MEASUREMENT B_sbblsu "Bedingung LSU betriebsbereit vor Kat f(lamsons_w)" UWORD B_TRUE 1 100 0 1 BIT_MASK 0x2 FUNCTION_LIST GGLSU DSLSLRS LRSEB IF_DATA DIM_X 0xFD30 INTERN BYTE IF_DATA MCMESS 0xFD30 INTERN /end MEASUREMENT
/begin MEASUREMENT B_sbblsu2 "Bedingung LSU betriebsbereit vor Kat, Bank 2 f(lamsons2_w)" UWORD B_TRUE 1 100 0 1 BIT_MASK 0x4 FUNCTION_LIST GGLSU DSLSLRS LRSEB IF_DATA DIM_X 0xFD30 INTERN BYTE IF_DATA MCMESS 0xFD30 INTERN /end MEASUREMENT
/begin MEASUREMENT B_sbbvk "Bedingung Sonde betriebsbereit vor Kat" UWORD B_TRUE 1 100 0 1 BIT_MASK 0x8 FUNCTION_LIST GGLSU DHLSU HLSU LRSKA TEBEB IF_DATA DIM_X 0xFD30 INTERN BYTE IF_DATA MCMESS 0xFD30 INTERN /end MEASUREMENT
/begin MEASUREMENT B_sbbvk2 "Bedingung Sonde betriebsbereit vor Kat, Bank 2" UWORD B_TRUE 1 100 0 1 BIT_MASK 0x10 FUNCTION_LIST GGLSU DHLSU HLSU LRSKA TEBEB IF_DATA DIM_X 0xFD30 INTERN BYTE IF_DATA MCMESS 0xFD30 INTERN /end MEASUREMENT
/begin MEASUREMENT B_schshe "" UWORD B_TRUE 1 100 0 1 BIT_MASK 0x4000 FUNCTION_LIST DFPM_DEKON IF_DATA DIM_X 0x383892 EXTERN BYTE IF_DATA MCMESS 0x383892 EXTERN /end MEASUREMENT
/begin MEASUREMENT B_schshe2 "" UWORD B_TRUE 1 100 0 1 BIT_MASK 0x4000 FUNCTION_LIST DFPM_DEKON IF_DATA DIM_X 0x383894 EXTERN BYTE IF_DATA MCMESS 0x383894 EXTERN /end MEASUREMENT
/begin MEASUREMENT B_sckwave "" UWORD B_TRUE 1 100 0 1 BIT_MASK 0x4000 FUNCTION_LIST DFPM_DEKON IF_DATA DIM_X 0x3838B6 EXTERN BYTE IF_DATA MCMESS 0x3838B6 EXTERN /end MEASUREMENT
/begin MEASUREMENT B_sclde "" UWORD B_TRUE 1 100 0 1 BIT_MASK 0x4000 FUNCTION_LIST DFPM_DEKON IF_DATA DIM_X 0x3838BC EXTERN BYTE IF_DATA MCMESS 0x3838BC EXTERN /end MEASUREMENT
/begin MEASUREMENT B_scnwse "" UWORD B_TRUE 1 100 0 1 BIT_MASK 0x4000 FUNCTION_LIST DFPM_DEKON IF_DATA DIM_X 0x3838F4 EXTERN BYTE IF_DATA MCMESS 0x3838F4 EXTERN /end MEASUREMENT
/begin MEASUREMENT B_scnwse2 "" UWORD B_TRUE 1 100 0 1 BIT_MASK 0x4000 FUNCTION_LIST DFPM_DEKON IF_DATA DIM_X 0x3838F6 EXTERN BYTE IF_DATA MCMESS 0x3838F6 EXTERN /end MEASUREMENT
/begin MEASUREMENT B_sctes "Leckdiagnose ist vom Scheduler freigegeben" UWORD B_TRUE 1 100 0 1 BIT_MASK 0x4000 FUNCTION_LIST DFPM_DTEV IF_DATA DIM_X 0x383916 EXTERN BYTE IF_DATA MCMESS 0x383916 EXTERN /end MEASUREMENT
/begin MEASUREMENT B_shuerf "Bedingung Sondenspannung hinter KAT erfassen" UWORD B_TRUE 1 100 0 1 BIT_MASK 0x400 FUNCTION_LIST GGLSH IF_DATA DIM_X 0xFD2E INTERN BYTE IF_DATA MCMESS 0xFD2E INTERN /end MEASUREMENT
/begin MEASUREMENT B_shuerf2 "Bedingung Sondenspannung hinter KAT erfassen Bank2" UWORD B_TRUE 1 100 0 1 BIT_MASK 0x800 FUNCTION_LIST GGLSH IF_DATA DIM_X 0xFD2E INTERN BYTE IF_DATA MCMESS 0xFD2E INTERN /end MEASUREMENT
/begin MEASUREMENT B_siaave "Fehlerart: Leitungsabfall Absperrventil Aktivkohlefilter (Endstufe)" UWORD B_TRUE 1 100 0 1 BIT_MASK 0x400 FUNCTION_LIST DFPM_DEKON IF_DATA DIM_X 0x383816 EXTERN BYTE IF_DATA MCMESS 0x383816 EXTERN /end MEASUREMENT
/begin MEASUREMENT B_siagre "Fehlertype: Leitungsabfall Endstufe AGR-Ventil" UWORD B_TRUE 1 100 0 1 BIT_MASK 0x400 FUNCTION_LIST DFPM_DUMMY043 IF_DATA DIM_X 0x383818 EXTERN BYTE IF_DATA MCMESS 0x383818 EXTERN /end MEASUREMENT
/begin MEASUREMENT B_sibm "Fehlertyp: keine Bezugsmarke im Start gefunden" UWORD B_TRUE 1 100 0 1 BIT_MASK 0x400 FUNCTION_LIST DFPM_DDG IF_DATA DIM_X 0x38381C EXTERN BYTE IF_DATA MCMESS 0x38381C EXTERN /end MEASUREMENT
/begin MEASUREMENT B_sibrems "Fehlertyp BREMS (Bremsschalter): Signal inaktiv" UWORD B_TRUE 1 100 0 1 BIT_MASK 0x400 FUNCTION_LIST DFPM_GGEGAS IF_DATA DIM_X 0x38381E EXTERN BYTE IF_DATA MCMESS 0x38381E EXTERN /end MEASUREMENT
/begin MEASUREMENT B_sibwf "Fehlertyp sig.: PWG Bewegung" UWORD B_TRUE 1 100 0 1 BIT_MASK 0x400 FUNCTION_LIST DFPM_GGPED IF_DATA DIM_X 0x383820 EXTERN BYTE IF_DATA MCMESS 0x383820 EXTERN /end MEASUREMENT
/begin MEASUREMENT B_sicas "Signalfehler CAN-Timeout ASC-Botschaften" UWORD B_TRUE 1 100 0 1 BIT_MASK 0x400 FUNCTION_LIST DFPM_DCAS IF_DATA DIM_X 0x383822 EXTERN BYTE IF_DATA MCMESS 0x383822 EXTERN /end MEASUREMENT
/begin MEASUREMENT B_sicge "Signalfehler CAN-Timeout EGS-Botschaft" UWORD B_TRUE 1 100 0 1 BIT_MASK 0x400 FUNCTION_LIST DFPM_DCGE IF_DATA DIM_X 0x383824 EXTERN BYTE IF_DATA MCMESS 0x383824 EXTERN /end MEASUREMENT
/begin MEASUREMENT B_sicgegs "Fehlertype: Signalunterbrechung EGS; Steuergerät" UWORD B_TRUE 1 100 0 1 BIT_MASK 0x400 FUNCTION_LIST DFPM_DCG IF_DATA DIM_X 0x383826 EXTERN BYTE IF_DATA MCMESS 0x383826 EXTERN /end MEASUREMENT
/begin MEASUREMENT B_sicgggp "Fehlertype: Signalunterbr. EGS; Gang unplausibel" UWORD B_TRUE 1 100 0 1 BIT_MASK 0x400 FUNCTION_LIST DFPM_DCG IF_DATA DIM_X 0x383828 EXTERN BYTE IF_DATA MCMESS 0x383828 EXTERN /end MEASUREMENT
/begin MEASUREMENT B_sicgggv "Fehlertype: Signalunterbr. EGS; Gangvergleich negativ" UWORD B_TRUE 1 100 0 1 BIT_MASK 0x400 FUNCTION_LIST DFPM_DCG IF_DATA DIM_X 0x38382A EXTERN BYTE IF_DATA MCMESS 0x38382A EXTERN /end MEASUREMENT
/begin MEASUREMENT B_sicgm1v "Fehlertype: Signalunterbrechung EGS; Magnetventil 1-2/4-5 Schaltung" UWORD B_TRUE 1 100 0 1 BIT_MASK 0x400 FUNCTION_LIST DFPM_DCG IF_DATA DIM_X 0x38382C EXTERN BYTE IF_DATA MCMESS 0x38382C EXTERN /end MEASUREMENT
/begin MEASUREMENT B_sicgm2v "Fehlertype: Signalunterbr. EGS; Magnetventil 2-3 Schaltung" UWORD B_TRUE 1 100 0 1 BIT_MASK 0x400 FUNCTION_LIST DFPM_DCG IF_DATA DIM_X 0x38382E EXTERN BYTE IF_DATA MCMESS 0x38382E EXTERN /end MEASUREMENT
/begin MEASUREMENT B_sicgm3v "Fehlertype: Signalunterbr. EGS; Magnetventil 3-4 Schaltung" UWORD B_TRUE 1 100 0 1 BIT_MASK 0x400 FUNCTION_LIST DFPM_DCG IF_DATA DIM_X 0x383830 EXTERN BYTE IF_DATA MCMESS 0x383830 EXTERN /end MEASUREMENT
/begin MEASUREMENT B_sicgmvk "Fehlertype: Signalunterbr. EGS; Magnetventil Wandlerkupplung" UWORD B_TRUE 1 100 0 1 BIT_MASK 0x400 FUNCTION_LIST DFPM_DCG IF_DATA DIM_X 0x383832 EXTERN BYTE IF_DATA MCMESS 0x383832 EXTERN /end MEASUREMENT
/begin MEASUREMENT B_sicgrmm "Fehlertype: Signalunterbr. EGS; Regelmagnetventil Modulierdruck" UWORD B_TRUE 1 100 0 1 BIT_MASK 0x400 FUNCTION_LIST DFPM_DCG IF_DATA DIM_X 0x383834 EXTERN BYTE IF_DATA MCMESS 0x383834 EXTERN /end MEASUREMENT
/begin MEASUREMENT B_sicgrms "Fehlertype: Signalunterbr. EGS; Regelmagnetventil Schaltdruck" UWORD B_TRUE 1 100 0 1 BIT_MASK 0x400 FUNCTION_LIST DFPM_DCG IF_DATA DIM_X 0x383836 EXTERN BYTE IF_DATA MCMESS 0x383836 EXTERN /end MEASUREMENT
/begin MEASUREMENT B_sicgudg "Fehlertype: Signalunterbr. EGS; Versorgungsspannung Drehzahlsensoren" UWORD B_TRUE 1 100 0 1 BIT_MASK 0x400 FUNCTION_LIST DFPM_DCG IF_DATA DIM_X 0x383838 EXTERN BYTE IF_DATA MCMESS 0x383838 EXTERN /end MEASUREMENT
/begin MEASUREMENT B_sicgumv "Fehlertype: Signalunterbr. EGS; Versorgungsspannung Magnetventile" UWORD B_TRUE 1 100 0 1 BIT_MASK 0x400 FUNCTION_LIST DFPM_DCG IF_DATA DIM_X 0x38383A EXTERN BYTE IF_DATA MCMESS 0x38383A EXTERN /end MEASUREMENT
/begin MEASUREMENT B_sicgvgc "Fehlertype: Signalunterbr. EGS; Verteilergetr.-Stellung unplaus." UWORD B_TRUE 1 100 0 1 BIT_MASK 0x400 FUNCTION_LIST DFPM_DCG IF_DATA DIM_X 0x38383C EXTERN BYTE IF_DATA MCMESS 0x38383C EXTERN /end MEASUREMENT
/begin MEASUREMENT B_sicgvrc "Fehlertype: Signalunterbr. EGS; Raddrehzahl hinten unplausibel" UWORD B_TRUE 1 100 0 1 BIT_MASK 0x400 FUNCTION_LIST DFPM_DCG IF_DATA DIM_X 0x38383E EXTERN BYTE IF_DATA MCMESS 0x38383E EXTERN /end MEASUREMENT
/begin MEASUREMENT B_sicgwk "Fehlertype: Signalunterbr. EGS; Wandlerkupplung" UWORD B_TRUE 1 100 0 1 BIT_MASK 0x400 FUNCTION_LIST DFPM_DCG IF_DATA DIM_X 0x383840 EXTERN BYTE IF_DATA MCMESS 0x383840 EXTERN /end MEASUREMENT
/begin MEASUREMENT B_sickbi "Signalfehler CAN-Timeout Kombi-Botschaften" UWORD B_TRUE 1 100 0 1 BIT_MASK 0x400 FUNCTION_LIST DFPM_DCKBI IF_DATA DIM_X 0x383842 EXTERN BYTE IF_DATA MCMESS 0x383842 EXTERN /end MEASUREMENT
/begin MEASUREMENT B_sicmil "Fehlerart:MIL über CAN sig.-Fehler" UWORD B_TRUE 1 100 0 1 BIT_MASK 0x400 FUNCTION_LIST DFPM_DCMIL IF_DATA DIM_X 0x383844 EXTERN BYTE IF_DATA MCMESS 0x383844 EXTERN /end MEASUREMENT
/begin MEASUREMENT B_sicra "Bedingung Abgleich Innenwiderstand Nernstzelle von LSU" UWORD B_TRUE 1 100 0 1 BIT_MASK 0x400 FUNCTION_LIST DFPM_GGAIRBAG IF_DATA DIM_X 0x383846 EXTERN BYTE IF_DATA MCMESS 0x383846 EXTERN /end MEASUREMENT
/begin MEASUREMENT B_sidk "Fehlertyp signal: Drosselklappenpoti" UWORD B_TRUE 1 100 0 1 BIT_MASK 0x400 FUNCTION_LIST DFPM_DDVE IF_DATA DIM_X 0x383848 EXTERN BYTE IF_DATA MCMESS 0x383848 EXTERN /end MEASUREMENT
/begin MEASUREMENT B_sidk1p "Fehlendes Signal: Drosselklappe 1. Poti" UWORD B_TRUE 1 100 0 1 BIT_MASK 0x400 FUNCTION_LIST DFPM_DDVE IF_DATA DIM_X 0x38384A EXTERN BYTE IF_DATA MCMESS 0x38384A EXTERN /end MEASUREMENT
/begin MEASUREMENT B_sidk2p "Fehlendes Signal: Drosselklappe 2. Poti" UWORD B_TRUE 1 100 0 1 BIT_MASK 0x400 FUNCTION_LIST DFPM_DDVE IF_DATA DIM_X 0x38384C EXTERN BYTE IF_DATA MCMESS 0x38384C EXTERN /end MEASUREMENT
/begin MEASUREMENT B_sidsl "Bedingung Signalfehler Ladedrucksensor" UWORD B_TRUE 1 100 0 1 BIT_MASK 0x400 FUNCTION_LIST DFPM_GGDSAS IF_DATA DIM_X 0x383850 EXTERN BYTE IF_DATA MCMESS 0x383850 EXTERN /end MEASUREMENT
/begin MEASUREMENT B_sidsu "Fehlerart: Umgebungsdrucksensor" UWORD B_TRUE 1 100 0 1 BIT_MASK 0x400 FUNCTION_LIST DFPM_GGDSAS IF_DATA DIM_X 0x383852 EXTERN BYTE IF_DATA MCMESS 0x383852 EXTERN /end MEASUREMENT
/begin MEASUREMENT B_sidsvlu "Fehlerart: Drucksensorsingalvergleich (DS-L DS-U)" UWORD B_TRUE 1 100 0 1 BIT_MASK 0x400 FUNCTION_LIST DFPM_GGDSAS IF_DATA DIM_X 0x383854 EXTERN BYTE IF_DATA MCMESS 0x383854 EXTERN /end MEASUREMENT
/begin MEASUREMENT B_sidvee "Fehlertyp sig.: DV-E Endstufe" UWORD B_TRUE 1 100 0 1 BIT_MASK 0x400 FUNCTION_LIST DFPM_DDVE IF_DATA DIM_X 0x383856 EXTERN BYTE IF_DATA MCMESS 0x383856 EXTERN /end MEASUREMENT
/begin MEASUREMENT B_sidvef "Fehlertyp sig.: DV-E Fehler bei Federprüfung" UWORD B_TRUE 1 100 0 1 BIT_MASK 0x400 FUNCTION_LIST DFPM_DDVE IF_DATA DIM_X 0x383858 EXTERN BYTE IF_DATA MCMESS 0x383858 EXTERN /end MEASUREMENT
/begin MEASUREMENT B_sidvefo "" UWORD B_TRUE 1 100 0 1 BIT_MASK 0x400 FUNCTION_LIST DFPM_DDVE IF_DATA DIM_X 0x38385A EXTERN BYTE IF_DATA MCMESS 0x38385A EXTERN /end MEASUREMENT
/begin MEASUREMENT B_sidvel "Fehlertyp sig.: DV-E Lageabweichung" UWORD B_TRUE 1 100 0 1 BIT_MASK 0x400 FUNCTION_LIST DFPM_DDVE IF_DATA DIM_X 0x38385C EXTERN BYTE IF_DATA MCMESS 0x38385C EXTERN /end MEASUREMENT
/begin MEASUREMENT B_sidven "Fehlertyp sig.: DV-E Fehler bei Prüfung Notluftposition" UWORD B_TRUE 1 100 0 1 BIT_MASK 0x400 FUNCTION_LIST DFPM_DDVE IF_DATA DIM_X 0x38385E EXTERN BYTE IF_DATA MCMESS 0x38385E EXTERN /end MEASUREMENT
/begin MEASUREMENT B_sidver "Fehlertyp sig.: DV-E Regelbereich" UWORD B_TRUE 1 100 0 1 BIT_MASK 0x400 FUNCTION_LIST DFPM_DDVE IF_DATA DIM_X 0x383860 EXTERN BYTE IF_DATA MCMESS 0x383860 EXTERN /end MEASUREMENT
/begin MEASUREMENT B_sidvet "" UWORD B_TRUE 1 100 0 1 BIT_MASK 0x400 FUNCTION_LIST DFPM_DDVE IF_DATA DIM_X 0x383862 EXTERN BYTE IF_DATA MCMESS 0x383862 EXTERN /end MEASUREMENT
/begin MEASUREMENT B_sidveu "Fehlertyp sig.: DV-E Fehler beim UMA-Lernen" UWORD B_TRUE 1 100 0 1 BIT_MASK 0x400 FUNCTION_LIST DFPM_DDVE IF_DATA DIM_X 0x383864 EXTERN BYTE IF_DATA MCMESS 0x383864 EXTERN /end MEASUREMENT
/begin MEASUREMENT B_sidveub "" UWORD B_TRUE 1 100 0 1 BIT_MASK 0x400 FUNCTION_LIST DFPM_DDVE IF_DATA DIM_X 0x383866 EXTERN BYTE IF_DATA MCMESS 0x383866 EXTERN /end MEASUREMENT
/begin MEASUREMENT B_sidveuw "" UWORD B_TRUE 1 100 0 1 BIT_MASK 0x400 FUNCTION_LIST DFPM_DDVE IF_DATA DIM_X 0x383868 EXTERN BYTE IF_DATA MCMESS 0x383868 EXTERN /end MEASUREMENT
/begin MEASUREMENT B_sidvev "Fehlertyp sig.: DV-E Fehler bei Verstärkerabgleich" UWORD B_TRUE 1 100 0 1 BIT_MASK 0x400 FUNCTION_LIST DFPM_DDVE IF_DATA DIM_X 0x38386A EXTERN BYTE IF_DATA MCMESS 0x38386A EXTERN /end MEASUREMENT
/begin MEASUREMENT B_siegfe "Bedingung: Signal Fehler bei den Eingangsgrößen der Füllungserfassung" UWORD B_TRUE 1 100 0 1 BIT_MASK 0x400 FUNCTION_LIST DFPM_EGFE IF_DATA DIM_X 0x38386C EXTERN BYTE IF_DATA MCMESS 0x38386C EXTERN /end MEASUREMENT
/begin MEASUREMENT B_siev1 "Fehlerart: Unterbrechung an Endstufe EV1" UWORD B_TRUE 1 100 0 1 BIT_MASK 0x400 FUNCTION_LIST DFPM_DEKON IF_DATA DIM_X 0x38386E EXTERN BYTE IF_DATA MCMESS 0x38386E EXTERN /end MEASUREMENT
/begin MEASUREMENT B_siev2 "Fehlerart: Unterbrechung an Endstufe EV2" UWORD B_TRUE 1 100 0 1 BIT_MASK 0x400 FUNCTION_LIST DFPM_DEKON IF_DATA DIM_X 0x383870 EXTERN BYTE IF_DATA MCMESS 0x383870 EXTERN /end MEASUREMENT
/begin MEASUREMENT B_siev3 "Fehlerart: Unterbrechung an Endstufe EV3" UWORD B_TRUE 1 100 0 1 BIT_MASK 0x400 FUNCTION_LIST DFPM_DEKON IF_DATA DIM_X 0x383872 EXTERN BYTE IF_DATA MCMESS 0x383872 EXTERN /end MEASUREMENT
/begin MEASUREMENT B_siev4 "Fehlerart: Unterbrechung an Endstufe EV4" UWORD B_TRUE 1 100 0 1 BIT_MASK 0x400 FUNCTION_LIST DFPM_DEKON IF_DATA DIM_X 0x383874 EXTERN BYTE IF_DATA MCMESS 0x383874 EXTERN /end MEASUREMENT
/begin MEASUREMENT B_siev5 "Fehlerart: Unterbrechung an Endstufe EV5" UWORD B_TRUE 1 100 0 1 BIT_MASK 0x400 FUNCTION_LIST DFPM_DEKON IF_DATA DIM_X 0x383876 EXTERN BYTE IF_DATA MCMESS 0x383876 EXTERN /end MEASUREMENT
/begin MEASUREMENT B_siev6 "Fehlerart: Unterbrechung an Endstufe EV6" UWORD B_TRUE 1 100 0 1 BIT_MASK 0x400 FUNCTION_LIST DFPM_DEKON IF_DATA DIM_X 0x383878 EXTERN BYTE IF_DATA MCMESS 0x383878 EXTERN /end MEASUREMENT
/begin MEASUREMENT B_sifgrl "Fehlertyp sig.: FGR-Lampe über CAN" UWORD B_TRUE 1 100 0 1 BIT_MASK 0x400 FUNCTION_LIST DFPM_DCFGRL IF_DATA DIM_X 0x38387A EXTERN BYTE IF_DATA MCMESS 0x38387A EXTERN /end MEASUREMENT
/begin MEASUREMENT B_sifp1p "Fehlerart: Fahrpedal 1.Potentiometer" UWORD B_TRUE 1 100 0 1 BIT_MASK 0x400 FUNCTION_LIST DFPM_GGPED IF_DATA DIM_X 0x38387C EXTERN BYTE IF_DATA MCMESS 0x38387C EXTERN /end MEASUREMENT
/begin MEASUREMENT B_sifp2p "Fehlerart: Fahrpedal 2.Potentiometer" UWORD B_TRUE 1 100 0 1 BIT_MASK 0x400 FUNCTION_LIST DFPM_GGPED IF_DATA DIM_X 0x38387E EXTERN BYTE IF_DATA MCMESS 0x38387E EXTERN /end MEASUREMENT
/begin MEASUREMENT B_sifpp "Fehlerart: Fahrpedal Potentiometer" UWORD B_TRUE 1 100 0 1 BIT_MASK 0x400 FUNCTION_LIST DFPM_GGPED IF_DATA DIM_X 0x383880 EXTERN BYTE IF_DATA MCMESS 0x383880 EXTERN /end MEASUREMENT
/begin MEASUREMENT B_sifrao "Fehlertyp 'Signal fehlt' for FRAO erkannt" UWORD B_TRUE 1 100 0 1 BIT_MASK 0x400 FUNCTION_LIST DFPM_DKVS IF_DATA DIM_X 0x383882 EXTERN BYTE IF_DATA MCMESS 0x383882 EXTERN /end MEASUREMENT
/begin MEASUREMENT B_sifrao2 "Fehlertyp 'Signal fehlt' for FRAO erkannt Bank 2" UWORD B_TRUE 1 100 0 1 BIT_MASK 0x400 FUNCTION_LIST DFPM_DKVS IF_DATA DIM_X 0x383884 EXTERN BYTE IF_DATA MCMESS 0x383884 EXTERN /end MEASUREMENT
/begin MEASUREMENT B_sifrau "Fehlertyp 'Signal fehlt' für FRAU erkannt" UWORD B_TRUE 1 100 0 1 BIT_MASK 0x400 FUNCTION_LIST DFPM_DKVS IF_DATA DIM_X 0x383886 EXTERN BYTE IF_DATA MCMESS 0x383886 EXTERN /end MEASUREMENT
/begin MEASUREMENT B_sifrau2 "Fehlertyp 'Signal fehlt' für FRAU erkannt Bank 2" UWORD B_TRUE 1 100 0 1 BIT_MASK 0x400 FUNCTION_LIST DFPM_DKVS IF_DATA DIM_X 0x383888 EXTERN BYTE IF_DATA MCMESS 0x383888 EXTERN /end MEASUREMENT
/begin MEASUREMENT B_sifrst "Fehlerart: LR-Abweichung" UWORD B_TRUE 1 100 0 1 BIT_MASK 0x400 FUNCTION_LIST DFPM_DKVS IF_DATA DIM_X 0x38388A EXTERN BYTE IF_DATA MCMESS 0x38388A EXTERN /end MEASUREMENT
/begin MEASUREMENT B_sifrst2 "Fehlerart: LR-Abweichung Bank 2" UWORD B_TRUE 1 100 0 1 BIT_MASK 0x400 FUNCTION_LIST DFPM_DKVS IF_DATA DIM_X 0x38388C EXTERN BYTE IF_DATA MCMESS 0x38388C EXTERN /end MEASUREMENT
/begin MEASUREMENT B_sigflsh "Signalunterbrechung (Kabelbruch) Bei Sonde hinter KAT erkannt" UBYTE B_TRUE 1 100 0 1 BIT_MASK 0x10 FUNCTION_LIST DLSH IF_DATA DIM_X 0x380A80 EXTERN BYTE IF_DATA MCMESS 0x380A80 EXTERN /end MEASUREMENT
/begin MEASUREMENT B_sigflsh2 "Signalunterbrechung (Kabelbruch) bei Sonde hinter KAT erkannt Bank2" UBYTE B_TRUE 1 100 0 1 BIT_MASK 0x20 FUNCTION_LIST DLSH IF_DATA DIM_X 0x380A80 EXTERN BYTE IF_DATA MCMESS 0x380A80 EXTERN /end MEASUREMENT
/begin MEASUREMENT B_sigflsu "Übersprechen vom Heizertakt auf Lambdasignal, Bank1" UWORD B_TRUE 1 100 0 1 BIT_MASK 0x4 FUNCTION_LIST DLSU IF_DATA DIM_X 0x381D14 EXTERN BYTE IF_DATA MCMESS 0x381D14 EXTERN /end MEASUREMENT
/begin MEASUREMENT B_sigflsu2 "Übersprechen vom Heizertakt auf Lambdasignal, Bank2" UWORD B_TRUE 1 100 0 1 BIT_MASK 0x40 FUNCTION_LIST DLSU IF_DATA DIM_X 0x381D14 EXTERN BYTE IF_DATA MCMESS 0x381D14 EXTERN /end MEASUREMENT
/begin MEASUREMENT B_sihlsu "Unterbrechung im Heizstromkreis LSU1" UWORD B_TRUE 1 100 0 1 BIT_MASK 0x20 FUNCTION_LIST DHLSU IF_DATA DIM_X 0xFD1E INTERN BYTE IF_DATA MCMESS 0xFD1E INTERN /end MEASUREMENT
/begin MEASUREMENT B_sihlsu2 "Unterbrechung im Heizstromkreis LSU2" UWORD B_TRUE 1 100 0 1 BIT_MASK 0x40 FUNCTION_LIST DHLSU IF_DATA DIM_X 0xFD1E INTERN BYTE IF_DATA MCMESS 0xFD1E INTERN /end MEASUREMENT
/begin MEASUREMENT B_sihsh "Lastabfall Sondenheizung hinter Kat" UWORD B_TRUE 1 100 0 1 BIT_MASK 0x400 FUNCTION_LIST DFPM_DHLSHK IF_DATA DIM_X 0x38388E EXTERN BYTE IF_DATA MCMESS 0x38388E EXTERN /end MEASUREMENT
/begin MEASUREMENT B_sihsh2 "Lastabfall Sondenheizung2 hinter Kat" UWORD B_TRUE 1 100 0 1 BIT_MASK 0x400 FUNCTION_LIST DFPM_DHLSHK IF_DATA DIM_X 0x383890 EXTERN BYTE IF_DATA MCMESS 0x383890 EXTERN /end MEASUREMENT
/begin MEASUREMENT B_sihshe "Lastabfall Sondenheizung hinter Kat (Endstufe)" UWORD B_TRUE 1 100 0 1 BIT_MASK 0x400 FUNCTION_LIST DFPM_DEKON IF_DATA DIM_X 0x383892 EXTERN BYTE IF_DATA MCMESS 0x383892 EXTERN /end MEASUREMENT
/begin MEASUREMENT B_sihshe2 "Lastabfall Sondenheizung2 hinter Kat (Endstufe)" UWORD B_TRUE 1 100 0 1 BIT_MASK 0x400 FUNCTION_LIST DFPM_DEKON IF_DATA DIM_X 0x383894 EXTERN BYTE IF_DATA MCMESS 0x383894 EXTERN /end MEASUREMENT
/begin MEASUREMENT B_sihsv "Lastabfall Sondenheizung vor Kat" UWORD B_TRUE 1 100 0 1 BIT_MASK 0x400 FUNCTION_LIST DFPM_DHLSU IF_DATA DIM_X 0x383896 EXTERN BYTE IF_DATA MCMESS 0x383896 EXTERN /end MEASUREMENT
/begin MEASUREMENT B_sihsv2 "Lastabfall Sondenheizung2 vor Kat" UWORD B_TRUE 1 100 0 1 BIT_MASK 0x400 FUNCTION_LIST DFPM_DHLSU IF_DATA DIM_X 0x383898 EXTERN BYTE IF_DATA MCMESS 0x383898 EXTERN /end MEASUREMENT
/begin MEASUREMENT B_sihsvsa "Signal - Fehler erkannt" UWORD B_TRUE 1 100 0 1 BIT_MASK 0x400 FUNCTION_LIST DFPM_DHLSU IF_DATA DIM_X 0x38389A EXTERN BYTE IF_DATA MCMESS 0x38389A EXTERN /end MEASUREMENT
/begin MEASUREMENT B_sihsvsa2 "Signal - Fehler erkannt Bank 2" UWORD B_TRUE 1 100 0 1 BIT_MASK 0x400 FUNCTION_LIST DFPM_DHLSU IF_DATA DIM_X 0x38389C EXTERN BYTE IF_DATA MCMESS 0x38389C EXTERN /end MEASUREMENT
/begin MEASUREMENT B_sikat "Fehlertyp 'Signal fehlt' für DKAT erkannt" UWORD B_TRUE 1 100 0 1 BIT_MASK 0x400 FUNCTION_LIST DFPM_DKAT IF_DATA DIM_X 0x38389E EXTERN BYTE IF_DATA MCMESS 0x38389E EXTERN /end MEASUREMENT
/begin MEASUREMENT B_sikat2 "Fehlertyp 'Signal fehlt' für DKAT 2 erkannt" UWORD B_TRUE 1 100 0 1 BIT_MASK 0x400 FUNCTION_LIST DFPM_DKAT IF_DATA DIM_X 0x3838A0 EXTERN BYTE IF_DATA MCMESS 0x3838A0 EXTERN /end MEASUREMENT
/begin MEASUREMENT B_sikos "Fehlertype: Leitungsabfall Endstufe Klimakompressor" UWORD B_TRUE 1 100 0 1 BIT_MASK 0x400 FUNCTION_LIST DFPM_DEKON IF_DATA DIM_X 0x3838A2 EXTERN BYTE IF_DATA MCMESS 0x3838A2 EXTERN /end MEASUREMENT
/begin MEASUREMENT B_sikpe "Bedingung für Fehlertyp Leitungsabfall für EKP-Relais Endstufe erkannt" UWORD B_TRUE 1 100 0 1 BIT_MASK 0x400 FUNCTION_LIST DFPM_DEKON IF_DATA DIM_X 0x3838A4 EXTERN BYTE IF_DATA MCMESS 0x3838A4 EXTERN /end MEASUREMENT
/begin MEASUREMENT B_sikrnt "Fehlertyp: Klopfregelung Nulltest" UWORD B_TRUE 1 100 0 1 BIT_MASK 0x400 FUNCTION_LIST DFPM_DKRNT IF_DATA DIM_X 0x3838A6 EXTERN BYTE IF_DATA MCMESS 0x3838A6 EXTERN /end MEASUREMENT
/begin MEASUREMENT B_sikrof "Fehlertyp: Klopfregelung Offset" UWORD B_TRUE 1 100 0 1 BIT_MASK 0x400 FUNCTION_LIST DFPM_DKRNT IF_DATA DIM_X 0x3838A8 EXTERN BYTE IF_DATA MCMESS 0x3838A8 EXTERN /end MEASUREMENT
/begin MEASUREMENT B_sikrtp "Fehlertyp: Klopfregelung Testimpuls" UWORD B_TRUE 1 100 0 1 BIT_MASK 0x400 FUNCTION_LIST DFPM_DKRTP IF_DATA DIM_X 0x3838AA EXTERN BYTE IF_DATA MCMESS 0x3838AA EXTERN /end MEASUREMENT
/begin MEASUREMENT B_siks1 "Fehlertyp: Klopfsensor 1" UWORD B_TRUE 1 100 0 1 BIT_MASK 0x400 FUNCTION_LIST DFPM_DKRS IF_DATA DIM_X 0x3838AC EXTERN BYTE IF_DATA MCMESS 0x3838AC EXTERN /end MEASUREMENT
/begin MEASUREMENT B_siks2 "Fehlertyp: Klopfsensor 2" UWORD B_TRUE 1 100 0 1 BIT_MASK 0x400 FUNCTION_LIST DFPM_DKRS IF_DATA DIM_X 0x3838AE EXTERN BYTE IF_DATA MCMESS 0x3838AE EXTERN /end MEASUREMENT
/begin MEASUREMENT B_siks3 "Fehlertyp: Klopfsensor 3" UWORD B_TRUE 1 100 0 1 BIT_MASK 0x400 FUNCTION_LIST DFPM_DKRS IF_DATA DIM_X 0x3838B0 EXTERN BYTE IF_DATA MCMESS 0x3838B0 EXTERN /end MEASUREMENT
/begin MEASUREMENT B_siks4 "Fehlertyp: Klopfsensor 4" UWORD B_TRUE 1 100 0 1 BIT_MASK 0x400 FUNCTION_LIST DFPM_DKRS IF_DATA DIM_X 0x3838B2 EXTERN BYTE IF_DATA MCMESS 0x3838B2 EXTERN /end MEASUREMENT
/begin MEASUREMENT B_sikuppl "Fehlertyp KUPPL: Signal inaktiv" UWORD B_TRUE 1 100 0 1 BIT_MASK 0x400 FUNCTION_LIST DFPM_DKUPPL IF_DATA DIM_X 0x3838B4 EXTERN BYTE IF_DATA MCMESS 0x3838B4 EXTERN /end MEASUREMENT
/begin MEASUREMENT B_sikwave "Fehlertype: Leitungsabfall Kühlwasserabsperrventil Endstufe" UWORD B_TRUE 1 100 0 1 BIT_MASK 0x400 FUNCTION_LIST DFPM_DEKON IF_DATA DIM_X 0x3838B6 EXTERN BYTE IF_DATA MCMESS 0x3838B6 EXTERN /end MEASUREMENT
/begin MEASUREMENT B_silash "Fehlertyp: Lambdasondenalterung hinter Kat." UWORD B_TRUE 1 100 0 1 BIT_MASK 0x400 FUNCTION_LIST DFPM_DLSAHK IF_DATA DIM_X 0x3838B8 EXTERN BYTE IF_DATA MCMESS 0x3838B8 EXTERN /end MEASUREMENT
/begin MEASUREMENT B_silash2 "Fehlertyp: Lambdasondenalterung hinter Kat. Bank 2" UWORD B_TRUE 1 100 0 1 BIT_MASK 0x400 FUNCTION_LIST DFPM_DLSAHK IF_DATA DIM_X 0x3838BA EXTERN BYTE IF_DATA MCMESS 0x3838BA EXTERN /end MEASUREMENT
/begin MEASUREMENT B_silde "Fehlertyp: Leitungsabfall LDR-Taktventil" UWORD B_TRUE 1 100 0 1 BIT_MASK 0x400 FUNCTION_LIST DFPM_DEKON IF_DATA DIM_X 0x3838BC EXTERN BYTE IF_DATA MCMESS 0x3838BC EXTERN /end MEASUREMENT
/begin MEASUREMENT B_sildo "Bedingung Signal-Fehler Fehlerpfad ldo" UWORD B_TRUE 1 100 0 1 BIT_MASK 0x400 FUNCTION_LIST DFPM_DLDR IF_DATA DIM_X 0x3838BE EXTERN BYTE IF_DATA MCMESS 0x3838BE EXTERN /end MEASUREMENT
/begin MEASUREMENT B_sildra "Bedingung Signal-Fehler Fehlerpfad LDRA" UWORD B_TRUE 1 100 0 1 BIT_MASK 0x400 FUNCTION_LIST DFPM_DLDR IF_DATA DIM_X 0x3838C0 EXTERN BYTE IF_DATA MCMESS 0x3838C0 EXTERN /end MEASUREMENT
/begin MEASUREMENT B_silf1e "Fehlertype: Leitungsabfall Endstufe Lüfter1" UWORD B_TRUE 1 100 0 1 BIT_MASK 0x400 FUNCTION_LIST DFPM_DEKON IF_DATA DIM_X 0x3838C2 EXTERN BYTE IF_DATA MCMESS 0x3838C2 EXTERN /end MEASUREMENT
/begin MEASUREMENT B_silf2e "Fehlertype: Leitungsabfall Endstufe Lüfter2" UWORD B_TRUE 1 100 0 1 BIT_MASK 0x400 FUNCTION_LIST DFPM_DEKON IF_DATA DIM_X 0x3838C4 EXTERN BYTE IF_DATA MCMESS 0x3838C4 EXTERN /end MEASUREMENT
/begin MEASUREMENT B_silf3e "Fehlertype: Leitungsabfall Endstufe Lüfter3" UWORD B_TRUE 1 100 0 1 BIT_MASK 0x400 FUNCTION_LIST DFPM_DEKON IF_DATA DIM_X 0x3838C6 EXTERN BYTE IF_DATA MCMESS 0x3838C6 EXTERN /end MEASUREMENT
/begin MEASUREMENT B_sillr "Fehlertyp: Leerlaufregelung" UWORD B_TRUE 1 100 0 1 BIT_MASK 0x400 FUNCTION_LIST DFPM_DLLR IF_DATA DIM_X 0x3838C8 EXTERN BYTE IF_DATA MCMESS 0x3838C8 EXTERN /end MEASUREMENT
/begin MEASUREMENT B_silm "Bedingung Signalfehler Hauptfüllungssensor" UWORD B_TRUE 1 100 0 1 BIT_MASK 0x400 FUNCTION_LIST DFPM_DHFM IF_DATA DIM_X 0x3838CA EXTERN BYTE IF_DATA MCMESS 0x3838CA EXTERN /end MEASUREMENT
/begin MEASUREMENT B_silsh "Fehlertyp 'Signal fehlt' hinter KAT erkannt" UWORD B_TRUE 1 100 0 1 BIT_MASK 0x400 FUNCTION_LIST DFPM_DLSH IF_DATA DIM_X 0x3838CC EXTERN BYTE IF_DATA MCMESS 0x3838CC EXTERN /end MEASUREMENT
/begin MEASUREMENT B_silsh2 "Fehlertyp 'Signal fehlt' hinter KAT erkannt Bank2" UWORD B_TRUE 1 100 0 1 BIT_MASK 0x400 FUNCTION_LIST DFPM_DLSH IF_DATA DIM_X 0x3838CE EXTERN BYTE IF_DATA MCMESS 0x3838CE EXTERN /end MEASUREMENT
/begin MEASUREMENT B_silsv "Fehlertyp 'Signal fehlt' vor KAT erkannt" UWORD B_TRUE 1 100 0 1 BIT_MASK 0x400 FUNCTION_LIST DFPM_DLSU IF_DATA DIM_X 0x3838D0 EXTERN BYTE IF_DATA MCMESS 0x3838D0 EXTERN /end MEASUREMENT
/begin MEASUREMENT B_silsv2 "Fehlertyp 'Signal fehlt' vor KAT erkannt Bank2" UWORD B_TRUE 1 100 0 1 BIT_MASK 0x400 FUNCTION_LIST DFPM_DLSU IF_DATA DIM_X 0x3838D2 EXTERN BYTE IF_DATA MCMESS 0x3838D2 EXTERN /end MEASUREMENT
/begin MEASUREMENT B_silsvv "Signal-Fehler: Vertauschte Lambda-Sonden" UWORD B_TRUE 1 100 0 1 BIT_MASK 0x400 FUNCTION_LIST DFPM_LSVV IF_DATA DIM_X 0x3838D4 EXTERN BYTE IF_DATA MCMESS 0x3838D4 EXTERN /end MEASUREMENT
/begin MEASUREMENT B_simd "Fehlertyp sig.: Aussetzer, Summenfehler (multiple)" UWORD B_TRUE 1 100 0 1 BIT_MASK 0x400 FUNCTION_LIST DFPM_DMDMIL IF_DATA DIM_X 0x3838D6 EXTERN BYTE IF_DATA MCMESS 0x3838D6 EXTERN /end MEASUREMENT
/begin MEASUREMENT B_simd00 "Fehlertyp sig.: Aussetzer Zündung 0" UWORD B_TRUE 1 100 0 1 BIT_MASK 0x400 FUNCTION_LIST DFPM_DMDMIL IF_DATA DIM_X 0x3838D8 EXTERN BYTE IF_DATA MCMESS 0x3838D8 EXTERN /end MEASUREMENT
/begin MEASUREMENT B_simd01 "Fehlertyp sig.: Aussetzer Zündung 1" UWORD B_TRUE 1 100 0 1 BIT_MASK 0x400 FUNCTION_LIST DFPM_DMDMIL IF_DATA DIM_X 0x3838DA EXTERN BYTE IF_DATA MCMESS 0x3838DA EXTERN /end MEASUREMENT
/begin MEASUREMENT B_simd02 "Fehlertyp sig.: Aussetzer Zündung 2" UWORD B_TRUE 1 100 0 1 BIT_MASK 0x400 FUNCTION_LIST DFPM_DMDMIL IF_DATA DIM_X 0x3838DC EXTERN BYTE IF_DATA MCMESS 0x3838DC EXTERN /end MEASUREMENT
/begin MEASUREMENT B_simd03 "Fehlertyp sig.: Aussetzer Zündung 3" UWORD B_TRUE 1 100 0 1 BIT_MASK 0x400 FUNCTION_LIST DFPM_DMDMIL IF_DATA DIM_X 0x3838DE EXTERN BYTE IF_DATA MCMESS 0x3838DE EXTERN /end MEASUREMENT
/begin MEASUREMENT B_simd04 "Fehlertyp sig.: Aussetzer Zündung 4" UWORD B_TRUE 1 100 0 1 BIT_MASK 0x400 FUNCTION_LIST DFPM_DMDMIL IF_DATA DIM_X 0x3838E0 EXTERN BYTE IF_DATA MCMESS 0x3838E0 EXTERN /end MEASUREMENT
/begin MEASUREMENT B_simd05 "Fehlertyp sig.: Aussetzer Zündung 5" UWORD B_TRUE 1 100 0 1 BIT_MASK 0x400 FUNCTION_LIST DFPM_DMDMIL IF_DATA DIM_X 0x3838E2 EXTERN BYTE IF_DATA MCMESS 0x3838E2 EXTERN /end MEASUREMENT
/begin MEASUREMENT B_simdb "Fehlertyp: Momentanüberwachung begrenzt dauerhaft" UWORD B_TRUE 1 100 0 1 BIT_MASK 0x400 FUNCTION_LIST DFPM_MDKOG IF_DATA DIM_X 0x3838E4 EXTERN BYTE IF_DATA MCMESS 0x3838E4 EXTERN /end MEASUREMENT
/begin MEASUREMENT B_simsg "Fehlertype: Signalunterbrechung Motorraumspülgebläse" UWORD B_TRUE 1 100 0 1 BIT_MASK 0x400 FUNCTION_LIST DFPM_MLS IF_DATA DIM_X 0x3838E6 EXTERN BYTE IF_DATA MCMESS 0x3838E6 EXTERN /end MEASUREMENT
/begin MEASUREMENT B_simsge "Fehlertype: Leitungsabfall Endstufe Motorraumspülgebläse" UWORD B_TRUE 1 100 0 1 BIT_MASK 0x400 FUNCTION_LIST DFPM_DEKON IF_DATA DIM_X 0x3838E8 EXTERN BYTE IF_DATA MCMESS 0x3838E8 EXTERN /end MEASUREMENT
/begin MEASUREMENT B_sin "Fehlertyp: kein Drehzahlsignal vorhanden" UWORD B_TRUE 1 100 0 1 BIT_MASK 0x400 FUNCTION_LIST DFPM_DDG IF_DATA DIM_X 0x3838EA EXTERN BYTE IF_DATA MCMESS 0x3838EA EXTERN /end MEASUREMENT
/begin MEASUREMENT B_sinwkw "Fehlertyp: Zuordnung Nockenwelle zu Kurbelwelle" UWORD B_TRUE 1 100 0 1 BIT_MASK 0x400 FUNCTION_LIST DFPM_DNWKW IF_DATA DIM_X 0x3838EC EXTERN BYTE IF_DATA MCMESS 0x3838EC EXTERN /end MEASUREMENT
/begin MEASUREMENT B_sinwkw2 "Fehlertyp: Zuordnung Nockenwelle 2 zu Kurbelwelle" UWORD B_TRUE 1 100 0 1 BIT_MASK 0x400 FUNCTION_LIST DFPM_DNWKW IF_DATA DIM_X 0x3838EE EXTERN BYTE IF_DATA MCMESS 0x3838EE EXTERN /end MEASUREMENT
/begin MEASUREMENT B_sinws "Fehlerart : Signalfehler Nockenwellengeber" UWORD B_TRUE 1 100 0 1 BIT_MASK 0x400 FUNCTION_LIST DFPM_DNWS IF_DATA DIM_X 0x3838F0 EXTERN BYTE IF_DATA MCMESS 0x3838F0 EXTERN /end MEASUREMENT
/begin MEASUREMENT B_sinws2 "Fehlerart : Sinalfehler Nockenwellengeber Bank2" UWORD B_TRUE 1 100 0 1 BIT_MASK 0x400 FUNCTION_LIST DFPM_DNWS IF_DATA DIM_X 0x3838F2 EXTERN BYTE IF_DATA MCMESS 0x3838F2 EXTERN /end MEASUREMENT
/begin MEASUREMENT B_sinwse "Fehlerart: Leitungsabfall Nockenwellensteuerungsventil Endstufe" UWORD B_TRUE 1 100 0 1 BIT_MASK 0x400 FUNCTION_LIST DFPM_DEKON IF_DATA DIM_X 0x3838F4 EXTERN BYTE IF_DATA MCMESS 0x3838F4 EXTERN /end MEASUREMENT
/begin MEASUREMENT B_sinwse2 "Fehlertype: Leitungsabfall Nockenwellensteuerung Bank2 Endstufe" UWORD B_TRUE 1 100 0 1 BIT_MASK 0x400 FUNCTION_LIST DFPM_DEKON IF_DATA DIM_X 0x3838F6 EXTERN BYTE IF_DATA MCMESS 0x3838F6 EXTERN /end MEASUREMENT
/begin MEASUREMENT B_siph "Bedingung keine alternierende Phasenpegel PG in den Bezugsmarken" UWORD B_TRUE 1 100 0 1 BIT_MASK 0x400 FUNCTION_LIST DFPM_DPH IF_DATA DIM_X 0x3838F8 EXTERN BYTE IF_DATA MCMESS 0x3838F8 EXTERN /end MEASUREMENT
/begin MEASUREMENT B_siph2 "Bedingung keine alternierende Phasenpegel PG2 in den Bezugsmarken" UWORD B_TRUE 1 100 0 1 BIT_MASK 0x400 FUNCTION_LIST DFPM_DPH IF_DATA DIM_X 0x3838FA EXTERN BYTE IF_DATA MCMESS 0x3838FA EXTERN /end MEASUREMENT
/begin MEASUREMENT B_sirkat "Fehlertyp 'Signal fehlt' for RKAT erkannt" UWORD B_TRUE 1 100 0 1 BIT_MASK 0x400 FUNCTION_LIST DFPM_DKVS IF_DATA DIM_X 0x3838FC EXTERN BYTE IF_DATA MCMESS 0x3838FC EXTERN /end MEASUREMENT
/begin MEASUREMENT B_sirkat2 "Fehlertyp 'Signal fehlt' for RKAT erkannt Bank 2" UWORD B_TRUE 1 100 0 1 BIT_MASK 0x400 FUNCTION_LIST DFPM_DKVS IF_DATA DIM_X 0x3838FE EXTERN BYTE IF_DATA MCMESS 0x3838FE EXTERN /end MEASUREMENT
/begin MEASUREMENT B_sirkaz "Fehlertyp 'Signal fehlt' for RKAZ erkannt" UWORD B_TRUE 1 100 0 1 BIT_MASK 0x400 FUNCTION_LIST DFPM_DKVS IF_DATA DIM_X 0x383900 EXTERN BYTE IF_DATA MCMESS 0x383900 EXTERN /end MEASUREMENT
/begin MEASUREMENT B_sirkaz2 "Fehlertyp 'Signal fehlt' for RKAZ erkannt Bank 2" UWORD B_TRUE 1 100 0 1 BIT_MASK 0x400 FUNCTION_LIST DFPM_DKVS IF_DATA DIM_X 0x383902 EXTERN BYTE IF_DATA MCMESS 0x383902 EXTERN /end MEASUREMENT
/begin MEASUREMENT B_sisgeep "" UWORD B_TRUE 1 100 0 1 BIT_MASK 0x400 FUNCTION_LIST DFPM_DSGEEP IF_DATA DIM_X 0x383904 EXTERN BYTE IF_DATA MCMESS 0x383904 EXTERN /end MEASUREMENT
/begin MEASUREMENT B_sislpe "Fehlertype: Leitungsabfall Endstufe Sekundärluftpumpe" UWORD B_TRUE 1 100 0 1 BIT_MASK 0x400 FUNCTION_LIST DFPM_DEKON IF_DATA DIM_X 0x383906 EXTERN BYTE IF_DATA MCMESS 0x383906 EXTERN /end MEASUREMENT
/begin MEASUREMENT B_sisls "Fehlertype: Sekundärluftsystem" UWORD B_TRUE 1 100 0 1 BIT_MASK 0x400 FUNCTION_LIST DFPM_DSLSLRS IF_DATA DIM_X 0x383908 EXTERN BYTE IF_DATA MCMESS 0x383908 EXTERN /end MEASUREMENT
/begin MEASUREMENT B_sisls2 "Fehlertyp:Sekundärluftsystem Bank 2" UWORD B_TRUE 1 100 0 1 BIT_MASK 0x400 FUNCTION_LIST DFPM_DSLSLRS IF_DATA DIM_X 0x38390A EXTERN BYTE IF_DATA MCMESS 0x38390A EXTERN /end MEASUREMENT
/begin MEASUREMENT B_sislv "Fehlertyp: Sekundärluftventil" UWORD B_TRUE 1 100 0 1 BIT_MASK 0x400 FUNCTION_LIST DFPM_DSLSLRS IF_DATA DIM_X 0x38390C EXTERN BYTE IF_DATA MCMESS 0x38390C EXTERN /end MEASUREMENT
/begin MEASUREMENT B_sislv2 "Fehlertyp: Sekundärluftventil Bank 2" UWORD B_TRUE 1 100 0 1 BIT_MASK 0x400 FUNCTION_LIST DFPM_DSLSLRS IF_DATA DIM_X 0x38390E EXTERN BYTE IF_DATA MCMESS 0x38390E EXTERN /end MEASUREMENT
/begin MEASUREMENT B_sislve "Fehlertype: Leitungsabfall Endstufe Sekundärluftventil" UWORD B_TRUE 1 100 0 1 BIT_MASK 0x400 FUNCTION_LIST DFPM_DEKON IF_DATA DIM_X 0x383910 EXTERN BYTE IF_DATA MCMESS 0x383910 EXTERN /end MEASUREMENT
/begin MEASUREMENT B_siswe "Fehlertyp: Geschwindigkeitssignal nicht vorhanden" UWORD B_TRUE 1 100 0 1 BIT_MASK 0x400 FUNCTION_LIST DFPM_BGRBS IF_DATA DIM_X 0x383912 EXTERN BYTE IF_DATA MCMESS 0x383912 EXTERN /end MEASUREMENT
/begin MEASUREMENT B_sita "Fehlertyp: Ansauglufttemperatur TANS (-Ladeluft)" UWORD B_TRUE 1 100 0 1 BIT_MASK 0x400 FUNCTION_LIST DFPM_GGTFA IF_DATA DIM_X 0x383914 EXTERN BYTE IF_DATA MCMESS 0x383914 EXTERN /end MEASUREMENT
/begin MEASUREMENT B_sites "Fehlerart: TEV offen" UWORD B_TRUE 1 100 0 1 BIT_MASK 0x400 FUNCTION_LIST DFPM_DTEV IF_DATA DIM_X 0x383916 EXTERN BYTE IF_DATA MCMESS 0x383916 EXTERN /end MEASUREMENT
/begin MEASUREMENT B_siteve "Fehlertyp: Leitungsabfall Tankentlüftungsventil Endstufe" UWORD B_TRUE 1 100 0 1 BIT_MASK 0x400 FUNCTION_LIST DFPM_DEKON IF_DATA DIM_X 0x383918 EXTERN BYTE IF_DATA MCMESS 0x383918 EXTERN /end MEASUREMENT
/begin MEASUREMENT B_sitget "" UWORD B_TRUE 1 100 0 1 BIT_MASK 0x400 FUNCTION_LIST DFPM_GGTGET IF_DATA DIM_X 0x38391C EXTERN BYTE IF_DATA MCMESS 0x38391C EXTERN /end MEASUREMENT
/begin MEASUREMENT B_sithm "Fehlerart: Signalfehler Thermostatdiagnose" UWORD B_TRUE 1 100 0 1 BIT_MASK 0x400 FUNCTION_LIST DFPM_GGTFM IF_DATA DIM_X 0x38391E EXTERN BYTE IF_DATA MCMESS 0x38391E EXTERN /end MEASUREMENT
/begin MEASUREMENT B_sitm "Fehlerart: Motortemperaturschwelle für Lambdaregelungsfreigabe nicht erreicht" UWORD B_TRUE 1 100 0 1 BIT_MASK 0x400 FUNCTION_LIST DFPM_GGTFM IF_DATA DIM_X 0x383920 EXTERN BYTE IF_DATA MCMESS 0x383920 EXTERN /end MEASUREMENT
/begin MEASUREMENT B_sitmki "Signalfehler Kühlmitteltemperatur vom Kombiinstrument" UWORD B_TRUE 1 100 0 1 BIT_MASK 0x400 FUNCTION_LIST DFPM_DUMMY043 IF_DATA DIM_X 0x383922 EXTERN BYTE IF_DATA MCMESS 0x383922 EXTERN /end MEASUREMENT
/begin MEASUREMENT B_sitmr "" UWORD B_TRUE 1 100 0 1 BIT_MASK 0x400 FUNCTION_LIST DFPM_GGTFMR IF_DATA DIM_X 0x383924 EXTERN BYTE IF_DATA MCMESS 0x383924 EXTERN /end MEASUREMENT
/begin MEASUREMENT B_sitol "Fehlertyp: Öltemperatur" UWORD B_TRUE 1 100 0 1 BIT_MASK 0x400 FUNCTION_LIST DFPM_GGTFOL IF_DATA DIM_X 0x383926 EXTERN BYTE IF_DATA MCMESS 0x383926 EXTERN /end MEASUREMENT
/begin MEASUREMENT B_situm "Fehlerart: Signal Umgebungstemperatur inaktiv" UWORD B_TRUE 1 100 0 1 BIT_MASK 0x400 FUNCTION_LIST DFPM_GGTFUMG IF_DATA DIM_X 0x383928 EXTERN BYTE IF_DATA MCMESS 0x383928 EXTERN /end MEASUREMENT
/begin MEASUREMENT B_siub "Fehlertyp: Umweltbedingungen" UWORD B_TRUE 1 100 0 1 BIT_MASK 0x400 FUNCTION_LIST DFPM_GGUB IF_DATA DIM_X 0x38392A EXTERN BYTE IF_DATA MCMESS 0x38392A EXTERN /end MEASUREMENT
/begin MEASUREMENT B_siufmv "Fehlertyp sig.: Funktionsüberwachung: Momentenvergleich" UWORD B_TRUE 1 100 0 1 BIT_MASK 0x400 FUNCTION_LIST DFPM_DUF IF_DATA DIM_X 0x38392C EXTERN BYTE IF_DATA MCMESS 0x38392C EXTERN /end MEASUREMENT
/begin MEASUREMENT B_siufska "Fehlertyp sig.: Funktionsüberwachung: Sicherheits-Kraftstoff-Abschaltung" UWORD B_TRUE 1 100 0 1 BIT_MASK 0x400 FUNCTION_LIST DFPM_DUF IF_DATA DIM_X 0x38392E EXTERN BYTE IF_DATA MCMESS 0x38392E EXTERN /end MEASUREMENT
/begin MEASUREMENT B_siurram "Fehlertyp sig.: Rechnerüberwachung: RAM" UWORD B_TRUE 1 100 0 1 BIT_MASK 0x400 FUNCTION_LIST DFPM_DUR IF_DATA DIM_X 0x383930 EXTERN BYTE IF_DATA MCMESS 0x383930 EXTERN /end MEASUREMENT
/begin MEASUREMENT B_siurrom "Fehlertyp sig.: Rechnerüberwachung: ROM" UWORD B_TRUE 1 100 0 1 BIT_MASK 0x400 FUNCTION_LIST DFPM_DUR IF_DATA DIM_X 0x383932 EXTERN BYTE IF_DATA MCMESS 0x383932 EXTERN /end MEASUREMENT
/begin MEASUREMENT B_siurrst "Fehlertyp sig.: Rechnerüberwachung: Reset" UWORD B_TRUE 1 100 0 1 BIT_MASK 0x400 FUNCTION_LIST DFPM_DUR IF_DATA DIM_X 0x383934 EXTERN BYTE IF_DATA MCMESS 0x383934 EXTERN /end MEASUREMENT
/begin MEASUREMENT B_siuvse "Fehlertyp: Leitungsabfall Umluftventil turbo" UWORD B_TRUE 1 100 0 1 BIT_MASK 0x400 FUNCTION_LIST DFPM_DEKON IF_DATA DIM_X 0x383936 EXTERN BYTE IF_DATA MCMESS 0x383936 EXTERN /end MEASUREMENT
/begin MEASUREMENT B_sivfz "Bedingung fehlendes Signal Fahrzeuggeschwindigkeit" UWORD B_TRUE 1 100 0 1 BIT_MASK 0x400 FUNCTION_LIST DFPM_DVFZ IF_DATA DIM_X 0x383938 EXTERN BYTE IF_DATA MCMESS 0x383938 EXTERN /end MEASUREMENT
/begin MEASUREMENT B_sivs01 "" UWORD B_TRUE 1 100 0 1 BIT_MASK 0x400 FUNCTION_LIST DFPM_DVS IF_DATA DIM_X 0x38393A EXTERN BYTE IF_DATA MCMESS 0x38393A EXTERN /end MEASUREMENT
/begin MEASUREMENT B_sivs02 "" UWORD B_TRUE 1 100 0 1 BIT_MASK 0x400 FUNCTION_LIST DFPM_DVS IF_DATA DIM_X 0x38393C EXTERN BYTE IF_DATA MCMESS 0x38393C EXTERN /end MEASUREMENT
/begin MEASUREMENT B_sivs03 "" UWORD B_TRUE 1 100 0 1 BIT_MASK 0x400 FUNCTION_LIST DFPM_DVS IF_DATA DIM_X 0x38393E EXTERN BYTE IF_DATA MCMESS 0x38393E EXTERN /end MEASUREMENT
/begin MEASUREMENT B_sivs04 "" UWORD B_TRUE 1 100 0 1 BIT_MASK 0x400 FUNCTION_LIST DFPM_DVS IF_DATA DIM_X 0x383940 EXTERN BYTE IF_DATA MCMESS 0x383940 EXTERN /end MEASUREMENT
/begin MEASUREMENT B_sivs05 "" UWORD B_TRUE 1 100 0 1 BIT_MASK 0x400 FUNCTION_LIST DFPM_DVS IF_DATA DIM_X 0x383942 EXTERN BYTE IF_DATA MCMESS 0x383942 EXTERN /end MEASUREMENT
/begin MEASUREMENT B_sivs06 "" UWORD B_TRUE 1 100 0 1 BIT_MASK 0x400 FUNCTION_LIST DFPM_DVS IF_DATA DIM_X 0x383944 EXTERN BYTE IF_DATA MCMESS 0x383944 EXTERN /end MEASUREMENT
/begin MEASUREMENT B_sivs1e "Fehlertype: Leitungsabfall Endstufe Ventilstuerung 1" UWORD B_TRUE 1 100 0 1 BIT_MASK 0x400 FUNCTION_LIST DFPM_DEKON IF_DATA DIM_X 0x383946 EXTERN BYTE IF_DATA MCMESS 0x383946 EXTERN /end MEASUREMENT
/begin MEASUREMENT B_sivs2e "Fehlertype: Leitungsabfall Endstufe Ventilsteuerung 2" UWORD B_TRUE 1 100 0 1 BIT_MASK 0x400 FUNCTION_LIST DFPM_DEKON IF_DATA DIM_X 0x383948 EXTERN BYTE IF_DATA MCMESS 0x383948 EXTERN /end MEASUREMENT
/begin MEASUREMENT B_sivsb1 "" UWORD B_TRUE 1 100 0 1 BIT_MASK 0x400 FUNCTION_LIST DFPM_DVS IF_DATA DIM_X 0x38394A EXTERN BYTE IF_DATA MCMESS 0x38394A EXTERN /end MEASUREMENT
/begin MEASUREMENT B_sivsb2 "" UWORD B_TRUE 1 100 0 1 BIT_MASK 0x400 FUNCTION_LIST DFPM_DVS IF_DATA DIM_X 0x38394C EXTERN BYTE IF_DATA MCMESS 0x38394C EXTERN /end MEASUREMENT
/begin MEASUREMENT B_sivss "" UWORD B_TRUE 1 100 0 1 BIT_MASK 0x400 FUNCTION_LIST DFPM_DVS IF_DATA DIM_X 0x38394E EXTERN BYTE IF_DATA MCMESS 0x38394E EXTERN /end MEASUREMENT
/begin MEASUREMENT B_siwfs "Fehlerart: Wegfahrsperre" UWORD B_TRUE 1 100 0 1 BIT_MASK 0x400 FUNCTION_LIST DFPM_WFS IF_DATA DIM_X 0x383950 EXTERN BYTE IF_DATA MCMESS 0x383950 EXTERN /end MEASUREMENT
/begin MEASUREMENT B_skaevab "Bedingung Ev-Abschaltung durch Sicherheitskraftstoffabschaltung aktiv" UWORD B_TRUE 1 100 0 1 BIT_MASK 0x2000 FUNCTION_LIST AEVABU IF_DATA DIM_X 0xFD4C INTERN BYTE IF_DATA MCMESS 0xFD4C INTERN /end MEASUREMENT
/begin MEASUREMENT B_sl "Bedingung Servo-Lenkung" UWORD B_TRUE 1 100 0 1 BIT_MASK 0x8 FUNCTION_LIST SWADP LLRMR IF_DATA DIM_X 0xFD86 INTERN BYTE IF_DATA MCMESS 0xFD86 INTERN /end MEASUREMENT
/begin MEASUREMENT B_sla "Anforderung Sekundärluftadaptionsphase" UWORD B_TRUE 1 100 0 1 BIT_MASK 0x100 FUNCTION_LIST DSLSLRS SLS IF_DATA DIM_X 0xFD02 INTERN BYTE IF_DATA MCMESS 0xFD02 INTERN /end MEASUREMENT
/begin MEASUREMENT B_slar "Anforderung Sekundärluftadaptionsphase zurücksetzen" UBYTE B_TRUE 1 100 0 1 BIT_MASK 0x20 FUNCTION_LIST DSLSLRS IF_DATA DIM_X 0x380904 EXTERN BYTE IF_DATA MCMESS 0x380904 EXTERN /end MEASUREMENT
/begin MEASUREMENT B_slarq "Gespeicherte Anforderung Sekundärluftadaptionsphase" UBYTE B_TRUE 1 100 0 1 BIT_MASK 0x40 FUNCTION_LIST DSLSLRS IF_DATA DIM_X 0x380901 EXTERN BYTE IF_DATA MCMESS 0x380901 EXTERN /end MEASUREMENT
/begin MEASUREMENT B_slas "Anforderung Sekundärluftadaptionsphase setzen" UBYTE B_TRUE 1 100 0 1 BIT_MASK 0x10 FUNCTION_LIST DSLSLRS IF_DATA DIM_X 0x380904 EXTERN BYTE IF_DATA MCMESS 0x380904 EXTERN /end MEASUREMENT
/begin MEASUREMENT B_sldsl4 "Bedingung: Freigabe Sekundärluft für Diagnosephase 4" UBYTE B_TRUE 1 100 0 1 BIT_MASK 0x4 FUNCTION_LIST SLS IF_DATA DIM_X 0x380920 EXTERN BYTE IF_DATA MCMESS 0x380920 EXTERN /end MEASUREMENT
/begin MEASUREMENT B_slkt "Bedingung: Freigabe Sekundärluft für Kurztest" UBYTE B_TRUE 1 100 0 1 BIT_MASK 0x8 FUNCTION_LIST SLS IF_DATA DIM_X 0x380920 EXTERN BYTE IF_DATA MCMESS 0x380920 EXTERN /end MEASUREMENT
/begin MEASUREMENT B_slp "Bedingung für Sekundärluftpumpe" UWORD B_TRUE 1 100 0 1 BIT_MASK 0x8000 FUNCTION_LIST SLS DSLPE DSLSLRS ESUKAS VHW IF_DATA DIM_X 0xFD02 INTERN BYTE IF_DATA MCMESS 0xFD02 INTERN /end MEASUREMENT
/begin MEASUREMENT B_slpoff "Sekundärluftpumpe abgeschaltet" UBYTE B_TRUE 1 100 0 1 BIT_MASK 0x1 FUNCTION_LIST SLS BBKHZ IF_DATA DIM_X 0x38091F EXTERN BYTE IF_DATA MCMESS 0x38091F EXTERN /end MEASUREMENT
/begin MEASUREMENT B_sls "Bedingung Sekundärluft aktiv" UWORD B_TRUE 1 100 0 1 BIT_MASK 0x1 FUNCTION_LIST SLS DKATLRS DLSH DSLSLRS DTEV GGLSU LAMKO LRAEB LRS T2DFA TC1MOD TEBEB IF_DATA DIM_X 0xFD04 INTERN BYTE IF_DATA MCMESS 0xFD04 INTERN /end MEASUREMENT
/begin MEASUREMENT B_slsadap "Bedingung: Sekundärluftmassenadaption" UBYTE B_TRUE 1 100 0 1 BIT_MASK 0x10 FUNCTION_LIST SLS DSLSLRS IF_DATA DIM_X 0x38091F EXTERN BYTE IF_DATA MCMESS 0x38091F EXTERN /end MEASUREMENT
/begin MEASUREMENT B_slsfz "Bedingung SLS in Fahrzeug eingebaut" UWORD B_TRUE 1 100 0 1 BIT_MASK 0x20 FUNCTION_LIST PROKON BBKHZ DSLSLRS LAKH LAMKO SLS T2DFA TC1MOD IF_DATA DIM_X 0xFD76 INTERN BYTE IF_DATA MCMESS 0xFD76 INTERN /end MEASUREMENT
/begin MEASUREMENT B_slsn2 "Bedingung Überlappung nach zylinderindiv. Spätverstellung" UWORD B_TRUE 1 100 0 1 BIT_MASK 0x20 FUNCTION_LIST AZUE IF_DATA DIM_X 0xFD00 INTERN BYTE IF_DATA MCMESS 0xFD00 INTERN /end MEASUREMENT
/begin MEASUREMENT B_slsoff "Sekundärlufteinblasung nach Ausräumen der Sekundärluft beendet" UWORD B_TRUE 1 100 0 1 BIT_MASK 0x2 FUNCTION_LIST SLS DSLSLRS LRSEB IF_DATA DIM_X 0xFD04 INTERN BYTE IF_DATA MCMESS 0xFD04 INTERN /end MEASUREMENT
/begin MEASUREMENT B_slsofw "Lokale Bit: B_slsoff um TDPHSLOF verzögert" UBYTE B_TRUE 1 100 0 1 BIT_MASK 0x40 FUNCTION_LIST DSLSLRS IF_DATA DIM_X 0x380903 EXTERN BYTE IF_DATA MCMESS 0x380903 EXTERN /end MEASUREMENT
/begin MEASUREMENT B_slsrdy "Bedingung SLS geprüft für 'ready-Byte'" UBYTE B_TRUE 1 100 0 1 BIT_MASK 0x8 FUNCTION_LIST DIMC IF_DATA DIM_X 0x382FD0 EXTERN BYTE IF_DATA MCMESS 0x382FD0 EXTERN /end MEASUREMENT
/begin MEASUREMENT B_slv "Bedingung für Sekundärluftventil" UWORD B_TRUE 1 100 0 1 BIT_MASK 0x4 FUNCTION_LIST SLS DSLVE VHW IF_DATA DIM_X 0xFD04 INTERN BYTE IF_DATA MCMESS 0xFD04 INTERN /end MEASUREMENT
/begin MEASUREMENT B_sp1 "FLC-Trigger der Aussetzererkennung" UBYTE B_TRUE 1 100 0 1 BIT_MASK 0x1 FUNCTION_LIST DMDMIL IF_DATA DIM_X 0x3809CC EXTERN BYTE IF_DATA MCMESS 0x3809CC EXTERN /end MEASUREMENT
/begin MEASUREMENT B_sp1s "Mitteilung an SR: SP1S ist Führungsgröße." UWORD B_TRUE 1 100 0 1 BIT_MASK 0x20 FUNCTION_LIST GGPED DUF UFSPSC IF_DATA DIM_X 0xFD3C INTERN BYTE IF_DATA MCMESS 0xFD3C INTERN /end MEASUREMENT
/begin MEASUREMENT B_sp2 "HLC-Trigger der Aussetzererkennung" UBYTE B_TRUE 1 100 0 1 BIT_MASK 0x1 FUNCTION_LIST DMDMIL IF_DATA DIM_X 0x3809CD EXTERN BYTE IF_DATA MCMESS 0x3809CD EXTERN /end MEASUREMENT
/begin MEASUREMENT B_sp2s "Mitteilung an SR:Poti2 SP2S Führungsgröße,Poti1 Ober-oder Untergrenze überschr." UWORD B_TRUE 1 100 0 1 BIT_MASK 0x40 FUNCTION_LIST GGPED DUF UFSPSC IF_DATA DIM_X 0xFD3C INTERN BYTE IF_DATA MCMESS 0xFD3C INTERN /end MEASUREMENT
/begin MEASUREMENT B_sp3 "Spezial-Bereichs-Trigger der Diagnose Kraftstoffversorgungssystem" UBYTE B_TRUE 1 100 0 1 BIT_MASK 0x1 FUNCTION_LIST DFPM IF_DATA DIM_X 0x382FC8 EXTERN WORD IF_DATA MCMESS 0x382FC8 EXTERN /end MEASUREMENT
/begin MEASUREMENT B_spontan0 "" UWORD B_TRUE 1 100 0 1 BIT_MASK 0x80 FUNCTION_LIST ACIFI EVI IF_DATA DIM_X 0xFD3E INTERN BYTE IF_DATA MCMESS 0xFD3E INTERN /end MEASUREMENT
/begin MEASUREMENT B_spontan1 "" UWORD B_TRUE 1 100 0 1 BIT_MASK 0x100 FUNCTION_LIST ACIFI EVI IF_DATA DIM_X 0xFD3E INTERN BYTE IF_DATA MCMESS 0xFD3E INTERN /end MEASUREMENT
/begin MEASUREMENT B_spontan2 "" UWORD B_TRUE 1 100 0 1 BIT_MASK 0x200 FUNCTION_LIST ACIFI EVI IF_DATA DIM_X 0xFD3E INTERN BYTE IF_DATA MCMESS 0xFD3E INTERN /end MEASUREMENT
/begin MEASUREMENT B_spontan3 "" UWORD B_TRUE 1 100 0 1 BIT_MASK 0x400 FUNCTION_LIST ACIFI EVI IF_DATA DIM_X 0xFD3E INTERN BYTE IF_DATA MCMESS 0xFD3E INTERN /end MEASUREMENT
/begin MEASUREMENT B_spontan4 "" UWORD B_TRUE 1 100 0 1 BIT_MASK 0x800 FUNCTION_LIST ACIFI EVI IF_DATA DIM_X 0xFD3E INTERN BYTE IF_DATA MCMESS 0xFD3E INTERN /end MEASUREMENT
/begin MEASUREMENT B_spontan5 "" UWORD B_TRUE 1 100 0 1 BIT_MASK 0x1000 FUNCTION_LIST ACIFI EVI IF_DATA DIM_X 0xFD3E INTERN BYTE IF_DATA MCMESS 0xFD3E INTERN /end MEASUREMENT
/begin MEASUREMENT B_spontan6 "" UWORD B_TRUE 1 100 0 1 BIT_MASK 0x2000 FUNCTION_LIST ACIFI IF_DATA DIM_X 0xFD3E INTERN BYTE IF_DATA MCMESS 0xFD3E INTERN /end MEASUREMENT
/begin MEASUREMENT B_spontan7 "" UWORD B_TRUE 1 100 0 1 BIT_MASK 0x4000 FUNCTION_LIST ACIFI IF_DATA DIM_X 0xFD3E INTERN BYTE IF_DATA MCMESS 0xFD3E INTERN /end MEASUREMENT
/begin MEASUREMENT B_spsa "Bedingung Winkeladaption Kurbel- zu Nockenwelle zulässig" UWORD B_TRUE 1 100 0 1 BIT_MASK 0x400 FUNCTION_LIST WANWKW DNWKW IF_DATA DIM_X 0xFD1A INTERN BYTE IF_DATA MCMESS 0xFD1A INTERN /end MEASUREMENT
/begin MEASUREMENT B_spsa2 "Bedingung Winkeladaption Nockenwelle 2 zu Kurbelwelle zulässig" UWORD B_TRUE 1 100 0 1 BIT_MASK 0x800 FUNCTION_LIST WANWKW DNWKW IF_DATA DIM_X 0xFD1A INTERN BYTE IF_DATA MCMESS 0xFD1A INTERN /end MEASUREMENT
/begin MEASUREMENT B_spsmin "Mitteilung an SR: '1'= PWG-Notfahren mit SPSMIN" UWORD B_TRUE 1 100 0 1 BIT_MASK 0x80 FUNCTION_LIST GGPED DUF UFSPSC IF_DATA DIM_X 0xFD3C INTERN BYTE IF_DATA MCMESS 0xFD3C INTERN /end MEASUREMENT
/begin MEASUREMENT B_st "Bedingung Start" UWORD B_TRUE 1 100 0 1 BIT_MASK 0x2000 FUNCTION_LIST BBSTT ADVE AEKP ATM BGLBZ BGRLP DLLR DLSH DLSU DPH DSLSLRS ESNST ESUK GGDPG GGDVE GGKS GGLSU GGTFM HLSU KRKE LLRRM LRSEB LRSHK MDFAW NLDG SLS WANWKW ZWMIN IF_DATA DIM_X 0xFD86 INTERN BYTE IF_DATA MCMESS 0xFD86 INTERN /end MEASUREMENT
/begin MEASUREMENT B_sta "Bedingung automatischer Start" UBYTE B_TRUE 1 100 0 1 BIT_MASK 0x10 FUNCTION_LIST STA STARTUPF VHW IF_DATA DIM_X 0x3830C9 EXTERN BYTE IF_DATA MCMESS 0x3830C9 EXTERN /end MEASUREMENT
/begin MEASUREMENT B_staa "Bedingung Startadaption aktiv im Nachstart" UWORD B_TRUE 1 100 0 1 BIT_MASK 0x800 FUNCTION_LIST STADAP ESNST IF_DATA DIM_X 0xFD5C INTERN BYTE IF_DATA MCMESS 0xFD5C INTERN /end MEASUREMENT
/begin MEASUREMENT B_startini "Startbit für Erkennung der ersten Synchronisation nach KL15 ein" UWORD B_TRUE 1 100 0 1 BIT_MASK 0x2000 FUNCTION_LIST GGDPG ALE IF_DATA DIM_X 0xFD14 INTERN BYTE IF_DATA MCMESS 0xFD14 INTERN /end MEASUREMENT
/begin MEASUREMENT B_stdmd "Bedingung Aussetzererkennung während Starthochlauf gesperrt" UWORD B_TRUE 1 100 0 1 BIT_MASK 0x4000 FUNCTION_LIST DMDSTP IF_DATA DIM_X 0xFD98 INTERN WORD IF_DATA MCMESS 0xFD98 INTERN /end MEASUREMENT
/begin MEASUREMENT B_stdmd_m "" UBYTE B_TRUE 1 100 0 1 BIT_MASK 0x20 FUNCTION_LIST DMDSTP IF_DATA DIM_X 0xE3F0 INTERN WORD IF_DATA MCMESS 0xE3F0 INTERN /end MEASUREMENT
/begin MEASUREMENT B_stdperr "Bedingung Adaptionsende aufgrund erkanntem Fehler" UWORD B_TRUE 1 100 0 1 BIT_MASK 0x1000 FUNCTION_LIST STADAP IF_DATA DIM_X 0x382370 EXTERN BYTE IF_DATA MCMESS 0x382370 EXTERN /end MEASUREMENT
/begin MEASUREMENT B_steigm "Bedingung Steigung des Sondensignals messen" UWORD B_TRUE 1 100 0 1 BIT_MASK 0x800 FUNCTION_LIST DLSAHK IF_DATA DIM_X 0xFD26 INTERN BYTE IF_DATA MCMESS 0xFD26 INTERN /end MEASUREMENT
/begin MEASUREMENT B_steigm2 "Bedingung Steigung des Sondensignals messen Bank2" UWORD B_TRUE 1 100 0 1 BIT_MASK 0x1000 FUNCTION_LIST DLSAHK IF_DATA DIM_X 0xFD26 INTERN BYTE IF_DATA MCMESS 0xFD26 INTERN /end MEASUREMENT
/begin MEASUREMENT B_stend "Bedingung Startende erreicht" UWORD B_TRUE 1 100 0 1 BIT_MASK 0x4000 FUNCTION_LIST BBSTT AEKP AKWAV ALE ARMD ATM BBKHZ BBLDR BBSAWE BGDVE BGRLP BGTABS DCGE DDCY DDVE DEGFE DEVE DHFM DHLSHK DHLSU DKRNT DLSU DSLSLRS DWUC ESNST ESSTT ESUK ESVW ESWL FUEREG GGAIRB GGKS GGLSU GGPED GGTFA GGTFM GGTFOL GGUB HLSHK HLSU KOS KRRA LDUVST LLRBB LLRMR LLRNS LLRRM LRSEB MDFAW MDKOG MOTAUS NMAXMD NWS RKTI SLS STADAP SU T2DFA TIMU VS ZWSTT IF_DATA DIM_X 0xFD86 INTERN BYTE IF_DATA MCMESS 0xFD86 INTERN /end MEASUREMENT
/begin MEASUREMENT B_stf "Bedingung Startfreigabe" UBYTE B_TRUE 1 100 0 1 BIT_MASK 0x4 FUNCTION_LIST STA IF_DATA DIM_X 0x3830C9 EXTERN BYTE IF_DATA MCMESS 0x3830C9 EXTERN /end MEASUREMENT
/begin MEASUREMENT B_stimnlph "Aussetzer stimuliert durch NLPH" UWORD B_TRUE 1 100 0 1 BIT_MASK 0x80 FUNCTION_LIST NLPH DMDSTP IF_DATA DIM_X 0xFD1A INTERN BYTE IF_DATA MCMESS 0xFD1A INTERN /end MEASUREMENT
/begin MEASUREMENT B_stldw "Bedingung Stützstellenwechsel LDR Adaption" UWORD B_TRUE 1 100 0 1 BIT_MASK 0x4 FUNCTION_LIST LDRPID IF_DATA DIM_X 0xFD68 INTERN BYTE IF_DATA MCMESS 0xFD68 INTERN /end MEASUREMENT
/begin MEASUREMENT B_stndfr "Freigabe Füllungsregler nach Start" UWORD B_TRUE 1 100 0 1 BIT_MASK 0x2000 FUNCTION_LIST FUEREG IF_DATA DIM_X 0xFD4A INTERN BYTE IF_DATA MCMESS 0xFD4A INTERN /end MEASUREMENT
/begin MEASUREMENT B_stndnl "Bedingung Beginn SG-Nachlauf oder Startende (1->0)" UWORD B_TRUE 1 100 0 1 BIT_MASK 0x40 FUNCTION_LIST ATM IF_DATA DIM_X 0xFD1C INTERN BYTE IF_DATA MCMESS 0xFD1C INTERN /end MEASUREMENT
/begin MEASUREMENT B_stoe "Bedingung B_st oder B_stend" UWORD B_TRUE 1 100 0 1 BIT_MASK 0x200 FUNCTION_LIST HLSU IF_DATA DIM_X 0xFD80 INTERN BYTE IF_DATA MCMESS 0xFD80 INTERN /end MEASUREMENT
/begin MEASUREMENT B_stswfs "Statusbit Wegfahrsperre" UBYTE B_TRUE 1 100 0 1 BIT_MASK 0x2 FUNCTION_LIST WFS T2LID IF_DATA DIM_X 0x3830B5 EXTERN BYTE IF_DATA MCMESS 0x3830B5 EXTERN /end MEASUREMENT
/begin MEASUREMENT B_su "Bedingung Saugrohrumschaltung" UWORD B_TRUE 1 100 0 1 BIT_MASK 0x8 FUNCTION_LIST SU IF_DATA DIM_X 0xFD4C INTERN BYTE IF_DATA MCMESS 0xFD4C INTERN /end MEASUREMENT
/begin MEASUREMENT B_su2 "Bedingung Saugrohrumschaltung, 2. Klappe" UWORD B_TRUE 1 100 0 1 BIT_MASK 0x10 FUNCTION_LIST SU IF_DATA DIM_X 0xFD4C INTERN BYTE IF_DATA MCMESS 0xFD4C INTERN /end MEASUREMENT
/begin MEASUREMENT B_sukp "Bedingung für die Freigabe der Saugrohrumschaltung Klappe 1" UWORD B_TRUE 1 100 0 1 BIT_MASK 0x20 FUNCTION_LIST SU IF_DATA DIM_X 0xFD4C INTERN BYTE IF_DATA MCMESS 0xFD4C INTERN /end MEASUREMENT
/begin MEASUREMENT B_sukp2 "Bedingung für die Freigabe der Saugrohrumschaltung Klappe 2" UWORD B_TRUE 1 100 0 1 BIT_MASK 0x40 FUNCTION_LIST SU IF_DATA DIM_X 0xFD4C INTERN BYTE IF_DATA MCMESS 0xFD4C INTERN /end MEASUREMENT
/begin MEASUREMENT B_svuerf "Bedingung Sondenspannung vor KAT erfassen" UWORD B_TRUE 1 100 0 1 BIT_MASK 0x10 FUNCTION_LIST SWADP GGLSH IF_DATA DIM_X 0xFD86 INTERN BYTE IF_DATA MCMESS 0xFD86 INTERN /end MEASUREMENT
/begin MEASUREMENT B_svuerf2 "Bedingung Sondenspannung vor KAT erfassen Bank2" UWORD B_TRUE 1 100 0 1 BIT_MASK 0x20 FUNCTION_LIST SWADP GGLSH IF_DATA DIM_X 0xFD86 INTERN BYTE IF_DATA MCMESS 0xFD86 INTERN /end MEASUREMENT
/begin MEASUREMENT B_sw0 "Bedingung keine Schliesszeitüberlappung" UWORD B_TRUE 1 100 0 1 BIT_MASK 0x40 FUNCTION_LIST AZUE IF_DATA DIM_X 0xFD00 INTERN BYTE IF_DATA MCMESS 0xFD00 INTERN /end MEASUREMENT
/begin MEASUREMENT B_sw1 "Bedingung Schliesszeitüberlappung" UWORD B_TRUE 1 100 0 1 BIT_MASK 0x80 FUNCTION_LIST AZUE IF_DATA DIM_X 0xFD00 INTERN BYTE IF_DATA MCMESS 0xFD00 INTERN /end MEASUREMENT
/begin MEASUREMENT B_swe "Bedingung Schlechtwegstrecke erkannt" UWORD B_TRUE 1 100 0 1 BIT_MASK 0x400 FUNCTION_LIST DMDSTP IF_DATA DIM_X 0xFD0C INTERN BYTE IF_DATA MCMESS 0xFD0C INTERN /end MEASUREMENT
/begin MEASUREMENT B_swev "Bedingung Schlechtwegstrecke im Verdacht" UWORD B_TRUE 1 100 0 1 BIT_MASK 0x200 FUNCTION_LIST DSWEC IF_DATA DIM_X 0xFD86 INTERN BYTE IF_DATA MCMESS 0xFD86 INTERN /end MEASUREMENT
/begin MEASUREMENT B_swe_c "Bedingung Schlechtwegstrecke erkannt aus %DSWEC" UWORD B_TRUE 1 100 0 1 BIT_MASK 0x400 FUNCTION_LIST DSWEC DMDSTP IF_DATA DIM_X 0xFD86 INTERN BYTE IF_DATA MCMESS 0xFD86 INTERN /end MEASUREMENT
/begin MEASUREMENT B_switchpg "Bedingung für Umschaltung des Phasengebers auf PG2 für Notlauf Drehzahlgeber" UWORD B_TRUE 1 100 0 1 BIT_MASK 0x40 FUNCTION_LIST DPH NLDG PHAS IF_DATA DIM_X 0xFD12 INTERN BYTE IF_DATA MCMESS 0xFD12 INTERN /end MEASUREMENT
/begin MEASUREMENT B_swknb "Bedingung Setzwertkorrektur nach Beschleunigen" UBYTE B_TRUE 1 100 0 1 BIT_MASK 0x40 FUNCTION_LIST FGRMD IF_DATA DIM_X 0x380AD8 EXTERN BYTE IF_DATA MCMESS 0x380AD8 EXTERN /end MEASUREMENT
/begin MEASUREMENT B_swknv "Bedingung Setzwertkorrektur nach Verzögern" UBYTE B_TRUE 1 100 0 1 BIT_MASK 0x80 FUNCTION_LIST FGRMD IF_DATA DIM_X 0x380AD8 EXTERN BYTE IF_DATA MCMESS 0x380AD8 EXTERN /end MEASUREMENT
/begin MEASUREMENT B_syn "Bedingung Synchronisation erfolgt" UWORD B_TRUE 1 100 0 1 BIT_MASK 0x4000 FUNCTION_LIST GGDPG DNWS TN WANWKW IF_DATA DIM_X 0xFD14 INTERN BYTE IF_DATA MCMESS 0xFD14 INTERN /end MEASUREMENT
/begin MEASUREMENT B_syn2nd "" UWORD B_TRUE 1 100 0 1 BIT_MASK 0x800 FUNCTION_LIST BGNG IF_DATA DIM_X 0xFD10 INTERN BYTE IF_DATA MCMESS 0xFD10 INTERN /end MEASUREMENT
/begin MEASUREMENT B_synbmale "Bedingung: Kein Phasengeber für Synchronisation vorhanden" UWORD B_TRUE 1 100 0 1 BIT_MASK 0x8000 FUNCTION_LIST GGDPG IF_DATA DIM_X 0xFD14 INTERN BYTE IF_DATA MCMESS 0xFD14 INTERN /end MEASUREMENT
/begin MEASUREMENT B_synnldg "Bedingung: Motorposition im Notlauf DG aus PG-Signal erkannt" UWORD B_TRUE 1 100 0 1 BIT_MASK 0x80 FUNCTION_LIST NLDG DDG GGDPG WANWKW IF_DATA DIM_X 0xFD18 INTERN BYTE IF_DATA MCMESS 0xFD18 INTERN /end MEASUREMENT
/begin MEASUREMENT B_synoknl "Synchronisation für den Notlauf ist erlaubt" UWORD B_TRUE 1 100 0 1 BIT_MASK 0x100 FUNCTION_LIST NLDG IF_DATA DIM_X 0xFD18 INTERN BYTE IF_DATA MCMESS 0xFD18 INTERN /end MEASUREMENT
/begin MEASUREMENT B_synph "Bedingung Synchronisation Phase" UWORD B_TRUE 1 100 0 1 BIT_MASK 0x1 FUNCTION_LIST GGDPG DKRS DMDMIL DMDSTP KRKE NLPH IF_DATA DIM_X 0xFD16 INTERN BYTE IF_DATA MCMESS 0xFD16 INTERN /end MEASUREMENT
/begin MEASUREMENT B_synti "" UWORD B_TRUE 1 100 0 1 BIT_MASK 0x8000 FUNCTION_LIST ACIFI IF_DATA DIM_X 0xFD3E INTERN BYTE IF_DATA MCMESS 0xFD3E INTERN /end MEASUREMENT
/begin MEASUREMENT B_szkat "Zykluszeit und Fehler in einer Bank abgelaufen" UWORD B_TRUE 1 100 0 1 BIT_MASK 0x4 FUNCTION_LIST DKATLRS IF_DATA DIM_X 0xFD22 INTERN BYTE IF_DATA MCMESS 0xFD22 INTERN /end MEASUREMENT
/begin MEASUREMENT B_szkat2 "Zykluszeit und Fehler in Bank2 abgelaufen" UWORD B_TRUE 1 100 0 1 BIT_MASK 0x8 FUNCTION_LIST DKATLRS IF_DATA DIM_X 0xFD22 INTERN BYTE IF_DATA MCMESS 0xFD22 INTERN /end MEASUREMENT
/begin MEASUREMENT B_szsls "Bedingung Diagnose Sekundärluftsystem durchgeführt, Summe" UBYTE B_TRUE 1 100 0 1 BIT_MASK 0x10 FUNCTION_LIST DSLSLRS T2DFA IF_DATA DIM_X 0x380901 EXTERN BYTE IF_DATA MCMESS 0x380901 EXTERN /end MEASUREMENT
/begin MEASUREMENT B_t2dvs "Ventilhubdiagnose über Tester bereitgeschaltet" UWORD B_TRUE 1 100 0 1 BIT_MASK 0x8 FUNCTION_LIST T2DFA DVS IF_DATA DIM_X 0xFD06 INTERN BYTE IF_DATA MCMESS 0xFD06 INTERN /end MEASUREMENT
/begin MEASUREMENT B_t2vsg "Bedingung Tester führt Zwangsverstellung nach ""Hub gross"" durch" UWORD B_TRUE 1 100 0 1 BIT_MASK 0x10 FUNCTION_LIST T2DFA DVS VS IF_DATA DIM_X 0xFD06 INTERN BYTE IF_DATA MCMESS 0xFD06 INTERN /end MEASUREMENT
/begin MEASUREMENT B_t2vsk "Bedingung Tester führt Zwangsverstellung nach ""Hub klein"" durch" UWORD B_TRUE 1 100 0 1 BIT_MASK 0x20 FUNCTION_LIST T2DFA DVS MDEX VS IF_DATA DIM_X 0xFD06 INTERN BYTE IF_DATA MCMESS 0xFD06 INTERN /end MEASUREMENT
/begin MEASUREMENT B_tabgbts "Bedingung Abgastemperatur für Bauteileschutz überschritten" UWORD B_TRUE 1 100 0 1 BIT_MASK 0x100 FUNCTION_LIST LAMBTS IF_DATA DIM_X 0xFD58 INTERN BYTE IF_DATA MCMESS 0xFD58 INTERN /end MEASUREMENT
/begin COMPU_METHOD B_TRUE "boolsche Zustände, positive Logik" TAB_VERB "%6.3" "" COMPU_TAB_REF B_TRUE /end COMPU_METHOD
/begin COMPU_VTAB B_TRUE "boolsche Zustände, positive Logik" TAB_VERB 2 0 "----" 1 "TRUE" /end COMPU_VTAB
/end MODULE
/end PROJECT
