/begin PROJECT _7804367 "156"
/begin HEADER "" VERSION "_7804367" PROJECT_NO _7804367 /end HEADER
/begin MODULE DIM ""
/begin MOD_COMMON "" BYTE_ORDER BIG_ENDIAN S_REC_LAYOUT DAMOS /end MOD_COMMON
/begin CHARACTERISTIC LDRAPP "Festwert für LDR-Applikation ohne Md-Koordination" VALUE 0x8196A9 KwUb 99.61 tv_ub_b100 0.00 99.61 FUNCTION_LIST LDTVMA IF_DATA DIM_X DIRECT 0x8196A9 /end CHARACTERISTIC
/begin CHARACTERISTIC LDRPBU "P-Regler Kennwert LDR back up Regler" VALUE 0x8196AA KwUb 0.2621 tv_q0p001028 0.00 0.2621 FUNCTION_LIST LDTVMA IF_DATA DIM_X DIRECT 0x8196AA /end CHARACTERISTIC
/begin CHARACTERISTIC LDRQ0DY "LDR-Reglerparameter Q0" CURVE 0x81D9DE GklWUw 3276.750 rel_uw_b3276p75 0.00 3276.750 FUNCTION_LIST LDRPID IF_DATA DIM_X DIRECT 0x81D9DE
 /begin AXIS_DESCR COM_AXIS nmot nmot_ub_q40 16 0.00 10200. AXIS_PTS_REF SNM16LDUB /end AXIS_DESCR
/end CHARACTERISTIC
/begin CHARACTERISTIC LDRQ0S "Reglerparameter Q0 LDR-PID Regler im Stationärbetrieb" VALUE 0x81D9FE KwUw 3276.750 rel_uw_b3276p75 0.00 3276.750 FUNCTION_LIST LDRPID IF_DATA DIM_X DIRECT 0x81D9FE /end CHARACTERISTIC
/begin CHARACTERISTIC LDRQ1DY "Reglerparameter Q1 PID-Regler im Dynamikbetrieb (Integrationsbeiwert)" CURVE 0x81DA00 GklWUw 3276.750 rel_uw_b3276p75 0.00 3276.750 FUNCTION_LIST LDRPID IF_DATA DIM_X DIRECT 0x81DA00
 /begin AXIS_DESCR COM_AXIS nmot nmot_ub_q40 16 0.00 10200. AXIS_PTS_REF SNM16LDUB /end AXIS_DESCR
/end CHARACTERISTIC
/begin CHARACTERISTIC LDRQ1ST "Reglerparameter Q1 PID-Regler im Stationärbetrieb (Integrationsbeiwert)" CURVE 0x81DA20 GklWUw 3276.750 rel_uw_b3276p75 0.00 3276.750 FUNCTION_LIST LDRPID IF_DATA DIM_X DIRECT 0x81DA20
 /begin AXIS_DESCR COM_AXIS nmot nmot_ub_q40 16 0.00 10200. AXIS_PTS_REF SNM16LDUB /end AXIS_DESCR
/end CHARACTERISTIC
/begin CHARACTERISTIC LDRVL "Vollast Erkennungsschwelle LDR" VALUE 0x819615 KwUb 99.61 rel_ub_b99p6 0.00 99.61 FUNCTION_LIST LDRPID IF_DATA DIM_X DIRECT 0x819615 /end CHARACTERISTIC
/begin CHARACTERISTIC LDUVRS "LDR Umluftventilsteuerung Reset vom Sollwert" VALUE 0x8114AE KwUb 2550. p_ub_q10 0.00 2550. FUNCTION_LIST LDUVST IF_DATA DIM_X DIRECT 0x8114AE /end CHARACTERISTIC
/begin CHARACTERISTIC LIMN "Untere Integratorbegrenzung bei stehendem Fahrzeug" VALUE 0x811623 KwUb 24.90 rel_ub_bn24p9 -24.90 0.00 FUNCTION_LIST LLRRM IF_DATA DIM_X DIRECT 0x811623 /end CHARACTERISTIC
/begin CHARACTERISTIC LIMNDLLR "Untere Integratorbegrenzung bei Diagnose Leerlaufregelung" VALUE 0x811624 KwUb 24.90 rel_ub_bn24p9 -24.90 0.00 FUNCTION_LIST LLRRM IF_DATA DIM_X DIRECT 0x811624 /end CHARACTERISTIC
/begin CHARACTERISTIC LIMNDTES "Untere Integratorbegrenzung bei DTES" VALUE 0x811625 KwUb 24.90 rel_ub_bn24p9 -24.90 0.00 FUNCTION_LIST LLRRM IF_DATA DIM_X DIRECT 0x811625 /end CHARACTERISTIC
/begin CHARACTERISTIC LIMNV "Untere Integratorbegrenzung bei rollendem Fahrzeug" VALUE 0x811626 KwUb 24.90 rel_ub_bn24p9 -24.90 0.00 FUNCTION_LIST LLRRM IF_DATA DIM_X DIRECT 0x811626 /end CHARACTERISTIC
/begin CHARACTERISTIC LIMTKOA "Zeitschwelle um den Kompressor unbegrenzt auszuschalten" VALUE 0x812B78 KwUb 51.00 t200msxs_ub_b51 0.00 51.00 FUNCTION_LIST KOS IF_DATA DIM_X DIRECT 0x812B78 /end CHARACTERISTIC
/begin CHARACTERISTIC LIMXDNS "Obere Integratorbegrenzung bei stehendem Fahrzeug" CURVE 0x819738 GklWUb 24.90 rel_ub_b24p9 0.00 24.90 FUNCTION_LIST LLRRM IF_DATA DIM_X DIRECT 0x819738
 /begin AXIS_DESCR COM_AXIS dns nmotd_sb_q10 6 -1280. 1270. AXIS_PTS_REF SNS206LLSB /end AXIS_DESCR
/end CHARACTERISTIC
/begin CHARACTERISTIC LIMXVDNS "Obere Integratorbegrenzung bei rollendem Fahrzeug" CURVE 0x81973E GklWUb 24.90 rel_ub_b24p9 0.00 24.90 FUNCTION_LIST LLRRM IF_DATA DIM_X DIRECT 0x81973E
 /begin AXIS_DESCR COM_AXIS dns nmotd_sb_q10 6 -1280. 1270. AXIS_PTS_REF SNS206LLSB /end AXIS_DESCR
/end CHARACTERISTIC
/begin CHARACTERISTIC LISTM "Wert des Leerlaufintegrators im Start" CURVE 0x819744 GklWUb 24.90 rel_ub_b24p9 0.00 24.90 FUNCTION_LIST LLRRM IF_DATA DIM_X DIRECT 0x819744
 /begin AXIS_DESCR COM_AXIS tmot temp_ub_q0p75_o48 6 -48.00 143.3 AXIS_PTS_REF STM06LLUB /end AXIS_DESCR
/end CHARACTERISTIC
/begin CHARACTERISTIC LKRN "Lastschwelle Klopfregelung" CURVE 0x819322 GklWUb 191.3 rel_ub_q0p75 0.00 191.3 FUNCTION_LIST KRRA IF_DATA DIM_X DIRECT 0x819322
 /begin AXIS_DESCR COM_AXIS nmot nmot_ub_q40 16 0.00 10200. AXIS_PTS_REF SNM16KRUB /end AXIS_DESCR
/end CHARACTERISTIC
/begin CHARACTERISTIC LLRICNF "Configurationsbyte für LLR Integrator" VALUE 0x811627 KwUb 255.0 dez 0.00 255.0 FUNCTION_LIST LLRRM IF_DATA DIM_X DIRECT 0x811627 /end CHARACTERISTIC
/begin CHARACTERISTIC LMSTMOT "Motortemp.-Korrektur von Lambda-Motor-Soll" CURVE 0x81915B KlAUbSstUbWUb 1.992 fak_ub_b2 0.00 1.992 FUNCTION_LIST LAKH IF_DATA DIM_X DIRECT 0x81915B
 /begin AXIS_DESCR STD_AXIS tmot temp_ub_q0p75_o48 4 -48.00 143.3 DEPOSIT ABSOLUT /end AXIS_DESCR
/end CHARACTERISTIC
/begin CHARACTERISTIC LNXQTM "Natürlicher Logarithmus aus Temperaturquotient" CURVE 0x81C738 KlAUwSstUwWUw 3.999939 fak_uw_b4 0.00 3.999939 FUNCTION_LIST BGTABS IF_DATA DIM_X DIRECT 0x81C738
 /begin AXIS_DESCR STD_AXIS xqtm_w fak_uw_b16 12 0.00 15.99976 DEPOSIT ABSOLUT /end AXIS_DESCR
/end CHARACTERISTIC
/begin CHARACTERISTIC LRHIMN "minimale Integratorgrenze der stetigen LRHK" VALUE 0x816EA2 KwSw 1.999969 fak_sw_b1 -1.000000 0.9999695 FUNCTION_LIST LRSHK IF_DATA DIM_X DIRECT 0x816EA2 /end CHARACTERISTIC
/begin CHARACTERISTIC LRHIMX "maximale Integratorgrenze der stetigen LRHK" VALUE 0x816EA4 KwSw 1.999969 fak_sw_b1 -1.000000 0.9999695 FUNCTION_LIST LRSHK IF_DATA DIM_X DIRECT 0x816EA4 /end CHARACTERISTIC
/begin CHARACTERISTIC LRNST1_T "Wartezeit in Lernschritt 1" VALUE 0x810D38 KwUb 5.080 t20msxs_ub_b5p1 0.02000 5.100 FUNCTION_LIST BGDVE IF_DATA DIM_X DIRECT 0x810D38 /end CHARACTERISTIC
/begin CHARACTERISTIC LRNST3_T "Wartezeit in Lernschritt 3" VALUE 0x810D39 KwUb 5.080 t20msxs_ub_b5p1 0.02000 5.100 FUNCTION_LIST BGDVE IF_DATA DIM_X DIRECT 0x810D39 /end CHARACTERISTIC
/begin CHARACTERISTIC LRNST7_T "Wartezeit in Lernschritt 7" VALUE 0x810D3A KwUb 5.080 t20msxs_ub_b5p1 0.02000 5.100 FUNCTION_LIST BGDVE IF_DATA DIM_X DIRECT 0x810D3A /end CHARACTERISTIC
/begin CHARACTERISTIC LRNST9_T "Wartezeit in Lernschritt 9" VALUE 0x810D3B KwUb 5.080 t20msxs_ub_b5p1 0.02000 5.100 FUNCTION_LIST BGDVE IF_DATA DIM_X DIRECT 0x810D3B /end CHARACTERISTIC
/begin CHARACTERISTIC LRNVB_T "Lernverbotszeit für 'normales Lernen'" VALUE 0x813D88 KwUw 1310.700 t20msxs_uw_q0p02 0.00 1310.700 FUNCTION_LIST BGDVE IF_DATA DIM_X DIRECT 0x813D88 /end CHARACTERISTIC
/begin CHARACTERISTIC LRSGKTM "Korrekturkennlinie der Reglerparameter bei tiefen Motortemperaturen" CURVE 0x8198DD KlAUbSstUbWUb 1.992 fak_ub_b2 0.00 1.992 FUNCTION_LIST LRS IF_DATA DIM_X DIRECT 0x8198DD
 /begin AXIS_DESCR STD_AXIS tmot temp_ub_q0p75_o48 6 -48.00 143.3 DEPOSIT ABSOLUT /end AXIS_DESCR
/end CHARACTERISTIC
/begin CHARACTERISTIC LRSTPZA "Periodendauer der LRS-Zwangsamplitude" VALUE 0x816D82 KwUw 655.3500 t10msxs_uw_b655p35 0.00 655.3500 FUNCTION_LIST LRS IF_DATA DIM_X DIRECT 0x816D82 /end CHARACTERISTIC
/begin CHARACTERISTIC LRSZAML "Amplitude der LRS-Zwangsamplitude" CURVE 0x812104 KlAUbSstUbWUb 0.249023438 fak_ub_b0p25 0.00 0.249023438 FUNCTION_LIST LRS IF_DATA DIM_X DIRECT 0x812104 /begin AXIS_DESCR STD_AXIS ml m_ub_b1020 6 0.00 1020. DEPOSIT ABSOLUT /end AXIS_DESCR /end CHARACTERISTIC
/begin CHARACTERISTIC LSUNAMN "untere Schwelle für LSU nicht aktiv" VALUE 0x81B8FE KwUw 15.99976 fak_uw_b16 0.00 15.99976 FUNCTION_LIST DLSU IF_DATA DIM_X DIRECT 0x81B8FE /end CHARACTERISTIC
/begin CHARACTERISTIC LSUNAMX "obere Schwelle für LSU nicht aktiv" VALUE 0x81B900 KwUw 15.99976 fak_uw_b16 0.00 15.99976 FUNCTION_LIST DLSU IF_DATA DIM_X DIRECT 0x81B900 /end CHARACTERISTIC
/begin CHARACTERISTIC LURBRL8 "Laufunruhe-Referenzwert bei Fahrzeug steht" CURVE 0x81B448 KlAUbSstUbWSb 463.8 luquant -232.8 231.0 FUNCTION_LIST DMDLU_C IF_DATA DIM_X DIRECT 0x81B448 /begin AXIS_DESCR STD_AXIS rl rel_ub_q0p75 8 0.00 191.3 DEPOSIT ABSOLUT /end AXIS_DESCR /end CHARACTERISTIC
/begin CHARACTERISTIC LURFOST "Laufruhe-Referenzwert für stop fuel-on/-off Adaption, Vergleich mit lunw" VALUE 0x81027F KwUb 463.8 luquant 0.00 463.8 FUNCTION_LIST DMDFON IF_DATA DIM_X DIRECT 0x81027F /end CHARACTERISTIC
/begin CHARACTERISTIC LURKH "dmrkh-abh. Laufunruhe-Referenzkorrekturwert, bei Katheizen" CURVE 0x81818E KlAUbSstUbWUb 1.992 fak_ub_b2 0.00 1.992 FUNCTION_LIST DMDLU_C IF_DATA DIM_X DIRECT 0x81818E /begin AXIS_DESCR STD_AXIS dmrkh rel_ub_b99p6 4 0.00 99.61 DEPOSIT ABSOLUT /end AXIS_DESCR /end CHARACTERISTIC
/begin CHARACTERISTIC LURKTM "Tmot-abhängiger Laufunruhe-Referenz-Korrekturwert" CURVE 0x8107E7 GklWSb 463.8 luquant -232.8 231.0 FUNCTION_LIST DMDLU IF_DATA DIM_X DIRECT 0x8107E7
 /begin AXIS_DESCR COM_AXIS tmot temp_ub_q0p75_o48 8 -48.00 143.3 AXIS_PTS_REF STM08DMUB /end AXIS_DESCR
/end CHARACTERISTIC
/begin CHARACTERISTIC LURMIN1 "Drehzahlabh. Laufunruhe-Referenz-Minimalwert 1" CURVE 0x8107EF GklWSb 463.8 luquant -232.8 231.0 FUNCTION_LIST DMDLU IF_DATA DIM_X DIRECT 0x8107EF
 /begin AXIS_DESCR COM_AXIS nmot nmot_ub_q40 8 0.00 10200. AXIS_PTS_REF SNM08DMUB /end AXIS_DESCR
/end CHARACTERISTIC
/begin CHARACTERISTIC LURMIN2 "Drehzahlabh. Laufunruhe-Referenz-Minimalwert 2" CURVE 0x8107F7 GklWSb 463.8 luquant -232.8 231.0 FUNCTION_LIST DMDLU IF_DATA DIM_X DIRECT 0x8107F7
 /begin AXIS_DESCR COM_AXIS nmot nmot_ub_q40 8 0.00 10200. AXIS_PTS_REF SNM08DMUB /end AXIS_DESCR
/end CHARACTERISTIC
/begin CHARACTERISTIC LURMIN3 "Drehzahlabh. Laufunruhe-Referenz-Minimalwert 3" CURVE 0x8107FF GklWSb 463.8 luquant -232.8 231.0 FUNCTION_LIST DMDLU IF_DATA DIM_X DIRECT 0x8107FF
 /begin AXIS_DESCR COM_AXIS nmot nmot_ub_q40 8 0.00 10200. AXIS_PTS_REF SNM08DMUB /end AXIS_DESCR
/end CHARACTERISTIC
/begin CHARACTERISTIC LURMINKH "Laufunruhe Referenz-Minimalwert bei Katheizen" VALUE 0x810807 KwSb 231.0 luquant 0.00 231.0 FUNCTION_LIST DMDLU IF_DATA DIM_X DIRECT 0x810807 /end CHARACTERISTIC
/begin CHARACTERISTIC LURST "Laufunruhe-Referenzwertkorrektur nach Start" CURVE 0x818197 KlAUbSstUbWUb 1.992 fak_ub_b2 0.00 1.992 FUNCTION_LIST DMDLU_C IF_DATA DIM_X DIRECT 0x818197
 /begin AXIS_DESCR STD_AXIS tnstmd t40msxs_ub_q0p04 6 0.00 10.20 DEPOSIT ABSOLUT /end AXIS_DESCR
/end CHARACTERISTIC
/begin CHARACTERISTIC MDEGSBGN "Max.Moment bei Getriebenotlauf oder Datensatzfehler (MT-Daten in AT-Fz)" CURVE 0x8137DE KlAUwSstUwWUw 99.99847 rel_uw_b100 0.00 99.99847 FUNCTION_LIST MDEX IF_DATA DIM_X DIRECT 0x8137DE
 /begin AXIS_DESCR STD_AXIS nmot_w nmot_uw_q0p25 8 0.00 16383.75 DEPOSIT ABSOLUT /end AXIS_DESCR
/end CHARACTERISTIC
/begin CHARACTERISTIC MDERFOKH "Anzahl Aussetzer für Adaptionsstop (Heilung) bei B_kh = 1" VALUE 0x81384E KwUw 65535.00 dez 0.00 65535.00 FUNCTION_LIST DMDFON IF_DATA DIM_X DIRECT 0x81384E /end CHARACTERISTIC
/begin CHARACTERISTIC MDERKFON "Anzahl Aussetzer für Adaptionsstop (Heilung)" VALUE 0x813850 KwUw 65535.00 dez 0.00 65535.00 FUNCTION_LIST DMDFON IF_DATA DIM_X DIRECT 0x813850 /end CHARACTERISTIC
/begin CHARACTERISTIC MDHYEZ "Momenten-Hysterese bei Entscheidung der Zylinderausblendung" VALUE 0x811B50 KwUb 99.61 rel_ub_b99p6 0.00 99.61 FUNCTION_LIST MDRED1 IF_DATA DIM_X DIRECT 0x811B50 /end CHARACTERISTIC
/begin CHARACTERISTIC MDHYST "Hysterese bei der Begrenzung des Sollmoments (Ebene 1 Überwachungskonzept)" VALUE 0x813FFC KwUw 99.99847 rel_uw_b100 0.00 99.99847 FUNCTION_LIST MDKOG IF_DATA DIM_X DIRECT 0x813FFC /end CHARACTERISTIC
/begin CHARACTERISTIC MDIMX "Maximales indiziertes Motormoment" VALUE 0x811C22 KwUb 99.61 rel_ub_b99p6 0.00 99.61 FUNCTION_LIST NMAXMD CAN MDBGV MDEX MDFAW MDKOG MDKOL MDZUL VMAXMD IF_DATA DIM_X DIRECT 0x811C22 /end CHARACTERISTIC
/begin CHARACTERISTIC MDIMX_UM "Maximal erreichbares indiziertes Motormoment für die Funktionsüberwachung" VALUE 0x817D03 KwUb 99.61 rel_ub_q0p3906 0.00 99.61 FUNCTION_LIST UFEING IF_DATA DIM_X DIRECT 0x817D03 /end CHARACTERISTIC
/begin CHARACTERISTIC MDKOAN "Drehmomentschwelle um den Klimakompressor abzuschalten" CURVE 0x812B79 GklWUb 99.61 rel_ub_b99p6 0.00 99.61 FUNCTION_LIST KOS IF_DATA DIM_X DIRECT 0x812B79
 /begin AXIS_DESCR COM_AXIS nmot nmot_ub_q40 8 0.00 10200. AXIS_PTS_REF SNM08KOUB /end AXIS_DESCR
/end CHARACTERISTIC
/begin CHARACTERISTIC MDKOEN "Drehmomentschwelle um den Klimakompressor einzuschalten" CURVE 0x812B81 GklWUb 99.61 rel_ub_b99p6 0.00 99.61 FUNCTION_LIST KOS IF_DATA DIM_X DIRECT 0x812B81
 /begin AXIS_DESCR COM_AXIS nmot nmot_ub_q40 8 0.00 10200. AXIS_PTS_REF SNM08KOUB /end AXIS_DESCR
/end CHARACTERISTIC
/begin CHARACTERISTIC MDLF1 "stationäres Moment für laufenden Lüfter 1" VALUE 0x811665 KwUb 99.61 rel_ub_b99p6 0.00 99.61 FUNCTION_LIST MDVERB IF_DATA DIM_X DIRECT 0x811665 /end CHARACTERISTIC
/begin CHARACTERISTIC MDLF2 "stationäres Moment für laufenden Lüfter 2" VALUE 0x811666 KwUb 99.61 rel_ub_b99p6 0.00 99.61 FUNCTION_LIST MDVERB IF_DATA DIM_X DIRECT 0x811666 /end CHARACTERISTIC
/begin CHARACTERISTIC MDMSG "Reservermoment beim Motorspülgebläse" VALUE 0x811667 KwUb 99.61 rel_ub_b99p6 0.00 99.61 FUNCTION_LIST MDVERB IF_DATA DIM_X DIRECT 0x811667 /end CHARACTERISTIC
/begin CHARACTERISTIC MDSH "Höhenabhängiger Anteil des Schleppmomentes" CURVE 0x81DADE KlAUbSstUbWSb 49.90 rel_q0p1957 -25.05 24.85 FUNCTION_LIST MDVER IF_DATA DIM_X DIRECT 0x81DADE /begin AXIS_DESCR STD_AXIS fho fak_ub_b4 6 0.00 3.984 DEPOSIT ABSOLUT /end AXIS_DESCR /end CHARACTERISTIC
/begin CHARACTERISTIC MDSM "Schleppmoment Temperaturanteil" CURVE 0x81DAEC GklWUw 99.99847 rel_uw_b100 0.00 99.99847 FUNCTION_LIST MDVER IF_DATA DIM_X DIRECT 0x81DAEC
 /begin AXIS_DESCR COM_AXIS tmot temp_ub_q0p75_o48 6 -48.00 143.3 AXIS_PTS_REF STM06__UB /end AXIS_DESCR
/end CHARACTERISTIC
/begin CHARACTERISTIC MDSTHO "Höhenschwelle zur Umschaltung Nachstartkompensation/Startmoment" VALUE 0x815B14 KwUw 3.999939 fak_uw_b4 0.00 3.999939 FUNCTION_LIST STMD IF_DATA DIM_X DIRECT 0x815B14 /end CHARACTERISTIC
/begin CHARACTERISTIC MDWBEGTW "Wandlermomentbegrenzung" CURVE 0x81DAD0 KlAUbSstUbWSb 198.9 rel_sb_q0p78 -99.84 99.06 FUNCTION_LIST MDWAN IF_DATA DIM_X DIRECT 0x81DAD0
 /begin AXIS_DESCR STD_AXIS twan_kge temp_ub_q1_o50 6 -50.00 205.0 DEPOSIT ABSOLUT /end AXIS_DESCR
/end CHARACTERISTIC
/begin CHARACTERISTIC MIFA_DAT_UC "" VAL_BLK 0x811CCC KwbUb 99.61 rel_ub_q0p3906 0.00 99.61 NUMBER 16 FUNCTION_LIST URCEIN IF_DATA DIM_X DIRECT 0x811CCC /end CHARACTERISTIC
/begin CHARACTERISTIC MIKSCAN "Inidiziertes Begrenzungsmoment bei Knallstart" CURVE 0x810226 KlAUbSstUbWUb 99.61 rel_ub_b99p6 0.00 99.61 FUNCTION_LIST MDEX IF_DATA DIM_X DIRECT 0x810226
 /begin AXIS_DESCR STD_AXIS tmot temp_ub_q0p75_o48 6 -48.00 143.3 DEPOSIT ABSOLUT /end AXIS_DESCR
/end CHARACTERISTIC
/begin CHARACTERISTIC MILANTI "MIL ist bei ti-Abschaltung an, auch im 1.dcy" VALUE 0x8108CD KwUb 1.000 dez 0.00 1.000 FUNCTION_LIST DMDMIL IF_DATA DIM_X DIRECT 0x8108CD /end CHARACTERISTIC
/begin CHARACTERISTIC MILSOL_DAT_UC "" VAL_BLK 0x811CDC KwbUb 99.61 rel_ub_q0p3906 0.00 99.61 NUMBER 16 FUNCTION_LIST URCEIN IF_DATA DIM_X DIRECT 0x811CDC /end CHARACTERISTIC
/begin CHARACTERISTIC MIVSNG "Momentschwelle großer Ventilhub" MAP 0x819C6F KfAxUbAyUbSstxUbSstyUbWUb 99.61 rel_ub_b100 0.00 99.61 FUNCTION_LIST VS IF_DATA DIM_X DIRECT 0x819C6F /begin AXIS_DESCR STD_AXIS ntolvs nmot_ub_q40 8 0.00 10200. DEPOSIT ABSOLUT /end AXIS_DESCR /begin AXIS_DESCR STD_AXIS gangi dez 8 0.00 255.0 DEPOSIT ABSOLUT /end AXIS_DESCR /end CHARACTERISTIC
/begin CHARACTERISTIC MKLSDO "Kupplungsmoment-Schwelle für Parameterumschaltung LSD" VALUE 0x8166E4 KwSw 199.9969 rel_sw_b100 -100.0000 99.99695 FUNCTION_LIST MDFAW IF_DATA DIM_X DIRECT 0x8166E4 /end CHARACTERISTIC
/begin CHARACTERISTIC MLDKVSF "Luftmassenschwelle für Fehlerfreigabe im DKVS (Tank leer)" VALUE 0x81C79C KwUw 233.0133 m_q0p00355 0.00 233.0133 FUNCTION_LIST DKVS IF_DATA DIM_X DIRECT 0x81C79C /end CHARACTERISTIC
/begin CHARACTERISTIC MLDKVSG "Luftmassenschwelle für Fehlerfreigabe Tank leer" VALUE 0x81C79E KwUw 233.0133 m_q0p00355 0.00 233.0133 FUNCTION_LIST DKVS IF_DATA DIM_X DIRECT 0x81C79E /end CHARACTERISTIC
/begin CHARACTERISTIC MLDSLKMN "min. Luftmasse für Bedingung Kurztest-Diagnose" VALUE 0x81996D KwUb 1020. m_ub_b1020 0.00 1020. FUNCTION_LIST SWADP IF_DATA DIM_X DIRECT 0x81996D /end CHARACTERISTIC
/begin CHARACTERISTIC MLDSLKMX "max. Luftmasse für Bedingung Kurztest-Diagnose" VALUE 0x81996E KwUb 1020. m_ub_b1020 0.00 1020. FUNCTION_LIST SWADP IF_DATA DIM_X DIRECT 0x81996E /end CHARACTERISTIC
/begin CHARACTERISTIC MLDTEFPF "Schwelle Motorluftmasse für Freigabe Überprüfung Diagnose DTEV passiv möglich" VALUE 0x81E318 KwUw 80.00000 m_q0p1 0.00 80.00000 FUNCTION_LIST DTEV IF_DATA DIM_X DIRECT 0x81E318 /end CHARACTERISTIC
/begin CHARACTERISTIC MLDTEPF "Schwelle Motorluftmasse für Freigabe Diagnose DTEV passiv möglich" VALUE 0x81E31A KwUw 80.00000 m_q0p1 0.00 80.00000 FUNCTION_LIST DTEV IF_DATA DIM_X DIRECT 0x81E31A /end CHARACTERISTIC
/begin CHARACTERISTIC MLFKMSDK "Luftmassenstromschwelle für multipl. Abgleich von HFM- und DK-Massenstrom" VALUE 0x814DD2 KwUw 6553.500 m_uw_b6553p5 0.00 6553.500 FUNCTION_LIST BGMSZS IF_DATA DIM_X DIRECT 0x814DD2 /end CHARACTERISTIC
/begin CHARACTERISTIC MLHFM "Linearisierung der Heißfilmspannung" CURVE 0x814E34 FklNoOffWUw 6553.500 m_uw_b6553p5 0.00 6553.500 FUNCTION_LIST GGHFM IF_DATA DIM_X DIRECT 0x814E34
 /begin AXIS_DESCR FIX_AXIS uhfm_w spg_uw_q0p00488 512 0.00 4.995117 FIX_AXIS_PAR 0 1 512 /end AXIS_DESCR
/end CHARACTERISTIC
/begin CHARACTERISTIC MLHFMMN "minimale HFM-Luftmassen Schwelle zum Rücksetzen des Min-Fehlers" VALUE 0x81BDB2 KwUw 6553.500 m_q0p1 0.00 6553.500 FUNCTION_LIST DHFM IF_DATA DIM_X DIRECT 0x81BDB2 /end CHARACTERISTIC
/begin CHARACTERISTIC MLKHMX "max. Luftmasse für Katheizen" VALUE 0x819113 KwUb 1020. m_ub_b1020 0.00 1020. FUNCTION_LIST BBKHZ IF_DATA DIM_X DIRECT 0x819113 /end CHARACTERISTIC
/begin CHARACTERISTIC MLKORFHO "Korrektur der Luftmasse über einen höhenabhängigen Faktor" CURVE 0x81BDB4 KlAUwSstUwWUw 0.9999847 fak_uw_b1 0.00 0.9999847 FUNCTION_LIST DHFM IF_DATA DIM_X DIRECT 0x81BDB4 /begin AXIS_DESCR STD_AXIS fho_w fak_uw_b4 2 0.00 3.999939 DEPOSIT ABSOLUT /end AXIS_DESCR /end CHARACTERISTIC
/begin CHARACTERISTIC MLLASH "Luftmassenschwelle für Schwingungsprüfung hinter KAT" VALUE 0x81B8C6 KwUw 6553.500 m_q0p1 0.00 6553.500 FUNCTION_LIST DLSAHK IF_DATA DIM_X DIRECT 0x81B8C6 /end CHARACTERISTIC
/begin CHARACTERISTIC MLMAX "Maximaler Luftfluß für die Lastberechnung nach SAE J1979" VALUE 0x81B4B2 KwUw 6553.500 m_uw_b6553p5 0.00 6553.500 FUNCTION_LIST BGRML IF_DATA DIM_X DIRECT 0x81B4B2 /end CHARACTERISTIC
/begin CHARACTERISTIC MLMIN "minimale HFM-Luftmasse" VALUE 0x815234 KwSw 6553.500 m_sw_b3276p8 -3276.800 3276.700 FUNCTION_LIST GGHFM IF_DATA DIM_X DIRECT 0x815234 /end CHARACTERISTIC
/begin CHARACTERISTIC MLNKAX "Luftmassenschwelle für Einschaltbereitschaft LRSHK I-Anteil" VALUE 0x816EA6 KwUw 7281.667 m_uw_b7281 0.00 7281.667 FUNCTION_LIST LRSHK IF_DATA DIM_X DIRECT 0x816EA6 /end CHARACTERISTIC
/begin CHARACTERISTIC MLO1 "obere Luftmengenschwelle Bereich 1" VALUE 0x81C99E KwUw 6553.500 m_uw_b6553p5 0.00 6553.500 FUNCTION_LIST LRA IF_DATA DIM_X DIRECT 0x81C99E /end CHARACTERISTIC
/begin CHARACTERISTIC MLO2 "obere Luftmengenschwelle Bereich 2" VALUE 0x813FE8 KwUw 6553.500 m_uw_b6553p5 0.00 6553.500 FUNCTION_LIST LRA IF_DATA DIM_X DIRECT 0x813FE8 /end CHARACTERISTIC
/begin CHARACTERISTIC MLO3 "obere Luftmengenschwelle Bereich 3" VALUE 0x81C9A0 KwUw 6553.500 m_uw_b6553p5 0.00 6553.500 FUNCTION_LIST LRA IF_DATA DIM_X DIRECT 0x81C9A0 /end CHARACTERISTIC
/begin CHARACTERISTIC MLOFS "Kennlinienoffset HFM 5" VALUE 0x815236 KwUw 6553.500 m_uw_b6553p5 0.00 6553.500 FUNCTION_LIST GGHFM DHFM IF_DATA DIM_X DIRECT 0x815236 /end CHARACTERISTIC
/begin CHARACTERISTIC MLOSTEST "obere Luftmassenschwelle für Testbeginn Schwingungsprüfung hinter KAT" VALUE 0x81B8C8 KwUw 6553.500 m_q0p1 0.00 6553.500 FUNCTION_LIST DLSAHK T2LID IF_DATA DIM_X DIRECT 0x81B8C8 /end CHARACTERISTIC
/begin CHARACTERISTIC MLSLMX "max. Motor-Luftmasse für Sekundärlufteinblasung" VALUE 0x81815D KwUb 1020. m_ub_b1020 0.00 1020. FUNCTION_LIST SLS T2DFA T2LID IF_DATA DIM_X DIRECT 0x81815D /end CHARACTERISTIC
/begin CHARACTERISTIC MLSUS "Sollwert Luftmassen-Integral für motorisches Katheizen" CURVE 0x819114 KlAUbSstUbWUb 5.803 m_ub_b5p8 0.00 5.803 FUNCTION_LIST BBKHZ IF_DATA DIM_X DIRECT 0x819114
 /begin AXIS_DESCR STD_AXIS tmst temp_ub_q0p75_o48 12 -48.00 143.3 DEPOSIT ABSOLUT /end AXIS_DESCR
/end CHARACTERISTIC
/begin CHARACTERISTIC MLU2 "untere Luftmengenschwelle Bereich 2" VALUE 0x81C9A2 KwUw 6553.500 m_uw_b6553p5 0.00 6553.500 FUNCTION_LIST LRA IF_DATA DIM_X DIRECT 0x81C9A2 /end CHARACTERISTIC
/begin CHARACTERISTIC MLU4 "untere Luftmengenschwelle Bereich 4" VALUE 0x813FEA KwUw 6553.500 m_uw_b6553p5 0.00 6553.500 FUNCTION_LIST LRA IF_DATA DIM_X DIRECT 0x813FEA /end CHARACTERISTIC
/begin CHARACTERISTIC MLUSSTG "Luftmassenschwelle für Dynamikprüfung hinter KAT" VALUE 0x81B8CA KwUw 6553.500 m_q0p1 0.00 6553.500 FUNCTION_LIST DLSAHK IF_DATA DIM_X DIRECT 0x81B8CA /end CHARACTERISTIC
/begin CHARACTERISTIC MLUSTEST "untere Luftmassenschwelle für Testbeginn Schwingungsprüfung hinter KAT" VALUE 0x81B8CC KwUw 6553.500 m_q0p1 0.00 6553.500 FUNCTION_LIST DLSAHK T2LID IF_DATA DIM_X DIRECT 0x81B8CC /end CHARACTERISTIC
/begin CHARACTERISTIC MLWDSLAMN "min. Luftmasse für Bedingung Adaption/Zusatzdiagnose (16 Bit)" VALUE 0x81A012 KwUw 6553.500 m_uw_b6553p5 0.00 6553.500 FUNCTION_LIST DSLSLRS IF_DATA DIM_X DIRECT 0x81A012 /end CHARACTERISTIC
/begin CHARACTERISTIC MLWDSLAMX "max. Luftmasse für Bedingung Adaption/Zusatzdiagnose (16 Bit)" VALUE 0x81A014 KwUw 6553.500 m_uw_b6553p5 0.00 6553.500 FUNCTION_LIST DSLSLRS IF_DATA DIM_X DIRECT 0x81A014 /end CHARACTERISTIC
/begin CHARACTERISTIC MLWDSLKMN "min. Luftmasse für Bedingung Kurztest-Diagnose (16 Bit)" VALUE 0x81A016 KwUw 6553.500 m_uw_b6553p5 0.00 6553.500 FUNCTION_LIST DSLSLRS IF_DATA DIM_X DIRECT 0x81A016 /end CHARACTERISTIC
/begin CHARACTERISTIC MLWDSLKMX "max. Luftmasse für Bedingung Kurztest-Diagnose (16 Bit)" VALUE 0x81A018 KwUw 6553.500 m_uw_b6553p5 0.00 6553.500 FUNCTION_LIST DSLSLRS IF_DATA DIM_X DIRECT 0x81A018 /end CHARACTERISTIC
/begin CHARACTERISTIC MLWDSLMN "min. Luftmasse für Bedingung Diagnose (16 Bit)" VALUE 0x81A01A KwUw 6553.500 m_uw_b6553p5 0.00 6553.500 FUNCTION_LIST DSLSLRS IF_DATA DIM_X DIRECT 0x81A01A /end CHARACTERISTIC
/begin CHARACTERISTIC MLWDSLMX "max. Luftmasse für Bedingung Diagnose (16 Bit)" VALUE 0x81A01C KwUw 6553.500 m_uw_b6553p5 0.00 6553.500 FUNCTION_LIST DSLSLRS IF_DATA DIM_X DIRECT 0x81A01C /end CHARACTERISTIC
/begin CHARACTERISTIC MLWDSLOMN "min. Luftmasse für Bedingung frm-Offset-Messung (16 Bit)" VALUE 0x81A01E KwUw 6553.500 m_uw_b6553p5 0.00 6553.500 FUNCTION_LIST DSLSLRS IF_DATA DIM_X DIRECT 0x81A01E /end CHARACTERISTIC
/begin CHARACTERISTIC MLWDSLOMX "max. Luftmasse für Bedingung frm-Offset-Messung (16 Bit)" VALUE 0x81A020 KwUw 6553.500 m_uw_b6553p5 0.00 6553.500 FUNCTION_LIST DSLSLRS IF_DATA DIM_X DIRECT 0x81A020 /end CHARACTERISTIC
/begin CHARACTERISTIC MNZWVS "Maximale ZW-Rücknahme bei Ventilhubsteuerung" CURVE 0x81E3A8 KlAUbSstUbWSb 191.3 zw_sb_q0p75 -96.00 95.25 FUNCTION_LIST ZWVS IF_DATA DIM_X DIRECT 0x81E3A8 /begin AXIS_DESCR STD_AXIS nmot nmot_ub_q40 8 0.00 10200. DEPOSIT ABSOLUT /end AXIS_DESCR /end CHARACTERISTIC
/begin CHARACTERISTIC MRESLL "LLR: Erhöhte Momentenreserve im LL nach Drehzahleinbruch" VALUE 0x8115C0 KwUb 24.90 rel_ub_b24p9 0.00 24.90 FUNCTION_LIST LLRMR IF_DATA DIM_X DIRECT 0x8115C0 /end CHARACTERISTIC
/begin CHARACTERISTIC MRESSL "Momentenreserve bei Servolenkung" VALUE 0x8159A4 KwUw 99.99847 rel_uw_b100 0.00 99.99847 FUNCTION_LIST LLRMR IF_DATA DIM_X DIRECT 0x8159A4 /end CHARACTERISTIC
/begin CHARACTERISTIC MRFABNTE "Schwelle zur Erkennung von Dauer-Hochlastfahrt" VALUE 0x818800 KwUb 99.61 rel_ub_b99p6 0.00 99.61 FUNCTION_LIST BBTEGA IF_DATA DIM_X DIRECT 0x818800 /end CHARACTERISTIC
/begin CHARACTERISTIC MRFALLO "Obere Leerlaufschwelle des relativen Fahrerwunschmoments" VALUE 0x8166E6 KwUw 199.9969 rel_uw_b200 0.00 199.9969 FUNCTION_LIST MDFAW IF_DATA DIM_X DIRECT 0x8166E6 /end CHARACTERISTIC
/begin CHARACTERISTIC MRFALLU "Untere Leerlaufschwelle des relativen Fahrerwunschmoments" VALUE 0x8166E8 KwUw 199.9969 rel_uw_b200 0.00 199.9969 FUNCTION_LIST MDFAW IF_DATA DIM_X DIRECT 0x8166E8 /end CHARACTERISTIC
/begin CHARACTERISTIC MRFAVLN "Vollasterkennungsschwelle des relativen Fahrerwunsches" CURVE 0x81DEFC KlAUwSstUwWUw 199.9969 rel_uw_b200 0.00 199.9969 FUNCTION_LIST MDFAW IF_DATA DIM_X DIRECT 0x81DEFC
 /begin AXIS_DESCR STD_AXIS nmot_w nmot_uw_q0p25 14 0.00 16383.75 DEPOSIT ABSOLUT /end AXIS_DESCR
/end CHARACTERISTIC
/begin CHARACTERISTIC MRFAVW "Schwelle zur Umschaltung des Vorlagerungswinkels bei max. Fahrerwunsches" CURVE 0x81C828 GklWUw 199.9969 rel_uw_b200 0.00 199.9969 FUNCTION_LIST ESVW IF_DATA DIM_X DIRECT 0x81C828
 /begin AXIS_DESCR COM_AXIS nmot nmot_ub_q40 8 0.00 10200. AXIS_PTS_REF SNM08GKUB /end AXIS_DESCR
/end CHARACTERISTIC
/begin CHARACTERISTIC MRFGRLL "Schwelle relatives Moment vom Fahrgeschwindigkeitsregler für Erkennung Leerlauf" VALUE 0x814856 KwUw 199.9969 rel_uw_b200 0.00 199.9969 FUNCTION_LIST FGRMD IF_DATA DIM_X DIRECT 0x814856 /end CHARACTERISTIC
/begin CHARACTERISTIC MRFGRMAX "Maximalwert für relatives Moment aus FGR" VALUE 0x813EEE KwUw 199.9969 rel_uw_b200 0.00 199.9969 FUNCTION_LIST FGRAUS FGRMD IF_DATA DIM_X DIRECT 0x813EEE /end CHARACTERISTIC
/begin CHARACTERISTIC MRFGRMR "FGR-Korrekturkennlinie" CURVE 0x814858 KlAUwSstUwWUw 199.9969 rel_uw_b200 0.00 199.9969 FUNCTION_LIST FGRMD IF_DATA DIM_X DIRECT 0x814858
 /begin AXIS_DESCR STD_AXIS mrregl_w rel_uw_b200 8 0.00 199.9969 DEPOSIT ABSOLUT /end AXIS_DESCR
/end CHARACTERISTIC
/begin CHARACTERISTIC MRFGRSTA "Startwert für Relatives Moment bei Aktivierung FGR-Regler" VALUE 0x81487A KwUw 199.9969 rel_uw_b200 0.00 199.9969 FUNCTION_LIST FGRMD IF_DATA DIM_X DIRECT 0x81487A /end CHARACTERISTIC
/begin CHARACTERISTIC MRMRFGR "Inverse FGR-Korrekturkennlinie" CURVE 0x81487C KlAUwSstUwWUw 199.9969 rel_uw_b200 0.00 199.9969 FUNCTION_LIST FGRMD IF_DATA DIM_X DIRECT 0x81487C
 /begin AXIS_DESCR STD_AXIS mrfgri_w rel_uw_b200 8 0.00 199.9969 DEPOSIT ABSOLUT /end AXIS_DESCR
/end CHARACTERISTIC
/begin CHARACTERISTIC MSABHMN "untere Luftmassenschwelle für Plausibilitätsprüfung LSU" VALUE 0x810C60 KwUb 1020. m_ub_b1020 0.00 1020. FUNCTION_LIST DHLSU T2LID IF_DATA DIM_X DIRECT 0x810C60 /end CHARACTERISTIC
/begin CHARACTERISTIC MSALLMN "Minimale Leerlaufluftmassenadaption für E-Gas" VALUE 0x810F42 KwUb 25.50 m_ub_q0p1 0.00 25.50 FUNCTION_LIST BGMSZS IF_DATA DIM_X DIRECT 0x810F42 /end CHARACTERISTIC
/begin CHARACTERISTIC MSALLMX "Maximale Leerlaufluftmassenadaption für E-Gas" VALUE 0x810F43 KwUb 25.50 m_ub_q0p1 0.00 25.50 FUNCTION_LIST BGMSZS IF_DATA DIM_X DIRECT 0x810F43 /end CHARACTERISTIC
/begin CHARACTERISTIC MSAPLMN "untere Schwelle für Plausibilitätsprüfung LSU" VALUE 0x8183FE KwUb 1020. m_ub_b1020 0.00 1020. FUNCTION_LIST DLSU T2LID IF_DATA DIM_X DIRECT 0x8183FE /end CHARACTERISTIC
/begin CHARACTERISTIC MSDKLMMN "minimaler Massenstrom über Drosselklappe in TE" VALUE 0x817672 KwUw 6553.500 m_uw_b6553p5 0.00 6553.500 FUNCTION_LIST TEB IF_DATA DIM_X DIRECT 0x817672 /end CHARACTERISTIC
/begin CHARACTERISTIC MSLBAS "Ini.- Sekundärluftmasse" VALUE 0x818103 KwUb 102.0 m_q0p4 0.00 102.0 FUNCTION_LIST DSLSLRS IF_DATA DIM_X DIRECT 0x818103 /end CHARACTERISTIC
/begin CHARACTERISTIC MSLG "Massenstrom Leckluft gesamt" VALUE 0x810F44 KwUb 25.50 m_ub_q0p1 0.00 25.50 FUNCTION_LIST BGMSZS IF_DATA DIM_X DIRECT 0x810F44 /end CHARACTERISTIC
/begin CHARACTERISTIC MSLUB "Sekundärluftmasse abhängig von der Batteriespannung" CURVE 0x81815E KlAUbSstUbWUb 102.0 m_ub_q0p4 0.00 102.0 FUNCTION_LIST SLS IF_DATA DIM_X DIRECT 0x81815E /begin AXIS_DESCR STD_AXIS ubf spg_ubatt 8 0.00 19.38 DEPOSIT ABSOLUT /end AXIS_DESCR /end CHARACTERISTIC
/begin CHARACTERISTIC MSLVMX "Diagnoseschwelle für Ventildichtheitsprüfung" VALUE 0x81A022 KwUw 102.3984 m_q0p0015625 0.00 102.3984 FUNCTION_LIST DSLSLRS IF_DATA DIM_X DIRECT 0x81A022 /end CHARACTERISTIC
/begin CHARACTERISTIC MSLVMXX "Diagnoseschwelle für absoluten Fehler Ventildichtheit" VALUE 0x81A024 KwUw 102.3984 m_q0p0015625 0.00 102.3984 FUNCTION_LIST DSLSLRS IF_DATA DIM_X DIRECT 0x81A024 /end CHARACTERISTIC
/begin CHARACTERISTIC MSNTATE "Kennlinie normierter Massenstrom durch TEV" CURVE 0x817602 KlAUwSstUwWUw 25.59961 m_uw_b25p6 0.00 25.59961 FUNCTION_LIST BGTEV IF_DATA DIM_X DIRECT 0x817602
 /begin AXIS_DESCR STD_AXIS msntate_kge rel_uw_b100 10 0.00 99.99847 DEPOSIT ABSOLUT /end AXIS_DESCR
/end CHARACTERISTIC
/begin CHARACTERISTIC MSRC_D_UC "" VAL_BLK 0x811CEC KwbUb 255.0 dez 0.00 255.0 NUMBER 16 FUNCTION_LIST URCEIN IF_DATA DIM_X DIRECT 0x811CEC /end CHARACTERISTIC
/begin CHARACTERISTIC MSRC_T_UC "Fehlerzeit für MSR-Eingriff-Überwachung des Befehlstests" VALUE 0x811E4F KwUb 10200.0 t40ms_ub_b10200 0.00 10200.0 FUNCTION_LIST URCMSRC IF_DATA DIM_X DIRECT 0x811E4F /end CHARACTERISTIC
/begin CHARACTERISTIC MSRC_T_UM "Fehlerzeit für MSR-Eingriff-Überwachung der Funktionsüberwachung" VALUE 0x817D77 KwUb 10200.0 t40ms_ub_b10200 0.00 10200.0 FUNCTION_LIST UFMSRC IF_DATA DIM_X DIRECT 0x817D77 /end CHARACTERISTIC
/begin CHARACTERISTIC MVER_D_UC "" VAL_BLK 0x811CFC KwbUb 255.0 dez 0.00 255.0 NUMBER 16 FUNCTION_LIST URCEIN IF_DATA DIM_X DIRECT 0x811CFC /end CHARACTERISTIC
/begin CHARACTERISTIC MVER_T_UC "Fehlerzeit beim Momentenvergleich im Befehlstest" VALUE 0x811FD1 KwUb 10200.0 t40ms_ub_b10200 0.00 10200.0 FUNCTION_LIST URCMVER IF_DATA DIM_X DIRECT 0x811FD1 /end CHARACTERISTIC
/begin CHARACTERISTIC MVER_T_UM "Fehlerzeit beim Momentenvergleich in der Funktionsüberwachung" VALUE 0x817EF9 KwUb 10200.0 t40ms_ub_b10200 0.00 10200.0 FUNCTION_LIST UFMVER IF_DATA DIM_X DIRECT 0x817EF9 /end CHARACTERISTIC
/begin CHARACTERISTIC MXNLFEHL "Maximale Anzahl von Fehlern der Synchronisationsüberwachung bei hoher Dynamik" VALUE 0x810C4D KwUb 8.000 dez 0.00 8.000 FUNCTION_LIST NLDG IF_DATA DIM_X DIRECT 0x810C4D /end CHARACTERISTIC
/begin CHARACTERISTIC MXNLN "Mindestanzahl von Zahnsignalen zur Heilung des NLDG" VALUE 0x8181B4 KwUb 255.0 dez 0.00 255.0 FUNCTION_LIST DDG IF_DATA DIM_X DIRECT 0x8181B4 /end CHARACTERISTIC
/begin CHARACTERISTIC MZFFIL_UC "Filter-Zeitkonstante für verzögertes Moment im Befehlstest" VALUE 0x811FCF KwUb 10159.4 zk40ms_ub_b10200 40.6299 10200.0 FUNCTION_LIST URCMZF IF_DATA DIM_X DIRECT 0x811FCF /end CHARACTERISTIC
/begin CHARACTERISTIC MZFFIL_UM "Filter-Zeitkonstante für verzögertes Moment in der Funktionsüberwachung" VALUE 0x817EF7 KwUb 10159.4 zk40ms_ub_b10200 40.6299 10200.0 FUNCTION_LIST UFMZF IF_DATA DIM_X DIRECT 0x817EF7 /end CHARACTERISTIC
/begin CHARACTERISTIC MZFPTR_DAT_UC "" VAL_BLK 0x811D0C KwbUb 255.0 dez 0.00 255.0 NUMBER 16 FUNCTION_LIST URCEIN IF_DATA DIM_X DIRECT 0x811D0C /end CHARACTERISTIC
/begin CHARACTERISTIC MZFREG_DAT_UC "" MAP 0x811D1C KfWUb 255.0 dez 0.00 255.0 FUNCTION_LIST URCEIN IF_DATA DIM_X DIRECT 0x811D1C /begin AXIS_DESCR FIX_AXIS x_uc dez 8 0.00 7.000 FIX_AXIS_PAR 0 0 8 /end AXIS_DESCR /begin AXIS_DESCR FIX_AXIS y_uc dez 16 0.00 15.00 FIX_AXIS_PAR 0 0 16 /end AXIS_DESCR /end CHARACTERISTIC
/begin CHARACTERISTIC MZFTV_UC "Verzugszeit für zulässiges Moment mz_um im Befehlstest" VALUE 0x811FD0 KwUb 320.000 t40ms_ub_b10200 0.00 320.000 FUNCTION_LIST URCMZF URCREF IF_DATA DIM_X DIRECT 0x811FD0 /end CHARACTERISTIC
/begin CHARACTERISTIC MZFTV_UM "Verzugszeit für zulässiges Moment mz_um in der Funktionsüberwachg" VALUE 0x817EF8 KwUb 280.000 t40ms_ub_b10200 40.0000 320.000 FUNCTION_LIST UFMZF IF_DATA DIM_X DIRECT 0x817EF8 /end CHARACTERISTIC
/begin CHARACTERISTIC MZF_DAT_UC "" VAL_BLK 0x811D9C KwbUb 99.61 rel_ub_q0p3906 0.00 99.61 NUMBER 16 FUNCTION_LIST URCEIN IF_DATA DIM_X DIRECT 0x811D9C /end CHARACTERISTIC
/begin CHARACTERISTIC MZL_DAT_UC "" VAL_BLK 0x811DAC KwbUb 0.3891 rel_ub_q0p00153 0.00 0.3891 NUMBER 16 FUNCTION_LIST URCEIN IF_DATA DIM_X DIRECT 0x811DAC /end CHARACTERISTIC
/begin CHARACTERISTIC N0 "Umrechnungskonstante für Einrechnung Gemischkorrektur rkat" VALUE 0x811414 KwUb 10200. nmot_ub_q40 0.00 10200. FUNCTION_LIST LRA IF_DATA DIM_X DIRECT 0x811414 /end CHARACTERISTIC
/begin CHARACTERISTIC N1DVSO "Diagnoseschwelle: Obere Drehzahl bei Ventilhub klein" VALUE 0x8122F9 KwUb 10200. nmot_ub_q40 0.00 10200. FUNCTION_LIST DVS IF_DATA DIM_X DIRECT 0x8122F9 /end CHARACTERISTIC
/begin CHARACTERISTIC N1DVSU "Diagnoseschwelle: Untere Drehzahl bei Ventilhub klein" VALUE 0x8122FA KwUb 10200. nmot_ub_q40 0.00 10200. FUNCTION_LIST DVS IF_DATA DIM_X DIRECT 0x8122FA /end CHARACTERISTIC
/begin CHARACTERISTIC N1VSTOL "Drehzahlschwelle im Toel-Bereich 2" VALUE 0x819CC1 KwUb 10200. nmot_ub_q40 0.00 10200. FUNCTION_LIST VS IF_DATA DIM_X DIRECT 0x819CC1 /end CHARACTERISTIC
/begin CHARACTERISTIC N1VSTOL3 "Drehzahlschwelle im Toel-Bereich 3" VALUE 0x819CC2 KwUb 10200. nmot_ub_q40 0.00 10200. FUNCTION_LIST VS IF_DATA DIM_X DIRECT 0x819CC2 /end CHARACTERISTIC
/begin CHARACTERISTIC N2DVSO "Diagnoseschwelle: Obere Drehzahl bei Ventilhub groß" VALUE 0x8122FB KwUb 10200. nmot_ub_q40 0.00 10200. FUNCTION_LIST DVS IF_DATA DIM_X DIRECT 0x8122FB /end CHARACTERISTIC
/begin CHARACTERISTIC N2DVSU "Diagnoseschwelle: Untere Drehzahl bei Ventilhub groß" VALUE 0x8122FC KwUb 10200. nmot_ub_q40 0.00 10200. FUNCTION_LIST DVS IF_DATA DIM_X DIRECT 0x8122FC /end CHARACTERISTIC
/begin CHARACTERISTIC N2VSTOL "Hysteresis Drehzahlschwelle im Toel-Bereich 2" VALUE 0x819CC3 KwUb 10200. nmot_ub_q40 0.00 10200. FUNCTION_LIST VS IF_DATA DIM_X DIRECT 0x819CC3 /end CHARACTERISTIC
/begin CHARACTERISTIC N2VSTOL3 "Hysteresis Drehzahlschwelle im Toel-Bereich 3" VALUE 0x819CC4 KwUb 10200. nmot_ub_q40 0.00 10200. FUNCTION_LIST VS IF_DATA DIM_X DIRECT 0x819CC4 /end CHARACTERISTIC
/begin CHARACTERISTIC NACHANZA "Anzahl Zündungen im Nachlauf" VALUE 0x8123D1 KwUb 255.0 dez 0.00 255.0 FUNCTION_LIST ZUE IF_DATA DIM_X DIRECT 0x8123D1 /end CHARACTERISTIC
/begin CHARACTERISTIC NANFSK "Drehzahlschwelle: Anfahren mit schleifender Kupplung" VALUE 0x819CC5 KwUb 10200. nmot_ub_q40 0.00 10200. FUNCTION_LIST VS IF_DATA DIM_X DIRECT 0x819CC5 /end CHARACTERISTIC
/begin CHARACTERISTIC NARAO "obere Drehzahlschwelle für AR aktiv" VALUE 0x811695 KwUb 10200. nmot_ub_q40 0.00 10200. FUNCTION_LIST ARMD IF_DATA DIM_X DIRECT 0x811695 /end CHARACTERISTIC
/begin CHARACTERISTIC NARASTG "Drehzahlschwelle in hoeherem Gang fuer AR aktiv" CURVE 0x811696 FklWUb 10200. nmot_ub_q40 0.00 10200. FUNCTION_LIST ARMD IF_DATA DIM_X DIRECT 0x811696 /begin AXIS_DESCR FIX_AXIS gangi dez 6 1.000 6.000 FIX_AXIS_PAR 1 0 6 /end AXIS_DESCR /end CHARACTERISTIC
/begin CHARACTERISTIC NARASTGU "Gangabhängige Drehzahlschwelle für AR aktiv" CURVE 0x81169C KlAUbSstUbWUb 10200. nmot_ub_q40 0.00 10200. FUNCTION_LIST ARMD IF_DATA DIM_X DIRECT 0x81169C /begin AXIS_DESCR STD_AXIS gangi dez 6 0.00 255.0 DEPOSIT ABSOLUT /end AXIS_DESCR /end CHARACTERISTIC
/begin CHARACTERISTIC NARLL "Drehzahlschwelle für AR im Leerlauf" VALUE 0x8116A9 KwUb 10200. nmot_ub_q40 0.00 10200. FUNCTION_LIST ARMD IF_DATA DIM_X DIRECT 0x8116A9 /end CHARACTERISTIC
/begin CHARACTERISTIC NASNOT "Drehzahlschwelle für ASR-Verbot wegen Abwürgeschutz" VALUE 0x811B4E KwUb 2560. nmot_ub_q40 0.00 2560. FUNCTION_LIST MDKOG MDKOL IF_DATA DIM_X DIRECT 0x811B4E /end CHARACTERISTIC
/begin CHARACTERISTIC NC_T_UM "Fehlertoleranzzeit für Motordrehzahlüberwachung für Funktionsüberwachung" VALUE 0x817D09 KwUb 10200.0 t40ms_ub_b10200 0.00 10200.0 FUNCTION_LIST UFNC IF_DATA DIM_X DIRECT 0x817D09 /end CHARACTERISTIC
/begin CHARACTERISTIC NDECJ "Drehzahl-Schwelle für CJ400-Endstufendiagnose" VALUE 0x810F17 KwUb 10200. nmot_ub_q40 0.00 10200. FUNCTION_LIST DECJ IF_DATA DIM_X DIRECT 0x810F17 /end CHARACTERISTIC
/begin CHARACTERISTIC NDFILOG "Schwelle für Filterausgang ndfil" CURVE 0x81607A FklWUw 16383.75 nmot_uw_q0p25 0.00 16383.75 FUNCTION_LIST ARMD IF_DATA DIM_X DIRECT 0x81607A /begin AXIS_DESCR FIX_AXIS gangi dez 6 1.000 6.000 FIX_AXIS_PAR 1 0 6 /end AXIS_DESCR /end CHARACTERISTIC
/begin CHARACTERISTIC NDIFFOG "Schwelle Drehzahldifferenz zum Auslösen Ini der AR beim Verzögern" CURVE 0x816062 FklWSw 16383.75 nmot_sw_q0p25 -8192.000 8191.750 FUNCTION_LIST ARMD IF_DATA DIM_X DIRECT 0x816062 /begin AXIS_DESCR FIX_AXIS gangi dez 6 1.000 6.000 FIX_AXIS_PAR 1 0 6 /end AXIS_DESCR /end CHARACTERISTIC
/begin CHARACTERISTIC NDIF_UM "erlaubte Differenz zwischen nmot und nz_um in der Funktionsüberwachung" VALUE 0x817D0A KwUb 10200. nmot_ub_q40 0.00 10200. FUNCTION_LIST UFNC IF_DATA DIM_X DIRECT 0x817D0A /end CHARACTERISTIC
/begin CHARACTERISTIC NDKPPU "Minimaldrehzahl für Plausibilisierung DK-Poti 2 nach unten im Normalbetrieb" VALUE 0x810DF5 KwUb 10000. nmot_ub_q40 200.0 10200. FUNCTION_LIST GGDVE IF_DATA DIM_X DIRECT 0x810DF5 /end CHARACTERISTIC
/begin CHARACTERISTIC NDKS "Drehzahlschwelle für Dia KS" VALUE 0x81916A KwUb 10200. nmot_ub_q40 0.00 10200. FUNCTION_LIST DKRS IF_DATA DIM_X DIRECT 0x81916A /end CHARACTERISTIC
/begin CHARACTERISTIC NDKTSO "Obere Drehzahlgrenze für DKAT-aktiv" VALUE 0x8183CB KwUb 10200. nmot_ub_q40 0.00 10200. FUNCTION_LIST DKATLRS IF_DATA DIM_X DIRECT 0x8183CB /end CHARACTERISTIC
/begin CHARACTERISTIC NDKTSOT "Obere Drehzahlgrenze für Funktionsanforderung" VALUE 0x8183CC KwUb 10200. nmot_ub_q40 0.00 10200. FUNCTION_LIST DKATLRS T2DFA T2LID IF_DATA DIM_X DIRECT 0x8183CC /end CHARACTERISTIC
/begin CHARACTERISTIC NDKTSU "untere Drehzahlgrenze für DKAT-aktiv" VALUE 0x8183CD KwUb 10200. nmot_ub_q40 0.00 10200. FUNCTION_LIST DKATLRS IF_DATA DIM_X DIRECT 0x8183CD /end CHARACTERISTIC
/begin CHARACTERISTIC NDKTSUT "Untere Drehzahlgrenze für Funktionsanforderung" VALUE 0x8183CE KwUb 10200. nmot_ub_q40 0.00 10200. FUNCTION_LIST DKATLRS T2DFA T2LID IF_DATA DIM_X DIRECT 0x8183CE /end CHARACTERISTIC
/begin CHARACTERISTIC NDLDRAPU "Drehzahlschwelle für LDRA Fehlerpfad und Heilung LDO Fehlerpfad" CURVE 0x8193EB KlAUbSstUbWUb 10200. nmot_ub_q40 0.00 10200. FUNCTION_LIST DLDR IF_DATA DIM_X DIRECT 0x8193EB /begin AXIS_DESCR STD_AXIS pu p_ub_q5 2 0.00 1275. DEPOSIT ABSOLUT /end AXIS_DESCR /end CHARACTERISTIC
/begin CHARACTERISTIC NDNWMN "Minimaldrehzahl für Diagnose Nockenwellensteuerung" VALUE 0x81862D KwUb 10200. nmot_ub_q40 0.00 10200. FUNCTION_LIST DNWS IF_DATA DIM_X DIRECT 0x81862D /end CHARACTERISTIC
/begin CHARACTERISTIC NDNWMX "Maximaldrehzahl für Diagnose Nockenwellensteuerung" VALUE 0x81862E KwUb 10200. nmot_ub_q40 0.00 10200. FUNCTION_LIST DNWS IF_DATA DIM_X DIRECT 0x81862E /end CHARACTERISTIC
/begin CHARACTERISTIC NDSVLO "obere Drehzahlschwelle für Signalvergleich Ladedruck mit Umgebungsdruck" VALUE 0x8184DE KwUb 10200. nmot_ub_q40 0.00 10200. FUNCTION_LIST GGDSAS IF_DATA DIM_X DIRECT 0x8184DE /end CHARACTERISTIC
/begin CHARACTERISTIC NDSVLU "Drehzahlschwelle für Signalvergleich Ladedruck mit Umgebungsdruck" VALUE 0x8184DF KwUb 10200. nmot_ub_q40 0.00 10200. FUNCTION_LIST GGDSAS IF_DATA DIM_X DIRECT 0x8184DF /end CHARACTERISTIC
/begin CHARACTERISTIC NDTHMMX "Max. Motordrehzahl für Freigabe Thermostat-Diagnose (Überdrücken)" VALUE 0x819037 KwUb 10200. nmot_ub_q40 0.00 10200. FUNCTION_LIST GGTFM IF_DATA DIM_X DIRECT 0x819037 /end CHARACTERISTIC
/begin CHARACTERISTIC NDV "Fehlererkennung Tachosignal / Drehzahlschwelle minimal" VALUE 0x818488 KwUb 10200. nmot_ub_q40 0.00 10200. FUNCTION_LIST DVFZ IF_DATA DIM_X DIRECT 0x818488 /end CHARACTERISTIC
/begin CHARACTERISTIC NDVO "Fehlererkennung Fz-Geschwindigkeitssignal, obere Drehzahlgrenze" VALUE 0x818489 KwUb 10200. nmot_ub_q40 0.00 10200. FUNCTION_LIST DVFZ IF_DATA DIM_X DIRECT 0x818489 /end CHARACTERISTIC
/begin CHARACTERISTIC NFGRMAX "Max. zul. Drehzahl bei FGR-Betrieb" VALUE 0x810F2C KwUb 10200. nmot_ub_q40 0.00 10200. FUNCTION_LIST BBFGR IF_DATA DIM_X DIRECT 0x810F2C /end CHARACTERISTIC
/begin CHARACTERISTIC NFGRMIN "Min. zul. Drehzahl bei FGR-Betrieb" VALUE 0x810F2D KwUb 10200. nmot_ub_q40 0.00 10200. FUNCTION_LIST BBFGR IF_DATA DIM_X DIRECT 0x810F2D /end CHARACTERISTIC
/begin CHARACTERISTIC NFHZ "Solldrehzahl bei eingeschalteter Frontscheibenheizung" VALUE 0x8115C4 KwUb 2550. nmot_ub_q10 0.00 2550. FUNCTION_LIST LLRNS IF_DATA DIM_X DIRECT 0x8115C4 /end CHARACTERISTIC
/begin CHARACTERISTIC NFHZFS "Solldrehzahl bei eingeschalteter Frontscheibenheizung und B_fs=1" VALUE 0x8115C5 KwUb 2550. nmot_ub_q10 0.00 2550. FUNCTION_LIST LLRNS IF_DATA DIM_X DIRECT 0x8115C5 /end CHARACTERISTIC
/begin CHARACTERISTIC NFLAGS_D_UC "" VAL_BLK 0x811DBC KwbUb 255.0 dez 0.00 255.0 NUMBER 16 FUNCTION_LIST URCEIN IF_DATA DIM_X DIRECT 0x811DBC /end CHARACTERISTIC
/begin CHARACTERISTIC NFLUV "Drehzahlschwelle der Modifikation der Laufunruhe-Berechnung" VALUE 0x810808 KwUb 10200. nmot_ub_q40 0.00 10200. FUNCTION_LIST DMDLU IF_DATA DIM_X DIRECT 0x810808 /end CHARACTERISTIC
/begin CHARACTERISTIC NFSKHM "LL-Solldrehzahl mit Fahrstufe und Katheizen" CURVE 0x81912D GklWUb 2550. nmot_ub_q10 0.00 2550. FUNCTION_LIST BBKHZ IF_DATA DIM_X DIRECT 0x81912D
 /begin AXIS_DESCR COM_AXIS tmot temp_ub_q0p75_o48 4 -48.00 143.3 AXIS_PTS_REF STM04__UB /end AXIS_DESCR
/end CHARACTERISTIC
/begin CHARACTERISTIC NFSM "Solldrehzahl Fahrstufenschalter ein" CURVE 0x819704 GklWUb 2550. nmot_ub_q10 0.00 2550. FUNCTION_LIST LLRNS IF_DATA DIM_X DIRECT 0x819704
 /begin AXIS_DESCR COM_AXIS tmot temp_ub_q0p75_o48 6 -48.00 143.3 AXIS_PTS_REF STM06LLUB /end AXIS_DESCR
/end CHARACTERISTIC
/begin CHARACTERISTIC NFSM2 "Solldrehzahl Fahstufenschalter ein Variante 2" CURVE 0x81970A GklWUb 2550. nmot_ub_q10 0.00 2550. FUNCTION_LIST LLRNS IF_DATA DIM_X DIRECT 0x81970A
 /begin AXIS_DESCR COM_AXIS tmot temp_ub_q0p75_o48 6 -48.00 143.3 AXIS_PTS_REF STM06LLUB /end AXIS_DESCR
/end CHARACTERISTIC
/begin CHARACTERISTIC NFSNLDG "Soll-Drehzahlerhöhung bei Drehzahlgeber-Notlauf" VALUE 0x819710 KwUb 2550. nmot_ub_q10 0.00 2550. FUNCTION_LIST LLRNS IF_DATA DIM_X DIRECT 0x819710 /end CHARACTERISTIC
/begin CHARACTERISTIC NGALU "Misfire Detection : Schwelle Drehzahländerung für Ausblendung" CURVE 0x813868 GklWUw 12799.77 nmotg_sw_q0p39 0.00 12799.77 FUNCTION_LIST DMDSTP IF_DATA DIM_X DIRECT 0x813868
 /begin AXIS_DESCR COM_AXIS nmot nmot_ub_q40 8 0.00 10200. AXIS_PTS_REF SNM08DMUB /end AXIS_DESCR
/end CHARACTERISTIC
/begin CHARACTERISTIC NGALUST "Misfire Detection : Schwelle Drehzahländerung für Ausblendung nach Start" VALUE 0x813878 KwUw 12799.77 nmotg_sw_q0p39 0.00 12799.77 FUNCTION_LIST DMDSTP IF_DATA DIM_X DIRECT 0x813878 /end CHARACTERISTIC
/begin CHARACTERISTIC NGANGMIN "Schwelle fuer Gangerkennung, Mindestwert PLausibilitaetstest" VALUE 0x813D66 KwUw 16383.75 nmot_uw_q0p25 0.00 16383.75 FUNCTION_LIST BBGANG IF_DATA DIM_X DIRECT 0x813D66 /end CHARACTERISTIC
/begin CHARACTERISTIC NGDNSA "Drehzahlgradient beim Absteuern der Schubabschalthysterese" VALUE 0x815996 KwSw 10239.84 nmotg_sw_q0p15625 -5120.000 5119.844 FUNCTION_LIST BBSAWE IF_DATA DIM_X DIRECT 0x815996 /end CHARACTERISTIC
/begin CHARACTERISTIC NGFSAWE "Schwelle Drehzahlgradient für Sperrung Filter SA/WE" VALUE 0x8166EA KwSw 25599.94 nmotg_sw_q0p39 -12800.16 12799.77 FUNCTION_LIST MDFAW IF_DATA DIM_X DIRECT 0x8166EA /end CHARACTERISTIC
/begin CHARACTERISTIC NGKRWN "Schwellwert Drehzahlgradient für Dynamikerkennung" CURVE 0x81D4CC GklWSw 12773.60 nmotg_sw_q0p39 0.00 12773.60 FUNCTION_LIST KRDY IF_DATA DIM_X DIRECT 0x81D4CC
 /begin AXIS_DESCR COM_AXIS nmot nmot_ub_q40 16 0.00 10200. AXIS_PTS_REF SNM16KRUB /end AXIS_DESCR
/end CHARACTERISTIC
/begin CHARACTERISTIC NGNSNF "Drehzahlgradientenschwelle zur Auslösung der Drehzahlnachführung" VALUE 0x8115C6 KwUb 25500. nmotg_ub_q100 0.00 25500. FUNCTION_LIST LLRNS IF_DATA DIM_X DIRECT 0x8115C6 /end CHARACTERISTIC
/begin CHARACTERISTIC NKORTOL "Kennlinie zur Drehzahlkorrektur in Abhängigkeit von toel" CURVE 0x818751 KlAUbSstUbWUb 10200. nmot_ub_q40 0.00 10200. FUNCTION_LIST NWS IF_DATA DIM_X DIRECT 0x818751
 /begin AXIS_DESCR STD_AXIS tol temp_ub_q0p75_o48 6 -48.00 143.3 DEPOSIT ABSOLUT /end AXIS_DESCR
/end CHARACTERISTIC
/begin CHARACTERISTIC NKRUM "Drehzahlschwelle Umschalten Delta-Lastsignal für Lastdynamik" VALUE 0x8191E9 KwUb 10200. nmot_ub_q40 0.00 10200. FUNCTION_LIST KRDY IF_DATA DIM_X DIRECT 0x8191E9 /end CHARACTERISTIC
/begin CHARACTERISTIC NKTDX "Maximale Drehzahlgrenze DKAT für Berechnung" VALUE 0x8183CF KwUb 10200. nmot_ub_q40 0.00 10200. FUNCTION_LIST DKATLRS T2DFA T2LID IF_DATA DIM_X DIRECT 0x8183CF /end CHARACTERISTIC
/begin CHARACTERISTIC NKTOLVS "Drehzahlkorrektur für Schaltschwellen in Abhängigkeit von Tol" CURVE 0x819CC6 KlAUbSstUbWUb 10200. nmot_ub_q40 0.00 10200. FUNCTION_LIST VS IF_DATA DIM_X DIRECT 0x819CC6
 /begin AXIS_DESCR STD_AXIS tol temp_ub_q0p75_o48 8 -48.00 143.3 DEPOSIT ABSOLUT /end AXIS_DESCR
/end CHARACTERISTIC
/begin CHARACTERISTIC NKTOLVSN "Drehzahlkorrektur Freigabebit (poel-Ersatz)" CURVE 0x819CD7 KlAUbSstUbWUb 10200. nmot_ub_q40 0.00 10200. FUNCTION_LIST VS IF_DATA DIM_X DIRECT 0x819CD7
 /begin AXIS_DESCR STD_AXIS tol temp_ub_q0p75_o48 8 -48.00 143.3 DEPOSIT ABSOLUT /end AXIS_DESCR
/end CHARACTERISTIC
/begin CHARACTERISTIC NLDIAPU "Drehzahlschwelle für Adaption I-Begrenzung" CURVE 0x819616 KlAUbSstUbWUb 10200. nmot_ub_q40 0.00 10200. FUNCTION_LIST LDRPID IF_DATA DIM_X DIRECT 0x819616 /begin AXIS_DESCR STD_AXIS pu p_ub_q5 2 0.00 1275. DEPOSIT ABSOLUT /end AXIS_DESCR /end CHARACTERISTIC
/begin CHARACTERISTIC NLLKHM "Leerlaufsolldrehzahl bei Kat.-Heizung" CURVE 0x819131 GklWUb 2550. nmot_ub_q10 0.00 2550. FUNCTION_LIST BBKHZ IF_DATA DIM_X DIRECT 0x819131
 /begin AXIS_DESCR COM_AXIS tmot temp_ub_q0p75_o48 4 -48.00 143.3 AXIS_PTS_REF STM04__UB /end AXIS_DESCR
/end CHARACTERISTIC
/begin CHARACTERISTIC NLLKT "Leerlaufsolldrehzahl bei Kurztest Sekundärluftdiagnose" VALUE 0x819135 KwUb 2550. nmot_ub_q10 0.00 2550. FUNCTION_LIST BBKHZ IF_DATA DIM_X DIRECT 0x819135 /end CHARACTERISTIC
/begin CHARACTERISTIC NLLM "Solldrehzahl" CURVE 0x819711 GklWUb 2550. nmot_ub_q10 0.00 2550. FUNCTION_LIST LLRNS DMDMIL IF_DATA DIM_X DIRECT 0x819711
 /begin AXIS_DESCR COM_AXIS tmot temp_ub_q0p75_o48 6 -48.00 143.3 AXIS_PTS_REF STM06LLUB /end AXIS_DESCR
/end CHARACTERISTIC
/begin CHARACTERISTIC NLLM2 "Solldrehzahl Bed. 2 für MT" CURVE 0x819717 GklWUb 2550. nmot_ub_q10 0.00 2550. FUNCTION_LIST LLRNS IF_DATA DIM_X DIRECT 0x819717
 /begin AXIS_DESCR COM_AXIS tmot temp_ub_q0p75_o48 6 -48.00 143.3 AXIS_PTS_REF STM06LLUB /end AXIS_DESCR
/end CHARACTERISTIC
/begin CHARACTERISTIC NLLTOL "Solldrehzahl abh. von Öltemperatur" CURVE 0x81971D KlAUbSstUbWUb 2550. nmot_ub_q10 0.00 2550. FUNCTION_LIST LLRNS IF_DATA DIM_X DIRECT 0x81971D
 /begin AXIS_DESCR STD_AXIS tol temp_ub_q0p75_o48 3 -48.00 143.3 DEPOSIT ABSOLUT /end AXIS_DESCR
/end CHARACTERISTIC
/begin CHARACTERISTIC NLPST1T "Wartezeit 1 im NLP-Lernen" VALUE 0x810D3C KwUb 2.540 t10msxs_ub_b2p55 0.01000 2.550 FUNCTION_LIST BGDVE IF_DATA DIM_X DIRECT 0x810D3C /end CHARACTERISTIC
/begin CHARACTERISTIC NLPST2T "Wartezeit 2 im NLP-Lernen" VALUE 0x810D3D KwUb 2.540 t10msxs_ub_b2p55 0.01000 2.550 FUNCTION_LIST BGDVE IF_DATA DIM_X DIRECT 0x810D3D /end CHARACTERISTIC
/begin CHARACTERISTIC NLRHO "obere Drehzahlgrenze für Regelung hinter Kat" VALUE 0x812177 KwUb 10200. nmot_ub_q40 0.00 10200. FUNCTION_LIST LRSHK IF_DATA DIM_X DIRECT 0x812177 /end CHARACTERISTIC
/begin CHARACTERISTIC NLRHU "untere Drehzahlgrenze für Regelung hinter Kat" VALUE 0x812178 KwUb 10200. nmot_ub_q40 0.00 10200. FUNCTION_LIST LRSHK IF_DATA DIM_X DIRECT 0x812178 /end CHARACTERISTIC
/begin CHARACTERISTIC NLRKA "Drehzahlschwelle für Unterdrücken gesteuertes Kat-Ausräumen" VALUE 0x811FEB KwUb 10200. nmot_ub_q40 0.00 10200. FUNCTION_LIST LRSKA IF_DATA DIM_X DIRECT 0x811FEB /end CHARACTERISTIC
/begin CHARACTERISTIC NLRSHB "Drehzahlschwelle, Abschalten LR bei Schub, in Verbindung mit LL und TLLRSHB" VALUE 0x812112 KwUb 10200. nmot_ub_q40 0.00 10200. FUNCTION_LIST LRSEB IF_DATA DIM_X DIRECT 0x812112 /end CHARACTERISTIC
/begin CHARACTERISTIC NMAX "Drehzahlbegrenzung" VALUE 0x816700 KwUw 16383.75 nmot_uw_q0p25 0.00 16383.75 FUNCTION_LIST NMAXMD IF_DATA DIM_X DIRECT 0x816700 /end CHARACTERISTIC
/begin CHARACTERISTIC NMAXANM "Drehzahlbegrenzung bei Anfahrvorgang Handschalter" VALUE 0x816702 KwUw 16383.75 nmot_uw_q0p25 0.00 16383.75 FUNCTION_LIST NMAXMD IF_DATA DIM_X DIRECT 0x816702 /end CHARACTERISTIC
/begin CHARACTERISTIC NMAXDV "Drehzahlbegrenzung bei Fehlererkennung Geschwindigkeitssignal" VALUE 0x816704 KwUw 10200.00 nmot_uw_q0p25 0.00 10200.00 FUNCTION_LIST NMAXMD IF_DATA DIM_X DIRECT 0x816704 /end CHARACTERISTIC
/begin CHARACTERISTIC NMAXDVG "Drehzahlgrenze für Automatik-Getriebe bei Fehler Geschwindigkeitssignal" CURVE 0x81DF38 GklWUw 16383.75 nmot_uw_q0p25 0.00 16383.75 FUNCTION_LIST NMAXMD IF_DATA DIM_X DIRECT 0x81DF38 /begin AXIS_DESCR COM_AXIS gangi dez 8 0.00 255.0 AXIS_PTS_REF SGA08MDUB /end AXIS_DESCR /end CHARACTERISTIC
/begin CHARACTERISTIC NMAXDZ "Drehzahlgrenze bei doppelter Zündausgabe" VALUE 0x816706 KwUw 16383.75 nmot_uw_q0p25 0.00 16383.75 FUNCTION_LIST NMAXMD IF_DATA DIM_X DIRECT 0x816706 /end CHARACTERISTIC
/begin CHARACTERISTIC NMAXKNS "Maximaldrehzahl bei Knallstart Automat" VALUE 0x816708 KwUw 16383.75 nmot_uw_q0p25 0.00 16383.75 FUNCTION_LIST NMAXMD IF_DATA DIM_X DIRECT 0x816708 /end CHARACTERISTIC
/begin CHARACTERISTIC NMAXNL "Drehzahlgrenze bei Drehzahlgeber-Notlauf" VALUE 0x81670A KwUw 16383.75 nmot_uw_q0p25 0.00 16383.75 FUNCTION_LIST NMAXMD IF_DATA DIM_X DIRECT 0x81670A /end CHARACTERISTIC
/begin CHARACTERISTIC NMAXO "obere n max - Schwelle" VALUE 0x813B48 KwUw 16383.75 nmot_uw_q0p25 0.00 16383.75 FUNCTION_LIST AMUENE IF_DATA DIM_X DIRECT 0x813B48 /end CHARACTERISTIC
/begin CHARACTERISTIC NMAXOG "erhöhte Drehzahlgrenze" VALUE 0x81670C KwUw 16383.75 nmot_uw_q0p25 0.00 16383.75 FUNCTION_LIST NMAXMD IF_DATA DIM_X DIRECT 0x81670C /end CHARACTERISTIC
/begin CHARACTERISTIC NMAXPN "Drehzahlbegrenzung bei Automat in P/N-Stellung" VALUE 0x81670E KwUw 16383.75 nmot_uw_q0p25 0.00 16383.75 FUNCTION_LIST NMAXMD IF_DATA DIM_X DIRECT 0x81670E /end CHARACTERISTIC
/begin CHARACTERISTIC NMAXSWG "Integratorsteigung NMAX-Steuerung Getriebe" VALUE 0x816710 KwUw 1638350. nmotg_q25 25.00000 1638375. FUNCTION_LIST NMAXMD IF_DATA DIM_X DIRECT 0x816710 /end CHARACTERISTIC
/begin CHARACTERISTIC NMAXSWVS "Integratorsteigung NMAX-Steuerung Ventilhubsteuerung" VALUE 0x816712 KwUw 1638350. nmotg_q25 25.00000 1638375. FUNCTION_LIST NMAXMD IF_DATA DIM_X DIRECT 0x816712 /end CHARACTERISTIC
/begin CHARACTERISTIC NMAXVS "Drehzahlbegrenzung im Toel-Bereich 3 bis Umschaltung erlaubt" VALUE 0x816714 KwUw 16383.75 nmot_uw_q0p25 0.00 16383.75 FUNCTION_LIST NMAXMD IF_DATA DIM_X DIRECT 0x816714 /end CHARACTERISTIC
/begin CHARACTERISTIC NMDBGVNW "Motordrehzahlschwelle zum Erzwingen NW-Stellung spät" VALUE 0x8162FC KwUw 16383.75 nmot_uw_q0p25 0.00 16383.75 FUNCTION_LIST MDBGV IF_DATA DIM_X DIRECT 0x8162FC /end CHARACTERISTIC
/begin CHARACTERISTIC NMIALU "Min. Drehzahl für Ausblendung der Aussetzererkennung" VALUE 0x810556 KwUb 10200. nmot_ub_q40 0.00 10200. FUNCTION_LIST DMDSTP IF_DATA DIM_X DIRECT 0x810556 /end CHARACTERISTIC
/begin CHARACTERISTIC NMIDLU "Min. Drehzahl für Ausblendung der Aussetzererkennung DMDDLU" VALUE 0x810547 KwUb 10200. nmot_ub_q40 0.00 10200. FUNCTION_LIST DMDDLU IF_DATA DIM_X DIRECT 0x810547 /end CHARACTERISTIC
/begin CHARACTERISTIC NMIN "Minimal Drehzahl" VALUE 0x813B52 KwUw 16383.75 nmot_uw_q0p25 0.00 16383.75 FUNCTION_LIST GGDPG ACIFI IF_DATA DIM_X DIRECT 0x813B52 /end CHARACTERISTIC
/begin CHARACTERISTIC NMINVMX "Minimale Drehzahlschwelle zur VMAX-Regelung" VALUE 0x811C3A KwUb 10200. nmot_ub_q40 0.00 10200. FUNCTION_LIST VMAXMD IF_DATA DIM_X DIRECT 0x811C3A /end CHARACTERISTIC
/begin CHARACTERISTIC NMIN_UM "minimale Drehzahl für Motordrehzahlüberwachung der Funktionsüberwachung" VALUE 0x817D0B KwUb 9680. nmot_ub_q40 520.0 10200. FUNCTION_LIST UFNC IF_DATA DIM_X DIRECT 0x817D0B /end CHARACTERISTIC
/begin CHARACTERISTIC NMN_DUF "Drehzahl-Schwelle fürs Setzen der Zyklusflags der Funktionsüberwachungs-Diagnose" VALUE 0x811FE8 KwUb 10200. nmot_ub_q40 0.00 10200. FUNCTION_LIST DUF IF_DATA DIM_X DIRECT 0x811FE8 /end CHARACTERISTIC
/begin CHARACTERISTIC NMOTDYFA "untere Drehzahlschwelle für Dynamikprüfung LSU bei Kurztest" VALUE 0x8183FF KwUb 10200. nmot_ub_q40 0.00 10200. FUNCTION_LIST DLSU T2DFA T2LID IF_DATA DIM_X DIRECT 0x8183FF /end CHARACTERISTIC
/begin CHARACTERISTIC NMOTDYNO "obere Drehzahlschwelle für Dynamikprüfung LSU" VALUE 0x818400 KwUb 10200. nmot_ub_q40 0.00 10200. FUNCTION_LIST DLSU T2DFA T2LID IF_DATA DIM_X DIRECT 0x818400 /end CHARACTERISTIC
/begin CHARACTERISTIC NMOTDYNU "untere Drehzahlschwelle für Dynamikprüfung LSU" VALUE 0x818401 KwUb 10200. nmot_ub_q40 0.00 10200. FUNCTION_LIST DLSU IF_DATA DIM_X DIRECT 0x818401 /end CHARACTERISTIC
/begin CHARACTERISTIC NMOTGW "Drehzahlschwelle Ventilhub gross während Kupplungsbetätigung" VALUE 0x819CE8 KwUb 10200. nmot_ub_q40 0.00 10200. FUNCTION_LIST VS IF_DATA DIM_X DIRECT 0x819CE8 /end CHARACTERISTIC
/begin CHARACTERISTIC NMOTGWNW "Drehzahlschwelle Spätstellung NW während Kupplungsbetätigung" VALUE 0x81875E KwUb 10200. nmot_ub_q40 0.00 10200. FUNCTION_LIST NWS IF_DATA DIM_X DIRECT 0x81875E /end CHARACTERISTIC
/begin CHARACTERISTIC NMOTQSYN "Motordrehzahlschwelle zur Freigabe des Schnellstarts über PG Schnellstart" VALUE 0x813B54 KwUw 700.0000 nmot_uw_q0p25 0.00 700.0000 FUNCTION_LIST GGDPG IF_DATA DIM_X DIRECT 0x813B54 /end CHARACTERISTIC
/begin CHARACTERISTIC NMOT_DAT_UC "" VAL_BLK 0x811DCC KwbUb 10200. nmot_ub_q40 0.00 10200. NUMBER 16 FUNCTION_LIST URCEIN IF_DATA DIM_X DIRECT 0x811DCC /end CHARACTERISTIC
/begin CHARACTERISTIC NMXALU "Max. Drehzahl für Ausblendung der Aussetzererkennung" VALUE 0x810557 KwUb 10200. nmot_ub_q40 0.00 10200. FUNCTION_LIST DMDSTP IF_DATA DIM_X DIRECT 0x810557 /end CHARACTERISTIC
/begin CHARACTERISTIC NMXDAEF "Maximaldrehzahl bei Drosselklappen-Antrieb-Ersatzbetrieb" CURVE 0x811C23 KlAUbSstUbWUb 10200. nmot_ub_q40 0.00 10200. FUNCTION_LIST NMAXMD IF_DATA DIM_X DIRECT 0x811C23 /begin AXIS_DESCR STD_AXIS wped relPED_ub_b100 6 0.00 100.0 DEPOSIT ABSOLUT /end AXIS_DESCR /end CHARACTERISTIC
/begin CHARACTERISTIC NMXDKPU "Maximaldrehzahl bei Sicherheitskraftstoffabschaltung (SKA)" VALUE 0x816716 KwUw 16383.75 nmot_uw_q0p25 0.00 16383.75 FUNCTION_LIST NMAXMD IF_DATA DIM_X DIRECT 0x816716 /end CHARACTERISTIC
/begin CHARACTERISTIC NMXPG "P-Glied bei NMAX-Regelung" CURVE 0x81985D GklWUb 0.9961 relnmot_q0p0039 0.00 0.9961 FUNCTION_LIST NMAXMD IF_DATA DIM_X DIRECT 0x81985D /begin AXIS_DESCR COM_AXIS gangi dez 8 0.00 255.0 AXIS_PTS_REF SGA08MDUB /end AXIS_DESCR /end CHARACTERISTIC
/begin CHARACTERISTIC NMXPRLG "Verstärkung Proportionalanteil der NMAX-Regelung im Normalbetrieb" MAP 0x819865 GkfWUb 0.9961 relnmot_q0p0039 0.00 0.9961 FUNCTION_LIST NMAXMD IF_DATA DIM_X DIRECT 0x819865
 /begin AXIS_DESCR COM_AXIS rl rel_ub_q0p75 8 0.00 191.3 AXIS_PTS_REF SRL08NXUB /end AXIS_DESCR
 /begin AXIS_DESCR COM_AXIS gangi dez 8 0.00 255.0 AXIS_PTS_REF SGA08MDUB /end AXIS_DESCR
/end CHARACTERISTIC
/begin CHARACTERISTIC NMXSKA "Maximaldrehzahl bei unbekannter Drosselklappenposition -> Ev-Abschaltung" VALUE 0x8110EA KwUb 10200. nmot_ub_q40 0.00 10200. FUNCTION_LIST AEVABU IF_DATA DIM_X DIRECT 0x8110EA /end CHARACTERISTIC
/begin CHARACTERISTIC NNPTMMX "Max. Motordrehzahl für Freigabe Unplausibilitätsprüfung tmot-Signa (Überdrücken)" VALUE 0x819038 KwUb 10200. nmot_ub_q40 0.00 10200. FUNCTION_LIST GGTFM IF_DATA DIM_X DIRECT 0x819038 /end CHARACTERISTIC
/begin CHARACTERISTIC NNSTA "Drehzahlübergang Normal -> Start" CURVE 0x819970 KlAUbSstUbWUb 10200. nmot_ub_q40 0.00 10200. FUNCTION_LIST BBSTT IF_DATA DIM_X DIRECT 0x819970
 /begin AXIS_DESCR STD_AXIS tans temp_ub_q0p75_o48 3 -48.00 143.3 DEPOSIT ABSOLUT /end AXIS_DESCR
/end CHARACTERISTIC
/begin CHARACTERISTIC NNWS "Drehzahlschwelle für NWS - Umschaltung" VALUE 0x81875F KwUb 10200. nmot_ub_q40 0.00 10200. FUNCTION_LIST NWS IF_DATA DIM_X DIRECT 0x81875F /end CHARACTERISTIC
/begin CHARACTERISTIC NNWTOEL "Drehzahlschwelle für Drehzahlkorrektur in Abhängigkeit von TOEL" VALUE 0x818760 KwUb 10200. nmot_ub_q40 0.00 10200. FUNCTION_LIST NWS IF_DATA DIM_X DIRECT 0x818760 /end CHARACTERISTIC
/begin CHARACTERISTIC NO1 "obere Drehzahlschwelle Bereich 1" VALUE 0x818F9F KwUb 10200. nmot_ub_q40 0.00 10200. FUNCTION_LIST LRA IF_DATA DIM_X DIRECT 0x818F9F /end CHARACTERISTIC
/begin CHARACTERISTIC NOASR_UC "" VALUE 0x811E50 KwUb 99.61 rel_ub_q0p3906 0.00 99.61 FUNCTION_LIST URCMSRC IF_DATA DIM_X DIRECT 0x811E50 /end CHARACTERISTIC
/begin CHARACTERISTIC NOASR_UM "Inaktivmaske für ASR" VALUE 0x817D78 KwUb 99.61 rel_ub_q0p3906 0.00 99.61 FUNCTION_LIST UFMSRC IF_DATA DIM_X DIRECT 0x817D78 /end CHARACTERISTIC
/begin CHARACTERISTIC NOBMINC "Wert der bei nicht erkannter Bezugsmarke aufaddiert wird" VALUE 0x8181B5 KwUb 255.0 dez 0.00 255.0 FUNCTION_LIST DDG IF_DATA DIM_X DIRECT 0x8181B5 /end CHARACTERISTIC
/begin CHARACTERISTIC NOBMINIT "Initialisierungswert für Zähler Bezugsmarkenverlust" VALUE 0x8181B6 KwUb 255.0 dez 0.00 255.0 FUNCTION_LIST DDG IF_DATA DIM_X DIRECT 0x8181B6 /end CHARACTERISTIC
/begin CHARACTERISTIC NOBMSTMX "Maximalwert für nicht erkannte Bezugsmarken im Start" VALUE 0x8181B7 KwUb 255.0 dez 0.00 255.0 FUNCTION_LIST DDG IF_DATA DIM_X DIRECT 0x8181B7 /end CHARACTERISTIC
/begin CHARACTERISTIC NOLRA "Codewort für Adaptionsfreigabe" VALUE 0x818FA0 KwUb 255.0 dez 0.00 255.0 FUNCTION_LIST LRA IF_DATA DIM_X DIRECT 0x818FA0 /end CHARACTERISTIC
/begin CHARACTERISTIC NOREA_UM "Kennung zur Anforderung kein Motorbetrieb möglich aus %UFREAC der Funktionsüberw" VALUE 0x817F0B KwUb 255.0 dez 0.00 255.0 FUNCTION_LIST UFREAC URDELAY IF_DATA DIM_X DIRECT 0x817F0B /end CHARACTERISTIC
/begin CHARACTERISTIC NPHERKMN "minimale Motordrehzahl für Phasensuche" VALUE 0x810C50 KwUb 10200. nmot_ub_q40 0.00 10200. FUNCTION_LIST NLPH IF_DATA DIM_X DIRECT 0x810C50 /end CHARACTERISTIC
/begin CHARACTERISTIC NPHERKMX "maximale Motordrehzahl für Phasensuche" VALUE 0x810C51 KwUb 10200. nmot_ub_q40 0.00 10200. FUNCTION_LIST NLPH IF_DATA DIM_X DIRECT 0x810C51 /end CHARACTERISTIC
/begin CHARACTERISTIC NPHINVMN "minimale Motordrehzahl für Initialisierung" VALUE 0x810C52 KwUb 10200. nmot_ub_q40 0.00 10200. FUNCTION_LIST NLPH IF_DATA DIM_X DIRECT 0x810C52 /end CHARACTERISTIC
/begin CHARACTERISTIC NPHINVMX "maximale Motordrehzahl für Initialisierung" VALUE 0x810C53 KwUb 10200. nmot_ub_q40 0.00 10200. FUNCTION_LIST NLPH IF_DATA DIM_X DIRECT 0x810C53 /end CHARACTERISTIC
/begin CHARACTERISTIC NRKAB "Mindestdrehzahl für Begrenzung Stelleingriff rkat bei niedrigen Drehzahlen" VALUE 0x811415 KwUb 10200. nmot_ub_q40 0.00 10200. FUNCTION_LIST LRA IF_DATA DIM_X DIRECT 0x811415 /end CHARACTERISTIC
/begin CHARACTERISTIC NRLIP_UM "Motordrehzahl-Schwelle für den rl/rlip-Vergleich in der Funktionsüberwachg" VALUE 0x817D68 KwUb 10200. nmot_ub_q40 0.00 10200. FUNCTION_LIST UFRLC IF_DATA DIM_X DIRECT 0x817D68 /end CHARACTERISTIC
/begin CHARACTERISTIC NRLMN "Minimaldrehzahl zur Berechnung von umsrln" VALUE 0x8152D6 KwUw 16383.75 nmot_ub_q0p25 0.00 16383.75 FUNCTION_LIST FUEDK IF_DATA DIM_X DIRECT 0x8152D6 /end CHARACTERISTIC
/begin CHARACTERISTIC NRLMNLLR "Minimaldrehzahl zur Berechnung von umsrln im LL" VALUE 0x8152D8 KwUw 16383.75 nmot_ub_q0p25 0.00 16383.75 FUNCTION_LIST FUEDK IF_DATA DIM_X DIRECT 0x8152D8 /end CHARACTERISTIC
/begin CHARACTERISTIC NRUBMX "Maximale Drehzahl für Batteriespannungsregelung" VALUE 0x818480 KwUb 2550. nmot_ub_q10 0.00 2550. FUNCTION_LIST BGLBZ IF_DATA DIM_X DIRECT 0x818480 /end CHARACTERISTIC
/begin CHARACTERISTIC NSAC "Solldrehzahl bei Klimaanlage ein (S_AC = 1)" VALUE 0x8115C7 KwUb 2550. nmot_ub_q10 0.00 2550. FUNCTION_LIST LLRNS IF_DATA DIM_X DIRECT 0x8115C7 /end CHARACTERISTIC
/begin CHARACTERISTIC NSACFS "Solldrehzahl bei Klimaanlage ein (S_AC = 1) und eingelegter Fahrstufe (S_fs=1)" VALUE 0x8115C8 KwUb 2550. nmot_ub_q10 0.00 2550. FUNCTION_LIST LLRNS IF_DATA DIM_X DIRECT 0x8115C8 /end CHARACTERISTIC
/begin CHARACTERISTIC NSC_T_UM "Nachstartüberwachungszeit für die Funktionsüberwachung" VALUE 0x817F1C KwUw 2621.400 t40msxs_uw_q0p04 0.00 2621.400 FUNCTION_LIST UFNSC IF_DATA DIM_X DIRECT 0x817F1C /end CHARACTERISTIC
/begin CHARACTERISTIC NSLBZS "Drehzahlschwelle zur Umschaltung der Solldrehzahl durch lbz" VALUE 0x8115C9 KwUb 10200. nmot_ub_q40 0.00 10200. FUNCTION_LIST LLRNS IF_DATA DIM_X DIRECT 0x8115C9 /end CHARACTERISTIC
/begin CHARACTERISTIC NSLPP "Solldrehzahl abhängig vom Pumpendruck der Servolenkung" CURVE 0x819724 KlAUbSstUbWUb 2550. nmot_ub_q10 0.00 2550. FUNCTION_LIST LLRNS IF_DATA DIM_X DIRECT 0x819724 /begin AXIS_DESCR STD_AXIS psl dez 4 0.00 255.0 DEPOSIT ABSOLUT /end AXIS_DESCR /end CHARACTERISTIC
/begin CHARACTERISTIC NSLPPFS "Solldrehzahl abhängig vom Pumpendruck der Servolenkung bei B_fs=1" CURVE 0x81972D KlAUbSstUbWUb 2550. nmot_ub_q10 0.00 2550. FUNCTION_LIST LLRNS IF_DATA DIM_X DIRECT 0x81972D /begin AXIS_DESCR STD_AXIS psl dez 4 0.00 255.0 DEPOSIT ABSOLUT /end AXIS_DESCR /end CHARACTERISTIC
/begin CHARACTERISTIC NSNLDG "Soll-Drehzahlerhöhung bei Drehzahlgeber-Notlauf" VALUE 0x819736 KwUb 2550. nmot_ub_q10 0.00 2550. FUNCTION_LIST LLRNS IF_DATA DIM_X DIRECT 0x819736 /end CHARACTERISTIC
/begin CHARACTERISTIC NSNOT "Solldrehzahlanhebung bei B_nnot=1" VALUE 0x8115CA KwUb 2550. nmot_ub_q10 0.00 2550. FUNCTION_LIST LLRNS IF_DATA DIM_X DIRECT 0x8115CA /end CHARACTERISTIC
/begin CHARACTERISTIC NSNOT1 "Solldrehzahlanhebung bei Notlauf" VALUE 0x8115CB KwUb 2550. nmot_ub_q10 0.00 2550. FUNCTION_LIST LLRNS IF_DATA DIM_X DIRECT 0x8115CB /end CHARACTERISTIC
/begin CHARACTERISTIC NSNOT1FS "Solldrehzahlanhebung bei Notlauf und Fahrstufe EIN" VALUE 0x8115CC KwUb 2550. nmot_ub_q10 0.00 2550. FUNCTION_LIST LLRNS IF_DATA DIM_X DIRECT 0x8115CC /end CHARACTERISTIC
/begin CHARACTERISTIC NSNOTFS "Solldrehzahlanhebung bei B_nnot=1 und Fahrstufe" VALUE 0x8115CD KwUb 2550. nmot_ub_q10 0.00 2550. FUNCTION_LIST LLRNS IF_DATA DIM_X DIRECT 0x8115CD /end CHARACTERISTIC
/begin CHARACTERISTIC NSOF_T_UM "Entprellzeit für Abschaltung der Nachstartaufweitung" VALUE 0x817D0C KwUb 10200.0 t40ms_ub_b10200 0.00 10200.0 FUNCTION_LIST UFNSC IF_DATA DIM_X DIRECT 0x817D0C /end CHARACTERISTIC
/begin CHARACTERISTIC NSTAMXHA "Höhenabhängige Drehzahlschwelle für STADAP aktiv" CURVE 0x818FBC KlAUbSstUbWUb 10200. nmot_ub_q40 0.00 10200. FUNCTION_LIST STADAP IF_DATA DIM_X DIRECT 0x818FBC /begin AXIS_DESCR STD_AXIS fho fak_ub_b4 16 0.00 3.984 DEPOSIT ABSOLUT /end AXIS_DESCR /end CHARACTERISTIC
/begin CHARACTERISTIC NSTART "Motordrehzahlschwelle für Unterdrehzahl-Ausstieg bei Nachstartaufweitung" VALUE 0x811C13 KwUb 10200. nmot_ub_q40 0.00 10200. FUNCTION_LIST MDZUL IF_DATA DIM_X DIRECT 0x811C13 /end CHARACTERISTIC
/begin CHARACTERISTIC NSTDMD "Max. Drehzahl für Ausblendung der Aussetzererkennung nach Start" VALUE 0x81387A KwUw 16383.75 nmot_uw_q0p25 0.00 16383.75 FUNCTION_LIST DMDSTP IF_DATA DIM_X DIRECT 0x81387A /end CHARACTERISTIC
/begin CHARACTERISTIC NSTEND "Motordrehzahlschwelle für Start Ende bei Nachstartaufweitung" VALUE 0x811C14 KwUb 10200. nmot_ub_q40 0.00 10200. FUNCTION_LIST MDZUL IF_DATA DIM_X DIRECT 0x811C14 /end CHARACTERISTIC
/begin CHARACTERISTIC NSTMXM "Drehzahlschwelle für Startende autom. Start f(TMOT)" CURVE 0x8121B5 KlAUbSstUbWUb 2550. nmot_ub_q10 0.00 2550. FUNCTION_LIST STA IF_DATA DIM_X DIRECT 0x8121B5
 /begin AXIS_DESCR STD_AXIS tmot temp_ub_q0p75_o48 4 -48.00 143.3 DEPOSIT ABSOLUT /end AXIS_DESCR
/end CHARACTERISTIC
/begin CHARACTERISTIC NSTNM "Übergang Start -> Normal" CURVE 0x819977 KlAUbSstUbWUb 10200. nmot_ub_q40 0.00 10200. FUNCTION_LIST BBSTT IF_DATA DIM_X DIRECT 0x819977
 /begin AXIS_DESCR STD_AXIS tmot temp_ub_q0p75_o48 3 -48.00 143.3 DEPOSIT ABSOLUT /end AXIS_DESCR
/end CHARACTERISTIC
/begin CHARACTERISTIC NSWO1 "Drehzahlschwelle 1 Umschaltg. zur Rechenzeitersparnis" VALUE 0x8198CD KwUb 10200. nmot_ub_q40 0.00 10200. FUNCTION_LIST PROKON IF_DATA DIM_X DIRECT 0x8198CD /end CHARACTERISTIC
/begin CHARACTERISTIC NSWO2 "Drehzahlschwelle 2 Umschaltg. zur Rechenzeitersparnis" VALUE 0x8198CE KwUb 10200. nmot_ub_q40 0.00 10200. FUNCTION_LIST PROKON IF_DATA DIM_X DIRECT 0x8198CE /end CHARACTERISTIC
/begin CHARACTERISTIC NTEB "Angehobene Solldrehzahl bei stark beladenem AKF" VALUE 0x8115CE KwUb 2550. nmot_ub_q10 0.00 2550. FUNCTION_LIST LLRNS IF_DATA DIM_X DIRECT 0x8115CE /end CHARACTERISTIC
/begin CHARACTERISTIC NTEBFS "Angehobene Solldrehzahl bei stark beladenem AKF und B_fs=1" VALUE 0x8115CF KwUb 2550. nmot_ub_q10 0.00 2550. FUNCTION_LIST LLRNS IF_DATA DIM_X DIRECT 0x8115CF /end CHARACTERISTIC
/begin CHARACTERISTIC NTOELNWS "nmottoel-Schwelle oberhalb derer die NWS in Abh. von der Last zugelassen wird" VALUE 0x818761 KwUb 10200. nmot_ub_q40 0.00 10200. FUNCTION_LIST NWS IF_DATA DIM_X DIRECT 0x818761 /end CHARACTERISTIC
/begin CHARACTERISTIC NTOLVSA "Drehzahlschwelle Ventilhubsteuerung zulasssen (poel-Ersatz)" VALUE 0x819CE9 KwUb 10200. nmot_ub_q40 0.00 10200. FUNCTION_LIST VS IF_DATA DIM_X DIRECT 0x819CE9 /end CHARACTERISTIC
/begin CHARACTERISTIC NTPKTO "obere Drehzahlschwelle für Periodendauer-Kurztest" VALUE 0x8121C2 KwUb 10200. nmot_ub_q40 0.00 10200. FUNCTION_LIST SWADP IF_DATA DIM_X DIRECT 0x8121C2 /end CHARACTERISTIC
/begin CHARACTERISTIC NTPKTU "untere Drehzahlschwelle für Periodendauer-Kurztest" VALUE 0x8121C3 KwUb 10200. nmot_ub_q40 0.00 10200. FUNCTION_LIST SWADP IF_DATA DIM_X DIRECT 0x8121C3 /end CHARACTERISTIC
/begin CHARACTERISTIC NTUMGTA "Schwelle Drehzahl für Bestimmung Umgebungstemperatur aus TANS" VALUE 0x8190C3 KwUb 10200. nmot_ub_q40 0.00 10200. FUNCTION_LIST GGTFUMG IF_DATA DIM_X DIRECT 0x8190C3 /end CHARACTERISTIC
/begin CHARACTERISTIC NTUMTA "Schwelle Drehzahl für Bestimmung Umgebungstemperatur" VALUE 0x818805 KwUb 10200. nmot_ub_q40 0.00 10200. FUNCTION_LIST BGTABS IF_DATA DIM_X DIRECT 0x818805 /end CHARACTERISTIC
/begin CHARACTERISTIC NTUMTAT "Schwelle Drehzahl für Bestimmung Umgebungstemperatur aus TANS" VALUE 0x81834C KwUb 10200. nmot_ub_q40 0.00 10200. FUNCTION_LIST ATM IF_DATA DIM_X DIRECT 0x81834C /end CHARACTERISTIC
/begin CHARACTERISTIC NU3 "untere Drehzahlschwelle Bereich 3" VALUE 0x818FA1 KwUb 10200. nmot_ub_q40 0.00 10200. FUNCTION_LIST LRA IF_DATA DIM_X DIRECT 0x818FA1 /end CHARACTERISTIC
/begin CHARACTERISTIC NUKAO "obere Drehzahlgrenze für ÜK-Adaption" VALUE 0x811346 KwUb 10200. nmot_ub_q40 0.00 10200. FUNCTION_LIST ESUKAS IF_DATA DIM_X DIRECT 0x811346 /end CHARACTERISTIC
/begin CHARACTERISTIC NUKAU "untere Drehzahlgrenze für ÜK-Adaption" VALUE 0x811347 KwUb 10200. nmot_ub_q40 0.00 10200. FUNCTION_LIST ESUKAS IF_DATA DIM_X DIRECT 0x811347 /end CHARACTERISTIC
/begin CHARACTERISTIC NVERZMN "minimale Drehzahl für Verzögerung" VALUE 0x817674 KwUw 16383.75 nmot_uw_q0p25 0.00 16383.75 FUNCTION_LIST TEB IF_DATA DIM_X DIRECT 0x817674 /end CHARACTERISTIC
/begin CHARACTERISTIC NVGDSLL "Drehzahlschwelle  für Drucksensorvergleich DSU/DSL im Leerlauf" VALUE 0x8184E0 KwUb 10200. nmot_ub_q40 0.00 10200. FUNCTION_LIST GGDSAS IF_DATA DIM_X DIRECT 0x8184E0 /end CHARACTERISTIC
/begin CHARACTERISTIC NVQUOT1O "Gangerkennung n/v 1 Gang oben" VALUE 0x813D68 KwUw 511.9922 qnv_uw_b512 0.00 511.9922 FUNCTION_LIST BBGANG IF_DATA DIM_X DIRECT 0x813D68 /end CHARACTERISTIC
/begin CHARACTERISTIC NVQUOT1U "Gangerekennung n/v 1 Gang unten" VALUE 0x813D6A KwUw 511.9922 qnv_uw_b512 0.00 511.9922 FUNCTION_LIST BBGANG IF_DATA DIM_X DIRECT 0x813D6A /end CHARACTERISTIC
/begin CHARACTERISTIC NVQUOT2O "Gangerkennung n/v 2 Gang oben" VALUE 0x813D6C KwUw 511.9922 qnv_uw_b512 0.00 511.9922 FUNCTION_LIST BBGANG IF_DATA DIM_X DIRECT 0x813D6C /end CHARACTERISTIC
/begin CHARACTERISTIC NVQUOT2U "Gangerkennung n/v 2 Gang unten" VALUE 0x813D6E KwUw 511.9922 qnv_uw_b512 0.00 511.9922 FUNCTION_LIST BBGANG IF_DATA DIM_X DIRECT 0x813D6E /end CHARACTERISTIC
/begin CHARACTERISTIC NVQUOT3O "Gangerkennung n/v 3 Gang oben" VALUE 0x813D70 KwUw 511.9922 qnv_uw_b512 0.00 511.9922 FUNCTION_LIST BBGANG IF_DATA DIM_X DIRECT 0x813D70 /end CHARACTERISTIC
/begin CHARACTERISTIC NVQUOT3U "Gangerkennung n/v 3 Gang unten" VALUE 0x813D72 KwUw 511.9922 qnv_uw_b512 0.00 511.9922 FUNCTION_LIST BBGANG IF_DATA DIM_X DIRECT 0x813D72 /end CHARACTERISTIC
/begin CHARACTERISTIC NVQUOT4O "Gangerkennung n/v 4 Gang oben" VALUE 0x813D74 KwUw 511.9922 qnv_uw_b512 0.00 511.9922 FUNCTION_LIST BBGANG IF_DATA DIM_X DIRECT 0x813D74 /end CHARACTERISTIC
/begin CHARACTERISTIC NVQUOT4U "Gangerkennung n/v 4 Gang unten" VALUE 0x813D76 KwUw 511.9922 qnv_uw_b512 0.00 511.9922 FUNCTION_LIST BBGANG IF_DATA DIM_X DIRECT 0x813D76 /end CHARACTERISTIC
/begin CHARACTERISTIC NVQUOT5O "Gangerkennung n/v 5 Gang oben" VALUE 0x813D78 KwUw 511.9922 qnv_uw_b512 0.00 511.9922 FUNCTION_LIST BBGANG IF_DATA DIM_X DIRECT 0x813D78 /end CHARACTERISTIC
/begin CHARACTERISTIC NVQUOT5U "Gangerkennung n/v 5 Gang unten" VALUE 0x813D7A KwUw 511.9922 qnv_uw_b512 0.00 511.9922 FUNCTION_LIST BBGANG IF_DATA DIM_X DIRECT 0x813D7A /end CHARACTERISTIC
/begin CHARACTERISTIC NVQUOT6O "Gangerkennung n/v 6 Gang oben" VALUE 0x813D7C KwUw 511.9922 qnv_uw_b512 0.00 511.9922 FUNCTION_LIST BBGANG IF_DATA DIM_X DIRECT 0x813D7C /end CHARACTERISTIC
/begin CHARACTERISTIC NVQUOT6U "Gangerkennung n/v 6 Gang unten" VALUE 0x813D7E KwUw 511.9922 qnv_uw_b512 0.00 511.9922 FUNCTION_LIST BBGANG IF_DATA DIM_X DIRECT 0x813D7E /end CHARACTERISTIC
/begin CHARACTERISTIC NVSTOL1G "Drehzahlschwelle im Toel-Bereich 1" CURVE 0x819CEA KlAUbSstUbWUb 10200. nmot_ub_q40 0.00 10200. FUNCTION_LIST VS IF_DATA DIM_X DIRECT 0x819CEA /begin AXIS_DESCR STD_AXIS gangi dez 8 0.00 255.0 DEPOSIT ABSOLUT /end AXIS_DESCR /end CHARACTERISTIC
/begin CHARACTERISTIC NWAFMN "Minimaldrehzahl für Freigabe Winkeladaption NW-Flanken" VALUE 0x810C5A KwUb 10200. nmot_ub_q40 0.00 10200. FUNCTION_LIST WANWKW IF_DATA DIM_X DIRECT 0x810C5A /end CHARACTERISTIC
/begin CHARACTERISTIC NWAFMX "Maximaldrehzahl für Freigabe Winkeladaption NW-Flanken" VALUE 0x810C5B KwUb 10200. nmot_ub_q40 0.00 10200. FUNCTION_LIST WANWKW IF_DATA DIM_X DIRECT 0x810C5B /end CHARACTERISTIC
/begin CHARACTERISTIC NWDK3 "Minimaldrehzahl für Berechnung DK-Winkel-Ersatzwert aus Füllungssignal" VALUE 0x810DF6 KwUb 10000. nmot_ub_q40 200.0 10200. FUNCTION_LIST GGDVE IF_DATA DIM_X DIRECT 0x810DF6 /end CHARACTERISTIC
/begin CHARACTERISTIC NWEM "Wiedereinsetzdrehzahl" CURVE 0x8196D4 GklWUb 10200. nmot_ub_q40 0.00 10200. FUNCTION_LIST BBSAWE IF_DATA DIM_X DIRECT 0x8196D4
 /begin AXIS_DESCR COM_AXIS tmot temp_ub_q0p75_o48 5 -48.00 143.3 AXIS_PTS_REF STM05SAUB /end AXIS_DESCR
/end CHARACTERISTIC
/begin CHARACTERISTIC NWENG "Wiedereinsetzdrehzahl" CURVE 0x815998 KlAUbSstSbWUb 10200. nmot_ub_q40 0.00 10200. FUNCTION_LIST BBSAWE IF_DATA DIM_X DIRECT 0x815998
 /begin AXIS_DESCR STD_AXIS ngfil nmotg_sb_q100 5 -12800. 12700. DEPOSIT ABSOLUT /end AXIS_DESCR
/end CHARACTERISTIC
/begin CHARACTERISTIC NWFSST "Drehzahlschwelle für Triggerung Vorfreigabe (nach Startende)" VALUE 0x811C42 KwUb 10200. nmot_ub_q40 0.00 10200. FUNCTION_LIST WFS IF_DATA DIM_X DIRECT 0x811C42 /end CHARACTERISTIC
/begin CHARACTERISTIC NWFSVR "Drehzahlschwelle für Verriegelung bei Unterschreitung während Initialisierung" VALUE 0x811C43 KwUb 12750. nmot_ub_q50 0.00 12750. FUNCTION_LIST WFS IF_DATA DIM_X DIRECT 0x811C43 /end CHARACTERISTIC
/begin CHARACTERISTIC NWPMBBR "Mindestdrehzahl für Pedalwertbegrenzung bei betätigter Bremse" VALUE 0x810E31 KwUb 10200. nmot_ub_q40 0.00 10200. FUNCTION_LIST GGPED IF_DATA DIM_X DIRECT 0x810E31 /end CHARACTERISTIC
/begin CHARACTERISTIC NWVLS "Drehzahlschwelle für Vollastzündwinkel spät Motorschutz" VALUE 0x819D8E KwUb 10200. nmot_ub_q40 0.00 10200. FUNCTION_LIST ZWBTSK IF_DATA DIM_X DIRECT 0x819D8E /end CHARACTERISTIC
/begin CHARACTERISTIC NWVSTSEG "Anzahl Segmente zur Schaltünterdrücken VS nach NWS Umschaltung" CURVE 0x819CFB KlAUbSstUbWUb 255.0 dez 0.00 255.0 FUNCTION_LIST VS IF_DATA DIM_X DIRECT 0x819CFB /begin AXIS_DESCR STD_AXIS nmot nmot_ub_q40 8 0.00 10200. DEPOSIT ABSOLUT /end AXIS_DESCR /end CHARACTERISTIC
/begin CHARACTERISTIC N_START_UM "Motordrehzahlschwelle für Unterdrehzahl-Ausstieg für die Fkt.-Überwachung" VALUE 0x817D0D KwUb 10200. nmot_ub_q40 0.00 10200. FUNCTION_LIST UFNSC IF_DATA DIM_X DIRECT 0x817D0D /end CHARACTERISTIC
/begin CHARACTERISTIC N_STEND_UM "Motordrehzahlschwelle für Startende in der Fkt.-Überwachung" VALUE 0x817D0E KwUb 10200. nmot_ub_q40 0.00 10200. FUNCTION_LIST UFNSC IF_DATA DIM_X DIRECT 0x817D0E /end CHARACTERISTIC
/begin CHARACTERISTIC OFQSYNADAP "Offset zwischen adaptierter Phasenflanke und Phasenflanke im Start" VALUE 0x813B56 KwSw 72.00000 kw_q0p0156 -36.00000 36.00000 FUNCTION_LIST GGDPG IF_DATA DIM_X DIRECT 0x813B56 /end CHARACTERISTIC
/begin CHARACTERISTIC PADMSA "Abgasgegendruck am Sondeneinbauort LSU" CURVE 0x81B912 KlAUwSstUwWUw 2559.961 p_uw_q0p039 0.00 2559.961 FUNCTION_LIST GGLSU IF_DATA DIM_X DIRECT 0x81B912
 /begin AXIS_DESCR STD_AXIS msabg_w m_uw_b6553p5 6 0.00 6553.500 DEPOSIT ABSOLUT /end AXIS_DESCR
/end CHARACTERISTIC
/begin CHARACTERISTIC PADMSA2 "Abgasgegendruck am Sondeneinbauort LSU 2" CURVE 0x81B92C KlAUwSstUwWUw 2559.961 p_uw_q0p039 0.00 2559.961 FUNCTION_LIST GGLSU IF_DATA DIM_X DIRECT 0x81B92C
 /begin AXIS_DESCR STD_AXIS msabg2_w m_uw_b6553p5 6 0.00 6553.500 DEPOSIT ABSOLUT /end AXIS_DESCR
/end CHARACTERISTIC
/begin CHARACTERISTIC PGFLNL "Anzahl an Phasenflanken bis NLDG aufgerufen wird bei eingetragenem E_n" VALUE 0x8181B8 KwUb 255.0 dez 0.00 255.0 FUNCTION_LIST DDG IF_DATA DIM_X DIRECT 0x8181B8 /end CHARACTERISTIC
/begin CHARACTERISTIC PGFLWA "Anzahl PG-Flankenwechsel für DG-Fehler B_signal" VALUE 0x810BFD KwUb 255.0 dez 0.00 255.0 FUNCTION_LIST DDG IF_DATA DIM_X DIRECT 0x810BFD /end CHARACTERISTIC
/begin CHARACTERISTIC PHLSNHMN "Heizleistung für ausreichende Sondenheizung" VALUE 0x818477 KwUb 2.550 fak_ub_q0p01 0.00 2.550 FUNCTION_LIST HLSHK IF_DATA DIM_X DIRECT 0x818477 /end CHARACTERISTIC
/begin CHARACTERISTIC PHNOKA "Anfangswert für Zähler Phasensignal nicht ok" VALUE 0x810BFE KwUb 255.0 dez 0.00 255.0 FUNCTION_LIST DPH IF_DATA DIM_X DIRECT 0x810BFE /end CHARACTERISTIC
/begin CHARACTERISTIC PH_MINSEG "Segmentlänge kurzes Segment beim Schnellstart-Phasengebersignal" VALUE 0x810C03 KwUb 90.00 kw_q6 0.00 90.00 FUNCTION_LIST GGDPG IF_DATA DIM_X DIRECT 0x810C03 /end CHARACTERISTIC
/begin CHARACTERISTIC PIDLDSUA "Prädiktionsintervall für dynamische Schubumluftventilansteuerung" VALUE 0x8114AF KwUb 63.75 fak_ub_b64 0.00 63.75 FUNCTION_LIST LDUVST IF_DATA DIM_X DIRECT 0x8114AF /end CHARACTERISTIC
/begin CHARACTERISTIC PLMRN "P-Anteil von Luftmassenregler" CURVE 0x81863D GklWUb 7.969 fak_ub_b8 0.00 7.969 FUNCTION_LIST FUEREG IF_DATA DIM_X DIRECT 0x81863D
 /begin AXIS_DESCR COM_AXIS nmot nmot_ub_q40 8 0.00 10200. AXIS_PTS_REF SNM08FEUB /end AXIS_DESCR
/end CHARACTERISTIC
/begin CHARACTERISTIC PLRHAV "Wichtungsfaktor des P-Anteils in der LRHK über KAT-Alterung" CURVE 0x812179 KlAUbSstUbWUb 0.9961 fak_ub_b1 0.00 0.9961 FUNCTION_LIST LRSHK IF_DATA DIM_X DIRECT 0x812179 /begin AXIS_DESCR STD_AXIS avkatf fak_ub_b1 8 0.00 0.9961 DEPOSIT ABSOLUT /end AXIS_DESCR /end CHARACTERISTIC
/begin CHARACTERISTIC PLRHAV2 "Wichtungsfaktor des P-Anteils in der LRHK über KAT-Alterung Bank 2" CURVE 0x81218A KlAUbSstUbWUb 0.9961 fak_ub_b1 0.00 0.9961 FUNCTION_LIST LRSHK IF_DATA DIM_X DIRECT 0x81218A /begin AXIS_DESCR STD_AXIS avkatf2 fak_ub_b1 8 0.00 0.9961 DEPOSIT ABSOLUT /end AXIS_DESCR /end CHARACTERISTIC
/begin CHARACTERISTIC PLSOLAP "Applikationswert für Soll-Ladedruck" VALUE 0x8152DA KwUw 2559.961 p_uw_q0p039 0.00 2559.961 FUNCTION_LIST FUEDK IF_DATA DIM_X DIRECT 0x8152DA /end CHARACTERISTIC
/begin CHARACTERISTIC POELMNVS "Minimal nötiger Öldruck für Ventilhubsteuerung" VALUE 0x819D0C KwUb 10.20 p_ub_q0p04 0.00 10.20 FUNCTION_LIST VS IF_DATA DIM_X DIRECT 0x819D0C /end CHARACTERISTIC
/begin CHARACTERISTIC PSAPES "Saugrohrdruck für Applikation Einspritzung" VALUE 0x81BFF6 KwUw 2559.961 p_uw_q0p039 0.00 2559.961 FUNCTION_LIST AES IF_DATA DIM_X DIRECT 0x81BFF6 /end CHARACTERISTIC
/begin CHARACTERISTIC PSPVDKUG "Verhältnis pspvdk ungedrosselt" VALUE 0x81BB16 KwUw 1.999969 fak_uw_b2 0.00 1.999969 FUNCTION_LIST BGMSZS BGRLP FUEDK IF_DATA DIM_X DIRECT 0x81BB16 /end CHARACTERISTIC
/begin CHARACTERISTIC PSSOLNGRD "Schwelle negativer pssol-Gradient" VALUE 0x814DD4 KwSw 65535.00 dez -32768.00 32767.00 FUNCTION_LIST BGMSZS IF_DATA DIM_X DIRECT 0x814DD4 /end CHARACTERISTIC
/begin CHARACTERISTIC PSSOLPGRD "Schwelle positiver pssol-Gradient" VALUE 0x814DD6 KwSw 65535.00 dez -32768.00 32767.00 FUNCTION_LIST BGMSZS IF_DATA DIM_X DIRECT 0x814DD6 /end CHARACTERISTIC
/begin CHARACTERISTIC PUE "Ersatzwert für Umgebungsdruck" VALUE 0x81BDE8 KwUw 2559.961 p_uw_q0p039 0.00 2559.961 FUNCTION_LIST GGDSAS IF_DATA DIM_X DIRECT 0x81BDE8 /end CHARACTERISTIC
/begin CHARACTERISTIC PUELSU "Ersatzwert für Umgebungsdruck" VALUE 0x81B946 KwUw 2559.961 p_uw_q0p039 0.00 2559.961 FUNCTION_LIST GGLSU IF_DATA DIM_X DIRECT 0x81B946 /end CHARACTERISTIC
/begin CHARACTERISTIC PUMN "Umgebungsdruckbegrenzung minimal" VALUE 0x81BDEA KwUw 2559.961 p_uw_q0p039 0.00 2559.961 FUNCTION_LIST GGDSAS IF_DATA DIM_X DIRECT 0x81BDEA /end CHARACTERISTIC
/begin CHARACTERISTIC PUMX "Umgebungsdruckbegrenzung maximal" VALUE 0x81BDEC KwUw 2559.961 p_uw_q0p039 0.00 2559.961 FUNCTION_LIST GGDSAS IF_DATA DIM_X DIRECT 0x81BDEC /end CHARACTERISTIC
/begin CHARACTERISTIC PUSPSMX "max. Abweichung von Umgebungsdruck und Saugrohrdruck" VALUE 0x81BDEE KwUw 2559.961 p_uw_q0p039 0.00 2559.961 FUNCTION_LIST GGDSAS IF_DATA DIM_X DIRECT 0x81BDEE /end CHARACTERISTIC
/begin CHARACTERISTIC PVDKMN "pvdk min. Schwelle für Fehlererkennung Ladedrucksensor" VALUE 0x81BDF0 KwUw 2559.961 p_uw_q0p039 0.00 2559.961 FUNCTION_LIST GGDSAS IF_DATA DIM_X DIRECT 0x81BDF0 /end CHARACTERISTIC
/begin CHARACTERISTIC PVDKMX "Ladedruckgrenze für Diagnose max. Fehler" CURVE 0x81BDF2 KlAUwSstUwWUw 2559.961 p_uw_q0p039 0.00 2559.961 FUNCTION_LIST GGDSAS IF_DATA DIM_X DIRECT 0x81BDF2
 /begin AXIS_DESCR STD_AXIS nmot_w nmot_uw_q0p25 4 0.00 16383.75 DEPOSIT ABSOLUT /end AXIS_DESCR
/end CHARACTERISTIC
/begin CHARACTERISTIC PVDKPSMX "max. Abweichung von Saugrohrdruck und Druck vor Drosselklappe" VALUE 0x81BE04 KwUw 2559.961 p_uw_q0p039 0.00 2559.961 FUNCTION_LIST GGDSAS IF_DATA DIM_X DIRECT 0x81BE04 /end CHARACTERISTIC
/begin CHARACTERISTIC PVDKPUD "Schwelle unterhalb welcher die Diff. zw. pvdkds und pu als 0 ausgegeben wird" VALUE 0x8184E1 KwUb 2550. p_ub_q10 0.00 2550. FUNCTION_LIST GGDSAS IF_DATA DIM_X DIRECT 0x8184E1 /end CHARACTERISTIC
/begin CHARACTERISTIC PVDN "LLR: P-Verstärkung bei stehendem Fahrzeug" CURVE 0x811628 GklWUb 0.3891 fak_q0p00153 0.00 0.3891 FUNCTION_LIST LLRRM IF_DATA DIM_X DIRECT 0x811628
 /begin AXIS_DESCR COM_AXIS dn nmotd_sb_q10 6 -1280. 1270. AXIS_PTS_REF SDN06LLSB /end AXIS_DESCR
/end CHARACTERISTIC
/begin CHARACTERISTIC PVDNV "LLR: P-Verstärkung bei rollendem Fahrzeug" CURVE 0x81162E GklWUb 0.3891 fak_q0p00153 0.00 0.3891 FUNCTION_LIST LLRRM IF_DATA DIM_X DIRECT 0x81162E
 /begin AXIS_DESCR COM_AXIS dn nmotd_sb_q10 6 -1280. 1270. AXIS_PTS_REF SDN06LLSB /end AXIS_DESCR
/end CHARACTERISTIC
/begin CHARACTERISTIC PVLDN "LLR: P-Verstärkung bei stehendem Fahrzeug (Luftanteil)" CURVE 0x811634 GklWUb 0.3891 fak_q0p00153 0.00 0.3891 FUNCTION_LIST LLRRM IF_DATA DIM_X DIRECT 0x811634
 /begin AXIS_DESCR COM_AXIS dn nmotd_sb_q10 6 -1280. 1270. AXIS_PTS_REF SDN06LLSB /end AXIS_DESCR
/end CHARACTERISTIC
/begin CHARACTERISTIC PVLDNV "LLR: P-Verstärkung bei stehendem Fahrzeug (Luftanteil)" CURVE 0x81163A GklWUb 0.3891 fak_q0p00153 0.00 0.3891 FUNCTION_LIST LLRRM IF_DATA DIM_X DIRECT 0x81163A
 /begin AXIS_DESCR COM_AXIS dn nmotd_sb_q10 6 -1280. 1270. AXIS_PTS_REF SDN06LLSB /end AXIS_DESCR
/end CHARACTERISTIC
/begin CHARACTERISTIC PZWKRA "Prozentuale Häufigkeit der ZW-Ausgabe durch die KR während Dynamikadaption" VALUE 0x811491 KwUb 99.61 rel_ub_b99p6 0.00 99.61 FUNCTION_LIST KRDY IF_DATA DIM_X DIRECT 0x811491 /end CHARACTERISTIC
/begin CHARACTERISTIC P_ZYL "Abstand zur Bestimmung des arithmet Mittelwertes - DMDLU" VALUE 0x810809 KwUb 7.000 dez 0.00 7.000 FUNCTION_LIST DMDLU IF_DATA DIM_X DIRECT 0x810809 /end CHARACTERISTIC
/begin CHARACTERISTIC RALEZMAX "Begrenzung der Anzahl rückwärts drehender Zähne im Auslauf" VALUE 0x810BF9 KwUb 127.0 dez 0.00 127.0 FUNCTION_LIST ALE IF_DATA DIM_X DIRECT 0x810BF9 /end CHARACTERISTIC
/begin CHARACTERISTIC RBEL "Belastungswiderstand für Pumpstrom-Erzeugung" VALUE 0x813C1C KwUw 131070.0 r_uw_q2 0.00 131070.0 FUNCTION_LIST GGLSH IF_DATA DIM_X DIRECT 0x813C1C /end CHARACTERISTIC
/begin CHARACTERISTIC REAC_D1_UC "" VAL_BLK 0x811DDC KwbUb 255.0 dez 0.00 255.0 NUMBER 16 FUNCTION_LIST URCEIN IF_DATA DIM_X DIRECT 0x811DDC /end CHARACTERISTIC
/begin CHARACTERISTIC REAC_D2_UC "" VAL_BLK 0x811DEC KwbUb 255.0 dez 0.00 255.0 NUMBER 16 FUNCTION_LIST URCEIN IF_DATA DIM_X DIRECT 0x811DEC /end CHARACTERISTIC
/begin CHARACTERISTIC REAC_T1_UC "Fehlerzeit bei der Funktions-Fehlerreaktionsüberwachung im Befehlstest" VALUE 0x811FE3 KwUb 10200.0 t40ms_ub_b10200 0.00 10200.0 FUNCTION_LIST URCREAC IF_DATA DIM_X DIRECT 0x811FE3 /end CHARACTERISTIC
/begin CHARACTERISTIC REAC_T1_UM "Fehlerzeit bei der Funktions-Fehlerreaktionsüberwachung in der Funktionsüberw." VALUE 0x817F0C KwUb 10200.0 t40ms_ub_b10200 0.00 10200.0 FUNCTION_LIST UFREAC IF_DATA DIM_X DIRECT 0x817F0C /end CHARACTERISTIC
/begin CHARACTERISTIC REAC_T2_UC "Fehlerzeit bei der Funktionsüberwachungs-Fehlerreaktionsüberw. im Befehlstest" VALUE 0x811FE4 KwUb 10200.0 t40ms_ub_b10200 0.00 10200.0 FUNCTION_LIST URCREAC IF_DATA DIM_X DIRECT 0x811FE4 /end CHARACTERISTIC
/begin CHARACTERISTIC REAC_T2_UM "Fehlerzeit bei der Funktionsüberwachungs-Fehlerreaktionsüberwachung" VALUE 0x817F0D KwUb 10200.0 t40ms_ub_b10200 0.00 10200.0 FUNCTION_LIST UFREAC IF_DATA DIM_X DIRECT 0x817F0D /end CHARACTERISTIC
/begin CHARACTERISTIC REDABM "Ev-Abschaltmuster für Momentenreduzierung" MAP 0x8110BA FkfNoShNoOffWUb 255.0 dez 0.00 255.0 FUNCTION_LIST AEVAB IF_DATA DIM_X DIRECT 0x8110BA /begin AXIS_DESCR FIX_AXIS evrbgn_one dez 8 0.00 7.000 FIX_AXIS_PAR 0 0 8 /end AXIS_DESCR /begin AXIS_DESCR FIX_AXIS redsol_one dez 6 0.00 5.000 FIX_AXIS_PAR 0 0 6 /end AXIS_DESCR /end CHARACTERISTIC
/begin CHARACTERISTIC REDHYOC "Hysterese der Reduzierstufe bei größerer Soll-Reduzierstufe als Ist-Wert" VALUE 0x811B51 KwSb 5.100 rel_sb_q0p02 -2.560 2.540 FUNCTION_LIST MDRED1 IF_DATA DIM_X DIRECT 0x811B51 /end CHARACTERISTIC
/begin CHARACTERISTIC REDHYUC "Hysterese der Reduzierstufe bei kleinerer Soll-Reduzierstufe als Ist-Wert" VALUE 0x811B52 KwSb 5.100 rel_sb_q0p02 -2.560 2.540 FUNCTION_LIST MDRED1 IF_DATA DIM_X DIRECT 0x811B52 /end CHARACTERISTIC
/begin CHARACTERISTIC REDZEM "Schwelle zwischen Zündeingriff und Einspritzausblendung" CURVE 0x81980A KlAUbSstUbWUb 255.0 dez 0.00 255.0 FUNCTION_LIST MDRED1 IF_DATA DIM_X DIRECT 0x81980A
 /begin AXIS_DESCR STD_AXIS tmot temp_ub_q0p75_o48 5 -48.00 143.3 DEPOSIT ABSOLUT /end AXIS_DESCR
/end CHARACTERISTIC
/begin CHARACTERISTIC REFINI "Startwert Referenzpegel bei Klopfregelung aktiv" VALUE 0x81149C KwUb 0.7227 spg_ub_b5 0.2930 1.016 FUNCTION_LIST KRKE IF_DATA DIM_X DIRECT 0x81149C /end CHARACTERISTIC
/begin CHARACTERISTIC RESETMAX "" VALUE 0x8198CF KwUb 1.000 dez 0.00 1.000 FUNCTION_LIST RUNTIME IF_DATA DIM_X DIRECT 0x8198CF /end CHARACTERISTIC
/begin CHARACTERISTIC RFLAGS_D_UC "" VAL_BLK 0x811DFC KwbUb 255.0 dez 0.00 255.0 NUMBER 16 FUNCTION_LIST URCEIN IF_DATA DIM_X DIRECT 0x811DFC /end CHARACTERISTIC
/begin CHARACTERISTIC RINHMX "Innenwiderstand Ri der Nernstsonde hinter KAT auf Maximalwert begrenzen" VALUE 0x813C1E KwUw 131070.0 r_uw_q2 0.00 131070.0 FUNCTION_LIST GGLSH IF_DATA DIM_X DIRECT 0x813C1E /end CHARACTERISTIC
/begin CHARACTERISTIC RISIGRESH "Schwelle für Reset Signalunterbrechung mit Ri-Diagnose hinter KAT" VALUE 0x81B8DE KwUw 131070.0 r_uw_q2 0.00 131070.0 FUNCTION_LIST DLSH IF_DATA DIM_X DIRECT 0x81B8DE /end CHARACTERISTIC
/begin CHARACTERISTIC RKADTEVO "obere rka Schwelle für passive Einschaltbedingungen Diagnose TEV" VALUE 0x81E31C KwSw 9.984375 rel_sw_b1536 0.00 9.984375 FUNCTION_LIST DTEV IF_DATA DIM_X DIRECT 0x81E31C /end CHARACTERISTIC
/begin CHARACTERISTIC RKADTEVU "untere rka Schwelle für passive Einschaltbedingungen Diagnose TEV" VALUE 0x81E31E KwSw 9.984375 rel_sw_b1536 -9.984375 0.00 FUNCTION_LIST DTEV IF_DATA DIM_X DIRECT 0x81E31E /end CHARACTERISTIC
/begin CHARACTERISTIC RKAE "Delta rkat- bzw. rkaz-Schwelle für Erkennung der eingeschwungenen Grundadaption" VALUE 0x81C7A0 KwSw 3071.953 rel_sw_b1536 -1536.000 1535.953 FUNCTION_LIST DKVS IF_DATA DIM_X DIRECT 0x81C7A0 /end CHARACTERISTIC
/begin CHARACTERISTIC RKATDN "untere Diagnoseschwelle additive Korrektur pro Zeit" VALUE 0x81C7A2 KwSw 3071.953 rel_sw_b1536 -1536.000 1535.953 FUNCTION_LIST DKVS IF_DATA DIM_X DIRECT 0x81C7A2 /end CHARACTERISTIC
/begin CHARACTERISTIC RKATDX "obere Diagnoseschwelle additive Korrektur pro Zeit" VALUE 0x81C7A4 KwSw 3071.953 rel_sw_b1536 -1536.000 1535.953 FUNCTION_LIST DKVS IF_DATA DIM_X DIRECT 0x81C7A4 /end CHARACTERISTIC
/begin CHARACTERISTIC RKATMN "untere Schwelle additive Korrektur pro Zeit" VALUE 0x81C9A4 KwSw 3071.953 rel_sw_b1536 -1536.000 1535.953 FUNCTION_LIST LRA IF_DATA DIM_X DIRECT 0x81C9A4 /end CHARACTERISTIC
/begin CHARACTERISTIC RKATMX "obere Schwelle additive Korrektur pro Zeit" VALUE 0x81C9A6 KwSw 3071.953 rel_sw_b1536 -1536.000 1535.953 FUNCTION_LIST LRA IF_DATA DIM_X DIRECT 0x81C9A6 /end CHARACTERISTIC
/begin CHARACTERISTIC RKATRN "reduzierte untere Schwelle additive Korrektur pro Zeit" VALUE 0x81C9A8 KwSw 3071.953 rel_sw_b1536 -1536.000 1535.953 FUNCTION_LIST LRA IF_DATA DIM_X DIRECT 0x81C9A8 /end CHARACTERISTIC
/begin CHARACTERISTIC RKATRX "reduzierte obere Schwelle additive Korrektur pro Zeit" VALUE 0x81C9AA KwSw 3071.953 rel_sw_b1536 -1536.000 1535.953 FUNCTION_LIST LRA IF_DATA DIM_X DIRECT 0x81C9AA /end CHARACTERISTIC
/begin CHARACTERISTIC RKAZDN "untere Diagnoseschwelle additive Korrektur pro Zündung" VALUE 0x81C7A6 KwSw 3071.953 rel_sw_b1536 -1536.000 1535.953 FUNCTION_LIST DKVS IF_DATA DIM_X DIRECT 0x81C7A6 /end CHARACTERISTIC
/begin CHARACTERISTIC RKAZDX "obere Diagnoseschwelle additive Korrektur pro Zündung" VALUE 0x81C7A8 KwSw 3071.953 rel_sw_b1536 -1536.000 1535.953 FUNCTION_LIST DKVS IF_DATA DIM_X DIRECT 0x81C7A8 /end CHARACTERISTIC
/begin CHARACTERISTIC RKAZMN "untere Schwelle additive Korrektur pro Zündung" VALUE 0x81C9AC KwSw 3071.953 rel_sw_b1536 -1536.000 1535.953 FUNCTION_LIST LRA IF_DATA DIM_X DIRECT 0x81C9AC /end CHARACTERISTIC
/begin CHARACTERISTIC RKAZMX "obere Schwelle additive Korrektur pro Zündung" VALUE 0x81C9AE KwSw 3071.953 rel_sw_b1536 -1536.000 1535.953 FUNCTION_LIST LRA IF_DATA DIM_X DIRECT 0x81C9AE /end CHARACTERISTIC
/begin CHARACTERISTIC RKAZRN "reduzierte untere Schwelle additive Korrektur pro Zündung" VALUE 0x81C9B0 KwSw 3071.953 rel_sw_b1536 -1536.000 1535.953 FUNCTION_LIST LRA IF_DATA DIM_X DIRECT 0x81C9B0 /end CHARACTERISTIC
/begin CHARACTERISTIC RKAZRX "reduzierte obere Schwelle additive Korrektur pro Zündung" VALUE 0x81C9B2 KwSw 3071.953 rel_sw_b1536 -1536.000 1535.953 FUNCTION_LIST LRA IF_DATA DIM_X DIRECT 0x81C9B2 /end CHARACTERISTIC
/begin CHARACTERISTIC RKBAUM "rk-Schwelle für BA-Anzeige" CURVE 0x81C804 GklWSw 6143.813 rel_sw_q0p1875 0.00 6143.813 FUNCTION_LIST ESUK IF_DATA DIM_X DIRECT 0x81C804
 /begin AXIS_DESCR COM_AXIS tmot temp_ub_q0p75_o48 9 -48.00 143.3 AXIS_PTS_REF STM09ESUB /end AXIS_DESCR
/end CHARACTERISTIC
/begin CHARACTERISTIC RKRMX1N "Maximaler Referenzpegel für Klopferkennungsschwelle Zyl.-gruppe 1" CURVE 0x81926B GklWUb 317.5 spg_ub_b320 1.250 318.8 FUNCTION_LIST KRKE IF_DATA DIM_X DIRECT 0x81926B
 /begin AXIS_DESCR COM_AXIS nmot nmot_ub_q40 16 0.00 10200. AXIS_PTS_REF SNM16KRUB /end AXIS_DESCR
/end CHARACTERISTIC
/begin CHARACTERISTIC RKRMX2N "Maximaler Referenzpegel für Klopferkennungsschwelle Zyl.-gruppe 2" CURVE 0x81927B GklWUb 317.5 spg_ub_b320 1.250 318.8 FUNCTION_LIST KRKE IF_DATA DIM_X DIRECT 0x81927B
 /begin AXIS_DESCR COM_AXIS nmot nmot_ub_q40 16 0.00 10200. AXIS_PTS_REF SNM16KRUB /end AXIS_DESCR
/end CHARACTERISTIC
/begin CHARACTERISTIC RKSP "Widerstand zwischen kongurierende Spannung und Sondensignal" VALUE 0x813C20 KwUw 131070.0 r_uw_q2 0.00 131070.0 FUNCTION_LIST GGLSH IF_DATA DIM_X DIRECT 0x813C20 /end CHARACTERISTIC
/begin CHARACTERISTIC RKUKKLU "Schwelle Summe Kurz-/Langzeitanteil" VALUE 0x8156D4 KwSw 12287.81 rel_sw_q0p1875 -6144.000 6143.813 FUNCTION_LIST ESUK IF_DATA DIM_X DIRECT 0x8156D4 /end CHARACTERISTIC
/begin CHARACTERISTIC RKUKKTU "Schwelle für Erkennung ÜK-Aktivität (Kurzzeitanteil)" VALUE 0x813FDE KwSw 12287.81 rel_sw_q0p1875 -6144.000 6143.813 FUNCTION_LIST ESUKAS IF_DATA DIM_X DIRECT 0x813FDE /end CHARACTERISTIC
/begin CHARACTERISTIC RKVAUM "rk-Schwelle für VA-Anzeige" CURVE 0x81C816 GklWSw 6144.000 rel_sw_q0p1875 -6144.000 0.00 FUNCTION_LIST ESUK IF_DATA DIM_X DIRECT 0x81C816
 /begin AXIS_DESCR COM_AXIS tmot temp_ub_q0p75_o48 9 -48.00 143.3 AXIS_PTS_REF STM09ESUB /end AXIS_DESCR
/end CHARACTERISTIC
/begin CHARACTERISTIC RL1DVSO "Diagnoseschwelle: Obere Last bei Ventilhub klein" VALUE 0x8122FD KwUb 191.3 rel_ub_q0p75 0.00 191.3 FUNCTION_LIST DVS IF_DATA DIM_X DIRECT 0x8122FD /end CHARACTERISTIC
/begin CHARACTERISTIC RL1DVSU "Diagnoseschwelle: Untere Last bei Ventilhub klein" VALUE 0x8122FE KwUb 191.3 rel_ub_q0p75 0.00 191.3 FUNCTION_LIST DVS IF_DATA DIM_X DIRECT 0x8122FE /end CHARACTERISTIC
/begin CHARACTERISTIC RL2DVSO "Diagnoseschwelle: Obere Last bei Ventilhub groß" VALUE 0x8122FF KwUb 191.3 rel_ub_q0p75 0.00 191.3 FUNCTION_LIST DVS IF_DATA DIM_X DIRECT 0x8122FF /end CHARACTERISTIC
/begin CHARACTERISTIC RL2DVSU "Diagnoseschwelle: Untere Last bei Ventilhub groß" VALUE 0x812300 KwUb 191.3 rel_ub_q0p75 0.00 191.3 FUNCTION_LIST DVS IF_DATA DIM_X DIRECT 0x812300 /end CHARACTERISTIC
/begin CHARACTERISTIC RLC_T_UM "Fehlertoleranzzeit für den rl-Vergleich mit der Funktion in der Funktionsüberw." VALUE 0x817D69 KwUb 10200.0 t40ms_ub_b10200 0.00 10200.0 FUNCTION_LIST UFRLC IF_DATA DIM_X DIRECT 0x817D69 /end CHARACTERISTIC
/begin CHARACTERISTIC RLDKTOT "Obere Lastgrenze für Funktionsanforderung" VALUE 0x8183D0 KwUb 191.3 rel_ub_q0p75 0.00 191.3 FUNCTION_LIST DKATLRS T2DFA T2LID IF_DATA DIM_X DIRECT 0x8183D0 /end CHARACTERISTIC
/begin CHARACTERISTIC RLDKTSO "Obere Lastkennlinie für DKAT-aktiv" CURVE 0x8183D1 GklWUb 191.3 rel_ub_q0p75 0.00 191.3 FUNCTION_LIST DKATLRS IF_DATA DIM_X DIRECT 0x8183D1
 /begin AXIS_DESCR COM_AXIS nmot nmot_ub_q40 5 0.00 10200. AXIS_PTS_REF SNM05DKUB /end AXIS_DESCR
/end CHARACTERISTIC
/begin CHARACTERISTIC RLDKTSU "Untere Lastkennlinie für DKAT-aktiv" CURVE 0x8183D6 GklWUb 191.3 rel_ub_q0p75 0.00 191.3 FUNCTION_LIST DKATLRS IF_DATA DIM_X DIRECT 0x8183D6
 /begin AXIS_DESCR COM_AXIS nmot nmot_ub_q40 5 0.00 10200. AXIS_PTS_REF SNM05DKUB /end AXIS_DESCR
/end CHARACTERISTIC
/begin CHARACTERISTIC RLDKTUT "Untere Lastgrenze für Funktionsanforderung" VALUE 0x8183DB KwUb 191.3 rel_ub_q0p75 0.00 191.3 FUNCTION_LIST DKATLRS T2DFA T2LID IF_DATA DIM_X DIRECT 0x8183DB /end CHARACTERISTIC
/begin CHARACTERISTIC RLDLLR "Füllungsschwelle für Diagnose LLR" VALUE 0x8196E2 KwUb 99.75 rel_ub_q0p75 0.00 99.75 FUNCTION_LIST DLLR IF_DATA DIM_X DIRECT 0x8196E2 /end CHARACTERISTIC
/begin CHARACTERISTIC RLDYNFA "Lastschwelle für Dynamikprüfung LSU bei Kurztest" VALUE 0x818402 KwUb 191.3 rel_ub_q0p75 0.00 191.3 FUNCTION_LIST DLSU T2DFA T2LID IF_DATA DIM_X DIRECT 0x818402 /end CHARACTERISTIC
/begin CHARACTERISTIC RLDYNO "obere Lastschwelle für Dynamikprüfung LSU" VALUE 0x818403 KwUb 191.3 rel_ub_q0p75 0.00 191.3 FUNCTION_LIST DLSU IF_DATA DIM_X DIRECT 0x818403 /end CHARACTERISTIC
/begin CHARACTERISTIC RLDYNU "untere Lastschwelle für Dynamikprüfung LSU" VALUE 0x818404 KwUb 191.3 rel_ub_q0p75 0.00 191.3 FUNCTION_LIST DLSU IF_DATA DIM_X DIRECT 0x818404 /end CHARACTERISTIC
/begin CHARACTERISTIC RLIPFIL_UM "Filter-Zeitkonstante für verzögerte Lastinfo rlipt_um in d. Funktionsüberwachung" VALUE 0x817D6A KwUb 10159.4 zk40ms_ub_b10200 40.6299 10200.0 FUNCTION_LIST UFRLC IF_DATA DIM_X DIRECT 0x817D6A /end CHARACTERISTIC
/begin CHARACTERISTIC RLIPTV_UM "Verzugszeit für Lastinformation rlip_um in der Funktionsüberwachung" VALUE 0x817D6B KwUb 320.000 t40ms_ub_b10200 0.00 320.000 FUNCTION_LIST UFRLC IF_DATA DIM_X DIRECT 0x817D6B /end CHARACTERISTIC
/begin CHARACTERISTIC RLIP_T_UM "Fehlertoleranzzeit für den rl/rlip-Vergleich in der Funktionsüberwachg" VALUE 0x817D6C KwUb 10200.0 t40ms_ub_b10200 0.00 10200.0 FUNCTION_LIST UFRLC IF_DATA DIM_X DIRECT 0x817D6C /end CHARACTERISTIC
/begin CHARACTERISTIC RLKRLDA "Rl-Schwelle für langsamen LDR-Eingriff (Adaption)" CURVE 0x8195BD GklWUb 191.3 rel_ub_q0p75 0.00 191.3 FUNCTION_LIST LDRLMX IF_DATA DIM_X DIRECT 0x8195BD
 /begin AXIS_DESCR COM_AXIS nmot nmot_ub_q40 8 0.00 10200. AXIS_PTS_REF SNM08LDUB /end AXIS_DESCR
/end CHARACTERISTIC
/begin CHARACTERISTIC RLLRHON "Kennlinie über nmot, obere rL Regelgrenze für Regler hinter KAT" CURVE 0x81219B GklWUb 191.3 rel_ub_q0p75 0.00 191.3 FUNCTION_LIST LRSHK IF_DATA DIM_X DIRECT 0x81219B
 /begin AXIS_DESCR COM_AXIS nmot nmot_ub_q40 8 0.00 10200. AXIS_PTS_REF SNM08LHUB /end AXIS_DESCR
/end CHARACTERISTIC
/begin CHARACTERISTIC RLLRHUN "Kennlinie über nmot, untere rL Regelgrenze für Regler hinter KAT" CURVE 0x8121A3 GklWUb 191.3 rel_ub_q0p75 0.00 191.3 FUNCTION_LIST LRSHK IF_DATA DIM_X DIRECT 0x8121A3
 /begin AXIS_DESCR COM_AXIS nmot nmot_ub_q40 8 0.00 10200. AXIS_PTS_REF SNM08LHUB /end AXIS_DESCR
/end CHARACTERISTIC
/begin CHARACTERISTIC RLLRSHB "relative Lastschwelle, Abschalten LR bei SLS, in Verbindung mit LL und NLRSHB" VALUE 0x812113 KwUb 191.3 rel_ub_q0p75 0.00 191.3 FUNCTION_LIST LRSEB IF_DATA DIM_X DIRECT 0x812113 /end CHARACTERISTIC
/begin CHARACTERISTIC RLLRUN "Kennlinie über nmot, untere rL Regelgrenze für Regler vor KAT" CURVE 0x812114 KlAUbSstUbWUb 191.3 rel_ub_q0p75 0.00 191.3 FUNCTION_LIST LRSEB IF_DATA DIM_X DIRECT 0x812114 /begin AXIS_DESCR STD_AXIS nmot nmot_ub_q40 8 0.00 10200. DEPOSIT ABSOLUT /end AXIS_DESCR /end CHARACTERISTIC
/begin CHARACTERISTIC RLNORM "" VALUE 0x8121C4 KwUb 24.90 fak_ub_q0p09765 0.00 24.90 FUNCTION_LIST SWADP IF_DATA DIM_X DIRECT 0x8121C4 /end CHARACTERISTIC
/begin CHARACTERISTIC RLNOT "Notlauf rl bei E_DK und E_LM" CURVE 0x810F45 KlAUbSstUbWUb 191.3 rel_ub_q0p75 0.00 191.3 FUNCTION_LIST BGMSZS IF_DATA DIM_X DIRECT 0x810F45 /begin AXIS_DESCR STD_AXIS nmot nmot_ub_q40 6 0.00 10200. DEPOSIT ABSOLUT /end AXIS_DESCR /end CHARACTERISTIC
/begin CHARACTERISTIC RLO2 "obere Lastschwelle Bereich 2" VALUE 0x818FA2 KwUb 191.3 rel_ub_q0p75 0.00 191.3 FUNCTION_LIST LRA IF_DATA DIM_X DIRECT 0x818FA2 /end CHARACTERISTIC
/begin CHARACTERISTIC RLO3 "obere rl - Schwelle Bereich 3" VALUE 0x818FA3 KwUb 191.3 rel_ub_q0p75 0.00 191.3 FUNCTION_LIST LRA IF_DATA DIM_X DIRECT 0x818FA3 /end CHARACTERISTIC
/begin CHARACTERISTIC RLPHERKMN "minimale Last für Phasensuche" VALUE 0x810C54 KwUb 191.3 rel_ub_q0p75 0.00 191.3 FUNCTION_LIST NLPH IF_DATA DIM_X DIRECT 0x810C54 /end CHARACTERISTIC
/begin CHARACTERISTIC RLPHERKMX "maximale Last für Phasensuche" VALUE 0x810C55 KwUb 191.3 rel_ub_q0p75 0.00 191.3 FUNCTION_LIST NLPH IF_DATA DIM_X DIRECT 0x810C55 /end CHARACTERISTIC
/begin CHARACTERISTIC RLSALUNG "Lastschwelle zur Schuberkennung für Ausblendung der Aussetzererkennung" MAP 0x810558 GkfWUb 191.3 rel_ub_q0p75 0.00 191.3 FUNCTION_LIST DMDSTP IF_DATA DIM_X DIRECT 0x810558 /begin AXIS_DESCR COM_AXIS gangi dez 8 0.00 255.0 AXIS_PTS_REF SGA08MDUB /end AXIS_DESCR
 /begin AXIS_DESCR COM_AXIS nmot nmot_ub_q40 8 0.00 10200. AXIS_PTS_REF SNM08DMUB /end AXIS_DESCR
/end CHARACTERISTIC
/begin CHARACTERISTIC RLSLSMN "min. rl für Freigabe Regelung während Sekundärluft" CURVE 0x812125 KlAUbSstUbWUb 191.3 rel_ub_q0p75 0.00 191.3 FUNCTION_LIST LRSEB IF_DATA DIM_X DIRECT 0x812125 /begin AXIS_DESCR STD_AXIS nmot nmot_ub_q40 4 0.00 10200. DEPOSIT ABSOLUT /end AXIS_DESCR /end CHARACTERISTIC
/begin CHARACTERISTIC RLSOLAP "Sollfüllung für Applikationszwecke" VALUE 0x81555A KwUw 1535.977 rel_uw_q0p0234 0.00 1535.977 FUNCTION_LIST MDFUE IF_DATA DIM_X DIRECT 0x81555A /end CHARACTERISTIC
/begin CHARACTERISTIC RLTPKTO "obere Lastschwelle für Periodendauer-Kurztest" VALUE 0x8121C5 KwUb 191.3 rel_ub_q0p75 0.00 191.3 FUNCTION_LIST SWADP IF_DATA DIM_X DIRECT 0x8121C5 /end CHARACTERISTIC
/begin CHARACTERISTIC RLTPKTU "untere Lastschwelle für Periodendauer-Kurztest" VALUE 0x8121C6 KwUb 191.3 rel_ub_q0p75 0.00 191.3 FUNCTION_LIST SWADP IF_DATA DIM_X DIRECT 0x8121C6 /end CHARACTERISTIC
/begin CHARACTERISTIC RLU2 "untere rl - Schwelle Bereich 2" VALUE 0x818FA4 KwUb 191.3 rel_ub_q0p75 0.00 191.3 FUNCTION_LIST LRA IF_DATA DIM_X DIRECT 0x818FA4 /end CHARACTERISTIC
/begin CHARACTERISTIC RLU3 "untere rl - Schwelle Bereich 3" VALUE 0x818FA5 KwUb 191.3 rel_ub_q0p75 0.00 191.3 FUNCTION_LIST LRA IF_DATA DIM_X DIRECT 0x818FA5 /end CHARACTERISTIC
/begin CHARACTERISTIC RLU4 "untere rl -Schwelle oberer multiplikativer Bereich" VALUE 0x818FA6 KwUb 191.3 rel_ub_q0p75 0.00 191.3 FUNCTION_LIST LRA IF_DATA DIM_X DIRECT 0x818FA6 /end CHARACTERISTIC
/begin CHARACTERISTIC RLUKAO "obere Lastgrenze für ÜK-Adaption" VALUE 0x811348 KwUb 191.3 rel_ub_q0p75 0.00 191.3 FUNCTION_LIST ESUKAS IF_DATA DIM_X DIRECT 0x811348 /end CHARACTERISTIC
/begin CHARACTERISTIC RLUKAU "untere Lastgrenze für ÜK-Adaption" VALUE 0x811349 KwUb 191.3 rel_ub_q0p75 0.00 191.3 FUNCTION_LIST ESUKAS IF_DATA DIM_X DIRECT 0x811349 /end CHARACTERISTIC
/begin CHARACTERISTIC RL_BO_UM "Offset für Toleranzgerade f(rl_um) für rlipf_um in der Funktionsüberwachung" VALUE 0x817D6D KwUb 191.3 rel_ub_q0p75 0.00 191.3 FUNCTION_LIST UFRLC IF_DATA DIM_X DIRECT 0x817D6D /end CHARACTERISTIC
/begin CHARACTERISTIC RL_DAT_UC "" VAL_BLK 0x811E0C KwbUb 191.3 rel_ub_q0p75 0.00 191.3 NUMBER 16 FUNCTION_LIST URCEIN IF_DATA DIM_X DIRECT 0x811E0C /end CHARACTERISTIC
/begin CHARACTERISTIC RL_MO_UM "Steigung für Toleranzgerade f(rl_um) für rlipf_um in der Funktionsüberwachung" VALUE 0x817D6E KwUb 255.0 dez 0.00 255.0 FUNCTION_LIST UFRLC IF_DATA DIM_X DIRECT 0x817D6E /end CHARACTERISTIC
/begin CHARACTERISTIC RMSLMN "Diagnoseschwelle: verringerte Sekundärluftmasse (Fehlerhaft)" VALUE 0x818104 KwUb 1.992 fak_ub_b2 0.00 1.992 FUNCTION_LIST DSLSLRS IF_DATA DIM_X DIRECT 0x818104 /end CHARACTERISTIC
/begin CHARACTERISTIC RMSLMNK "Diagnoseschwelle Bandendetest: verringerte Sekundärluftmasse" VALUE 0x818105 KwUb 1.992 fak_ub_b2 0.00 1.992 FUNCTION_LIST DSLSLRS IF_DATA DIM_X DIRECT 0x818105 /end CHARACTERISTIC
/begin CHARACTERISTIC RMSLPMN "Diagnoseschwelle: Fehler Sekundärluftpumpe, nur Pulse Air" VALUE 0x818106 KwUb 1.992 fak_ub_b2 0.00 1.992 FUNCTION_LIST DSLSLRS IF_DATA DIM_X DIRECT 0x818106 /end CHARACTERISTIC
/begin CHARACTERISTIC RMSLTMN "Schwelle: sehr geringe Sekundärluftmasse, ohne Offset" VALUE 0x818107 KwUb 1.992 fak_ub_b2 0.00 1.992 FUNCTION_LIST DSLSLRS IF_DATA DIM_X DIRECT 0x818107 /end CHARACTERISTIC
/begin CHARACTERISTIC RMSTEVIO "Schwelle relativer Massenstrom für i.O. Erkennung" VALUE 0x81E320 KwUw 199.9969 rel_uw_b200 0.00 199.9969 FUNCTION_LIST DTEV IF_DATA DIM_X DIRECT 0x81E320 /end CHARACTERISTIC
/begin CHARACTERISTIC RMSTEVMN "Minimalwert relativer Massenstrom TEV" VALUE 0x81E322 KwSw 399.9939 rel_sw_b200 -200.0000 199.9939 FUNCTION_LIST DTEV IF_DATA DIM_X DIRECT 0x81E322 /end CHARACTERISTIC
/begin CHARACTERISTIC RMSTEVMX "Maximalwert relativer Massenstrom TEV" VALUE 0x81E324 KwSw 399.9939 rel_sw_b200 -200.0000 199.9939 FUNCTION_LIST DTEV IF_DATA DIM_X DIRECT 0x81E324 /end CHARACTERISTIC
/begin CHARACTERISTIC ROMRSTA_UM "maximale Anzahl Resets bei Fehlererkennung im ROM-Check in der Initialisierung" VALUE 0x817F17 KwUb 255.0 dez 0.00 255.0 FUNCTION_LIST URROM IF_DATA DIM_X DIRECT 0x817F17 /end CHARACTERISTIC
/begin CHARACTERISTIC RST_TV_UM "Kennung zur Anforderung eines Reset-Tastverhältnisses aus der Funktionsüberwach." VALUE 0x817D00 KwUb 255.0 dez 0.00 255.0 FUNCTION_LIST UFURAM URDELAY IF_DATA DIM_X DIRECT 0x817D00 /end CHARACTERISTIC
/begin CHARACTERISTIC SAFK1 "Filterkonstante 1 für Lambdasonden-Signalausgabe" VALUE 0x81BB12 KwUw 0.9999847 fak_uw_b1 0.00 0.9999847 FUNCTION_LIST DLSSA IF_DATA DIM_X DIRECT 0x81BB12 /end CHARACTERISTIC
/begin CHARACTERISTIC SALUNKH "dmrkh-abh. Nullastfaktoren bei Katheizen" CURVE 0x8102AC KlAUbSstUbWUb 1.992 fak_ub_b2 0.00 1.992 FUNCTION_LIST DMDSTP IF_DATA DIM_X DIRECT 0x8102AC /begin AXIS_DESCR STD_AXIS dmrkh rel_ub_b99p6 4 0.00 99.61 DEPOSIT ABSOLUT /end AXIS_DESCR /end CHARACTERISTIC
/begin CHARACTERISTIC SDLAA "Schwelle delta Lambda für LSU Abgleich" VALUE 0x813D04 KwSw 15.99976 fak_sw_b8 -8.000000 7.999756 FUNCTION_LIST GGLSU IF_DATA DIM_X DIRECT 0x813D04 /end CHARACTERISTIC
/begin CHARACTERISTIC SDLAB "Schwelle delta Lambda für Erkennung Betriebsbereitschaft LSU" VALUE 0x813D06 KwSw 15.99976 fak_sw_b8 -8.000000 7.999756 FUNCTION_LIST GGLSU IF_DATA DIM_X DIRECT 0x813D06 /end CHARACTERISTIC
/begin CHARACTERISTIC SDLAMX "Schwelle delta Lambda max pro Rechentakt" VALUE 0x813C12 KwUw 15.99976 fak_uw_b16 0.00 15.99976 FUNCTION_LIST DLSU IF_DATA DIM_X DIRECT 0x813C12 /end CHARACTERISTIC
/begin CHARACTERISTIC SDLAOF "Schwelle delta Lambda Offset Regler hinter Kat" VALUE 0x81B902 KwSw 1.999969 fak_sw_b1 -1.000000 0.9999695 FUNCTION_LIST DLSU IF_DATA DIM_X DIRECT 0x81B902 /end CHARACTERISTIC
/begin CHARACTERISTIC SDLDRAH "rl-Schwelle fuer DLDR zum Heilen von LDRA im i.O. Fall" VALUE 0x8193F0 KwUb 191.3 rel_ub_q0p75 0.00 191.3 FUNCTION_LIST DLDR IF_DATA DIM_X DIRECT 0x8193F0 /end CHARACTERISTIC
/begin CHARACTERISTIC SDLDRAS "rl-Schwelle fuer DLDR zum Setzen von LDRA im Fehlerfall" VALUE 0x8193F1 KwUb 191.3 rel_ub_q0p75 0.00 191.3 FUNCTION_LIST DLDR IF_DATA DIM_X DIRECT 0x8193F1 /end CHARACTERISTIC
/begin CHARACTERISTIC SDLDRL "Mindestfuellung LDR fuer DIA LDR maximal zulaessiger Druck" VALUE 0x8193F2 KwUb 191.3 rel_ub_q0p75 0.00 191.3 FUNCTION_LIST DLDR IF_DATA DIM_X DIRECT 0x8193F2 /end CHARACTERISTIC
/begin CHARACTERISTIC SDLDSUA "Schwelle für dynamische Schubumluftventilsteuerung aktiv" CURVE 0x8114B0 FklWUb 2550. p_ub_q10 0.00 2550. FUNCTION_LIST LDUVST IF_DATA DIM_X DIRECT 0x8114B0 /begin AXIS_DESCR FIX_AXIS plsol p_ub_q10 16 0.00 2550. FIX_AXIS_PAR 0 4 16 /end AXIS_DESCR /end CHARACTERISTIC
/begin AXIS_PTS SDN06LLSB "Stützstellenvert. Drehzahldifferenz, 10 Sst., LL-Reg." 0x811640 dn SstAUbSstSb 2550. nmotd_sb_q10 6 -1280. 1270. FUNCTION_LIST LLRRM DEPOSIT ABSOLUT IF_DATA DIM_X DIRECT 0x811640 /end AXIS_PTS
/begin AXIS_PTS SDZ08DMUB "SST-Verteilung in DMD, 8 Drehzahl-SST" 0x81029A nmot SstAUbSstUb 10200. nmot_ub_q40 8 0.00 10200. FUNCTION_LIST DMDFON DEPOSIT ABSOLUT IF_DATA DIM_X DIRECT 0x81029A /end AXIS_PTS
/begin AXIS_PTS SDZ08DMUB2 "SST-Verteilung in DMD, 8 Drehzahl-SST" 0x8102A3 nmot SstAUbSstUb 10200. nmot_ub_q40 8 0.00 10200. FUNCTION_LIST DMDFON DEPOSIT ABSOLUT IF_DATA DIM_X DIRECT 0x8102A3 /end AXIS_PTS
/begin CHARACTERISTIC SENZZYL0 "Klopfsensor für SW-Zylinderzähler 0" VALUE 0x8191BF KwUb 3.000 dezsub1 1.000 4.000 FUNCTION_LIST GGKS IF_DATA DIM_X DIRECT 0x8191BF /end CHARACTERISTIC
/begin CHARACTERISTIC SENZZYL1 "Klopfsensor für SW-Zylinderzähler 1" VALUE 0x8191C0 KwUb 3.000 dezsub1 1.000 4.000 FUNCTION_LIST GGKS IF_DATA DIM_X DIRECT 0x8191C0 /end CHARACTERISTIC
/begin CHARACTERISTIC SENZZYL2 "Klopfsensor für SW-Zylinderzähler 2" VALUE 0x8191C1 KwUb 3.000 dezsub1 1.000 4.000 FUNCTION_LIST GGKS IF_DATA DIM_X DIRECT 0x8191C1 /end CHARACTERISTIC
/begin CHARACTERISTIC SENZZYL3 "Klopfsensor für SW-Zylinderzähler 3" VALUE 0x8191C2 KwUb 3.000 dezsub1 1.000 4.000 FUNCTION_LIST GGKS IF_DATA DIM_X DIRECT 0x8191C2 /end CHARACTERISTIC
/begin CHARACTERISTIC SENZZYL4 "Klopfsensor für SW-Zylinderzähler 4" VALUE 0x8191C3 KwUb 3.000 dezsub1 1.000 4.000 FUNCTION_LIST GGKS IF_DATA DIM_X DIRECT 0x8191C3 /end CHARACTERISTIC
/begin CHARACTERISTIC SENZZYL5 "Klopfsensor für SW-Zylinderzähler 5" VALUE 0x8191C4 KwUb 3.000 dezsub1 1.000 4.000 FUNCTION_LIST GGKS IF_DATA DIM_X DIRECT 0x8191C4 /end CHARACTERISTIC
/begin CHARACTERISTIC SENZZYL6 "Klopfsensor für SW-Zylinderzähler 6" VALUE 0x8191C5 KwUb 3.000 dezsub1 1.000 4.000 FUNCTION_LIST GGKS IF_DATA DIM_X DIRECT 0x8191C5 /end CHARACTERISTIC
/begin CHARACTERISTIC SENZZYL7 "Klopfsensor für SW-Zylinderzähler 7" VALUE 0x8191C6 KwUb 3.000 dezsub1 1.000 4.000 FUNCTION_LIST GGKS IF_DATA DIM_X DIRECT 0x8191C6 /end CHARACTERISTIC
/begin CHARACTERISTIC SFLAGS_D_UC "" VAL_BLK 0x811E1C KwbUb 255.0 dez 0.00 255.0 NUMBER 16 FUNCTION_LIST URCEIN IF_DATA DIM_X DIRECT 0x811E1C /end CHARACTERISTIC
/begin CHARACTERISTIC SFONTM "Schwellwert tmot für fuel-on Adaption aktiv" VALUE 0x810280 KwUb 191.3 temp_ub_q0p75_o48 -48.00 143.3 FUNCTION_LIST DMDFON IF_DATA DIM_X DIRECT 0x810280 /end CHARACTERISTIC
/begin AXIS_PTS SGA08MDUB "Stützstellenverteilung Ist Gang 8 Sst." 0x810058 gangi SstAUbSstUb 255.0 dez 8 0.00 255.0 FUNCTION_LIST SSTBER87 DMDSTP MDFAW NMAXMD DEPOSIT ABSOLUT IF_DATA DIM_X DIRECT 0x810058 /end AXIS_PTS
/begin CHARACTERISTIC SGIDK1_DAT "Diagnose-Nummer" ASCII 0x81FC82 KwbUb 255.0 KennText 0.00 255.0 NUMBER 4 FUNCTION_LIST ZIF IF_DATA DIM_X DIRECT 0x81FC82 /end CHARACTERISTIC
/begin CHARACTERISTIC SGIDK2_DAT "Teilenummer f. programmiertes Steuergerät" ASCII 0x81FC76 KwbUb 255.0 KennText 0.00 255.0 NUMBER 11 FUNCTION_LIST ZIF TC9MOD IF_DATA DIM_X DIRECT 0x81FC76 /end CHARACTERISTIC
/begin CHARACTERISTIC SKA_DRHZ_UC "" VALUE 0x811FE5 KwUb 10200. nmot_ub_q40 0.00 10200. FUNCTION_LIST URCREAC IF_DATA DIM_X DIRECT 0x811FE5 /end CHARACTERISTIC
/begin CHARACTERISTIC SKA_DRHZ_UM "" VALUE 0x817F0E KwUb 10200. nmot_ub_q40 0.00 10200. FUNCTION_LIST UFREAC IF_DATA DIM_X DIRECT 0x817F0E /end CHARACTERISTIC
/begin CHARACTERISTIC SLFOO2N "Obere Schwelle (Schwellwert-KL) für Lernfilterwert bei fuel-on/-off Adaption" CURVE 0x810281 GklWUb 0.9338 dtsegn_b720divZyl 0.00 0.9338 FUNCTION_LIST DMDFON IF_DATA DIM_X DIRECT 0x810281
 /begin AXIS_DESCR COM_AXIS nmot nmot_ub_q40 8 0.00 10200. AXIS_PTS_REF SDZ08DMUB2 /end AXIS_DESCR
/end CHARACTERISTIC
/begin CHARACTERISTIC SLFOON "Obere Schwelle (Schwellwert-KL) für Lernfilterwert bei fuel-on/-off Adaption" CURVE 0x810289 GklWUb 0.9338 dtsegn_b720divZyl 0.00 0.9338 FUNCTION_LIST DMDFON IF_DATA DIM_X DIRECT 0x810289
 /begin AXIS_DESCR COM_AXIS nmot nmot_ub_q40 8 0.00 10200. AXIS_PTS_REF SDZ08DMUB /end AXIS_DESCR
/end CHARACTERISTIC
/begin CHARACTERISTIC SLFOU "Untere Schwelle für Lernfilterwert bei fuel-on/-off Adaption" VALUE 0x813852 KwSw 119.9963 dtsegn_b720divZyl 0.00 119.9963 FUNCTION_LIST DMDFON IF_DATA DIM_X DIRECT 0x813852 /end CHARACTERISTIC
/begin CHARACTERISTIC SMLDYN "Luftmassenschwelle für Sondendynamik hinter KAT" VALUE 0x81B8CE KwUw 182.0417 m_q0p00277 0.00 182.0417 FUNCTION_LIST DLSAHK IF_DATA DIM_X DIRECT 0x81B8CE /end CHARACTERISTIC
/begin AXIS_PTS SNM05DKUB "Stützstellenvert. nmot" 0x81007A nmot SstAUbSstUb 10200. nmot_ub_q40 5 0.00 10200. FUNCTION_LIST SSTBER87 DKATLRS DEPOSIT ABSOLUT IF_DATA DIM_X DIRECT 0x81007A /end AXIS_PTS
/begin AXIS_PTS SNM08DMUB "SST-Verteilung in DMD, 8 Drehzahl-SST" 0x810097 nmot SstAUbSstUb 10200. nmot_ub_q40 8 0.00 10200. FUNCTION_LIST SSTBER87 DMDDLU DMDDVS DMDLU DMDLUA DMDMIL DMDSTP DEPOSIT ABSOLUT IF_DATA DIM_X DIRECT 0x810097 /end AXIS_PTS
/begin AXIS_PTS SNM08FEUB "Stützstellenverteilung Drehzahl, 08 Sst., Füllungseingriffe" 0x8100A0 nmot SstAUbSstUb 10200. nmot_ub_q40 8 0.00 10200. FUNCTION_LIST SSTBER87 FUEREG DEPOSIT ABSOLUT IF_DATA DIM_X DIRECT 0x8100A0 /end AXIS_PTS
/begin AXIS_PTS SNM08GKUB "Stützstellenverteilung Gemischkontrolle 8 nmot Stützstellen" 0x818BE2 nmot SstAUbSstUb 10200. nmot_ub_q40 8 0.00 10200. FUNCTION_LIST ESVW DEPOSIT ABSOLUT IF_DATA DIM_X DIRECT 0x818BE2 /end AXIS_PTS
/begin AXIS_PTS SNM08KOUB "Stützstellenverteilung für Klimakompressorsteuerung  8  nmot" 0x812B89 nmot SstAUbSstUb 10200. nmot_ub_q40 8 0.00 10200. FUNCTION_LIST KOS DEPOSIT ABSOLUT IF_DATA DIM_X DIRECT 0x812B89 /end AXIS_PTS
/begin AXIS_PTS SNM08LDUB "Stützstellenverteilung für Ladedruckregelung" 0x8100A9 nmot SstAUbSstUb 10200. nmot_ub_q40 8 0.00 10200. FUNCTION_LIST SSTBER87 LDOB LDRLMX LDRPID DEPOSIT ABSOLUT IF_DATA DIM_X DIRECT 0x8100A9 /end AXIS_PTS
/begin AXIS_PTS SNM08LDUW "Stützstellenverteilung für Ladedruckregelung" 0x81360C nmot_w SstAUwSstUw 16383.75 nmot_uw_q0p25 8 0.00 16383.75 FUNCTION_LIST SSTBER87 LDRLMX LDRPID DEPOSIT ABSOLUT IF_DATA DIM_X DIRECT 0x81360C /end AXIS_PTS
/begin AXIS_PTS SNM08LHUB "nmot abhängige Stützstellen (Anzahl 8)" 0x81803A nmot SstAUbSstUb 10200. nmot_ub_q40 8 0.00 10200. FUNCTION_LIST SSTBER87 LRSHK DEPOSIT ABSOLUT IF_DATA DIM_X DIRECT 0x81803A /end AXIS_PTS
/begin AXIS_PTS SNM16KRUB "Stützstellenverteilung Drehzahl, 16 Sst." 0x81806C nmot SstAUbSstUb 10200. nmot_ub_q40 16 0.00 10200. FUNCTION_LIST SSTBER87 DKRS GGKS KRDY KRKE KRRA DEPOSIT ABSOLUT IF_DATA DIM_X DIRECT 0x81806C /end AXIS_PTS
/begin AXIS_PTS SNM16LDUB "Stützstellenverteilung für Ladedruckregelung" 0x810105 nmot SstAUbSstUb 10200. nmot_ub_q40 16 0.00 10200. FUNCTION_LIST SSTBER87 LDRPID DEPOSIT ABSOLUT IF_DATA DIM_X DIRECT 0x810105 /end AXIS_PTS
/begin AXIS_PTS SNS206LLSB "" 0x811647 dns SstAUbSstSb 2550. nmotd_sb_q10 6 -1280. 1270. FUNCTION_LIST LLRRM DEPOSIT ABSOLUT IF_DATA DIM_X DIRECT 0x811647 /end AXIS_PTS
/begin CHARACTERISTIC SP12LL_UM "maximale Differenz zwischen SP1S und SP2S unterhalb der Vollgas-Schwelle" VALUE 0x817D6F KwUb 4.9805 spg_ub_q0p019 0.00 4.9805 FUNCTION_LIST UFSPSC IF_DATA DIM_X DIRECT 0x817D6F /end CHARACTERISTIC
/begin CHARACTERISTIC SP12VG_UM "maximale Differenz zwischen SP1S und SP2S oberhalb der Vollgas-Schwelle" VALUE 0x817D70 KwUb 4.9805 spg_ub_q0p019 0.00 4.9805 FUNCTION_LIST UFSPSC IF_DATA DIM_X DIRECT 0x817D70 /end CHARACTERISTIC
/begin CHARACTERISTIC SP1ADC_DIF "max. Diff. zw. Sollwertpoti1 & Sollwertpoti1 vom Überw.Modul im stationären Fall" VALUE 0x817F10 KwUb 4.9805 spg_ub_q0p019 0.00 4.9805 FUNCTION_LIST URADCC IF_DATA DIM_X DIRECT 0x817F10 /end CHARACTERISTIC
/begin CHARACTERISTIC SP1_STAT "Bandbreite für die Erkennung auf sp1s stationär" VALUE 0x817F11 KwUb 4.9805 spg_ub_q0p019 0.00 4.9805 FUNCTION_LIST URADCC IF_DATA DIM_X DIRECT 0x817F11 /end CHARACTERISTIC
/begin CHARACTERISTIC SP1_STAT_T "Zeit für die Erkennung auf sp1s stationär" VALUE 0x817F12 KwUb 2.550 t10msxs_ub_b2p55 0.00 2.550 FUNCTION_LIST URADCC IF_DATA DIM_X DIRECT 0x817F12 /end CHARACTERISTIC
/begin CHARACTERISTIC SPSC_MIN_UM "" VALUE 0x817D71 KwUb 4.9805 spg_ub_q0p019 0.00 4.9805 FUNCTION_LIST UFSPSC IF_DATA DIM_X DIRECT 0x817D71 /end CHARACTERISTIC
/begin CHARACTERISTIC SPSC_T_UM "Fehlerzeit bei zueinander unplausiblen Sollwerten in der Funktionsüberwachung" VALUE 0x817D72 KwUb 10200.0 t40ms_ub_b10200 0.00 10200.0 FUNCTION_LIST UFSPSC IF_DATA DIM_X DIRECT 0x817D72 /end CHARACTERISTIC
/begin CHARACTERISTIC SPSN_DAT_UC "" VAL_BLK 0x811E2C KwbUb 4.9805 spg_ub_q0p019 0.00 4.9805 NUMBER 16 FUNCTION_LIST URCEIN IF_DATA DIM_X DIRECT 0x811E2C /end CHARACTERISTIC
/begin CHARACTERISTIC SPSVG_UM "Vollgas-Sollwert-Schwelle zur Umschaltung der maximalen Differenz SP1S-SP2S" VALUE 0x817D73 KwUb 4.9805 spg_ub_q0p019 0.00 4.9805 FUNCTION_LIST UFSPSC IF_DATA DIM_X DIRECT 0x817D73 /end CHARACTERISTIC
/begin CHARACTERISTIC SRKTEVS "Saugrohrkonstante bei Schließen des Tankentlüftungsventil" VALUE 0x81164E KwUb 5.080 t20msxs_ub_b5p1 0.02000 5.100 FUNCTION_LIST LLRRM IF_DATA DIM_X DIRECT 0x81164E /end CHARACTERISTIC
/begin AXIS_PTS SRL08NXUB "Stützstellenverteilung relative Luftfüllung 8 Sst." 0x810187 rl SstAUbSstUb 191.3 rel_ub_q0p75 8 0.00 191.3 FUNCTION_LIST SSTBER87 NMAXMD DEPOSIT ABSOLUT IF_DATA DIM_X DIRECT 0x810187 /end AXIS_PTS
/begin CHARACTERISTIC SRYHS "Schwelle für Readiness-Bildung Sondenheizungs-Diagnose" VALUE 0x810BEF KwUb 255.0 dez 0.00 255.0 FUNCTION_LIST DIMC IF_DATA DIM_X DIRECT 0x810BEF /end CHARACTERISTIC
/begin CHARACTERISTIC SRYKAT "Schwelle für Readiness-Bildung Katalysator-Diagnose" VALUE 0x810BF0 KwUb 255.0 dez 0.00 255.0 FUNCTION_LIST DIMC IF_DATA DIM_X DIRECT 0x810BF0 /end CHARACTERISTIC
/begin CHARACTERISTIC SRYLS "Schwelle für Readiness-Bildung Lambdasonden-Diagnose" VALUE 0x810BF1 KwUb 255.0 dez 0.00 255.0 FUNCTION_LIST DIMC IF_DATA DIM_X DIRECT 0x810BF1 /end CHARACTERISTIC
/begin CHARACTERISTIC SRYSLS "Schwelle für Readiness-Bildung Sekundärluft-Diagnose" VALUE 0x810BF2 KwUb 255.0 dez 0.00 255.0 FUNCTION_LIST DIMC IF_DATA DIM_X DIRECT 0x810BF2 /end CHARACTERISTIC
/begin CHARACTERISTIC SRYTES "Schwelle für Readiness-Bildung Tankentlüftungs-Diagnose" VALUE 0x810BF3 KwUb 255.0 dez 0.00 255.0 FUNCTION_LIST DIMC IF_DATA DIM_X DIRECT 0x810BF3 /end CHARACTERISTIC
/begin CHARACTERISTIC STLDIA1 "Stützstelle1 für LDR Adaptionskennlinie" VALUE 0x81961B KwUb 10200. nmot_ub_q40 0.00 10200. FUNCTION_LIST LDRPID IF_DATA DIM_X DIRECT 0x81961B /end CHARACTERISTIC
/begin CHARACTERISTIC STLDIA2 "Stützstelle2 für LDR Adaptionskennlinie" VALUE 0x81961C KwUb 10200. nmot_ub_q40 0.00 10200. FUNCTION_LIST LDRPID IF_DATA DIM_X DIRECT 0x81961C /end CHARACTERISTIC
/begin CHARACTERISTIC STLDIA3 "Stützstelle3 für LDR Adaptionskennlinie" VALUE 0x81961D KwUb 10200. nmot_ub_q40 0.00 10200. FUNCTION_LIST LDRPID IF_DATA DIM_X DIRECT 0x81961D /end CHARACTERISTIC
/begin CHARACTERISTIC STLDIA4 "Stützstelle4 für LDR Adaptionskennlinie" VALUE 0x81961E KwUb 10200. nmot_ub_q40 0.00 10200. FUNCTION_LIST LDRPID IF_DATA DIM_X DIRECT 0x81961E /end CHARACTERISTIC
/begin AXIS_PTS STM04__UB "" 0x8180B6 tmot SstAUbSstUb 191.3 temp_ub_q0p75_o48 4 -48.00 143.3 FUNCTION_LIST SSTBER87 BBKHZ DEPOSIT ABSOLUT IF_DATA DIM_X DIRECT 0x8180B6 /end AXIS_PTS
/begin AXIS_PTS STM05SAUB "Stützstellenverteilung" 0x8180BB tmot SstAUbSstUb 191.3 temp_ub_q0p75_o48 5 -48.00 143.3 FUNCTION_LIST SSTBER87 BBSAWE DEPOSIT ABSOLUT IF_DATA DIM_X DIRECT 0x8180BB /end AXIS_PTS
/begin AXIS_PTS STM06LLUB "Stützstellenverteilung Motortemperatur, 6 Sst." 0x8180C1 tmot SstAUbSstUb 191.3 temp_ub_q0p75_o48 6 -48.00 143.3 FUNCTION_LIST SSTBER87 LLRNS LLRRM DEPOSIT ABSOLUT IF_DATA DIM_X DIRECT 0x8180C1 /end AXIS_PTS
/begin AXIS_PTS STM06__UB "Stützstellenverteilung Motortemperatur, 6 Sst." 0x8180C8 tmot SstAUbSstUb 191.3 temp_ub_q0p75_o48 6 -48.00 143.3 FUNCTION_LIST SSTBER87 MDVER ZWMIN DEPOSIT ABSOLUT IF_DATA DIM_X DIRECT 0x8180C8 /end AXIS_PTS
/begin AXIS_PTS STM08DMUB "8 Motortemperaturstützstellen für DMD" 0x8180CF tmot SstAUbSstUb 191.3 temp_ub_q0p75_o48 8 -48.00 143.3 FUNCTION_LIST SSTBER87 DMDLU DEPOSIT ABSOLUT IF_DATA DIM_X DIRECT 0x8180CF /end AXIS_PTS
/begin AXIS_PTS STM09ESUB "Stützstellenverteilung Motortemperatur, 9 Sst." 0x8180D8 tmot SstAUbSstUb 191.3 temp_ub_q0p75_o48 9 -48.00 143.3 FUNCTION_LIST SSTBER87 ESUK DEPOSIT ABSOLUT IF_DATA DIM_X DIRECT 0x8180D8 /end AXIS_PTS
/begin AXIS_PTS STS12ESUB "SST-Verteilung für Motorstarttemperatur" 0x8101D9 tmst SstAUbSstUb 191.3 temp_ub_q0p75_o48 12 -48.00 143.3 FUNCTION_LIST SSTBER87 ESNST ESWL DEPOSIT ABSOLUT IF_DATA DIM_X DIRECT 0x8101D9 /end AXIS_PTS
/begin CHARACTERISTIC SULSUMN "Schwellwert für Plausibilitätsfehler während B_sa" VALUE 0x81B890 KwUw 319.9951 spg_q0p00488 0.00 319.9951 FUNCTION_LIST DHLSU IF_DATA DIM_X DIRECT 0x81B890 /end CHARACTERISTIC
/begin CHARACTERISTIC SULSUMX "Schwellwert für Plausibilitätsfehler CJ110" VALUE 0x81B904 KwUw 319.9951 spg_uw_q0p00488 0.00 319.9951 FUNCTION_LIST DLSU DHLSU IF_DATA DIM_X DIRECT 0x81B904 /end CHARACTERISTIC
/begin CHARACTERISTIC SUMODE0 "keine Bestromung der Saugrohrklappen" VALUE 0x8187DD KwUb 255.0 dez 0.00 255.0 FUNCTION_LIST SU IF_DATA DIM_X DIRECT 0x8187DD /end CHARACTERISTIC
/begin CHARACTERISTIC SUMODE1 "Bestromung von Klappe 1, keine Bestromung von Klappe 2" VALUE 0x8187DE KwUb 255.0 dez 0.00 255.0 FUNCTION_LIST SU IF_DATA DIM_X DIRECT 0x8187DE /end CHARACTERISTIC
/begin CHARACTERISTIC SUMODE2 "keine Bestromung von Klappe 1, Bestromung von Klappe 2" VALUE 0x8187DF KwUb 255.0 dez 0.00 255.0 FUNCTION_LIST SU IF_DATA DIM_X DIRECT 0x8187DF /end CHARACTERISTIC
/begin CHARACTERISTIC SUMODE3 "Bestromung von Klappe 1 und Klappe 2" VALUE 0x8187E0 KwUb 255.0 dez 0.00 255.0 FUNCTION_LIST SU IF_DATA DIM_X DIRECT 0x8187E0 /end CHARACTERISTIC
/begin CHARACTERISTIC SVDLDUVS "Schwelle Verdichterdruckverhältnis für LDR Umluftventilsteuerung" CURVE 0x819334 KlAUbSstUbWUb 3.984 fak_ub_b4 0.00 3.984 FUNCTION_LIST LDUVST IF_DATA DIM_X DIRECT 0x819334 /begin AXIS_DESCR STD_AXIS nmot nmot_ub_q40 8 0.00 10200. DEPOSIT ABSOLUT /end AXIS_DESCR /end CHARACTERISTIC
/begin CHARACTERISTIC SZANSSM "Absteuerungsfaktorumschaltschwelle für Nachstartfaktor" CURVE 0x818977 GklWUb 0.9961 fak_ub_b1 0.00 0.9961 FUNCTION_LIST ESNST IF_DATA DIM_X DIRECT 0x818977
 /begin AXIS_DESCR COM_AXIS tmst temp_ub_q0p75_o48 12 -48.00 143.3 AXIS_PTS_REF STS12ESUB /end AXIS_DESCR
/end CHARACTERISTIC
/begin CHARACTERISTIC TABGBTS "Abgastemperaturschwelle für Bauteileschutz" VALUE 0x81C920 KwUw 1279.980 temp_uw_q0p0195_o50 -50.00000 1229.980 FUNCTION_LIST LAMBTS IF_DATA DIM_X DIRECT 0x81C920 /end CHARACTERISTIC
/begin CHARACTERISTIC TABGL "Zeit für LSU-Abgleich" VALUE 0x810C73 KwUb 2.550 t10msxs_ub_b2p55 0.00 2.550 FUNCTION_LIST GGLSU IF_DATA DIM_X DIRECT 0x810C73 /end CHARACTERISTIC
/begin CHARACTERISTIC TABGMCSD "Abgastemperaturschwelle für CSD-Messung" VALUE 0x810C67 KwUb 1275. temp_ub_q5_o50 -50.00 1225. FUNCTION_LIST DLSH T2DFA T2LID IF_DATA DIM_X DIRECT 0x810C67 /end CHARACTERISTIC
/begin CHARACTERISTIC TABGMEX "Abgastemperatur unterhalb der Kat-Anspringtemperatur" VALUE 0x81834D KwUb 1275. temp_ub_q5_o50 -50.00 1225. FUNCTION_LIST ATM IF_DATA DIM_X DIRECT 0x81834D /end CHARACTERISTIC
/begin CHARACTERISTIC TABGMHS "Abgastemperaturschwelle für die Sondenheizung LSU" VALUE 0x8121AF KwUb 1275. temp_ub_q5_o50 -50.00 1225. FUNCTION_LIST HLSU IF_DATA DIM_X DIRECT 0x8121AF /end CHARACTERISTIC
/begin CHARACTERISTIC TABGS "Zeit nach Start für LSU-Abgleich" VALUE 0x810C74 KwUb 25.50 t100msxs_ub_b25p5 0.00 25.50 FUNCTION_LIST GGLSU IF_DATA DIM_X DIRECT 0x810C74 /end CHARACTERISTIC
/begin CHARACTERISTIC TABGSTG "Abgastemperaturschwelle für Dynamik-Messung" VALUE 0x8183EA KwUb 1275. temp_ub_q5_o50 -50.00 1225. FUNCTION_LIST DLSAHK IF_DATA DIM_X DIRECT 0x8183EA /end CHARACTERISTIC
/begin CHARACTERISTIC TABLDOBN "Abregelzeit für LDR-Overboost" CURVE 0x819428 GklWUb 60.00 t1sxs_ub_b255 0.00 60.00 FUNCTION_LIST LDOB IF_DATA DIM_X DIRECT 0x819428
 /begin AXIS_DESCR COM_AXIS nmot nmot_ub_q40 8 0.00 10200. AXIS_PTS_REF SNM08LDUB /end AXIS_DESCR
/end CHARACTERISTIC
/begin CHARACTERISTIC TABSMADTM "Abstellzeit bis Abkühlung Motor für Diagnose TMOT" VALUE 0x81CEB6 KwUw 65535.00 t1sxs_uw_q1 0.00 65535.00 FUNCTION_LIST GGTFM IF_DATA DIM_X DIRECT 0x81CEB6 /end CHARACTERISTIC
/begin CHARACTERISTIC TABSTHLSU "Mindestabstellzeit für Wiederholstart Heizung LSU" VALUE 0x81E1F4 KwUw 65535.00 t1sxs_uw_q1 0.00 65535.00 FUNCTION_LIST HLSU IF_DATA DIM_X DIRECT 0x81E1F4 /end CHARACTERISTIC
/begin CHARACTERISTIC TADE "Ersatzgröße Lufttemperatur im Fehlerfall" VALUE 0x818FDD KwUb 191.3 temp_ub_q0p75_o48 -48.00 143.3 FUNCTION_LIST GGTFA IF_DATA DIM_X DIRECT 0x818FDD /end CHARACTERISTIC
/begin CHARACTERISTIC TADHMN "untere Temperaturschwelle für die Heizerdiagnose" VALUE 0x8183A7 KwUb 1275. temp_ub_q5_o50 -50.00 1225. FUNCTION_LIST DHLSHK IF_DATA DIM_X DIRECT 0x8183A7 /end CHARACTERISTIC
/begin CHARACTERISTIC TADHMX "obere Temperaturschwelle für die Heizerdiagnose" VALUE 0x8183A8 KwUb 1275. temp_ub_q5_o50 -50.00 1225. FUNCTION_LIST DHLSHK IF_DATA DIM_X DIRECT 0x8183A8 /end CHARACTERISTIC
/begin CHARACTERISTIC TADLLR "Ansauglufttemperaturschwelle für Diagnose Leerlaufsteller" VALUE 0x8196E3 KwUb 191.3 temp_ub_q0p75_o48 -48.00 143.3 FUNCTION_LIST DLLR IF_DATA DIM_X DIRECT 0x8196E3 /end CHARACTERISTIC
/begin CHARACTERISTIC TADMM "1. Stufenbreite (Zeit) für Motortemperaturmodell" VALUE 0x81CEB8 KwUw 6553.500 t100msxs_uw_b6553p5 0.00 6553.500 FUNCTION_LIST GGTFM IF_DATA DIM_X DIRECT 0x81CEB8 /end CHARACTERISTIC
/begin CHARACTERISTIC TADMN "Ansauglufttemperatur min." VALUE 0x818FDE KwUb 191.3 temp_ub_q0p75_o48 -48.00 143.3 FUNCTION_LIST GGTFA IF_DATA DIM_X DIRECT 0x818FDE /end CHARACTERISTIC
/begin CHARACTERISTIC TADMX "Ansauglufttemperatur max." VALUE 0x818FDF KwUb 191.3 temp_ub_q0p75_o48 -48.00 143.3 FUNCTION_LIST GGTFA IF_DATA DIM_X DIRECT 0x818FDF /end CHARACTERISTIC
/begin CHARACTERISTIC TADTEAMX "Kennlinie Max. tastverhältnis abhängig vom Integral Massenstrom TE nach TE Stop" CURVE 0x819B77 KlAUbSstUbWUb 99.61 rel_ub_b99p6 0.00 99.61 FUNCTION_LIST DTEV IF_DATA DIM_X DIRECT 0x819B77
 /begin AXIS_DESCR STD_AXIS tdtesta t100msxs_ub_b25p5 14 0.00 25.50 DEPOSIT ABSOLUT /end AXIS_DESCR
/end CHARACTERISTIC
/begin CHARACTERISTIC TADTEMX "Tastverhältnisschwelle für aktive Prüfung" VALUE 0x819B94 KwUb 89.84 rel_ub_b99p6 9.766 99.61 FUNCTION_LIST DTEV IF_DATA DIM_X DIRECT 0x819B94 /end CHARACTERISTIC
/begin CHARACTERISTIC TALAMX "Abgastemperatur-Schwellwert für Prüfung Heizerkopplung" VALUE 0x818405 KwUb 1275. temp_ub_q5_o50 -50.00 1225. FUNCTION_LIST DLSU IF_DATA DIM_X DIRECT 0x818405 /end CHARACTERISTIC
/begin CHARACTERISTIC TALDUVSE "Zeit bis zur Aktivierung LDR Umluftventilsteuerung nach Startende" VALUE 0x813FF6 KwUw 3276.750 t50msxs_uw_b3276p75 0.00 3276.750 FUNCTION_LIST LDUVST IF_DATA DIM_X DIRECT 0x813FF6 /end CHARACTERISTIC
/begin CHARACTERISTIC TALF "Ansauglufttemperaturschwelle für Lüftersteuerung" VALUE 0x8197F6 KwUb 191.3 temp_ub_q0p75_o48 -48.00 143.3 FUNCTION_LIST MLS IF_DATA DIM_X DIRECT 0x8197F6 /end CHARACTERISTIC
/begin CHARACTERISTIC TALSUMN "Abgastemperatur-Schwellwert für Heilung E_hsvsa" VALUE 0x810C61 KwUb 1275. temp_ub_q5_o50 -50.00 1225. FUNCTION_LIST DHLSU IF_DATA DIM_X DIRECT 0x810C61 /end CHARACTERISTIC
/begin CHARACTERISTIC TALSUMX "Abgastemperatur-Schwellwert für hohe Sondenspannung" VALUE 0x818406 KwUb 1275. temp_ub_q5_o50 -50.00 1225. FUNCTION_LIST DLSU IF_DATA DIM_X DIRECT 0x818406 /end CHARACTERISTIC
/begin CHARACTERISTIC TALSUSAE "Abgastemperatur-Schwellwert für Fehlereintrag E_hsvsa" VALUE 0x810C62 KwUb 1275. temp_ub_q5_o50 -50.00 1225. FUNCTION_LIST DHLSU IF_DATA DIM_X DIRECT 0x810C62 /end CHARACTERISTIC
/begin CHARACTERISTIC TAMIALU "Minimale Ansauglufttemperatur für Ausblendung der Aussetzererkennung" VALUE 0x810598 KwUb 191.3 temp_ub_q0p75_o48 -48.00 143.3 FUNCTION_LIST DMDSTP IF_DATA DIM_X DIRECT 0x810598 /end CHARACTERISTIC
/begin CHARACTERISTIC TANDSLMN "min. Ansauglufttemperatur für SL- Diagnose" VALUE 0x818108 KwUb 191.3 temp_ub_q0p75_o48 -48.00 143.3 FUNCTION_LIST DSLSLRS T2DFA T2LID IF_DATA DIM_X DIRECT 0x818108 /end CHARACTERISTIC
/begin CHARACTERISTIC TANDSLMX "max. Ansauglufttemperatur für SL- Diagnose" VALUE 0x818109 KwUb 191.3 temp_ub_q0p75_o48 -48.00 143.3 FUNCTION_LIST DSLSLRS T2DFA T2LID IF_DATA DIM_X DIRECT 0x818109 /end CHARACTERISTIC
/begin CHARACTERISTIC TANDT "Schwelle Temperaturdifferenz Ansaugluft für Heißstart" CURVE 0x81131C KlAUbSstUbWUb 191.3 temp_ub_b191p25 0.00 191.3 FUNCTION_LIST ESSTT IF_DATA DIM_X DIRECT 0x81131C
 /begin AXIS_DESCR STD_AXIS tansab temp_ub_q0p75_o48 8 -48.00 143.3 DEPOSIT ABSOLUT /end AXIS_DESCR
/end CHARACTERISTIC
/begin CHARACTERISTIC TANDT1 "Delta Temperatur Ansaugluft für Heißstart" CURVE 0x81146F KlAUbSstUbWUb 191.3 temp_ub_b191p25 0.00 191.3 FUNCTION_LIST GGTFM IF_DATA DIM_X DIRECT 0x81146F
 /begin AXIS_DESCR STD_AXIS tansab temp_ub_q0p75_o48 8 -48.00 143.3 DEPOSIT ABSOLUT /end AXIS_DESCR
/end CHARACTERISTIC
/begin CHARACTERISTIC TANH "Ansauglufttemperatur - Schwelle heiß" VALUE 0x81132D KwUb 191.3 temp_ub_q0p75_o48 -48.00 143.3 FUNCTION_LIST ESSTT IF_DATA DIM_X DIRECT 0x81132D /end CHARACTERISTIC
/begin CHARACTERISTIC TANH1 "Ansauglufttemperatur - Schwelle Heißstart" VALUE 0x811480 KwUb 191.3 temp_ub_q0p75_o48 -48.00 143.3 FUNCTION_LIST GGTFM IF_DATA DIM_X DIRECT 0x811480 /end CHARACTERISTIC
/begin CHARACTERISTIC TANHKMMN "Kat-Temperatur für ausreichende Sondenheizung" VALUE 0x81B948 KwUw 1535.977 temp_q0p0234_o273 -273.1500 1262.827 FUNCTION_LIST HLSHK IF_DATA DIM_X DIRECT 0x81B948 /end CHARACTERISTIC
/begin CHARACTERISTIC TANKL "Schwelle Tank leer erkannt" VALUE 0x81848C KwUb 127.5 fuel_ub_q0p5 0.00 127.5 FUNCTION_LIST GGFST IF_DATA DIM_X DIRECT 0x81848C /end CHARACTERISTIC
/begin CHARACTERISTIC TANSELI "Temperatur Ansaugluft-Erfassung u. Linearisierung, Inverskennlinie" CURVE 0x818FE0 KlAUbSstUbWUb 191.3 temp_ub_q0p75_o48 -48.00 143.3 FUNCTION_LIST GGTFA IF_DATA DIM_X DIRECT 0x818FE0 /begin AXIS_DESCR STD_AXIS wtans spg_ub_b5 20 0.00 4.980 DEPOSIT ABSOLUT /end AXIS_DESCR /end CHARACTERISTIC
/begin CHARACTERISTIC TANSMN "Ansauglufttemperaturschwelle zur Nachstartaufweitung" VALUE 0x811C1E KwUb 191.3 temp_ub_q0p75_o48 -48.00 143.3 FUNCTION_LIST MDZUL IF_DATA DIM_X DIRECT 0x811C1E /end CHARACTERISTIC
/begin CHARACTERISTIC TANSMN_UM "Ansauglufttemperaturschwelle zur Nachstartaufweitung in der Fkt.-Überwachung" VALUE 0x817D0F KwUb 191.3 temp_ub_q0p75_o48 -48.00 143.3 FUNCTION_LIST UFNSC IF_DATA DIM_X DIRECT 0x817D0F /end CHARACTERISTIC
/begin CHARACTERISTIC TANW "Ansauglufttemperaturschwelle für Nockenwellenverstellung" VALUE 0x818762 KwUb 191.3 temp_ub_q0p75_o48 -48.00 143.3 FUNCTION_LIST NWS IF_DATA DIM_X DIRECT 0x818762 /end CHARACTERISTIC
/begin CHARACTERISTIC TAPVLTM "Schwelle Abstellzeit für EKP-Vorlauf" CURVE 0x817A2A KlAUbSstUbWUw 65535.00 t1sxs_uw_b65535 0.00 65535.00 FUNCTION_LIST AEKP IF_DATA DIM_X DIRECT 0x817A2A
 /begin AXIS_DESCR STD_AXIS tmotab temp_ub_q0p75_o48 12 -48.00 143.3 DEPOSIT ABSOLUT /end AXIS_DESCR
/end CHARACTERISTIC
/begin CHARACTERISTIC TARA "Temperaturschwelle Ansaugluft" VALUE 0x811416 KwUb 191.3 temp_ub_q0p75_o48 -48.00 143.3 FUNCTION_LIST LRAEB IF_DATA DIM_X DIRECT 0x811416 /end CHARACTERISTIC
/begin CHARACTERISTIC TARAU "Ansauglufttemperaturschwelle für Einschalten der Lambda - Regelung" VALUE 0x81212E KwUb 191.3 temp_ub_q0p75_o48 -48.00 143.3 FUNCTION_LIST LRSEB IF_DATA DIM_X DIRECT 0x81212E /end CHARACTERISTIC
/begin CHARACTERISTIC TAREIN "Sperrzeit für Antiruckelfunktion" VALUE 0x8116AA KwUb 2.550 t10msxs_ub_b2p55 0.00 2.550 FUNCTION_LIST ARMD IF_DATA DIM_X DIRECT 0x8116AA /end CHARACTERISTIC
/begin CHARACTERISTIC TASHS "Schwelle Ansauglufttemp. für Auslösung TLRHS - Sperrzeit LR bei Heißstart" VALUE 0x81212F KwUb 191.3 temp_ub_q0p75_o48 -48.00 143.3 FUNCTION_LIST LRSEB IF_DATA DIM_X DIRECT 0x81212F /end CHARACTERISTIC
/begin CHARACTERISTIC TASIG "Zeit für Ausblendung von Störspitzen außerhalb Band für Erk. Signalunterbrechung" VALUE 0x810C68 KwUb 5.100 t20msxs_ub_b5p1 0.00 5.100 FUNCTION_LIST DLSH IF_DATA DIM_X DIRECT 0x810C68 /end CHARACTERISTIC
/begin CHARACTERISTIC TASLSO "obere Ansauglufttemperaturschwelle für Sekundärluftsystem" VALUE 0x81816F KwUb 191.3 temp_ub_q0p75_o48 -48.00 143.3 FUNCTION_LIST SLS IF_DATA DIM_X DIRECT 0x81816F /end CHARACTERISTIC
/begin CHARACTERISTIC TASLSU "untere Ansauglufttemperaturschwelle für Sekundärluftsystem" VALUE 0x818170 KwUb 191.3 temp_ub_q0p75_o48 -48.00 143.3 FUNCTION_LIST SLS IF_DATA DIM_X DIRECT 0x818170 /end CHARACTERISTIC
/begin CHARACTERISTIC TASTBFA "Modell-Temperatur vor Vorkatalysator Startwert bei B_faatm Anforderung" VALUE 0x81834E KwUb 1275. temp_ub_q5_o50 -50.00 1225. FUNCTION_LIST ATM IF_DATA DIM_X DIRECT 0x81834E /end CHARACTERISTIC
/begin CHARACTERISTIC TASUS "Ansauglufttemperaturschwelle für Saugrohrumschaltung" VALUE 0x8187E1 KwUb 191.3 temp_ub_q0p75_o48 -48.00 143.3 FUNCTION_LIST SU IF_DATA DIM_X DIRECT 0x8187E1 /end CHARACTERISTIC
/begin CHARACTERISTIC TATEGMX "Maximales Tastverhältnis für getakteten Betrieb." VALUE 0x81E1FE KwUw 99.99847 rel_uw_b100 0.00 99.99847 FUNCTION_LIST ATEV IF_DATA DIM_X DIRECT 0x81E1FE /end CHARACTERISTIC
/begin CHARACTERISTIC TATEGRDO "Obere Schwelle Tastverhältnis TEV zur Erkennung eines neg. Gradienten tatesoll" VALUE 0x8199D8 KwUb 99.61 rel_ub_b99p6 0.00 99.61 FUNCTION_LIST ATEV IF_DATA DIM_X DIRECT 0x8199D8 /end CHARACTERISTIC
/begin CHARACTERISTIC TATEGRDU "Untere Schwelle Tastverhältnis TEV zur Erkennung eines neg. Gradienten tatesoll" VALUE 0x8199D9 KwUb 99.61 rel_ub_b99p6 0.00 99.61 FUNCTION_LIST ATEV IF_DATA DIM_X DIRECT 0x8199D9 /end CHARACTERISTIC
/begin CHARACTERISTIC TATELL "tans- Schwelle für Tankentlüfung bei B_ll = 1" VALUE 0x818801 KwUb 191.3 temp_ub_q0p75_o48 -48.00 143.3 FUNCTION_LIST BBTEGA IF_DATA DIM_X DIRECT 0x818801 /end CHARACTERISTIC
/begin CHARACTERISTIC TATEMSN "Kennlinie Tastverhältnis TEV abhängig vom gewünschten Massenstrom" CURVE 0x81E200 KlAUwSstUwWUw 99.99847 rel_uw_b100 0.00 99.99847 FUNCTION_LIST ATEV IF_DATA DIM_X DIRECT 0x81E200
 /begin AXIS_DESCR STD_AXIS msntev_w m_uw_b25p6 10 0.00 25.59961 DEPOSIT ABSOLUT /end AXIS_DESCR
/end CHARACTERISTIC
/begin CHARACTERISTIC TATMKH "Abgastemperaturkorrektur bei Kat-Heizen aktiv" VALUE 0x81834F KwUb 1275. temp_q5 0.00 1275. FUNCTION_LIST ATM IF_DATA DIM_X DIRECT 0x81834F /end CHARACTERISTIC
/begin CHARACTERISTIC TATMKH2 "Abgastemperaturkorrektur bei Kat-Heizen aktiv Bank2" VALUE 0x818350 KwUb 1275. temp_q5 0.00 1275. FUNCTION_LIST ATM IF_DATA DIM_X DIRECT 0x818350 /end CHARACTERISTIC
/begin CHARACTERISTIC TATMKW "Abgastemperaturkorrektur bei Kat warmhalten aktiv" VALUE 0x818351 KwUb 1275. temp_q5 0.00 1275. FUNCTION_LIST ATM IF_DATA DIM_X DIRECT 0x818351 /end CHARACTERISTIC
/begin CHARACTERISTIC TATMSA "Abgastemperatur bei Schubabschneiden" VALUE 0x818352 KwUb 1275. temp_ub_q5_o50 -50.00 1225. FUNCTION_LIST ATM IF_DATA DIM_X DIRECT 0x818352 /end CHARACTERISTIC
/begin CHARACTERISTIC TATMSTI "Initialisierungswert für tabgm, tkatm Startwert bei Powerfail" VALUE 0x818353 KwUb 1275. temp_ub_q5_o50 -50.00 1225. FUNCTION_LIST ATM IF_DATA DIM_X DIRECT 0x818353 /end CHARACTERISTIC
/begin CHARACTERISTIC TATMTMOT "Motortemperatur warmer Motor , für Temperaturkorrektur beim Kaltstart" VALUE 0x818354 KwUb 191.3 temp_ub_q0p75_o48 -48.00 143.3 FUNCTION_LIST ATM IF_DATA DIM_X DIRECT 0x818354 /end CHARACTERISTIC
/begin CHARACTERISTIC TATMTP "Abgastaupunkttemperatur" VALUE 0x818355 KwUb 1275. temp_ub_q5_o50 -50.00 1225. FUNCTION_LIST ATM IF_DATA DIM_X DIRECT 0x818355 /end CHARACTERISTIC
/begin CHARACTERISTIC TATMWMK "Temperaturoffset  für Wärmemengenberechnung" VALUE 0x818356 KwSb 1275. temp_q5 -640.0 635.0 FUNCTION_LIST ATM IF_DATA DIM_X DIRECT 0x818356 /end CHARACTERISTIC
/begin CHARACTERISTIC TAUHLT "Zeit für Einfrieren Lambdaregler bei Abgasuntersuchung" VALUE 0x818131 KwUb 25.50 t100msxs_ub_b25p5 0.00 25.50 FUNCTION_LIST SGAAU IF_DATA DIM_X DIRECT 0x818131 /end CHARACTERISTIC
/begin CHARACTERISTIC TBLRH "Sperrzeit für Regelung hinter Kat nach Freigabe durch Regelung vor Kat" VALUE 0x8121AB KwUb 25.50 t100msxs_ub_b25p5 0.00 25.50 FUNCTION_LIST LRSHK IF_DATA DIM_X DIRECT 0x8121AB /end CHARACTERISTIC
/begin CHARACTERISTIC TC6CSL "Mode 6: Component ID für Prüfung Sekundärluftsystem" VALUE 0x81810A KwUb 127.0 dez 0.00 127.0 FUNCTION_LIST DSLSLRS IF_DATA DIM_X DIRECT 0x81810A /end CHARACTERISTIC
/begin CHARACTERISTIC TC6CSL2 "Mode 6: Component ID für Prüfung Sekundärluftsystem, Bank 2" VALUE 0x81810B KwUb 127.0 dez 0.00 127.0 FUNCTION_LIST DSLSLRS IF_DATA DIM_X DIRECT 0x81810B /end CHARACTERISTIC
/begin CHARACTERISTIC TC6CSLK "Mode 6: Component ID für Prüfung Sekundärluftsystem; Kurztest" VALUE 0x81810C KwUb 127.0 dez 0.00 127.0 FUNCTION_LIST DSLSLRS IF_DATA DIM_X DIRECT 0x81810C /end CHARACTERISTIC
/begin CHARACTERISTIC TC6CSLK2 "Mode 6: Component ID für Prüfung Sekundärluftsystem, Bank 2; Kurztest" VALUE 0x81810D KwUb 127.0 dez 0.00 127.0 FUNCTION_LIST DSLSLRS IF_DATA DIM_X DIRECT 0x81810D /end CHARACTERISTIC
/begin CHARACTERISTIC TC6CSLN "Mode 6: Component ID für Prüfung minimale Sekundärluft in Phase 1" VALUE 0x81810E KwUb 127.0 dez 0.00 127.0 FUNCTION_LIST DSLSLRS IF_DATA DIM_X DIRECT 0x81810E /end CHARACTERISTIC
/begin CHARACTERISTIC TC6CSLN2 "Mode 6: Component ID für Prüfung minimale Sekundärluft in Phase 1, Bank 2" VALUE 0x81810F KwUb 127.0 dez 0.00 127.0 FUNCTION_LIST DSLSLRS IF_DATA DIM_X DIRECT 0x81810F /end CHARACTERISTIC
/begin CHARACTERISTIC TC6CSLV "Mode 6: Component ID für Prüfung Dichtheit SL-Ventil" VALUE 0x818110 KwUb 127.0 dez 0.00 127.0 FUNCTION_LIST DSLSLRS IF_DATA DIM_X DIRECT 0x818110 /end CHARACTERISTIC
/begin CHARACTERISTIC TC6CSLV2 "Mode 6: Component ID für Prüfung Dichtheit SL-Ventil, Bank 2" VALUE 0x818111 KwUb 127.0 dez 0.00 127.0 FUNCTION_LIST DSLSLRS IF_DATA DIM_X DIRECT 0x818111 /end CHARACTERISTIC
/begin CHARACTERISTIC TC6CTHM "Mode 6: Component ID für Prüfung Kühlwasserthermostat" VALUE 0x819039 KwUb 126.0 dez 1.000 127.0 FUNCTION_LIST GGTFM IF_DATA DIM_X DIRECT 0x819039 /end CHARACTERISTIC
/begin CHARACTERISTIC TC6TECI "Mode 6 Codewort für i.O. Prüfung des TEVs aus DLDP" VALUE 0x819B95 KwUb 127.0 dez 0.00 127.0 FUNCTION_LIST DTEV IF_DATA DIM_X DIRECT 0x819B95 /end CHARACTERISTIC
/begin CHARACTERISTIC TC6TECL "Mode 6 Codewort für i.O. Prüfung des TEVs aus Luft-Prüfung" VALUE 0x819B96 KwUb 127.0 dez 0.00 127.0 FUNCTION_LIST DTEV IF_DATA DIM_X DIRECT 0x819B96 /end CHARACTERISTIC
/begin CHARACTERISTIC TC6TECNL "Mode 6 Codewort für NICHT i.O. Prüfung des TEVs aus Luft-Prüfung" VALUE 0x819B97 KwUb 127.0 dez 0.00 127.0 FUNCTION_LIST DTEV IF_DATA DIM_X DIRECT 0x819B97 /end CHARACTERISTIC
/begin CHARACTERISTIC TC6TECP "Mode 6 Codewort für passive i.O. Prüfung des TEVs" VALUE 0x819B98 KwUb 127.0 dez 0.00 127.0 FUNCTION_LIST DTEV IF_DATA DIM_X DIRECT 0x819B98 /end CHARACTERISTIC
/begin CHARACTERISTIC TC6TECRF "Mode 6 Codewort für i.O. Prüfung des TEVs aus FR-Abweichung Richtung fett" VALUE 0x819B99 KwUb 127.0 dez 0.00 127.0 FUNCTION_LIST DTEV IF_DATA DIM_X DIRECT 0x819B99 /end CHARACTERISTIC
/begin CHARACTERISTIC TC6TECRM "Mode 6 Codewort für i.O. Prüfung des TEVs aus FR-Abweichung Richtung mager" VALUE 0x819B9A KwUb 127.0 dez 0.00 127.0 FUNCTION_LIST DTEV IF_DATA DIM_X DIRECT 0x819B9A /end CHARACTERISTIC
/begin CHARACTERISTIC TC6TECT "Mode 6 Codewort für i.O. Prüfung des TEVs aus DLDP" VALUE 0x819B9B KwUb 127.0 dez 0.00 127.0 FUNCTION_LIST DTEV IF_DATA DIM_X DIRECT 0x819B9B /end CHARACTERISTIC
/begin CHARACTERISTIC TDCAS "Zeit für Timeouterkennung CAN-Schnittstelle ASC" VALUE 0x810233 KwUb 5.100 t20msxs_ub_b5p1 0.00 5.100 FUNCTION_LIST DCAS IF_DATA DIM_X DIRECT 0x810233 /end CHARACTERISTIC
/begin CHARACTERISTIC TDCGE "Zeit für Timeouterkennung CAN-Schnittstelle EGS" VALUE 0x813824 KwUw 655.3500 t10msxs_uw_b655p35 0.00 655.3500 FUNCTION_LIST DCGE IF_DATA DIM_X DIRECT 0x813824 /end CHARACTERISTIC
/begin CHARACTERISTIC TDCKBI "Zeit für Timeouterkennung CAN-Schnittstelle Kombi" VALUE 0x810236 KwUb 5.100 t20msxs_ub_b5p1 0.00 5.100 FUNCTION_LIST DCKBI IF_DATA DIM_X DIRECT 0x810236 /end CHARACTERISTIC
/begin CHARACTERISTIC TDCMIL "Entprellzeit für Zyklusflag MIL über CAN" VALUE 0x810239 KwUb 25.50 t100msxs_ub_b25p5 0.00 25.50 FUNCTION_LIST DCMIL IF_DATA DIM_X DIRECT 0x810239 /end CHARACTERISTIC
/begin CHARACTERISTIC TDDFL "Entprellzeit für Fehlereintrag Drucksensor Ladedruck" VALUE 0x8184E2 KwUb 25.50 t100msxs_ub_b25p5 0.00 25.50 FUNCTION_LIST GGDSAS IF_DATA DIM_X DIRECT 0x8184E2 /end CHARACTERISTIC
/begin CHARACTERISTIC TDDFLUGD "Entprellzeit für Fehlereintrag Drucksensor Ladedruck" VALUE 0x8184E3 KwUb 25.50 t100msxs_ub_b25p5 0.00 25.50 FUNCTION_LIST GGDSAS IF_DATA DIM_X DIRECT 0x8184E3 /end CHARACTERISTIC
/begin CHARACTERISTIC TDDFU "Entprellzeit für Fehlereintrag Druckksensor Umgebung" VALUE 0x8184E4 KwUb 25.50 t100msxs_ub_b25p5 0.00 25.50 FUNCTION_LIST GGDSAS IF_DATA DIM_X DIRECT 0x8184E4 /end CHARACTERISTIC
/begin CHARACTERISTIC TDDFUELSAN "Zeitverzögerung nach unterschreiten einer Schwelle durch dfuelsan" VALUE 0x810F52 KwUb 2.550 t10msxs_ub_b2p55 0.00 2.550 FUNCTION_LIST BGMSZS IF_DATA DIM_X DIRECT 0x810F52 /end CHARACTERISTIC
/begin CHARACTERISTIC TDDFUUGD "Entprellzeit für Fehlereintrag Druckksensor Umgebung" VALUE 0x8184E5 KwUb 25.50 t100msxs_ub_b25p5 0.00 25.50 FUNCTION_LIST GGDSAS IF_DATA DIM_X DIRECT 0x8184E5 /end CHARACTERISTIC
/begin CHARACTERISTIC TDDNWS "Verzugszeit für Freigabe Diagnose Nockenwellenverstellung in Endpositionen" VALUE 0x81862F KwUb 2.550 t10msxs_ub_b2p55 0.00 2.550 FUNCTION_LIST DNWS IF_DATA DIM_X DIRECT 0x81862F /end CHARACTERISTIC
/begin CHARACTERISTIC TDDSLA "Dauer Sekundärlufteinblasung für Adaptionsphase" VALUE 0x818171 KwUb 25.50 t100msxs_ub_b25p5 0.00 25.50 FUNCTION_LIST SLS IF_DATA DIM_X DIRECT 0x818171 /end CHARACTERISTIC
/begin CHARACTERISTIC TDDTHMF1 "Zeitverzögerung nach Freigabebedingung1 für Thermostatdiagnose" VALUE 0x81903A KwUb 25.50 t100msxs_ub_b25p5 0.00 25.50 FUNCTION_LIST GGTFM IF_DATA DIM_X DIRECT 0x81903A /end CHARACTERISTIC
/begin CHARACTERISTIC TDEGFEMN "Zeitverzögerung für Setzen des MIN-Fehlers" VALUE 0x8184D0 KwUb 25.50 t100msxs_ub_b25p5 0.00 25.50 FUNCTION_LIST DEGFE IF_DATA DIM_X DIRECT 0x8184D0 /end CHARACTERISTIC
/begin CHARACTERISTIC TDEGFEMX "Zeitverzögerung für Setzen des MAX-Fehlers" VALUE 0x8184D1 KwUb 25.50 t100msxs_ub_b25p5 0.00 25.50 FUNCTION_LIST DEGFE IF_DATA DIM_X DIRECT 0x8184D1 /end CHARACTERISTIC
/begin CHARACTERISTIC TDEGFENO "Zeitverzögerung für Setzen des NO-Fehlers" VALUE 0x8184D2 KwUb 25.50 t100msxs_ub_b25p5 0.00 25.50 FUNCTION_LIST DEGFE IF_DATA DIM_X DIRECT 0x8184D2 /end CHARACTERISTIC
/begin CHARACTERISTIC TDEGFEST "Zeitverzögerung nach Start" VALUE 0x8184D3 KwUb 25.50 t100msxs_ub_b25p5 0.00 25.50 FUNCTION_LIST DEGFE IF_DATA DIM_X DIRECT 0x8184D3 /end CHARACTERISTIC
/begin CHARACTERISTIC TDFGABGLGD "Zeitverzug für die Berücksichtigung von B_fgabglgd" VALUE 0x810F53 KwUb 2.550 t10msxs_ub_b2p55 0.00 2.550 FUNCTION_LIST BGMSZS IF_DATA DIM_X DIRECT 0x810F53 /end CHARACTERISTIC
/begin CHARACTERISTIC TDFGRL "Entprellzeit für Zyklusflag FGR-Lampe über CAN" VALUE 0x810238 KwUb 25.50 t100msxs_ub_b25p5 0.00 25.50 FUNCTION_LIST DCFGRL IF_DATA DIM_X DIRECT 0x810238 /end CHARACTERISTIC
/begin CHARACTERISTIC TDFHS "Entprellzeit für Heizerendstufe" VALUE 0x810C63 KwUb 2.550 t10msxs_ub_b2p55 0.00 2.550 FUNCTION_LIST DHLSU IF_DATA DIM_X DIRECT 0x810C63 /end CHARACTERISTIC
/begin CHARACTERISTIC TDKATAKT "Schwellwert Zyklus fertig wenn aktive Überwachungszeit > TDKATAKT" VALUE 0x81B8B0 KwUw 3276.750 t50msxs_uw_b3276p75 0.00 3276.750 FUNCTION_LIST DKATLRS IF_DATA DIM_X DIRECT 0x81B8B0 /end CHARACTERISTIC
/begin CHARACTERISTIC TDKATATT "Schwellwert Zyklus fertig für Funktionsanforderung" VALUE 0x81B8B2 KwUw 3276.750 t50msxs_uw_b3276p75 0.00 3276.750 FUNCTION_LIST DKATLRS IF_DATA DIM_X DIRECT 0x81B8B2 /end CHARACTERISTIC
/begin CHARACTERISTIC TDKLAGDE "Zeitdelta für Fehlerzählerlöschung bei DK-Soll-/Istvergleich" VALUE 0x810D2C KwUb 5.100 t20msxs_ub_b5p1 0.00 5.100 FUNCTION_LIST ADVE IF_DATA DIM_X DIRECT 0x810D2C /end CHARACTERISTIC
/begin CHARACTERISTIC TDKNACH "Zeit im Nachlauf bis stromlose DK im NLP einschwingt" VALUE 0x813D8A KwUw 655.3500 t10msxs_uw_b655p35 0.00 655.3500 FUNCTION_LIST BGDVE IF_DATA DIM_X DIRECT 0x813D8A /end CHARACTERISTIC
/begin CHARACTERISTIC TDKPAW "Zeit für DK-Poti-Auswahl" VALUE 0x810DF7 KwUb 2.540 t10msxs_ub_b2p55 0.01000 2.550 FUNCTION_LIST GGDVE IF_DATA DIM_X DIRECT 0x810DF7 /end CHARACTERISTIC
/begin CHARACTERISTIC TDKUPNOG "Verzögerungszeit nach Gangwechsel bis erneute Gangwechselerk. möglich" VALUE 0x818486 KwUb 255.0 t1sxs_ub_b255 0.00 255.0 FUNCTION_LIST DKUPPL IF_DATA DIM_X DIRECT 0x818486 /end CHARACTERISTIC
/begin CHARACTERISTIC TDLDRA "Zeitschwelle für Dia LDR - Regelabweichung" VALUE 0x8193F3 KwUb 12.75 t50msxs_ub_b12p75 0.00 12.75 FUNCTION_LIST DLDR IF_DATA DIM_X DIRECT 0x8193F3 /end CHARACTERISTIC
/begin CHARACTERISTIC TDLDRA2 "Zeitschwelle für Dia LDR - Regelabweichung (B_mxldra)" VALUE 0x8193F4 KwUb 12.75 t50msxs_ub_b12p75 0.00 12.75 FUNCTION_LIST DLDR IF_DATA DIM_X DIRECT 0x8193F4 /end CHARACTERISTIC
/begin CHARACTERISTIC TDLLR "Wartezeit bis setzten der Bedingung Diagnose Leerlaufsteller" VALUE 0x81DA58 KwUw 255.0000 t200msxs_ub_b51 0.00 255.0000 FUNCTION_LIST DLLR IF_DATA DIM_X DIRECT 0x81DA58 /end CHARACTERISTIC
/begin CHARACTERISTIC TDLLRMN "Wartezeit bis Fehlereintrag Steller geschlossen" VALUE 0x81DA5A KwUw 255.0000 t200msxs_ub_b51 0.00 255.0000 FUNCTION_LIST DLLR IF_DATA DIM_X DIRECT 0x81DA5A /end CHARACTERISTIC
/begin CHARACTERISTIC TDLLRMX "Wartezeit bis Fehlereintrag Steller offen" VALUE 0x81DA5C KwUw 255.0000 t200msxs_ub_b51 0.00 255.0000 FUNCTION_LIST DLLR IF_DATA DIM_X DIRECT 0x81DA5C /end CHARACTERISTIC
/begin CHARACTERISTIC TDLLRNF "Wartezeit bis Meldung kein Fehler bei Leerlaufsteller" VALUE 0x81DA5E KwUw 255.0000 t200msxs_ub_b51 0.00 255.0000 FUNCTION_LIST DLLR IF_DATA DIM_X DIRECT 0x81DA5E /end CHARACTERISTIC
/begin CHARACTERISTIC TDLRHAFTMX "Verweildauer für Aktivierung der Haftreibungsroutine" VALUE 0x818492 KwUb 12.75 t50msxs_q0p05 0.00 12.75 FUNCTION_LIST ADVE IF_DATA DIM_X DIRECT 0x818492 /end CHARACTERISTIC
/begin CHARACTERISTIC TDLRPIDC "Zeitdelta zur Fehlerzeitdecrementierung bei DLR-Stellbereichsüberwachung" VALUE 0x813D56 KwUw 655.3500 t10msxs_uw_b655p35 0.00 655.3500 FUNCTION_LIST ADVE IF_DATA DIM_X DIRECT 0x813D56 /end CHARACTERISTIC
/begin CHARACTERISTIC TDLRPIDMX "max. Zeit für PWM-Tastverhältnis des DLR bei temp. UMA-Adapt." VALUE 0x810D3E KwUb 12.75 t50msxs_q0p05 0.00 12.75 FUNCTION_LIST BGDVE IF_DATA DIM_X DIRECT 0x810D3E /end CHARACTERISTIC
/begin CHARACTERISTIC TDLSVV "Entprellzeit für Erkennung vertauschte Lambdasonden" VALUE 0x81E1FA KwUw 6553.500 t100msxs_uw_b6553p5 0.00 6553.500 FUNCTION_LIST DLSUV IF_DATA DIM_X DIRECT 0x81E1FA /end CHARACTERISTIC
/begin CHARACTERISTIC TDMFBSA "Zeitkonstante PT1-Filter beim Schubabschalten" VALUE 0x8166EC KwUw 655.350000 zk10msxs_uw_b655 0.0100001526 655.360000 FUNCTION_LIST MDFAW IF_DATA DIM_X DIRECT 0x8166EC /end CHARACTERISTIC
/begin CHARACTERISTIC TDMFBWE "Zeitkonstante PT1-Filter beim weichen Wiedereinsetzen" VALUE 0x8166EE KwUw 655.350000 zk10msxs_uw_b655 0.0100001526 655.360000 FUNCTION_LIST MDFAW IF_DATA DIM_X DIRECT 0x8166EE /end CHARACTERISTIC
/begin CHARACTERISTIC TDMFBWEH "Zeitkonstante PT1-Filter bei hartem Wiedereinsetzen" VALUE 0x8166F0 KwUw 655.350000 zk10msxs_uw_b655 0.0100001526 655.360000 FUNCTION_LIST MDFAW IF_DATA DIM_X DIRECT 0x8166F0 /end CHARACTERISTIC
/begin CHARACTERISTIC TDMLHFM "Zeitverzögerung für das Setzen von B_ehfm" VALUE 0x810F58 KwUb 2.540 t10msxs_ub_b2p55 0.01000 2.550 FUNCTION_LIST DHFM IF_DATA DIM_X DIRECT 0x810F58 /end CHARACTERISTIC
/begin CHARACTERISTIC TDMLMN "Entprellzeit HFM-(Hauptlastgeber-)Fehlererkennung Minimalwert" VALUE 0x8184D5 KwUb 25.50 t100msxs_ub_b25p5 0.00 25.50 FUNCTION_LIST DHFM IF_DATA DIM_X DIRECT 0x8184D5 /end CHARACTERISTIC
/begin CHARACTERISTIC TDMLMX "Entprellzeit HFM-(Hauptlastgeber-)Fehlererkennung Maximalwert" VALUE 0x8184D6 KwUb 25.50 t100msxs_ub_b25p5 0.00 25.50 FUNCTION_LIST DHFM IF_DATA DIM_X DIRECT 0x8184D6 /end CHARACTERISTIC
/begin CHARACTERISTIC TDMLNF "Entprellzeit HFM-(Hauptlastgeber-)Diagnose mit i.O.-Meldung" VALUE 0x8184D7 KwUb 25.50 t100msxs_ub_b25p5 0.00 25.50 FUNCTION_LIST DHFM IF_DATA DIM_X DIRECT 0x8184D7 /end CHARACTERISTIC
/begin CHARACTERISTIC TDMLST "Entprellzeit HFM-(Hauptlastgeber-)Fehlererkennung im Start" VALUE 0x8184D8 KwUb 25.50 t100msxs_ub_b25p5 0.00 25.50 FUNCTION_LIST DHFM IF_DATA DIM_X DIRECT 0x8184D8 /end CHARACTERISTIC
/begin CHARACTERISTIC TDMLVS "Entprellzeit HFM bei Ventilhubumschaltung" VALUE 0x8184D9 KwUb 25.50 t100msxs_ub_b25p5 0.00 25.50 FUNCTION_LIST DHFM IF_DATA DIM_X DIRECT 0x8184D9 /end CHARACTERISTIC
/begin CHARACTERISTIC TDMRESLL "Sperrzeit für die erhöhte Momentenreserve nach dem Start" VALUE 0x8196E5 KwUb 51.00 t200msxs_ub_b51 0.00 51.00 FUNCTION_LIST LLRMR IF_DATA DIM_X DIRECT 0x8196E5 /end CHARACTERISTIC
/begin CHARACTERISTIC TDMRESNL "Abschaltzeit für Momentenreserve bei getr. Kupplung und nicht LL" VALUE 0x8159A6 KwUw 1310.700 t20msxs_uw_q0p02 0.00 1310.700 FUNCTION_LIST LLRMR IF_DATA DIM_X DIRECT 0x8159A6 /end CHARACTERISTIC
/begin CHARACTERISTIC TDMSDKS "Zeitverzögerung bis das Bit B_fkmsdks wirksam wird" VALUE 0x810F54 KwUb 255.0 dez 0.00 255.0 FUNCTION_LIST BGMSZS IF_DATA DIM_X DIRECT 0x810F54 /end CHARACTERISTIC
/begin CHARACTERISTIC TDMSLMN1 "Mindestmeßzeit Sekundärluftmasse, Phase 1" VALUE 0x818112 KwUb 25.50 t100msxs_ub_b25p5 0.00 25.50 FUNCTION_LIST DSLSLRS IF_DATA DIM_X DIRECT 0x818112 /end CHARACTERISTIC
/begin CHARACTERISTIC TDMSLMN4 "Mindestmeßzeit Sekundärluftmasse, Phase 4" VALUE 0x818113 KwUb 25.50 t100msxs_ub_b25p5 0.00 25.50 FUNCTION_LIST DSLSLRS IF_DATA DIM_X DIRECT 0x818113 /end CHARACTERISTIC
/begin CHARACTERISTIC TDMSLMNK "Mindestmeßzeit Sekundärluftmasse, Phase 1 bei Kurztest" VALUE 0x818114 KwUb 25.50 t100msxs_ub_b25p5 0.00 25.50 FUNCTION_LIST DSLSLRS IF_DATA DIM_X DIRECT 0x818114 /end CHARACTERISTIC
/begin CHARACTERISTIC TDMSLOF3 "Meßzeit Offset Sekundärluftmasse, Phase 3" VALUE 0x818115 KwUb 25.50 t100msxs_ub_b25p5 0.00 25.50 FUNCTION_LIST DSLSLRS IF_DATA DIM_X DIRECT 0x818115 /end CHARACTERISTIC
/begin CHARACTERISTIC TDMSLOF5 "Meßzeit Offset sekundärluftmasse, Phase 5" VALUE 0x818116 KwUb 25.50 t100msxs_ub_b25p5 0.00 25.50 FUNCTION_LIST DSLSLRS IF_DATA DIM_X DIRECT 0x818116 /end CHARACTERISTIC
/begin CHARACTERISTIC TDMSLOFK "Meßzeit Offset Sekundärluftmasse, Phase 3 bei Kurztest" VALUE 0x818117 KwUb 25.50 t100msxs_ub_b25p5 0.00 25.50 FUNCTION_LIST DSLSLRS IF_DATA DIM_X DIRECT 0x818117 /end CHARACTERISTIC
/begin CHARACTERISTIC TDMSLV "Messzeit für Ventildichtheitsprüfung" VALUE 0x818118 KwUb 25.50 t100msxs_ub_b25p5 0.00 25.50 FUNCTION_LIST DSLSLRS IF_DATA DIM_X DIRECT 0x818118 /end CHARACTERISTIC
/begin CHARACTERISTIC TDMSLVK "Meßzeit für Ventildichtheitsprüfung bei Kurztest" VALUE 0x818119 KwUb 25.50 t100msxs_ub_b25p5 0.00 25.50 FUNCTION_LIST DSLSLRS IF_DATA DIM_X DIRECT 0x818119 /end CHARACTERISTIC
/begin CHARACTERISTIC TDNDTHMF "Zeitverzögerung Freigabe Thermostatdiagnose nach Drehzahlunterschreitung" VALUE 0x81CEBA KwUw 6553.500 t100msxs_uw_b6553p5 0.00 6553.500 FUNCTION_LIST GGTFM IF_DATA DIM_X DIRECT 0x81CEBA /end CHARACTERISTIC
/begin CHARACTERISTIC TDNDTHMS "Zeitverzögerung Sperrung Thermostatdiagnose nach Drehzahlüberschreitung" VALUE 0x81903B KwUb 25.50 t100msxs_ub_b25p5 0.00 25.50 FUNCTION_LIST GGTFM IF_DATA DIM_X DIRECT 0x81903B /end CHARACTERISTIC
/begin CHARACTERISTIC TDNNPTMF "Zeitverzögerung Freigabe tmot-Unplausibilität nach Drehzahlunterschreitung" VALUE 0x81CEBC KwUw 6553.500 t100msxs_uw_b6553p5 0.00 6553.500 FUNCTION_LIST GGTFM IF_DATA DIM_X DIRECT 0x81CEBC /end CHARACTERISTIC
/begin CHARACTERISTIC TDNNPTMS "Zeitverzögerung Sperrung tmot-Unplausibilitätsprüfg. nach Drehzahlüberschreitung" VALUE 0x81903C KwUb 25.50 t100msxs_ub_b25p5 0.00 25.50 FUNCTION_LIST GGTFM IF_DATA DIM_X DIRECT 0x81903C /end CHARACTERISTIC
/begin CHARACTERISTIC TDNPTMF1 "Zeitverzögerung nach Freigabebedingung1 für tmot-Unplausibilitätsprüfung" VALUE 0x81903D KwUb 25.50 t100msxs_ub_b25p5 0.00 25.50 FUNCTION_LIST GGTFM IF_DATA DIM_X DIRECT 0x81903D /end CHARACTERISTIC
/begin CHARACTERISTIC TDNSTA "Auspufferwärmzeit ab Start, für TANS - Diagnose" VALUE 0x819009 KwUb 255.0 t1sxs_ub_b255 0.00 255.0 FUNCTION_LIST GGTFA IF_DATA DIM_X DIRECT 0x819009 /end CHARACTERISTIC
/begin CHARACTERISTIC TDNSTOL "Wartezeit für Anfangserwärmung des (Motor-)Oel-Sensors TOL ab Startende" VALUE 0x819097 KwUb 255.0 t1sxs_ub_b255 0.00 255.0 FUNCTION_LIST GGTFOL IF_DATA DIM_X DIRECT 0x819097 /end CHARACTERISTIC
/begin CHARACTERISTIC TDNSUB "Batterie - Erholzeit ab Start, für UBATT - Diagnose" VALUE 0x810C77 KwUb 255.0 t100msxs_ub_b255 0.00 255.0 FUNCTION_LIST GGUB IF_DATA DIM_X DIRECT 0x810C77 /end CHARACTERISTIC
/begin CHARACTERISTIC TDNWSP "Zeitverzögerung für Prüfung Nockenwellenverschiebung" VALUE 0x8181BA KwUb 51.00 t200msxs_ub_b51 0.00 51.00 FUNCTION_LIST DNWKW IF_DATA DIM_X DIRECT 0x8181BA /end CHARACTERISTIC
/begin CHARACTERISTIC TDPDK "Zeitkonstante Abregelung für Faktor fmvp_w" VALUE 0x815994 KwUw 327.670000 zk10msxs_uw_b655 0.0100001526 327.680000 FUNCTION_LIST LDRPLS IF_DATA DIM_X DIRECT 0x815994 /end CHARACTERISTIC
/begin CHARACTERISTIC TDPH2SLOF "Zeit Einschaltverzögerung von Phase 2 nach Phase 3" VALUE 0x81811A KwUb 25.50 t100msxs_ub_b25p5 0.00 25.50 FUNCTION_LIST DSLSLRS IF_DATA DIM_X DIRECT 0x81811A /end CHARACTERISTIC
/begin CHARACTERISTIC TDPHSLOF "Zeit Einschaltverzögerung Bit B_slsoff in Phase 2, 3 und 5 nach" VALUE 0x81811B KwUb 25.50 t100msxs_ub_b25p5 0.00 25.50 FUNCTION_LIST DSLSLRS IF_DATA DIM_X DIRECT 0x81811B /end CHARACTERISTIC
/begin CHARACTERISTIC TDPSSOL "Zeitverzögerung der Bedingung B_pssol für die Freigabe des schnellen Abgleichs" VALUE 0x810F55 KwUb 2.490 t10msxs_ub_b2p55 0.06000 2.550 FUNCTION_LIST BGMSZS IF_DATA DIM_X DIRECT 0x810F55 /end CHARACTERISTIC
/begin CHARACTERISTIC TDRLMXLAM "Zeitverzögerung für Rücksetzen der max.Auswahl rl über Lambda-Soll" VALUE 0x810F56 KwUb 2.550 t10msxs_ub_b2p55 0.00 2.550 FUNCTION_LIST BGMSZS IF_DATA DIM_X DIRECT 0x810F56 /end CHARACTERISTIC
/begin CHARACTERISTIC TDSLKT "Dauer Kurztest Sekundärluftdiagnose für Massenmessung" VALUE 0x818172 KwUb 25.50 t100msxs_ub_b25p5 0.00 25.50 FUNCTION_LIST SLS IF_DATA DIM_X DIRECT 0x818172 /end CHARACTERISTIC
/begin CHARACTERISTIC TDSLMDRL "Einschaltverzögerung Delta-rl-Sperre bei Bildung B_dslmes" VALUE 0x81811C KwUb 25.50 t100msxs_ub_b25p5 0.00 25.50 FUNCTION_LIST DSLSLRS IF_DATA DIM_X DIRECT 0x81811C /end CHARACTERISTIC
/begin CHARACTERISTIC TDSLMVBA "Einschaltverzögerung BA-/VA-Sperre bei Bildung B_dslmes" VALUE 0x81811D KwUb 25.50 t100msxs_ub_b25p5 0.00 25.50 FUNCTION_LIST DSLSLRS IF_DATA DIM_X DIRECT 0x81811D /end CHARACTERISTIC
/begin CHARACTERISTIC TDSRLMX "Zeitverzögerung für Umschalten von Haupt- auf Nebenlastsignal" VALUE 0x810F57 KwUb 2.550 t10msxs_ub_b2p55 0.00 2.550 FUNCTION_LIST BGMSZS IF_DATA DIM_X DIRECT 0x810F57 /end CHARACTERISTIC
/begin CHARACTERISTIC TDTA "Entprellzeit Fehlererkennung TANS" VALUE 0x81900A KwUb 25.50 t100msxs_ub_b25p5 0.00 25.50 FUNCTION_LIST GGTFA IF_DATA DIM_X DIRECT 0x81900A /end CHARACTERISTIC
/begin CHARACTERISTIC TDTAL "TANS Fehlererkennung / Zeitsperre ab B_LL = 1" VALUE 0x81900B KwUb 255.0 t1sxs_ub_b255 0.00 255.0 FUNCTION_LIST GGTFA IF_DATA DIM_X DIRECT 0x81900B /end CHARACTERISTIC
/begin CHARACTERISTIC TDTEFA "Zeit für Sperre DTEV ab Start bei Testeranforderung" VALUE 0x81E326 KwUw 180.0000 t100msxs_uw_b6553p6 20.00000 200.0000 FUNCTION_LIST DTEV T2DFA T2LID IF_DATA DIM_X DIRECT 0x81E326 /end CHARACTERISTIC
/begin CHARACTERISTIC TDTESZO "Zeit ab Startende für schnelle Spülratenabsteuerung DTEV bei B_ll = TRUE inaktiv" VALUE 0x81E328 KwUw 6553.500 t100msxs_uw_b6553p6 0.00 6553.500 FUNCTION_LIST DTEV IF_DATA DIM_X DIRECT 0x81E328 /end CHARACTERISTIC
/begin CHARACTERISTIC TDTESZU "Zeit ab Startende für Aktivierung Spülratenabsteuerung DTEV bei B_ll = TRUE" VALUE 0x81E32A KwUw 6553.500 t100msxs_uw_b6553p6 0.00 6553.500 FUNCTION_LIST DTEV IF_DATA DIM_X DIRECT 0x81E32A /end CHARACTERISTIC
/begin CHARACTERISTIC TDTEZAM "Zeit ab Start für aktive DTEV möglich" VALUE 0x81E32C KwUw 6553.500 t100msxs_uw_b6553p6 0.00 6553.500 FUNCTION_LIST DTEV IF_DATA DIM_X DIRECT 0x81E32C /end CHARACTERISTIC
/begin CHARACTERISTIC TDTGET "Entprellzeit Fehlererkennung TGET Getriebetemperatur" VALUE 0x8190C8 KwUb 25.50 t100msxs_ub_b25p5 0.00 25.50 FUNCTION_LIST GGTGET IF_DATA DIM_X DIRECT 0x8190C8 /end CHARACTERISTIC
/begin CHARACTERISTIC TDTM "Entprellzeit Fehlererkennung TMOT" VALUE 0x81CEBE KwUw 6553.500 t100msxs_uw_b6553p5 0.00 6553.500 FUNCTION_LIST GGTFM IF_DATA DIM_X DIRECT 0x81CEBE /end CHARACTERISTIC
/begin CHARACTERISTIC TDTMMA "Verzögerungszeit Anfangswert Motortemperaturmodell" VALUE 0x813FF0 KwUw 6553.500 t100msxs_uw_b6553p5 0.00 6553.500 FUNCTION_LIST GGTFM IF_DATA DIM_X DIRECT 0x813FF0 /end CHARACTERISTIC
/begin CHARACTERISTIC TDTMNP "Entprellzeit Fehlererkennung Unplausibilität Signal TMOT" VALUE 0x813FF2 KwUw 6553.500 t100msxs_uw_b6553p5 0.00 6553.500 FUNCTION_LIST GGTFM IF_DATA DIM_X DIRECT 0x813FF2 /end CHARACTERISTIC
/begin CHARACTERISTIC TDTMNPO "Entprellzeit Fehlererkennung Unplausibilität oben TMOT" VALUE 0x81903E KwUb 25.50 t100msxs_ub_b25p5 0.00 25.50 FUNCTION_LIST GGTFM IF_DATA DIM_X DIRECT 0x81903E /end CHARACTERISTIC
/begin CHARACTERISTIC TDTMPOG "Entprellzeit Prüfung obere Unplausibilität gültig TMOT" VALUE 0x81903F KwUb 25.50 t100msxs_ub_b25p5 0.00 25.50 FUNCTION_LIST GGTFM IF_DATA DIM_X DIRECT 0x81903F /end CHARACTERISTIC
/begin CHARACTERISTIC TDTMR "Entprellzeit Fehlererkennung Motorraumtemperatur TMR" VALUE 0x811481 KwUb 25.50 t100msxs_ub_b25p5 0.00 25.50 FUNCTION_LIST GGTFMR IF_DATA DIM_X DIRECT 0x811481 /end CHARACTERISTIC
/begin CHARACTERISTIC TDTOL "Entprellzeit Fehlererkennung TOL (Motor-)Oeltemperatur" VALUE 0x819098 KwUb 51.00 t200msxs_ub_b51 0.00 51.00 FUNCTION_LIST GGTFOL IF_DATA DIM_X DIRECT 0x819098 /end CHARACTERISTIC
/begin CHARACTERISTIC TDTUM "Entprellzeit Fehlererkennung Umgebungslufttemperatur TUM" VALUE 0x8190C4 KwUb 25.50 t100msxs_ub_b25p5 0.00 25.50 FUNCTION_LIST GGTFUMG IF_DATA DIM_X DIRECT 0x8190C4 /end CHARACTERISTIC
/begin CHARACTERISTIC TDTUMNF "Entprellzeit für i.O.-Erkennung Umgebungslufttemperatur TUM" VALUE 0x8190C5 KwUb 25.50 t100msxs_ub_b25p5 0.00 25.50 FUNCTION_LIST GGTFUMG IF_DATA DIM_X DIRECT 0x8190C5 /end CHARACTERISTIC
/begin CHARACTERISTIC TDUB "Wartezeit für UBATT-Diagnose" VALUE 0x810C78 KwUb 25.50 t100msxs_ub_b25p5 0.00 25.50 FUNCTION_LIST GGUB IF_DATA DIM_X DIRECT 0x810C78 /end CHARACTERISTIC
/begin CHARACTERISTIC TDUBHFM "Zeit für HFM-Diagnose mit u < UBHFM" VALUE 0x810F59 KwUb 25.40 t100msxs_ub_b25p5 0.1000 25.50 FUNCTION_LIST DHFM IF_DATA DIM_X DIRECT 0x810F59 /end CHARACTERISTIC
/begin CHARACTERISTIC TDV "Fehlererkennung Tachosignal / Zeitdauer für Abfrage" VALUE 0x81848A KwUb 12.75 t50msxs_ub_b12p75 0.00 12.75 FUNCTION_LIST DVFZ IF_DATA DIM_X DIRECT 0x81848A /end CHARACTERISTIC
/begin CHARACTERISTIC TDVGDSLL "Verzögerungszeit für Drucksensorvergleich DSU/DSL im Leerlauf" VALUE 0x8184E6 KwUb 25.50 t100msxs_ub_b25p5 0.00 25.50 FUNCTION_LIST GGDSAS IF_DATA DIM_X DIRECT 0x8184E6 /end CHARACTERISTIC
/begin CHARACTERISTIC TDVIVZ "Toleranzzeit bei zu großer Abweichung zw. Istgeschw. und Zielgeschw." VALUE 0x813EDE KwUw 1310.680 t20msxs_uw_q0p02 0.02000000 1310.700 FUNCTION_LIST BBFGR IF_DATA DIM_X DIRECT 0x813EDE /end CHARACTERISTIC
/begin CHARACTERISTIC TDVZVI "Toleranzzeit bei zu großer Abweichung zw. Zielgeschw. und Istgeschw." VALUE 0x813EE0 KwUw 1310.680 t20msxs_uw_q0p02 0.02000000 1310.700 FUNCTION_LIST BBFGR IF_DATA DIM_X DIRECT 0x813EE0 /end CHARACTERISTIC
/begin CHARACTERISTIC TDWFSVN "Verzögerungszeit ab Kl.15 aus vor Verriegelung Motronic im Nachlauf" VALUE 0x811C44 KwUb 652.8 t2560ms_ub_b255 0.00 652.8 FUNCTION_LIST WFS IF_DATA DIM_X DIRECT 0x811C44 /end CHARACTERISTIC
/begin CHARACTERISTIC TDWLSVV "Wartezeit für Zyklusbit setzen Diagnose vertauschte Lambdasonden" VALUE 0x81E1FC KwUw 6553.500 t100msxs_uw_b6553p5 0.00 6553.500 FUNCTION_LIST DLSUV IF_DATA DIM_X DIRECT 0x81E1FC /end CHARACTERISTIC
/begin CHARACTERISTIC TEDTP "Einschaltdauer der LSU-Heizung während Kondenswasserphase" VALUE 0x8121B0 KwUb 2.550 t10msxs_ub_b2p55 0.00 2.550 FUNCTION_LIST HLSU IF_DATA DIM_X DIRECT 0x8121B0 /end CHARACTERISTIC
/begin CHARACTERISTIC TEMIN "minimales TE" VALUE 0x813FEC KwUw 174.7600 tinjection_sy 0.00 174.7600 FUNCTION_LIST RKTI TEB IF_DATA DIM_X DIRECT 0x813FEC /end CHARACTERISTIC
/begin CHARACTERISTIC TFDLLRO "Obere Schwelle für Zeitfenster für DLLR" VALUE 0x81DA60 KwUw 6553.500 t100msxs_uw_b6553p5 0.00 6553.500 FUNCTION_LIST DLLR IF_DATA DIM_X DIRECT 0x81DA60 /end CHARACTERISTIC
/begin CHARACTERISTIC TFDLLRU "Untere Schwelle für Zeitfenster für DLLR" VALUE 0x81DA62 KwUw 6553.500 t100msxs_uw_b6553p5 0.00 6553.500 FUNCTION_LIST DLLR IF_DATA DIM_X DIRECT 0x81DA62 /end CHARACTERISTIC
/begin CHARACTERISTIC TFGRAQU "Toleranzzeit für Aquaplaningerkennung im FGR-Betrieb" VALUE 0x810F2E KwUb 5.080 t20msxs_ub_b5p1 0.02000 5.100 FUNCTION_LIST BBFGR IF_DATA DIM_X DIRECT 0x810F2E /end CHARACTERISTIC
/begin CHARACTERISTIC TFGRARLG "Rampenlaufzeit bei langsamer FGR-Abschaltung" CURVE 0x8184A8 KlAUbSstUbWUb 5.100 t20msxs_ub_b5p1 0.00 5.100 FUNCTION_LIST FGRAUS BBFGR IF_DATA DIM_X DIRECT 0x8184A8 /begin AXIS_DESCR STD_AXIS gangi dez 8 0.00 255.0 DEPOSIT ABSOLUT /end AXIS_DESCR /end CHARACTERISTIC
/begin CHARACTERISTIC TFGRASR "Zeit für FGR-Abschaltung bei ASR-Eingriff" VALUE 0x810F2F KwUb 5.080 t20msxs_ub_b5p1 0.02000 5.100 FUNCTION_LIST BBFGR IF_DATA DIM_X DIRECT 0x810F2F /end CHARACTERISTIC
/begin CHARACTERISTIC TFGRAUSL "Ausschaltverzögerung FGR-Lampe" VALUE 0x810F39 KwUb 5.100 t20msxs_ub_b5p1 0.00 5.100 FUNCTION_LIST GGFGRH IF_DATA DIM_X DIRECT 0x810F39 /end CHARACTERISTIC
/begin CHARACTERISTIC TFGRENT "Entprellzeit beim Ausschalten einer Bedienhebelfunktion" VALUE 0x810F3A KwUb 5.100 t20msxs_ub_b5p1 0.00 5.100 FUNCTION_LIST GGFGRH IF_DATA DIM_X DIRECT 0x810F3A /end CHARACTERISTIC
/begin CHARACTERISTIC TFGRENUM "Toleranzzeit für FGR-Einschaltung nach Erkennung FGR in der Funktionsüberwachung" VALUE 0x817D07 KwUb 10200.0 t40ms_ub_b10200 0.00 10200.0 FUNCTION_LIST UFFGRE IF_DATA DIM_X DIRECT 0x817D07 /end CHARACTERISTIC
/begin CHARACTERISTIC TFGRMSR "Zeit für FGR-Abschaltung bei MSR-Eingriff" VALUE 0x810F30 KwUb 5.080 t20msxs_ub_b5p1 0.02000 5.100 FUNCTION_LIST BBFGR IF_DATA DIM_X DIRECT 0x810F30 /end CHARACTERISTIC
/begin CHARACTERISTIC TFGRTP "Zeit für Tip-Erkennung bei FGR-Bedientasten" VALUE 0x810F38 KwUb 5.080 t20msxs_ub_b5p1 0.02000 5.100 FUNCTION_LIST FGRMD IF_DATA DIM_X DIRECT 0x810F38 /end CHARACTERISTIC
/begin CHARACTERISTIC TFGRUEOB "Toleranzzeit für Überschreiten der oberen Beschleunigungsschwelle im FGR-Betrieb" VALUE 0x810F31 KwUb 5.080 t20msxs_ub_b5p1 0.02000 5.100 FUNCTION_LIST BBFGR IF_DATA DIM_X DIRECT 0x810F31 /end CHARACTERISTIC
/begin CHARACTERISTIC TFGRUM "Toleranzzeit für Erkennung FGR-Betrieb in der Funktionsüberwachung" VALUE 0x810F32 KwUb 5.080 t20msxs_ub_b5p1 0.02000 5.100 FUNCTION_LIST BBFGR IF_DATA DIM_X DIRECT 0x810F32 /end CHARACTERISTIC
/begin CHARACTERISTIC TFGRUNUB "Toleranzzeit für Unterschreiten der unteren Beschl.schwelle im FGR-Betrieb" VALUE 0x810F33 KwUb 5.080 t20msxs_ub_b5p1 0.02000 5.100 FUNCTION_LIST BBFGR IF_DATA DIM_X DIRECT 0x810F33 /end CHARACTERISTIC
/begin CHARACTERISTIC TFIMSLI "Zeitkonstante für msli- und msln-Filter" VALUE 0x81811E KwUb 12.6996 zk100msxs_ub_b25p5 0.100392 12.8000 FUNCTION_LIST DSLSLRS IF_DATA DIM_X DIRECT 0x81811E /end CHARACTERISTIC
/begin CHARACTERISTIC TFIMSLIK "Zeitkonstante für msli- und msln-Filter bei Kurztest" VALUE 0x81811F KwUb 12.6996 zk100msxs_ub_b25p5 0.100392 12.8000 FUNCTION_LIST DSLSLRS IF_DATA DIM_X DIRECT 0x81811F /end CHARACTERISTIC
/begin CHARACTERISTIC TFIMSLO "Zeitkonstante für mslo- Filter" VALUE 0x818120 KwUb 12.6996 zk100msxs_ub_b25p5 0.100392 12.8000 FUNCTION_LIST DSLSLRS IF_DATA DIM_X DIRECT 0x818120 /end CHARACTERISTIC
/begin CHARACTERISTIC TFIMSLOK "Zeitkonstante für mslo- Filter bei Kurztest" VALUE 0x818121 KwUb 12.6996 zk100msxs_ub_b25p5 0.100392 12.8000 FUNCTION_LIST DSLSLRS IF_DATA DIM_X DIRECT 0x818121 /end CHARACTERISTIC
/begin CHARACTERISTIC TFIMSLV "Zeitkonstante für mslv- Filter" VALUE 0x818122 KwUb 12.6996 zk100msxs_ub_b25p5 0.100392 12.8000 FUNCTION_LIST DSLSLRS IF_DATA DIM_X DIRECT 0x818122 /end CHARACTERISTIC
/begin CHARACTERISTIC TFIMSLVK "Zeitkonstante für mslv- Filter bei Kurztest" VALUE 0x818123 KwUb 12.6996 zk100msxs_ub_b25p5 0.100392 12.8000 FUNCTION_LIST DSLSLRS IF_DATA DIM_X DIRECT 0x818123 /end CHARACTERISTIC
/begin CHARACTERISTIC TFKWAVTMS "Timeout-Schwelle für Freigabe Diagn. bei Fehler Bed. Kühlw.-Absperrventil B_kwav" CURVE 0x819040 KlAUbSstUbWUb 5100. t20sxs_ub_b5100 0.00 5100. FUNCTION_LIST GGTFM IF_DATA DIM_X DIRECT 0x819040
 /begin AXIS_DESCR STD_AXIS tmst temp_ub_q0p75_o48 4 -48.00 143.3 DEPOSIT ABSOLUT /end AXIS_DESCR
/end CHARACTERISTIC
/begin CHARACTERISTIC TFMIZU "Filterzeitkonstante zur Filterung des zulässigen Moments" VALUE 0x8166F8 KwUw 655.350000 zk10msxs_uw_b655 0.0100001526 655.360000 FUNCTION_LIST MDZUL IF_DATA DIM_X DIRECT 0x8166F8 /end CHARACTERISTIC
/begin CHARACTERISTIC TFPWG2 "Filterzeit zur Filterung von Poti 2 bei der Bewegungserkennung" VALUE 0x813DDC KwUw 655.350000 zk10msxs_uw_b655 0.0100001526 655.360000 FUNCTION_LIST GGPED IF_DATA DIM_X DIRECT 0x813DDC /end CHARACTERISTIC
/begin CHARACTERISTIC TFRA "Erkennungszeit für eingeschwungene Grundadaption von fra" VALUE 0x81880C KwUb 51.00 t200msxs_ub_b51 0.00 51.00 FUNCTION_LIST DKVS IF_DATA DIM_X DIRECT 0x81880C /end CHARACTERISTIC
/begin CHARACTERISTIC TFRAOZ "Verweilzeit in FRAO für Zyklusflag bei nicht eingeschw. Adaption" VALUE 0x81880D KwUb 51.00 t200msxs_ub_b51 0.00 51.00 FUNCTION_LIST DKVS IF_DATA DIM_X DIRECT 0x81880D /end CHARACTERISTIC
/begin CHARACTERISTIC TFRAUZ "Verweilzeit in FRAU für Zyklusflag bei nicht eingeschw. Adaption" VALUE 0x81880E KwUb 51.00 t200msxs_ub_b51 0.00 51.00 FUNCTION_LIST DKVS IF_DATA DIM_X DIRECT 0x81880E /end CHARACTERISTIC
/begin CHARACTERISTIC TFRM "Stabilisierungszeit für die Lambdareglerabfrage." VALUE 0x81768C KwUw 1310.700 t20msxs_uw_b1310 0.00 1310.700 FUNCTION_LIST DVS IF_DATA DIM_X DIRECT 0x81768C /end CHARACTERISTIC
/begin CHARACTERISTIC TFRMB "Verzög.zeit für Erkennung Mittelwert des Lambdareglers innerhalb Schwellen" VALUE 0x8183EB KwUb 25.50 t100msxs_ub_b25p5 0.00 25.50 FUNCTION_LIST DLSAHK IF_DATA DIM_X DIRECT 0x8183EB /end CHARACTERISTIC
/begin CHARACTERISTIC TFRMDTEE "Erkennungszeit für eingeschwungene frm" VALUE 0x819B9C KwUb 3.000 t100msxs_ub_b25p5 0.00 3.000 FUNCTION_LIST DTEV IF_DATA DIM_X DIRECT 0x819B9C /end CHARACTERISTIC
/begin CHARACTERISTIC TFRMST "Erkennungszeit für eingeschwungene Grundadaption von frm" VALUE 0x81880F KwUb 51.00 t200msxs_ub_b51 0.00 51.00 FUNCTION_LIST DKVS IF_DATA DIM_X DIRECT 0x81880F /end CHARACTERISTIC
/begin CHARACTERISTIC TFRMZST "Verweilzeit für unplausibles frm-Signal (Kurztest)" VALUE 0x818810 KwUb 51.00 t200msxs_ub_b51 0.00 51.00 FUNCTION_LIST DKVS IF_DATA DIM_X DIRECT 0x818810 /end CHARACTERISTIC
/begin CHARACTERISTIC TFTEINI "Zeit für Erkennung TE Stop" VALUE 0x817676 KwUw 6553.500 t100msxs_uw_b6553p5 0.00 6553.500 FUNCTION_LIST TEB IF_DATA DIM_X DIRECT 0x817676 /end CHARACTERISTIC
/begin CHARACTERISTIC TFWDKPN "Zeitkonstante für Filterung der DK-Winkel vor Vergl. mit Ersatzwert aus Füllung" CURVE 0x810DF8 KlAUbSstUbWUb 2.54000 zk10msxs_ub_b2p55 0.0100000 2.55000 FUNCTION_LIST GGDVE IF_DATA DIM_X DIRECT 0x810DF8 /begin AXIS_DESCR STD_AXIS nmot nmot_ub_q40 6 0.00 10200. DEPOSIT ABSOLUT /end AXIS_DESCR /end CHARACTERISTIC
/begin CHARACTERISTIC TFWPFGR "Filterzeitkonstante für Berechnung wpfgr_w" VALUE 0x81DF36 KwUw 3276.75000 zk50msxs_uw_b3276p8 0.0500007630 3276.80000 FUNCTION_LIST MDFAW IF_DATA DIM_X DIRECT 0x81DF36 /end CHARACTERISTIC
/begin CHARACTERISTIC TGETDE "Ersatzgröße Getriebetemperatur im Fehlerfall" VALUE 0x8190C9 KwUb 191.3 temp_ub_q0p75_o48 -48.00 143.3 FUNCTION_LIST GGTGET IF_DATA DIM_X DIRECT 0x8190C9 /end CHARACTERISTIC
/begin CHARACTERISTIC TGETDMN "Getriebetemperatur min." VALUE 0x8190CA KwUb 191.3 temp_ub_q0p75_o48 -48.00 143.3 FUNCTION_LIST GGTGET IF_DATA DIM_X DIRECT 0x8190CA /end CHARACTERISTIC
/begin CHARACTERISTIC TGETDMNTU "minimale Getriebeöltemperatur abhängig von Umgebungstemperatur" CURVE 0x81CF74 KlAUbSstUbWSb 191.3 temp_sb_q0p75 -96.00 95.25 FUNCTION_LIST GGTGET IF_DATA DIM_X DIRECT 0x81CF74
 /begin AXIS_DESCR STD_AXIS tumg temp_ub_q0p75_o48 20 -48.00 143.3 DEPOSIT ABSOLUT /end AXIS_DESCR
/end CHARACTERISTIC
/begin CHARACTERISTIC TGETDMX "Getriebetemperatur max." VALUE 0x8190CB KwUb 191.3 temp_ub_q0p75_o48 -48.00 143.3 FUNCTION_LIST GGTGET IF_DATA DIM_X DIRECT 0x8190CB /end CHARACTERISTIC
/begin CHARACTERISTIC TGETELI "Getriebetemperatur Erfassung und Linearisierung, Inverskennlinie" CURVE 0x8190CC KlAUbSstUbWUb 191.3 temp_ub_q0p75_o48 -48.00 143.3 FUNCTION_LIST GGTGET IF_DATA DIM_X DIRECT 0x8190CC /begin AXIS_DESCR STD_AXIS wtget spg_ub_b5 18 0.00 4.980 DEPOSIT ABSOLUT /end AXIS_DESCR /end CHARACTERISTIC
/begin CHARACTERISTIC TGETO "obere Temperaturschwelle Getriebeöl für Ansteuerung KWAV" VALUE 0x819DB9 KwUb 191.3 temp_ub_q0p75_o48 -48.00 143.3 FUNCTION_LIST AKWAV IF_DATA DIM_X DIRECT 0x819DB9 /end CHARACTERISTIC
/begin CHARACTERISTIC TGETU "untere Temperaturschwelle Getriebeöl für Ansteuerung KWAV" VALUE 0x819DBA KwUb 191.3 temp_ub_q0p75_o48 -48.00 143.3 FUNCTION_LIST AKWAV IF_DATA DIM_X DIRECT 0x819DBA /end CHARACTERISTIC
/begin CHARACTERISTIC TGGLS "Zeitdauer für ADC nach Interrupt im Funktionsrechner (Asic)" VALUE 0x810C70 KwUb 2.000 t1msxms_q1 3.000 5.000 FUNCTION_LIST GGLSH IF_DATA DIM_X DIRECT 0x810C70 /end CHARACTERISTIC
/begin CHARACTERISTIC THHA "Auszeit für Reduzierung der Heizleistung Sonde hinter Kat bei 13V" VALUE 0x818478 KwUb 2.550 t10msxs_q0p01_o0p05 -0.05000 2.500 FUNCTION_LIST HLSHK IF_DATA DIM_X DIRECT 0x818478 /end CHARACTERISTIC
/begin CHARACTERISTIC THHA2 "Auszeit für Reduzierung der Heizleistung Sonde2 hinter Kat bei 13V" VALUE 0x818479 KwUb 2.550 t10msxs_q0p01_o0p05 -0.05000 2.500 FUNCTION_LIST HLSHK IF_DATA DIM_X DIRECT 0x818479 /end CHARACTERISTIC
/begin CHARACTERISTIC THHAWU "Ausschaltzeit während Leistungsreduzierung Sondenheizung hinter Kat" VALUE 0x81847A KwUb 2.550 t10msxs_ub_b2p55 0.00 2.550 FUNCTION_LIST HLSHK IF_DATA DIM_X DIRECT 0x81847A /end CHARACTERISTIC
/begin CHARACTERISTIC THLDUVD "Haltezeit LDR Umluftventilsteuerung dynamisch" VALUE 0x813FF8 KwUw 3276.750 t50msxs_uw_b3276p75 0.00 3276.750 FUNCTION_LIST LDUVST IF_DATA DIM_X DIRECT 0x813FF8 /end CHARACTERISTIC
/begin CHARACTERISTIC THOPP1 "Fehlerzeit bei Hochohmigkeitsprüfung Poti 1" VALUE 0x810E32 KwUb 2.550 t10msxs_ub_b2p55 0.00 2.550 FUNCTION_LIST GGPED IF_DATA DIM_X DIRECT 0x810E32 /end CHARACTERISTIC
/begin CHARACTERISTIC THOPP2 "Fehlerzeit bei Hochohmigkeitsprüfung Poti 2" VALUE 0x810E33 KwUb 2.550 t10msxs_ub_b2p55 0.00 2.550 FUNCTION_LIST GGPED IF_DATA DIM_X DIRECT 0x810E33 /end CHARACTERISTIC
/begin CHARACTERISTIC THSHA "Verzögerungszeit für Sonde ausreichend beheizt" VALUE 0x81847B KwUb 25.50 t100msxs_ub_b25p5 0.00 25.50 FUNCTION_LIST HLSHK IF_DATA DIM_X DIRECT 0x81847B /end CHARACTERISTIC
/begin CHARACTERISTIC THSHKTK "Kennlinie für die Ausschaltdauer der Sondenheizung abh. v.d. Abgastemp. h.Kat" CURVE 0x81B94A KlAUwSstUwWUw 2.550000 t10msxs_q0p01_o0p05 -0.05000000 2.500000 FUNCTION_LIST HLSHK IF_DATA DIM_X DIRECT 0x81B94A
 /begin AXIS_DESCR STD_AXIS tanhkm_w temp_q0p0234_o273 8 -273.1500 1262.827 DEPOSIT ABSOLUT /end AXIS_DESCR
/end CHARACTERISTIC
/begin CHARACTERISTIC THSHKTK2 "Kennlinie für die Ausschaltdauer der Sondenheizung2 abh. v.d. Abgastemp. h.Kat" CURVE 0x81B96C KlAUwSstUwWUw 2.550000 t10msxs_q0p01_o0p05 -0.05000000 2.500000 FUNCTION_LIST HLSHK IF_DATA DIM_X DIRECT 0x81B96C
 /begin AXIS_DESCR STD_AXIS tanhkm2_w temp_q0p0234_o273 8 -273.1500 1262.827 DEPOSIT ABSOLUT /end AXIS_DESCR
/end CHARACTERISTIC
/begin CHARACTERISTIC THSRIH "Zeitverzög. Bereitschaft der Ri-Messung nach eingesch. Sondenheizung hinter KAT" VALUE 0x813C22 KwUw 655.3500 t10msxs_uw_b655p35 0.00 655.3500 FUNCTION_LIST GGLSH IF_DATA DIM_X DIRECT 0x813C22 /end CHARACTERISTIC
/begin CHARACTERISTIC TKATBTS "Kat-Temperaturschwelle für Bauteileschutz" VALUE 0x81C922 KwUw 1279.980 temp_uw_q0p0195_o50 -50.00000 1229.980 FUNCTION_LIST LAMBTS IF_DATA DIM_X DIRECT 0x81C922 /end CHARACTERISTIC
/begin CHARACTERISTIC TKATDSL "maximale Katalysatortemperatur für Freigabe SLS-Diagnose" VALUE 0x818124 KwUb 1275. temp_ub_q5_o50 -50.00 1225. FUNCTION_LIST DSLSLRS T2DFA T2LID IF_DATA DIM_X DIRECT 0x818124 /end CHARACTERISTIC
/begin CHARACTERISTIC TKATMLRH "Einschaltschwelle Kat-Modelltemperatur  für Lambdaregelung hinter Kat" VALUE 0x8121AC KwUb 1275. temp_ub_q5_o50 -50.00 1225. FUNCTION_LIST LRSHK IF_DATA DIM_X DIRECT 0x8121AC /end CHARACTERISTIC
/begin CHARACTERISTIC TKATMN "Katalysatortemperaturregelschwelle für Kat warmhalten" VALUE 0x819136 KwUb 1275. temp_ub_q5_o50 -50.00 1225. FUNCTION_LIST BBKHZ IF_DATA DIM_X DIRECT 0x819136 /end CHARACTERISTIC
/begin CHARACTERISTIC TKATMOE "Temperaturkorrektur Kat ohne Exotherme tkatm" VALUE 0x818357 KwSb 1275. temp_q5 -640.0 635.0 FUNCTION_LIST ATM IF_DATA DIM_X DIRECT 0x818357 /end CHARACTERISTIC
/begin CHARACTERISTIC TKATMSHU "Kat-Temperatur für ausreichende Sondenheizung" VALUE 0x8183F7 KwUb 1275. temp_ub_q5_o50 -50.00 1225. FUNCTION_LIST DLSH T2DFA T2LID IF_DATA DIM_X DIRECT 0x8183F7 /end CHARACTERISTIC
/begin CHARACTERISTIC TKATSA "Katalysator-Temperaturschwelle für Schubabschalten" VALUE 0x8114C8 KwUb 1275. temp_ub_q5_o50 -50.00 1225. FUNCTION_LIST BBSAWE IF_DATA DIM_X DIRECT 0x8114C8 /end CHARACTERISTIC
/begin CHARACTERISTIC TKATW "Katalysatortemperaturschwelle für Kat warmhalten" VALUE 0x819137 KwUb 1275. temp_ub_q5_o50 -50.00 1225. FUNCTION_LIST BBKHZ IF_DATA DIM_X DIRECT 0x819137 /end CHARACTERISTIC
/begin CHARACTERISTIC TKHABB "Entprellzeit für Abbruchbedingungen der Funktion Katheizen" VALUE 0x819138 KwUb 25.50 t100msxs_ub_b25p5 0.00 25.50 FUNCTION_LIST BBKHZ IF_DATA DIM_X DIRECT 0x819138 /end CHARACTERISTIC
/begin CHARACTERISTIC TKHFSAB "Entprellzeit für Umschaltung auf Katheizdrehzahl bei Fahrstufe" VALUE 0x819139 KwUb 25.50 t100msxs_ub_b25p5 0.00 25.50 FUNCTION_LIST BBKHZ IF_DATA DIM_X DIRECT 0x819139 /end CHARACTERISTIC
/begin CHARACTERISTIC TKHLL "Abbruchzeit Katheizen Leerlauf" VALUE 0x81CFE8 KwUw 6553.500 t100msxs_uw_b6553p5 0.00 6553.500 FUNCTION_LIST BBKHZ IF_DATA DIM_X DIRECT 0x81CFE8 /end CHARACTERISTIC
/begin CHARACTERISTIC TKHLLAB "Entprellzeit für Ende Katheizdrehzahl im LL" VALUE 0x81913A KwUb 25.50 t100msxs_ub_b25p5 0.00 25.50 FUNCTION_LIST BBKHZ IF_DATA DIM_X DIRECT 0x81913A /end CHARACTERISTIC
/begin CHARACTERISTIC TKHLLMX "Maximale Zeit für angehobene Katheiz-Drehzahl" VALUE 0x81CFEA KwUw 655.3500 t10msxs_uw_b655p35 0.00 655.3500 FUNCTION_LIST BBKHZ IF_DATA DIM_X DIRECT 0x81CFEA /end CHARACTERISTIC
/begin CHARACTERISTIC TKHMX "Maximale Einschaltdauer der Funktion Katheizen" VALUE 0x81CFEC KwUw 655.3500 t10msxs_uw_b655p35 0.00 655.3500 FUNCTION_LIST BBKHZ IF_DATA DIM_X DIRECT 0x81CFEC /end CHARACTERISTIC
/begin CHARACTERISTIC TKOAMNN "Minimale Abschaltzeit des Klimakompressors" CURVE 0x812B92 GklWUb 51.00 t200msxs_ub_b51 0.00 51.00 FUNCTION_LIST KOS IF_DATA DIM_X DIRECT 0x812B92
 /begin AXIS_DESCR COM_AXIS nmot nmot_ub_q40 8 0.00 10200. AXIS_PTS_REF SNM08KOUB /end AXIS_DESCR
/end CHARACTERISTIC
/begin CHARACTERISTIC TKOAMXN "Maximale Abschaltzeit des Klimakompressors" CURVE 0x812B9A GklWUb 51.00 t200msxs_ub_b51 0.00 51.00 FUNCTION_LIST KOS IF_DATA DIM_X DIRECT 0x812B9A
 /begin AXIS_DESCR COM_AXIS nmot nmot_ub_q40 8 0.00 10200. AXIS_PTS_REF SNM08KOUB /end AXIS_DESCR
/end CHARACTERISTIC
/begin CHARACTERISTIC TKOEMNN "Minimale Einschaltzeit des Klimakompressors" CURVE 0x812BA2 GklWUb 51.00 t200msxs_ub_b51 0.00 51.00 FUNCTION_LIST KOS IF_DATA DIM_X DIRECT 0x812BA2
 /begin AXIS_DESCR COM_AXIS nmot nmot_ub_q40 8 0.00 10200. AXIS_PTS_REF SNM08KOUB /end AXIS_DESCR
/end CHARACTERISTIC
/begin CHARACTERISTIC TKSTBFA "Modell-Temperatur hinter Hauptkat Startwert bei B_faatm Anforderun" VALUE 0x818358 KwUb 1275. temp_ub_q5_o50 -50.00 1225. FUNCTION_LIST ATM IF_DATA DIM_X DIRECT 0x818358 /end CHARACTERISTIC
/begin CHARACTERISTIC TKTPVK "Abgastemperatur Kat (aus ATM) für TP-Überwachung Sonde vor Kat" VALUE 0x8121C7 KwUb 1275. temp_ub_q5_o50 -50.00 1225. FUNCTION_LIST SWADP IF_DATA DIM_X DIRECT 0x8121C7 /end CHARACTERISTIC
/begin CHARACTERISTIC TKTVHK "Kat-Modelltemperatur für Schwingungsprüfung SHK" VALUE 0x8121C8 KwUb 1275. temp_ub_q5_o50 -50.00 1225. FUNCTION_LIST SWADP IF_DATA DIM_X DIRECT 0x8121C8 /end CHARACTERISTIC
/begin CHARACTERISTIC TKWAVCH "Zeit für Check Kühlwasserabsperrventil" VALUE 0x819DBB KwUb 25.50 t100msxs_ub_b25p5 0.00 25.50 FUNCTION_LIST AKWAV IF_DATA DIM_X DIRECT 0x819DBB /end CHARACTERISTIC
/begin CHARACTERISTIC TLAED "Wartezeit bis Fehlerlampe aus nach Start" VALUE 0x810BF4 KwUb 51.00 t200msxs_ub_b51 0.00 51.00 FUNCTION_LIST DMIL IF_DATA DIM_X DIRECT 0x810BF4 /end CHARACTERISTIC
/begin CHARACTERISTIC TLAFA "Vezögerungszeit bis Lambda Fahrerwunsch aktiv" VALUE 0x818F8A KwUb 25.50 t100msxs_ub_b25p5 0.00 25.50 FUNCTION_LIST LAMFAW IF_DATA DIM_X DIRECT 0x818F8A /end CHARACTERISTIC
/begin CHARACTERISTIC TLDIAN "Entprellzeit für Nachführung I-Adaption negativ" VALUE 0x81961F KwUb 12.75 t50msxs_ub_b12p75 0.00 12.75 FUNCTION_LIST LDRPID IF_DATA DIM_X DIRECT 0x81961F /end CHARACTERISTIC
/begin CHARACTERISTIC TLDIAPN "Entprellzeit für Nachführung I-Adaption positiv" CURVE 0x819620 GklWUb 12.75 t50msxs_ub_b12p75 0.00 12.75 FUNCTION_LIST LDRPID IF_DATA DIM_X DIRECT 0x819620
 /begin AXIS_DESCR COM_AXIS nmot nmot_ub_q40 8 0.00 10200. AXIS_PTS_REF SNM08LDUB /end AXIS_DESCR
/end CHARACTERISTIC
/begin CHARACTERISTIC TLDOBAN "Zeit für LDR-Overboost aktiv" CURVE 0x819430 GklWUb 255.0 t1sxs_ub_b255 0.00 255.0 FUNCTION_LIST LDOB IF_DATA DIM_X DIRECT 0x819430
 /begin AXIS_DESCR COM_AXIS nmot nmot_ub_q40 8 0.00 10200. AXIS_PTS_REF SNM08LDUB /end AXIS_DESCR
/end CHARACTERISTIC
/begin CHARACTERISTIC TLDOBN "Sperrzeit für LDR-Overboost" CURVE 0x819438 GklWUb 255.0 t1sxs_ub_b255 0.00 255.0 FUNCTION_LIST LDOB IF_DATA DIM_X DIRECT 0x819438
 /begin AXIS_DESCR COM_AXIS nmot nmot_ub_q40 8 0.00 10200. AXIS_PTS_REF SNM08LDUB /end AXIS_DESCR
/end CHARACTERISTIC
/begin CHARACTERISTIC TLDRA "Verzögerungszeit fuer Dia LDR Regelabweichung Erkennung Zyklusflag" VALUE 0x8193F5 KwUb 12.75 t50msxs_ub_b12p75 0.00 12.75 FUNCTION_LIST DLDR IF_DATA DIM_X DIRECT 0x8193F5 /end CHARACTERISTIC
/begin CHARACTERISTIC TLKRLDAB "Zeitkonstante für langsame LDR-Absenkung" CURVE 0x81D6F4 GklWUw 64.2009796 zk50msxs_uw_b3276p8 0.0500007630 64.2509804 FUNCTION_LIST LDRLMX IF_DATA DIM_X DIRECT 0x81D6F4
 /begin AXIS_DESCR COM_AXIS nmot_w nmot_uw_q0p25 8 0.00 16383.75 AXIS_PTS_REF SNM08LDUW /end AXIS_DESCR
/end CHARACTERISTIC
/begin CHARACTERISTIC TLKRLDAU "Zeitkonstante für langsame LDR-Aufregelung" CURVE 0x81D704 GklWUw 64.2009796 zk50msxs_uw_b3276p8 0.0500007630 64.2509804 FUNCTION_LIST LDRLMX IF_DATA DIM_X DIRECT 0x81D704
 /begin AXIS_DESCR COM_AXIS nmot_w nmot_uw_q0p25 8 0.00 16383.75 AXIS_PTS_REF SNM08LDUW /end AXIS_DESCR
/end CHARACTERISTIC
/begin CHARACTERISTIC TLLASH "Verzög.zeit um lamlash_w zu sperren wenn lamsons_w ungleich lamlash_w ist" VALUE 0x8183EC KwUb 25.50 t100msxs_ub_b25p5 0.00 25.50 FUNCTION_LIST DLSAHK IF_DATA DIM_X DIRECT 0x8183EC /end CHARACTERISTIC
/begin CHARACTERISTIC TLMSSLAB "Entprellzeit für Abbruch Sekundärluftanfettung" VALUE 0x818173 KwUb 25.40 t100msxs_ub_b25p5 0.1000 25.50 FUNCTION_LIST SLS IF_DATA DIM_X DIRECT 0x818173 /end CHARACTERISTIC
/begin CHARACTERISTIC TLMSSLMX "Maximale Zeit für Sekundärluftanfettung im Leerlauf" VALUE 0x818174 KwUb 255.0 t100msxs_ub_b255 0.00 255.0 FUNCTION_LIST SLS IF_DATA DIM_X DIRECT 0x818174 /end CHARACTERISTIC
/begin CHARACTERISTIC TLRBAM "Sperrzeit für Einschalten LR nach BA" CURVE 0x816D94 KlAUbSstUbWUw 655.3500 t10msxs_uw_b655p35 0.00 655.3500 FUNCTION_LIST LRSEB IF_DATA DIM_X DIRECT 0x816D94
 /begin AXIS_DESCR STD_AXIS tmot temp_ub_q0p75_o48 8 -48.00 143.3 DEPOSIT ABSOLUT /end AXIS_DESCR
/end CHARACTERISTIC
/begin CHARACTERISTIC TLRHS "Sperrzeit LR bei Heißstart, ausgelöst über Schwellen TASHS und TMSHS" VALUE 0x8198EC KwUb 25.50 t100msxs_ub_b25p5 0.00 25.50 FUNCTION_LIST LRSEB IF_DATA DIM_X DIRECT 0x8198EC /end CHARACTERISTIC
/begin CHARACTERISTIC TLRSZWSA "Zeitdauer für LRS-Zwangseinschaltung nach Schubabschneiden" VALUE 0x81E1D4 KwUw 6553.500 t100msxs_uw_b6553p5 0.00 6553.500 FUNCTION_LIST LRSEB IF_DATA DIM_X DIRECT 0x81E1D4 /end CHARACTERISTIC
/begin CHARACTERISTIC TLRTMS "Sperrzeit LR nach Start, abhängig von der Motortemperatur bei Start" CURVE 0x81E1D6 KlAUbSstUbWUw 6553.500 t100msxs_uw_b6553p5 0.00 6553.500 FUNCTION_LIST LRSEB IF_DATA DIM_X DIRECT 0x81E1D6
 /begin AXIS_DESCR STD_AXIS tmst temp_ub_q0p75_o48 5 -48.00 143.3 DEPOSIT ABSOLUT /end AXIS_DESCR
/end CHARACTERISTIC
/begin CHARACTERISTIC TLRVAM "Sperrzeit für Einschalten LR nach VA" CURVE 0x816DAE KlAUbSstUbWUw 655.3500 t10msxs_uw_b655p35 0.00 655.3500 FUNCTION_LIST LRSEB IF_DATA DIM_X DIRECT 0x816DAE
 /begin AXIS_DESCR STD_AXIS tmot temp_ub_q0p75_o48 8 -48.00 143.3 DEPOSIT ABSOLUT /end AXIS_DESCR
/end CHARACTERISTIC
/begin CHARACTERISTIC TLRZWTMS "Zeit für Zwangseinschaltung LR (CARB-Forderung) nach Start" CURVE 0x81E1E6 KlAUbSstUbWUw 6553.500 t100msxs_uw_b6553p5 0.00 6553.500 FUNCTION_LIST LRSEB IF_DATA DIM_X DIRECT 0x81E1E6
 /begin AXIS_DESCR STD_AXIS tmst temp_ub_q0p75_o48 4 -48.00 143.3 DEPOSIT ABSOLUT /end AXIS_DESCR
/end CHARACTERISTIC
/begin CHARACTERISTIC TLSUSAE "Zeit für Fehlereintrag während B_sa" VALUE 0x813BA2 KwUw 1310.700 t20msxs_uw_b1310 0.00 1310.700 FUNCTION_LIST DHLSU IF_DATA DIM_X DIRECT 0x813BA2 /end CHARACTERISTIC
/begin CHARACTERISTIC TLSUTA "Kennlinie für die Einschaltdauer der LSU-Heizung nach Start" CURVE 0x819962 KlAUbSstUbWUb 2.550 t10msxs_ub_b2p55 0.00 2.550 FUNCTION_LIST HLSU IF_DATA DIM_X DIRECT 0x819962
 /begin AXIS_DESCR STD_AXIS tans temp_ub_q0p75_o48 4 -48.00 143.3 DEPOSIT ABSOLUT /end AXIS_DESCR
/end CHARACTERISTIC
/begin CHARACTERISTIC TLSUVH "Zeit für LSU vorheizen" VALUE 0x8121B1 KwUb 25.50 t100msxs_ub_b25p5 0.00 25.50 FUNCTION_LIST HLSU IF_DATA DIM_X DIRECT 0x8121B1 /end CHARACTERISTIC
/begin CHARACTERISTIC TMABDTMN "Minimalschwelle der Motorabstelltemperatur für Diagnose TMOT" VALUE 0x819049 KwUb 103.5 temp_ub_q0p75_o48 39.75 143.3 FUNCTION_LIST GGTFM IF_DATA DIM_X DIRECT 0x819049 /end CHARACTERISTIC
/begin CHARACTERISTIC TMADB0 "Motortemperaturbereich 0 für Berechnung Kaltstartanreicherung" VALUE 0x81145E KwUb 255.0 dez 0.00 255.0 FUNCTION_LIST STADAP IF_DATA DIM_X DIRECT 0x81145E /end CHARACTERISTIC
/begin CHARACTERISTIC TMADB1 "Motortemperaturbereich 1 für Berechnung Kaltstartanreicherung" VALUE 0x81145F KwUb 255.0 dez 0.00 255.0 FUNCTION_LIST STADAP IF_DATA DIM_X DIRECT 0x81145F /end CHARACTERISTIC
/begin CHARACTERISTIC TMADB2 "Motortemperaturbereich 2 für Berechnung Kaltstartanreicherung" VALUE 0x811460 KwUb 255.0 dez 0.00 255.0 FUNCTION_LIST STADAP IF_DATA DIM_X DIRECT 0x811460 /end CHARACTERISTIC
/begin CHARACTERISTIC TMAR "Untere tmot-Schwelle für AR-Freigabe" VALUE 0x8116AB KwUb 191.3 temp_ub_q0p75_o48 -48.00 143.3 FUNCTION_LIST ARMD IF_DATA DIM_X DIRECT 0x8116AB /end CHARACTERISTIC
/begin CHARACTERISTIC TMASKIV1 "Temperaturschwelle für Verlägerung 1. KAT-Intervall, Aussetzererkennung" VALUE 0x8108CE KwUb 191.3 temp_ub_q0p75_o48 -48.00 143.3 FUNCTION_LIST DMDMIL IF_DATA DIM_X DIRECT 0x8108CE /end CHARACTERISTIC
/begin CHARACTERISTIC TMAU "Tmot-Schwelle für AU-Störgrößenaufschaltung" VALUE 0x818132 KwUb 191.3 temp_ub_q0p75_o48 -48.00 143.3 FUNCTION_LIST SGAAU IF_DATA DIM_X DIRECT 0x818132 /end CHARACTERISTIC
/begin CHARACTERISTIC TMAXKAT "maximale Kat-Temperatur für Kat-diagnose" VALUE 0x8183DC KwUb 1275. temp_ub_q5_o50 -50.00 1225. FUNCTION_LIST DKATLRS IF_DATA DIM_X DIRECT 0x8183DC /end CHARACTERISTIC
/begin CHARACTERISTIC TMCC650 "KR-testmode am Pin ADT des CC650" VALUE 0x8191C7 KwUb 255.0 dez 0.00 255.0 FUNCTION_LIST GGKS IF_DATA DIM_X DIRECT 0x8191C7 /end CHARACTERISTIC
/begin CHARACTERISTIC TMDLLR "Motortemperaturschwelle für Diagnose Leerlaufsteller" VALUE 0x8196E4 KwUb 191.3 temp_ub_q0p75_o48 -48.00 143.3 FUNCTION_LIST DLLR IF_DATA DIM_X DIRECT 0x8196E4 /end CHARACTERISTIC
/begin CHARACTERISTIC TMDMAD "Motortemperaturschwelle für Freigabe der Adaption des Verlustmoments" VALUE 0x8197A4 KwUb 191.3 temp_ub_q0p75_o48 -48.00 143.3 FUNCTION_LIST MDVERAD IF_DATA DIM_X DIRECT 0x8197A4 /end CHARACTERISTIC
/begin CHARACTERISTIC TMDMMA "Anfangstemperatur für Motortemperaturmodell" VALUE 0x81904A KwUb 191.3 temp_ub_q0p75_o48 -48.00 143.3 FUNCTION_LIST GGTFM IF_DATA DIM_X DIRECT 0x81904A /end CHARACTERISTIC
/begin CHARACTERISTIC TMDMMAT "Ersatztemperatur abh. Abstellzeit während TDTMMA" CURVE 0x81CEC0 KlAUwSstUwWUw 191.2500 temp_ub_q0p75_o48 -48.00000 143.2500 FUNCTION_LIST GGTFM IF_DATA DIM_X DIRECT 0x81CEC0
 /begin AXIS_DESCR STD_AXIS tabst_w t1sxs_uw_q1 3 0.00 65535.00 DEPOSIT ABSOLUT /end AXIS_DESCR
/end CHARACTERISTIC
/begin CHARACTERISTIC TMDMMAU "Unterster Anfangswert aus tans für Motortemperaturmodell" VALUE 0x81904B KwUb 191.3 temp_ub_q0p75_o48 -48.00 143.3 FUNCTION_LIST GGTFM IF_DATA DIM_X DIRECT 0x81904B /end CHARACTERISTIC
/begin CHARACTERISTIC TMDMMEE "Endtemperatur für Ersatzwert Motortemperatur" VALUE 0x81904C KwUb 191.3 temp_ub_q0p75_o48 -48.00 143.3 FUNCTION_LIST GGTFM IF_DATA DIM_X DIRECT 0x81904C /end CHARACTERISTIC
/begin CHARACTERISTIC TMDMMER "Endtemperatur für Referenzwert Motortemperatur" VALUE 0x81904D KwUb 191.3 temp_ub_q0p75_o48 -48.00 143.3 FUNCTION_LIST GGTFM IF_DATA DIM_X DIRECT 0x81904D /end CHARACTERISTIC
/begin CHARACTERISTIC TMDMN "Motortemperatur min." VALUE 0x81904E KwUb 191.3 temp_ub_q0p75_o48 -48.00 143.3 FUNCTION_LIST GGTFM IF_DATA DIM_X DIRECT 0x81904E /end CHARACTERISTIC
/begin CHARACTERISTIC TMDMX "Motortemperatur max." VALUE 0x81904F KwUb 191.3 temp_ub_q0p75_o48 -48.00 143.3 FUNCTION_LIST GGTFM IF_DATA DIM_X DIRECT 0x81904F /end CHARACTERISTIC
/begin CHARACTERISTIC TMDNW "Minimale Motortemperatur für Diagnose Nockenwellensteuerung" VALUE 0x818630 KwUb 191.3 temp_ub_q0p75_o48 -48.00 143.3 FUNCTION_LIST DNWS IF_DATA DIM_X DIRECT 0x818630 /end CHARACTERISTIC
/begin CHARACTERISTIC TMDSLAMN "min. Motortemperatur für Zusatzdiagnose" VALUE 0x818125 KwUb 191.3 temp_ub_q0p75_o48 -48.00 143.3 FUNCTION_LIST DSLSLRS IF_DATA DIM_X DIRECT 0x818125 /end CHARACTERISTIC
/begin CHARACTERISTIC TMDSLMN "min. Motortemperatur für DSLS" VALUE 0x818126 KwUb 191.3 temp_ub_q0p75_o48 -48.00 143.3 FUNCTION_LIST DSLSLRS T2DFA T2LID IF_DATA DIM_X DIRECT 0x818126 /end CHARACTERISTIC
/begin CHARACTERISTIC TMDSLMX "max. Motortemperatur für DSLS" VALUE 0x818127 KwUb 191.3 temp_ub_q0p75_o48 -48.00 143.3 FUNCTION_LIST DSLSLRS T2DFA T2LID IF_DATA DIM_X DIRECT 0x818127 /end CHARACTERISTIC
/begin CHARACTERISTIC TMDTEU "Untere Motortemperaturschwelle für Tankentlüftungsdiagnose" VALUE 0x819B9D KwUb 63.75 temp_ub_q0p75_o48 27.00 90.75 FUNCTION_LIST DTEV T2DFA T2LID IF_DATA DIM_X DIRECT 0x819B9D /end CHARACTERISTIC
/begin CHARACTERISTIC TMDV "Motortemperaturschwelle für Freigabe Fz-Geschwindigkeits-Diagnose" VALUE 0x81848B KwUb 191.3 temp_ub_q0p75_o48 -48.00 143.3 FUNCTION_LIST DVFZ IF_DATA DIM_X DIRECT 0x81848B /end CHARACTERISTIC
/begin CHARACTERISTIC TMDYNA "TMOT - Schwelle für Lastdynamikadaption aktiv" VALUE 0x811492 KwUb 191.3 temp_ub_q0p75_o48 -48.00 143.3 FUNCTION_LIST KRDY IF_DATA DIM_X DIRECT 0x811492 /end CHARACTERISTIC
/begin CHARACTERISTIC TMELIPU1 "Motor-Temperatur: Erfassung u. Linearisierung, Inverskennlinie 1, pullup aktiv" CURVE 0x81CECE KlAUwSstUwWUw 191.9970 temp_uw_q0p75_o48 -48.00000 143.9970 FUNCTION_LIST GGTFM IF_DATA DIM_X DIRECT 0x81CECE
 /begin AXIS_DESCR STD_AXIS wtmot_w spg_q0p00488 20 0.00 319.9951 DEPOSIT ABSOLUT /end AXIS_DESCR
/end CHARACTERISTIC
/begin CHARACTERISTIC TMESP "Motortemperaturschwelle Schnellstart" VALUE 0x810F12 KwUb 191.3 temp_ub_q0p75_o48 -48.00 143.3 FUNCTION_LIST ACIFI IF_DATA DIM_X DIRECT 0x810F12 /end CHARACTERISTIC
/begin CHARACTERISTIC TMFASLMN "Motortemperaturschwelle Testeranforderung Sekundärluftdiagnose" VALUE 0x818175 KwUb 191.3 temp_ub_q0p75_o48 -48.00 143.3 FUNCTION_LIST SLS T2DFA T2LID IF_DATA DIM_X DIRECT 0x818175 /end CHARACTERISTIC
/begin CHARACTERISTIC TMFTOLMX "Motortemperaturschwelle für ausblenden von TOL max Fehler." VALUE 0x819099 KwUb 191.3 temp_ub_q0p75_o48 -48.00 143.3 FUNCTION_LIST GGTFOL IF_DATA DIM_X DIRECT 0x819099 /end CHARACTERISTIC
/begin CHARACTERISTIC TMH "Motortemperatur - Schwelle heiß" VALUE 0x81132E KwUb 191.3 temp_ub_q0p75_o48 -48.00 143.3 FUNCTION_LIST ESSTT IF_DATA DIM_X DIRECT 0x81132E /end CHARACTERISTIC
/begin CHARACTERISTIC TMHSG "Motortemperatur Heißstartgrenze" VALUE 0x81132F KwUb 191.3 temp_ub_q0p75_o48 -48.00 143.3 FUNCTION_LIST ESSTT IF_DATA DIM_X DIRECT 0x81132F /end CHARACTERISTIC
/begin COMPU_METHOD dez "1 : 1 Umrechnug (dez/hex)" RAT_FUNC "%6.2" "" COEFFS 0 1 0 0 0 1 /end COMPU_METHOD
/begin COMPU_METHOD dezsub1 "" RAT_FUNC "%6.2" "-" COEFFS 0 1 -1 0 0 1 /end COMPU_METHOD
/begin COMPU_METHOD dtsegn_b720divZyl "" RAT_FUNC "%6.4" "grad/KW" COEFFS 0 273.067 0 0 0 1 /end COMPU_METHOD
/begin COMPU_METHOD fak_q0p00153 "" RAT_FUNC "%6.4" "-" COEFFS 0 256 0 0 0 0.390625 /end COMPU_METHOD
/begin COMPU_METHOD fak_sw_b1 "" RAT_FUNC "%7.6" "-" COEFFS 0 65536 0 0 0 2 /end COMPU_METHOD
/begin COMPU_METHOD fak_sw_b8 "" RAT_FUNC "%6.5" "-" COEFFS 0 65536 0 0 0 16 /end COMPU_METHOD
/begin COMPU_METHOD fak_ub_b0p25 "" RAT_FUNC "%10.7" "-" COEFFS 0 256 0 0 0 0.25 /end COMPU_METHOD
/begin COMPU_METHOD fak_ub_b1 "" RAT_FUNC "%6.4" "-" COEFFS 0 256 0 0 0 1 /end COMPU_METHOD
/begin COMPU_METHOD fak_ub_b2 "" RAT_FUNC "%6.4" "-" COEFFS 0 256 0 0 0 2 /end COMPU_METHOD
/begin COMPU_METHOD fak_ub_b4 "" RAT_FUNC "%6.4" "-" COEFFS 0 256 0 0 0 4 /end COMPU_METHOD
/begin COMPU_METHOD fak_ub_b64 "" RAT_FUNC "%6.3" "-" COEFFS 0 256 0 0 0 64 /end COMPU_METHOD
/begin COMPU_METHOD fak_ub_b8 "" RAT_FUNC "%6.4" "-" COEFFS 0 256 0 0 0 8 /end COMPU_METHOD
/begin COMPU_METHOD fak_ub_q0p01 "" RAT_FUNC "%6.4" "-" COEFFS 0 1 0 0 0 0.01 /end COMPU_METHOD
/begin COMPU_METHOD fak_ub_q0p09765 "" RAT_FUNC "%6.3" "%/ms" COEFFS 0 256 0 0 0 25 /end COMPU_METHOD
/begin COMPU_METHOD fak_uw_b1 "" RAT_FUNC "%7.6" "-" COEFFS 0 65536 0 0 0 1 /end COMPU_METHOD
/begin COMPU_METHOD fak_uw_b16 "" RAT_FUNC "%6.5" "-" COEFFS 0 65536 0 0 0 16 /end COMPU_METHOD
/begin COMPU_METHOD fak_uw_b2 "" RAT_FUNC "%7.6" "-" COEFFS 0 65536 0 0 0 2 /end COMPU_METHOD
/begin COMPU_METHOD fak_uw_b4 "" RAT_FUNC "%7.6" "-" COEFFS 0 65536 0 0 0 4 /end COMPU_METHOD
/begin COMPU_METHOD fuel_ub_q0p5 "" RAT_FUNC "%6.3" "l" COEFFS 0 1 0 0 0 0.5 /end COMPU_METHOD
/begin COMPU_METHOD KennText "" RAT_FUNC "%6.2" "" COEFFS 0 1 0 0 0 1 /end COMPU_METHOD
/begin COMPU_METHOD kw_q0p0156 "" RAT_FUNC "%6.4" "°KW" COEFFS 0 64 0 0 0 1 /end COMPU_METHOD
/begin COMPU_METHOD kw_q6 "" RAT_FUNC "%6.2" "°KW" COEFFS 0 1 0 0 0 6 /end COMPU_METHOD
/begin COMPU_METHOD luquant "Umrechnung Laufunruhe in DMD" RAT_FUNC "%6.2" "(Umdr./sec)^2" COEFFS 0 0.549756 0 0 0 1 /end COMPU_METHOD
/begin COMPU_METHOD m_q0p0015625 "" RAT_FUNC "%6.4" "kg/h" COEFFS 0 640 0 0 0 1 /end COMPU_METHOD
/begin COMPU_METHOD m_q0p00277 "" RAT_FUNC "%6.4" "g" COEFFS 0 360 0 0 0 1 /end COMPU_METHOD
/begin COMPU_METHOD m_q0p00355 "" RAT_FUNC "%6.4" "kg" COEFFS 0 1125 0 0 0 4 /end COMPU_METHOD
/begin COMPU_METHOD m_q0p1 "" RAT_FUNC "%6.3" "kg/h" COEFFS 0 10 0 0 0 1 /end COMPU_METHOD
/begin COMPU_METHOD m_q0p4 "" RAT_FUNC "%6.3" "kg/h" COEFFS 0 1 0 0 0 0.4 /end COMPU_METHOD
/begin COMPU_METHOD m_sw_b3276p8 "" RAT_FUNC "%6.3" "kg/h" COEFFS 0 1 0 0 0 0.1 /end COMPU_METHOD
/begin COMPU_METHOD m_ub_b1020 "" RAT_FUNC "%6.2" "kg/h" COEFFS 0 1 0 0 0 4 /end COMPU_METHOD
/begin COMPU_METHOD m_ub_b5p8 "" RAT_FUNC "%6.4" "kg" COEFFS 0 5625 0 0 0 128 /end COMPU_METHOD
/begin COMPU_METHOD m_ub_q0p1 "" RAT_FUNC "%6.3" "kg/h" COEFFS 0 256 0 0 0 25.6 /end COMPU_METHOD
/begin COMPU_METHOD m_ub_q0p4 "" RAT_FUNC "%6.3" "kg" COEFFS 0 1 0 0 0 0.4 /end COMPU_METHOD
/begin COMPU_METHOD m_uw_b25p6 "" RAT_FUNC "%6.5" "kg/h" COEFFS 0 65536 0 0 0 25.6 /end COMPU_METHOD
/begin COMPU_METHOD m_uw_b6553p5 "" RAT_FUNC "%6.3" "kg/h" COEFFS 0 1 0 0 0 0.1 /end COMPU_METHOD
/begin COMPU_METHOD m_uw_b7281 "" RAT_FUNC "%6.3" "g" COEFFS 0 9 0 0 0 1 /end COMPU_METHOD
/begin COMPU_METHOD nmotd_sb_q10 "" RAT_FUNC "%6.1" "U/min" COEFFS 0 1 0 0 0 10 /end COMPU_METHOD
/begin COMPU_METHOD nmotg_q25 "" RAT_FUNC "%6.1" "U/min/s" COEFFS 0 1 0 0 0 25 /end COMPU_METHOD
/begin COMPU_METHOD nmotg_sb_q100 "" RAT_FUNC "%6.0" "U/min/s" COEFFS 0 1 0 0 0 100 /end COMPU_METHOD
/begin COMPU_METHOD nmotg_sw_q0p15625 "" RAT_FUNC "%6.3" "U/min/s" COEFFS 0 1 0 0 0 0.15625 /end COMPU_METHOD
/begin COMPU_METHOD nmotg_sw_q0p39 "" RAT_FUNC "%6.3" "U/min/s" COEFFS 0 1 0 0 0 0.39063 /end COMPU_METHOD
/begin COMPU_METHOD nmotg_ub_q100 "" RAT_FUNC "%6.0" "U/min/s" COEFFS 0 1 0 0 0 100 /end COMPU_METHOD
/begin COMPU_METHOD nmot_sw_q0p25 "" RAT_FUNC "%6.3" "U/min" COEFFS 0 1 0 0 0 0.25 /end COMPU_METHOD
/begin COMPU_METHOD nmot_ub_q0p25 "" RAT_FUNC "%6.3" "U/min" COEFFS 0 1 0 0 0 0.25 /end COMPU_METHOD
/begin COMPU_METHOD nmot_ub_q10 "" RAT_FUNC "%6.1" "U/min" COEFFS 0 1 0 0 0 10 /end COMPU_METHOD
/begin COMPU_METHOD nmot_ub_q40 "" RAT_FUNC "%6.1" "Upm" COEFFS 0 1 0 0 0 40 /end COMPU_METHOD
/begin COMPU_METHOD nmot_ub_q50 "" RAT_FUNC "%6.1" "Upm" COEFFS 0 1 0 0 0 50 /end COMPU_METHOD
/begin COMPU_METHOD nmot_uw_q0p25 "" RAT_FUNC "%6.3" "U/min" COEFFS 0 1 0 0 0 0.25 /end COMPU_METHOD
/begin COMPU_METHOD p_ub_q0p04 "" RAT_FUNC "%6.4" "hPa" COEFFS 0 1 0 0 0 0.04 /end COMPU_METHOD
/begin COMPU_METHOD p_ub_q10 "" RAT_FUNC "%6.1" "hPa" COEFFS 0 1 0 0 0 10 /end COMPU_METHOD
/begin COMPU_METHOD p_ub_q5 "" RAT_FUNC "%6.2" "hPa" COEFFS 0 1 0 0 0 5 /end COMPU_METHOD
/begin COMPU_METHOD p_uw_q0p039 "" RAT_FUNC "%6.4" "hPa" COEFFS 0 256 0 0 0 10 /end COMPU_METHOD
/begin COMPU_METHOD qnv_uw_b512 "" RAT_FUNC "%6.4" "(U/min)/(km/h)" COEFFS 0 65536 0 0 0 512 /end COMPU_METHOD
/begin COMPU_METHOD relnmot_q0p0039 "" RAT_FUNC "%6.4" "%/(U/min)" COEFFS 0 256 0 0 0 1 /end COMPU_METHOD
/begin COMPU_METHOD relPED_ub_b100 "" RAT_FUNC "%6.3" "% PED" COEFFS 0 255 0 0 0 100 /end COMPU_METHOD
/begin COMPU_METHOD rel_q0p1957 "" RAT_FUNC "%6.3" "%" COEFFS 0 511 0 0 0 100 /end COMPU_METHOD
/begin COMPU_METHOD rel_sb_q0p02 "" RAT_FUNC "%6.4" "%" COEFFS 0 50 0 0 0 1 /end COMPU_METHOD
/begin COMPU_METHOD rel_sb_q0p78 "" RAT_FUNC "%6.3" "%" COEFFS 0 1 0 0 0 0.78 /end COMPU_METHOD
/begin COMPU_METHOD rel_sw_b100 "" RAT_FUNC "%6.4" "%" COEFFS 0 32768 0 0 0 100 /end COMPU_METHOD
/begin COMPU_METHOD rel_sw_b1536 "" RAT_FUNC "%6.4" "%" COEFFS 0 65536 0 0 0 3072 /end COMPU_METHOD
/begin COMPU_METHOD rel_sw_b200 "" RAT_FUNC "%6.4" "%" COEFFS 0 65536 0 0 0 400 /end COMPU_METHOD
/begin COMPU_METHOD rel_sw_q0p1875 "" RAT_FUNC "%6.3" "%" COEFFS 0 65536 0 0 0 12288 /end COMPU_METHOD
/begin COMPU_METHOD rel_ub_b100 "" RAT_FUNC "%6.3" "%" COEFFS 0 256 0 0 0 100 /end COMPU_METHOD
/begin COMPU_METHOD rel_ub_b24p9 "" RAT_FUNC "%6.3" "%" COEFFS 0 255 0 0 0 24.9 /end COMPU_METHOD
/begin COMPU_METHOD rel_ub_b99p6 "" RAT_FUNC "%6.3" "%" COEFFS 0 256 0 0 0 100 /end COMPU_METHOD
/begin COMPU_METHOD rel_ub_bn24p9 "" RAT_FUNC "%6.5" "%" COEFFS 0 -255 0 0 0 24.9 /end COMPU_METHOD
/begin COMPU_METHOD rel_ub_q0p00153 "" RAT_FUNC "%6.4" "%" COEFFS 0 256 0 0 0 0.3906 /end COMPU_METHOD
/begin COMPU_METHOD rel_ub_q0p3906 "" RAT_FUNC "%6.3" "%" COEFFS 0 256 0 0 0 100 /end COMPU_METHOD
/begin COMPU_METHOD rel_ub_q0p75 "" RAT_FUNC "%6.3" "%" COEFFS 0 1 0 0 0 0.75 /end COMPU_METHOD
/begin COMPU_METHOD rel_uw_b100 "" RAT_FUNC "%6.4" "%" COEFFS 0 65536 0 0 0 100 /end COMPU_METHOD
/begin COMPU_METHOD rel_uw_b200 "" RAT_FUNC "%6.4" "%" COEFFS 0 65536 0 0 0 200 /end COMPU_METHOD
/begin COMPU_METHOD rel_uw_b3276p75 "" RAT_FUNC "%6.4" "%/100hPa" COEFFS 0 1 0 0 0 0.05 /end COMPU_METHOD
/begin COMPU_METHOD rel_uw_q0p0234 "" RAT_FUNC "%6.4" "%" COEFFS 0 32 0 0 0 0.75 /end COMPU_METHOD
/begin COMPU_METHOD r_uw_q2 "" RAT_FUNC "%6.2" "Ohm" COEFFS 0 1 0 0 0 2 /end COMPU_METHOD
/begin COMPU_METHOD spg_q0p00488 "" RAT_FUNC "%6.4" "V" COEFFS 0 1024 0 0 0 5 /end COMPU_METHOD
/begin COMPU_METHOD spg_ubatt "" RAT_FUNC "%6.4" "V" COEFFS 0 1 0 0 0 0.076 /end COMPU_METHOD
/begin COMPU_METHOD spg_ub_b320 "" RAT_FUNC "%6.2" "V" COEFFS 0 1 0 0 0 1.25 /end COMPU_METHOD
/begin COMPU_METHOD spg_ub_b5 "" RAT_FUNC "%6.4" "V" COEFFS 0 256 0 0 0 5 /end COMPU_METHOD
/begin COMPU_METHOD spg_ub_q0p019 "" RAT_FUNC "%6.4" "V" COEFFS 0 256 0 0 0 5 /end COMPU_METHOD
/begin COMPU_METHOD spg_uw_q0p00488 "" RAT_FUNC "%6.4" "V" COEFFS 0 1024 0 0 0 5 /end COMPU_METHOD
/begin COMPU_METHOD t100msxs_ub_b255 "" RAT_FUNC "%6.2" "s" COEFFS 0 1 0 0 0 1 /end COMPU_METHOD
/begin COMPU_METHOD t100msxs_ub_b25p5 "" RAT_FUNC "%6.3" "s" COEFFS 0 1 0 0 0 0.1 /end COMPU_METHOD
/begin COMPU_METHOD t100msxs_uw_b6553p5 "" RAT_FUNC "%6.3" "s" COEFFS 0 1 0 0 0 0.1 /end COMPU_METHOD
/begin COMPU_METHOD t100msxs_uw_b6553p6 "" RAT_FUNC "%6.3" "s" COEFFS 0 10 0 0 0 1 /end COMPU_METHOD
/begin COMPU_METHOD t10msxs_q0p01_o0p05 "" RAT_FUNC "%6.4" "s" COEFFS 0 1 0.05 0 0 0.01 /end COMPU_METHOD
/begin COMPU_METHOD t10msxs_ub_b2p55 "" RAT_FUNC "%6.4" "s" COEFFS 0 1 0 0 0 0.01 /end COMPU_METHOD
/begin COMPU_METHOD t10msxs_uw_b655p35 "" RAT_FUNC "%6.4" "s" COEFFS 0 1 0 0 0 0.01 /end COMPU_METHOD
/begin COMPU_METHOD t1msxms_q1 "" RAT_FUNC "%6.2" "ms" COEFFS 0 1 0 0 0 1 /end COMPU_METHOD
/begin COMPU_METHOD t1sxs_ub_b255 "" RAT_FUNC "%6.2" "s" COEFFS 0 1 0 0 0 1 /end COMPU_METHOD
/begin COMPU_METHOD t1sxs_uw_b65535 "" RAT_FUNC "%6.2" "s" COEFFS 0 1 0 0 0 1 /end COMPU_METHOD
/begin COMPU_METHOD t1sxs_uw_q1 "" RAT_FUNC "%6.2" "s" COEFFS 0 1 0 0 0 1 /end COMPU_METHOD
/begin COMPU_METHOD t200msxs_ub_b51 "" RAT_FUNC "%6.3" "s" COEFFS 0 1 0 0 0 0.2 /end COMPU_METHOD
/begin COMPU_METHOD t20msxs_ub_b5p1 "" RAT_FUNC "%6.4" "s" COEFFS 0 1 0 0 0 0.02 /end COMPU_METHOD
/begin COMPU_METHOD t20msxs_uw_b1310 "" RAT_FUNC "%6.4" "s" COEFFS 0 1 0 0 0 0.02 /end COMPU_METHOD
/begin COMPU_METHOD t20msxs_uw_q0p02 "" RAT_FUNC "%6.4" "s" COEFFS 0 1 0 0 0 0.02 /end COMPU_METHOD
/begin COMPU_METHOD t20sxs_ub_b5100 "" RAT_FUNC "%6.1" "s" COEFFS 0 1 0 0 0 20 /end COMPU_METHOD
/begin COMPU_METHOD t2560ms_ub_b255 "" RAT_FUNC "%6.2" "Sek" COEFFS 0 1 0 0 0 2.56 /end COMPU_METHOD
/begin COMPU_METHOD t40msxs_ub_q0p04 "" RAT_FUNC "%6.4" "s" COEFFS 0 1 0 0 0 0.04 /end COMPU_METHOD
/begin COMPU_METHOD t40msxs_uw_q0p04 "" RAT_FUNC "%6.4" "s" COEFFS 0 1 0 0 0 0.04 /end COMPU_METHOD
/begin COMPU_METHOD t40ms_ub_b10200 "" RAT_FUNC "%7.2" "ms" COEFFS 0 1 0 0 0 40 /end COMPU_METHOD
/begin COMPU_METHOD t50msxs_q0p05 "" RAT_FUNC "%6.4" "s" COEFFS 0 1 0 0 0 0.05 /end COMPU_METHOD
/begin COMPU_METHOD t50msxs_ub_b12p75 "" RAT_FUNC "%6.4" "s" COEFFS 0 1 0 0 0 0.05 /end COMPU_METHOD
/begin COMPU_METHOD t50msxs_uw_b3276p75 "" RAT_FUNC "%6.4" "s" COEFFS 0 1 0 0 0 0.05 /end COMPU_METHOD
/begin COMPU_METHOD temp_q0p0234_o273 "" RAT_FUNC "%6.1" "Grad C" COEFFS 0 1 273.15 0 0 0.0234375 /end COMPU_METHOD
/begin COMPU_METHOD temp_q5 "" RAT_FUNC "%6.2" "Grad C" COEFFS 0 1 0 0 0 5 /end COMPU_METHOD
/begin COMPU_METHOD temp_sb_q0p75 "" RAT_FUNC "%6.3" "Grad C" COEFFS 0 1 0 0 0 0.75 /end COMPU_METHOD
/begin COMPU_METHOD temp_ub_b191p25 "" RAT_FUNC "%6.3" "Grad C" COEFFS 0 1 0 0 0 0.75 /end COMPU_METHOD
/begin COMPU_METHOD temp_ub_q0p75_o48 "" RAT_FUNC "%6.2" "Grad C" COEFFS 0 1 48 0 0 0.75 /end COMPU_METHOD
/begin COMPU_METHOD temp_ub_q1_o50 "" RAT_FUNC "%6.2" "Grad C" COEFFS 0 1 50 0 0 1 /end COMPU_METHOD
/begin COMPU_METHOD temp_ub_q5_o50 "" RAT_FUNC "%6.2" "Grad C" COEFFS 0 1 50 0 0 5 /end COMPU_METHOD
/begin COMPU_METHOD temp_uw_q0p0195_o50 "" RAT_FUNC "%6.2" "Grad C" COEFFS 0 256 12800 0 0 5 /end COMPU_METHOD
/begin COMPU_METHOD temp_uw_q0p75_o48 "" RAT_FUNC "%6.2" "Grad C" COEFFS 0 1 48 0 0 0.00292969 /end COMPU_METHOD
/begin COMPU_METHOD tinjection_sy "" RAT_FUNC "%6.4" "ms" COEFFS 0 375 0 0 0 1 /end COMPU_METHOD
/begin COMPU_METHOD tv_q0p001028 "" RAT_FUNC "%6.4" "%" COEFFS 0 1 0 0 0 0.001028 /end COMPU_METHOD
/begin COMPU_METHOD tv_ub_b100 "" RAT_FUNC "%6.3" "%" COEFFS 0 256 0 0 0 100 /end COMPU_METHOD
/begin COMPU_METHOD zk100msxs_ub_b25p5 "" RAT_FUNC "%6.3" "s" COEFFS 0 0 256 0 10 0 /end COMPU_METHOD
/begin COMPU_METHOD zk10msxs_ub_b2p55 "" RAT_FUNC "%6.4" "s" COEFFS 0 0 255 0 100 0 /end COMPU_METHOD
/begin COMPU_METHOD zk10msxs_uw_b655 "" RAT_FUNC "%10.4" "s" COEFFS 0 0 65536 0 100 0 /end COMPU_METHOD
/begin COMPU_METHOD zk40ms_ub_b10200 "" RAT_FUNC "%6.1" "ms" COEFFS 0 0 10240 0 1 40 /end COMPU_METHOD
/begin COMPU_METHOD zk50msxs_uw_b3276p8 "" RAT_FUNC "%10.3" "s" COEFFS 0 0 65536 0 20 0 /end COMPU_METHOD
/begin COMPU_METHOD zw_sb_q0p75 "" RAT_FUNC "%6.3" "grad KW" COEFFS 0 255 0 0 0 191.25 /end COMPU_METHOD
/begin RECORD_LAYOUT FkfNoShNoOffWUb FNC_VALUES 1 UBYTE COLUMN_DIR DIRECT /end RECORD_LAYOUT
/begin RECORD_LAYOUT FklNoOffWUw FNC_VALUES 1 UWORD COLUMN_DIR DIRECT /end RECORD_LAYOUT
/begin RECORD_LAYOUT FklWSw FNC_VALUES 1 SWORD COLUMN_DIR DIRECT /end RECORD_LAYOUT
/begin RECORD_LAYOUT FklWUb FNC_VALUES 1 UBYTE COLUMN_DIR DIRECT /end RECORD_LAYOUT
/begin RECORD_LAYOUT FklWUw FNC_VALUES 1 UWORD COLUMN_DIR DIRECT /end RECORD_LAYOUT
/begin RECORD_LAYOUT GkfWUb FNC_VALUES 1 UBYTE COLUMN_DIR DIRECT /end RECORD_LAYOUT
/begin RECORD_LAYOUT GklWSb FNC_VALUES 1 SBYTE COLUMN_DIR DIRECT /end RECORD_LAYOUT
/begin RECORD_LAYOUT GklWSw FNC_VALUES 1 SWORD COLUMN_DIR DIRECT /end RECORD_LAYOUT
/begin RECORD_LAYOUT GklWUb FNC_VALUES 1 UBYTE COLUMN_DIR DIRECT /end RECORD_LAYOUT
/begin RECORD_LAYOUT GklWUw FNC_VALUES 1 UWORD COLUMN_DIR DIRECT /end RECORD_LAYOUT
/begin RECORD_LAYOUT KfAxUbAyUbSstxUbSstyUbWUb NO_AXIS_PTS_X 1 UBYTE NO_AXIS_PTS_Y 2 UBYTE AXIS_PTS_X 3 UBYTE INDEX_INCR DIRECT AXIS_PTS_Y 4 UBYTE INDEX_INCR DIRECT FNC_VALUES 5 UBYTE COLUMN_DIR DIRECT /end RECORD_LAYOUT
/begin RECORD_LAYOUT KfWUb FNC_VALUES 1 UBYTE COLUMN_DIR DIRECT /end RECORD_LAYOUT
/begin RECORD_LAYOUT KlAUbSstSbWUb NO_AXIS_PTS_X 1 UBYTE AXIS_PTS_X 2 SBYTE INDEX_INCR DIRECT FNC_VALUES 3 UBYTE COLUMN_DIR DIRECT /end RECORD_LAYOUT
/begin RECORD_LAYOUT KlAUbSstUbWSb NO_AXIS_PTS_X 1 UBYTE AXIS_PTS_X 2 UBYTE INDEX_INCR DIRECT FNC_VALUES 3 SBYTE COLUMN_DIR DIRECT /end RECORD_LAYOUT
/begin RECORD_LAYOUT KlAUbSstUbWUb NO_AXIS_PTS_X 1 UBYTE AXIS_PTS_X 2 UBYTE INDEX_INCR DIRECT FNC_VALUES 3 UBYTE COLUMN_DIR DIRECT /end RECORD_LAYOUT
/begin RECORD_LAYOUT KlAUbSstUbWUw NO_AXIS_PTS_X 1 UBYTE AXIS_PTS_X 2 UBYTE INDEX_INCR DIRECT FNC_VALUES 3 UWORD COLUMN_DIR DIRECT /end RECORD_LAYOUT
/begin RECORD_LAYOUT KlAUwSstUwWUw NO_AXIS_PTS_X 1 UWORD AXIS_PTS_X 2 UWORD INDEX_INCR DIRECT FNC_VALUES 3 UWORD COLUMN_DIR DIRECT /end RECORD_LAYOUT
/begin RECORD_LAYOUT KwbUb FNC_VALUES 1 UBYTE COLUMN_DIR DIRECT /end RECORD_LAYOUT
/begin RECORD_LAYOUT KwSb FNC_VALUES 1 SBYTE COLUMN_DIR DIRECT /end RECORD_LAYOUT
/begin RECORD_LAYOUT KwSw FNC_VALUES 1 SWORD COLUMN_DIR DIRECT /end RECORD_LAYOUT
/begin RECORD_LAYOUT KwUb FNC_VALUES 1 UBYTE COLUMN_DIR DIRECT /end RECORD_LAYOUT
/begin RECORD_LAYOUT KwUw FNC_VALUES 1 UWORD COLUMN_DIR DIRECT /end RECORD_LAYOUT
/begin RECORD_LAYOUT SstAUbSstSb NO_AXIS_PTS_X 1 UBYTE AXIS_PTS_X 2 SBYTE INDEX_INCR DIRECT /end RECORD_LAYOUT
/begin RECORD_LAYOUT SstAUbSstUb NO_AXIS_PTS_X 1 UBYTE AXIS_PTS_X 2 UBYTE INDEX_INCR DIRECT /end RECORD_LAYOUT
/begin RECORD_LAYOUT SstAUwSstUw NO_AXIS_PTS_X 1 UWORD AXIS_PTS_X 2 UWORD INDEX_INCR DIRECT /end RECORD_LAYOUT
/end MODULE
/end PROJECT
