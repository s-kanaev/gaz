/begin PROJECT _7804367 "156"
/begin HEADER "" VERSION "_7804367" PROJECT_NO _7804367 /end HEADER
/begin MODULE DIM ""
/begin MOD_COMMON "" BYTE_ORDER BIG_ENDIAN S_REC_LAYOUT DAMOS /end MOD_COMMON
/begin CHARACTERISTIC FUKAVAKU "Untergrenze adaptiver ÜK-Korrekturfaktor VA bei kaltem Motor" VALUE 0x811341 KwUb 3.875 fak_ub_b4 0.1094 3.984 FUNCTION_LIST ESUKAS IF_DATA DIM_X DIRECT 0x811341 /end CHARACTERISTIC
/begin CHARACTERISTIC FUKAVAWI "Init.-Wert adaptiver ÜK-Korrekturfaktor VA für warmen Motor" VALUE 0x811342 KwUb 3.984 fak_ub_b4 0.00 3.984 FUNCTION_LIST ESUKAS IF_DATA DIM_X DIRECT 0x811342 /end CHARACTERISTIC
/begin CHARACTERISTIC FUKAVAWO "Obergrenze adaptiver ÜK-Korrekturfaktor VA bei warmem Motor" VALUE 0x811343 KwUb 3.984 fak_ub_b4 0.00 3.984 FUNCTION_LIST ESUKAS IF_DATA DIM_X DIRECT 0x811343 /end CHARACTERISTIC
/begin CHARACTERISTIC FUKAVAWU "Untergrenze adaptiver ÜK-Korrekturfaktor VA bei warmem Motor" VALUE 0x811344 KwUb 3.875 fak_ub_b4 0.1094 3.984 FUNCTION_LIST ESUKAS IF_DATA DIM_X DIRECT 0x811344 /end CHARACTERISTIC
/begin CHARACTERISTIC FUKE "Faktor ÜK-Ersatzwert" VALUE 0x8156D2 KwUw 7.999878 fak_uw_b8 0.00 7.999878 FUNCTION_LIST ESUK IF_DATA DIM_X DIRECT 0x8156D2 /end CHARACTERISTIC
/begin CHARACTERISTIC FUKNSTM "Startwert Faktor ÜK im Nachstart" CURVE 0x81898C KlAUbSstUbWUb 3.984 fak_ub_b4 0.00 3.984 FUNCTION_LIST ESUK IF_DATA DIM_X DIRECT 0x81898C
 /begin AXIS_DESCR STD_AXIS tmst temp_ub_q0p75_o48 9 -48.00 143.3 DEPOSIT ABSOLUT /end AXIS_DESCR
/end CHARACTERISTIC
/begin CHARACTERISTIC FUMRBRK "Faktor Umrechnung HC-Konzentration in Beladung ftead" VALUE 0x819A3C KwUb 31.88 fak_ub_b32 0.00 31.88 FUNCTION_LIST TEB IF_DATA DIM_X DIRECT 0x819A3C /end CHARACTERISTIC
/begin CHARACTERISTIC FUMRMV "Faktor Dichte der Luft" VALUE 0x8121D6 KwUb 1.992 dichte_ub_b2 0.00 1.992 FUNCTION_LIST BGTEV IF_DATA DIM_X DIRECT 0x8121D6 /end CHARACTERISTIC
/begin CHARACTERISTIC FV60KWU "Faktor zur Verlängerung des 60 UWK Intervalls" VALUE 0x81089A KwUb 19.00 dez 1.000 20.00 FUNCTION_LIST DMDMIL IF_DATA DIM_X DIRECT 0x81089A /end CHARACTERISTIC
/begin CHARACTERISTIC FVANST "Gewichtungsfaktor VA im Nachstart" VALUE 0x811332 KwUb 1.992 fak_ub_b2 0.00 1.992 FUNCTION_LIST ESUK IF_DATA DIM_X DIRECT 0x811332 /end CHARACTERISTIC
/begin CHARACTERISTIC FVCANRO "Korrekturfaktor für Umrechn. Fz-Geschw. aus CAN in vfzroh" VALUE 0x813D18 KwUw 1.999969 fak_uw_b2 0.00 1.999969 FUNCTION_LIST GGVFZG IF_DATA DIM_X DIRECT 0x813D18 /end CHARACTERISTIC
/begin CHARACTERISTIC FVERMN "Kennlinie Faktor Vermischung Regeneriergas Tankentlüftung mit Frischluft" CURVE 0x8121D8 KlAUbSstUbWUb 0.9961 fak_ub_b1 0.00 0.9961 FUNCTION_LIST TEB IF_DATA DIM_X DIRECT 0x8121D8 /begin AXIS_DESCR STD_AXIS nmot nmot_ub_q40 6 0.00 10200. DEPOSIT ABSOLUT /end AXIS_DESCR /end CHARACTERISTIC
/begin CHARACTERISTIC FVERZDYN "Dynamischer Faktor Verzögerung Regeneriergas zw. Drosselklappe, Einspritzventil" CURVE 0x817648 GklWUw 0.003905886 t_min_q5p96em8 0.00 0.003905886 FUNCTION_LIST TEB IF_DATA DIM_X DIRECT 0x817648
 /begin AXIS_DESCR COM_AXIS qmsdyn fak_ub_b16 5 0.00 15.94 AXIS_PTS_REF SQM05TEUB /end AXIS_DESCR
/end CHARACTERISTIC
/begin CHARACTERISTIC FVFKUKA "Gewichtung des Korrekturfaktors in UK-Adaption" VALUE 0x811345 KwUb 7.969 fak_ub_b8 0.00 7.969 FUNCTION_LIST ESUKAS IF_DATA DIM_X DIRECT 0x811345 /end CHARACTERISTIC
/begin CHARACTERISTIC FVRMDYN "dynamischer Faktor Vermischung Regeneriergas Tankentlüftung mit Frischluft" CURVE 0x8121E5 GklWUb 7.969 fak_ub_b8 0.00 7.969 FUNCTION_LIST TEB IF_DATA DIM_X DIRECT 0x8121E5
 /begin AXIS_DESCR COM_AXIS qmsdyn fak_ub_b16 5 0.00 15.94 AXIS_PTS_REF SQM05TEUB /end AXIS_DESCR
/end CHARACTERISTIC
/begin CHARACTERISTIC FVSTM "Gemischkorrektur Tmot-Abhängig" CURVE 0x8121FA KlAUbSstUbWUb 3.984 fak_ub_b4 0.00 3.984 FUNCTION_LIST esvs IF_DATA DIM_X DIRECT 0x8121FA
 /begin AXIS_DESCR STD_AXIS tmot temp_ub_q0p75_o48 8 -48.00 143.3 DEPOSIT ABSOLUT /end AXIS_DESCR
/end CHARACTERISTIC
/begin CHARACTERISTIC FWEAB "Rekursionskostante Wiedereinsetzfaktor abnehmend" VALUE 0x810E50 KwUb 0.9961 fak_ub_b1 0.00 0.9961 FUNCTION_LIST ACIFI IF_DATA DIM_X DIRECT 0x810E50 /end CHARACTERISTIC
/begin CHARACTERISTIC FWEAUF "Rekursionskonstante Wiedereinsetzfaktor zunehmend" VALUE 0x810E51 KwUb 0.9961 fak_ub_b1 0.00 0.9961 FUNCTION_LIST ACIFI IF_DATA DIM_X DIRECT 0x810E51 /end CHARACTERISTIC
/begin CHARACTERISTIC FWEMXT "maximaler Faktor Wiedereinsetzen Temperaturkennlinie" CURVE 0x818497 KlAUbSstUbWUb 0.9922 fak_ub_b2 1.000 1.992 FUNCTION_LIST ACIFI IF_DATA DIM_X DIRECT 0x818497
 /begin AXIS_DESCR STD_AXIS tmot temp_ub_q0p75_o48 8 -48.00 143.3 DEPOSIT ABSOLUT /end AXIS_DESCR
/end CHARACTERISTIC
/begin CHARACTERISTIC FWFN "Faktor Wandfilm Drehzahleinfluss" VALUE 0x811333 KwUb 1.494 rel_ub_b1p4941 0.00 1.494 FUNCTION_LIST ESUK IF_DATA DIM_X DIRECT 0x811333 /end CHARACTERISTIC
/begin CHARACTERISTIC FWFTBR "Gewichtungsfaktor für ftbr" CURVE 0x81BE06 KlAUwSstSwWUw 1.999969 fak_uw_b2 0.00 1.999969 FUNCTION_LIST BGTMPK IF_DATA DIM_X DIRECT 0x81BE06
 /begin AXIS_DESCR STD_AXIS evtmod temp_sw_q0p75 14 -24576.00 24575.25 DEPOSIT ABSOLUT /end AXIS_DESCR
/end CHARACTERISTIC
/begin CHARACTERISTIC FWLKFTBR "Warmlaufkorrektur für Brennraumtemperaturmodell" CURVE 0x81BE40 KlAUwSstSwWUw 1.999969 fak_uw_b2 0.00 1.999969 FUNCTION_LIST BGTMPK IF_DATA DIM_X DIRECT 0x81BE40
 /begin AXIS_DESCR STD_AXIS tmotdif_w temp_sw_q0p75 14 -24576.00 24575.25 DEPOSIT ABSOLUT /end AXIS_DESCR
/end CHARACTERISTIC
/begin CHARACTERISTIC FWMABGW "Faktor für Wärmemengen bei Wiederholstart für Taupunktende Abgas vor Vorkat" VALUE 0x8181ED KwUb 0.9961 fak_ub_b1 0.00 0.9961 FUNCTION_LIST ATM IF_DATA DIM_X DIRECT 0x8181ED /end CHARACTERISTIC
/begin CHARACTERISTIC FWMABGW2 "Faktor für Wärmemengen bei Wiederholstart Abgas Bank2" VALUE 0x8181EE KwUb 0.9961 fak_ub_b1 0.00 0.9961 FUNCTION_LIST ATM IF_DATA DIM_X DIRECT 0x8181EE /end CHARACTERISTIC
/begin CHARACTERISTIC FWMKATW "Faktor für Wärmemengen bei Wiederholstart für Taupunktende hinter Hauptkat" VALUE 0x8181EF KwUb 0.9961 fak_ub_b1 0.00 0.9961 FUNCTION_LIST ATM IF_DATA DIM_X DIRECT 0x8181EF /end CHARACTERISTIC
/begin CHARACTERISTIC FWMKATW2 "Faktor für Wärmemengen bei Wiederholstart für Taupunktende hinter Hauptkat Bank2" VALUE 0x8181F0 KwUb 0.9961 fak_ub_b1 0.00 0.9961 FUNCTION_LIST ATM IF_DATA DIM_X DIRECT 0x8181F0 /end CHARACTERISTIC
/begin CHARACTERISTIC FWMLHFMMN "Wichtungsfaktor für minimale HFM-Luftmassen Schwelle in Abhängigkeit von d.Höhe" CURVE 0x81BB18 KlAUwSstUwWUw 0.9999847 fak_uw_b1 0.00 0.9999847 FUNCTION_LIST DHFM IF_DATA DIM_X DIRECT 0x81BB18 /begin AXIS_DESCR STD_AXIS fho_w fak_uw_b4 2 0.00 3.999939 DEPOSIT ABSOLUT /end AXIS_DESCR /end CHARACTERISTIC
/begin CHARACTERISTIC FWNMOT "Einschaltschwelle nmot für Funkenbandzündung" VALUE 0x8123E5 KwUb 3000. nmot_ub_q40 0.00 3000. FUNCTION_LIST ZUESZ IF_DATA DIM_X DIRECT 0x8123E5 /end CHARACTERISTIC
/begin CHARACTERISTIC FWNWLRAO "Obere Grenze Gemischkorrektur zur Deaktivierung LR" VALUE 0x81114A KwUb 3.984 fak_ub_b4 0.00 3.984 FUNCTION_LIST ESNWS IF_DATA DIM_X DIRECT 0x81114A /end CHARACTERISTIC
/begin CHARACTERISTIC FWNWLRAU "Untere Grenze Gemischkorrektur zur Deaktivierung LR" VALUE 0x81114B KwUb 3.984 fak_ub_b4 0.00 3.984 FUNCTION_LIST ESNWS IF_DATA DIM_X DIRECT 0x81114B /end CHARACTERISTIC
/begin CHARACTERISTIC FWPEDRLS "Faktor zur direkten rlsol-Vorgabe aus wped (Applikation)" VALUE 0x815314 KwUw 3.999939 fak_uw_b4 0.00 3.999939 FUNCTION_LIST MDFUE IF_DATA DIM_X DIRECT 0x815314 /end CHARACTERISTIC
/begin CHARACTERISTIC FWRLDKNM "KL für Wichtung der rel. Luftfüllung aus DK-Signal berechnet in Abh. von nmot" CURVE 0x8148DE KlAUwSstUwWUw 1.999969 fak_uw_b2 0.00 1.999969 FUNCTION_LIST BGMSZS IF_DATA DIM_X DIRECT 0x8148DE
 /begin AXIS_DESCR STD_AXIS nmot_w nmot_uw_q0p25 6 0.00 16383.75 DEPOSIT ABSOLUT /end AXIS_DESCR
/end CHARACTERISTIC
/begin CHARACTERISTIC FWSTAA1 "Wichtung Nachstart" CURVE 0x8110F0 GklWUb 1.992 fak_ub_b2 0.00 1.992 FUNCTION_LIST ESNST IF_DATA DIM_X DIRECT 0x8110F0
 /begin AXIS_DESCR COM_AXIS kstaa fak_ub_b2 6 0.00 1.992 AXIS_PTS_REF SKS06ESUB /end AXIS_DESCR
/end CHARACTERISTIC
/begin CHARACTERISTIC FWSTAA2 "Wichtung Nachstart Umschaltschwelle" CURVE 0x8110F6 GklWUb 1.992 fak_ub_b2 0.00 1.992 FUNCTION_LIST ESNST IF_DATA DIM_X DIRECT 0x8110F6
 /begin AXIS_DESCR COM_AXIS kstaa fak_ub_b2 6 0.00 1.992 AXIS_PTS_REF SKS06ESUB /end AXIS_DESCR
/end CHARACTERISTIC
/begin CHARACTERISTIC FWSTAA3 "Wichtung Nachstart Abregelung Bereich 1" CURVE 0x8110FC GklWUb 1.992 fak_ub_b2 0.00 1.992 FUNCTION_LIST ESNST IF_DATA DIM_X DIRECT 0x8110FC
 /begin AXIS_DESCR COM_AXIS kstaa fak_ub_b2 6 0.00 1.992 AXIS_PTS_REF SKS06ESUB /end AXIS_DESCR
/end CHARACTERISTIC
/begin CHARACTERISTIC FWSTAA4 "Wichtung Nachstart Abregelung Bereich 2" CURVE 0x811102 GklWUb 1.992 fak_ub_b2 0.00 1.992 FUNCTION_LIST ESNST IF_DATA DIM_X DIRECT 0x811102
 /begin AXIS_DESCR COM_AXIS kstaa fak_ub_b2 6 0.00 1.992 AXIS_PTS_REF SKS06ESUB /end AXIS_DESCR
/end CHARACTERISTIC
/begin CHARACTERISTIC FZANSSA1 "Faktor für zündsynchrone Abregelung des Nachstartfaktors bei Heißstart Bereich 1" CURVE 0x818953 GklWUb 0.249023438 fak_ub_b0p25 0.00 0.249023438 FUNCTION_LIST ESNST IF_DATA DIM_X DIRECT 0x818953
 /begin AXIS_DESCR COM_AXIS tans temp_ub_q0p75_o48 6 -48.00 143.3 AXIS_PTS_REF STA06ESUB /end AXIS_DESCR
/end CHARACTERISTIC
/begin CHARACTERISTIC FZANSSA2 "Faktor für zündsynchrone Abregelung des Nachstartfaktors bei Heißstart Bereich 2" CURVE 0x818959 GklWUb 0.249023438 fak_ub_b0p25 0.00 0.249023438 FUNCTION_LIST ESNST IF_DATA DIM_X DIRECT 0x818959
 /begin AXIS_DESCR COM_AXIS tans temp_ub_q0p75_o48 6 -48.00 143.3 AXIS_PTS_REF STA06ESUB /end AXIS_DESCR
/end CHARACTERISTIC
/begin CHARACTERISTIC FZANSSM1 "Faktor für zündsynchrone Abregelung des Nachstartfaktors oberhalb Schwelle" CURVE 0x81895F GklWUb 0.249023438 fak_ub_b0p25 0.00 0.249023438 FUNCTION_LIST ESNST IF_DATA DIM_X DIRECT 0x81895F
 /begin AXIS_DESCR COM_AXIS tmst temp_ub_q0p75_o48 12 -48.00 143.3 AXIS_PTS_REF STS12ESUB /end AXIS_DESCR
/end CHARACTERISTIC
/begin CHARACTERISTIC FZANSSM2 "Faktor für zündsynchrone Abregelung des Nachstartfaktors unterhalb Schwelle" CURVE 0x81896B GklWUb 0.249023438 fak_ub_b0p25 0.00 0.249023438 FUNCTION_LIST ESNST IF_DATA DIM_X DIRECT 0x81896B
 /begin AXIS_DESCR COM_AXIS tmst temp_ub_q0p75_o48 12 -48.00 143.3 AXIS_PTS_REF STS12ESUB /end AXIS_DESCR
/end CHARACTERISTIC
/begin CHARACTERISTIC FZN0 "Zylinderindividueller Faktor bei neutraler NW-Stellung EV 1" CURVE 0x810E52 GklWUb 1.992 fak_ub_b2 0.00 1.992 FUNCTION_LIST ACIFI IF_DATA DIM_X DIRECT 0x810E52
 /begin AXIS_DESCR COM_AXIS nmot nmot_ub_q40 16 0.00 10200. AXIS_PTS_REF SNM16CIUB /end AXIS_DESCR
/end CHARACTERISTIC
/begin CHARACTERISTIC FZN1 "Zylinderindividueller Faktor bei neutraler NW-Stellung EV 1" CURVE 0x810E62 GklWUb 1.992 fak_ub_b2 0.00 1.992 FUNCTION_LIST ACIFI IF_DATA DIM_X DIRECT 0x810E62
 /begin AXIS_DESCR COM_AXIS nmot nmot_ub_q40 16 0.00 10200. AXIS_PTS_REF SNM16CIUB /end AXIS_DESCR
/end CHARACTERISTIC
/begin CHARACTERISTIC FZN2 "Zylinderindividueller Faktor bei neutraler NW-Stellung EV 2" CURVE 0x810E72 GklWUb 1.992 fak_ub_b2 0.00 1.992 FUNCTION_LIST ACIFI IF_DATA DIM_X DIRECT 0x810E72
 /begin AXIS_DESCR COM_AXIS nmot nmot_ub_q40 16 0.00 10200. AXIS_PTS_REF SNM16CIUB /end AXIS_DESCR
/end CHARACTERISTIC
/begin CHARACTERISTIC FZN3 "Zylinderindividueller Faktor bei neutraler NW-Stellung EV 3" CURVE 0x810E82 GklWUb 1.992 fak_ub_b2 0.00 1.992 FUNCTION_LIST ACIFI IF_DATA DIM_X DIRECT 0x810E82
 /begin AXIS_DESCR COM_AXIS nmot nmot_ub_q40 16 0.00 10200. AXIS_PTS_REF SNM16CIUB /end AXIS_DESCR
/end CHARACTERISTIC
/begin CHARACTERISTIC FZN4 "Zylinderindividueller Faktor bei neutraler NW-Stellung EV 4" CURVE 0x810E92 GklWUb 1.992 fak_ub_b2 0.00 1.992 FUNCTION_LIST ACIFI IF_DATA DIM_X DIRECT 0x810E92
 /begin AXIS_DESCR COM_AXIS nmot nmot_ub_q40 16 0.00 10200. AXIS_PTS_REF SNM16CIUB /end AXIS_DESCR
/end CHARACTERISTIC
/begin CHARACTERISTIC FZN5 "Zylinderindividueller Faktor bei neutraler NW-Stellung EV 5" CURVE 0x810EA2 GklWUb 1.992 fak_ub_b2 0.00 1.992 FUNCTION_LIST ACIFI IF_DATA DIM_X DIRECT 0x810EA2
 /begin AXIS_DESCR COM_AXIS nmot nmot_ub_q40 16 0.00 10200. AXIS_PTS_REF SNM16CIUB /end AXIS_DESCR
/end CHARACTERISTIC
/begin CHARACTERISTIC FZNWN0 "Zylinderindividueller Faktor bei aktiver NW-Stellung EV 1" CURVE 0x810EB2 GklWUb 1.992 fak_ub_b2 0.00 1.992 FUNCTION_LIST ACIFI IF_DATA DIM_X DIRECT 0x810EB2
 /begin AXIS_DESCR COM_AXIS nmot nmot_ub_q40 16 0.00 10200. AXIS_PTS_REF SNM16CIUB /end AXIS_DESCR
/end CHARACTERISTIC
/begin CHARACTERISTIC FZNWN1 "Zylinderindividueller Faktor bei aktiver NW-Stellung EV 1" CURVE 0x810EC2 GklWUb 1.992 fak_ub_b2 0.00 1.992 FUNCTION_LIST ACIFI IF_DATA DIM_X DIRECT 0x810EC2
 /begin AXIS_DESCR COM_AXIS nmot nmot_ub_q40 16 0.00 10200. AXIS_PTS_REF SNM16CIUB /end AXIS_DESCR
/end CHARACTERISTIC
/begin CHARACTERISTIC FZNWN2 "Zylinderindividueller Faktor bei aktiver NW-Stellung EV 2" CURVE 0x810ED2 GklWUb 1.992 fak_ub_b2 0.00 1.992 FUNCTION_LIST ACIFI IF_DATA DIM_X DIRECT 0x810ED2
 /begin AXIS_DESCR COM_AXIS nmot nmot_ub_q40 16 0.00 10200. AXIS_PTS_REF SNM16CIUB /end AXIS_DESCR
/end CHARACTERISTIC
/begin CHARACTERISTIC FZNWN3 "Zylinderindividueller Faktor bei aktiver NW-Stellung EV 3" CURVE 0x810EE2 GklWUb 1.992 fak_ub_b2 0.00 1.992 FUNCTION_LIST ACIFI IF_DATA DIM_X DIRECT 0x810EE2
 /begin AXIS_DESCR COM_AXIS nmot nmot_ub_q40 16 0.00 10200. AXIS_PTS_REF SNM16CIUB /end AXIS_DESCR
/end CHARACTERISTIC
/begin CHARACTERISTIC FZNWN4 "Zylinderindividueller Faktor bei aktiver NW-Stellung EV 4" CURVE 0x810EF2 GklWUb 1.992 fak_ub_b2 0.00 1.992 FUNCTION_LIST ACIFI IF_DATA DIM_X DIRECT 0x810EF2
 /begin AXIS_DESCR COM_AXIS nmot nmot_ub_q40 16 0.00 10200. AXIS_PTS_REF SNM16CIUB /end AXIS_DESCR
/end CHARACTERISTIC
/begin CHARACTERISTIC FZNWN5 "Zylinderindividueller Faktor bei aktiver NW-Stellung EV 5" CURVE 0x810F02 GklWUb 1.992 fak_ub_b2 0.00 1.992 FUNCTION_LIST ACIFI IF_DATA DIM_X DIRECT 0x810F02
 /begin AXIS_DESCR COM_AXIS nmot nmot_ub_q40 16 0.00 10200. AXIS_PTS_REF SNM16CIUB /end AXIS_DESCR
/end CHARACTERISTIC
/begin CHARACTERISTIC FZWKHMX "Normierung für Faktor Momentenreserve Katheizen" VALUE 0x812A8A KwUb 0.9961 fak_ub_b1 0.00 0.9961 FUNCTION_LIST ZWMIN IF_DATA DIM_X DIRECT 0x812A8A /end CHARACTERISTIC
/begin CHARACTERISTIC FZWSTNM "Zündwinkel im Start" CURVE 0x8179A4 KlAUbSstUbWSb 191.3 zw_sb_q0p75 -96.00 95.25 FUNCTION_LIST ZWSTT IF_DATA DIM_X DIRECT 0x8179A4 /begin AXIS_DESCR STD_AXIS nmot nmot_ub_q40 6 0.00 10200. DEPOSIT ABSOLUT /end AXIS_DESCR /end CHARACTERISTIC
/begin CHARACTERISTIC FZWSTTM "Zündwinkel im Start" CURVE 0x81E39A KlAUbSstUbWSb 191.3 zw_sb_q0p75 -96.00 95.25 FUNCTION_LIST ZWSTT IF_DATA DIM_X DIRECT 0x81E39A
 /begin AXIS_DESCR STD_AXIS tmst temp_ub_q0p75_o48 6 -48.00 143.3 DEPOSIT ABSOLUT /end AXIS_DESCR
/end CHARACTERISTIC
/begin CHARACTERISTIC GAFGRO "Max. zul. Gang bei FGR-Betrieb" VALUE 0x810F2A KwUb 255.0 dez 0.00 255.0 FUNCTION_LIST BBFGR IF_DATA DIM_X DIRECT 0x810F2A /end CHARACTERISTIC
/begin CHARACTERISTIC GAFGRU "Min. zul. Gang bei FGR-Betrieb" VALUE 0x810F2B KwUb 255.0 dez 0.00 255.0 FUNCTION_LIST BBFGR IF_DATA DIM_X DIRECT 0x810F2B /end CHARACTERISTIC
/begin CHARACTERISTIC GANGIMDB "Gang, bei welchem geschw.-abhängige Momentenaufbaubegr. wirkt." VALUE 0x811B45 KwUb 255.0 dez 0.00 255.0 FUNCTION_LIST MDBGV IF_DATA DIM_X DIRECT 0x811B45 /end CHARACTERISTIC
/begin CHARACTERISTIC GFDLDN "LLR: Gewichtungsfaktor für D-Verstärkung auf Luftpfad" CURVE 0x81160B GklWUb 0.9961 rel_ub_b1p0 0.00 0.9961 FUNCTION_LIST LLRRM IF_DATA DIM_X DIRECT 0x81160B
 /begin AXIS_DESCR COM_AXIS dns nmotd_sb_q10 6 -1280. 1270. AXIS_PTS_REF SNS06LLSB /end AXIS_DESCR
/end CHARACTERISTIC
/begin CHARACTERISTIC GWPLDOB "Gradient Pedalwinkel zum Ausloesen des Overboost" VALUE 0x8193F9 KwUb 2000. rel_ub_q8 0.00 2000. FUNCTION_LIST LDOB IF_DATA DIM_X DIRECT 0x8193F9 /end CHARACTERISTIC
/begin CHARACTERISTIC GWPLDU "Gradientenschwelle pedal für dynamische Freigabe Umluftventilsteuerung" VALUE 0x8114AA KwSb 99.60 rel_sb_q0p39 -50.00 49.61 FUNCTION_LIST LDUVST IF_DATA DIM_X DIRECT 0x8114AA /end CHARACTERISTIC
/begin CHARACTERISTIC GWPLDUR "Gradient Pedalwert für Reset LDR Umluftventilansteuerung dynamisch" VALUE 0x8114AB KwSb 99.60 rel_sb_q0p39 -50.00 49.61 FUNCTION_LIST LDUVST IF_DATA DIM_X DIRECT 0x8114AB /end CHARACTERISTIC
/begin CHARACTERISTIC HLSUKORMX "Maximalwert des Korrekturfaktors für die  LSU-Heizleistung" VALUE 0x8198FF KwUb 1.992 fak_ub_b2 0.00 1.992 FUNCTION_LIST HLSU IF_DATA DIM_X DIRECT 0x8198FF /end CHARACTERISTIC
/begin CHARACTERISTIC HSLDSUA "Hysterese für stationäre Schubumluftventilansteuerung" VALUE 0x8114AC KwUb 2550. p_ub_q10 0.00 2550. FUNCTION_LIST LDUVST IF_DATA DIM_X DIRECT 0x8114AC /end CHARACTERISTIC
/begin CHARACTERISTIC HSSLDSUA "Hysterese zum Schließen der Turbo Umluftventile im Stationärpfad" VALUE 0x8114AD KwUb 3.984 fak_ub_b4 0.00 3.984 FUNCTION_LIST LDUVST IF_DATA DIM_X DIRECT 0x8114AD /end CHARACTERISTIC
/begin CHARACTERISTIC HYKATA "Absolute Hysterese bei Katalysatordiagnose" VALUE 0x8183BB KwUb 0.9961 fak_ub_b1 0.00 0.9961 FUNCTION_LIST DKATLRS IF_DATA DIM_X DIRECT 0x8183BB /end CHARACTERISTIC
/begin CHARACTERISTIC HYKATR "Relative Hysterese bei Katalysatordiagnose" VALUE 0x8183BC KwUb 0.9961 fak_ub_b1 0.00 0.9961 FUNCTION_LIST DKATLRS IF_DATA DIM_X DIRECT 0x8183BC /end CHARACTERISTIC
/begin CHARACTERISTIC ILMLKAXTK "Schwelle Fettfläche Kat-Ausräumen nach SA, Funktion der Kat-Temperatur" CURVE 0x81E1A8 KlAUwSstUwWUw 4660.267 m_uw_b4660 0.00 4660.267 FUNCTION_LIST LRSKA IF_DATA DIM_X DIRECT 0x81E1A8
 /begin AXIS_DESCR STD_AXIS tkatm_w temp_uw_q0p0195_o50 5 -50.00000 1229.980 DEPOSIT ABSOLUT /end AXIS_DESCR
/end CHARACTERISTIC
/begin CHARACTERISTIC ILMLKAXTK2 "Schwelle Fettfläche Kat-Ausräumen nach SA, Funktion der Kat-Temperartur" CURVE 0x81E1BE KlAUwSstUwWUw 4660.267 m_uw_b4660 0.00 4660.267 FUNCTION_LIST LRSKA IF_DATA DIM_X DIRECT 0x81E1BE
 /begin AXIS_DESCR STD_AXIS tkatm2_w temp_uw_q0p0195_o50 5 -50.00000 1229.980 DEPOSIT ABSOLUT /end AXIS_DESCR
/end CHARACTERISTIC
/begin CHARACTERISTIC ILMRMN "Minimalwert des Luftmassenreglers" VALUE 0x813F70 KwSw 1535.977 rel_sw_q0p0234 -768.0000 767.9766 FUNCTION_LIST FUEREG IF_DATA DIM_X DIRECT 0x813F70 /end CHARACTERISTIC
/begin CHARACTERISTIC ILMRMX "Maximalwert des Luftmassenreglers" VALUE 0x813F72 KwSw 1535.977 rel_sw_q0p0234 -768.0000 767.9766 FUNCTION_LIST FUEREG IF_DATA DIM_X DIRECT 0x813F72 /end CHARACTERISTIC
/begin CHARACTERISTIC ILMRN "Integratorverstärkung von Luftmassenregler" CURVE 0x818635 GklWUb 7.969 fak_ub_b8 0.00 7.969 FUNCTION_LIST FUEREG IF_DATA DIM_X DIRECT 0x818635
 /begin AXIS_DESCR COM_AXIS nmot nmot_ub_q40 8 0.00 10200. AXIS_PTS_REF SNM08FEUB /end AXIS_DESCR
/end CHARACTERISTIC
/begin CHARACTERISTIC IMLATDSL "min. Luftmassenfluß für Adaption/Zusatzdiagnose" VALUE 0x81A00E KwUw 23.30133 m_uw_b23p3 0.00 23.30133 FUNCTION_LIST DSLSLRS IF_DATA DIM_X DIRECT 0x81A00E /end CHARACTERISTIC
/begin CHARACTERISTIC IMLATDSLK "min. Luftmassenfluß für Kurztest" VALUE 0x81A010 KwUw 23.30133 m_uw_b23p3 0.00 23.30133 FUNCTION_LIST DSLSLRS T2DFA T2LID IF_DATA DIM_X DIRECT 0x81A010 /end CHARACTERISTIC
/begin CHARACTERISTIC IMLDSL "minimale durchgeströmte Luftmasse" VALUE 0x818102 KwUb 0.9961 fak_ub_b1 0.00 0.9961 FUNCTION_LIST DSLSLRS IF_DATA DIM_X DIRECT 0x818102 /end CHARACTERISTIC
/begin CHARACTERISTIC IMLHS "Luftmassenintegral Heißstart" VALUE 0x811273 KwUb 23.21 m_ub_b23p3 0.00 23.21 FUNCTION_LIST ESSTT IF_DATA DIM_X DIRECT 0x811273 /end CHARACTERISTIC
/begin CHARACTERISTIC IMLKHTMS "imlpr-Schwelle für Übergang auf Lambda-Katheizen" CURVE 0x81570E KlAUbSstUbWUb 0.9961 fak_ub_b1 0.00 0.9961 FUNCTION_LIST BBKHZ IF_DATA DIM_X DIRECT 0x81570E
 /begin AXIS_DESCR STD_AXIS tmst temp_ub_q0p75_o48 8 -48.00 143.3 DEPOSIT ABSOLUT /end AXIS_DESCR
/end CHARACTERISTIC
/begin CHARACTERISTIC IMLKVSMX "Maximale Integrationsschwelle für Fehlerfreigabe in DKVS (Tank leer)" VALUE 0x81C79A KwUw 233.0133 m_q0p00355 0.00 233.0133 FUNCTION_LIST DKVS IF_DATA DIM_X DIRECT 0x81C79A /end CHARACTERISTIC
/begin CHARACTERISTIC IMLLASKH "imlpr-Schwelle für Übergang auf Lambda-Abgas-Vorgabe" VALUE 0x819151 KwUb 0.9961 fak_ub_b1 0.00 0.9961 FUNCTION_LIST LAKH IF_DATA DIM_X DIRECT 0x819151 /end CHARACTERISTIC
/begin CHARACTERISTIC IMLPRNWA "Nockenwelle rückschalten bei Katheizen" CURVE 0x81BFA0 KlAUbSstUbWUw 0.9999847 fak_uw_b1 0.00 0.9999847 FUNCTION_LIST NWS IF_DATA DIM_X DIRECT 0x81BFA0
 /begin AXIS_DESCR STD_AXIS tmst temp_ub_q0p75_o48 6 -48.00 143.3 DEPOSIT ABSOLUT /end AXIS_DESCR
/end CHARACTERISTIC
/begin CHARACTERISTIC IMLPRNWE "Nockenwelle schalten bei Katheizen" CURVE 0x81BFB4 KlAUbSstUbWUw 0.9999847 fak_uw_b1 0.00 0.9999847 FUNCTION_LIST NWS IF_DATA DIM_X DIRECT 0x81BFB4
 /begin AXIS_DESCR STD_AXIS tmst temp_ub_q0p75_o48 6 -48.00 143.3 DEPOSIT ABSOLUT /end AXIS_DESCR
/end CHARACTERISTIC
/begin CHARACTERISTIC IMLSALR "Schwellwert integr. Luftmasse f. Einschaltverzögerung LR nach SA" VALUE 0x816D92 KwUw 4660.267 m_uw_b4660 0.00 4660.267 FUNCTION_LIST LRSEB IF_DATA DIM_X DIRECT 0x816D92 /end CHARACTERISTIC
/begin CHARACTERISTIC IMLSLMN "min. Verhältnisfaktor psum_w/mlsu für Einschaltung SLS" VALUE 0x81815B KwUb 0.9961 fak_ub_b1 0.00 0.9961 FUNCTION_LIST SLS IF_DATA DIM_X DIRECT 0x81815B /end CHARACTERISTIC
/begin CHARACTERISTIC IMLSLMX "max. Verhältnisfaktor psum_w/mlsu für Einschaltung SLS" VALUE 0x81815C KwUb 0.9961 fak_ub_b1 0.00 0.9961 FUNCTION_LIST SLS IF_DATA DIM_X DIRECT 0x81815C /end CHARACTERISTIC
/begin CHARACTERISTIC IMLSLSA "Schwelle Luftmassenintegral für Anfang Sekundärluft im Abgas" VALUE 0x81A05A KwUw 4660.267 m_uw_b4660 0.00 4660.267 FUNCTION_LIST SLS IF_DATA DIM_X DIRECT 0x81A05A /end CHARACTERISTIC
/begin CHARACTERISTIC IMLSLSE "Schwelle Luftmassenintegral für Ende Sekundärluft im Abgas" VALUE 0x81A05C KwUw 4660.267 m_uw_b4660 0.00 4660.267 FUNCTION_LIST SLS IF_DATA DIM_X DIRECT 0x81A05C /end CHARACTERISTIC
/begin CHARACTERISTIC IMSDTEVA "Schwelle für Intergal des Massenstroms TEV nach längerm TE-Stop" VALUE 0x819B3D KwUb 11.32 m_ub_q0p0444 0.00 11.32 FUNCTION_LIST DTEV IF_DATA DIM_X DIRECT 0x819B3D /end CHARACTERISTIC
/begin CHARACTERISTIC IMTUMGTA "Schwelle integrierte Luftmasse für Bestimmung Umgebungstemperatur" VALUE 0x8190C2 KwUb 23.21 m_ub_b23p3 0.00 23.21 FUNCTION_LIST GGTFUMG IF_DATA DIM_X DIRECT 0x8190C2 /end CHARACTERISTIC
/begin CHARACTERISTIC IMTUMTA "Schwelle integrierte Luftmasse für Bestimmung Umgebungstemperatur" VALUE 0x818804 KwUb 23.21 m_ub_b23p3 0.00 23.21 FUNCTION_LIST BGTABS IF_DATA DIM_X DIRECT 0x818804 /end CHARACTERISTIC
/begin CHARACTERISTIC IMTUMTAT "Schwelle integrierte Luftmasse für Bestimmung Umgebungstemperatur aus TANS" VALUE 0x8181F1 KwUb 23.21 m_ub_b23p3 0.00 23.21 FUNCTION_LIST ATM IF_DATA DIM_X DIRECT 0x8181F1 /end CHARACTERISTIC
/begin CHARACTERISTIC INCKSTAI "Inkrement-Step für STADAP-Faktor" CURVE 0x81143B KlAUbSstUbWSb 0.9922 fak_sb_b1 0.00 0.9922 FUNCTION_LIST STADAP IF_DATA DIM_X DIRECT 0x81143B /begin AXIS_DESCR STD_AXIS tmadb dez 3 0.00 255.0 DEPOSIT ABSOLUT /end AXIS_DESCR /end CHARACTERISTIC
/begin CHARACTERISTIC IP1A_MX_UM "max. Spannung für DK-Istwert-Poti 1 am unteren Anschlag für die Funktionsüberw." VALUE 0x817D13 KwUb 4.9805 spg_ub_q0p019 0.00 4.9805 FUNCTION_LIST UFRLC IF_DATA DIM_X DIRECT 0x817D13 /end CHARACTERISTIC
/begin CHARACTERISTIC IP2A_MN_UM "min. Spannung für DK-Istwert-Poti 2 am unteren Anschlag für die Funktionsüberw." VALUE 0x817D14 KwUb 4.9805 spg_ub_q0p019 0.00 4.9805 FUNCTION_LIST UFRLC IF_DATA DIM_X DIRECT 0x817D14 /end CHARACTERISTIC
/begin CHARACTERISTIC IPA_T_UM "Fehlertoleranzzeit für unteren DK-Anschlag im ungültigen Bereich f. d. Fktüberw." VALUE 0x817D15 KwUb 10200.0 t40ms_ub_b10200 0.00 10200.0 FUNCTION_LIST UFRLC IF_DATA DIM_X DIRECT 0x817D15 /end CHARACTERISTIC
/begin CHARACTERISTIC IVDN "LLR: I-Verstärkung bei stehendem Fahrzeug" CURVE 0x811611 GklWUb 0.6076 rel_q0p002383 0.00 0.6076 FUNCTION_LIST LLRRM IF_DATA DIM_X DIRECT 0x811611
 /begin AXIS_DESCR COM_AXIS dn nmotd_sb_q10 6 -1280. 1270. AXIS_PTS_REF SDN06LLSB /end AXIS_DESCR
/end CHARACTERISTIC
/begin CHARACTERISTIC IVDNDTE "LLR: I-Verstärkung bei DTEV" CURVE 0x811617 GklWUb 0.6076 rel_q0p002383 0.00 0.6076 FUNCTION_LIST LLRRM IF_DATA DIM_X DIRECT 0x811617
 /begin AXIS_DESCR COM_AXIS dn nmotd_sb_q10 6 -1280. 1270. AXIS_PTS_REF SDN06LLSB /end AXIS_DESCR
/end CHARACTERISTIC
/begin CHARACTERISTIC IVDNV "LLR: I-Verstärkung bei rollendem Fahrzeug" CURVE 0x81161D GklWUb 0.6076 rel_q0p002383 0.00 0.6076 FUNCTION_LIST LLRRM IF_DATA DIM_X DIRECT 0x81161D
 /begin AXIS_DESCR COM_AXIS dn nmotd_sb_q10 6 -1280. 1270. AXIS_PTS_REF SDN06LLSB /end AXIS_DESCR
/end CHARACTERISTIC
/begin CHARACTERISTIC IVDYNLSU "Startwert für dynlsu_w" VALUE 0x81B8F4 KwUw 15.99976 fak_uw_b16 0.00 15.99976 FUNCTION_LIST DLSU IF_DATA DIM_X DIRECT 0x81B8F4 /end CHARACTERISTIC
/begin CHARACTERISTIC KAFLTESG "Ausfußkonstante Leitung TEV-Saugrohr" VALUE 0x81E22A KwUw 28.79956 fak1_q4p3945Em4 0.00 28.79956 FUNCTION_LIST BGTEV IF_DATA DIM_X DIRECT 0x81E22A /end CHARACTERISTIC
/begin CHARACTERISTIC KAMFZ "Segment- bzw. Messfensterbeginn bei Segmentzeiterfassung Aussetzererkennung" VALUE 0x8181A4 KwSb 1530. kw_tooth_sy -768.0 762.0 FUNCTION_LIST DMDTSB IF_DATA DIM_X DIRECT 0x8181A4 /end CHARACTERISTIC
/begin CHARACTERISTIC KATBFML "Filterzeitkonstante für Signaldämpfung in Katbelastung" CURVE 0x8183BD GklWUb 12.7498039 zk50msxs_ub_b12p8 0.0501960784 12.8000000 FUNCTION_LIST DKATLRS IF_DATA DIM_X DIRECT 0x8183BD /begin AXIS_DESCR COM_AXIS ml m_ub_b1020 5 0.00 1020. AXIS_PTS_REF SML05DKUB /end AXIS_DESCR /end CHARACTERISTIC
/begin CHARACTERISTIC KATBFMN "Schwellwert für kleine Katalysatorbelastung" VALUE 0x8183C2 KwUb 0.9961 fak_ub_b1 0.00 0.9961 FUNCTION_LIST DKATLRS IF_DATA DIM_X DIRECT 0x8183C2 /end CHARACTERISTIC
/begin CHARACTERISTIC KATBFMNT "Schwellwert für kleine Katalysatorbelastung bei Testeransteuerung" VALUE 0x8183C3 KwUb 0.9961 fak_ub_b1 0.00 0.9961 FUNCTION_LIST DKATLRS IF_DATA DIM_X DIRECT 0x8183C3 /end CHARACTERISTIC
/begin CHARACTERISTIC KATBFN "normierter Mittelwert der Sondenamplitude" VALUE 0x8183C4 KwUb 0.9961 fak_ub_b1 0.00 0.9961 FUNCTION_LIST DKATLRS IF_DATA DIM_X DIRECT 0x8183C4 /end CHARACTERISTIC
/begin CHARACTERISTIC KATBFNM "Normierungsfaktor multiplikativ für Katbelastung" VALUE 0x8183C5 KwUb 1.330 spg_ub_b1p33 0.00 1.330 FUNCTION_LIST DKATLRS IF_DATA DIM_X DIRECT 0x8183C5 /end CHARACTERISTIC
/begin CHARACTERISTIC KATBFNP "Normierungsfaktor additiv für Katbelastung" VALUE 0x8183C6 KwUb 1.330 spg_ub_b1p33 0.00 1.330 FUNCTION_LIST DKATLRS IF_DATA DIM_X DIRECT 0x8183C6 /end CHARACTERISTIC
/begin CHARACTERISTIC KATBFSX "Max. Integrationsschwelle für Stoppbedingung" VALUE 0x8183C7 KwSb 1.992 fak_sb_b1 -1.000 0.9922 FUNCTION_LIST DKATLRS T2DFA T2LID IF_DATA DIM_X DIRECT 0x8183C7 /end CHARACTERISTIC
/begin CHARACTERISTIC KATBFXM "Maximale Katbelastungsschwelle für Stoppbedingung" CURVE 0x81B8A2 GklWSw 1023.984 freq_sw_b512 -512.0000 511.9844 FUNCTION_LIST DKATLRS T2DFA T2LID IF_DATA DIM_X DIRECT 0x81B8A2 /begin AXIS_DESCR COM_AXIS ml m_ub_b1020 5 0.00 1020. AXIS_PTS_REF SML05DKUB /end AXIS_DESCR /end CHARACTERISTIC
/begin CHARACTERISTIC KATBFXT "Maximale Katbelastungsschwelle für Stoppbedingung, Testerbetrieb" VALUE 0x81B8AC KwSw 1023.984 freq_sw_b512 -512.0000 511.9844 FUNCTION_LIST DKATLRS IF_DATA DIM_X DIRECT 0x81B8AC /end CHARACTERISTIC
/begin CHARACTERISTIC KATBSG "Katalysatorspeichergröße für Katbelastung" VALUE 0x8183C8 KwUb 220.5 m_ub_b221p35 0.8681 221.4 FUNCTION_LIST DKATLRS IF_DATA DIM_X DIRECT 0x8183C8 /end CHARACTERISTIC
/begin CHARACTERISTIC KATBSH "Offset für Lambdaregelung leicht im fetten Bereich" VALUE 0x8183C9 KwUb 221.4 mgrad_ub_b221p35 0.00 221.4 FUNCTION_LIST DKATLRS IF_DATA DIM_X DIRECT 0x8183C9 /end CHARACTERISTIC
/begin CHARACTERISTIC KATBSHF "Verstärkungsfaktor für Regellagendifferenz" VALUE 0x81B8AE KwUw 9996.308 mgrad_uw_q0p0961 0.00 9996.308 FUNCTION_LIST DKATLRS IF_DATA DIM_X DIRECT 0x81B8AE /end CHARACTERISTIC
/begin CHARACTERISTIC KATBSHG "Begrenzungsfaktor der Regellagenkorrektur" VALUE 0x8183CA KwUb 0.9961 fak_ub_b1 0.00 0.9961 FUNCTION_LIST DKATLRS IF_DATA DIM_X DIRECT 0x8183CA /end CHARACTERISTIC
/begin CHARACTERISTIC KATMEXML "Exotherme Temperatur im KAT tkatm" CURVE 0x8181F2 GklWSb 1275. temp_q5 -640.0 635.0 FUNCTION_LIST ATM IF_DATA DIM_X DIRECT 0x8181F2
 /begin AXIS_DESCR COM_AXIS ml_w m_uw_b6553p5 7 0.00 6553.500 AXIS_PTS_REF SML07TMUW /end AXIS_DESCR
/end CHARACTERISTIC
/begin CHARACTERISTIC KATMEXML2 "Exotherme Temperatur im Kat, Bank 2" CURVE 0x8181F9 GklWSb 1275. temp_q5 -640.0 635.0 FUNCTION_LIST ATM IF_DATA DIM_X DIRECT 0x8181F9
 /begin AXIS_DESCR COM_AXIS ml_w m_uw_b6553p5 7 0.00 6553.500 AXIS_PTS_REF SML07TMUW /end AXIS_DESCR
/end CHARACTERISTIC
/begin CHARACTERISTIC KDLASHKI "Kennlinie über dlashkm, Bewertungsfaktor für I-Anteil in der LRHK" CURVE 0x816DCC GklWSw 1.999969 fak_sw_b1 -1.000000 0.9999695 FUNCTION_LIST LRSHK IF_DATA DIM_X DIRECT 0x816DCC
 /begin AXIS_DESCR COM_AXIS dlashkm_w fak_sw_b1 8 -1.000000 0.9999695 AXIS_PTS_REF SM108LHSW /end AXIS_DESCR
/end CHARACTERISTIC
/begin CHARACTERISTIC KDLASHKI2 "Kennlinie über dlashkm, Bewertungsfaktor für I-Anteil in der LRHK, Bank 2" CURVE 0x816DDC GklWSw 1.999969 fak_sw_b1 -1.000000 0.9999695 FUNCTION_LIST LRSHK IF_DATA DIM_X DIRECT 0x816DDC
 /begin AXIS_DESCR COM_AXIS dlashkm2_w fak_sw_b1 8 -1.000000 0.9999695 AXIS_PTS_REF SM208LHSW /end AXIS_DESCR
/end CHARACTERISTIC
/begin CHARACTERISTIC KDLASHKP "Kennlinie über dlashkm, Bewertungsfaktor für P-Anteil in der LRHK" CURVE 0x816DEC GklWSw 1.999969 fak_sw_b1 -1.000000 0.9999695 FUNCTION_LIST LRSHK IF_DATA DIM_X DIRECT 0x816DEC
 /begin AXIS_DESCR COM_AXIS dlashkm_w fak_sw_b1 8 -1.000000 0.9999695 AXIS_PTS_REF SM108LHSW /end AXIS_DESCR
/end CHARACTERISTIC
/begin CHARACTERISTIC KDLASHKP2 "Kennlinie über dlashkm, Bewertungsfaktor für P-Anteil in der LRHK, Bank 2" CURVE 0x816DFC GklWSw 1.999969 fak_sw_b1 -1.000000 0.9999695 FUNCTION_LIST LRSHK IF_DATA DIM_X DIRECT 0x816DFC
 /begin AXIS_DESCR COM_AXIS dlashkm2_w fak_sw_b1 8 -1.000000 0.9999695 AXIS_PTS_REF SM208LHSW /end AXIS_DESCR
/end CHARACTERISTIC
/begin CHARACTERISTIC KDLRIDDVE "Identifizierung des DLR-Parametersatzes zu DV-E-Typ" VALUE 0x818491 KwUb 255.0 dez 0.00 255.0 FUNCTION_LIST ADVE IF_DATA DIM_X DIRECT 0x818491 /end CHARACTERISTIC
/begin CHARACTERISTIC KDYNFA "Rekursionskonstante für LSU-Dynamik bei Kurztest" VALUE 0x813C0E KwUw 0.9999847 fak_uw_b1 0.00 0.9999847 FUNCTION_LIST DLSU IF_DATA DIM_X DIRECT 0x813C0E /end CHARACTERISTIC
/begin CHARACTERISTIC KDYNLSU "Rekursionskonstante für LSU-Dynamik" VALUE 0x813C10 KwUw 0.9999847 fak_uw_b1 0.00 0.9999847 FUNCTION_LIST DLSU IF_DATA DIM_X DIRECT 0x813C10 /end CHARACTERISTIC
/begin CHARACTERISTIC KE1N "Klopferkennungsschwelle bei Zylinderzähler 1" CURVE 0x8191EB GklWUb 15.94 fak_ub_b16 0.00 15.94 FUNCTION_LIST KRKE IF_DATA DIM_X DIRECT 0x8191EB
 /begin AXIS_DESCR COM_AXIS nmot nmot_ub_q40 16 0.00 10200. AXIS_PTS_REF SNM16KRUB /end AXIS_DESCR
/end CHARACTERISTIC
/begin CHARACTERISTIC KE2N "Klopferkennungsschwelle bei Zylinderzähler 2" CURVE 0x8191FB GklWUb 15.94 fak_ub_b16 0.00 15.94 FUNCTION_LIST KRKE IF_DATA DIM_X DIRECT 0x8191FB
 /begin AXIS_DESCR COM_AXIS nmot nmot_ub_q40 16 0.00 10200. AXIS_PTS_REF SNM16KRUB /end AXIS_DESCR
/end CHARACTERISTIC
/begin CHARACTERISTIC KE3N "Klopferkennungsschwelle bei Zylinderzähler 3" CURVE 0x81920B GklWUb 15.94 fak_ub_b16 0.00 15.94 FUNCTION_LIST KRKE IF_DATA DIM_X DIRECT 0x81920B
 /begin AXIS_DESCR COM_AXIS nmot nmot_ub_q40 16 0.00 10200. AXIS_PTS_REF SNM16KRUB /end AXIS_DESCR
/end CHARACTERISTIC
/begin CHARACTERISTIC KE4N "Klopferkennungsschwelle bei Zylinderzähler 4" CURVE 0x81921B GklWUb 15.94 fak_ub_b16 0.00 15.94 FUNCTION_LIST KRKE IF_DATA DIM_X DIRECT 0x81921B
 /begin AXIS_DESCR COM_AXIS nmot nmot_ub_q40 16 0.00 10200. AXIS_PTS_REF SNM16KRUB /end AXIS_DESCR
/end CHARACTERISTIC
/begin CHARACTERISTIC KE5N "Klopferkennungsschwelle bei Zylinderzähler 5" CURVE 0x81922B GklWUb 15.94 fak_ub_b16 0.00 15.94 FUNCTION_LIST KRKE IF_DATA DIM_X DIRECT 0x81922B
 /begin AXIS_DESCR COM_AXIS nmot nmot_ub_q40 16 0.00 10200. AXIS_PTS_REF SNM16KRUB /end AXIS_DESCR
/end CHARACTERISTIC
/begin CHARACTERISTIC KE6N "Klopferkennungsschwelle bei Zylinderzähler 6" CURVE 0x81923B GklWUb 15.94 fak_ub_b16 0.00 15.94 FUNCTION_LIST KRKE IF_DATA DIM_X DIRECT 0x81923B
 /begin AXIS_DESCR COM_AXIS nmot nmot_ub_q40 16 0.00 10200. AXIS_PTS_REF SNM16KRUB /end AXIS_DESCR
/end CHARACTERISTIC
/begin CHARACTERISTIC KE7N "Klopferkennungsschwelle bei Zylinderzähler 7" CURVE 0x81924B GklWUb 15.94 fak_ub_b16 0.00 15.94 FUNCTION_LIST KRKE IF_DATA DIM_X DIRECT 0x81924B
 /begin AXIS_DESCR COM_AXIS nmot nmot_ub_q40 16 0.00 10200. AXIS_PTS_REF SNM16KRUB /end AXIS_DESCR
/end CHARACTERISTIC
/begin CHARACTERISTIC KE8N "Klopferkennungsschwelle bei Zylinderzähler 8" CURVE 0x81925B GklWUb 15.94 fak_ub_b16 0.00 15.94 FUNCTION_LIST KRKE IF_DATA DIM_X DIRECT 0x81925B
 /begin AXIS_DESCR COM_AXIS nmot nmot_ub_q40 16 0.00 10200. AXIS_PTS_REF SNM16KRUB /end AXIS_DESCR
/end CHARACTERISTIC
/begin CHARACTERISTIC KEDNEG "Wert für die Reduzierung der Einschaltdauer LSU-Heizung nach Start" VALUE 0x8121AD KwUb 99.22 tgrad_ub_b99p6 0.3906 99.61 FUNCTION_LIST HLSU IF_DATA DIM_X DIRECT 0x8121AD /end CHARACTERISTIC
/begin CHARACTERISTIC KEDPOS "Wert für die Vergrößerung der Einschaltdauer LSU-Heizung nach Start" VALUE 0x8121AE KwUb 99.22 tgrad_ub_b99p6 0.3906 99.61 FUNCTION_LIST HLSU IF_DATA DIM_X DIRECT 0x8121AE /end CHARACTERISTIC
/begin CHARACTERISTIC KEMLN "Messfensterlänge für Klopfregelung" CURVE 0x81916F GklWUb 191.3 zw_ub_q0p75 0.00 191.3 FUNCTION_LIST GGKS IF_DATA DIM_X DIRECT 0x81916F
 /begin AXIS_DESCR COM_AXIS nmot nmot_ub_q40 16 0.00 10200. AXIS_PTS_REF SNM16KRUB /end AXIS_DESCR
/end CHARACTERISTIC
/begin CHARACTERISTIC KFABAK "Aufteilungsfaktor Wandfilm bei BA" MAP 0x81899F GkfWUb 0.9961 fak_ub_b1 0.00 0.9961 FUNCTION_LIST ESUK IF_DATA DIM_X DIRECT 0x81899F
 /begin AXIS_DESCR COM_AXIS tmot temp_ub_q0p75_o48 9 -48.00 143.3 AXIS_PTS_REF STM09ESUB /end AXIS_DESCR
 /begin AXIS_DESCR COM_AXIS nmot nmot_ub_q40 12 0.00 10200. AXIS_PTS_REF SNM12ESUB2 /end AXIS_DESCR
/end CHARACTERISTIC
/begin CHARACTERISTIC KFAMAL "Kennfeld Absenkungsfaktor für Lur-Wert bei erkannten Mehrfachaussetzern" MAP 0x8105A7 GkfWUb 0.9961 fak_ub_b1 0.00 0.9961 FUNCTION_LIST DMDLU IF_DATA DIM_X DIRECT 0x8105A7
 /begin AXIS_DESCR COM_AXIS rl rel_ub_q0p75 8 0.00 191.3 AXIS_PTS_REF SRL08DMUB /end AXIS_DESCR
 /begin AXIS_DESCR COM_AXIS nmot nmot_ub_q40 8 0.00 10200. AXIS_PTS_REF SNM08DMUB /end AXIS_DESCR
/end CHARACTERISTIC
/begin CHARACTERISTIC KFAMAL1 "Kennfeld Absenkungsfaktor für Lur-Wert bei erkannten Mehrfachaussetzern" MAP 0x8105E7 GkfWUb 0.9961 fak_ub_b1 0.00 0.9961 FUNCTION_LIST DMDLU IF_DATA DIM_X DIRECT 0x8105E7
 /begin AXIS_DESCR COM_AXIS rl rel_ub_q0p75 8 0.00 191.3 AXIS_PTS_REF SRL08DMUB /end AXIS_DESCR
 /begin AXIS_DESCR COM_AXIS nmot nmot_ub_q40 8 0.00 10200. AXIS_PTS_REF SNM08DMUB /end AXIS_DESCR
/end CHARACTERISTIC
/begin CHARACTERISTIC KFATMLA "Kennfeld Abgastemperatur-Korrektur = f(Lambda)" MAP 0x818200 GkfWSb 1275. temp_q5 -640.0 635.0 FUNCTION_LIST ATM IF_DATA DIM_X DIRECT 0x818200 /begin AXIS_DESCR COM_AXIS ml m_ub_b1020 6 0.00 1020. AXIS_PTS_REF SML06TMUB /end AXIS_DESCR
 /begin AXIS_DESCR COM_AXIS lamsbg_w fak_uw_b16 6 0.00 15.99976 AXIS_PTS_REF SLX06TMUW /end AXIS_DESCR
/end CHARACTERISTIC
/begin CHARACTERISTIC KFATMLA2 "Kennfeld Abgastemperatur-Korrektur = f(lambda) Bank2" MAP 0x818224 GkfWSb 1275. temp_q5 -640.0 635.0 FUNCTION_LIST ATM IF_DATA DIM_X DIRECT 0x818224 /begin AXIS_DESCR COM_AXIS ml m_ub_b1020 6 0.00 1020. AXIS_PTS_REF SML06TMUB /end AXIS_DESCR
 /begin AXIS_DESCR COM_AXIS lamsbg2_w fak_uw_b16 6 0.00 15.99976 AXIS_PTS_REF SLY06TMUW /end AXIS_DESCR
/end CHARACTERISTIC
/begin CHARACTERISTIC KFATMZW "Kennfeld Abgastemperatur-Korrektur = f(Zündwinkelverstellung)" MAP 0x818248 GkfWSb 1275. temp_q5 -640.0 635.0 FUNCTION_LIST ATM IF_DATA DIM_X DIRECT 0x818248 /begin AXIS_DESCR COM_AXIS ml m_ub_b1020 6 0.00 1020. AXIS_PTS_REF SML06TMUB /end AXIS_DESCR
 /begin AXIS_DESCR COM_AXIS etazwimt rel_ub_b127p5 6 0.00 127.5 AXIS_PTS_REF SEZ06TMUB /end AXIS_DESCR
/end CHARACTERISTIC
/begin CHARACTERISTIC KFATMZW2 "Kennfeld Abgastemperatur-Korrektur = f(Zündwinkel) Bank2" MAP 0x81826C GkfWSb 1275. temp_q5 -640.0 635.0 FUNCTION_LIST ATM IF_DATA DIM_X DIRECT 0x81826C /begin AXIS_DESCR COM_AXIS ml m_ub_b1020 6 0.00 1020. AXIS_PTS_REF SML06TMUB /end AXIS_DESCR
 /begin AXIS_DESCR COM_AXIS etazwimt rel_ub_b127p5 6 0.00 127.5 AXIS_PTS_REF SEZ06TMUB /end AXIS_DESCR
/end CHARACTERISTIC
/begin CHARACTERISTIC KFAVAK "Aufteilungsfaktor Wandfilm bei VA" MAP 0x818A0B GkfWUb 0.9961 fak_ub_b1 0.00 0.9961 FUNCTION_LIST ESUK IF_DATA DIM_X DIRECT 0x818A0B
 /begin AXIS_DESCR COM_AXIS tmot temp_ub_q0p75_o48 9 -48.00 143.3 AXIS_PTS_REF STM09ESUB /end AXIS_DESCR
 /begin AXIS_DESCR COM_AXIS nmot nmot_ub_q40 12 0.00 10200. AXIS_PTS_REF SNM12ESUB2 /end AXIS_DESCR
/end CHARACTERISTIC
/begin CHARACTERISTIC KFBAKL "Faktor Beschleunigungsanreicherung (K+L-Anteil)" MAP 0x818A77 GkfWUb 15.94 fak_ub_b16 0.00 15.94 FUNCTION_LIST ESUK IF_DATA DIM_X DIRECT 0x818A77
 /begin AXIS_DESCR COM_AXIS tmot temp_ub_q0p75_o48 9 -48.00 143.3 AXIS_PTS_REF STM09ESUB /end AXIS_DESCR
 /begin AXIS_DESCR COM_AXIS nmot nmot_ub_q40 12 0.00 10200. AXIS_PTS_REF SNM12ESUB2 /end AXIS_DESCR
/end CHARACTERISTIC
/begin CHARACTERISTIC KFBBLSU "Kennfeld für B_sbblsu" MAP 0x813C86 KfAxUbAyUbSstxUbSstyUwWUb 25.50 t100msxs_ub_b25p5 0.00 25.50 FUNCTION_LIST GGLSU IF_DATA DIM_X DIRECT 0x813C86 /begin AXIS_DESCR STD_AXIS ub spg_ubatt 4 0.00 19.38 DEPOSIT ABSOLUT /end AXIS_DESCR
 /begin AXIS_DESCR STD_AXIS lamsons_w fak_uw_b16 5 0.00 15.99976 DEPOSIT ABSOLUT /end AXIS_DESCR
/end CHARACTERISTIC
/begin CHARACTERISTIC KFBS "Kennfeld für banksel. Gemischfaktor" MAP 0x81C868 KfAxUbAyUbSstxUbSstyUbWSb 0.4980 fak_sb_b0p25 -0.2500 0.2480 FUNCTION_LIST GK IF_DATA DIM_X DIRECT 0x81C868 /begin AXIS_DESCR STD_AXIS nmot nmot_ub_q40 8 0.00 10200. DEPOSIT ABSOLUT /end AXIS_DESCR /begin AXIS_DESCR STD_AXIS rl rel_ub_q0p75 8 0.00 191.3 DEPOSIT ABSOLUT /end AXIS_DESCR /end CHARACTERISTIC
/begin CHARACTERISTIC KFBS2 "Kennfeld für banksel. Gemischfaktor Variante 2" MAP 0x81C8BA KfAxUbAyUbSstxUbSstyUbWSb 0.4980 fak_sb_b0p25 -0.2500 0.2480 FUNCTION_LIST GK IF_DATA DIM_X DIRECT 0x81C8BA /begin AXIS_DESCR STD_AXIS nmot nmot_ub_q40 8 0.00 10200. DEPOSIT ABSOLUT /end AXIS_DESCR /begin AXIS_DESCR STD_AXIS rl rel_ub_q0p75 8 0.00 191.3 DEPOSIT ABSOLUT /end AXIS_DESCR /end CHARACTERISTIC
/begin CHARACTERISTIC KFCFO "Kennfeld zur Definition der Bereichseigenschaften (dominant..)" MAP 0x81024F GkfWUb 255.0 dez 0.00 255.0 FUNCTION_LIST DMDFON IF_DATA DIM_X DIRECT 0x81024F
 /begin AXIS_DESCR COM_AXIS rl rel_ub_q0p75 3 0.00 191.3 AXIS_PTS_REF SDZ03DMUB /end AXIS_DESCR
 /begin AXIS_DESCR COM_AXIS nmot nmot_ub_q40 8 0.00 10200. AXIS_PTS_REF SDZ08DMUB /end AXIS_DESCR
/end CHARACTERISTIC
/begin CHARACTERISTIC KFCFO2 "Kennfeld zur Definition der Bereichseigenschaften (dominant..)" MAP 0x810267 GkfWUb 255.0 dez 0.00 255.0 FUNCTION_LIST DMDFON IF_DATA DIM_X DIRECT 0x810267
 /begin AXIS_DESCR COM_AXIS rl rel_ub_q0p75 3 0.00 191.3 AXIS_PTS_REF SDZ03DMUB2 /end AXIS_DESCR
 /begin AXIS_DESCR COM_AXIS nmot nmot_ub_q40 8 0.00 10200. AXIS_PTS_REF SDZ08DMUB2 /end AXIS_DESCR
/end CHARACTERISTIC
/begin CHARACTERISTIC KFDETATE "Zündwinkelwirkungsgrad Korrektur for DTEV" MAP 0x819B3E KfAxUbAyUbSstxUbSstyUbWUb 127.5 rel_ub_b127p5 0.00 127.5 FUNCTION_LIST DTEV IF_DATA DIM_X DIRECT 0x819B3E
 /begin AXIS_DESCR STD_AXIS etazwist rel_ub_b127p5 4 0.00 127.5 DEPOSIT ABSOLUT /end AXIS_DESCR
 /begin AXIS_DESCR STD_AXIS dmletanu m_q0p1 6 0.00 25.50 DEPOSIT ABSOLUT /end AXIS_DESCR
/end CHARACTERISTIC
/begin CHARACTERISTIC KFDLASO "Kennfeld Lambdasollwert-Korrektur für stetigen Lambdaregler" MAP 0x811FF2 GkfWSb 0.06226 fak_sb_b0p03125 -0.03125 0.03101 FUNCTION_LIST LRS IF_DATA DIM_X DIRECT 0x811FF2
 /begin AXIS_DESCR COM_AXIS nmot nmot_ub_q40 10 0.00 10200. AXIS_PTS_REF SNM10LSUB /end AXIS_DESCR
 /begin AXIS_DESCR COM_AXIS rl rel_ub_q0p75 10 0.00 191.3 AXIS_PTS_REF SRL10LSUB /end AXIS_DESCR
/end CHARACTERISTIC
/begin CHARACTERISTIC KFDLASO2 "Kennfeld Lambdasollwert-Korrektur für stetigen Lambdaregler, Bank2" MAP 0x812056 GkfWSb 0.06226 fak_sb_b0p03125 -0.03125 0.03101 FUNCTION_LIST LRS IF_DATA DIM_X DIRECT 0x812056
 /begin AXIS_DESCR COM_AXIS nmot nmot_ub_q40 10 0.00 10200. AXIS_PTS_REF SNM10LSUB /end AXIS_DESCR
 /begin AXIS_DESCR COM_AXIS rl rel_ub_q0p75 10 0.00 191.3 AXIS_PTS_REF SRL10LSUB /end AXIS_DESCR
/end CHARACTERISTIC
/begin CHARACTERISTIC KFDLSD "Dämpfung PT2-Filter Lastschlagdämpfung" MAP 0x81DC48 GkfWUw 1.999969 fak_uw_b2 0.00 1.999969 FUNCTION_LIST MDFAW IF_DATA DIM_X DIRECT 0x81DC48 /begin AXIS_DESCR COM_AXIS gangi dez 8 0.00 255.0 AXIS_PTS_REF SGA08MDUB /end AXIS_DESCR
 /begin AXIS_DESCR COM_AXIS nmot_w nmot_uw_q0p25 6 0.00 16383.75 AXIS_PTS_REF SNM06MDUW /end AXIS_DESCR
/end CHARACTERISTIC
/begin CHARACTERISTIC KFDLULS "Delta Druck für Überladeschutzdiagnose" MAP 0x819347 KfAxUbAyUbSstxUbSstyUbWUb 1275. p_ub_q5 0.00 1275. FUNCTION_LIST DLDR IF_DATA DIM_X DIRECT 0x819347 /begin AXIS_DESCR STD_AXIS nmot nmot_ub_q40 8 0.00 10200. DEPOSIT ABSOLUT /end AXIS_DESCR /begin AXIS_DESCR STD_AXIS plsol p_ub_q10 8 0.00 2550. DEPOSIT ABSOLUT /end AXIS_DESCR /end CHARACTERISTIC
/begin CHARACTERISTIC KFDLUR "Kennfeld für Laufunruhedifferenz dluts Referenzwert" MAP 0x810407 GkfWSb 463.8 luquant -232.8 231.0 FUNCTION_LIST DMDDLU IF_DATA DIM_X DIRECT 0x810407
 /begin AXIS_DESCR COM_AXIS rl rel_ub_q0p75 8 0.00 191.3 AXIS_PTS_REF SRL08DMUB /end AXIS_DESCR
 /begin AXIS_DESCR COM_AXIS nmot nmot_ub_q40 8 0.00 10200. AXIS_PTS_REF SNM08DMUB /end AXIS_DESCR
/end CHARACTERISTIC
/begin CHARACTERISTIC KFDLUR1 "Kennfeld für Laufunruhedifferenz dluts Referenzwert" MAP 0x810447 GkfWSb 463.8 luquant -232.8 231.0 FUNCTION_LIST DMDDLU IF_DATA DIM_X DIRECT 0x810447
 /begin AXIS_DESCR COM_AXIS rl rel_ub_q0p75 8 0.00 191.3 AXIS_PTS_REF SRL08DMUB /end AXIS_DESCR
 /begin AXIS_DESCR COM_AXIS nmot nmot_ub_q40 8 0.00 10200. AXIS_PTS_REF SNM08DMUB /end AXIS_DESCR
/end CHARACTERISTIC
/begin CHARACTERISTIC KFDLUR2 "Kennfeld für Laufunruhedifferenz dluts Referenzwert" MAP 0x810487 GkfWSb 463.8 luquant -232.8 231.0 FUNCTION_LIST DMDDLU IF_DATA DIM_X DIRECT 0x810487
 /begin AXIS_DESCR COM_AXIS rl rel_ub_q0p75 8 0.00 191.3 AXIS_PTS_REF SRL08DMUB /end AXIS_DESCR
 /begin AXIS_DESCR COM_AXIS nmot nmot_ub_q40 8 0.00 10200. AXIS_PTS_REF SNM08DMUB /end AXIS_DESCR
/end CHARACTERISTIC
/begin CHARACTERISTIC KFDLURV "Kennfeld für Laufunruhedifferenz dluts Referenzwert bei Ventilhub gross" MAP 0x8104C7 GkfWSb 463.8 luquant -232.8 231.0 FUNCTION_LIST DMDDLU IF_DATA DIM_X DIRECT 0x8104C7
 /begin AXIS_DESCR COM_AXIS rl rel_ub_q0p75 8 0.00 191.3 AXIS_PTS_REF SRL08DMUB /end AXIS_DESCR
 /begin AXIS_DESCR COM_AXIS nmot nmot_ub_q40 8 0.00 10200. AXIS_PTS_REF SNM08DMUB /end AXIS_DESCR
/end CHARACTERISTIC
/begin CHARACTERISTIC KFDLURV1 "Kennfeld Laufunruhedifferenz Referenzwert in Diagnose DVS bei kleinem Ventilhub" MAP 0x810815 GkfWSb 463.8 luquant -232.8 231.0 FUNCTION_LIST DMDDVS IF_DATA DIM_X DIRECT 0x810815
 /begin AXIS_DESCR COM_AXIS rl rel_ub_q0p75 8 0.00 191.3 AXIS_PTS_REF SRL08D2UB /end AXIS_DESCR
 /begin AXIS_DESCR COM_AXIS nmot nmot_ub_q40 8 0.00 10200. AXIS_PTS_REF SNM08D2UB /end AXIS_DESCR
/end CHARACTERISTIC
/begin CHARACTERISTIC KFDLURV2 "Kennfeld Laufunruhedifferenz Referenzwert in Diagnose DVS bei großem Ventilhub" MAP 0x810855 GkfWSb 463.8 luquant -232.8 231.0 FUNCTION_LIST DMDDVS IF_DATA DIM_X DIRECT 0x810855
 /begin AXIS_DESCR COM_AXIS rl rel_ub_q0p75 8 0.00 191.3 AXIS_PTS_REF SRL08D2UB /end AXIS_DESCR
 /begin AXIS_DESCR COM_AXIS nmot nmot_ub_q40 8 0.00 10200. AXIS_PTS_REF SNM08D2UB /end AXIS_DESCR
/end CHARACTERISTIC
/begin CHARACTERISTIC KFDLURZ "Kennfeld für Laufunruhedifferenz dluts Referenzwert bei ZAS" MAP 0x810507 GkfWSb 463.8 luquant -232.8 231.0 FUNCTION_LIST DMDDLU IF_DATA DIM_X DIRECT 0x810507
 /begin AXIS_DESCR COM_AXIS rl rel_ub_q0p75 8 0.00 191.3 AXIS_PTS_REF SRL08DMUB /end AXIS_DESCR
 /begin AXIS_DESCR COM_AXIS nmot nmot_ub_q40 8 0.00 10200. AXIS_PTS_REF SNM08DMUB /end AXIS_DESCR
/end CHARACTERISTIC
/begin CHARACTERISTIC KFDMDARO "Obere Schwelle für Momenteneingriff" MAP 0x81DB04 GkfWSw 199.9969 rel_sw_b100 -100.0000 99.99695 FUNCTION_LIST ARMD IF_DATA DIM_X DIRECT 0x81DB04 /begin AXIS_DESCR COM_AXIS gangi dez 6 0.00 255.0 AXIS_PTS_REF SGA06MDUB /end AXIS_DESCR
 /begin AXIS_DESCR COM_AXIS mkar_w rel_sw_b100 8 -100.0000 99.99695 AXIS_PTS_REF SMK08MDSW /end AXIS_DESCR
/end CHARACTERISTIC
/begin CHARACTERISTIC KFDMDARU "Untere Schwelle für Momenteneingriff" MAP 0x81DB64 GkfWSw 199.9969 rel_sw_b100 -100.0000 99.99695 FUNCTION_LIST ARMD IF_DATA DIM_X DIRECT 0x81DB64 /begin AXIS_DESCR COM_AXIS gangi dez 6 0.00 255.0 AXIS_PTS_REF SGA06MDUB /end AXIS_DESCR
 /begin AXIS_DESCR COM_AXIS mkar_w rel_sw_b100 8 -100.0000 99.99695 AXIS_PTS_REF SMK08MDSW /end AXIS_DESCR
/end CHARACTERISTIC
/begin CHARACTERISTIC KFDMDPO "Delta Moment Dashpotauslösung" MAP 0x816312 GkfWSw 199.9969 rel_sw_b100 -100.0000 99.99695 FUNCTION_LIST MDFAW IF_DATA DIM_X DIRECT 0x816312 /begin AXIS_DESCR COM_AXIS gangi dez 8 0.00 255.0 AXIS_PTS_REF SGA08MDUB /end AXIS_DESCR
 /begin AXIS_DESCR COM_AXIS mkfanb_w rel_sw_b100 6 -100.0000 99.99695 AXIS_PTS_REF SMK106MDSW /end AXIS_DESCR
/end CHARACTERISTIC
/begin CHARACTERISTIC KFDMLSDO "Delta Moment Auslösung Lastschlagdämpfung" MAP 0x816372 GkfWSw 199.9969 rel_sw_b100 -100.0000 99.99695 FUNCTION_LIST MDFAW IF_DATA DIM_X DIRECT 0x816372 /begin AXIS_DESCR COM_AXIS gangi dez 8 0.00 255.0 AXIS_PTS_REF SGA08MDUB /end AXIS_DESCR
 /begin AXIS_DESCR COM_AXIS mkfanb_w rel_sw_b100 6 -100.0000 99.99695 AXIS_PTS_REF SMK206MDSW /end AXIS_DESCR
/end CHARACTERISTIC
/begin CHARACTERISTIC KFDPVL "Druckabfall am Luftfilter zur Berechnung Massestrom Tankentlüftung hinter Lader" MAP 0x81E22C KfAxUwAyUwSstxUwSstyUwWUw 2559.961 p_uw_q0p039 0.00 2559.961 FUNCTION_LIST BGTEV IF_DATA DIM_X DIRECT 0x81E22C
 /begin AXIS_DESCR STD_AXIS vfzg_w vfzg_uw_b512 3 0.00 511.9922 DEPOSIT ABSOLUT /end AXIS_DESCR
 /begin AXIS_DESCR STD_AXIS mshfm_w m_uw_b6553p5 6 0.00 6553.500 DEPOSIT ABSOLUT /end AXIS_DESCR
/end CHARACTERISTIC
/begin CHARACTERISTIC KFDTMRS "Kennfeld Motortemperatur-Gradient im Schub für Referenzmodell" MAP 0x81CE36 KfAxUbAyUbSstxUbSstyUbWSb 0.1868 temp_sb_b0p093 -0.09375 0.09302 FUNCTION_LIST GGTFM IF_DATA DIM_X DIRECT 0x81CE36 /begin AXIS_DESCR STD_AXIS mll1 m_ub_b1020 5 0.00 1020. DEPOSIT ABSOLUT /end AXIS_DESCR
 /begin AXIS_DESCR STD_AXIS tmrw temp_ub_q0p75_o48 4 -48.00 143.3 DEPOSIT ABSOLUT /end AXIS_DESCR
/end CHARACTERISTIC
/begin CHARACTERISTIC KFDTMTE "Kennfeld Motortemperaturgradient für Ersatztemperatur" MAP 0x81CE56 KfAxUbAyUbSstxUbSstyUbWSb 0.1868 temp_sb_b0p093 -0.09375 0.09302 FUNCTION_LIST GGTFM IF_DATA DIM_X DIRECT 0x81CE56 /begin AXIS_DESCR STD_AXIS mll1 m_ub_b1020 5 0.00 1020. DEPOSIT ABSOLUT /end AXIS_DESCR
 /begin AXIS_DESCR STD_AXIS tmew temp_ub_q0p75_o48 4 -48.00 143.3 DEPOSIT ABSOLUT /end AXIS_DESCR
/end CHARACTERISTIC
/begin CHARACTERISTIC KFDTMTR "Kennfeld Motortemperaturgradient für Referenztemperatur" MAP 0x81CE76 KfAxUbAyUbSstxUbSstyUbWSb 0.1868 temp_sb_b0p093 -0.09375 0.09302 FUNCTION_LIST GGTFM IF_DATA DIM_X DIRECT 0x81CE76 /begin AXIS_DESCR STD_AXIS mll1 m_ub_b1020 5 0.00 1020. DEPOSIT ABSOLUT /end AXIS_DESCR
 /begin AXIS_DESCR STD_AXIS tmrw temp_ub_q0p75_o48 4 -48.00 143.3 DEPOSIT ABSOLUT /end AXIS_DESCR
/end CHARACTERISTIC
/begin CHARACTERISTIC KFDTMTU "Kennfeld Korrekturgradient Motortemperatur bei geringer Erwärmung" MAP 0x81CE96 KfAxUbAyUbSstxUbSstyUbWSb 0.1868 temp_sb_b0p093 -0.09375 0.09302 FUNCTION_LIST GGTFM IF_DATA DIM_X DIRECT 0x81CE96 /begin AXIS_DESCR STD_AXIS mll1 m_ub_b1020 5 0.00 1020. DEPOSIT ABSOLUT /end AXIS_DESCR
 /begin AXIS_DESCR STD_AXIS tumginp temp_ub_q0p75_o48 4 -48.00 143.3 DEPOSIT ABSOLUT /end AXIS_DESCR
/end CHARACTERISTIC
/begin CHARACTERISTIC KFDWTBR "Wichtungsfaktor Brennraumtemperaturmodell abhängig von NWS-Stellung" MAP 0x81BE7A KfAxUbAyUbSstxUbSstyUbWSb 1.992 fak_sb_b1 -1.000 0.9922 FUNCTION_LIST BGTMPK IF_DATA DIM_X DIRECT 0x81BE7A /begin AXIS_DESCR STD_AXIS rl rel_ub_q0p75 10 0.00 191.3 DEPOSIT ABSOLUT /end AXIS_DESCR /begin AXIS_DESCR STD_AXIS nmot nmot_ub_q40 12 0.00 10200. DEPOSIT ABSOLUT /end AXIS_DESCR /end CHARACTERISTIC
/begin CHARACTERISTIC KFDWTBR2 "Wichtungsfaktor Brennraumtemperaturmodell abhängig von NWS-Stellung" MAP 0x81BF0A KfAxUbAyUbSstxUbSstyUbWSb 1.992 fak_sb_b1 -1.000 0.9922 FUNCTION_LIST BGTMPK IF_DATA DIM_X DIRECT 0x81BF0A /begin AXIS_DESCR STD_AXIS rl rel_ub_q0p75 10 0.00 191.3 DEPOSIT ABSOLUT /end AXIS_DESCR /begin AXIS_DESCR STD_AXIS nmot nmot_ub_q40 12 0.00 10200. DEPOSIT ABSOLUT /end AXIS_DESCR /end CHARACTERISTIC
/begin CHARACTERISTIC KFDYES "Lastdynamikerkennungsschwelle" MAP 0x81D40C GkfWUw 767.9766 rel_uw_q0p0234 0.00 767.9766 FUNCTION_LIST KRDY IF_DATA DIM_X DIRECT 0x81D40C
 /begin AXIS_DESCR COM_AXIS nmot_w nmot_uw_q0p25 8 0.00 16383.75 AXIS_PTS_REF SNM08KRUW /end AXIS_DESCR
 /begin AXIS_DESCR COM_AXIS wdkba_w relDK_q0p02441 6 -800.0000 799.9756 AXIS_PTS_REF SWD06KRSW /end AXIS_DESCR
/end CHARACTERISTIC
/begin CHARACTERISTIC KFDYESOF "Dynamikvorhalt Offsetschwelle" MAP 0x81D46C GkfWUw 767.9766 rel_uw_q0p0234 0.00 767.9766 FUNCTION_LIST KRDY IF_DATA DIM_X DIRECT 0x81D46C
 /begin AXIS_DESCR COM_AXIS nmot_w nmot_uw_q0p25 8 0.00 16383.75 AXIS_PTS_REF SNM08KRUW /end AXIS_DESCR
 /begin AXIS_DESCR COM_AXIS wdkba_w relDK_q0p02441 6 -800.0000 799.9756 AXIS_PTS_REF SWD06KRSW /end AXIS_DESCR
/end CHARACTERISTIC
/begin CHARACTERISTIC KFDZWKG "Zündwinkelkorrektur durch Verschieben der Klopfgrenze" MAP 0x8176B4 KfAxUbAyUbSstxUbSstyUbWSb 15.00 zw_sb_q0p75 0.00 15.00 FUNCTION_LIST ZWGRU IF_DATA DIM_X DIRECT 0x8176B4 /begin AXIS_DESCR STD_AXIS nmot nmot_ub_q40 8 0.00 10200. DEPOSIT ABSOLUT /end AXIS_DESCR /begin AXIS_DESCR STD_AXIS lambas fak_ub_b2 5 0.00 1.992 DEPOSIT ABSOLUT /end AXIS_DESCR /end CHARACTERISTIC
/begin CHARACTERISTIC KFETATE "Kennfeld gewünscher Wirkungsgrad bei Tankentlüftung bei Erreichen te = TEMIN" MAP 0x81E294 KfAxUwAyUwSstxSwSstyUwWUw 50.00000 rel_q0p00195 50.00000 100.0000 FUNCTION_LIST TEB IF_DATA DIM_X DIRECT 0x81E294
 /begin AXIS_DESCR STD_AXIS fteadf_w fak_q0p00195 3 -64.00000 63.99805 DEPOSIT ABSOLUT /end AXIS_DESCR
 /begin AXIS_DESCR STD_AXIS mifa_w rel_uw_b100 5 0.00 99.99847 DEPOSIT ABSOLUT /end AXIS_DESCR
/end CHARACTERISTIC
/begin CHARACTERISTIC KFFDLBTS "Faktor Delta Lambdasoll für Bauteileschutz" MAP 0x818DFD GkfWUb 1.992 fak_ub_b2 0.00 1.992 FUNCTION_LIST LAMBTS IF_DATA DIM_X DIRECT 0x818DFD
 /begin AXIS_DESCR COM_AXIS rl rel_ub_q0p75 12 0.00 191.3 AXIS_PTS_REF SRL12GKUB /end AXIS_DESCR
 /begin AXIS_DESCR COM_AXIS nmot nmot_ub_q40 16 0.00 10200. AXIS_PTS_REF SNM16GKUB /end AXIS_DESCR
/end CHARACTERISTIC
/begin CHARACTERISTIC KFFFANZ "Anzahl Folgefunken" MAP 0x8123E6 KfAxUbAyUbSstxUbSstyUbWUb 255.0 dez 0.00 255.0 FUNCTION_LIST ZUESZ IF_DATA DIM_X DIRECT 0x8123E6
 /begin AXIS_DESCR STD_AXIS tmot temp_ub_q0p75_o48 8 -48.00 143.3 DEPOSIT ABSOLUT /end AXIS_DESCR
 /begin AXIS_DESCR STD_AXIS nmot nmot_ub_q40 8 0.00 10200. DEPOSIT ABSOLUT /end AXIS_DESCR
/end CHARACTERISTIC
/begin CHARACTERISTIC KFFLDEO "Faktor für Ladedruckeingriff auf Overboostwert durch KR" MAP 0x819449 GkfWUb 0.9961 fak_ub_b1 0.00 0.9961 FUNCTION_LIST LDRLMX IF_DATA DIM_X DIRECT 0x819449
 /begin AXIS_DESCR COM_AXIS nmot nmot_ub_q40 8 0.00 10200. AXIS_PTS_REF SNM08LDUB /end AXIS_DESCR
 /begin AXIS_DESCR COM_AXIS wkrmsu zw_ub_q0p75 8 0.00 191.3 AXIS_PTS_REF SWK208LDUB /end AXIS_DESCR
/end CHARACTERISTIC
/begin CHARACTERISTIC KFFLLDE "Faktor für langsamen Ladedruckeingriff auf rlmax durch KR" MAP 0x819489 GkfWUb 1.992 fak_ub_b2 0.00 1.992 FUNCTION_LIST LDRLMX IF_DATA DIM_X DIRECT 0x819489
 /begin AXIS_DESCR COM_AXIS nmot nmot_ub_q40 8 0.00 10200. AXIS_PTS_REF SNM08LDUB /end AXIS_DESCR
 /begin AXIS_DESCR COM_AXIS wkrmstat zw_ub_q0p75 8 0.00 191.3 AXIS_PTS_REF SWK08LDUB /end AXIS_DESCR
/end CHARACTERISTIC
/begin CHARACTERISTIC KFFRARAG "Verstärkungsfaktor Automat Fzg" MAP 0x815FA8 KfAxUbAyUbSstxUbSstyUbWUb 1.563 fak_q0p0061 0.00 1.563 FUNCTION_LIST ARMD IF_DATA DIM_X DIRECT 0x815FA8 /begin AXIS_DESCR STD_AXIS gangi dez 6 0.00 255.0 DEPOSIT ABSOLUT /end AXIS_DESCR /begin AXIS_DESCR STD_AXIS nmot nmot_ub_q40 6 0.00 10200. DEPOSIT ABSOLUT /end AXIS_DESCR /end CHARACTERISTIC
/begin CHARACTERISTIC KFFRARAW "Verstärkungsfaktor bei AT, WK geschlossen" MAP 0x815FDA KfAxUbAyUbSstxUbSstyUbWUb 1.563 fak_q0p0061 0.00 1.563 FUNCTION_LIST ARMD IF_DATA DIM_X DIRECT 0x815FDA /begin AXIS_DESCR STD_AXIS gangi dez 6 0.00 255.0 DEPOSIT ABSOLUT /end AXIS_DESCR /begin AXIS_DESCR STD_AXIS nmot nmot_ub_q40 6 0.00 10200. DEPOSIT ABSOLUT /end AXIS_DESCR /end CHARACTERISTIC
/begin CHARACTERISTIC KFFRARHG "Verstärkungsfaktor" MAP 0x81600C KfAxUbAyUbSstxUbSstyUbWUb 1.563 fak_q0p0061 0.00 1.563 FUNCTION_LIST ARMD IF_DATA DIM_X DIRECT 0x81600C /begin AXIS_DESCR STD_AXIS gangi dez 6 0.00 255.0 DEPOSIT ABSOLUT /end AXIS_DESCR /begin AXIS_DESCR STD_AXIS nmot nmot_ub_q40 6 0.00 10200. DEPOSIT ABSOLUT /end AXIS_DESCR /end CHARACTERISTIC
/begin CHARACTERISTIC KFFSLDE "Faktor für schnellen LDR-Eingriff(Absenkung)" MAP 0x8194C9 GkfWUb 1.992 fak_ub_b2 0.00 1.992 FUNCTION_LIST LDRLMX IF_DATA DIM_X DIRECT 0x8194C9
 /begin AXIS_DESCR COM_AXIS nmot nmot_ub_q40 8 0.00 10200. AXIS_PTS_REF SNM08LDUB /end AXIS_DESCR
 /begin AXIS_DESCR COM_AXIS wkrmdy zw_ub_q0p75 8 0.00 191.3 AXIS_PTS_REF SWK108LDUB /end AXIS_DESCR
/end CHARACTERISTIC
/begin CHARACTERISTIC KFFTEAN "Kennfeld Maximale Spülrate bei Notlauftankentlüftung" MAP 0x819A3D GkfWUb 0.1992 fak_ub_b0p5 0.00 0.1992 FUNCTION_LIST TEB IF_DATA DIM_X DIRECT 0x819A3D
 /begin AXIS_DESCR COM_AXIS nmot nmot_ub_q40 10 0.00 10200. AXIS_PTS_REF SNM10TEUB /end AXIS_DESCR
 /begin AXIS_DESCR COM_AXIS wdkba relDK_ub_b100 10 0.00 100.0 AXIS_PTS_REF SDK10TEUB /end AXIS_DESCR
/end CHARACTERISTIC
/begin CHARACTERISTIC KFFTEAX "Kennfeld maximale Spülrate" MAP 0x819AA1 KfAxUbAyUbSstxUbSstyUbWUb 0.1992 fak_ub_b0p5 0.00 0.1992 FUNCTION_LIST TEB IF_DATA DIM_X DIRECT 0x819AA1 /begin AXIS_DESCR STD_AXIS ml m_ub_b1020 5 0.00 1020. DEPOSIT ABSOLUT /end AXIS_DESCR
 /begin AXIS_DESCR STD_AXIS tans temp_ub_q0p75_o48 4 -48.00 143.3 DEPOSIT ABSOLUT /end AXIS_DESCR
/end CHARACTERISTIC
/begin CHARACTERISTIC KFFWL "Kennfeld Warmlauffaktor" MAP 0x818C41 GkfWUb 1.992 fak_ub_b2 0.00 1.992 FUNCTION_LIST ESWL IF_DATA DIM_X DIRECT 0x818C41
 /begin AXIS_DESCR COM_AXIS tmot temp_ub_q0p75_o48 12 -48.00 143.3 AXIS_PTS_REF STM12ESUB /end AXIS_DESCR
 /begin AXIS_DESCR COM_AXIS tmst temp_ub_q0p75_o48 12 -48.00 143.3 AXIS_PTS_REF STS12ESUB /end AXIS_DESCR
/end CHARACTERISTIC
/begin CHARACTERISTIC KFFWLVS "Kennfeld Warmlauffaktor bei großem Ventilhub" MAP 0x818CD1 GkfWUb 1.992 fak_ub_b2 0.00 1.992 FUNCTION_LIST ESWL IF_DATA DIM_X DIRECT 0x818CD1
 /begin AXIS_DESCR COM_AXIS tmot temp_ub_q0p75_o48 12 -48.00 143.3 AXIS_PTS_REF STM12ESUB /end AXIS_DESCR
 /begin AXIS_DESCR COM_AXIS tmst temp_ub_q0p75_o48 12 -48.00 143.3 AXIS_PTS_REF STS12ESUB /end AXIS_DESCR
/end CHARACTERISTIC
/begin CHARACTERISTIC KFFWLW "Kennfeld Wichtung Warmlauffaktor" MAP 0x811380 GkfWUb 0.9961 fak_ub_b1 0.00 0.9961 FUNCTION_LIST ESWL IF_DATA DIM_X DIRECT 0x811380
 /begin AXIS_DESCR COM_AXIS nmot nmot_ub_q40 12 0.00 10200. AXIS_PTS_REF SNM12ESUB2 /end AXIS_DESCR
 /begin AXIS_DESCR COM_AXIS rl rel_ub_q0p75 12 0.00 191.3 AXIS_PTS_REF SRL12ESUB /end AXIS_DESCR
/end CHARACTERISTIC
/begin CHARACTERISTIC KFFWTBR "Wichtungsfaktor Tans/Tmot für Brennraumtemperaturmodell" MAP 0x81850B KfAxUbAyUbSstxUbSstyUbWUb 0.9961 fak_ub_b1 0.00 0.9961 FUNCTION_LIST BGTMPK IF_DATA DIM_X DIRECT 0x81850B /begin AXIS_DESCR STD_AXIS rl rel_ub_q0p75 10 0.00 191.3 DEPOSIT ABSOLUT /end AXIS_DESCR /begin AXIS_DESCR STD_AXIS nmot nmot_ub_q40 12 0.00 10200. DEPOSIT ABSOLUT /end AXIS_DESCR /end CHARACTERISTIC
/begin CHARACTERISTIC KFFWTBR2 "Wichtungsfaktor Tans/Tmot für Brennraumtemperaturmodell Variante 2" MAP 0x81859B KfAxUbAyUbSstxUbSstyUbWUb 0.9961 fak_ub_b1 0.00 0.9961 FUNCTION_LIST BGTMPK IF_DATA DIM_X DIRECT 0x81859B /begin AXIS_DESCR STD_AXIS rl rel_ub_q0p75 10 0.00 191.3 DEPOSIT ABSOLUT /end AXIS_DESCR /begin AXIS_DESCR STD_AXIS nmot nmot_ub_q40 12 0.00 10200. DEPOSIT ABSOLUT /end AXIS_DESCR /end CHARACTERISTIC
/begin CHARACTERISTIC KFKABMT "Kennfeld Korrekturfaktor für berechnete Amplitude, abhängig von ml und Kat.-Tem" MAP 0x813BA6 KfAxUbAyUbSstxUbSstyUbWUb 1.992 fak_ub_b2 0.00 1.992 FUNCTION_LIST DKATLRS IF_DATA DIM_X DIRECT 0x813BA6 /begin AXIS_DESCR STD_AXIS ml m_ub_b1020 8 0.00 1020. DEPOSIT ABSOLUT /end AXIS_DESCR
 /begin AXIS_DESCR STD_AXIS tkdkte temp_ub_q5_o50 8 -50.00 1225. DEPOSIT ABSOLUT /end AXIS_DESCR
/end CHARACTERISTIC
/begin CHARACTERISTIC KFKHFM "Korrekturkennfeld für HFM" MAP 0x810F5C KfAxUbAyUbSstxUbSstyUbWUb 1.992 fak_ub_b2 0.00 1.992 FUNCTION_LIST GGHFM IF_DATA DIM_X DIRECT 0x810F5C /begin AXIS_DESCR STD_AXIS nmot nmot_ub_q40 14 0.00 10200. DEPOSIT ABSOLUT /end AXIS_DESCR /begin AXIS_DESCR STD_AXIS rl rel_ub_q0p75 14 0.00 191.3 DEPOSIT ABSOLUT /end AXIS_DESCR /end CHARACTERISTIC
/begin CHARACTERISTIC KFKSWF "Kennfeld für Kat.-Schutz-Wichtungsfaktoren" MAP 0x81089B KfAxUbAyUbSstxUbSstyUbWUb 255.0 dez 0.00 255.0 FUNCTION_LIST DMDMIL IF_DATA DIM_X DIRECT 0x81089B /begin AXIS_DESCR STD_AXIS nmot nmot_ub_q40 6 0.00 10200. DEPOSIT ABSOLUT /end AXIS_DESCR /begin AXIS_DESCR STD_AXIS rl rel_ub_q0p75 6 0.00 191.3 DEPOSIT ABSOLUT /end AXIS_DESCR /end CHARACTERISTIC
/begin CHARACTERISTIC KFKWTMP "Kennfeld Drehmomentenreserve für Kat warmhalten, zeitweise" MAP 0x81D000 KfAxUwAyUwSstxUwSstyUwWUw 99.99847 rel_uw_b100 0.00 99.99847 FUNCTION_LIST KHMD IF_DATA DIM_X DIRECT 0x81D000
 /begin AXIS_DESCR STD_AXIS nmot_w nmot_uw_q0p25 4 0.00 16383.75 DEPOSIT ABSOLUT /end AXIS_DESCR
 /begin AXIS_DESCR STD_AXIS mifakh_w rel_uw_b100 4 0.00 99.99847 DEPOSIT ABSOLUT /end AXIS_DESCR
/end CHARACTERISTIC
/begin CHARACTERISTIC KFLAMSLS "Kennfeld Lambda-Korrektur bei Sekundärluft" MAP 0x818424 KfAxUbAyUbSstxUbSstyUbWUb 0.4980 fak_ub_b1p25_o0p75 0.7500 1.248 FUNCTION_LIST GGLSU IF_DATA DIM_X DIRECT 0x818424 /begin AXIS_DESCR STD_AXIS nmot nmot_ub_q40 8 0.00 10200. DEPOSIT ABSOLUT /end AXIS_DESCR /begin AXIS_DESCR STD_AXIS rl rel_ub_q0p75 8 0.00 191.3 DEPOSIT ABSOLUT /end AXIS_DESCR /end CHARACTERISTIC
/begin CHARACTERISTIC KFLANS "Kennfeld Lambda-Motor-Beschreibung im Nachstart" MAP 0x815560 GkfWUw 15.89990 fak_uw_b16 0.09985352 15.99976 FUNCTION_LIST ESNST IF_DATA DIM_X DIRECT 0x815560
 /begin AXIS_DESCR COM_AXIS tmst temp_ub_q0p75_o48 12 -48.00 143.3 AXIS_PTS_REF STS12ESUB /end AXIS_DESCR
 /begin AXIS_DESCR COM_AXIS anztib_w dez 12 0.00 65535.00 AXIS_PTS_REF SAN12ESUW /end AXIS_DESCR
/end CHARACTERISTIC
/begin CHARACTERISTIC KFLANSKH "Kennfeld Lambda-Motor-Vorgabe bei Katheizen im Nachstart" MAP 0x81D1B0 KfAxUbAyUbSstxUbSstyUwWUw 15.89990 fak_q0p000244 0.09985352 15.99976 FUNCTION_LIST LAKH IF_DATA DIM_X DIRECT 0x81D1B0
 /begin AXIS_DESCR STD_AXIS tmst temp_ub_q0p75_o48 6 -48.00 143.3 DEPOSIT ABSOLUT /end AXIS_DESCR
 /begin AXIS_DESCR STD_AXIS anztib_w dez 12 0.00 65535.00 DEPOSIT ABSOLUT /end AXIS_DESCR
/end CHARACTERISTIC
/begin CHARACTERISTIC KFLASKH "Kennfeld Lambda-Abgas-Soll bei Katheizen" MAP 0x81D260 KfAxUwAyUwSstxUwSstyUwWUw 15.99976 fak_q0p000244 0.00 15.99976 FUNCTION_LIST LAKH IF_DATA DIM_X DIRECT 0x81D260
 /begin AXIS_DESCR STD_AXIS nmot_w nmot_uw_q0p25 8 0.00 16383.75 DEPOSIT ABSOLUT /end AXIS_DESCR
 /begin AXIS_DESCR STD_AXIS rl_w rel_uw_q0p0234 8 0.00 1535.977 DEPOSIT ABSOLUT /end AXIS_DESCR
/end CHARACTERISTIC
/begin CHARACTERISTIC KFLASWLR "Kennfeld Lambda-Motor-Soll im Warmlauf bei aktiver LR" MAP 0x818D61 GkfWUb 1.992 fak_ub_b2 0.00 1.992 FUNCTION_LIST ESWL IF_DATA DIM_X DIRECT 0x818D61
 /begin AXIS_DESCR COM_AXIS tmot temp_ub_q0p75_o48 12 -48.00 143.3 AXIS_PTS_REF STM12ESUB /end AXIS_DESCR
 /begin AXIS_DESCR COM_AXIS tmst temp_ub_q0p75_o48 12 -48.00 143.3 AXIS_PTS_REF STS12ESUB /end AXIS_DESCR
/end CHARACTERISTIC
/begin CHARACTERISTIC KFLBTS "Lambdasoll für Bauteileschutz" MAP 0x818EBD GkfWUb 1.992 fak_ub_b2 0.00 1.992 FUNCTION_LIST LAMBTS IF_DATA DIM_X DIRECT 0x818EBD
 /begin AXIS_DESCR COM_AXIS rl rel_ub_q0p75 12 0.00 191.3 AXIS_PTS_REF SRL12GKUB /end AXIS_DESCR
 /begin AXIS_DESCR COM_AXIS nmot nmot_ub_q40 16 0.00 10200. AXIS_PTS_REF SNM16GKUB /end AXIS_DESCR
/end CHARACTERISTIC
/begin CHARACTERISTIC KFLDFK "Ladedruck Filterkonstante" MAP 0x813F02 KfAxUwAyUwSstxUwSstyUwWUw 655.350000 zk10msxs_uw_b655 0.0100001526 655.360000 FUNCTION_LIST GGDSAS IF_DATA DIM_X DIRECT 0x813F02
 /begin AXIS_DESCR STD_AXIS nmot_w nmot_uw_q0p25 4 0.00 16383.75 DEPOSIT ABSOLUT /end AXIS_DESCR
 /begin AXIS_DESCR STD_AXIS psspvdkd_w fak_uw_b4 6 0.00 3.999939 DEPOSIT ABSOLUT /end AXIS_DESCR
/end CHARACTERISTIC
/begin CHARACTERISTIC KFLDHBN "LDR-Höhenbegrenzung (max. Verdichterdruckverhältnis)" MAP 0x819509 KfAxUbAyUbSstxUbSstyUbWUb 3.984 fak_ub_b4 0.00 3.984 FUNCTION_LIST LDRLMX IF_DATA DIM_X DIRECT 0x819509 /begin AXIS_DESCR STD_AXIS nmot nmot_ub_q40 10 0.00 10200. DEPOSIT ABSOLUT /end AXIS_DESCR
 /begin AXIS_DESCR STD_AXIS tans temp_ub_q0p75_o48 8 -48.00 143.3 DEPOSIT ABSOLUT /end AXIS_DESCR
/end CHARACTERISTIC
/begin CHARACTERISTIC KFLDIMX "Kennfeld LDR I-Reglerbegrenzung" MAP 0x81D734 GkfWUw 327.6750 tv_uw_q0p005 0.00 327.6750 FUNCTION_LIST LDRPID IF_DATA DIM_X DIRECT 0x81D734
 /begin AXIS_DESCR COM_AXIS nmot_w nmot_uw_q0p25 16 0.00 16383.75 AXIS_PTS_REF SNM16LDUW /end AXIS_DESCR
 /begin AXIS_DESCR COM_AXIS plsol_w p_uw_q0p039 8 0.00 2559.961 AXIS_PTS_REF SPL08LDUW /end AXIS_DESCR
/end CHARACTERISTIC
/begin CHARACTERISTIC KFLDIOPU "Korrektur der TV-Werte durch Höheneinfluß" MAP 0x8195C8 GkfWUb 163.2 tv_ub_q0p64 0.00 163.2 FUNCTION_LIST LDRPID IF_DATA DIM_X DIRECT 0x8195C8
 /begin AXIS_DESCR COM_AXIS nmot nmot_ub_q40 8 0.00 10200. AXIS_PTS_REF SNM08LDUB /end AXIS_DESCR
 /begin AXIS_DESCR COM_AXIS pu p_ub_q5 8 0.00 1275. AXIS_PTS_REF SPU08LDUB /end AXIS_DESCR
/end CHARACTERISTIC
/begin CHARACTERISTIC KFLDRAPP "Kennfeld für LDR-Applikation ohne Md-Koordination" MAP 0x819629 KfAxUbAyUbSstxUbSstyUbWUb 99.61 tv_ub_b100 0.00 99.61 FUNCTION_LIST LDTVMA IF_DATA DIM_X DIRECT 0x819629 /begin AXIS_DESCR STD_AXIS nmot nmot_ub_q40 8 0.00 10200. DEPOSIT ABSOLUT /end AXIS_DESCR /begin AXIS_DESCR STD_AXIS wped relPED_ub_b100 8 0.00 100.0 DEPOSIT ABSOLUT /end AXIS_DESCR /end CHARACTERISTIC
/begin CHARACTERISTIC KFLDRL "KF zur Linearisierung Ladedruck=f(TV)" MAP 0x81D834 GkfWSw 327.6750 tv_sw_q0p005 -163.8400 163.8350 FUNCTION_LIST LDRPID IF_DATA DIM_X DIRECT 0x81D834
 /begin AXIS_DESCR COM_AXIS nmot_w nmot_uw_q0p25 16 0.00 16383.75 AXIS_PTS_REF SNM16LDUW /end AXIS_DESCR
 /begin AXIS_DESCR COM_AXIS ldtvr_w tv_sw_q0p005 10 -163.8400 163.8350 AXIS_PTS_REF STV10LDSW /end AXIS_DESCR
/end CHARACTERISTIC
/begin CHARACTERISTIC KFLDRQ2 "Kennfeld LDR-Reglerparameter Q2" MAP 0x81D974 GkfWUw 3276.750 rel_uw_b3276p75 0.00 3276.750 FUNCTION_LIST LDRPID IF_DATA DIM_X DIRECT 0x81D974
 /begin AXIS_DESCR COM_AXIS nmot nmot_ub_q40 8 0.00 10200. AXIS_PTS_REF SNM08LDUB /end AXIS_DESCR
 /begin AXIS_DESCR COM_AXIS lde p_sb_q10 4 0.00 2550. AXIS_PTS_REF SLD04LDUB /end AXIS_DESCR
/end CHARACTERISTIC
/begin CHARACTERISTIC KFLDRX "Maximalfüllung LDR" MAP 0x81D4EC KfAxUbAyUbSstxUbSstyUwWUw 1535.977 rel_uw_q0p0234 0.00 1535.977 FUNCTION_LIST LDRLMX IF_DATA DIM_X DIRECT 0x81D4EC
 /begin AXIS_DESCR STD_AXIS tmot temp_ub_q0p75_o48 6 -48.00 143.3 DEPOSIT ABSOLUT /end AXIS_DESCR
 /begin AXIS_DESCR STD_AXIS nmot_w nmot_uw_q0p25 18 0.00 16383.75 DEPOSIT ABSOLUT /end AXIS_DESCR
/end CHARACTERISTIC
/begin CHARACTERISTIC KFLDRXNW "Maximalfüllung LDR bei NW-Stellung spät" MAP 0x81D5F0 KfAxUbAyUbSstxUbSstyUwWUw 1535.977 rel_uw_q0p0234 0.00 1535.977 FUNCTION_LIST LDRLMX IF_DATA DIM_X DIRECT 0x81D5F0
 /begin AXIS_DESCR STD_AXIS tmot temp_ub_q0p75_o48 6 -48.00 143.3 DEPOSIT ABSOLUT /end AXIS_DESCR
 /begin AXIS_DESCR STD_AXIS nmot_w nmot_uw_q0p25 18 0.00 16383.75 DEPOSIT ABSOLUT /end AXIS_DESCR
/end CHARACTERISTIC
/begin CHARACTERISTIC KFLDRXO "Delta Füllung (rl) im Overboostbetrieb" MAP 0x8193FA KfAxUbAyUbSstxUbSstyUbWUb 191.3 rel_ub_q0p75 0.00 191.3 FUNCTION_LIST LDOB IF_DATA DIM_X DIRECT 0x8193FA /begin AXIS_DESCR STD_AXIS nmot nmot_ub_q40 8 0.00 10200. DEPOSIT ABSOLUT /end AXIS_DESCR
 /begin AXIS_DESCR STD_AXIS tans temp_ub_q0p75_o48 4 -48.00 143.3 DEPOSIT ABSOLUT /end AXIS_DESCR
/end CHARACTERISTIC
/begin CHARACTERISTIC KFLF "Lambdakennfeld bei Teillast" MAP 0x818816 KfAxUbAyUbSstxUbSstyUbWUb 1.992 fak_ub_b2 0.00 1.992 FUNCTION_LIST ESGRU IF_DATA DIM_X DIRECT 0x818816 /begin AXIS_DESCR STD_AXIS nmot nmot_ub_q40 16 0.00 10200. DEPOSIT ABSOLUT /end AXIS_DESCR /begin AXIS_DESCR STD_AXIS rl rel_ub_q0p75 16 0.00 191.3 DEPOSIT ABSOLUT /end AXIS_DESCR /end CHARACTERISTIC
/begin CHARACTERISTIC KFLMSKH "Kennfeld Lambda-Motor-Soll bei Katheizen" MAP 0x81D304 KfAxUwAyUwSstxUwSstyUwWUw 15.99976 fak_q0p000244 0.00 15.99976 FUNCTION_LIST LAKH IF_DATA DIM_X DIRECT 0x81D304
 /begin AXIS_DESCR STD_AXIS nmot_w nmot_uw_q0p25 8 0.00 16383.75 DEPOSIT ABSOLUT /end AXIS_DESCR
 /begin AXIS_DESCR STD_AXIS rl_w rel_uw_q0p0234 8 0.00 1535.977 DEPOSIT ABSOLUT /end AXIS_DESCR
/end CHARACTERISTIC
/begin CHARACTERISTIC KFLRSG1 "Kennfeld Reglerparameter g1 stetiger Lambdaregler" MAP 0x8169DE GkfWSw 63.99902 fak_sw_b32 -32.00000 31.99902 FUNCTION_LIST LRS IF_DATA DIM_X DIRECT 0x8169DE
 /begin AXIS_DESCR COM_AXIS nmot_w nmot_uw_q0p25 7 0.00 16383.75 AXIS_PTS_REF SNM07LSUW /end AXIS_DESCR
 /begin AXIS_DESCR COM_AXIS rl_w rel_uw_q0p0234 8 0.00 1535.977 AXIS_PTS_REF SRL08LSUW /end AXIS_DESCR
/end CHARACTERISTIC
/begin CHARACTERISTIC KFLRSG2 "Kennfeld Reglerparameter g2 stetiger Lambdaregler" MAP 0x816A4E GkfWUw 63.99902 fak_uw_b64 0.00 63.99902 FUNCTION_LIST LRS IF_DATA DIM_X DIRECT 0x816A4E
 /begin AXIS_DESCR COM_AXIS nmot_w nmot_uw_q0p25 7 0.00 16383.75 AXIS_PTS_REF SNM07LSUW /end AXIS_DESCR
 /begin AXIS_DESCR COM_AXIS rl_w rel_uw_q0p0234 8 0.00 1535.977 AXIS_PTS_REF SRL08LSUW /end AXIS_DESCR
/end CHARACTERISTIC
/begin CHARACTERISTIC KFLRSG4 "Kennfeld Reglerparameter g4 stetiger Lambdaregler" MAP 0x816ABE GkfWSw 3.999939 fak_sw_b2 -2.000000 1.999939 FUNCTION_LIST LRS IF_DATA DIM_X DIRECT 0x816ABE
 /begin AXIS_DESCR COM_AXIS nmot_w nmot_uw_q0p25 7 0.00 16383.75 AXIS_PTS_REF SNM07LSUW /end AXIS_DESCR
 /begin AXIS_DESCR COM_AXIS rl_w rel_uw_q0p0234 8 0.00 1535.977 AXIS_PTS_REF SRL08LSUW /end AXIS_DESCR
/end CHARACTERISTIC
/begin CHARACTERISTIC KFLRSP1 "Kennfeld Reglerparameter p1 stetiger Lambdaregler" MAP 0x816B2E GkfWUw 127.9980 fak_uw_b128 0.00 127.9980 FUNCTION_LIST LRS IF_DATA DIM_X DIRECT 0x816B2E
 /begin AXIS_DESCR COM_AXIS nmot_w nmot_uw_q0p25 7 0.00 16383.75 AXIS_PTS_REF SNM07LSUW /end AXIS_DESCR
 /begin AXIS_DESCR COM_AXIS rl_w rel_uw_q0p0234 8 0.00 1535.977 AXIS_PTS_REF SRL08LSUW /end AXIS_DESCR
/end CHARACTERISTIC
/begin CHARACTERISTIC KFLRSP2 "Kennfeld Reglerparameter p2 stetiger Lambdaregler" MAP 0x816B9E GkfWUw 127.9980 fak_uw_b128 0.00 127.9980 FUNCTION_LIST LRS IF_DATA DIM_X DIRECT 0x816B9E
 /begin AXIS_DESCR COM_AXIS nmot_w nmot_uw_q0p25 7 0.00 16383.75 AXIS_PTS_REF SNM07LSUW /end AXIS_DESCR
 /begin AXIS_DESCR COM_AXIS rl_w rel_uw_q0p0234 8 0.00 1535.977 AXIS_PTS_REF SRL08LSUW /end AXIS_DESCR
/end CHARACTERISTIC
/begin CHARACTERISTIC KFLRSP3 "Kennfeld Reglerparameter p3 stetiger Lambdaregler" MAP 0x816C0E GkfWUw 127.9980 fak_uw_b128 0.00 127.9980 FUNCTION_LIST LRS IF_DATA DIM_X DIRECT 0x816C0E
 /begin AXIS_DESCR COM_AXIS nmot_w nmot_uw_q0p25 7 0.00 16383.75 AXIS_PTS_REF SNM07LSUW /end AXIS_DESCR
 /begin AXIS_DESCR COM_AXIS rl_w rel_uw_q0p0234 8 0.00 1535.977 AXIS_PTS_REF SRL08LSUW /end AXIS_DESCR
/end CHARACTERISTIC
/begin CHARACTERISTIC KFLRSP4 "Kennfeld Reglerparameter p4 stetiger Lambdaregler" MAP 0x816C7E GkfWSw 127.9980 fak_sw_b64 -64.00000 63.99805 FUNCTION_LIST LRS IF_DATA DIM_X DIRECT 0x816C7E
 /begin AXIS_DESCR COM_AXIS nmot_w nmot_uw_q0p25 7 0.00 16383.75 AXIS_PTS_REF SNM07LSUW /end AXIS_DESCR
 /begin AXIS_DESCR COM_AXIS rl_w rel_uw_q0p0234 8 0.00 1535.977 AXIS_PTS_REF SRL08LSUW /end AXIS_DESCR
/end CHARACTERISTIC
/begin CHARACTERISTIC KFLRST "Kennfeld Streckentotzeit" MAP 0x816CEE KfAxUwAyUwSstxUwSstyUwWUw 327.67000000 tz10msxs_uw_b327p68 0.010000000000 327.68000000 FUNCTION_LIST LRS IF_DATA DIM_X DIRECT 0x816CEE
 /begin AXIS_DESCR STD_AXIS nmot_w nmot_uw_q0p25 7 0.00 16383.75 DEPOSIT ABSOLUT /end AXIS_DESCR
 /begin AXIS_DESCR STD_AXIS rl_w rel_uw_q0p0234 8 0.00 1535.977 DEPOSIT ABSOLUT /end AXIS_DESCR
/end CHARACTERISTIC
/begin CHARACTERISTIC KFLRSTAU "Kennfeld Streckenzeitkonstante" MAP 0x8120BA KfAxUbAyUbSstxUbSstyUbWUb 2.54000 zk10msxs_ub_b2p55 0.0100000 2.55000 FUNCTION_LIST LRS IF_DATA DIM_X DIRECT 0x8120BA /begin AXIS_DESCR STD_AXIS nmot nmot_ub_q40 7 0.00 10200. DEPOSIT ABSOLUT /end AXIS_DESCR /begin AXIS_DESCR STD_AXIS rl rel_ub_q0p75 8 0.00 191.3 DEPOSIT ABSOLUT /end AXIS_DESCR /end CHARACTERISTIC
/begin CHARACTERISTIC KFLSUED "Kennfeld für die Einschaltdauer der LSU-Heizung abh. von Abgastemperatur und ml" MAP 0x819900 KfAxUbAyUbSstxUbSstyUbWUb 2.550 t10msxs_ub_b2p55 0.00 2.550 FUNCTION_LIST HLSU IF_DATA DIM_X DIRECT 0x819900
 /begin AXIS_DESCR STD_AXIS tabgm temp_ub_q5_o50 7 -50.00 1225. DEPOSIT ABSOLUT /end AXIS_DESCR
 /begin AXIS_DESCR STD_AXIS msabg m_ub_b1020 5 0.00 1020. DEPOSIT ABSOLUT /end AXIS_DESCR
/end CHARACTERISTIC
/begin CHARACTERISTIC KFLSUED2 "Kennfeld für die Einschaltdauer der LSU-Heizung abh. von Abgastemperatur2 und ml" MAP 0x819931 KfAxUbAyUbSstxUbSstyUbWUb 2.550 t10msxs_ub_b2p55 0.00 2.550 FUNCTION_LIST HLSU IF_DATA DIM_X DIRECT 0x819931
 /begin AXIS_DESCR STD_AXIS tabgm2 temp_ub_q5_o50 7 -50.00 1225. DEPOSIT ABSOLUT /end AXIS_DESCR
 /begin AXIS_DESCR STD_AXIS msabg2 m_ub_b1020 5 0.00 1020. DEPOSIT ABSOLUT /end AXIS_DESCR
/end CHARACTERISTIC
/begin CHARACTERISTIC KFLUAR "Kennfeld für Laufunruhe-Abstandsmass-Referenzwert" MAP 0x8102BE GkfWUb 463.8 luquant 0.00 463.8 FUNCTION_LIST DMDLUA IF_DATA DIM_X DIRECT 0x8102BE
 /begin AXIS_DESCR COM_AXIS rl rel_ub_q0p75 8 0.00 191.3 AXIS_PTS_REF SRL08DMUB /end AXIS_DESCR
 /begin AXIS_DESCR COM_AXIS nmot nmot_ub_q40 8 0.00 10200. AXIS_PTS_REF SNM08DMUB /end AXIS_DESCR
/end CHARACTERISTIC
/begin CHARACTERISTIC KFLUAR1 "Kennfeld für Laufunruhe-Abstandsmass-Referenzwert" MAP 0x8102FE GkfWUb 463.8 luquant 0.00 463.8 FUNCTION_LIST DMDLUA IF_DATA DIM_X DIRECT 0x8102FE
 /begin AXIS_DESCR COM_AXIS rl rel_ub_q0p75 8 0.00 191.3 AXIS_PTS_REF SRL08DMUB /end AXIS_DESCR
 /begin AXIS_DESCR COM_AXIS nmot nmot_ub_q40 8 0.00 10200. AXIS_PTS_REF SNM08DMUB /end AXIS_DESCR
/end CHARACTERISTIC
/begin CHARACTERISTIC KFLUAR2 "Kennfeld für Laufunruhe-Abstandsmass-Referenzwert" MAP 0x81033E GkfWUb 463.8 luquant 0.00 463.8 FUNCTION_LIST DMDLUA IF_DATA DIM_X DIRECT 0x81033E
 /begin AXIS_DESCR COM_AXIS rl rel_ub_q0p75 8 0.00 191.3 AXIS_PTS_REF SRL08DMUB /end AXIS_DESCR
 /begin AXIS_DESCR COM_AXIS nmot nmot_ub_q40 8 0.00 10200. AXIS_PTS_REF SNM08DMUB /end AXIS_DESCR
/end CHARACTERISTIC
/begin CHARACTERISTIC KFLUARV "Kennfeld für Laufunruhe-Abstandsmass-Referenzwert für Ventilhub gross" MAP 0x81037E GkfWUb 463.8 luquant 0.00 463.8 FUNCTION_LIST DMDLUA IF_DATA DIM_X DIRECT 0x81037E
 /begin AXIS_DESCR COM_AXIS rl rel_ub_q0p75 8 0.00 191.3 AXIS_PTS_REF SRL08DMUB /end AXIS_DESCR
 /begin AXIS_DESCR COM_AXIS nmot nmot_ub_q40 8 0.00 10200. AXIS_PTS_REF SNM08DMUB /end AXIS_DESCR
/end CHARACTERISTIC
/begin CHARACTERISTIC KFLUARZ "Kennfeld für Laufunruhe-Abstandsmass-Referenzwert bei ZAS" MAP 0x8103BE GkfWUb 463.8 luquant 0.00 463.8 FUNCTION_LIST DMDLUA IF_DATA DIM_X DIRECT 0x8103BE
 /begin AXIS_DESCR COM_AXIS rl rel_ub_q0p75 8 0.00 191.3 AXIS_PTS_REF SRL08DMUB /end AXIS_DESCR
 /begin AXIS_DESCR COM_AXIS nmot nmot_ub_q40 8 0.00 10200. AXIS_PTS_REF SNM08DMUB /end AXIS_DESCR
/end CHARACTERISTIC
/begin CHARACTERISTIC KFLURB "Kennfeld für Laufunruhe-Referenz-Basiswert" MAP 0x810627 GkfWSb 463.8 luquant -232.8 231.0 FUNCTION_LIST DMDLU IF_DATA DIM_X DIRECT 0x810627
 /begin AXIS_DESCR COM_AXIS rl rel_ub_q0p75 8 0.00 191.3 AXIS_PTS_REF SRL08DMUB /end AXIS_DESCR
 /begin AXIS_DESCR COM_AXIS nmot nmot_ub_q40 8 0.00 10200. AXIS_PTS_REF SNM08DMUB /end AXIS_DESCR
/end CHARACTERISTIC
/begin CHARACTERISTIC KFLURB1 "Kennfeld für Laufunruhe-Referenz-Basiswert" MAP 0x810667 GkfWSb 463.8 luquant -232.8 231.0 FUNCTION_LIST DMDLU IF_DATA DIM_X DIRECT 0x810667
 /begin AXIS_DESCR COM_AXIS rl rel_ub_q0p75 8 0.00 191.3 AXIS_PTS_REF SRL08DMUB /end AXIS_DESCR
 /begin AXIS_DESCR COM_AXIS nmot nmot_ub_q40 8 0.00 10200. AXIS_PTS_REF SNM08DMUB /end AXIS_DESCR
/end CHARACTERISTIC
/begin CHARACTERISTIC KFLURB2 "Kennfeld für Laufunruhe-Referenz-Basiswert" MAP 0x8106A7 GkfWSb 463.8 luquant -232.8 231.0 FUNCTION_LIST DMDLU IF_DATA DIM_X DIRECT 0x8106A7
 /begin AXIS_DESCR COM_AXIS rl rel_ub_q0p75 8 0.00 191.3 AXIS_PTS_REF SRL08DMUB /end AXIS_DESCR
 /begin AXIS_DESCR COM_AXIS nmot nmot_ub_q40 8 0.00 10200. AXIS_PTS_REF SNM08DMUB /end AXIS_DESCR
/end CHARACTERISTIC
/begin CHARACTERISTIC KFLURBV "Kennfeld für Laufunruhe-Referenz-Basiswert Ventilhub groß" MAP 0x8106E7 GkfWSb 463.8 luquant -232.8 231.0 FUNCTION_LIST DMDLU IF_DATA DIM_X DIRECT 0x8106E7
 /begin AXIS_DESCR COM_AXIS rl rel_ub_q0p75 8 0.00 191.3 AXIS_PTS_REF SRL08DMUB /end AXIS_DESCR
 /begin AXIS_DESCR COM_AXIS nmot nmot_ub_q40 8 0.00 10200. AXIS_PTS_REF SNM08DMUB /end AXIS_DESCR
/end CHARACTERISTIC
/begin CHARACTERISTIC KFLURBZ "Kennfeld für Laufunruhe-Referenz-Basiswert bei ZAS" MAP 0x810727 GkfWSb 463.8 luquant -232.8 231.0 FUNCTION_LIST DMDLU IF_DATA DIM_X DIRECT 0x810727
 /begin AXIS_DESCR COM_AXIS rl rel_ub_q0p75 8 0.00 191.3 AXIS_PTS_REF SRL08DMUB /end AXIS_DESCR
 /begin AXIS_DESCR COM_AXIS nmot nmot_ub_q40 8 0.00 10200. AXIS_PTS_REF SNM08DMUB /end AXIS_DESCR
/end CHARACTERISTIC
/begin CHARACTERISTIC KFLURM "Kennfeld für Laufunruhe-Referenzwert zur Mehrfachaussetzererkennung ->Lum-Vergl." MAP 0x810767 GkfWSb 463.8 luquant -232.8 231.0 FUNCTION_LIST DMDLU IF_DATA DIM_X DIRECT 0x810767
 /begin AXIS_DESCR COM_AXIS rl rel_ub_q0p75 8 0.00 191.3 AXIS_PTS_REF SRL08DMUB /end AXIS_DESCR
 /begin AXIS_DESCR COM_AXIS nmot nmot_ub_q40 8 0.00 10200. AXIS_PTS_REF SNM08DMUB /end AXIS_DESCR
/end CHARACTERISTIC
/begin CHARACTERISTIC KFLURM1 "Kennfeld für Laufunruhe-Referenzwert zur Mehrfachaussetzererkennung ->Lum-Vergl." MAP 0x8107A7 GkfWSb 463.8 luquant -232.8 231.0 FUNCTION_LIST DMDLU IF_DATA DIM_X DIRECT 0x8107A7
 /begin AXIS_DESCR COM_AXIS rl rel_ub_q0p75 8 0.00 191.3 AXIS_PTS_REF SRL08DMUB /end AXIS_DESCR
 /begin AXIS_DESCR COM_AXIS nmot nmot_ub_q40 8 0.00 10200. AXIS_PTS_REF SNM08DMUB /end AXIS_DESCR
/end CHARACTERISTIC
/begin CHARACTERISTIC KFMAKR "Kennfeld Meßfensteranfang Klopfregelung" MAP 0x81917F GkfWUb 191.3 zw_ub_q0p75 0.00 191.3 FUNCTION_LIST GGKS IF_DATA DIM_X DIRECT 0x81917F
 /begin AXIS_DESCR COM_AXIS nmot nmot_ub_q40 16 0.00 10200. AXIS_PTS_REF SNM16KRUB /end AXIS_DESCR
 /begin AXIS_DESCR COM_AXIS rl rel_ub_q0p75 4 0.00 191.3 AXIS_PTS_REF SRL04KRUB /end AXIS_DESCR
/end CHARACTERISTIC
/begin CHARACTERISTIC KFMDBGRG "Kennfeld mit dem Wert der Momentenbegrenzung" MAP 0x81DBD6 KfAxUwAyUwSstxUwSstyUwWUw 99.99847 rel_uw_b100 0.00 99.99847 FUNCTION_LIST MDBGRG IF_DATA DIM_X DIRECT 0x81DBD6 /begin AXIS_DESCR STD_AXIS nmot nmot_ub_q40 4 0.00 2621400. DEPOSIT ABSOLUT /end AXIS_DESCR /begin AXIS_DESCR STD_AXIS gangi dez 7 0.00 65535.00 DEPOSIT ABSOLUT /end AXIS_DESCR /end CHARACTERISTIC
/begin CHARACTERISTIC KFMDDSLA "Kennfeld Drehmomentenreserve bei Testereingriff Sekundärluftdiagnose" MAP 0x81D034 KfAxUwAyUwSstxUwSstyUwWUw 99.99847 rel_uw_b100 0.00 99.99847 FUNCTION_LIST KHMD IF_DATA DIM_X DIRECT 0x81D034
 /begin AXIS_DESCR STD_AXIS nmot_w nmot_uw_q0p25 4 0.00 16383.75 DEPOSIT ABSOLUT /end AXIS_DESCR
 /begin AXIS_DESCR STD_AXIS mifakh_w rel_uw_b100 4 0.00 99.99847 DEPOSIT ABSOLUT /end AXIS_DESCR
/end CHARACTERISTIC
/begin CHARACTERISTIC KFMDKH "Kennfeld Drehmomentenreserve für Katheizen" MAP 0x81D068 KfAxUwAyUwSstxUwSstyUwWUw 99.99847 rel_uw_b100 0.00 99.99847 FUNCTION_LIST KHMD IF_DATA DIM_X DIRECT 0x81D068
 /begin AXIS_DESCR STD_AXIS nmot_w nmot_uw_q0p25 8 0.00 16383.75 DEPOSIT ABSOLUT /end AXIS_DESCR
 /begin AXIS_DESCR STD_AXIS mifakh_w rel_uw_b100 8 0.00 99.99847 DEPOSIT ABSOLUT /end AXIS_DESCR
/end CHARACTERISTIC
/begin CHARACTERISTIC KFMDKHLL "Kennfeld Drehmomentenreserve für Katheizen bei LL" MAP 0x81D10C KfAxUwAyUwSstxUwSstyUwWUw 99.99847 rel_uw_b100 0.00 99.99847 FUNCTION_LIST KHMD IF_DATA DIM_X DIRECT 0x81D10C
 /begin AXIS_DESCR STD_AXIS nmot_w nmot_uw_q0p25 8 0.00 16383.75 DEPOSIT ABSOLUT /end AXIS_DESCR
 /begin AXIS_DESCR STD_AXIS mifakh_w rel_uw_b100 8 0.00 99.99847 DEPOSIT ABSOLUT /end AXIS_DESCR
/end CHARACTERISTIC
/begin CHARACTERISTIC KFMDKO "Drehmomentaufnahme Klimakompressor" MAP 0x819757 KfAxUbAyUbSstxUbSstyUbWUb 49.73 rel_ub_b49p725 0.00 49.73 FUNCTION_LIST MDVERB IF_DATA DIM_X DIRECT 0x819757 /begin AXIS_DESCR STD_AXIS nmot nmot_ub_q40 6 0.00 10200. DEPOSIT ABSOLUT /end AXIS_DESCR /begin AXIS_DESCR STD_AXIS kopwm dez 8 0.00 255.0 DEPOSIT ABSOLUT /end AXIS_DESCR /end CHARACTERISTIC
/begin CHARACTERISTIC KFMDS "Schleppmoment Drehzahl- und Lastabhängigkeit" MAP 0x815B16 KfAxUwAyUwSstxUwSstyUwWUw 99.99847 rel_uw_b100 0.00 99.99847 FUNCTION_LIST MDVER IF_DATA DIM_X DIRECT 0x815B16
 /begin AXIS_DESCR STD_AXIS nmot_w nmot_uw_q0p25 10 0.00 16383.75 DEPOSIT ABSOLUT /end AXIS_DESCR
 /begin AXIS_DESCR STD_AXIS rl_w rel_uw_q0p0234 12 0.00 1535.977 DEPOSIT ABSOLUT /end AXIS_DESCR
/end CHARACTERISTIC
/begin CHARACTERISTIC KFMDS2 "Schleppmoment Variante 2" MAP 0x815C36 KfAxUwAyUwSstxUwSstyUwWUw 99.99847 rel_uw_b100 0.00 99.99847 FUNCTION_LIST MDVER IF_DATA DIM_X DIRECT 0x815C36
 /begin AXIS_DESCR STD_AXIS nmot_w nmot_uw_q0p25 10 0.00 16383.75 DEPOSIT ABSOLUT /end AXIS_DESCR
 /begin AXIS_DESCR STD_AXIS rl_w rel_uw_q0p0234 12 0.00 1535.977 DEPOSIT ABSOLUT /end AXIS_DESCR
/end CHARACTERISTIC
/begin CHARACTERISTIC KFMDS3 "Schleppmoment Variante 3" MAP 0x815D56 KfAxUwAyUwSstxUwSstyUwWUw 99.99847 rel_uw_b100 0.00 99.99847 FUNCTION_LIST MDVER IF_DATA DIM_X DIRECT 0x815D56
 /begin AXIS_DESCR STD_AXIS nmot_w nmot_uw_q0p25 10 0.00 16383.75 DEPOSIT ABSOLUT /end AXIS_DESCR
 /begin AXIS_DESCR STD_AXIS rl_w rel_uw_q0p0234 12 0.00 1535.977 DEPOSIT ABSOLUT /end AXIS_DESCR
/end CHARACTERISTIC
/begin CHARACTERISTIC KFMDS4 "Schleppmoment Variante 4" MAP 0x815E76 KfAxUwAyUwSstxUwSstyUwWUw 99.99847 rel_uw_b100 0.00 99.99847 FUNCTION_LIST MDVER IF_DATA DIM_X DIRECT 0x815E76
 /begin AXIS_DESCR STD_AXIS nmot_w nmot_uw_q0p25 10 0.00 16383.75 DEPOSIT ABSOLUT /end AXIS_DESCR
 /begin AXIS_DESCR STD_AXIS rl_w rel_uw_q0p0234 12 0.00 1535.977 DEPOSIT ABSOLUT /end AXIS_DESCR
/end CHARACTERISTIC
/begin CHARACTERISTIC KFMDST "Startmoment" MAP 0x815A94 KfAxUbAyUbSstxUbSstyUbWSb 198.9 rel_sb_q0p78 -99.84 99.06 FUNCTION_LIST STMD IF_DATA DIM_X DIRECT 0x815A94 /begin AXIS_DESCR STD_AXIS qnst fak_ub_b2 8 0.00 1.992 DEPOSIT ABSOLUT /end AXIS_DESCR
 /begin AXIS_DESCR STD_AXIS tmot temp_ub_q0p75_o48 6 -48.00 143.3 DEPOSIT ABSOLUT /end AXIS_DESCR
/end CHARACTERISTIC
/begin CHARACTERISTIC KFMDST1 "Startmoment" MAP 0x815AD4 KfAxUbAyUbSstxUbSstyUbWSb 198.9 rel_sb_q0p78 -99.84 99.06 FUNCTION_LIST STMD IF_DATA DIM_X DIRECT 0x815AD4 /begin AXIS_DESCR STD_AXIS qnst fak_ub_b2 8 0.00 1.992 DEPOSIT ABSOLUT /end AXIS_DESCR
 /begin AXIS_DESCR STD_AXIS tmot temp_ub_q0p75_o48 6 -48.00 143.3 DEPOSIT ABSOLUT /end AXIS_DESCR
/end CHARACTERISTIC
/begin CHARACTERISTIC KFMDZOF_UC "Kennfeld für Offset-Toleranz in Abhängigkeit vom zul. Moment im Befehlstest" MAP 0x811F06 GkfWUb 99.61 rel_ub_b99p6 0.00 99.61 FUNCTION_LIST URCMZUL IF_DATA DIM_X DIRECT 0x811F06
 /begin AXIS_DESCR COM_AXIS mzmax_uc rel_ub_b99p6 8 0.00 99.61 AXIS_PTS_REF MDV08_UC /end AXIS_DESCR
 /begin AXIS_DESCR COM_AXIS nmot_uc nmot_ub_q40 8 0.00 10200. AXIS_PTS_REF NMV08_UC /end AXIS_DESCR
/end CHARACTERISTIC
/begin CHARACTERISTIC KFMDZOF_UM "Kennfeld für Offset-Toleranz in Abhängigkeit vom zulässigen Moment" MAP 0x817E2E GkfWUb 99.61 rel_ub_b99p6 0.00 99.61 FUNCTION_LIST UFMZUL IF_DATA DIM_X DIRECT 0x817E2E
 /begin AXIS_DESCR COM_AXIS mzmax_um rel_ub_b99p6 8 0.00 99.61 AXIS_PTS_REF MDV08_UM /end AXIS_DESCR
 /begin AXIS_DESCR COM_AXIS nmot_um nmot_ub_q40 8 0.00 10200. AXIS_PTS_REF NMV08_UM /end AXIS_DESCR
/end CHARACTERISTIC
/begin CHARACTERISTIC KFMIGSL "Wichtungsfaktor GS Momenteneingriff auf Füllung" MAP 0x81373A KfAxUwAyUwSstxUwSstyUwWUw 15.99976 fak_uw_b16 0.00 15.99976 FUNCTION_LIST MDEX IF_DATA DIM_X DIRECT 0x81373A
 /begin AXIS_DESCR STD_AXIS nmot_w nmot_uw_q0p25 8 0.00 16383.75 DEPOSIT ABSOLUT /end AXIS_DESCR
 /begin AXIS_DESCR STD_AXIS mifa_w rel_uw_b100 8 0.00 99.99847 DEPOSIT ABSOLUT /end AXIS_DESCR
/end CHARACTERISTIC
/begin CHARACTERISTIC KFMILSD "Startwert indiziertes Moment für Lastschlagdämpfung" MAP 0x81DCA8 GkfWUw 98.99902 rel_uw_b100 0.9994507 99.99847 FUNCTION_LIST MDFAW IF_DATA DIM_X DIRECT 0x81DCA8 /begin AXIS_DESCR COM_AXIS gangi dez 8 0.00 255.0 AXIS_PTS_REF SGA08MDUB /end AXIS_DESCR
 /begin AXIS_DESCR COM_AXIS nmot_w nmot_uw_q0p25 6 0.00 16383.75 AXIS_PTS_REF SNM06MDUW /end AXIS_DESCR
/end CHARACTERISTIC
/begin CHARACTERISTIC KFMIMN "Minimales Schubmoment" MAP 0x8159E0 KfAxUbAyUbSstxUbSstyUwWUw 99.99847 rel_uw_b100 0.00 99.99847 FUNCTION_LIST MDMIN IF_DATA DIM_X DIRECT 0x8159E0 /begin AXIS_DESCR STD_AXIS gangi dez 8 0.00 255.0 DEPOSIT ABSOLUT /end AXIS_DESCR
 /begin AXIS_DESCR STD_AXIS nmot_w nmot_uw_q0p25 8 0.00 16383.75 DEPOSIT ABSOLUT /end AXIS_DESCR
/end CHARACTERISTIC
/begin CHARACTERISTIC KFMIOP "Kennfeld optimales Motormoment" MAP 0x8160D6 GkfWUw 99.99847 rel_uw_b100 0.00 99.99847 FUNCTION_LIST MDBAS MDMAX IF_DATA DIM_X DIRECT 0x8160D6
 /begin AXIS_DESCR COM_AXIS nmot_w nmot_uw_q0p25 16 0.00 16383.75 AXIS_PTS_REF SNM16OPUW /end AXIS_DESCR
 /begin AXIS_DESCR COM_AXIS rl_w_kge rel_uw_q0p0234 16 0.00 1535.977 AXIS_PTS_REF SRL11OPUW /end AXIS_DESCR
/end CHARACTERISTIC
/begin CHARACTERISTIC KFMIRED "Kennfeld Abregelungsmoment für VMAX-Regelung" MAP 0x811C34 GkfWUb 99.61 rel_ub_b99p6 0.00 99.61 FUNCTION_LIST VMAXMD IF_DATA DIM_X DIRECT 0x811C34
 /begin AXIS_DESCR COM_AXIS bfzglf bfzg_sb_q0p217 2 -27.78 27.56 AXIS_PTS_REF SBF02MFSB /end AXIS_DESCR
 /begin AXIS_DESCR COM_AXIS rl_w rel_uw_q0p0234 3 0.00 1535.977 AXIS_PTS_REF SRL03MFUW /end AXIS_DESCR
/end CHARACTERISTIC
/begin CHARACTERISTIC KFMIRL "Kennfeld für Berechnung Sollfüllung" MAP 0x815316 KfAxUwAyUwSstxUwSstyUwWUw 1535.977 rel_uw_q0p0234 0.00 1535.977 FUNCTION_LIST MDFUE IF_DATA DIM_X DIRECT 0x815316
 /begin AXIS_DESCR STD_AXIS nmot_w nmot_uw_q0p25 16 0.00 16383.75 DEPOSIT ABSOLUT /end AXIS_DESCR
 /begin AXIS_DESCR STD_AXIS misopl1_w rel_uw_b100 16 0.00 99.99847 DEPOSIT ABSOLUT /end AXIS_DESCR
/end CHARACTERISTIC
/begin CHARACTERISTIC KFMIZUFIL "Zulässiges indiziertes Moment zur Momentenbegrenzung vor Filter" MAP 0x811B53 GkfWUb 99.61 rel_ub_b99p6 0.00 99.61 FUNCTION_LIST MDZUL IF_DATA DIM_X DIRECT 0x811B53
 /begin AXIS_DESCR COM_AXIS wped relPED_ub_b100 8 0.00 100.0 AXIS_PTS_REF SWP08OPUB /end AXIS_DESCR
 /begin AXIS_DESCR COM_AXIS nmot nmot_ub_q40 8 0.00 10200. AXIS_PTS_REF SNM08OPUB /end AXIS_DESCR
/end CHARACTERISTIC
/begin CHARACTERISTIC KFMIZUNS "Zulässiges Moment bei Nachstartaufweitung" MAP 0x811B93 GkfWUb 99.61 rel_ub_b99p6 0.00 99.61 FUNCTION_LIST MDZUL IF_DATA DIM_X DIRECT 0x811B93
 /begin AXIS_DESCR COM_AXIS wped relPED_ub_b100 8 0.00 100.0 AXIS_PTS_REF SWP08OPUB /end AXIS_DESCR
 /begin AXIS_DESCR COM_AXIS nmot nmot_ub_q40 8 0.00 10200. AXIS_PTS_REF SNM08OPUB /end AXIS_DESCR
/end CHARACTERISTIC
/begin CHARACTERISTIC KFMIZUOF "Zulässiges indiziertes Moment zur Momentenbegrenzung" MAP 0x811BD3 GkfWUb 99.61 rel_ub_b99p6 0.00 99.61 FUNCTION_LIST MDZUL IF_DATA DIM_X DIRECT 0x811BD3
 /begin AXIS_DESCR COM_AXIS mizuvfil rel_ub_b99p6 8 0.00 99.61 AXIS_PTS_REF SMO08OPUB /end AXIS_DESCR
 /begin AXIS_DESCR COM_AXIS nmot nmot_ub_q40 8 0.00 10200. AXIS_PTS_REF SNM08OPUB /end AXIS_DESCR
/end CHARACTERISTIC
/begin CHARACTERISTIC KFMI_UC "Kennfeld optimales Motormoment im Befehlstest" MAP 0x811E75 GkfWUb 99.61 rel_ub_b99p6 0.00 99.61 FUNCTION_LIST URCMIST IF_DATA DIM_X DIRECT 0x811E75
 /begin AXIS_DESCR COM_AXIS rl_uc rel_ub_q0p75 8 0.00 191.3 AXIS_PTS_REF RLV08_UC /end AXIS_DESCR
 /begin AXIS_DESCR COM_AXIS nmot_uc nmot_ub_q40 8 0.00 10200. AXIS_PTS_REF NZWV08_UC /end AXIS_DESCR
/end CHARACTERISTIC
/begin CHARACTERISTIC KFMI_UM "Kennfeld optimales Motormoment in der Funktionsüberwachung" MAP 0x817D9D GkfWUb 99.61 rel_ub_b99p6 0.00 99.61 FUNCTION_LIST UFMIST IF_DATA DIM_X DIRECT 0x817D9D
 /begin AXIS_DESCR COM_AXIS rl_um rel_ub_q0p75 8 0.00 191.3 AXIS_PTS_REF RLV08_UM /end AXIS_DESCR
 /begin AXIS_DESCR COM_AXIS nmot_um nmot_ub_q40 8 0.00 10200. AXIS_PTS_REF NZWV08_UM /end AXIS_DESCR
/end CHARACTERISTIC
/begin CHARACTERISTIC KFMLDMN "ML-Schwelle für B_minflr-Diagnose HFM/HLM" MAP 0x81BB22 KfAxUwAyUwSstxUwSstyUwWSw 6553.500 m_q0p1 -3276.800 3276.700 FUNCTION_LIST DHFM IF_DATA DIM_X DIRECT 0x81BB22
 /begin AXIS_DESCR STD_AXIS wdkbadmn_w relDK_q0p02441 8 0.00 1599.976 DEPOSIT ABSOLUT /end AXIS_DESCR
 /begin AXIS_DESCR STD_AXIS nmot_w nmot_uw_q0p25 8 0.00 16383.75 DEPOSIT ABSOLUT /end AXIS_DESCR
/end CHARACTERISTIC
/begin CHARACTERISTIC KFMLDMX "ML-Schwelle für B_maxflr-Diagnose HFM/HLM" MAP 0x81BBC6 KfAxUwAyUwSstxUwSstyUwWUw 6553.500 m_q0p1 0.00 6553.500 FUNCTION_LIST DHFM IF_DATA DIM_X DIRECT 0x81BBC6
 /begin AXIS_DESCR STD_AXIS wdkbadmx_w relDK_q0p02441 8 0.00 1599.976 DEPOSIT ABSOLUT /end AXIS_DESCR
 /begin AXIS_DESCR STD_AXIS nmot_w nmot_uw_q0p25 8 0.00 16383.75 DEPOSIT ABSOLUT /end AXIS_DESCR
/end CHARACTERISTIC
/begin CHARACTERISTIC KFMLVSMN "ML-Schwelle für B_minflr-Diagnose bei B_vsv" MAP 0x81BC6A KfAxUwAyUwSstxUwSstyUwWSw 6553.500 m_q0p1 -3276.800 3276.700 FUNCTION_LIST DHFM IF_DATA DIM_X DIRECT 0x81BC6A
 /begin AXIS_DESCR STD_AXIS wdkbadmn_w relDK_q0p02441 8 0.00 1599.976 DEPOSIT ABSOLUT /end AXIS_DESCR
 /begin AXIS_DESCR STD_AXIS nmot_w nmot_uw_q0p25 8 0.00 16383.75 DEPOSIT ABSOLUT /end AXIS_DESCR
/end CHARACTERISTIC
/begin CHARACTERISTIC KFMLVSMX "ML-Schwelle für B_maxflr-Diagnose bei B_vsv" MAP 0x81BD0E KfAxUwAyUwSstxUwSstyUwWUw 6553.500 m_q0p1 0.00 6553.500 FUNCTION_LIST DHFM IF_DATA DIM_X DIRECT 0x81BD0E
 /begin AXIS_DESCR STD_AXIS wdkbadmx_w relDK_q0p02441 8 0.00 1599.976 DEPOSIT ABSOLUT /end AXIS_DESCR
 /begin AXIS_DESCR STD_AXIS nmot_w nmot_uw_q0p25 8 0.00 16383.75 DEPOSIT ABSOLUT /end AXIS_DESCR
/end CHARACTERISTIC
/begin CHARACTERISTIC KFMPED_UC "Kennfeld für zulässiges Moment aus der Pedalstellung im Befehlstest" MAP 0x811F46 GkfWUb 99.61 rel_ub_b99p6 0.00 99.61 FUNCTION_LIST URCMZUL IF_DATA DIM_X DIRECT 0x811F46
 /begin AXIS_DESCR COM_AXIS spsn_uc spg_ub_q0p019 8 0.00 4.9805 AXIS_PTS_REF SPSNV08_UC /end AXIS_DESCR
 /begin AXIS_DESCR COM_AXIS nmot_uc nmot_ub_q40 8 0.00 10200. AXIS_PTS_REF NMV08_UC /end AXIS_DESCR
/end CHARACTERISTIC
/begin CHARACTERISTIC KFMPED_UM "Kennfeld für zulässiges Moment aus der Pedalstellung in der Funktionsüberwachg" MAP 0x817E6E GkfWUb 99.61 rel_ub_b99p6 0.00 99.61 FUNCTION_LIST UFMZUL IF_DATA DIM_X DIRECT 0x817E6E
 /begin AXIS_DESCR COM_AXIS spsn_um spg_ub_q0p019 8 0.00 4.9805 AXIS_PTS_REF SPSNV08_UM /end AXIS_DESCR
 /begin AXIS_DESCR COM_AXIS nmot_um nmot_ub_q40 8 0.00 10200. AXIS_PTS_REF NMV08_UM /end AXIS_DESCR
/end CHARACTERISTIC
/begin CHARACTERISTIC KFMPNS_UC "Kennfeld für zul. Moment aus Pedalstellung bei kaltem Motor im Befehlstest" MAP 0x811F86 GkfWUb 99.61 rel_ub_b99p6 0.00 99.61 FUNCTION_LIST URCMZUL IF_DATA DIM_X DIRECT 0x811F86
 /begin AXIS_DESCR COM_AXIS spsn_uc spg_ub_q0p019 8 0.00 4.9805 AXIS_PTS_REF SPSNV08_UC /end AXIS_DESCR
 /begin AXIS_DESCR COM_AXIS nmot_uc nmot_ub_q40 8 0.00 10200. AXIS_PTS_REF NMV08_UC /end AXIS_DESCR
/end CHARACTERISTIC
/begin CHARACTERISTIC KFMPNS_UM "Kennfeld für zul. Moment aus Pedalstellung bei kaltem Motor" MAP 0x817EAE GkfWUb 99.61 rel_ub_b99p6 0.00 99.61 FUNCTION_LIST UFMZUL IF_DATA DIM_X DIRECT 0x817EAE
 /begin AXIS_DESCR COM_AXIS spsn_um spg_ub_q0p019 8 0.00 4.9805 AXIS_PTS_REF SPSNV08_UM /end AXIS_DESCR
 /begin AXIS_DESCR COM_AXIS nmot_um nmot_ub_q40 8 0.00 10200. AXIS_PTS_REF NMV08_UM /end AXIS_DESCR
/end CHARACTERISTIC
/begin CHARACTERISTIC KFMRES "LLR: Basis Momentenreserve im LL und ll-nahem Bereich" MAP 0x8114D0 GkfWUb 24.90 rel_ub_b24p9 0.00 24.90 FUNCTION_LIST LLRMR IF_DATA DIM_X DIRECT 0x8114D0
 /begin AXIS_DESCR COM_AXIS nmot nmot_ub_q40 10 0.00 10200. AXIS_PTS_REF SNM10LLUB /end AXIS_DESCR
 /begin AXIS_DESCR COM_AXIS mifa_w rel_uw_b100 8 0.00 99.99847 AXIS_PTS_REF SMI08LLUB /end AXIS_DESCR
/end CHARACTERISTIC
/begin CHARACTERISTIC KFMRESK "LLR: Basis Momentenreserve im LL und ll-nahem Bereich,ausgekuppelt" MAP 0x811520 GkfWUb 24.90 rel_ub_b24p9 0.00 24.90 FUNCTION_LIST LLRMR IF_DATA DIM_X DIRECT 0x811520
 /begin AXIS_DESCR COM_AXIS nmot nmot_ub_q40 10 0.00 10200. AXIS_PTS_REF SNM10LLUB /end AXIS_DESCR
 /begin AXIS_DESCR COM_AXIS mifa_w rel_uw_b100 8 0.00 99.99847 AXIS_PTS_REF SMI08LLUB /end AXIS_DESCR
/end CHARACTERISTIC
/begin CHARACTERISTIC KFMRESNL "Momentenreserve im nicht Leerlauf" MAP 0x811570 GkfWUb 24.90 rel_ub_b24p9 0.00 24.90 FUNCTION_LIST LLRMR IF_DATA DIM_X DIRECT 0x811570
 /begin AXIS_DESCR COM_AXIS nmot nmot_ub_q40 10 0.00 10200. AXIS_PTS_REF SNM10LLUB /end AXIS_DESCR
 /begin AXIS_DESCR COM_AXIS mifa_w rel_uw_b100 8 0.00 99.99847 AXIS_PTS_REF SMI08LLUB /end AXIS_DESCR
/end CHARACTERISTIC
/begin CHARACTERISTIC KFMRESTM "Kennfeld Temp-abhängige Begrenzung Momentenreserve" MAP 0x81DA64 KfAxUwAyUwSstxUwSstyUwWUw 24.90000 rel_ub_b24p9 0.00 24.90000 FUNCTION_LIST LLRMR IF_DATA DIM_X DIRECT 0x81DA64
 /begin AXIS_DESCR STD_AXIS tnse_w t100msxs_uw_b6553p5 6 0.00 6553.500 DEPOSIT ABSOLUT /end AXIS_DESCR
 /begin AXIS_DESCR STD_AXIS tmot temp_ub_q0p75_o48 6 -48.00000 143.2500 DEPOSIT ABSOLUT /end AXIS_DESCR
/end CHARACTERISTIC
/begin CHARACTERISTIC KFMSNWDK "Kennfeld normierter Massenstrom über DK" MAP 0x8148F8 KfAxUwAyUwSstxUwSstyUwWUw 6553.500 m_uw_b6553p5 0.00 6553.500 FUNCTION_LIST BGMSZS BGRLP IF_DATA DIM_X DIRECT 0x8148F8
 /begin AXIS_DESCR STD_AXIS wdkbab_w rel_uw_b100 16 0.00 99.99847 DEPOSIT ABSOLUT /end AXIS_DESCR
 /begin AXIS_DESCR STD_AXIS nmot_w nmot_uw_q0p25 6 0.00 16383.75 DEPOSIT ABSOLUT /end AXIS_DESCR
/end CHARACTERISTIC
/begin CHARACTERISTIC KFNSWRL "Wichtung Nachstartanhebung" MAP 0x811108 KfAxUbAyUbSstxUbSstyUbWUb 1.992 fak_ub_b2 0.00 1.992 FUNCTION_LIST ESNST IF_DATA DIM_X DIRECT 0x811108
 /begin AXIS_DESCR STD_AXIS tmst temp_ub_q0p75_o48 8 -48.00 143.3 DEPOSIT ABSOLUT /end AXIS_DESCR
 /begin AXIS_DESCR STD_AXIS rl rel_ub_q0p75 6 0.00 191.3 DEPOSIT ABSOLUT /end AXIS_DESCR
/end CHARACTERISTIC
/begin CHARACTERISTIC KFNWNGNG "Last, bei welcher in Abh. von Motordrehzahl und Gang die NW angesteuert wird." MAP 0x8186ED KfAxUbAyUbSstxUbSstyUbWUb 191.3 rel_ub_q0p75 0.00 191.3 FUNCTION_LIST NWS IF_DATA DIM_X DIRECT 0x8186ED /begin AXIS_DESCR STD_AXIS nmot nmot_ub_q40 10 0.00 10200. DEPOSIT ABSOLUT /end AXIS_DESCR /begin AXIS_DESCR STD_AXIS gangi dez 8 0.00 255.0 DEPOSIT ABSOLUT /end AXIS_DESCR /end CHARACTERISTIC
/begin CHARACTERISTIC KFNWSH "Faktor Gemischkorrektur bei Wechsel NWS spät nach früh" MAP 0x81114C KfAxUbAyUbSstxUbSstyUbWUb 1.984 fak_ub_b4 0.00 1.984 FUNCTION_LIST ESNWS IF_DATA DIM_X DIRECT 0x81114C /begin AXIS_DESCR STD_AXIS nmot nmot_ub_q40 8 0.00 10200. DEPOSIT ABSOLUT /end AXIS_DESCR /begin AXIS_DESCR STD_AXIS rl rel_ub_q0p75 8 0.00 191.3 DEPOSIT ABSOLUT /end AXIS_DESCR /end CHARACTERISTIC
/begin CHARACTERISTIC KFNWSL "Faktor Gemischkorrktur bei Wechsel NWS früh nach spät" MAP 0x81119E KfAxUbAyUbSstxUbSstyUbWUb 3.984 fak_ub_b4 0.00 3.984 FUNCTION_LIST ESNWS IF_DATA DIM_X DIRECT 0x81119E /begin AXIS_DESCR STD_AXIS nmot nmot_ub_q40 8 0.00 10200. DEPOSIT ABSOLUT /end AXIS_DESCR /begin AXIS_DESCR STD_AXIS rl rel_ub_q0p75 8 0.00 191.3 DEPOSIT ABSOLUT /end AXIS_DESCR /end CHARACTERISTIC
/begin CHARACTERISTIC KFNWVSA "Sperrzeit der NW-Umschaltung bei Wechsel von Ventilhub gross in klein" MAP 0x819C1D KfAxUbAyUbSstxUbSstyUbWUb 5.100 t20msxs_ub_b5p1 0.00 5.100 FUNCTION_LIST VS IF_DATA DIM_X DIRECT 0x819C1D
 /begin AXIS_DESCR STD_AXIS tol temp_ub_q0p75_o48 8 -48.00 143.3 DEPOSIT ABSOLUT /end AXIS_DESCR
 /begin AXIS_DESCR STD_AXIS nmot nmot_ub_q40 8 0.00 10200. DEPOSIT ABSOLUT /end AXIS_DESCR
/end CHARACTERISTIC
/begin CHARACTERISTIC KFPBRK "Korrekturfaktor für Brennraumdruck" MAP 0x81C01A KfAxUwAyUwSstxUwSstyUwWUw 1.999969 fak_uw_b2 0.00 1.999969 FUNCTION_LIST BGSRM IF_DATA DIM_X DIRECT 0x81C01A
 /begin AXIS_DESCR STD_AXIS nmot_w nmot_uw_q0p25 6 0.00 16383.75 DEPOSIT ABSOLUT /end AXIS_DESCR
 /begin AXIS_DESCR STD_AXIS rl_w rel_uw_q0p0234 6 0.00 1535.977 DEPOSIT ABSOLUT /end AXIS_DESCR
/end CHARACTERISTIC
/begin CHARACTERISTIC KFPBRKNW "Korrekturfaktor für Brennraumdruck bei aktiver NWS" MAP 0x81C07E KfAxUwAyUwSstxUwSstyUwWUw 1.999969 fak_uw_b2 0.00 1.999969 FUNCTION_LIST BGSRM IF_DATA DIM_X DIRECT 0x81C07E
 /begin AXIS_DESCR STD_AXIS nmot_w nmot_uw_q0p25 6 0.00 16383.75 DEPOSIT ABSOLUT /end AXIS_DESCR
 /begin AXIS_DESCR STD_AXIS rl_w rel_uw_q0p0234 6 0.00 1535.977 DEPOSIT ABSOLUT /end AXIS_DESCR
/end CHARACTERISTIC
/begin CHARACTERISTIC KFPED "Relatives Fahrerwunschmoment aus Fahrpedal" MAP 0x8163D2 KfAxUwAyUwSstxUwSstyUwWUw 199.9969 rel_uw_b200 0.00 199.9969 FUNCTION_LIST MDFAW IF_DATA DIM_X DIRECT 0x8163D2
 /begin AXIS_DESCR STD_AXIS wped_w relPED_uw_b100 16 0.00 100.0000 DEPOSIT ABSOLUT /end AXIS_DESCR
 /begin AXIS_DESCR STD_AXIS nmot_w nmot_uw_q0p25 13 0.00 16383.75 DEPOSIT ABSOLUT /end AXIS_DESCR
/end CHARACTERISTIC
/begin CHARACTERISTIC KFPEDR "Relatives Fahrerwunschmoment aus Fahrpedal für Rückwärtsgang" MAP 0x8165B0 KfAxUwAyUwSstxUwSstyUwWUw 199.9969 rel_uw_b200 0.00 199.9969 FUNCTION_LIST MDFAW IF_DATA DIM_X DIRECT 0x8165B0
 /begin AXIS_DESCR STD_AXIS wped_w relPED_uw_b100 16 0.00 100.0000 DEPOSIT ABSOLUT /end AXIS_DESCR
 /begin AXIS_DESCR STD_AXIS nmot_w nmot_uw_q0p25 8 0.00 16383.75 DEPOSIT ABSOLUT /end AXIS_DESCR
/end CHARACTERISTIC
/begin CHARACTERISTIC KFPRG "interner Abgaspartialdruck abhängig von NW-Verstellung bei sumode=0" MAP 0x81C0E2 KfAxUwAyUwSstxUwSstyUwWUw 2559.961 p_uw_q0p039 0.00 2559.961 FUNCTION_LIST BGSRM IF_DATA DIM_X DIRECT 0x81C0E2
 /begin AXIS_DESCR STD_AXIS wnwue_w kw_q0p0019 2 0.00 127.9980 DEPOSIT ABSOLUT /end AXIS_DESCR
 /begin AXIS_DESCR STD_AXIS nmot_w nmot_uw_q0p25 24 0.00 16383.75 DEPOSIT ABSOLUT /end AXIS_DESCR
/end CHARACTERISTIC
/begin CHARACTERISTIC KFPRG2 "interner Abgaspartialdruck abhängig von Ventilerhebungskurve" MAP 0x81C17A KfAxUwAyUwSstxUwSstyUwWUw 2559.961 p_uw_q0p039 0.00 2559.961 FUNCTION_LIST BGSRM IF_DATA DIM_X DIRECT 0x81C17A
 /begin AXIS_DESCR STD_AXIS wnwue_w kw_q0p0019 2 0.00 127.9980 DEPOSIT ABSOLUT /end AXIS_DESCR
 /begin AXIS_DESCR STD_AXIS nmot_w nmot_uw_q0p25 24 0.00 16383.75 DEPOSIT ABSOLUT /end AXIS_DESCR
/end CHARACTERISTIC
/begin CHARACTERISTIC KFPRG2SU "interner Abgaspartialdruck abhängig von NW-Verstellung bei sumode=2" MAP 0x81C212 KfAxUwAyUwSstxUwSstyUwWUw 2559.961 p_uw_q0p039 0.00 2559.961 FUNCTION_LIST BGSRM IF_DATA DIM_X DIRECT 0x81C212
 /begin AXIS_DESCR STD_AXIS wnwue_w kw_q0p0019 2 0.00 127.9980 DEPOSIT ABSOLUT /end AXIS_DESCR
 /begin AXIS_DESCR STD_AXIS nmot_w nmot_uw_q0p25 24 0.00 16383.75 DEPOSIT ABSOLUT /end AXIS_DESCR
/end CHARACTERISTIC
/begin CHARACTERISTIC KFPRGSU "interner Abgaspartialdruck abhängig von NW-Verstellung bei sumode=1" MAP 0x81C2AA KfAxUwAyUwSstxUwSstyUwWUw 2559.961 p_uw_q0p039 0.00 2559.961 FUNCTION_LIST BGSRM IF_DATA DIM_X DIRECT 0x81C2AA
 /begin AXIS_DESCR STD_AXIS wnwue_w kw_q0p0019 2 0.00 127.9980 DEPOSIT ABSOLUT /end AXIS_DESCR
 /begin AXIS_DESCR STD_AXIS nmot_w nmot_uw_q0p25 24 0.00 16383.75 DEPOSIT ABSOLUT /end AXIS_DESCR
/end CHARACTERISTIC
/begin CHARACTERISTIC KFPUNWV "Pulsationskennfeld bei Nockenwellenverstellung" MAP 0x81103E KfAxUbAyUbSstxUbSstyUbWUb 1.992 fak_ub_b2 0.00 1.992 FUNCTION_LIST GGHFM IF_DATA DIM_X DIRECT 0x81103E /begin AXIS_DESCR STD_AXIS nmot nmot_ub_q40 14 0.00 10200. DEPOSIT ABSOLUT /end AXIS_DESCR /begin AXIS_DESCR STD_AXIS wnwue kw_ub_q0p5 6 0.00 127.5 DEPOSIT ABSOLUT /end AXIS_DESCR /end CHARACTERISTIC
/begin CHARACTERISTIC KFQTE "Kennfeld Auf-/Absteuergeschwindigkeit der Sollspülrate Tankentlüftung" MAP 0x819AC0 GkfWUb 0.0121593164 perio_ub_b0p012207 0.00 0.0121593164 FUNCTION_LIST TEB IF_DATA DIM_X DIRECT 0x819AC0 /begin AXIS_DESCR COM_AXIS ml m_ub_b1020 6 0.00 1020. AXIS_PTS_REF SML06TEUB /end AXIS_DESCR
 /begin AXIS_DESCR COM_AXIS frmit fak_ub_b2 5 0.00 1.992 AXIS_PTS_REF SFR05TEUB /end AXIS_DESCR
/end CHARACTERISTIC
/begin CHARACTERISTIC KFRINH "Kennfeld für Nernst-Innenwiderstand hinter Kat" MAP 0x818375 KfAxUbAyUbSstxUbSstyUbWUb 2040. r_q8 0.00 2040. FUNCTION_LIST DHLSHK IF_DATA DIM_X DIRECT 0x818375
 /begin AXIS_DESCR STD_AXIS tkatmf temp_ub_q5_o50 5 -50.00 1225. DEPOSIT ABSOLUT /end AXIS_DESCR
 /begin AXIS_DESCR STD_AXIS phlsnhf fak_ub_q0p01 3 0.00 2.550 DEPOSIT ABSOLUT /end AXIS_DESCR
/end CHARACTERISTIC
/begin CHARACTERISTIC KFRINH2 "Kennfeld für Nernst-Innenwiderstand hinter Kat Bank2" MAP 0x81838E KfAxUbAyUbSstxUbSstyUbWUb 2040. r_q8 0.00 2040. FUNCTION_LIST DHLSHK IF_DATA DIM_X DIRECT 0x81838E
 /begin AXIS_DESCR STD_AXIS tkatmf2 temp_ub_q5_o50 5 -50.00 1225. DEPOSIT ABSOLUT /end AXIS_DESCR
 /begin AXIS_DESCR STD_AXIS phlsnhf2 fak_ub_q0p01 3 0.00 2.550 DEPOSIT ABSOLUT /end AXIS_DESCR
/end CHARACTERISTIC
/begin CHARACTERISTIC KFRLIP_UM "Kennfeld für rl - Berechnung aus Drosselklappenwinkel in der Funktionsüberwachg" MAP 0x817D16 KfAxUbAyUbSstxUbSstyUbWUb 191.3 rel_ub_q0p75 0.00 191.3 FUNCTION_LIST UFRLC IF_DATA DIM_X DIRECT 0x817D16
 /begin AXIS_DESCR STD_AXIS ipsn_um spg_ub_q0p019 8 0.00 4.9805 DEPOSIT ABSOLUT /end AXIS_DESCR
 /begin AXIS_DESCR STD_AXIS nmot_um nmot_ub_q40 8 0.00 10200. DEPOSIT ABSOLUT /end AXIS_DESCR
/end CHARACTERISTIC
/begin CHARACTERISTIC KFRLMN "minimale Füllung im befeuerten Betrieb" MAP 0x818646 GkfWUb 191.3 rel_ub_q0p75 0.00 191.3 FUNCTION_LIST MDFUE IF_DATA DIM_X DIRECT 0x818646
 /begin AXIS_DESCR COM_AXIS nmot nmot_ub_q40 12 0.00 10200. AXIS_PTS_REF SNM12FEUB /end AXIS_DESCR
 /begin AXIS_DESCR COM_AXIS tmot temp_ub_q0p75_o48 4 -48.00 143.3 AXIS_PTS_REF STM04FEUB /end AXIS_DESCR
/end CHARACTERISTIC
/begin CHARACTERISTIC KFRLMNSA "minimales rl bei Schubabschalten" MAP 0x818676 GkfWUb 191.3 rel_ub_q0p75 0.00 191.3 FUNCTION_LIST MDFUE IF_DATA DIM_X DIRECT 0x818676
 /begin AXIS_DESCR COM_AXIS nmot nmot_ub_q40 12 0.00 10200. AXIS_PTS_REF SNM12FEUB /end AXIS_DESCR
 /begin AXIS_DESCR COM_AXIS tmot temp_ub_q0p75_o48 4 -48.00 143.3 AXIS_PTS_REF STM04FEUB /end AXIS_DESCR
/end CHARACTERISTIC
/begin CHARACTERISTIC KFSU "Kennfeld für Saugrohrumschaltung, Klappe 1" MAP 0x818779 KfAxUbAyUbSstxUbSstyUbWUb 2.000 dez 0.00 2.000 FUNCTION_LIST SU IF_DATA DIM_X DIRECT 0x818779 /begin AXIS_DESCR STD_AXIS nmot nmot_ub_q40 6 0.00 10200. DEPOSIT ABSOLUT /end AXIS_DESCR /begin AXIS_DESCR STD_AXIS rlshk rel_ub_q0p75 6 0.00 191.3 DEPOSIT ABSOLUT /end AXIS_DESCR /end CHARACTERISTIC
/begin CHARACTERISTIC KFSU2 "Kennfeld für Saugrohrumschaltung, Klappe 2" MAP 0x8187AB KfAxUbAyUbSstxUbSstyUbWUb 2.000 dez 0.00 2.000 FUNCTION_LIST SU IF_DATA DIM_X DIRECT 0x8187AB /begin AXIS_DESCR STD_AXIS nmot nmot_ub_q40 6 0.00 10200. DEPOSIT ABSOLUT /end AXIS_DESCR /begin AXIS_DESCR STD_AXIS rlshk rel_ub_q0p75 6 0.00 191.3 DEPOSIT ABSOLUT /end AXIS_DESCR /end CHARACTERISTIC
/begin CHARACTERISTIC KFSZT "Schließzeit-Kennfeld" MAP 0x812438 KfAxUbAyUbSstxUbSstyUbWUb 25.20 txms_ub_q0p1 0.3000 25.50 FUNCTION_LIST ZUESZ IF_DATA DIM_X DIRECT 0x812438 /begin AXIS_DESCR STD_AXIS ub spg_ubatt 8 0.00 19.38 DEPOSIT ABSOLUT /end AXIS_DESCR /begin AXIS_DESCR STD_AXIS nmot nmot_ub_q40 8 0.00 10200. DEPOSIT ABSOLUT /end AXIS_DESCR /end CHARACTERISTIC
/begin CHARACTERISTIC KFTADMS "dynamischer Bewertungsfaktor für das Absteuern des TEV" MAP 0x817652 KfAxUbAyUbSstxSbSstyUbWUb 1.992 fak_ub_b2 0.00 1.992 FUNCTION_LIST TEB IF_DATA DIM_X DIRECT 0x817652
 /begin AXIS_DESCR STD_AXIS dmssginr fak_sb_b1 5 -1.000 0.9922 DEPOSIT ABSOLUT /end AXIS_DESCR
 /begin AXIS_DESCR STD_AXIS nmot nmot_ub_q40 4 0.00 10200. DEPOSIT ABSOLUT /end AXIS_DESCR
/end CHARACTERISTIC
/begin CHARACTERISTIC KFTARX "Kennfeld Maximalfuellung Tans Korrekturfaktor" MAP 0x81956D GkfWUb 1.992 fak_ub_b2 0.00 1.992 FUNCTION_LIST LDRLMX IF_DATA DIM_X DIRECT 0x81956D
 /begin AXIS_DESCR COM_AXIS nmot nmot_ub_q40 8 0.00 10200. AXIS_PTS_REF SNM08LDUB /end AXIS_DESCR
 /begin AXIS_DESCR COM_AXIS tans temp_ub_q0p75_o48 8 -48.00 143.3 AXIS_PTS_REF STA08LDUB /end AXIS_DESCR
/end CHARACTERISTIC
/begin CHARACTERISTIC KFTATM "Kennfeld Abgastemperatur   f(nmot,rl)" MAP 0x818290 KfAxUbAyUbSstxUbSstyUbWUb 1275. temp_ub_q5_o50 -50.00 1225. FUNCTION_LIST ATM IF_DATA DIM_X DIRECT 0x818290 /begin AXIS_DESCR STD_AXIS nmot nmot_ub_q40 8 0.00 10200. DEPOSIT ABSOLUT /end AXIS_DESCR /begin AXIS_DESCR STD_AXIS rl rel_ub_q0p75 8 0.00 191.3 DEPOSIT ABSOLUT /end AXIS_DESCR /end CHARACTERISTIC
/begin CHARACTERISTIC KFTATM2 "Kennfeld Abgastemperatur f(nmot,rl) Bank2" MAP 0x8182E2 KfAxUbAyUbSstxUbSstyUbWUb 1275. temp_ub_q5_o50 -50.00 1225. FUNCTION_LIST ATM IF_DATA DIM_X DIRECT 0x8182E2 /begin AXIS_DESCR STD_AXIS nmot nmot_ub_q40 8 0.00 10200. DEPOSIT ABSOLUT /end AXIS_DESCR /begin AXIS_DESCR STD_AXIS rl rel_ub_q0p75 8 0.00 191.3 DEPOSIT ABSOLUT /end AXIS_DESCR /end CHARACTERISTIC
/begin CHARACTERISTIC KFTATX "Kennfeld für maximales Tastverhältnis" MAP 0x819ADE KfAxUbAyUbSstxUbSstyUbWUb 99.61 rel_ub_b99p6 0.00 99.61 FUNCTION_LIST TEB IF_DATA DIM_X DIRECT 0x819ADE /begin AXIS_DESCR STD_AXIS nmot nmot_ub_q40 10 0.00 10200. DEPOSIT ABSOLUT /end AXIS_DESCR /begin AXIS_DESCR STD_AXIS pspu fak_ub_b2 6 0.00 1.992 DEPOSIT ABSOLUT /end AXIS_DESCR /end CHARACTERISTIC
/begin CHARACTERISTIC KFTEKA "Kennfeld Sollkraftstoffanteil bei Regenerierung" MAP 0x81E2C6 KfAxUbAyUbSstxUbSstyUbWSb 0.9922 fak_sb_b1 0.00 0.9922 FUNCTION_LIST TEB IF_DATA DIM_X DIRECT 0x81E2C6 /begin AXIS_DESCR STD_AXIS nmot nmot_ub_q40 5 0.00 10200. DEPOSIT ABSOLUT /end AXIS_DESCR /begin AXIS_DESCR STD_AXIS rl rel_ub_q0p75 5 0.00 191.3 DEPOSIT ABSOLUT /end AXIS_DESCR /end CHARACTERISTIC
/begin CHARACTERISTIC KFTEVP "Kennfeld Periodendauer TEV" MAP 0x81997E KfAxUbAyUbSstxUbSstyUbWUb 127.5 t500usxms_ub_q0p5 0.00 127.5 FUNCTION_LIST ATEV IF_DATA DIM_X DIRECT 0x81997E /begin AXIS_DESCR STD_AXIS nmot nmot_ub_q40 5 0.00 10200. DEPOSIT ABSOLUT /end AXIS_DESCR /begin AXIS_DESCR STD_AXIS tateroh rel_ub_b99p6 9 0.00 99.61 DEPOSIT ABSOLUT /end AXIS_DESCR /end CHARACTERISTIC
/begin CHARACTERISTIC KFTVFRR "Kennfeld: Lambda-Regler nach dieser Zeit auf Referenzwert zurücksetzen" MAP 0x819B62 KfAxUbAyUbSstxUbSstyUbWUb 25.50 t100msxs_ub_b25p5 0.00 25.50 FUNCTION_LIST DTEV IF_DATA DIM_X DIRECT 0x819B62
 /begin AXIS_DESCR STD_AXIS tadteazs rel_ub_b99p6 4 0.00 99.61 DEPOSIT ABSOLUT /end AXIS_DESCR
 /begin AXIS_DESCR STD_AXIS ml m_ub_b1020 3 0.00 1020. DEPOSIT ABSOLUT /end AXIS_DESCR
/end CHARACTERISTIC
/begin CHARACTERISTIC KFTVLDRE "Kennfeld tastverhältnisersatzwert für LDR" MAP 0x81967B KfAxUbAyUbSstxUbSstyUbWUb 99.61 tv_ub_b100 0.00 99.61 FUNCTION_LIST LDTVMA IF_DATA DIM_X DIRECT 0x81967B /begin AXIS_DESCR STD_AXIS nmot nmot_ub_q40 8 0.00 10200. DEPOSIT ABSOLUT /end AXIS_DESCR /begin AXIS_DESCR STD_AXIS plsol p_ub_q10 4 0.00 2550. DEPOSIT ABSOLUT /end AXIS_DESCR /end CHARACTERISTIC
/begin CHARACTERISTIC KFTVNWGH "Verzögerungszeit Gemischkorrektur bei Wechsel spät nach früh" MAP 0x8111F0 KfAxUbAyUbSstxUbSstyUbWUb 2.550 t10msxs_ub_b2p55 0.00 2.550 FUNCTION_LIST ESNWS IF_DATA DIM_X DIRECT 0x8111F0
 /begin AXIS_DESCR STD_AXIS tmot temp_ub_q0p75_o48 4 -48.00 143.3 DEPOSIT ABSOLUT /end AXIS_DESCR
 /begin AXIS_DESCR STD_AXIS nmot nmot_ub_q40 8 0.00 10200. DEPOSIT ABSOLUT /end AXIS_DESCR
/end CHARACTERISTIC
/begin CHARACTERISTIC KFTVNWGL "Verzögerungszeit Gemischkorrektur bei Wechsel früh nach spät" MAP 0x81121E KfAxUbAyUbSstxUbSstyUbWUb 2.550 t10msxs_ub_b2p55 0.00 2.550 FUNCTION_LIST ESNWS IF_DATA DIM_X DIRECT 0x81121E
 /begin AXIS_DESCR STD_AXIS tmot temp_ub_q0p75_o48 4 -48.00 143.3 DEPOSIT ABSOLUT /end AXIS_DESCR
 /begin AXIS_DESCR STD_AXIS nmot nmot_ub_q40 8 0.00 10200. DEPOSIT ABSOLUT /end AXIS_DESCR
/end CHARACTERISTIC
/begin CHARACTERISTIC KFTVSA "Verzögerungszeit für Schubabschalten" MAP 0x8196AC GkfWUb 2.550 t10msxs_ub_b2p55 0.00 2.550 FUNCTION_LIST BBSAWE IF_DATA DIM_X DIRECT 0x8196AC
 /begin AXIS_DESCR COM_AXIS tmot temp_ub_q0p75_o48 5 -48.00 143.3 AXIS_PTS_REF STM05SAUB /end AXIS_DESCR
 /begin AXIS_DESCR COM_AXIS nmot nmot_ub_q40 8 0.00 10200. AXIS_PTS_REF SNM08__UB /end AXIS_DESCR
/end CHARACTERISTIC
/begin CHARACTERISTIC KFTVTEV "Kennfeld Verzugszeit Tankentlüftungsventil" MAP 0x8199BB KfAxUbAyUbSstxUbSstyUbWUb 127.5 t500usxms_ub_q0p5 0.00 127.5 FUNCTION_LIST ATEV IF_DATA DIM_X DIRECT 0x8199BB /begin AXIS_DESCR STD_AXIS ub spg_ubatt 6 0.00 19.38 DEPOSIT ABSOLUT /end AXIS_DESCR
 /begin AXIS_DESCR STD_AXIS tans temp_ub_q0p75_o48 3 -48.00 143.3 DEPOSIT ABSOLUT /end AXIS_DESCR
/end CHARACTERISTIC
/begin CHARACTERISTIC KFURL "Umrechnungsfaktor von ps->rl abhängig von NW-Verstellung bei sumode=0" MAP 0x81C342 KfAxUwAyUwSstxUwSstyUwWUw 0.2999954 rel_uw_b0p3 0.00 0.2999954 FUNCTION_LIST BGSRM IF_DATA DIM_X DIRECT 0x81C342
 /begin AXIS_DESCR STD_AXIS wnwue_w kw_q0p0019 2 0.00 127.9980 DEPOSIT ABSOLUT /end AXIS_DESCR
 /begin AXIS_DESCR STD_AXIS nmot_w nmot_uw_q0p25 24 0.00 16383.75 DEPOSIT ABSOLUT /end AXIS_DESCR
/end CHARACTERISTIC
/begin CHARACTERISTIC KFURL2 "Umrechnungsfaktor von ps->rl abhängig von Ventilerhebungskurve" MAP 0x81C3DA KfAxUwAyUwSstxUwSstyUwWUw 0.2999954 rel_uw_b0p3 0.00 0.2999954 FUNCTION_LIST BGSRM IF_DATA DIM_X DIRECT 0x81C3DA
 /begin AXIS_DESCR STD_AXIS wnwue_w kw_q0p0019 2 0.00 127.9980 DEPOSIT ABSOLUT /end AXIS_DESCR
 /begin AXIS_DESCR STD_AXIS nmot_w nmot_uw_q0p25 24 0.00 16383.75 DEPOSIT ABSOLUT /end AXIS_DESCR
/end CHARACTERISTIC
/begin CHARACTERISTIC KFURL2SU "Umrechnungsfaktor von ps->rl abhängig von NW-Verstellung bei sumode=2" MAP 0x81C472 KfAxUwAyUwSstxUwSstyUwWUw 0.2999954 rel_uw_b0p3 0.00 0.2999954 FUNCTION_LIST BGSRM IF_DATA DIM_X DIRECT 0x81C472
 /begin AXIS_DESCR STD_AXIS wnwue_w kw_q0p0019 2 0.00 127.9980 DEPOSIT ABSOLUT /end AXIS_DESCR
 /begin AXIS_DESCR STD_AXIS nmot_w nmot_uw_q0p25 24 0.00 16383.75 DEPOSIT ABSOLUT /end AXIS_DESCR
/end CHARACTERISTIC
/begin CHARACTERISTIC KFURLSU "Umrechnungsfaktor von ps->rl abhängig von NW-Verstellung bei sumode=1" MAP 0x81C50A KfAxUwAyUwSstxUwSstyUwWUw 0.2999954 rel_uw_b0p3 0.00 0.2999954 FUNCTION_LIST BGSRM IF_DATA DIM_X DIRECT 0x81C50A
 /begin AXIS_DESCR STD_AXIS wnwue_w kw_q0p0019 2 0.00 127.9980 DEPOSIT ABSOLUT /end AXIS_DESCR
 /begin AXIS_DESCR STD_AXIS nmot_w nmot_uw_q0p25 24 0.00 16383.75 DEPOSIT ABSOLUT /end AXIS_DESCR
/end CHARACTERISTIC
/begin CHARACTERISTIC KFUSHK "Sondenspannungssollwert für Regelung hinter Kat. (statt KFUSRHK für Variantenk.)" MAP 0x812135 KfAxUbAyUbSstxUbSstyUbWUb 1.330 spg_ub_q0p0052_o0p2 -0.2000 1.130 FUNCTION_LIST LRSHK IF_DATA DIM_X DIRECT 0x812135 /begin AXIS_DESCR STD_AXIS nmot nmot_ub_q40 6 0.00 10200. DEPOSIT ABSOLUT /end AXIS_DESCR /begin AXIS_DESCR STD_AXIS rl rel_ub_q0p75 6 0.00 191.3 DEPOSIT ABSOLUT /end AXIS_DESCR /end CHARACTERISTIC
/begin CHARACTERISTIC KFVAKL "Faktor Verzögerungsabmagerung (K+L-Anteil)" MAP 0x818AE3 GkfWUb 15.94 fak_ub_b16 0.00 15.94 FUNCTION_LIST ESUK IF_DATA DIM_X DIRECT 0x818AE3
 /begin AXIS_DESCR COM_AXIS tmot temp_ub_q0p75_o48 9 -48.00 143.3 AXIS_PTS_REF STM09ESUB /end AXIS_DESCR
 /begin AXIS_DESCR COM_AXIS nmot nmot_ub_q40 12 0.00 10200. AXIS_PTS_REF SNM12ESUB2 /end AXIS_DESCR
/end CHARACTERISTIC
/begin CHARACTERISTIC KFVOFFS "Geschwindigkeits-Offset für FGR-Regler" MAP 0x8147D6 KfAxUwAyUwSstxUwSstyUwWUw 511.9922 vfzg_uw_b512 0.00 511.9922 FUNCTION_LIST FGRMD IF_DATA DIM_X DIRECT 0x8147D6
 /begin AXIS_DESCR STD_AXIS vziel_w vfzg_uw_b512 6 0.00 511.9922 DEPOSIT ABSOLUT /end AXIS_DESCR
 /begin AXIS_DESCR STD_AXIS gangi dez 8 0.00 65535.00 DEPOSIT ABSOLUT /end AXIS_DESCR
/end CHARACTERISTIC
/begin CHARACTERISTIC KFVPDKLD "Max. zulässiges Druckverhältnis DK für ldra Diagnose" MAP 0x819399 KfAxUbAyUbSstxUbSstyUbWUb 3.984 fak_ub_b4 0.00 3.984 FUNCTION_LIST DLDR IF_DATA DIM_X DIRECT 0x819399 /begin AXIS_DESCR STD_AXIS nmot nmot_ub_q40 8 0.00 10200. DEPOSIT ABSOLUT /end AXIS_DESCR /begin AXIS_DESCR STD_AXIS wdkba relDK_ub_b100 8 0.00 100.0 DEPOSIT ABSOLUT /end AXIS_DESCR /end CHARACTERISTIC
/begin CHARACTERISTIC KFVPDKSD "Solldruckverhältnis DK im Dynamikbetrieb" MAP 0x815754 GkfWUw 1.999969 fak_uw_b2 0.00 1.999969 FUNCTION_LIST LDRPLS IF_DATA DIM_X DIRECT 0x815754
 /begin AXIS_DESCR COM_AXIS nmot_w nmot_uw_q0p25 12 0.00 16383.75 AXIS_PTS_REF SNM12LDUW /end AXIS_DESCR
 /begin AXIS_DESCR COM_AXIS vpsspu_w fak_uw_b4 12 0.00 3.999939 AXIS_PTS_REF SVP12LDUW /end AXIS_DESCR
/end CHARACTERISTIC
/begin CHARACTERISTIC KFVPDKSE "Solldruckverhältnis DK im Stationärbetrieb" MAP 0x815874 GkfWUw 1.999969 fak_uw_b2 0.00 1.999969 FUNCTION_LIST LDRPLS IF_DATA DIM_X DIRECT 0x815874
 /begin AXIS_DESCR COM_AXIS nmot_w nmot_uw_q0p25 12 0.00 16383.75 AXIS_PTS_REF SNM12LDUW /end AXIS_DESCR
 /begin AXIS_DESCR COM_AXIS vpsspu_w fak_uw_b4 12 0.00 3.999939 AXIS_PTS_REF SVP12LDUW /end AXIS_DESCR
/end CHARACTERISTIC
/begin CHARACTERISTIC KFVSGK "Faktor Abmagerung bei Wechsel Ventilhub groß nach klein" MAP 0x81220B KfAxUbAyUbSstxUbSstyUbWUb 3.984 fak_ub_b4 0.00 3.984 FUNCTION_LIST esvs IF_DATA DIM_X DIRECT 0x81220B /begin AXIS_DESCR STD_AXIS rl rel_ub_q0p75 8 0.00 191.3 DEPOSIT ABSOLUT /end AXIS_DESCR /begin AXIS_DESCR STD_AXIS nmot nmot_ub_q40 8 0.00 10200. DEPOSIT ABSOLUT /end AXIS_DESCR /end CHARACTERISTIC
/begin CHARACTERISTIC KFVSKG "Faktor Anreicherung bei Wechsel Webtilhub klein nach groß" MAP 0x81225D KfAxUbAyUbSstxUbSstyUbWUb 3.984 fak_ub_b4 0.00 3.984 FUNCTION_LIST esvs IF_DATA DIM_X DIRECT 0x81225D /begin AXIS_DESCR STD_AXIS rl rel_ub_q0p75 8 0.00 191.3 DEPOSIT ABSOLUT /end AXIS_DESCR /begin AXIS_DESCR STD_AXIS nmot nmot_ub_q40 8 0.00 10200. DEPOSIT ABSOLUT /end AXIS_DESCR /end CHARACTERISTIC
/begin CHARACTERISTIC KFWDKMSN "Kennfeld für Drosselklappen-Sollwinkel" MAP 0x81C5D0 KfAxUwAyUwSstxUwSstyUwWUw 99.99847 rel_uw_b100 0.00 99.99847 FUNCTION_LIST FUEDK IF_DATA DIM_X DIRECT 0x81C5D0
 /begin AXIS_DESCR STD_AXIS mlwdknf_w m_uw_b6553p5 16 0.00 6553.500 DEPOSIT ABSOLUT /end AXIS_DESCR
 /begin AXIS_DESCR STD_AXIS nmot_w nmot_uw_q0p25 6 0.00 16383.75 DEPOSIT ABSOLUT /end AXIS_DESCR
/end CHARACTERISTIC
/begin CHARACTERISTIC KFWDKPP "Ersatzwert für Drosselklappenwinkel aus Füllungssignal" MAP 0x810D4B KfAxUbAyUbSstxUbSstyUbWUb 100.0 relDK_ub_b100 0.00 100.0 FUNCTION_LIST GGDVE IF_DATA DIM_X DIRECT 0x810D4B /begin AXIS_DESCR STD_AXIS nmot nmot_ub_q40 12 0.00 10200. DEPOSIT ABSOLUT /end AXIS_DESCR /begin AXIS_DESCR STD_AXIS rlvppl rel_ub_q0p75 12 0.00 191.3 DEPOSIT ABSOLUT /end AXIS_DESCR /end CHARACTERISTIC
/begin CHARACTERISTIC KFWDKSMX "maximaler Solldrosselklappenwinkel" MAP 0x81527C KfAxUwAyUwSstxUwSstyUwWUw 99.99847 rel_uw_b100 0.00 99.99847 FUNCTION_LIST FUEDK IF_DATA DIM_X DIRECT 0x81527C
 /begin AXIS_DESCR STD_AXIS nmot_w nmot_uw_q0p25 10 0.00 16383.75 DEPOSIT ABSOLUT /end AXIS_DESCR
 /begin AXIS_DESCR STD_AXIS fho_w fak_uw_b4 3 0.00 3.999939 DEPOSIT ABSOLUT /end AXIS_DESCR
/end CHARACTERISTIC
/begin CHARACTERISTIC KFWEE "Kennfeld Winkel Einspritzende" MAP 0x818B62 GkfWUb 1530. zw_ub_q6 0.00 1530. FUNCTION_LIST ESVW IF_DATA DIM_X DIRECT 0x818B62
 /begin AXIS_DESCR COM_AXIS rl rel_ub_q0p75 8 0.00 191.3 AXIS_PTS_REF SRL08GKUB /end AXIS_DESCR
 /begin AXIS_DESCR COM_AXIS nmot nmot_ub_q40 8 0.00 10200. AXIS_PTS_REF SNM08GKUB /end AXIS_DESCR
/end CHARACTERISTIC
/begin CHARACTERISTIC KFWEEK "Kennfeld-Kalt Winkel Einspritzende" MAP 0x818BA2 GkfWUb 1530. zw_ub_q6 0.00 1530. FUNCTION_LIST ESVW IF_DATA DIM_X DIRECT 0x818BA2
 /begin AXIS_DESCR COM_AXIS rl rel_ub_q0p75 8 0.00 191.3 AXIS_PTS_REF SRL08GKUB /end AXIS_DESCR
 /begin AXIS_DESCR COM_AXIS nmot nmot_ub_q40 8 0.00 10200. AXIS_PTS_REF SNM08GKUB /end AXIS_DESCR
/end CHARACTERISTIC
/begin CHARACTERISTIC KFWHSTT "Wichtungskennfeld Heißstart" MAP 0x811274 KfAxUbAyUbSstxUbSstyUbWUb 1.992 fak_ub_b2 0.00 1.992 FUNCTION_LIST ESSTT IF_DATA DIM_X DIRECT 0x811274
 /begin AXIS_DESCR STD_AXIS tans temp_ub_q0p75_o48 6 -48.00 143.3 DEPOSIT ABSOLUT /end AXIS_DESCR
 /begin AXIS_DESCR STD_AXIS anztist dez 6 0.00 255.0 DEPOSIT ABSOLUT /end AXIS_DESCR
/end CHARACTERISTIC
/begin CHARACTERISTIC KFWKSTAB "Faktor Wiederholkaltstart zur Reduzierung der Startmenge" MAP 0x815680 KfAxUbAyUbSstxUwSstyUbWUb 1.992 fak_ub_b2 0.00 1.992 FUNCTION_LIST ESSTT IF_DATA DIM_X DIRECT 0x815680
 /begin AXIS_DESCR STD_AXIS tabst_w t1sxs_uw_q1 4 0.00 65535.00 DEPOSIT ABSOLUT /end AXIS_DESCR
 /begin AXIS_DESCR STD_AXIS tmst temp_ub_q0p75_o48 4 -48.00 143.3 DEPOSIT ABSOLUT /end AXIS_DESCR
/end CHARACTERISTIC
/begin CHARACTERISTIC KFWKSTN "Wichtungskennfeld Kaltstart" MAP 0x8112A6 KfAxUbAyUbSstxUbSstyUbWUb 0.9961 fak_ub_b1 0.00 0.9961 FUNCTION_LIST ESSTT IF_DATA DIM_X DIRECT 0x8112A6
 /begin AXIS_DESCR STD_AXIS tmst temp_ub_q0p75_o48 4 -48.00 143.3 DEPOSIT ABSOLUT /end AXIS_DESCR
 /begin AXIS_DESCR STD_AXIS nmot nmot_ub_q40 4 0.00 10200. DEPOSIT ABSOLUT /end AXIS_DESCR
/end CHARACTERISTIC
/begin CHARACTERISTIC KFWKSTT "Wichtungskennfeld Kaltstart" MAP 0x8112C0 KfAxUbAyUbSstxUbSstyUbWUb 1.992 fak_ub_b2 0.00 1.992 FUNCTION_LIST ESSTT IF_DATA DIM_X DIRECT 0x8112C0
 /begin AXIS_DESCR STD_AXIS tmst temp_ub_q0p75_o48 12 -48.00 143.3 DEPOSIT ABSOLUT /end AXIS_DESCR
 /begin AXIS_DESCR STD_AXIS anztist dez 6 0.00 255.0 DEPOSIT ABSOLUT /end AXIS_DESCR
/end CHARACTERISTIC
/begin CHARACTERISTIC KFWMABG "Kennfeld für Wärmemengen-Schwellwert Taupunktende Abgas" MAP 0x81B710 GkfWUw 3712.000 q_uw_q0p0566 0.00 3712.000 FUNCTION_LIST ATM IF_DATA DIM_X DIRECT 0x81B710
 /begin AXIS_DESCR COM_AXIS tabgmst temp_ub_q5_o50 7 -50.00 1225. AXIS_PTS_REF ST107TMUB /end AXIS_DESCR
 /begin AXIS_DESCR COM_AXIS tmst temp_ub_q0p75_o48 5 -48.00000 49103.25 AXIS_PTS_REF STM05TMUB /end AXIS_DESCR
/end CHARACTERISTIC
/begin CHARACTERISTIC KFWMABG2 "Kennfeld für Wärmemengen-Schwellwert Taupunktende Abgas Bank2" MAP 0x81B756 GkfWUw 3712.000 q_uw_q0p0566 0.00 3712.000 FUNCTION_LIST ATM IF_DATA DIM_X DIRECT 0x81B756
 /begin AXIS_DESCR COM_AXIS tabgmst2 temp_ub_q5_o50 7 -50.00 1225. AXIS_PTS_REF ST207TMUB /end AXIS_DESCR
 /begin AXIS_DESCR COM_AXIS tmst temp_ub_q0p75_o48 5 -48.00000 49103.25 AXIS_PTS_REF STM05TMUB /end AXIS_DESCR
/end CHARACTERISTIC
/begin CHARACTERISTIC KFWMKAT "Kennfeld für Wärmemengen-Schwellwert Taupunktende hinter Kat" MAP 0x81B79C GkfWUw 3712.000 q_uw_q0p0566 0.00 3712.000 FUNCTION_LIST ATM IF_DATA DIM_X DIRECT 0x81B79C
 /begin AXIS_DESCR COM_AXIS tkatmst temp_ub_q5_o50 7 -50.00 1225. AXIS_PTS_REF ST307TMUB /end AXIS_DESCR
 /begin AXIS_DESCR COM_AXIS tmst temp_ub_q0p75_o48 5 -48.00000 49103.25 AXIS_PTS_REF STM05TMUB /end AXIS_DESCR
/end CHARACTERISTIC
/begin CHARACTERISTIC KFWMKAT2 "Kennfeld für Wärmemengen-Schwellwert Taupunktende hinter Kat Bank2" MAP 0x81B7E2 GkfWUw 3712.000 q_uw_q0p0566 0.00 3712.000 FUNCTION_LIST ATM IF_DATA DIM_X DIRECT 0x81B7E2
 /begin AXIS_DESCR COM_AXIS tkatmst2 temp_ub_q5_o50 7 -50.00 1225. AXIS_PTS_REF ST407TMUB /end AXIS_DESCR
 /begin AXIS_DESCR COM_AXIS tmst temp_ub_q0p75_o48 5 -48.00000 49103.25 AXIS_PTS_REF STM05TMUB /end AXIS_DESCR
/end CHARACTERISTIC
/begin CHARACTERISTIC KFWPFGR "Inverses Pedalkennfeld für FGR-Betrieb" MAP 0x81DD08 KfAxUwAyUwSstxUwSstyUwWUw 99.99847 rel_uw_b100 0.00 99.99847 FUNCTION_LIST MDFAW IF_DATA DIM_X DIRECT 0x81DD08
 /begin AXIS_DESCR STD_AXIS mrfgr_w rel_uw_b200 16 0.00 199.9969 DEPOSIT ABSOLUT /end AXIS_DESCR
 /begin AXIS_DESCR STD_AXIS nmot_w nmot_uw_q0p25 8 0.00 16383.75 DEPOSIT ABSOLUT /end AXIS_DESCR
/end CHARACTERISTIC
/begin CHARACTERISTIC KFWWNS "Wiederholstartzeitfaktor" MAP 0x81C7AA KfAxUbAyUbSstxUwSstyUbWUb 1.992 fak_ub_b2 0.00 1.992 FUNCTION_LIST ESNST IF_DATA DIM_X DIRECT 0x81C7AA
 /begin AXIS_DESCR STD_AXIS tabst_w t1sxs_uw_q1 8 0.00 65535.00 DEPOSIT ABSOLUT /end AXIS_DESCR
 /begin AXIS_DESCR STD_AXIS tmst temp_ub_q0p75_o48 8 -48.00 143.3 DEPOSIT ABSOLUT /end AXIS_DESCR
/end CHARACTERISTIC
/begin CHARACTERISTIC KFZDASH "Zeitkonstante PT1-Filter Dashpot" MAP 0x81DE3C GkfWUw 655.350000 zk10msxs_uw_b655 0.0100001526 655.360000 FUNCTION_LIST MDFAW IF_DATA DIM_X DIRECT 0x81DE3C /begin AXIS_DESCR COM_AXIS gangi dez 8 0.00 255.0 AXIS_PTS_REF SGA08MDUB /end AXIS_DESCR
 /begin AXIS_DESCR COM_AXIS nmot_w nmot_uw_q0p25 6 0.00 16383.75 AXIS_PTS_REF SNM06MDUW /end AXIS_DESCR
/end CHARACTERISTIC
/begin CHARACTERISTIC KFZLSD "Zeitkonstante PT2-Filter Lastschlagdämpfung" MAP 0x81DE9C GkfWUw 655.350000 zk10msxs_uw_b655 0.0100001526 655.360000 FUNCTION_LIST MDFAW IF_DATA DIM_X DIRECT 0x81DE9C /begin AXIS_DESCR COM_AXIS gangi dez 8 0.00 255.0 AXIS_PTS_REF SGA08MDUB /end AXIS_DESCR
 /begin AXIS_DESCR COM_AXIS nmot_w nmot_uw_q0p25 6 0.00 16383.75 AXIS_PTS_REF SNM06MDUW /end AXIS_DESCR
/end CHARACTERISTIC
/begin CHARACTERISTIC KFZW "Zündwinkelkennfeld" MAP 0x81248A GkfWSb 191.3 zw_sb_q0p75 -96.00 95.25 FUNCTION_LIST ZWGRU IF_DATA DIM_X DIRECT 0x81248A
 /begin AXIS_DESCR COM_AXIS nmot nmot_ub_q40 24 0.00 10200. AXIS_PTS_REF SNM24ZUUB /end AXIS_DESCR
 /begin AXIS_DESCR COM_AXIS rl rel_ub_q0p75 16 0.00 191.3 AXIS_PTS_REF SRL16ZUUB /end AXIS_DESCR
/end CHARACTERISTIC
/begin CHARACTERISTIC KFZW2 "Zündwinkelkennfeld Variante 2" MAP 0x81260A GkfWSb 191.3 zw_sb_q0p75 -96.00 95.25 FUNCTION_LIST ZWGRU IF_DATA DIM_X DIRECT 0x81260A
 /begin AXIS_DESCR COM_AXIS nmot nmot_ub_q40 24 0.00 10200. AXIS_PTS_REF SNM24ZUUB /end AXIS_DESCR
 /begin AXIS_DESCR COM_AXIS rl rel_ub_q0p75 16 0.00 191.3 AXIS_PTS_REF SRL16ZUUB /end AXIS_DESCR
/end CHARACTERISTIC
/begin CHARACTERISTIC KFZW3 "Zündwinkelkennfeld Variante 3" MAP 0x81278A GkfWSb 191.3 zw_sb_q0p75 -96.00 95.25 FUNCTION_LIST ZWGRU IF_DATA DIM_X DIRECT 0x81278A
 /begin AXIS_DESCR COM_AXIS nmot nmot_ub_q40 24 0.00 10200. AXIS_PTS_REF SNM24ZUUB /end AXIS_DESCR
 /begin AXIS_DESCR COM_AXIS rl rel_ub_q0p75 16 0.00 191.3 AXIS_PTS_REF SRL16ZUUB /end AXIS_DESCR
/end CHARACTERISTIC
/begin CHARACTERISTIC KFZW4 "Zündwinkelkennfeld" MAP 0x81290A GkfWSb 191.3 zw_sb_q0p75 -96.00 95.25 FUNCTION_LIST ZWGRU IF_DATA DIM_X DIRECT 0x81290A
 /begin AXIS_DESCR COM_AXIS nmot nmot_ub_q40 24 0.00 10200. AXIS_PTS_REF SNM24ZUUB /end AXIS_DESCR
 /begin AXIS_DESCR COM_AXIS rl rel_ub_q0p75 16 0.00 191.3 AXIS_PTS_REF SRL16ZUUB /end AXIS_DESCR
/end CHARACTERISTIC
/begin CHARACTERISTIC KFZWMN "Min-Zündwinkel" MAP 0x8176EC KfAxUbAyUbSstxUbSstyUbWSb 191.3 zw_sb_q0p75 -96.00 95.25 FUNCTION_LIST ZWMIN IF_DATA DIM_X DIRECT 0x8176EC /begin AXIS_DESCR STD_AXIS nmot nmot_ub_q40 16 0.00 10200. DEPOSIT ABSOLUT /end AXIS_DESCR /begin AXIS_DESCR STD_AXIS rl rel_ub_q0p75 12 0.00 191.3 DEPOSIT ABSOLUT /end AXIS_DESCR /end CHARACTERISTIC
/begin CHARACTERISTIC KFZWMNKH "Min-Zündwinkel Katheizen" MAP 0x8177CA KfAxUbAyUbSstxUbSstyUbWSb 191.3 zw_sb_q0p75 -96.00 95.25 FUNCTION_LIST ZWMIN IF_DATA DIM_X DIRECT 0x8177CA /begin AXIS_DESCR STD_AXIS nmot nmot_ub_q40 16 0.00 10200. DEPOSIT ABSOLUT /end AXIS_DESCR /begin AXIS_DESCR STD_AXIS rl rel_ub_q0p75 12 0.00 191.3 DEPOSIT ABSOLUT /end AXIS_DESCR /end CHARACTERISTIC
/begin CHARACTERISTIC KFZWMNST "Min-Zündwinkel für Start und Nachstart" MAP 0x8178A8 KfAxUbAyUbSstxUbSstyUbWSb 191.3 zw_sb_q0p75 -96.00 95.25 FUNCTION_LIST ZWMIN IF_DATA DIM_X DIRECT 0x8178A8 /begin AXIS_DESCR STD_AXIS nmot nmot_ub_q40 16 0.00 10200. DEPOSIT ABSOLUT /end AXIS_DESCR /begin AXIS_DESCR STD_AXIS rl rel_ub_q0p75 12 0.00 191.3 DEPOSIT ABSOLUT /end AXIS_DESCR /end CHARACTERISTIC
/begin CHARACTERISTIC KFZWMS "Kennfeld mit dauerhaft spätest möglichem Zündwinkel" MAP 0x812A8B GkfWSb 191.3 zw_sb_q0p75 -96.00 95.25 FUNCTION_LIST ZWMIN IF_DATA DIM_X DIRECT 0x812A8B
 /begin AXIS_DESCR COM_AXIS nmot nmot_ub_q40 16 0.00 10200. AXIS_PTS_REF SNM16ZUUB /end AXIS_DESCR
 /begin AXIS_DESCR COM_AXIS rl rel_ub_q0p75 12 0.00 191.3 AXIS_PTS_REF SRL12ZUUB /end AXIS_DESCR
/end CHARACTERISTIC
/begin CHARACTERISTIC KFZWOP "optimaler Zündwinkel" MAP 0x811745 GkfWSb 191.3 zw_sb_q0p75 -96.00 95.25 FUNCTION_LIST MDBAS IF_DATA DIM_X DIRECT 0x811745
 /begin AXIS_DESCR COM_AXIS nmot_w nmot_uw_q0p25 16 0.00 16383.75 AXIS_PTS_REF SNM16OPUW /end AXIS_DESCR
 /begin AXIS_DESCR COM_AXIS rl_w_kge rel_uw_q0p0234 16 0.00 1535.977 AXIS_PTS_REF SRL11OPUW /end AXIS_DESCR
/end CHARACTERISTIC
/begin CHARACTERISTIC KFZWOP2 "optimaler Zündwinkel Variante 2" MAP 0x811845 GkfWSb 191.3 zw_sb_q0p75 -96.00 95.25 FUNCTION_LIST MDBAS IF_DATA DIM_X DIRECT 0x811845
 /begin AXIS_DESCR COM_AXIS nmot_w nmot_uw_q0p25 16 0.00 16383.75 AXIS_PTS_REF SNM16OPUW /end AXIS_DESCR
 /begin AXIS_DESCR COM_AXIS rl_w_kge rel_uw_q0p0234 16 0.00 1535.977 AXIS_PTS_REF SRL11OPUW /end AXIS_DESCR
/end CHARACTERISTIC
/begin CHARACTERISTIC KFZWOP3 "optimaler Zündwinkel Variante 3" MAP 0x811945 GkfWSb 191.3 zw_sb_q0p75 -96.00 95.25 FUNCTION_LIST MDBAS IF_DATA DIM_X DIRECT 0x811945
 /begin AXIS_DESCR COM_AXIS nmot_w nmot_uw_q0p25 16 0.00 16383.75 AXIS_PTS_REF SNM16OPUW /end AXIS_DESCR
 /begin AXIS_DESCR COM_AXIS rl_w_kge rel_uw_q0p0234 16 0.00 1535.977 AXIS_PTS_REF SRL11OPUW /end AXIS_DESCR
/end CHARACTERISTIC
/begin CHARACTERISTIC KFZWOP4 "optimaler Zündwinkel Varainte 4" MAP 0x811A45 GkfWSb 191.3 zw_sb_q0p75 -96.00 95.25 FUNCTION_LIST MDBAS IF_DATA DIM_X DIRECT 0x811A45
 /begin AXIS_DESCR COM_AXIS nmot_w nmot_uw_q0p25 16 0.00 16383.75 AXIS_PTS_REF SNM16OPUW /end AXIS_DESCR
 /begin AXIS_DESCR COM_AXIS rl_w_kge rel_uw_q0p0234 16 0.00 1535.977 AXIS_PTS_REF SRL11OPUW /end AXIS_DESCR
/end CHARACTERISTIC
/begin CHARACTERISTIC KFZWWLNM "Delta Zündwinkel im Warmlauf" MAP 0x8179B2 KfAxUbAyUbSstxUbSstyUbWSb 191.3 zw_sb_q0p75 -96.00 95.25 FUNCTION_LIST ZWWL IF_DATA DIM_X DIRECT 0x8179B2 /begin AXIS_DESCR STD_AXIS nmot nmot_ub_q40 16 0.00 10200. DEPOSIT ABSOLUT /end AXIS_DESCR
 /begin AXIS_DESCR STD_AXIS tans temp_ub_q0p75_o48 6 -48.00 143.3 DEPOSIT ABSOLUT /end AXIS_DESCR
/end CHARACTERISTIC
/begin CHARACTERISTIC KFZWWLTM "Delta Zündwinkel im Warmlauf" MAP 0x81E3BA KfAxUbAyUbSstxUbSstyUbWSb 191.3 zw_sb_q0p75 -96.00 95.25 FUNCTION_LIST ZWWL IF_DATA DIM_X DIRECT 0x81E3BA
 /begin AXIS_DESCR STD_AXIS tmot temp_ub_q0p75_o48 12 -48.00 143.3 DEPOSIT ABSOLUT /end AXIS_DESCR
 /begin AXIS_DESCR STD_AXIS tmst temp_ub_q0p75_o48 12 -48.00 143.3 DEPOSIT ABSOLUT /end AXIS_DESCR
/end CHARACTERISTIC
/begin CHARACTERISTIC KFZW_UC "Kennfeld für optimalen Zündwinkel im Befehlstest" MAP 0x811EB5 GkfWSb 191.3 zw_sb_q0p75 -96.00 95.25 FUNCTION_LIST URCMIST IF_DATA DIM_X DIRECT 0x811EB5
 /begin AXIS_DESCR COM_AXIS rl_uc rel_ub_q0p75 8 0.00 191.3 AXIS_PTS_REF RLV08_UC /end AXIS_DESCR
 /begin AXIS_DESCR COM_AXIS nmot_uc nmot_ub_q40 8 0.00 10200. AXIS_PTS_REF NZWV08_UC /end AXIS_DESCR
/end CHARACTERISTIC
/begin CHARACTERISTIC KFZW_UM "Kennfeld für optimalen Zündwinkel in der Funktionsüberwachung" MAP 0x817DDD GkfWSb 191.3 zw_sb_q0p75 -96.00 95.25 FUNCTION_LIST UFMIST IF_DATA DIM_X DIRECT 0x817DDD
 /begin AXIS_DESCR COM_AXIS rl_um rel_ub_q0p75 8 0.00 191.3 AXIS_PTS_REF RLV08_UM /end AXIS_DESCR
 /begin AXIS_DESCR COM_AXIS nmot_um nmot_ub_q40 8 0.00 10200. AXIS_PTS_REF NZWV08_UM /end AXIS_DESCR
/end CHARACTERISTIC
/begin CHARACTERISTIC KHCTEMN "Minimalwert HC-Konzentration Regeneriergas Tankentlüftung" VALUE 0x819B2C KwSb 3.984 fak_sb_b2 -2.000 1.984 FUNCTION_LIST TEB IF_DATA DIM_X DIRECT 0x819B2C /end CHARACTERISTIC
/begin CHARACTERISTIC KHCTEMX "Maximalwert HC-Konzentration Regeneriergas Tankentlüftung" VALUE 0x819B2D KwSb 3.984 fak_sb_b2 -2.000 1.984 FUNCTION_LIST TEB IF_DATA DIM_X DIRECT 0x819B2D /end CHARACTERISTIC
/begin CHARACTERISTIC KIDMSNTE "Integrationsgeschwindigkeit für die Berechnung der Massenstromänderung TEV" VALUE 0x81E316 KwUw 127.9980 m_q0p00195 0.00 127.9980 FUNCTION_LIST DTEV IF_DATA DIM_X DIRECT 0x81E316 /end CHARACTERISTIC
/begin CHARACTERISTIC KIFZGAG "Integratorverstärkung des Fahrzeugmodells bei AT" CURVE 0x81603E FklWUw 4863.926 fak_uw_b4864 0.00 4863.926 FUNCTION_LIST ARMD IF_DATA DIM_X DIRECT 0x81603E /begin AXIS_DESCR FIX_AXIS gangi dez 6 1.000 6.000 FIX_AXIS_PAR 1 0 6 /end AXIS_DESCR /end CHARACTERISTIC
/begin CHARACTERISTIC KIFZGAWG "Integratorverstärkung des Fahrzeugmodells bei AT, geschlossene WK" CURVE 0x81604A FklWUw 4863.926 fak_uw_b4864 0.00 4863.926 FUNCTION_LIST ARMD IF_DATA DIM_X DIRECT 0x81604A /begin AXIS_DESCR FIX_AXIS gangi dez 6 1.000 6.000 FIX_AXIS_PAR 1 0 6 /end AXIS_DESCR /end CHARACTERISTIC
/begin CHARACTERISTIC KIFZGHG "Integratorverstärkung des Fahrzeugmodells bei Handschalter" CURVE 0x816056 FklWUw 4863.926 fak_uw_b4864 0.00 4863.926 FUNCTION_LIST ARMD IF_DATA DIM_X DIRECT 0x816056 /begin AXIS_DESCR FIX_AXIS gangi dez 6 1.000 6.000 FIX_AXIS_PAR 1 0 6 /end AXIS_DESCR /end CHARACTERISTIC
/begin CHARACTERISTIC KILRHML "I-Anteil fuer stetige LRHK" CURVE 0x812167 GklWUb 0.04980 freq_ub_b0p05 0.00 0.04980 FUNCTION_LIST LRSHK IF_DATA DIM_X DIRECT 0x812167 /begin AXIS_DESCR COM_AXIS ml m_ub_b1020 8 0.00 1020. AXIS_PTS_REF SML08LHUB /end AXIS_DESCR /end CHARACTERISTIC
/begin CHARACTERISTIC KIMSALL "Beiwert für Leerlaufluftmassenintegrator für E-Gas" VALUE 0x810F3E KwUb 25.4996 mk1sxs_ub_b25p6 0.100392 25.6000 FUNCTION_LIST BGMSZS IF_DATA DIM_X DIRECT 0x810F3E /end CHARACTERISTIC
/begin CHARACTERISTIC KINMXG "Übertragungsfaktor I-Regler für NMAX-Regelung" CURVE 0x819815 GklWUb 5.100 relnmot_q0p02 0.00 5.100 FUNCTION_LIST NMAXMD IF_DATA DIM_X DIRECT 0x819815 /begin AXIS_DESCR COM_AXIS gangi dez 8 0.00 255.0 AXIS_PTS_REF SGA08MDUB /end AXIS_DESCR /end CHARACTERISTIC
/begin CHARACTERISTIC KINMXRLG "Verstärkung Integralanteil der NMAX-Regelung im Normalbetrieb" MAP 0x81981D GkfWUb 5.100 relnmot_q0p02 0.00 5.100 FUNCTION_LIST NMAXMD IF_DATA DIM_X DIRECT 0x81981D
 /begin AXIS_DESCR COM_AXIS rl rel_ub_q0p75 8 0.00 191.3 AXIS_PTS_REF SRL08NXUB /end AXIS_DESCR
 /begin AXIS_DESCR COM_AXIS gangi dez 8 0.00 255.0 AXIS_PTS_REF SGA08MDUB /end AXIS_DESCR
/end CHARACTERISTIC
/begin CHARACTERISTIC KIRMSMS "Integrationsgeschwindigkeit Abgleich Massenstrom TEV mit berechnetem Massenstrom" CURVE 0x81767A KlAUbSstUbWUw 2498.970 fak_q0p03815 0.9918213 2499.962 FUNCTION_LIST DTEV IF_DATA DIM_X DIRECT 0x81767A /begin AXIS_DESCR STD_AXIS mstedte m_ub_b25p6 4 0.00 25.50 DEPOSIT ABSOLUT /end AXIS_DESCR /end CHARACTERISTIC
/begin CHARACTERISTIC KISRM "Integratorbeiwert für Saugrohrmodell (Dynamik)" VALUE 0x813F4A KwUw 0.9999847 fak_uw_b1 0.00 0.9999847 FUNCTION_LIST BGSRM IF_DATA DIM_X DIRECT 0x813F4A /end CHARACTERISTIC
/begin CHARACTERISTIC KISRM2 "Integratorbeiwert für Saugrohrmodell (Dynamik) abhängig von Ventilerhebungskurve" VALUE 0x813F4C KwUw 0.9999847 fak_uw_b1 0.00 0.9999847 FUNCTION_LIST BGSRM IF_DATA DIM_X DIRECT 0x813F4C /end CHARACTERISTIC
/begin CHARACTERISTIC KISRM2SU "Integationsbeiwert für Saugrohrmodell bei sumode=2" VALUE 0x813F4E KwUw 0.9999847 fak_uw_b1 0.00 0.9999847 FUNCTION_LIST BGSRM IF_DATA DIM_X DIRECT 0x813F4E /end CHARACTERISTIC
/begin CHARACTERISTIC KISRMSU "Integrationsbeiwert für Saugrohrmodell bei sumode=1" VALUE 0x813F50 KwUw 0.9999847 fak_uw_b1 0.00 0.9999847 FUNCTION_LIST BGSRM IF_DATA DIM_X DIRECT 0x813F50 /end CHARACTERISTIC
/begin CHARACTERISTIC KKFFGRGA "Verstärkungsfaktor bei Konstantfahrt für FGR-Regler" CURVE 0x81BA46 KlAUwSstUwWUw 3199.951 rel_uw_b3200 0.00 3199.951 FUNCTION_LIST FGRMD IF_DATA DIM_X DIRECT 0x81BA46 /begin AXIS_DESCR STD_AXIS gangi dez 8 0.00 65535.00 DEPOSIT ABSOLUT /end AXIS_DESCR /end CHARACTERISTIC
/begin CHARACTERISTIC KLAF "Ausflußkennlinie" CURVE 0x8149E8 FklWUw 0.9999847 fak_uw_b1 0.00 0.9999847 FUNCTION_LIST BGMSZS BGRLP FUEDK IF_DATA DIM_X DIRECT 0x8149E8
 /begin AXIS_DESCR FIX_AXIS klaf_kge fak_uw_q0p001 501 0.5000000 1.000000 FIX_AXIS_PAR 500 0 501 /end AXIS_DESCR
/end CHARACTERISTIC
/begin CHARACTERISTIC KLAFTE "Ausflußkennlinie für TEV incl. Leitung AKF-TEV" CURVE 0x8175C8 KlAUwSstUwWUw 1.999969 fak_uw_b2 0.00 1.999969 FUNCTION_LIST BGTEV IF_DATA DIM_X DIRECT 0x8175C8
 /begin AXIS_DESCR STD_AXIS phtevpu_w fak_uw_b2 14 0.00 1.999969 DEPOSIT ABSOLUT /end AXIS_DESCR
/end CHARACTERISTIC
/begin CHARACTERISTIC KLATMLAE "Exotherme Temperaturabnahme bei Anfettung" CURVE 0x818334 GklWUb 0.9961 fak_ub_b1 0.00 0.9961 FUNCTION_LIST ATM IF_DATA DIM_X DIRECT 0x818334
 /begin AXIS_DESCR COM_AXIS lamsbg_w fak_uw_b16 6 0.00 15.99976 AXIS_PTS_REF SLX06TMUW /end AXIS_DESCR
/end CHARACTERISTIC
/begin CHARACTERISTIC KLATMLAE2 "Exotherme Temperaturabnahme bei Anfettung, Bank 2" CURVE 0x81833A GklWUb 0.9961 fak_ub_b1 0.00 0.9961 FUNCTION_LIST ATM IF_DATA DIM_X DIRECT 0x81833A
 /begin AXIS_DESCR COM_AXIS lamsbg2_w fak_uw_b16 6 0.00 15.99976 AXIS_PTS_REF SLY06TMUW /end AXIS_DESCR
/end CHARACTERISTIC
/begin CHARACTERISTIC KLATMZWE "Exotherme Temperaturabnahme im Kat bei späterem Zündwinkel tkatm" CURVE 0x818340 GklWUb 0.9961 fak_ub_b1 0.00 0.9961 FUNCTION_LIST ATM IF_DATA DIM_X DIRECT 0x818340
 /begin AXIS_DESCR COM_AXIS etazwimt rel_ub_b127p5 6 0.00 127.5 AXIS_PTS_REF SEZ06TMUB /end AXIS_DESCR
/end CHARACTERISTIC
/begin CHARACTERISTIC KLATMZWE2 "Exotherme Temperaturabnahme im Kat bei späterem Zündwinkel, Bank 2" CURVE 0x818346 GklWUb 0.9961 fak_ub_b1 0.00 0.9961 FUNCTION_LIST ATM IF_DATA DIM_X DIRECT 0x818346
 /begin AXIS_DESCR COM_AXIS etazwimt rel_ub_b127p5 6 0.00 127.5 AXIS_PTS_REF SEZ06TMUB /end AXIS_DESCR
/end CHARACTERISTIC
/begin CHARACTERISTIC KLDMDLF1 "Kennlinie Reservemoment Lüfter" CURVE 0x811653 GklWUb 99.61 rel_ub_b99p6 0.00 99.61 FUNCTION_LIST MDVERB IF_DATA DIM_X DIRECT 0x811653
 /begin AXIS_DESCR COM_AXIS nmot nmot_ub_q40 6 0.00 10200. AXIS_PTS_REF SNM06MDUB /end AXIS_DESCR
/end CHARACTERISTIC
/begin CHARACTERISTIC KLDMDLF2 "Kennlinie Reservemoment Lüfter 2" CURVE 0x811659 GklWUb 99.61 rel_ub_b99p6 0.00 99.61 FUNCTION_LIST MDVERB IF_DATA DIM_X DIRECT 0x811659
 /begin AXIS_DESCR COM_AXIS nmot nmot_ub_q40 6 0.00 10200. AXIS_PTS_REF SNM06MDUB /end AXIS_DESCR
/end CHARACTERISTIC
/begin CHARACTERISTIC KLDMDMSG "Kennlinie Reservermoment Motorspülgebläse" CURVE 0x81165F GklWUb 99.61 rel_ub_b99p6 0.00 99.61 FUNCTION_LIST MDVERB IF_DATA DIM_X DIRECT 0x81165F
 /begin AXIS_DESCR COM_AXIS nmot nmot_ub_q40 6 0.00 10200. AXIS_PTS_REF SNM06MDUB /end AXIS_DESCR
/end CHARACTERISTIC
/begin CHARACTERISTIC KLDPDK "Druckabfall über Drosselklappe" CURVE 0x81C6C0 KlAUwSstUwWUw 2559.961 p_uw_q0p039 0.00 2559.961 FUNCTION_LIST FUEDK IF_DATA DIM_X DIRECT 0x81C6C0
 /begin AXIS_DESCR STD_AXIS mlkge_w m_uw_b6553p5 16 0.00 6553.500 DEPOSIT ABSOLUT /end AXIS_DESCR
/end CHARACTERISTIC
/begin CHARACTERISTIC KLDTPH "Festwertkennlinie eines Gewichtungsfaktors für die Dynamikbewertung" CURVE 0x810C0C FklWUb 0.9961 fak_q0p0039 0.00 0.9961 FUNCTION_LIST NLDG IF_DATA DIM_X DIRECT 0x810C0C
 /begin AXIS_DESCR FIX_AXIS dtsegph_w t5usxus_q5 16 -40960.00 40955.00 FIX_AXIS_PAR -8192 10 16 /end AXIS_DESCR
/end CHARACTERISTIC
/begin CHARACTERISTIC KLDTPHST "Festwertkennlinie eines Gewichtungsfaktors für Motorstart" CURVE 0x810C1C FklWUb 0.9961 fak_q0p0039 0.00 0.9961 FUNCTION_LIST NLDG IF_DATA DIM_X DIRECT 0x810C1C
 /begin AXIS_DESCR FIX_AXIS dtsegph_w t5usxus_q5 16 -40960.00 40955.00 FIX_AXIS_PAR -8192 10 16 /end AXIS_DESCR
/end CHARACTERISTIC
/begin CHARACTERISTIC KLDYNCOR "Wert für Dynamikkorrektur nach der ersten Zündung" CURVE 0x813B80 KlAUbSstUbWUw 2621400. t40usxus_q40 0.00 2621400. FUNCTION_LIST NLDG IF_DATA DIM_X DIRECT 0x813B80
 /begin AXIS_DESCR STD_AXIS tmot temp_ub_q0p75_o48 4 -48.00 143.3 DEPOSIT ABSOLUT /end AXIS_DESCR
/end CHARACTERISTIC
/begin CHARACTERISTIC KLETAZW_UC "ZW-Wirkungsgrad in Abhängigkeit von delta ZW im Befehlstest" CURVE 0x811EF5 KlAUbSstUbWUb 127.5 rel_ub_b127p5 0.00 127.5 FUNCTION_LIST URCMIST IF_DATA DIM_X DIRECT 0x811EF5 /begin AXIS_DESCR STD_AXIS dzw_uc zw_ub_q0p75 8 0.00 191.3 DEPOSIT ABSOLUT /end AXIS_DESCR /end CHARACTERISTIC
/begin CHARACTERISTIC KLETAZW_UM "ZW-Wirkungsgrad in Abhängigkeit von delta ZW in der Funktionsüberwachung" CURVE 0x817E1D KlAUbSstUbWUb 127.5 rel_ub_b127p5 0.00 127.5 FUNCTION_LIST UFMIST IF_DATA DIM_X DIRECT 0x817E1D /begin AXIS_DESCR STD_AXIS dzw_um zw_ub_q0p75 8 0.00 191.3 DEPOSIT ABSOLUT /end AXIS_DESCR /end CHARACTERISTIC
/begin CHARACTERISTIC KLITHMS "Kennlinie integrierte Luftmassenschwelle für Thermostat-Monitoring THM" CURVE 0x819023 KlAUbSstUbWUb 23.21 m_ub_b23p3 0.00 23.21 FUNCTION_LIST GGTFM IF_DATA DIM_X DIRECT 0x819023
 /begin AXIS_DESCR STD_AXIS tmst temp_ub_q0p75_o48 4 -48.00 143.3 DEPOSIT ABSOLUT /end AXIS_DESCR
/end CHARACTERISTIC
/begin CHARACTERISTIC KLLAKHFH "Umgebungsdruckkorrektur Lambda Katheizen" CURVE 0x81D3A8 KlAUwSstUwWUw 1.999969 fak_uw_b2 0.00 1.999969 FUNCTION_LIST LAKH IF_DATA DIM_X DIRECT 0x81D3A8 /begin AXIS_DESCR STD_AXIS fho_w fak_uw_b4 4 0.00 3.999939 DEPOSIT ABSOLUT /end AXIS_DESCR /end CHARACTERISTIC
/begin CHARACTERISTIC KLNLPHN "Korrektur des Sensor-Phasengangs" CURVE 0x810C2C FklWSb 15.94 kw_q0p0625 -8.000 7.938 FUNCTION_LIST NLDG IF_DATA DIM_X DIRECT 0x810C2C
 /begin AXIS_DESCR FIX_AXIS nmot nmot_ub_q40 16 0.00 5080. FIX_AXIS_PAR 0 3 16 /end AXIS_DESCR
/end CHARACTERISTIC
/begin CHARACTERISTIC KLNPED_UC "pedalsollwertabh. Drehzahlbegr. in der DK-Antrieb-Ersatzfunktion; Befehlstest" CURVE 0x811FD2 KlAUbSstUbWUb 10200. nmot_ub_q40 0.00 10200. FUNCTION_LIST URCREAC IF_DATA DIM_X DIRECT 0x811FD2
 /begin AXIS_DESCR STD_AXIS spsn_uc spg_ub_q0p019 8 0.00 4.9805 DEPOSIT ABSOLUT /end AXIS_DESCR
/end CHARACTERISTIC
/begin CHARACTERISTIC KLNPED_UM "pedalsollwertabh. Drehzahlbegrenzung in der DK-Antrieb-Ersatzfunktion, Fktsüberw" CURVE 0x817EFA KlAUbSstUbWUb 10200. nmot_ub_q40 0.00 10200. FUNCTION_LIST UFREAC IF_DATA DIM_X DIRECT 0x817EFA
 /begin AXIS_DESCR STD_AXIS spsn_um spg_ub_q0p019 8 0.00 4.9805 DEPOSIT ABSOLUT /end AXIS_DESCR
/end CHARACTERISTIC
/begin CHARACTERISTIC KLOELD "Kennlinie eines Gewichtungsfaktors für Öldruck im Start" CURVE 0x81B6EC KlAUwSstUwWUw 2047.969 fak_ub_b8 0.00 2047.969 FUNCTION_LIST NLDG IF_DATA DIM_X DIRECT 0x81B6EC
 /begin AXIS_DESCR STD_AXIS tabst_w t1sxs_uw_q1 6 0.00 65535.00 DEPOSIT ABSOLUT /end AXIS_DESCR
/end CHARACTERISTIC
/begin CHARACTERISTIC KLOELT "Kennlinie eines Gewichtungsfaktors für Öltemperatur im Start" CURVE 0x8181BB KlAUbSstUbWUb 7.969 fak_ub_b8 0.00 7.969 FUNCTION_LIST NLDG IF_DATA DIM_X DIRECT 0x8181BB
 /begin AXIS_DESCR STD_AXIS tmot temp_ub_q0p75_o48 5 -48.00 143.3 DEPOSIT ABSOLUT /end AXIS_DESCR
/end CHARACTERISTIC
/begin CHARACTERISTIC KLRLSALULL "Lastschwelle zur Schuberkennung für Ausblendung der Aussetzererkennung im LL" CURVE 0x81054E GklWUb 191.3 rel_ub_q0p75 0.00 191.3 FUNCTION_LIST DMDSTP IF_DATA DIM_X DIRECT 0x81054E
 /begin AXIS_DESCR COM_AXIS nmot nmot_ub_q40 8 0.00 10200. AXIS_PTS_REF SNM08DMUB /end AXIS_DESCR
/end CHARACTERISTIC
/begin CHARACTERISTIC KLTALUST "Zeitdauer Ausblendung der Aussetzererkennung nach Motorstart" CURVE 0x81B43A KlAUbSstUbWUw 655.3500 t10msxs_uw_b655p35 0.00 655.3500 FUNCTION_LIST DMDSTP IF_DATA DIM_X DIRECT 0x81B43A
 /begin AXIS_DESCR STD_AXIS tmst temp_ub_q0p75_o48 4 -48.00 143.3 DEPOSIT ABSOLUT /end AXIS_DESCR
/end CHARACTERISTIC
/begin CHARACTERISTIC KLTHMDTMS "Delta Motorstart-Temperatur für Verifikation/Heilung Thermostatdiagnose" CURVE 0x81902C KlAUbSstUbWUb 191.3 temp_ub_b191p25 0.00 191.3 FUNCTION_LIST GGTFM IF_DATA DIM_X DIRECT 0x81902C
 /begin AXIS_DESCR STD_AXIS tmst temp_ub_q0p75_o48 5 -48.00 143.3 DEPOSIT ABSOLUT /end AXIS_DESCR
/end CHARACTERISTIC
/begin CHARACTERISTIC KLTNSTKO "Unterdrückungszeit des Kompressors nach dem Start" CURVE 0x812B6D KlAUbSstUbWUb 51.00 t200msxs_ub_b51 0.00 51.00 FUNCTION_LIST KOS IF_DATA DIM_X DIRECT 0x812B6D
 /begin AXIS_DESCR STD_AXIS tmst temp_ub_q0p75_o48 5 -48.00 143.3 DEPOSIT ABSOLUT /end AXIS_DESCR
/end CHARACTERISTIC
/begin CHARACTERISTIC KLWNWI "Festwertkennlinie eines Gewichtungsfaktors für den Winkelfehler" CURVE 0x810C3C FklWUb 0.9961 fak_q0p0039 0.00 0.9961 FUNCTION_LIST NLDG IF_DATA DIM_X DIRECT 0x810C3C
 /begin AXIS_DESCR FIX_AXIS wnwix_w kw_sw_b128 16 -127.9961 128.0000 FIX_AXIS_PAR -32767 12 16 /end AXIS_DESCR
/end CHARACTERISTIC
/begin CHARACTERISTIC KLZZWMNST "KL Zeitkonstante für Abregelung ZW-Begrenzung im Nachstart" CURVE 0x817986 KlAUbSstUbWUw 655.350000 zk10msxs_uw_b655 0.0100001526 655.360000 FUNCTION_LIST ZWMIN IF_DATA DIM_X DIRECT 0x817986
 /begin AXIS_DESCR STD_AXIS tmst temp_ub_q0p75_o48 8 -48.00 143.3 DEPOSIT ABSOLUT /end AXIS_DESCR
/end CHARACTERISTIC
/begin CHARACTERISTIC KMLTESG "Konstante für Regeneriermasse in Leitung TEV-Saugrohr bei Normdruck + Normtemp." VALUE 0x81E266 KwUw 1.066650 fak1_q1p63Em5 0.00 1.066650 FUNCTION_LIST BGTEV IF_DATA DIM_X DIRECT 0x81E266 /end CHARACTERISTIC
/begin CHARACTERISTIC KMXSTG "Filterkonstante für Filter max. Steigung für Sonde hinter KAT" VALUE 0x81B8C4 KwUw 0.9999847 fak_uw_b1 0.00 0.9999847 FUNCTION_LIST DLSAHK IF_DATA DIM_X DIRECT 0x81B8C4 /end CHARACTERISTIC
/begin CHARACTERISTIC KNLSYN "Sicherheitsfaktor für Notlauf-Synchronisationsbedingung" VALUE 0x810C4C KwUb 7.969 fak_ub_b8 0.00 7.969 FUNCTION_LIST NLDG IF_DATA DIM_X DIRECT 0x810C4C /end CHARACTERISTIC
/begin CHARACTERISTIC KNSNF "Sperrband für Solldrehzahlnachführung" VALUE 0x8115C3 KwUb 2550. nmot_ub_q10 0.00 2550. FUNCTION_LIST LLRNS IF_DATA DIM_X DIRECT 0x8115C3 /end CHARACTERISTIC
/begin CHARACTERISTIC KOPWMTU "Nachbildung Kompressor-Last aus Umgebungstemperatur" CURVE 0x812B5B KlAUbSstUbWUb 255.0 dez 0.00 255.0 FUNCTION_LIST KOLS IF_DATA DIM_X DIRECT 0x812B5B
 /begin AXIS_DESCR STD_AXIS tumg temp_ub_q0p75_o48 8 -48.00 143.3 DEPOSIT ABSOLUT /end AXIS_DESCR
/end CHARACTERISTIC
/begin CHARACTERISTIC KPLRHML "P-Anteil fuer stetige LRHK" CURVE 0x81216F GklWUb 3.984 fak_ub_b4 0.00 3.984 FUNCTION_LIST LRSHK IF_DATA DIM_X DIRECT 0x81216F /begin AXIS_DESCR COM_AXIS ml m_ub_b1020 8 0.00 1020. AXIS_PTS_REF SML08LHUB /end AXIS_DESCR /end CHARACTERISTIC
/begin CHARACTERISTIC KRAFGRGA "Verstärkungsfaktor bei Rampe für FGR-Regler" CURVE 0x81BA68 KlAUwSstUwWUw 3199.951 rel_uw_b3200 0.00 3199.951 FUNCTION_LIST FGRMD IF_DATA DIM_X DIRECT 0x81BA68 /begin AXIS_DESCR STD_AXIS gangi dez 8 0.00 65535.00 DEPOSIT ABSOLUT /end AXIS_DESCR /end CHARACTERISTIC
/begin CHARACTERISTIC KRAL1N "Klopfregeladaption Lastbereich 1" CURVE 0x81929C GklWUb 191.3 rel_ub_q0p75 0.00 191.3 FUNCTION_LIST KRRA IF_DATA DIM_X DIRECT 0x81929C
 /begin AXIS_DESCR COM_AXIS nmot nmot_ub_q40 16 0.00 10200. AXIS_PTS_REF SNM16KRUB /end AXIS_DESCR
/end CHARACTERISTIC
/begin CHARACTERISTIC KRAL2N "Klopfregeladaption Lastbereich 2" CURVE 0x8192AC GklWUb 191.3 rel_ub_q0p75 0.00 191.3 FUNCTION_LIST KRRA IF_DATA DIM_X DIRECT 0x8192AC
 /begin AXIS_DESCR COM_AXIS nmot nmot_ub_q40 16 0.00 10200. AXIS_PTS_REF SNM16KRUB /end AXIS_DESCR
/end CHARACTERISTIC
/begin CHARACTERISTIC KRAL3N "Klopfregeladaption Lastbereich 3" CURVE 0x8192BC GklWUb 191.3 rel_ub_q0p75 0.00 191.3 FUNCTION_LIST KRRA IF_DATA DIM_X DIRECT 0x8192BC
 /begin AXIS_DESCR COM_AXIS nmot nmot_ub_q40 16 0.00 10200. AXIS_PTS_REF SNM16KRUB /end AXIS_DESCR
/end CHARACTERISTIC
/begin CHARACTERISTIC KRALH "Klopfregeladaption Lasthysterese" VALUE 0x8192CC KwUb 191.3 rel_ub_q0p75 0.00 191.3 FUNCTION_LIST KRRA IF_DATA DIM_X DIRECT 0x8192CC /end CHARACTERISTIC
/begin CHARACTERISTIC KRAN1 "Klopfregeladaption Drehzahlbereich, Stützstelle 1" VALUE 0x8192CD KwUb 10200. nmot_ub_q40 0.00 10200. FUNCTION_LIST KRRA IF_DATA DIM_X DIRECT 0x8192CD /end CHARACTERISTIC
/begin CHARACTERISTIC KRAN2 "Klopfregeladaption Drehzahlbereich, Stützstelle 2" VALUE 0x8192CE KwUb 10200. nmot_ub_q40 0.00 10200. FUNCTION_LIST KRRA IF_DATA DIM_X DIRECT 0x8192CE /end CHARACTERISTIC
/begin CHARACTERISTIC KRAN3 "Klopfregeladaption Drehzahlbereich, Stützstelle 3" VALUE 0x8192CF KwUb 10200. nmot_ub_q40 0.00 10200. FUNCTION_LIST KRRA IF_DATA DIM_X DIRECT 0x8192CF /end CHARACTERISTIC
/begin CHARACTERISTIC KRAN4 "Klopfregeladaption Drehzahlbereich, Stützstelle 4" VALUE 0x8192D0 KwUb 10200. nmot_ub_q40 0.00 10200. FUNCTION_LIST KRRA IF_DATA DIM_X DIRECT 0x8192D0 /end CHARACTERISTIC
/begin CHARACTERISTIC KRANH "Klopfregeladaption Drehzahlhysterese" VALUE 0x8192D1 KwUb 10200. nmot_ub_q40 0.00 10200. FUNCTION_LIST KRRA IF_DATA DIM_X DIRECT 0x8192D1 /end CHARACTERISTIC
/begin CHARACTERISTIC KRDWA "Klopfregelung Differenz aktueller ZW zu Adaptionskennfeld" VALUE 0x8114A6 KwUb 191.3 zw_ub_q0p75 0.00 191.3 FUNCTION_LIST KRRA IF_DATA DIM_X DIRECT 0x8114A6 /end CHARACTERISTIC
/begin CHARACTERISTIC KRDWSN "Klopfregelung delta - Winkel Sicherheit" CURVE 0x8192D2 GklWUb 191.3 zw_ub_qn0p75 -191.3 0.00 FUNCTION_LIST KRRA IF_DATA DIM_X DIRECT 0x8192D2
 /begin AXIS_DESCR COM_AXIS nmot nmot_ub_q40 16 0.00 10200. AXIS_PTS_REF SNM16KRUB /end AXIS_DESCR
/end CHARACTERISTIC
/begin CHARACTERISTIC KRFHKS "Fehlerhäufigkeit Klopfsensoren" VALUE 0x819169 KwUb 255.0 dez 0.00 255.0 FUNCTION_LIST DKRS IF_DATA DIM_X DIRECT 0x819169 /end CHARACTERISTIC
/begin CHARACTERISTIC KRFHT "Fehlerhäufigkeit Testimpuls" VALUE 0x811487 KwUb 254.0 dez 1.000 255.0 FUNCTION_LIST DKRNT DKRTP GGKS IF_DATA DIM_X DIRECT 0x811487 /end CHARACTERISTIC
/begin CHARACTERISTIC KRFKN "Spätverstellung pro Klopfereignis" CURVE 0x8192E2 GklWUb 191.3 zw_ub_qn0p75 -191.3 0.00 FUNCTION_LIST KRRA IF_DATA DIM_X DIRECT 0x8192E2
 /begin AXIS_DESCR COM_AXIS nmot nmot_ub_q40 16 0.00 10200. AXIS_PTS_REF SNM16KRUB /end AXIS_DESCR
/end CHARACTERISTIC
/begin CHARACTERISTIC KRFTP1 "Tiefpassverhalten normal" VALUE 0x811495 KwUb 24.00 dez 8.000 32.00 FUNCTION_LIST KRKE IF_DATA DIM_X DIRECT 0x811495 /end CHARACTERISTIC
/begin CHARACTERISTIC KRFTP2 "Tiefpassverhalten bei Drehzahldynamik" VALUE 0x811496 KwUb 14.00 dez 2.000 16.00 FUNCTION_LIST KRKE IF_DATA DIM_X DIRECT 0x811496 /end CHARACTERISTIC
/begin CHARACTERISTIC KRFTP3 "Tiefpassverhalten bei Lastdynamik" VALUE 0x811497 KwUb 14.00 dez 2.000 16.00 FUNCTION_LIST KRKE IF_DATA DIM_X DIRECT 0x811497 /end CHARACTERISTIC
/begin CHARACTERISTIC KRFTP4 "Tiefpassverhalten bei Umschalten NW oder Ventilhub" VALUE 0x811498 KwUb 14.00 dez 2.000 16.00 FUNCTION_LIST KRKE IF_DATA DIM_X DIRECT 0x811498 /end CHARACTERISTIC
/begin CHARACTERISTIC KRKFKS "Zuordnung der Kloperkennungskennlinie bei fehlender Zyl.-1-Erkennung" VALUE 0x811499 KwUb 255.0 dez 0.00 255.0 FUNCTION_LIST KRKE IF_DATA DIM_X DIRECT 0x811499 /end CHARACTERISTIC
/begin CHARACTERISTIC KRKTE "Umrechnung relative Kraftstoffmasse rk in effektive Einspritzzeit te" VALUE 0x8187F5 KwUb 0.4533 rkti_sy 0.00 0.4533 FUNCTION_LIST AES IF_DATA DIM_X DIRECT 0x8187F5 /end CHARACTERISTIC
/begin CHARACTERISTIC KRLMDY "Lesen bei Lastbereichswechsel: immer oder nur bei Dynamik" VALUE 0x8114A7 KwUb 1.000 dez 0.00 1.000 FUNCTION_LIST KRRA IF_DATA DIM_X DIRECT 0x8114A7 /end CHARACTERISTIC
/begin CHARACTERISTIC KRMXN "maximale Spätverstellung" CURVE 0x8192F2 GklWUb 190.5 zw_ub_qn0p75 -191.3 -0.7500 FUNCTION_LIST KRRA IF_DATA DIM_X DIRECT 0x8192F2
 /begin AXIS_DESCR COM_AXIS nmot nmot_ub_q40 16 0.00 10200. AXIS_PTS_REF SNM16KRUB /end AXIS_DESCR
/end CHARACTERISTIC
/begin CHARACTERISTIC KRNMDY "Lesen bei Drehzahlbereichswechsel: immer oder nur bei Dynamik" VALUE 0x8114A8 KwUb 1.000 dez 0.00 1.000 FUNCTION_LIST KRRA IF_DATA DIM_X DIRECT 0x8114A8 /end CHARACTERISTIC
/begin CHARACTERISTIC KRVFN "Anz. Zünd./Zyl., bzw. Zeitangabe von Frühverst. zu Frühverst. (Stufenbreite-KR)" CURVE 0x819302 GklWUb 254.0 dez 1.000 255.0 FUNCTION_LIST KRRA IF_DATA DIM_X DIRECT 0x819302
 /begin AXIS_DESCR COM_AXIS nmot nmot_ub_q40 16 0.00 10200. AXIS_PTS_REF SNM16KRUB /end AXIS_DESCR
/end CHARACTERISTIC
/begin CHARACTERISTIC KRVFSN "Anzahl Zündungen/Zyl., oder Zeitangabe für schnelle Frühverstellung der KR" CURVE 0x819312 GklWUb 254.0 dez 1.000 255.0 FUNCTION_LIST KRRA IF_DATA DIM_X DIRECT 0x819312
 /begin AXIS_DESCR COM_AXIS nmot nmot_ub_q40 16 0.00 10200. AXIS_PTS_REF SNM16KRUB /end AXIS_DESCR
/end CHARACTERISTIC
/begin CHARACTERISTIC KRVST "Verstärkung nach Start" VALUE 0x81149A KwUb 6.000 dez 0.00 6.000 FUNCTION_LIST KRKE IF_DATA DIM_X DIRECT 0x81149A /end CHARACTERISTIC
/begin CHARACTERISTIC KRWKRUM "Speichern bei Klopfen: Wert vor oder nach Klopfen" VALUE 0x8114A9 KwUb 1.000 dez 0.00 1.000 FUNCTION_LIST KRRA IF_DATA DIM_X DIRECT 0x8114A9 /end CHARACTERISTIC
/begin CHARACTERISTIC KSTAI "Arbeitsbereiche für STADAP-Faktoren" CURVE 0x811442 KlAUbSstUbWUb 255.0 dez 0.00 255.0 FUNCTION_LIST STADAP IF_DATA DIM_X DIRECT 0x811442
 /begin AXIS_DESCR STD_AXIS tmst temp_ub_q0p75_o48 12 -48.00 143.3 DEPOSIT ABSOLUT /end AXIS_DESCR
/end CHARACTERISTIC
/begin CHARACTERISTIC KSTAMX0 "Max-Begrenzung des STADAP-Faktors in Bereich 0" VALUE 0x81145B KwUb 0.9922 fak_ub_b2 1.000 1.992 FUNCTION_LIST STADAP IF_DATA DIM_X DIRECT 0x81145B /end CHARACTERISTIC
/begin CHARACTERISTIC KSTAMX1 "Max-Begrenzung des STADAP-Faktors in Bereich 1" VALUE 0x81145C KwUb 0.9922 fak_ub_b2 1.000 1.992 FUNCTION_LIST STADAP IF_DATA DIM_X DIRECT 0x81145C /end CHARACTERISTIC
/begin CHARACTERISTIC KSTAMX2 "Max-Begrenzung des STADAP-Faktors in Bereich 2" VALUE 0x81145D KwUb 0.9922 fak_ub_b2 1.000 1.992 FUNCTION_LIST STADAP IF_DATA DIM_X DIRECT 0x81145D /end CHARACTERISTIC
/begin CHARACTERISTIC KSTTOPMN "Minimale Betriebsdauer seit PWF für Startmengenadaption" VALUE 0x813FEE KwUw 393210.0 t6minxmin_q6 0.00 393210.0 FUNCTION_LIST STADAP IF_DATA DIM_X DIRECT 0x813FEE /end CHARACTERISTIC
/begin CHARACTERISTIC KSZA "Anzahl Klopfsensoren" VALUE 0x81149B KwUb 3.000 dez 1.000 4.000 FUNCTION_LIST KRKE DKRS IF_DATA DIM_X DIRECT 0x81149B /end CHARACTERISTIC
/begin CHARACTERISTIC KUMSRL "Umrechnungskonstante von Massenstrom in relative Luftfüllung" VALUE 0x810F3F KwUb 0.00199218750 kumsrl_ub_b0p002 0.00 0.00199218750 FUNCTION_LIST BGMSZS FUEDK TEB IF_DATA DIM_X DIRECT 0x810F3F /end CHARACTERISTIC
/begin CHARACTERISTIC KVLAD "Konstante für Umrechnung von Ladedruck in Luftmasse" VALUE 0x810F40 KwUb 1.992 rel_ub_b2p0 0.00 1.992 FUNCTION_LIST BGMSZS IF_DATA DIM_X DIRECT 0x810F40 /end CHARACTERISTIC
/begin CHARACTERISTIC KVZAF "Verstärkungsfaktor Zusatzamplitudenfilter" VALUE 0x812103 KwSb 3.984 fak_sb_b2 -2.000 1.984 FUNCTION_LIST LRS IF_DATA DIM_X DIRECT 0x812103 /end CHARACTERISTIC
/begin CHARACTERISTIC LADFIL "Ladedruckfilterung" VALUE 0x810F41 KwUb 0.9961 fak_ub_b1 0.00 0.9961 FUNCTION_LIST BGMSZS IF_DATA DIM_X DIRECT 0x810F41 /end CHARACTERISTIC
/begin CHARACTERISTIC LALIUS "Lambdalinearisierung, LSU-Sonde vor Katalysator" CURVE 0x813CAA KlAUwSstUwWUw 15.99976 fak_uw_b16 0.00 15.99976 FUNCTION_LIST GGLSU IF_DATA DIM_X DIRECT 0x813CAA
 /begin AXIS_DESCR STD_AXIS usvkk_w spg_uw_q0p00488 22 0.00 319.9951 DEPOSIT ABSOLUT /end AXIS_DESCR
/end CHARACTERISTIC
/begin CHARACTERISTIC LALIUSH "Lambdalinearisierung, Sonde hinter Katalysator" CURVE 0x816E0C KlAUwSstUwWUw 15.99976 fak_uw_b16 0.00 15.99976 FUNCTION_LIST LRSHK IF_DATA DIM_X DIRECT 0x816E0C
 /begin AXIS_DESCR STD_AXIS ushk_w spg_uw_q0p00488_o1 10 -1.000000 318.9951 DEPOSIT ABSOLUT /end AXIS_DESCR
/end CHARACTERISTIC
/begin CHARACTERISTIC LALIUSH2 "Lambdalinearisierung, Sonde hinter Katalysator, Bank 2" CURVE 0x816E36 KlAUwSstUwWUw 15.99976 fak_uw_b16 0.00 15.99976 FUNCTION_LIST LRSHK IF_DATA DIM_X DIRECT 0x816E36
 /begin AXIS_DESCR STD_AXIS ushk2_w spg_uw_q0p00488_o1 10 -1.000000 318.9951 DEPOSIT ABSOLUT /end AXIS_DESCR
/end CHARACTERISTIC
/begin CHARACTERISTIC LALIUSMN "minimales, ueber LALIUS (%GGLSU) messbares Lambda" VALUE 0x816D80 KwUw 15.99976 fak_uw_b16 0.00 15.99976 FUNCTION_LIST LRS LRSEB IF_DATA DIM_X DIRECT 0x816D80 /end CHARACTERISTIC
/begin CHARACTERISTIC LALIUSRH "Lambdalinearisierung, Sonde hinter Katalysator, Sollwert" CURVE 0x816E60 KlAUbSstUbWUw 15.99976 fak_uw_b16 0.00 15.99976 FUNCTION_LIST LRSHK IF_DATA DIM_X DIRECT 0x816E60
 /begin AXIS_DESCR STD_AXIS usrhk spg_ub_q0p0052_o0p2 10 -0.2000 1.130 DEPOSIT ABSOLUT /end AXIS_DESCR
/end CHARACTERISTIC
/begin CHARACTERISTIC LALIUSRH2 "Lambdalinearisierung, Sonde hinter Katalysator, Sollwert Bank2" CURVE 0x816E80 KlAUbSstUbWUw 15.99976 fak_uw_b16 0.00 15.99976 FUNCTION_LIST LRSHK IF_DATA DIM_X DIRECT 0x816E80
 /begin AXIS_DESCR STD_AXIS usrhk2 spg_ub_q0p0052_o0p2 10 -0.2000 1.130 DEPOSIT ABSOLUT /end AXIS_DESCR
/end CHARACTERISTIC
/begin CHARACTERISTIC LAMDYNO "obere Lambdaschwelle für Dynamikprüfung LSU" VALUE 0x81B8F6 KwUw 15.99976 fak_uw_b16 0.00 15.99976 FUNCTION_LIST DLSU IF_DATA DIM_X DIRECT 0x81B8F6 /end CHARACTERISTIC
/begin CHARACTERISTIC LAMDYNU "untere Lambdaschwelle für Dynamikprüfung LSU" VALUE 0x81B8F8 KwUw 15.99976 fak_uw_b16 0.00 15.99976 FUNCTION_LIST DLSU IF_DATA DIM_X DIRECT 0x81B8F8 /end CHARACTERISTIC
/begin CHARACTERISTIC LAMFA "Lambda Fahrerwunsch" MAP 0x81C926 KfAxUbAyUbSstxUbSstyUwWUb 1.992 fak_ub_b2 0.00 1.992 FUNCTION_LIST LAMFAW IF_DATA DIM_X DIRECT 0x81C926 /begin AXIS_DESCR STD_AXIS nmot nmot_ub_q40 15 0.00 10200. DEPOSIT ABSOLUT /end AXIS_DESCR
 /begin AXIS_DESCR STD_AXIS mrfa_w rel_uw_b200 6 0.00 199.9969 DEPOSIT ABSOLUT /end AXIS_DESCR
/end CHARACTERISTIC
/begin CHARACTERISTIC LAMKAML "Lambdasollwert für Katalysator-Ausräumen (luftmassenabhängig)" CURVE 0x8198D1 KlAUbSstUbWUb 0.4980 fak_ub_b1p25_o0p75 0.7500 1.248 FUNCTION_LIST LRSKA IF_DATA DIM_X DIRECT 0x8198D1 /begin AXIS_DESCR STD_AXIS ml m_ub_b1020 5 0.00 1020. DEPOSIT ABSOLUT /end AXIS_DESCR /end CHARACTERISTIC
/begin CHARACTERISTIC LAMLGF "Laufgrenze ""fett""" VALUE 0x811411 KwUb 1.992 fak_ub_b2 0.00 1.992 FUNCTION_LIST LAMKO IF_DATA DIM_X DIRECT 0x811411 /end CHARACTERISTIC
/begin CHARACTERISTIC LAMLGFSL "Laufgrenze ""fett"" bei Sekundärluftbetrieb" VALUE 0x811412 KwUb 1.992 fak_ub_b2 0.00 1.992 FUNCTION_LIST LAMKO IF_DATA DIM_X DIRECT 0x811412 /end CHARACTERISTIC
/begin CHARACTERISTIC LAMLGMTM "Laufgrenze ""mager""" CURVE 0x818F8B GklWUb 1.992 fak_ub_b2 0.00 1.992 FUNCTION_LIST LAMKO IF_DATA DIM_X DIRECT 0x818F8B
 /begin AXIS_DESCR COM_AXIS tmot temp_ub_q0p75_o48 12 -48.00 143.3 AXIS_PTS_REF STM12ESUB /end AXIS_DESCR
/end CHARACTERISTIC
/begin CHARACTERISTIC LAMMN "Untere Plausibilitätsschwelle für Lambda" VALUE 0x81B8FA KwUw 15.99976 fak_uw_b16 0.00 15.99976 FUNCTION_LIST DLSU IF_DATA DIM_X DIRECT 0x81B8FA /end CHARACTERISTIC
/begin CHARACTERISTIC LAMMX "Obere Plausibilitätsschwelle für Lambda" VALUE 0x81B8FC KwUw 15.99976 fak_uw_b16 0.00 15.99976 FUNCTION_LIST DLSU IF_DATA DIM_X DIRECT 0x81B8FC /end CHARACTERISTIC
/begin CHARACTERISTIC LAMSKAMX "Lambda-Ist vor Kat für Erkennung Magerbedingung Kat-Ausräumen" VALUE 0x8169C0 KwUw 15.99976 fak_uw_b16 0.00 15.99976 FUNCTION_LIST LRSKA IF_DATA DIM_X DIRECT 0x8169C0 /end CHARACTERISTIC
/begin CHARACTERISTIC LAMSKAMX2 "Lambda-Ist vor Kat für Erkennung Magerbedingung Kat-Ausräumen, Bank2" VALUE 0x8169C2 KwUw 15.99976 fak_uw_b16 0.00 15.99976 FUNCTION_LIST LRSKA IF_DATA DIM_X DIRECT 0x8169C2 /end CHARACTERISTIC
/begin CHARACTERISTIC LAMSOSOF "Lambdasonde Soll Obergrenze für 1.0-Fenster" VALUE 0x813FE4 KwUw 15.99976 fak_uw_b16 0.00 15.99976 FUNCTION_LIST LAMKO IF_DATA DIM_X DIRECT 0x813FE4 /end CHARACTERISTIC
/begin CHARACTERISTIC LAMSOSUF "Lambdasonde Soll Untergrenze für 1.0-Fenster" VALUE 0x813FE6 KwUw 15.99976 fak_uw_b16 0.00 15.99976 FUNCTION_LIST LAMKO IF_DATA DIM_X DIRECT 0x813FE6 /end CHARACTERISTIC
/begin CHARACTERISTIC LAMSSAMN "untere Grenze für lamsosa und lamsisa, CARB-Tester, DLSSALRS" VALUE 0x8184BD KwUb 1.992 fak_ub_b2 0.00 1.992 FUNCTION_LIST DLSSA TC5MOD IF_DATA DIM_X DIRECT 0x8184BD /end CHARACTERISTIC
/begin CHARACTERISTIC LAMSSAMX "obere Grenze für lamsosa und lamsisa, CARB-Tester, DLSSALRS" VALUE 0x8184BE KwUb 1.992 fak_ub_b2 0.00 1.992 FUNCTION_LIST DLSSA TC5MOD IF_DATA DIM_X DIRECT 0x8184BE /end CHARACTERISTIC
/begin CHARACTERISTIC LASDSLA "Lambda-Abgas-Soll bei Sekundärluftadaption/Kurztest" CURVE 0x81D3BA KlAUwSstUwWUw 15.99976 fak_q0p000244 0.00 15.99976 FUNCTION_LIST LAKH IF_DATA DIM_X DIRECT 0x81D3BA /begin AXIS_DESCR STD_AXIS ml_w m_uw_b6553p5 4 0.00 6553.500 DEPOSIT ABSOLUT /end AXIS_DESCR /end CHARACTERISTIC
/begin CHARACTERISTIC LASHKAB "Startwert für dynamische Sollwertanhebung (lamsolh) in der LRHK" VALUE 0x816EA0 KwSw 0.9999695 fak_sw_b1 0.00 0.9999695 FUNCTION_LIST LRSHK IF_DATA DIM_X DIRECT 0x816EA0 /end CHARACTERISTIC
/begin CHARACTERISTIC LASOAB "Lambdasollwert bei Bankabschaltung" VALUE 0x811413 KwUb 1.992 fak_ub_b2 0.00 1.992 FUNCTION_LIST LAMKO IF_DATA DIM_X DIRECT 0x811413 /end CHARACTERISTIC
/begin CHARACTERISTIC LASTMOT "Motortemp.-Korrektur von Lambda-Abgas-Soll" CURVE 0x819152 KlAUbSstUbWUb 1.992 fak_ub_b2 0.00 1.992 FUNCTION_LIST LAKH IF_DATA DIM_X DIRECT 0x819152
 /begin AXIS_DESCR STD_AXIS tmot temp_ub_q0p75_o48 4 -48.00 143.3 DEPOSIT ABSOLUT /end AXIS_DESCR
/end CHARACTERISTIC
/begin CHARACTERISTIC LASWLTM "Offset Lambda-Motor-Soll bei inaktiver Lambdaregelung" CURVE 0x818DF1 GklWSb 1.992 fak_sb_b1 -1.000 0.9922 FUNCTION_LIST ESWL IF_DATA DIM_X DIRECT 0x818DF1
 /begin AXIS_DESCR COM_AXIS tmot temp_ub_q0p75_o48 12 -48.00 143.3 AXIS_PTS_REF STM12ESUB /end AXIS_DESCR
/end CHARACTERISTIC
/begin CHARACTERISTIC LBMINC "Wert der bei Bezugsmarkenverlust hinzuaddiert wird" VALUE 0x813B4C KwUw 65535.00 dez 0.00 65535.00 FUNCTION_LIST DDG IF_DATA DIM_X DIRECT 0x813B4C /end CHARACTERISTIC
/begin CHARACTERISTIC LBMINIT "Initialisierungswert des Zählers Bezugsmarkenverlust, wenn SG zuvor im NLDG war" VALUE 0x813B4E KwUw 65535.00 dez 0.00 65535.00 FUNCTION_LIST DDG IF_DATA DIM_X DIRECT 0x813B4E /end CHARACTERISTIC
/begin CHARACTERISTIC LBMMX "Maximalwert für Zähler Bezugsmarkenverlust" VALUE 0x813B50 KwUw 65535.00 dez 0.00 65535.00 FUNCTION_LIST DDG IF_DATA DIM_X DIRECT 0x813B50 /end CHARACTERISTIC
/begin CHARACTERISTIC LBMSUB "Differenzwert zwischen der Fehlereintragsschwelle und der Notlaufanforderung" VALUE 0x81B6E6 KwUw 65535.00 dez 0.00 65535.00 FUNCTION_LIST DDG IF_DATA DIM_X DIRECT 0x81B6E6 /end CHARACTERISTIC
/begin CHARACTERISTIC LBZO1 "Schwelle für lbz zur Solldrehzahlanhebung beim Verlassen des LL" VALUE 0x819701 KwUb 99.61 rel_ub_b99p6 0.00 99.61 FUNCTION_LIST LLRNS IF_DATA DIM_X DIRECT 0x819701 /end CHARACTERISTIC
/begin CHARACTERISTIC LBZO2 "Schwelle für lbz zur Solldrehzahlanhebung im Leerlauf" VALUE 0x819702 KwUb 99.61 rel_ub_b99p6 0.00 99.61 FUNCTION_LIST LLRNS IF_DATA DIM_X DIRECT 0x819702 /end CHARACTERISTIC
/begin CHARACTERISTIC LBZU "Schwelle für lbz zur Solldrehzahlabsenkung beim Verlassen des Leerlaufs" VALUE 0x819703 KwUb 99.61 rel_ub_b99p6 0.00 99.61 FUNCTION_LIST LLRNS IF_DATA DIM_X DIRECT 0x819703 /end CHARACTERISTIC
/begin CHARACTERISTIC LDAMN "Minimalwertbegrenzung der Adaption LDR I-Adaption" VALUE 0x81D9B4 KwSw 327.6750 tv_sw_q0p005 -163.8400 163.8350 FUNCTION_LIST LDRPID IF_DATA DIM_X DIRECT 0x81D9B4 /end CHARACTERISTIC
/begin CHARACTERISTIC LDDIAN "Schrittweite pro Programmdurchlauf für negativ-Nachführung I-Begrenzung" VALUE 0x81D9B6 KwSw 327.6750 tv_sw_q0p005 -163.8400 163.8350 FUNCTION_LIST LDRPID IF_DATA DIM_X DIRECT 0x81D9B6 /end CHARACTERISTIC
/begin CHARACTERISTIC LDDIAP "Schrittweite pro Programmdurchlauf für positiv-Nachführung I-Begrenzung" VALUE 0x81D9B8 KwSw 163.8350 tv_sw_q0p005 0.00 163.8350 FUNCTION_LIST LDRPID IF_DATA DIM_X DIRECT 0x81D9B8 /end CHARACTERISTIC
/begin CHARACTERISTIC LDDIMNN "Sicherheitsabstand LDR I-Regler Begrenzung negativ" CURVE 0x81D9BA GklWSw 163.8350 tv_sw_q0p005 0.00 163.8350 FUNCTION_LIST LDRPID IF_DATA DIM_X DIRECT 0x81D9BA
 /begin AXIS_DESCR COM_AXIS nmot_w nmot_uw_q0p25 8 0.00 16383.75 AXIS_PTS_REF SNM08LDUW /end AXIS_DESCR
/end CHARACTERISTIC
/begin CHARACTERISTIC LDDIMXN "Sicherheitsabstand LDR I-Regler Begrenzung" CURVE 0x81D9CA GklWSw 163.8350 tv_sw_q0p005 0.00 163.8350 FUNCTION_LIST LDRPID IF_DATA DIM_X DIRECT 0x81D9CA
 /begin AXIS_DESCR COM_AXIS nmot_w nmot_uw_q0p25 8 0.00 16383.75 AXIS_PTS_REF SNM08LDUW /end AXIS_DESCR
/end CHARACTERISTIC
/begin CHARACTERISTIC LDEIAO "Obere Regelabweichungsschwelle für Negativ-Verstellung" VALUE 0x819608 KwSb 2550. p_sb_q10 -1280. 1270. FUNCTION_LIST LDRPID IF_DATA DIM_X DIRECT 0x819608 /end CHARACTERISTIC
/begin CHARACTERISTIC LDEIAP "Regelabweichungsschwelle für  Positiv Adaption I-Regler" VALUE 0x819609 KwSb 2550. p_sb_q10 -1280. 1270. FUNCTION_LIST LDRPID IF_DATA DIM_X DIRECT 0x819609 /end CHARACTERISTIC
/begin CHARACTERISTIC LDEIAPS "Regelabweichungsschwelle für schnelle Positiv-Nachführung" VALUE 0x81960A KwSb 2550. p_sb_q10 -1280. 1270. FUNCTION_LIST LDRPID IF_DATA DIM_X DIRECT 0x81960A /end CHARACTERISTIC
/begin CHARACTERISTIC LDEIAU "Untere Regelabweichungsschwelle für Negativ-Verstellung" VALUE 0x81960B KwSb 2550. p_sb_q10 -1280. 1270. FUNCTION_LIST LDRPID IF_DATA DIM_X DIRECT 0x81960B /end CHARACTERISTIC
/begin CHARACTERISTIC LDHIA "Hysterese für LDR I-Adaptionskennlinie" VALUE 0x81960C KwSb 5080. nmot_ub_q40 0.00 5080. FUNCTION_LIST LDRPID IF_DATA DIM_X DIRECT 0x81960C /end CHARACTERISTIC
/begin CHARACTERISTIC LDIATA "Korrektur I-Begrenzung LDR PID Rgler als Funktion von Tans" CURVE 0x81960D GklWSb 163.2 tv_ub_q0p64 -81.92 81.28 FUNCTION_LIST LDRPID IF_DATA DIM_X DIRECT 0x81960D
 /begin AXIS_DESCR COM_AXIS tans temp_ub_q0p75_o48 8 -48.00 143.3 AXIS_PTS_REF STA08LDUB /end AXIS_DESCR
/end CHARACTERISTIC
/begin CHARACTERISTIC LDMXNN "Begrenzung max. Nachführung LDR negativ für Regleradaption" VALUE 0x81D9DA KwSw 163.8400 tv_sw_q0p005 -163.8400 0.00 FUNCTION_LIST LDRPID IF_DATA DIM_X DIRECT 0x81D9DA /end CHARACTERISTIC
/begin CHARACTERISTIC LDMXNP "Begrenzung max. Nachführung LDR Adaption positiv bei Bereichswechsel" VALUE 0x81D9DC KwSw 163.8350 tv_sw_q0p005 0.00 163.8350 FUNCTION_LIST LDRPID IF_DATA DIM_X DIRECT 0x81D9DC /end CHARACTERISTIC
/begin CHARACTERISTIC LDORXN "Maximalfuellung LDR bei E_ldo (Überladefehler)" CURVE 0x8195AD GklWUb 191.3 rel_ub_q0p75 0.00 191.3 FUNCTION_LIST LDRLMX IF_DATA DIM_X DIRECT 0x8195AD
 /begin AXIS_DESCR COM_AXIS nmot nmot_ub_q40 8 0.00 10200. AXIS_PTS_REF SNM08LDUB /end AXIS_DESCR
/end CHARACTERISTIC
/begin CHARACTERISTIC LDPBN "LDR p-Begrenzung bei zu hoher Motortemperatur" CURVE 0x8195B5 GklWUb 2550. p_ub_q10 0.00 2550. FUNCTION_LIST LDRLMX IF_DATA DIM_X DIRECT 0x8195B5
 /begin AXIS_DESCR COM_AXIS nmot nmot_ub_q40 8 0.00 10200. AXIS_PTS_REF SNM08LDUB /end AXIS_DESCR
/end CHARACTERISTIC
/begin AXIS_PTS MDV08_UC "Stützstellenverteilung für Moment im Befehlstest" 0x811FC6 mzmax_uc SstAUbSstUb 99.61 rel_ub_b99p6 8 0.00 99.61 FUNCTION_LIST URCMZUL DEPOSIT ABSOLUT IF_DATA DIM_X DIRECT 0x811FC6 /end AXIS_PTS
/begin AXIS_PTS MDV08_UM "Stützstellenverteilung für Moment in der Funktionsüberwachung" 0x817EEE mzmax_um SstAUbSstUb 99.61 rel_ub_b99p6 8 0.00 99.61 FUNCTION_LIST UFMZUL DEPOSIT ABSOLUT IF_DATA DIM_X DIRECT 0x817EEE /end AXIS_PTS
/begin AXIS_PTS NMV08_UC "Stützstellenverteilung für Motordrehzahl im Befehlstest" 0x811E51 nmot_uc SstAUbSstUb 10200. nmot_ub_q40 8 0.00 10200. FUNCTION_LIST URCEINS URCMZUL DEPOSIT ABSOLUT IF_DATA DIM_X DIRECT 0x811E51 /end AXIS_PTS
/begin AXIS_PTS NMV08_UM "Stützstellenverteilung für Motordrehzahl in der Funktionsüberwachung" 0x817D79 nmot_um SstAUbSstUb 10200. nmot_ub_q40 8 0.00 10200. FUNCTION_LIST UFEINS UFMZUL DEPOSIT ABSOLUT IF_DATA DIM_X DIRECT 0x817D79 /end AXIS_PTS
/begin AXIS_PTS NZWV08_UC "" 0x811E5A nmot_uc SstAUbSstUb 10200. nmot_ub_q40 8 0.00 10200. FUNCTION_LIST URCEINS URCMIST DEPOSIT ABSOLUT IF_DATA DIM_X DIRECT 0x811E5A /end AXIS_PTS
/begin AXIS_PTS NZWV08_UM "" 0x817D82 nmot_um SstAUbSstUb 10200. nmot_ub_q40 8 0.00 10200. FUNCTION_LIST UFEINS UFMIST DEPOSIT ABSOLUT IF_DATA DIM_X DIRECT 0x817D82 /end AXIS_PTS
/begin AXIS_PTS RLV08_UC "Stutzstellenverteilung für Lastinfo im Befehlstest" 0x811E63 rl_uc SstAUbSstUb 191.3 rel_ub_q0p75 8 0.00 191.3 FUNCTION_LIST URCEINS URCMIST DEPOSIT ABSOLUT IF_DATA DIM_X DIRECT 0x811E63 /end AXIS_PTS
/begin AXIS_PTS RLV08_UM "Stutzstellenverteilung für Lastinfo in der Funktionsüberwachung" 0x817D8B rl_um SstAUbSstUb 191.3 rel_ub_q0p75 8 0.00 191.3 FUNCTION_LIST UFEINS UFMIST DEPOSIT ABSOLUT IF_DATA DIM_X DIRECT 0x817D8B /end AXIS_PTS
/begin AXIS_PTS SAN12ESUW "SST-Verteilung für den begrenzten Einspritzzähler anztib_w" 0x813590 anztib_w SstAUwSstUw 65535.00 dez 12 0.00 65535.00 FUNCTION_LIST SSTBER87 ESNST DEPOSIT ABSOLUT IF_DATA DIM_X DIRECT 0x813590 /end AXIS_PTS
/begin AXIS_PTS SBF02MFSB "" 0x811C3B bfzglf SstAUbSstSb 55.34 bfzg_sb_q0p217 2 -27.78 27.56 FUNCTION_LIST VMAXMD DEPOSIT ABSOLUT IF_DATA DIM_X DIRECT 0x811C3B /end AXIS_PTS
/begin AXIS_PTS SDK10TEUB "wdkba abhängige Stützstellen (Anzahl 10)" 0x818006 wdkba SstAUbSstUb 100.0 relDK_ub_b100 10 0.00 100.0 FUNCTION_LIST SSTBER87 TEB DEPOSIT ABSOLUT IF_DATA DIM_X DIRECT 0x818006 /end AXIS_PTS
/begin AXIS_PTS SDN06LLSB "Stützstellenvert. Drehzahldifferenz, 10 Sst., LL-Reg." 0x811640 dn SstAUbSstSb 2550. nmotd_sb_q10 6 -1280. 1270. FUNCTION_LIST LLRRM DEPOSIT ABSOLUT IF_DATA DIM_X DIRECT 0x811640 /end AXIS_PTS
/begin AXIS_PTS SDZ03DMUB "SST-Verteilung in DMD, 3 Drehzahl-SST" 0x810292 rl SstAUbSstUb 191.3 rel_ub_q0p75 3 0.00 191.3 FUNCTION_LIST DMDFON DEPOSIT ABSOLUT IF_DATA DIM_X DIRECT 0x810292 /end AXIS_PTS
/begin AXIS_PTS SDZ03DMUB2 "SST-Verteilung in DMD, 3 Drehzahl-SST" 0x810296 rl SstAUbSstUb 191.3 rel_ub_q0p75 3 0.00 191.3 FUNCTION_LIST DMDFON DEPOSIT ABSOLUT IF_DATA DIM_X DIRECT 0x810296 /end AXIS_PTS
/begin AXIS_PTS SDZ08DMUB "SST-Verteilung in DMD, 8 Drehzahl-SST" 0x81029A nmot SstAUbSstUb 10200. nmot_ub_q40 8 0.00 10200. FUNCTION_LIST DMDFON DEPOSIT ABSOLUT IF_DATA DIM_X DIRECT 0x81029A /end AXIS_PTS
/begin AXIS_PTS SDZ08DMUB2 "SST-Verteilung in DMD, 8 Drehzahl-SST" 0x8102A3 nmot SstAUbSstUb 10200. nmot_ub_q40 8 0.00 10200. FUNCTION_LIST DMDFON DEPOSIT ABSOLUT IF_DATA DIM_X DIRECT 0x8102A3 /end AXIS_PTS
/begin AXIS_PTS SEZ06TMUB "Stützstellenverteilung, Zündwinkelwirkungsgrad" 0x818011 etazwimt SstAUbSstUb 127.5 rel_ub_b127p5 6 0.00 127.5 FUNCTION_LIST SSTBER87 ATM DEPOSIT ABSOLUT IF_DATA DIM_X DIRECT 0x818011 /end AXIS_PTS
/begin AXIS_PTS SFR05TEUB "frmit abhängige Stützstellen (Anzahl 5)" 0x818018 frmit SstAUbSstUb 1.992 fak_ub_b2 5 0.00 1.992 FUNCTION_LIST SSTBER87 TEB DEPOSIT ABSOLUT IF_DATA DIM_X DIRECT 0x818018 /end AXIS_PTS
/begin AXIS_PTS SGA06MDUB "Stützstellenverteilung Ist Gang 6 Sst." 0x819F76 gangi SstAUbSstUb 255.0 dez 6 0.00 255.0 FUNCTION_LIST SSTBER87 ARMD DEPOSIT ABSOLUT IF_DATA DIM_X DIRECT 0x819F76 /end AXIS_PTS
/begin AXIS_PTS SGA08MDUB "Stützstellenverteilung Ist Gang 8 Sst." 0x810058 gangi SstAUbSstUb 255.0 dez 8 0.00 255.0 FUNCTION_LIST SSTBER87 DMDSTP MDFAW NMAXMD DEPOSIT ABSOLUT IF_DATA DIM_X DIRECT 0x810058 /end AXIS_PTS
/begin AXIS_PTS SKS06ESUB "SST-Verteilung für den Startadaptionsfaktor kstaa" 0x810061 kstaa SstAUbSstUb 1.992 fak_ub_b2 6 0.00 1.992 FUNCTION_LIST SSTBER87 ESNST DEPOSIT ABSOLUT IF_DATA DIM_X DIRECT 0x810061 /end AXIS_PTS
/begin AXIS_PTS SLD04LDUB "Stützstellenverteilung für Ladedruckregelung" 0x810068 lde SstAUbSstUb 2550. p_sb_q10 4 0.00 2550. FUNCTION_LIST SSTBER87 LDRPID DEPOSIT ABSOLUT IF_DATA DIM_X DIRECT 0x810068 /end AXIS_PTS
/begin AXIS_PTS SLX06TMUW "Stützstellenverteilung, Lambdasoll" 0x819F7E lamsbg_w SstAUwSstUw 15.99976 fak_uw_b16 6 0.00 15.99976 FUNCTION_LIST SSTBER87 ATM DEPOSIT ABSOLUT IF_DATA DIM_X DIRECT 0x819F7E /end AXIS_PTS
/begin AXIS_PTS SLY06TMUW "Stützstellenverteilung, Lambdasoll Bank2" 0x819F8C lamsbg2_w SstAUwSstUw 15.99976 fak_uw_b16 6 0.00 15.99976 FUNCTION_LIST SSTBER87 ATM DEPOSIT ABSOLUT IF_DATA DIM_X DIRECT 0x819F8C /end AXIS_PTS
/begin AXIS_PTS SM108LHSW "dlashk_w abhängige Stützstellen (Anzahl 8)" 0x8135AA dlashkm_w SstASwSstSw 1.999969 fak_sw_b1 8 -1.000000 0.9999695 FUNCTION_LIST SSTBER87 LRSHK DEPOSIT ABSOLUT IF_DATA DIM_X DIRECT 0x8135AA /end AXIS_PTS
/begin AXIS_PTS SM208LHSW "dlashk2_w abhängige Stützstellen (Anzahl 8)" 0x8135BC dlashkm2_w SstASwSstSw 1.999969 fak_sw_b1 8 -1.000000 0.9999695 FUNCTION_LIST SSTBER87 LRSHK DEPOSIT ABSOLUT IF_DATA DIM_X DIRECT 0x8135BC /end AXIS_PTS
/begin AXIS_PTS SMI08LLUB "" 0x8135CE mifa_w SstAUwSstUw 99.99847 rel_uw_b100 8 0.00 99.99847 FUNCTION_LIST SSTBER87 LLRMR DEPOSIT ABSOLUT IF_DATA DIM_X DIRECT 0x8135CE /end AXIS_PTS
/begin AXIS_PTS SMK08MDSW "Antiruckelmoment-abhängige Stützstellen (Anzahl =8)" 0x81DBC4 mkar_w SstASwSstSw 199.9969 rel_sw_b100 8 -100.0000 99.99695 FUNCTION_LIST ARMD DEPOSIT ABSOLUT IF_DATA DIM_X DIRECT 0x81DBC4 /end AXIS_PTS
/begin AXIS_PTS SMK106MDSW "" 0x8135E0 mkfanb_w SstASwSstSw 199.9969 rel_sw_b100 6 -100.0000 99.99695 FUNCTION_LIST SSTBER87 MDFAW DEPOSIT ABSOLUT IF_DATA DIM_X DIRECT 0x8135E0 /end AXIS_PTS
/begin AXIS_PTS SMK206MDSW "" 0x8135EE mkfanb_w SstASwSstSw 199.9969 rel_sw_b100 6 -100.0000 99.99695 FUNCTION_LIST SSTBER87 MDFAW DEPOSIT ABSOLUT IF_DATA DIM_X DIRECT 0x8135EE /end AXIS_PTS
/begin AXIS_PTS SML05DKUB "Stützstellenvert. Luftmasse" 0x81006D ml SstAUbSstUb 1020. m_ub_b1020 5 0.00 1020. FUNCTION_LIST SSTBER87 DKATLRS DEPOSIT ABSOLUT IF_DATA DIM_X DIRECT 0x81006D /end AXIS_PTS
/begin AXIS_PTS SML06TEUB "ml abhängige Stützstellen (Anzahl 6)" 0x818023 ml SstAUbSstUb 1020. m_ub_b1020 6 0.00 1020. FUNCTION_LIST SSTBER87 TEB DEPOSIT ABSOLUT IF_DATA DIM_X DIRECT 0x818023 /end AXIS_PTS
/begin AXIS_PTS SML06TMUB "Stützstellenverteilung, Luftmasse, 6 Stützstellen" 0x81802A ml SstAUbSstUb 1020. m_ub_b1020 6 0.00 1020. FUNCTION_LIST SSTBER87 ATM DEPOSIT ABSOLUT IF_DATA DIM_X DIRECT 0x81802A /end AXIS_PTS
/begin AXIS_PTS SML07TMUW "Stützstellenverteilung, Luftmasse, 7 Stützstellen" 0x819F9A ml_w SstAUwSstUw 6553.500 m_uw_b6553p5 7 0.00 6553.500 FUNCTION_LIST SSTBER87 ATM DEPOSIT ABSOLUT IF_DATA DIM_X DIRECT 0x819F9A /end AXIS_PTS
/begin AXIS_PTS SML08LHUB "ml abhängige Stützstellen (Anzahl 8)" 0x818031 ml SstAUbSstUb 1020. m_ub_b1020 8 0.00 1020. FUNCTION_LIST SSTBER87 LRSHK DEPOSIT ABSOLUT IF_DATA DIM_X DIRECT 0x818031 /end AXIS_PTS
/begin AXIS_PTS SMO08OPUB "Stützstellenverteilung für zulässiges Moment mizuvfil" 0x811C15 mizuvfil SstAUbSstUb 99.61 rel_ub_b99p6 8 0.00 99.61 FUNCTION_LIST MDZUL DEPOSIT ABSOLUT IF_DATA DIM_X DIRECT 0x811C15 /end AXIS_PTS
/begin AXIS_PTS SNM06MDUB "Gruppenstützstelle nmot-Abhängigkeiten" 0x811668 nmot SstAUbSstUb 10200. nmot_ub_q40 6 0.00 10200. FUNCTION_LIST MDVERB DEPOSIT ABSOLUT IF_DATA DIM_X DIRECT 0x811668 /end AXIS_PTS
/begin AXIS_PTS SNM06MDUW "Rover" 0x819FAA nmot_w SstAUwSstUw 16383.75 nmot_uw_q0p25 6 0.00 16383.75 FUNCTION_LIST SSTBER87 MDFAW DEPOSIT ABSOLUT IF_DATA DIM_X DIRECT 0x819FAA /end AXIS_PTS
/begin AXIS_PTS SNM07LSUW "Stützstellenverteilung Reglerparameter LRS" 0x8135FC nmot_w SstAUwSstUw 16383.75 nmot_uw_q0p25 7 0.00 16383.75 FUNCTION_LIST SSTBER87 LRS DEPOSIT ABSOLUT IF_DATA DIM_X DIRECT 0x8135FC /end AXIS_PTS
/begin AXIS_PTS SNM08D2UB "" 0x81008E nmot SstAUbSstUb 10200. nmot_ub_q40 8 0.00 10200. FUNCTION_LIST SSTBER87 DMDDVS DEPOSIT ABSOLUT IF_DATA DIM_X DIRECT 0x81008E /end AXIS_PTS
/begin AXIS_PTS SNM08DMUB "SST-Verteilung in DMD, 8 Drehzahl-SST" 0x810097 nmot SstAUbSstUb 10200. nmot_ub_q40 8 0.00 10200. FUNCTION_LIST SSTBER87 DMDDLU DMDDVS DMDLU DMDLUA DMDMIL DMDSTP DEPOSIT ABSOLUT IF_DATA DIM_X DIRECT 0x810097 /end AXIS_PTS
/begin AXIS_PTS SNM08FEUB "Stützstellenverteilung Drehzahl, 08 Sst., Füllungseingriffe" 0x8100A0 nmot SstAUbSstUb 10200. nmot_ub_q40 8 0.00 10200. FUNCTION_LIST SSTBER87 FUEREG DEPOSIT ABSOLUT IF_DATA DIM_X DIRECT 0x8100A0 /end AXIS_PTS
/begin AXIS_PTS SNM08GKUB "Stützstellenverteilung Gemischkontrolle 8 nmot Stützstellen" 0x818BE2 nmot SstAUbSstUb 10200. nmot_ub_q40 8 0.00 10200. FUNCTION_LIST ESVW DEPOSIT ABSOLUT IF_DATA DIM_X DIRECT 0x818BE2 /end AXIS_PTS
/begin AXIS_PTS SNM08KRUW "Stützstellenverteilung Drehzahl, 8 Sst." 0x819FB8 nmot_w SstAUwSstUw 16383.75 nmot_uw_q0p25 8 0.00 16383.75 FUNCTION_LIST SSTBER87 KRDY DEPOSIT ABSOLUT IF_DATA DIM_X DIRECT 0x819FB8 /end AXIS_PTS
/begin AXIS_PTS SNM08LDUB "Stützstellenverteilung für Ladedruckregelung" 0x8100A9 nmot SstAUbSstUb 10200. nmot_ub_q40 8 0.00 10200. FUNCTION_LIST SSTBER87 LDOB LDRLMX LDRPID DEPOSIT ABSOLUT IF_DATA DIM_X DIRECT 0x8100A9 /end AXIS_PTS
/begin AXIS_PTS SNM08LDUW "Stützstellenverteilung für Ladedruckregelung" 0x81360C nmot_w SstAUwSstUw 16383.75 nmot_uw_q0p25 8 0.00 16383.75 FUNCTION_LIST SSTBER87 LDRLMX LDRPID DEPOSIT ABSOLUT IF_DATA DIM_X DIRECT 0x81360C /end AXIS_PTS
/begin AXIS_PTS SNM08OPUB "Stützstellenverteilung für Motordrehzahl nmot" 0x8100B2 nmot SstAUbSstUb 10200. nmot_ub_q40 8 0.00 10200. FUNCTION_LIST SSTBER87 MDZUL DEPOSIT ABSOLUT IF_DATA DIM_X DIRECT 0x8100B2 /end AXIS_PTS
/begin AXIS_PTS SNM08__UB "Stützstellenverteilung Drehzahl, 8 Sst." 0x8100BB nmot SstAUbSstUb 10200. nmot_ub_q40 8 0.00 10200. FUNCTION_LIST SSTBER87 BBSAWE ZUE DEPOSIT ABSOLUT IF_DATA DIM_X DIRECT 0x8100BB /end AXIS_PTS
/begin AXIS_PTS SNM10LLUB "" 0x8100C4 nmot SstAUbSstUb 10200. nmot_ub_q40 10 0.00 10200. FUNCTION_LIST SSTBER87 LLRMR DEPOSIT ABSOLUT IF_DATA DIM_X DIRECT 0x8100C4 /end AXIS_PTS
/begin AXIS_PTS SNM10LSUB "Stützstellenverteilung Kat-Vorsteuerwert LRS" 0x8100CF nmot SstAUbSstUb 10200. nmot_ub_q40 10 0.00 10200. FUNCTION_LIST SSTBER87 LRS DEPOSIT ABSOLUT IF_DATA DIM_X DIRECT 0x8100CF /end AXIS_PTS
/begin AXIS_PTS SNM10TEUB "nmot abhängige Stützstellen (Anzahl 10)" 0x818043 nmot SstAUbSstUb 10200. nmot_ub_q40 10 0.00 10200. FUNCTION_LIST SSTBER87 TEB DEPOSIT ABSOLUT IF_DATA DIM_X DIRECT 0x818043 /end AXIS_PTS
/begin AXIS_PTS SNM12ESUB2 "" 0x8100DA nmot SstAUbSstUb 10200. nmot_ub_q40 12 0.00 10200. FUNCTION_LIST SSTBER87 ESUK ESWL DEPOSIT ABSOLUT IF_DATA DIM_X DIRECT 0x8100DA /end AXIS_PTS
/begin AXIS_PTS SNM12FEUB "Stützstellen für WDKSMX, WDKUGDN" 0x8100E7 nmot SstAUbSstUb 10200. nmot_ub_q40 12 0.00 10200. FUNCTION_LIST SSTBER87 BGMSZS MDFUE DEPOSIT ABSOLUT IF_DATA DIM_X DIRECT 0x8100E7 /end AXIS_PTS
/begin AXIS_PTS SNM12LDUW "Stützstellenverteilung für Ladedruckregelung" 0x81361E nmot_w SstAUwSstUw 16383.75 nmot_uw_q0p25 12 0.00 16383.75 FUNCTION_LIST SSTBER87 LDRPLS DEPOSIT ABSOLUT IF_DATA DIM_X DIRECT 0x81361E /end AXIS_PTS
/begin AXIS_PTS SNM16CIUB "Stützstellenverteilung Drehzahl, 16 Sst." 0x8100F4 nmot SstAUbSstUb 10200. nmot_ub_q40 16 0.00 10200. FUNCTION_LIST SSTBER87 ACIFI DEPOSIT ABSOLUT IF_DATA DIM_X DIRECT 0x8100F4 /end AXIS_PTS
/begin AXIS_PTS SNM16GKUB "Stützstellenverteilung Gemischkontrolle 16 nmot Stützstellen" 0x81805B nmot SstAUbSstUb 10200. nmot_ub_q40 16 0.00 10200. FUNCTION_LIST SSTBER87 LAMBTS DEPOSIT ABSOLUT IF_DATA DIM_X DIRECT 0x81805B /end AXIS_PTS
/begin AXIS_PTS SNM16KRUB "Stützstellenverteilung Drehzahl, 16 Sst." 0x81806C nmot SstAUbSstUb 10200. nmot_ub_q40 16 0.00 10200. FUNCTION_LIST SSTBER87 DKRS GGKS KRDY KRKE KRRA DEPOSIT ABSOLUT IF_DATA DIM_X DIRECT 0x81806C /end AXIS_PTS
/begin AXIS_PTS SNM16LDUW "Stützstellenverteilung für Ladedruckregelung" 0x813638 nmot_w SstAUwSstUw 16383.75 nmot_uw_q0p25 16 0.00 16383.75 FUNCTION_LIST SSTBER87 LDRPID DEPOSIT ABSOLUT IF_DATA DIM_X DIRECT 0x813638 /end AXIS_PTS
/begin AXIS_PTS SNM16OPUW "Stützstellenverteilung Drehzahl" 0x81365A nmot_w SstAUwSstUw 16383.75 nmot_uw_q0p25 16 0.00 16383.75 FUNCTION_LIST SSTBER87 MDBAS MDMAX DEPOSIT ABSOLUT IF_DATA DIM_X DIRECT 0x81365A /end AXIS_PTS
/begin AXIS_PTS SNM16ZUUB "Stützstellenverteilung Drehzahl, 16 Sst." 0x810116 nmot SstAUbSstUb 10200. nmot_ub_q40 16 0.00 10200. FUNCTION_LIST SSTBER87 ZWMIN DEPOSIT ABSOLUT IF_DATA DIM_X DIRECT 0x810116 /end AXIS_PTS
/begin AXIS_PTS SNM24ZUUB "Stützstellenverteilung Drehzahl, 24 Sst." 0x810127 nmot SstAUbSstUb 10200. nmot_ub_q40 24 0.00 10200. FUNCTION_LIST SSTBER87 ZWGRU DEPOSIT ABSOLUT IF_DATA DIM_X DIRECT 0x810127 /end AXIS_PTS
/begin AXIS_PTS SNS06LLSB "Stützstellenvert., Solldrehzahlabw., 06 Sst., LL-Regel." 0x8115D0 dns SstAUbSstSb 2550. nmotd_sb_q10 6 -1280. 1270. FUNCTION_LIST LLRNS LLRRM DEPOSIT ABSOLUT IF_DATA DIM_X DIRECT 0x8115D0 /end AXIS_PTS
/begin AXIS_PTS SPL08LDUW "Stützstellenverteilung für Ladedruckregelung" 0x819FCA plsol_w SstAUwSstUw 2559.961 p_uw_q0p039 8 0.00 2559.961 FUNCTION_LIST SSTBER87 LDRPID DEPOSIT ABSOLUT IF_DATA DIM_X DIRECT 0x819FCA /end AXIS_PTS
/begin AXIS_PTS SPSNV08_UC "Stützstellenverteilung für Pedalwert im Befehlstest" 0x811E6C spsn_uc SstAUbSstUb 4.9805 spg_ub_q0p019 8 0.00 4.9805 FUNCTION_LIST URCEINS URCMZUL DEPOSIT ABSOLUT IF_DATA DIM_X DIRECT 0x811E6C /end AXIS_PTS
/begin AXIS_PTS SPSNV08_UM "Stützstellenverteilung für Pedalwert in der Funktionsüberwachung" 0x817D94 spsn_um SstAUbSstUb 4.9805 spg_ub_q0p019 8 0.00 4.9805 FUNCTION_LIST UFEINS UFMZUL DEPOSIT ABSOLUT IF_DATA DIM_X DIRECT 0x817D94 /end AXIS_PTS
/begin AXIS_PTS SPU08LDUB "Stützstellenverteilung für Ladedruckregelung" 0x810149 pu SstAUbSstUb 1275. p_ub_q5 8 0.00 1275. FUNCTION_LIST SSTBER87 LDRPID DEPOSIT ABSOLUT IF_DATA DIM_X DIRECT 0x810149 /end AXIS_PTS
/begin AXIS_PTS SQM05TEUB "Luftmassenquotient-abhängige Stützstellen (Anzahl =5)" 0x810152 qmsdyn SstAUbSstUb 15.94 fak_ub_b16 5 0.00 15.94 FUNCTION_LIST SSTBER87 TEB DEPOSIT ABSOLUT IF_DATA DIM_X DIRECT 0x810152 /end AXIS_PTS
/begin AXIS_PTS SRL03MFUW "" 0x81671A rl_w SstAUwSstUw 1535.977 rel_uw_q0p0234 3 0.00 1535.977 FUNCTION_LIST VMAXMD DEPOSIT ABSOLUT IF_DATA DIM_X DIRECT 0x81671A /end AXIS_PTS
/begin AXIS_PTS SRL04KRUB "Stützstellenverteilung relative Füllung, 4 Sst." 0x81807D rl SstAUbSstUb 191.3 rel_ub_q0p75 4 0.00 191.3 FUNCTION_LIST SSTBER87 GGKS DEPOSIT ABSOLUT IF_DATA DIM_X DIRECT 0x81807D /end AXIS_PTS
/begin AXIS_PTS SRL08D2UB "" 0x810163 rl SstAUbSstUb 191.3 rel_ub_q0p75 8 0.00 191.3 FUNCTION_LIST SSTBER87 DMDDVS DEPOSIT ABSOLUT IF_DATA DIM_X DIRECT 0x810163 /end AXIS_PTS
/begin AXIS_PTS SRL08DMUB "SST-Verteilung in DMD, 8 Last-SST" 0x81016C rl SstAUbSstUb 191.3 rel_ub_q0p75 8 0.00 191.3 FUNCTION_LIST SSTBER87 DMDDLU DMDLU DMDLUA DMDSTP DEPOSIT ABSOLUT IF_DATA DIM_X DIRECT 0x81016C /end AXIS_PTS
/begin AXIS_PTS SRL08GKUB "Stützstellenverteilung Gemischkontrolle 8 rl Stützstellen" 0x818BEB rl SstAUbSstUb 191.3 rel_ub_q0p75 8 0.00 191.3 FUNCTION_LIST ESVW DEPOSIT ABSOLUT IF_DATA DIM_X DIRECT 0x818BEB /end AXIS_PTS
/begin AXIS_PTS SRL08LSUW "Stützstellenverteilung Reglerparameter" 0x81367C rl_w SstAUwSstUw 1535.977 rel_uw_q0p0234 8 0.00 1535.977 FUNCTION_LIST SSTBER87 LRS DEPOSIT ABSOLUT IF_DATA DIM_X DIRECT 0x81367C /end AXIS_PTS
/begin AXIS_PTS SRL08NXUB "Stützstellenverteilung relative Luftfüllung 8 Sst." 0x810187 rl SstAUbSstUb 191.3 rel_ub_q0p75 8 0.00 191.3 FUNCTION_LIST SSTBER87 NMAXMD DEPOSIT ABSOLUT IF_DATA DIM_X DIRECT 0x810187 /end AXIS_PTS
/begin AXIS_PTS SRL10LSUB "Stützstellenverteilung Kat-Vorsteuerwert LRS" 0x810190 rl SstAUbSstUb 191.3 rel_ub_q0p75 10 0.00 191.3 FUNCTION_LIST SSTBER87 LRS DEPOSIT ABSOLUT IF_DATA DIM_X DIRECT 0x810190 /end AXIS_PTS
/begin AXIS_PTS SRL11OPUW "Stützstellenverteilung relative Luftfüllung" 0x8162D6 rl_w_kge SstAUwSstUw 1535.977 rel_uw_q0p0234 16 0.00 1535.977 FUNCTION_LIST MDBAS MDMAX DEPOSIT ABSOLUT IF_DATA DIM_X DIRECT 0x8162D6 /end AXIS_PTS
/begin AXIS_PTS SRL12ESUB "Sst-Verteilung für die relative Füllung rl" 0x81019B rl SstAUbSstUb 191.3 rel_ub_q0p75 12 0.00 191.3 FUNCTION_LIST SSTBER87 ESWL DEPOSIT ABSOLUT IF_DATA DIM_X DIRECT 0x81019B /end AXIS_PTS
/begin AXIS_PTS SRL12GKUB "12 Füllungsstützstellen für ?" 0x818082 rl SstAUbSstUb 191.3 rel_ub_q0p75 12 0.00 191.3 FUNCTION_LIST SSTBER87 LAMBTS DEPOSIT ABSOLUT IF_DATA DIM_X DIRECT 0x818082 /end AXIS_PTS
/begin AXIS_PTS SRL12ZUUB "Stützstellenverteilung relative Luftfüllung, 12 St." 0x8101A8 rl SstAUbSstUb 191.3 rel_ub_q0p75 12 0.00 191.3 FUNCTION_LIST SSTBER87 ZWMIN DEPOSIT ABSOLUT IF_DATA DIM_X DIRECT 0x8101A8 /end AXIS_PTS
/begin AXIS_PTS SRL16ZUUB "Stützstellenverteilung relative Füllung, 16 Sst." 0x8101B5 rl SstAUbSstUb 191.3 rel_ub_q0p75 16 0.00 191.3 FUNCTION_LIST SSTBER87 ZWGRU DEPOSIT ABSOLUT IF_DATA DIM_X DIRECT 0x8101B5 /end AXIS_PTS
/begin AXIS_PTS ST107TMUB "Stützstellenverteilung, Starttemperatur an Sonde vorne" 0x81808F tabgmst SstAUbSstUb 1275. temp_ub_q5_o50 7 -50.00 1225. FUNCTION_LIST SSTBER87 ATM DEPOSIT ABSOLUT IF_DATA DIM_X DIRECT 0x81808F /end AXIS_PTS
/begin AXIS_PTS ST207TMUB "Stützstellenverteilung, Starttemperatur an Sonde vorne, Bank2" 0x818097 tabgmst2 SstAUbSstUb 1275. temp_ub_q5_o50 7 -50.00 1225. FUNCTION_LIST SSTBER87 ATM DEPOSIT ABSOLUT IF_DATA DIM_X DIRECT 0x818097 /end AXIS_PTS
/begin AXIS_PTS ST307TMUB "Stützstellenverteilung, Starttemperatur an Sonde hinten" 0x81809F tkatmst SstAUbSstUb 1275. temp_ub_q5_o50 7 -50.00 1225. FUNCTION_LIST SSTBER87 ATM DEPOSIT ABSOLUT IF_DATA DIM_X DIRECT 0x81809F /end AXIS_PTS
/begin AXIS_PTS ST407TMUB "Stützstellenverteilung, Starttemperatur an Sonde hinten, Bank2" 0x8180A7 tkatmst2 SstAUbSstUb 1275. temp_ub_q5_o50 7 -50.00 1225. FUNCTION_LIST SSTBER87 ATM DEPOSIT ABSOLUT IF_DATA DIM_X DIRECT 0x8180A7 /end AXIS_PTS
/begin AXIS_PTS STA06ESUB "SST-Verteilung für die Ansauglufttemperatur" 0x8180AF tans SstAUbSstUb 191.3 temp_ub_q0p75_o48 6 -48.00 143.3 FUNCTION_LIST SSTBER87 ESNST DEPOSIT ABSOLUT IF_DATA DIM_X DIRECT 0x8180AF /end AXIS_PTS
/begin AXIS_PTS STA08LDUB "Stützstellenverteilung für Ladedruckregelung" 0x8101C6 tans SstAUbSstUb 191.3 temp_ub_q0p75_o48 8 -48.00 143.3 FUNCTION_LIST SSTBER87 LDRLMX LDRPID DEPOSIT ABSOLUT IF_DATA DIM_X DIRECT 0x8101C6 /end AXIS_PTS
/begin AXIS_PTS STM04FEUB "Stützstellenverteilung Motortemperatur" 0x8101CF tmot SstAUbSstUb 191.3 temp_ub_q0p75_o48 4 -48.00 143.3 FUNCTION_LIST SSTBER87 MDFUE DEPOSIT ABSOLUT IF_DATA DIM_X DIRECT 0x8101CF /end AXIS_PTS
/begin AXIS_PTS STM05SAUB "Stützstellenverteilung" 0x8180BB tmot SstAUbSstUb 191.3 temp_ub_q0p75_o48 5 -48.00 143.3 FUNCTION_LIST SSTBER87 BBSAWE DEPOSIT ABSOLUT IF_DATA DIM_X DIRECT 0x8180BB /end AXIS_PTS
/begin AXIS_PTS STM05TMUB "Stützstellenverteilung, Motorstarttemperatur" 0x819FDC tmst SstAUwSstUw 49151.25 temp_ub_q0p75_o48 5 -48.00000 49103.25 FUNCTION_LIST SSTBER87 ATM DEPOSIT ABSOLUT IF_DATA DIM_X DIRECT 0x819FDC /end AXIS_PTS
/begin AXIS_PTS STM09ESUB "Stützstellenverteilung Motortemperatur, 9 Sst." 0x8180D8 tmot SstAUbSstUb 191.3 temp_ub_q0p75_o48 9 -48.00 143.3 FUNCTION_LIST SSTBER87 ESUK DEPOSIT ABSOLUT IF_DATA DIM_X DIRECT 0x8180D8 /end AXIS_PTS
/begin AXIS_PTS STM12ESUB "SST-Verteilung für die Motortemperatur tmot" 0x8180E2 tmot SstAUbSstUb 191.3 temp_ub_q0p75_o48 12 -48.00 143.3 FUNCTION_LIST SSTBER87 ESWL LAMKO DEPOSIT ABSOLUT IF_DATA DIM_X DIRECT 0x8180E2 /end AXIS_PTS
/begin AXIS_PTS STS12ESUB "SST-Verteilung für Motorstarttemperatur" 0x8101D9 tmst SstAUbSstUb 191.3 temp_ub_q0p75_o48 12 -48.00 143.3 FUNCTION_LIST SSTBER87 ESNST ESWL DEPOSIT ABSOLUT IF_DATA DIM_X DIRECT 0x8101D9 /end AXIS_PTS
/begin AXIS_PTS STV10LDSW "Stützstellenverteilung für Ladedruckregelung" 0x81DA40 ldtvr_w SstASwSstSw 327.6750 tv_sw_q0p005 10 -163.8400 163.8350 FUNCTION_LIST LDRPID DEPOSIT ABSOLUT IF_DATA DIM_X DIRECT 0x81DA40 /end AXIS_PTS
/begin AXIS_PTS SVP12LDUW "Stützstellenverteilung für vpssplg bei LDR" 0x81368E vpsspu_w SstAUwSstUw 3.999939 fak_uw_b4 12 0.00 3.999939 FUNCTION_LIST SSTBER87 LDRPLS DEPOSIT ABSOLUT IF_DATA DIM_X DIRECT 0x81368E /end AXIS_PTS
/begin AXIS_PTS SWD06KRSW "Stützstellenverteilung DK-Winkel, 6 Sst." 0x819FE8 wdkba_w SstASwSstSw 1599.976 relDK_q0p02441 6 -800.0000 799.9756 FUNCTION_LIST SSTBER87 KRDY DEPOSIT ABSOLUT IF_DATA DIM_X DIRECT 0x819FE8 /end AXIS_PTS
/begin AXIS_PTS SWK08LDUB "Stützstellenverteilung für Ladedruckregelung" 0x8101E6 wkrmstat SstAUbSstUb 191.3 zw_ub_q0p75 8 0.00 191.3 FUNCTION_LIST SSTBER87 LDRLMX DEPOSIT ABSOLUT IF_DATA DIM_X DIRECT 0x8101E6 /end AXIS_PTS
/begin AXIS_PTS SWK108LDUB "Stützstellenverteilung für Ladedruckregelung" 0x8101EF wkrmdy SstAUbSstUb 191.3 zw_ub_q0p75 8 0.00 191.3 FUNCTION_LIST SSTBER87 LDRLMX DEPOSIT ABSOLUT IF_DATA DIM_X DIRECT 0x8101EF /end AXIS_PTS
/begin AXIS_PTS SWK208LDUB "Stützstellenverteilung für Ladedruckregelung" 0x8101F8 wkrmsu SstAUbSstUb 191.3 zw_ub_q0p75 8 0.00 191.3 FUNCTION_LIST SSTBER87 LDRLMX DEPOSIT ABSOLUT IF_DATA DIM_X DIRECT 0x8101F8 /end AXIS_PTS
/begin AXIS_PTS SWP08OPUB "Stützstellenverteilung für Pedalstellung wped" 0x81020A wped SstAUbSstUb 100.0 relPED_ub_b100 8 0.00 100.0 FUNCTION_LIST SSTBER87 MDZUL DEPOSIT ABSOLUT IF_DATA DIM_X DIRECT 0x81020A /end AXIS_PTS
/begin COMPU_METHOD bfzg_sb_q0p217 "" RAT_FUNC "%6.3" "m/s^2" COEFFS 0 1 0 0 0 0.217 /end COMPU_METHOD
/begin COMPU_METHOD dez "1 : 1 Umrechnug (dez/hex)" RAT_FUNC "%6.2" "" COEFFS 0 1 0 0 0 1 /end COMPU_METHOD
/begin COMPU_METHOD dichte_ub_b2 "" RAT_FUNC "%6.4" "kg/m^3" COEFFS 0 256 0 0 0 2 /end COMPU_METHOD
/begin COMPU_METHOD fak1_q1p63Em5 "" RAT_FUNC "%7.6" "[g*K]/hPa" COEFFS 0 61440 0 0 0 1 /end COMPU_METHOD
/begin COMPU_METHOD fak1_q4p3945Em4 "" RAT_FUNC "%6.5" "[kg/h]/g" COEFFS 0 65536 0 0 0 28.8 /end COMPU_METHOD
/begin COMPU_METHOD fak_q0p000244 "" RAT_FUNC "%6.5" "-" COEFFS 0 65536 0 0 0 16 /end COMPU_METHOD
/begin COMPU_METHOD fak_q0p00195 "" RAT_FUNC "%6.4" "-" COEFFS 0 65536 0 0 0 128 /end COMPU_METHOD
/begin COMPU_METHOD fak_q0p0039 "" RAT_FUNC "%6.4" "-" COEFFS 0 256 0 0 0 1 /end COMPU_METHOD
/begin COMPU_METHOD fak_q0p0061 "" RAT_FUNC "%6.4" "" COEFFS 0 255 0 0 0 1.5625 /end COMPU_METHOD
/begin COMPU_METHOD fak_q0p03815 "" RAT_FUNC "%6.4" "%/(s*kg/h)" COEFFS 0 65536 0 0 0 2500 /end COMPU_METHOD
/begin COMPU_METHOD fak_sb_b0p03125 "" RAT_FUNC "%6.5" "-" COEFFS 0 256 0 0 0 0.0625 /end COMPU_METHOD
/begin COMPU_METHOD fak_sb_b0p25 "" RAT_FUNC "%6.4" "-" COEFFS 0 256 0 0 0 0.5 /end COMPU_METHOD
/begin COMPU_METHOD fak_sb_b1 "" RAT_FUNC "%6.4" "-" COEFFS 0 256 0 0 0 2 /end COMPU_METHOD
/begin COMPU_METHOD fak_sb_b2 "" RAT_FUNC "%6.4" "-" COEFFS 0 256 0 0 0 4 /end COMPU_METHOD
/begin COMPU_METHOD fak_sw_b1 "" RAT_FUNC "%7.6" "-" COEFFS 0 65536 0 0 0 2 /end COMPU_METHOD
/begin COMPU_METHOD fak_sw_b2 "" RAT_FUNC "%7.6" "-" COEFFS 0 65536 0 0 0 4 /end COMPU_METHOD
/begin COMPU_METHOD fak_sw_b32 "" RAT_FUNC "%6.5" "-" COEFFS 0 65536 0 0 0 64 /end COMPU_METHOD
/begin COMPU_METHOD fak_sw_b64 "" RAT_FUNC "%6.4" "-" COEFFS 0 65536 0 0 0 128 /end COMPU_METHOD
/begin COMPU_METHOD fak_ub_b0p25 "" RAT_FUNC "%10.7" "-" COEFFS 0 256 0 0 0 0.25 /end COMPU_METHOD
/begin COMPU_METHOD fak_ub_b0p5 "" RAT_FUNC "%6.4" "-" COEFFS 0 256 0 0 0 0.5 /end COMPU_METHOD
/begin COMPU_METHOD fak_ub_b1 "" RAT_FUNC "%6.4" "-" COEFFS 0 256 0 0 0 1 /end COMPU_METHOD
/begin COMPU_METHOD fak_ub_b16 "" RAT_FUNC "%6.4" "-" COEFFS 0 256 0 0 0 16 /end COMPU_METHOD
/begin COMPU_METHOD fak_ub_b1p25_o0p75 "" RAT_FUNC "%6.3" "-" COEFFS 0 1 -0.75 0 0 0.00195313 /end COMPU_METHOD
/begin COMPU_METHOD fak_ub_b2 "" RAT_FUNC "%6.4" "-" COEFFS 0 256 0 0 0 2 /end COMPU_METHOD
/begin COMPU_METHOD fak_ub_b32 "" RAT_FUNC "%6.3" "-" COEFFS 0 256 0 0 0 32 /end COMPU_METHOD
/begin COMPU_METHOD fak_ub_b4 "" RAT_FUNC "%6.4" "-" COEFFS 0 256 0 0 0 4 /end COMPU_METHOD
/begin COMPU_METHOD fak_ub_b8 "" RAT_FUNC "%6.4" "-" COEFFS 0 256 0 0 0 8 /end COMPU_METHOD
/begin COMPU_METHOD fak_ub_q0p01 "" RAT_FUNC "%6.4" "-" COEFFS 0 1 0 0 0 0.01 /end COMPU_METHOD
/begin COMPU_METHOD fak_uw_b1 "" RAT_FUNC "%7.6" "-" COEFFS 0 65536 0 0 0 1 /end COMPU_METHOD
/begin COMPU_METHOD fak_uw_b128 "" RAT_FUNC "%6.4" "-" COEFFS 0 65536 0 0 0 128 /end COMPU_METHOD
/begin COMPU_METHOD fak_uw_b16 "" RAT_FUNC "%6.5" "-" COEFFS 0 65536 0 0 0 16 /end COMPU_METHOD
/begin COMPU_METHOD fak_uw_b2 "" RAT_FUNC "%7.6" "-" COEFFS 0 65536 0 0 0 2 /end COMPU_METHOD
/begin COMPU_METHOD fak_uw_b4 "" RAT_FUNC "%7.6" "-" COEFFS 0 65536 0 0 0 4 /end COMPU_METHOD
/begin COMPU_METHOD fak_uw_b4864 "" RAT_FUNC "%6.4" "-" COEFFS 0 65536 0 0 0 4864 /end COMPU_METHOD
/begin COMPU_METHOD fak_uw_b64 "" RAT_FUNC "%6.5" "-" COEFFS 0 65536 0 0 0 64 /end COMPU_METHOD
/begin COMPU_METHOD fak_uw_b8 "" RAT_FUNC "%6.5" "-" COEFFS 0 65536 0 0 0 8 /end COMPU_METHOD
/begin COMPU_METHOD fak_uw_q0p001 "" RAT_FUNC "%6.5" "" COEFFS 0 65536 0 0 0 65.536 /end COMPU_METHOD
/begin COMPU_METHOD freq_sw_b512 "" RAT_FUNC "%6.4" "1/s" COEFFS 0 65536 0 0 0 1024 /end COMPU_METHOD
/begin COMPU_METHOD freq_ub_b0p05 "" RAT_FUNC "%6.5" "1/s" COEFFS 0 256 0 0 0 0.05 /end COMPU_METHOD
/begin COMPU_METHOD kumsrl_ub_b0p002 "" RAT_FUNC "%10.9" "(kg/h)/(1/min)(%)" COEFFS 0 128000 0 0 0 1 /end COMPU_METHOD
/begin COMPU_METHOD kw_q0p0019 "" RAT_FUNC "%6.4" "°KW" COEFFS 0 512 0 0 0 1 /end COMPU_METHOD
/begin COMPU_METHOD kw_q0p0625 "" RAT_FUNC "%6.4" "°KW" COEFFS 0 16 0 0 0 1 /end COMPU_METHOD
/begin COMPU_METHOD kw_sw_b128 "" RAT_FUNC "%6.4" "°KW" COEFFS 0 65536 0 0 0 256 /end COMPU_METHOD
/begin COMPU_METHOD kw_tooth_sy "" RAT_FUNC "%6.2" "°KW" COEFFS 0 0.166667 0 0 0 1 /end COMPU_METHOD
/begin COMPU_METHOD kw_ub_q0p5 "" RAT_FUNC "%6.3" "°KW" COEFFS 0 256 0 0 0 128 /end COMPU_METHOD
/begin COMPU_METHOD luquant "Umrechnung Laufunruhe in DMD" RAT_FUNC "%6.2" "(Umdr./sec)^2" COEFFS 0 0.549756 0 0 0 1 /end COMPU_METHOD
/begin COMPU_METHOD mgrad_ub_b221p35 "" RAT_FUNC "%6.2" "mg/s" COEFFS 0 230.4 0 0 0 200 /end COMPU_METHOD
/begin COMPU_METHOD mgrad_uw_q0p0961 "" RAT_FUNC "%6.1" "mg/(V*s)" COEFFS 0 9805.82 0 0 0 102000 /end COMPU_METHOD
/begin COMPU_METHOD mk1sxs_ub_b25p6 "" RAT_FUNC "%6.3" "kg/h*s" COEFFS 0 0 256 0 10 0 /end COMPU_METHOD
/begin COMPU_METHOD m_q0p00195 "" RAT_FUNC "%6.4" "kg/(h*s)" COEFFS 0 65536 0 0 0 128 /end COMPU_METHOD
/begin COMPU_METHOD m_q0p00355 "" RAT_FUNC "%6.4" "kg" COEFFS 0 1125 0 0 0 4 /end COMPU_METHOD
/begin COMPU_METHOD m_q0p1 "" RAT_FUNC "%6.3" "kg/h" COEFFS 0 10 0 0 0 1 /end COMPU_METHOD
/begin COMPU_METHOD m_ub_b1020 "" RAT_FUNC "%6.2" "kg/h" COEFFS 0 1 0 0 0 4 /end COMPU_METHOD
/begin COMPU_METHOD m_ub_b221p35 "" RAT_FUNC "%6.2" "mg" COEFFS 0 230.4 0 0 0 200 /end COMPU_METHOD
/begin COMPU_METHOD m_ub_b23p3 "" RAT_FUNC "%6.3" "kg" COEFFS 0 2812.5 0 0 0 256 /end COMPU_METHOD
/begin COMPU_METHOD m_ub_b25p6 "" RAT_FUNC "%6.3" "kg/h" COEFFS 0 256 0 0 0 25.6 /end COMPU_METHOD
/begin COMPU_METHOD m_ub_q0p0444 "" RAT_FUNC "%6.4" "g" COEFFS 0 1 0 0 0 0.0444 /end COMPU_METHOD
/begin COMPU_METHOD m_uw_b23p3 "" RAT_FUNC "%6.5" "kg" COEFFS 0 2812.5 0 0 0 1 /end COMPU_METHOD
/begin COMPU_METHOD m_uw_b4660 "" RAT_FUNC "%6.4" "g" COEFFS 0 3600 0 0 0 256 /end COMPU_METHOD
/begin COMPU_METHOD m_uw_b6553p5 "" RAT_FUNC "%6.3" "kg/h" COEFFS 0 1 0 0 0 0.1 /end COMPU_METHOD
/begin COMPU_METHOD nmotd_sb_q10 "" RAT_FUNC "%6.1" "U/min" COEFFS 0 1 0 0 0 10 /end COMPU_METHOD
/begin COMPU_METHOD nmot_ub_q10 "" RAT_FUNC "%6.1" "U/min" COEFFS 0 1 0 0 0 10 /end COMPU_METHOD
/begin COMPU_METHOD nmot_ub_q40 "" RAT_FUNC "%6.1" "Upm" COEFFS 0 1 0 0 0 40 /end COMPU_METHOD
/begin COMPU_METHOD nmot_uw_q0p25 "" RAT_FUNC "%6.3" "U/min" COEFFS 0 1 0 0 0 0.25 /end COMPU_METHOD
/begin COMPU_METHOD perio_ub_b0p012207 "" RAT_FUNC "%10.8" "1/s" COEFFS 0 256 0 0 0 0.012207 /end COMPU_METHOD
/begin COMPU_METHOD p_sb_q10 "" RAT_FUNC "%6.1" "hPa" COEFFS 0 1 0 0 0 10 /end COMPU_METHOD
/begin COMPU_METHOD p_ub_q10 "" RAT_FUNC "%6.1" "hPa" COEFFS 0 1 0 0 0 10 /end COMPU_METHOD
/begin COMPU_METHOD p_ub_q5 "" RAT_FUNC "%6.2" "hPa" COEFFS 0 1 0 0 0 5 /end COMPU_METHOD
/begin COMPU_METHOD p_uw_q0p039 "" RAT_FUNC "%6.4" "hPa" COEFFS 0 256 0 0 0 10 /end COMPU_METHOD
/begin COMPU_METHOD q_uw_q0p0566 "" RAT_FUNC "%6.4" "kJ" COEFFS 0 65535 0 0 0 3712 /end COMPU_METHOD
/begin COMPU_METHOD relDK_q0p02441 "" RAT_FUNC "%6.4" "% DK" COEFFS 0 65536 0 0 0 1600 /end COMPU_METHOD
/begin COMPU_METHOD relDK_ub_b100 "" RAT_FUNC "%6.3" "% DK" COEFFS 0 255 0 0 0 100 /end COMPU_METHOD
/begin COMPU_METHOD relnmot_q0p02 "" RAT_FUNC "%6.4" "%/(U/min)/s" COEFFS 0 1 0 0 0 0.02 /end COMPU_METHOD
/begin COMPU_METHOD relPED_ub_b100 "" RAT_FUNC "%6.3" "% PED" COEFFS 0 255 0 0 0 100 /end COMPU_METHOD
/begin COMPU_METHOD relPED_uw_b100 "" RAT_FUNC "%6.4" "% PED" COEFFS 0 65535 0 0 0 100 /end COMPU_METHOD
/begin COMPU_METHOD rel_q0p00195 "" RAT_FUNC "%6.4" "%" COEFFS 0 65536 0 0 0 128 /end COMPU_METHOD
/begin COMPU_METHOD rel_q0p002383 "" RAT_FUNC "%6.4" "%/(s*U/min)" COEFFS 0 256 0 0 0 0.61 /end COMPU_METHOD
/begin COMPU_METHOD rel_sb_q0p39 "" RAT_FUNC "%6.3" "%" COEFFS 0 1 0 0 0 0.3906 /end COMPU_METHOD
/begin COMPU_METHOD rel_sb_q0p78 "" RAT_FUNC "%6.3" "%" COEFFS 0 1 0 0 0 0.78 /end COMPU_METHOD
/begin COMPU_METHOD rel_sw_b100 "" RAT_FUNC "%6.4" "%" COEFFS 0 32768 0 0 0 100 /end COMPU_METHOD
/begin COMPU_METHOD rel_sw_q0p0234 "" RAT_FUNC "%6.4" "%/seg" COEFFS 0 32 0 0 0 0.75 /end COMPU_METHOD
/begin COMPU_METHOD rel_ub_b127p5 "" RAT_FUNC "%6.3" "%" COEFFS 0 2 0 0 0 1 /end COMPU_METHOD
/begin COMPU_METHOD rel_ub_b1p0 "" RAT_FUNC "%6.4" "%" COEFFS 0 256 0 0 0 1 /end COMPU_METHOD
/begin COMPU_METHOD rel_ub_b1p4941 "" RAT_FUNC "%6.4" "" COEFFS 0 256 0 0 0 1.5 /end COMPU_METHOD
/begin COMPU_METHOD rel_ub_b24p9 "" RAT_FUNC "%6.3" "%" COEFFS 0 255 0 0 0 24.9 /end COMPU_METHOD
/begin COMPU_METHOD rel_ub_b2p0 "" RAT_FUNC "%6.4" "%" COEFFS 0 256 0 0 0 2 /end COMPU_METHOD
/begin COMPU_METHOD rel_ub_b49p725 "" RAT_FUNC "%6.3" "%" COEFFS 0 255 0 0 0 49.725 /end COMPU_METHOD
/begin COMPU_METHOD rel_ub_b99p6 "" RAT_FUNC "%6.3" "%" COEFFS 0 256 0 0 0 100 /end COMPU_METHOD
/begin COMPU_METHOD rel_ub_q0p75 "" RAT_FUNC "%6.3" "%" COEFFS 0 1 0 0 0 0.75 /end COMPU_METHOD
/begin COMPU_METHOD rel_ub_q8 "" RAT_FUNC "%6.2" "%/s" COEFFS 0 1 0 0 0 8 /end COMPU_METHOD
/begin COMPU_METHOD rel_uw_b0p3 "" RAT_FUNC "%8.7" "%/hPa" COEFFS 0 65536 0 0 0 0.3 /end COMPU_METHOD
/begin COMPU_METHOD rel_uw_b100 "" RAT_FUNC "%6.4" "%" COEFFS 0 65536 0 0 0 100 /end COMPU_METHOD
/begin COMPU_METHOD rel_uw_b200 "" RAT_FUNC "%6.4" "%" COEFFS 0 65536 0 0 0 200 /end COMPU_METHOD
/begin COMPU_METHOD rel_uw_b3200 "" RAT_FUNC "%6.4" "%/(km/h)" COEFFS 0 65536 0 0 0 3200 /end COMPU_METHOD
/begin COMPU_METHOD rel_uw_b3276p75 "" RAT_FUNC "%6.4" "%/100hPa" COEFFS 0 1 0 0 0 0.05 /end COMPU_METHOD
/begin COMPU_METHOD rel_uw_q0p0234 "" RAT_FUNC "%6.4" "%" COEFFS 0 32 0 0 0 0.75 /end COMPU_METHOD
/begin COMPU_METHOD rkti_sy "" RAT_FUNC "%6.4" "ms/%" COEFFS 0 562.5 0 0 0 1 /end COMPU_METHOD
/begin COMPU_METHOD r_q8 "" RAT_FUNC "%6.2" "Ohm" COEFFS 0 1 0 0 0 8 /end COMPU_METHOD
/begin COMPU_METHOD spg_ubatt "" RAT_FUNC "%6.4" "V" COEFFS 0 1 0 0 0 0.076 /end COMPU_METHOD
/begin COMPU_METHOD spg_ub_b1p33 "" RAT_FUNC "%6.4" "V" COEFFS 0 255 0 0 0 1.33 /end COMPU_METHOD
/begin COMPU_METHOD spg_ub_q0p0052_o0p2 "" RAT_FUNC "%6.3" "V" COEFFS 0 255 51 0 0 1.33 /end COMPU_METHOD
/begin COMPU_METHOD spg_ub_q0p019 "" RAT_FUNC "%6.4" "V" COEFFS 0 256 0 0 0 5 /end COMPU_METHOD
/begin COMPU_METHOD spg_uw_q0p00488 "" RAT_FUNC "%6.4" "V" COEFFS 0 1024 0 0 0 5 /end COMPU_METHOD
/begin COMPU_METHOD spg_uw_q0p00488_o1 "" RAT_FUNC "%6.3" "V" COEFFS 0 1024 1024 0 0 5 /end COMPU_METHOD
/begin COMPU_METHOD t100msxs_ub_b25p5 "" RAT_FUNC "%6.3" "s" COEFFS 0 1 0 0 0 0.1 /end COMPU_METHOD
/begin COMPU_METHOD t100msxs_uw_b6553p5 "" RAT_FUNC "%6.3" "s" COEFFS 0 1 0 0 0 0.1 /end COMPU_METHOD
/begin COMPU_METHOD t10msxs_ub_b2p55 "" RAT_FUNC "%6.4" "s" COEFFS 0 1 0 0 0 0.01 /end COMPU_METHOD
/begin COMPU_METHOD t10msxs_uw_b655p35 "" RAT_FUNC "%6.4" "s" COEFFS 0 1 0 0 0 0.01 /end COMPU_METHOD
/begin COMPU_METHOD t1sxs_uw_q1 "" RAT_FUNC "%6.2" "s" COEFFS 0 1 0 0 0 1 /end COMPU_METHOD
/begin COMPU_METHOD t200msxs_ub_b51 "" RAT_FUNC "%6.3" "s" COEFFS 0 1 0 0 0 0.2 /end COMPU_METHOD
/begin COMPU_METHOD t20msxs_ub_b5p1 "" RAT_FUNC "%6.4" "s" COEFFS 0 1 0 0 0 0.02 /end COMPU_METHOD
/begin COMPU_METHOD t40ms_ub_b10200 "" RAT_FUNC "%7.2" "ms" COEFFS 0 1 0 0 0 40 /end COMPU_METHOD
/begin COMPU_METHOD t40usxus_q40 "" RAT_FUNC "%6.1" "us" COEFFS 0 1 0 0 0 40 /end COMPU_METHOD
/begin COMPU_METHOD t500usxms_ub_q0p5 "" RAT_FUNC "%6.3" "ms" COEFFS 0 1 0 0 0 0.5 /end COMPU_METHOD
/begin COMPU_METHOD t5usxus_q5 "" RAT_FUNC "%6.2" "us" COEFFS 0 1 0 0 0 5 /end COMPU_METHOD
/begin COMPU_METHOD t6minxmin_q6 "" RAT_FUNC "%6.2" "min" COEFFS 0 1 0 0 0 6 /end COMPU_METHOD
/begin COMPU_METHOD temp_q5 "" RAT_FUNC "%6.2" "Grad C" COEFFS 0 1 0 0 0 5 /end COMPU_METHOD
/begin COMPU_METHOD temp_sb_b0p093 "" RAT_FUNC "%6.5" "Grad C" COEFFS 0 512 0 0 0 0.375 /end COMPU_METHOD
/begin COMPU_METHOD temp_sw_q0p75 "" RAT_FUNC "%6.3" "Grad C" COEFFS 0 4 0 0 0 3 /end COMPU_METHOD
/begin COMPU_METHOD temp_ub_b191p25 "" RAT_FUNC "%6.3" "Grad C" COEFFS 0 1 0 0 0 0.75 /end COMPU_METHOD
/begin COMPU_METHOD temp_ub_q0p75_o48 "" RAT_FUNC "%6.2" "Grad C" COEFFS 0 1 48 0 0 0.75 /end COMPU_METHOD
/begin COMPU_METHOD temp_ub_q5_o50 "" RAT_FUNC "%6.2" "Grad C" COEFFS 0 1 50 0 0 5 /end COMPU_METHOD
/begin COMPU_METHOD temp_uw_q0p0195_o50 "" RAT_FUNC "%6.2" "Grad C" COEFFS 0 256 12800 0 0 5 /end COMPU_METHOD
/begin COMPU_METHOD tgrad_ub_b99p6 "" RAT_FUNC "%6.3" "ms/s" COEFFS 0 1 0 0 0 0.390625 /end COMPU_METHOD
/begin COMPU_METHOD tv_sw_q0p005 "" RAT_FUNC "%6.4" "%" COEFFS 0 1 0 0 0 0.005 /end COMPU_METHOD
/begin COMPU_METHOD tv_ub_b100 "" RAT_FUNC "%6.3" "%" COEFFS 0 256 0 0 0 100 /end COMPU_METHOD
/begin COMPU_METHOD tv_ub_q0p64 "" RAT_FUNC "%6.3" "%" COEFFS 0 100 0 0 0 64 /end COMPU_METHOD
/begin COMPU_METHOD tv_uw_q0p005 "" RAT_FUNC "%6.4" "%" COEFFS 0 1 0 0 0 0.005 /end COMPU_METHOD
/begin COMPU_METHOD txms_ub_q0p1 "" RAT_FUNC "%6.3" "ms" COEFFS 0 10 0 0 0 1 /end COMPU_METHOD
/begin COMPU_METHOD tz10msxs_uw_b327p68 "" RAT_FUNC "%6.2" "s" COEFFS 0 0 327.68 0 1 0 /end COMPU_METHOD
/begin COMPU_METHOD t_min_q5p96em8 "" RAT_FUNC "%10.9" "Min" COEFFS 0 1 0 0 0 5.96e-008 /end COMPU_METHOD
/begin COMPU_METHOD vfzg_uw_b512 "" RAT_FUNC "%6.4" "km/h" COEFFS 0 65536 0 0 0 512 /end COMPU_METHOD
/begin COMPU_METHOD zk10msxs_ub_b2p55 "" RAT_FUNC "%6.4" "s" COEFFS 0 0 255 0 100 0 /end COMPU_METHOD
/begin COMPU_METHOD zk10msxs_uw_b655 "" RAT_FUNC "%10.4" "s" COEFFS 0 0 65536 0 100 0 /end COMPU_METHOD
/begin COMPU_METHOD zk50msxs_ub_b12p8 "" RAT_FUNC "%10.5" "s" COEFFS 0 0 128 0 10 0 /end COMPU_METHOD
/begin COMPU_METHOD zw_sb_q0p75 "" RAT_FUNC "%6.3" "grad KW" COEFFS 0 255 0 0 0 191.25 /end COMPU_METHOD
/begin COMPU_METHOD zw_ub_q0p75 "" RAT_FUNC "%6.3" "Grad KW" COEFFS 0 255 0 0 0 191.25 /end COMPU_METHOD
/begin COMPU_METHOD zw_ub_q6 "" RAT_FUNC "%6.2" "Grad KW" COEFFS 0 255 0 0 0 1530 /end COMPU_METHOD
/begin COMPU_METHOD zw_ub_qn0p75 "" RAT_FUNC "%6.4" "grad KW" COEFFS 0 1 0 0 0 -0.75 /end COMPU_METHOD
/begin RECORD_LAYOUT FklWSb FNC_VALUES 1 SBYTE COLUMN_DIR DIRECT /end RECORD_LAYOUT
/begin RECORD_LAYOUT FklWUb FNC_VALUES 1 UBYTE COLUMN_DIR DIRECT /end RECORD_LAYOUT
/begin RECORD_LAYOUT FklWUw FNC_VALUES 1 UWORD COLUMN_DIR DIRECT /end RECORD_LAYOUT
/begin RECORD_LAYOUT GkfWSb FNC_VALUES 1 SBYTE COLUMN_DIR DIRECT /end RECORD_LAYOUT
/begin RECORD_LAYOUT GkfWSw FNC_VALUES 1 SWORD COLUMN_DIR DIRECT /end RECORD_LAYOUT
/begin RECORD_LAYOUT GkfWUb FNC_VALUES 1 UBYTE COLUMN_DIR DIRECT /end RECORD_LAYOUT
/begin RECORD_LAYOUT GkfWUw FNC_VALUES 1 UWORD COLUMN_DIR DIRECT /end RECORD_LAYOUT
/begin RECORD_LAYOUT GklWSb FNC_VALUES 1 SBYTE COLUMN_DIR DIRECT /end RECORD_LAYOUT
/begin RECORD_LAYOUT GklWSw FNC_VALUES 1 SWORD COLUMN_DIR DIRECT /end RECORD_LAYOUT
/begin RECORD_LAYOUT GklWUb FNC_VALUES 1 UBYTE COLUMN_DIR DIRECT /end RECORD_LAYOUT
/begin RECORD_LAYOUT GklWUw FNC_VALUES 1 UWORD COLUMN_DIR DIRECT /end RECORD_LAYOUT
/begin RECORD_LAYOUT KfAxUbAyUbSstxSbSstyUbWUb NO_AXIS_PTS_X 1 UBYTE NO_AXIS_PTS_Y 2 UBYTE AXIS_PTS_X 3 SBYTE INDEX_INCR DIRECT AXIS_PTS_Y 4 UBYTE INDEX_INCR DIRECT FNC_VALUES 5 UBYTE COLUMN_DIR DIRECT /end RECORD_LAYOUT
/begin RECORD_LAYOUT KfAxUbAyUbSstxUbSstyUbWSb NO_AXIS_PTS_X 1 UBYTE NO_AXIS_PTS_Y 2 UBYTE AXIS_PTS_X 3 UBYTE INDEX_INCR DIRECT AXIS_PTS_Y 4 UBYTE INDEX_INCR DIRECT FNC_VALUES 5 SBYTE COLUMN_DIR DIRECT /end RECORD_LAYOUT
/begin RECORD_LAYOUT KfAxUbAyUbSstxUbSstyUbWUb NO_AXIS_PTS_X 1 UBYTE NO_AXIS_PTS_Y 2 UBYTE AXIS_PTS_X 3 UBYTE INDEX_INCR DIRECT AXIS_PTS_Y 4 UBYTE INDEX_INCR DIRECT FNC_VALUES 5 UBYTE COLUMN_DIR DIRECT /end RECORD_LAYOUT
/begin RECORD_LAYOUT KfAxUbAyUbSstxUbSstyUwWUb NO_AXIS_PTS_X 1 UBYTE NO_AXIS_PTS_Y 2 UBYTE AXIS_PTS_X 3 UBYTE INDEX_INCR DIRECT AXIS_PTS_Y 4 UWORD INDEX_INCR DIRECT FNC_VALUES 5 UBYTE COLUMN_DIR DIRECT /end RECORD_LAYOUT
/begin RECORD_LAYOUT KfAxUbAyUbSstxUbSstyUwWUw NO_AXIS_PTS_X 1 UBYTE NO_AXIS_PTS_Y 2 UBYTE AXIS_PTS_X 3 UBYTE INDEX_INCR DIRECT AXIS_PTS_Y 4 UWORD INDEX_INCR DIRECT FNC_VALUES 5 UWORD COLUMN_DIR DIRECT /end RECORD_LAYOUT
/begin RECORD_LAYOUT KfAxUbAyUbSstxUwSstyUbWUb NO_AXIS_PTS_X 1 UBYTE NO_AXIS_PTS_Y 2 UBYTE AXIS_PTS_X 3 UWORD INDEX_INCR DIRECT AXIS_PTS_Y 4 UBYTE INDEX_INCR DIRECT FNC_VALUES 5 UBYTE COLUMN_DIR DIRECT /end RECORD_LAYOUT
/begin RECORD_LAYOUT KfAxUwAyUwSstxSwSstyUwWUw NO_AXIS_PTS_X 1 UWORD NO_AXIS_PTS_Y 2 UWORD AXIS_PTS_X 3 SWORD INDEX_INCR DIRECT AXIS_PTS_Y 4 UWORD INDEX_INCR DIRECT FNC_VALUES 5 UWORD COLUMN_DIR DIRECT /end RECORD_LAYOUT
/begin RECORD_LAYOUT KfAxUwAyUwSstxUwSstyUwWSw NO_AXIS_PTS_X 1 UWORD NO_AXIS_PTS_Y 2 UWORD AXIS_PTS_X 3 UWORD INDEX_INCR DIRECT AXIS_PTS_Y 4 UWORD INDEX_INCR DIRECT FNC_VALUES 5 SWORD COLUMN_DIR DIRECT /end RECORD_LAYOUT
/begin RECORD_LAYOUT KfAxUwAyUwSstxUwSstyUwWUw NO_AXIS_PTS_X 1 UWORD NO_AXIS_PTS_Y 2 UWORD AXIS_PTS_X 3 UWORD INDEX_INCR DIRECT AXIS_PTS_Y 4 UWORD INDEX_INCR DIRECT FNC_VALUES 5 UWORD COLUMN_DIR DIRECT /end RECORD_LAYOUT
/begin RECORD_LAYOUT KlAUbSstUbWSb NO_AXIS_PTS_X 1 UBYTE AXIS_PTS_X 2 UBYTE INDEX_INCR DIRECT FNC_VALUES 3 SBYTE COLUMN_DIR DIRECT /end RECORD_LAYOUT
/begin RECORD_LAYOUT KlAUbSstUbWUb NO_AXIS_PTS_X 1 UBYTE AXIS_PTS_X 2 UBYTE INDEX_INCR DIRECT FNC_VALUES 3 UBYTE COLUMN_DIR DIRECT /end RECORD_LAYOUT
/begin RECORD_LAYOUT KlAUbSstUbWUw NO_AXIS_PTS_X 1 UBYTE AXIS_PTS_X 2 UBYTE INDEX_INCR DIRECT FNC_VALUES 3 UWORD COLUMN_DIR DIRECT /end RECORD_LAYOUT
/begin RECORD_LAYOUT KlAUwSstSwWUw NO_AXIS_PTS_X 1 UWORD AXIS_PTS_X 2 SWORD INDEX_INCR DIRECT FNC_VALUES 3 UWORD COLUMN_DIR DIRECT /end RECORD_LAYOUT
/begin RECORD_LAYOUT KlAUwSstUwWUw NO_AXIS_PTS_X 1 UWORD AXIS_PTS_X 2 UWORD INDEX_INCR DIRECT FNC_VALUES 3 UWORD COLUMN_DIR DIRECT /end RECORD_LAYOUT
/begin RECORD_LAYOUT KwSb FNC_VALUES 1 SBYTE COLUMN_DIR DIRECT /end RECORD_LAYOUT
/begin RECORD_LAYOUT KwSw FNC_VALUES 1 SWORD COLUMN_DIR DIRECT /end RECORD_LAYOUT
/begin RECORD_LAYOUT KwUb FNC_VALUES 1 UBYTE COLUMN_DIR DIRECT /end RECORD_LAYOUT
/begin RECORD_LAYOUT KwUw FNC_VALUES 1 UWORD COLUMN_DIR DIRECT /end RECORD_LAYOUT
/begin RECORD_LAYOUT SstASwSstSw NO_AXIS_PTS_X 1 SWORD AXIS_PTS_X 2 SWORD INDEX_INCR DIRECT /end RECORD_LAYOUT
/begin RECORD_LAYOUT SstAUbSstSb NO_AXIS_PTS_X 1 UBYTE AXIS_PTS_X 2 SBYTE INDEX_INCR DIRECT /end RECORD_LAYOUT
/begin RECORD_LAYOUT SstAUbSstUb NO_AXIS_PTS_X 1 UBYTE AXIS_PTS_X 2 UBYTE INDEX_INCR DIRECT /end RECORD_LAYOUT
/begin RECORD_LAYOUT SstAUwSstUw NO_AXIS_PTS_X 1 UWORD AXIS_PTS_X 2 UWORD INDEX_INCR DIRECT /end RECORD_LAYOUT
/end MODULE
/end PROJECT
