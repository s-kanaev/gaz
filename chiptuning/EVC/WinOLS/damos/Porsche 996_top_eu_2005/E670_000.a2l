/begin PROJECT _7804367 "156"
/begin HEADER "" VERSION "_7804367" PROJECT_NO _7804367 /end HEADER
/begin MODULE DIM ""
/begin MOD_COMMON "" BYTE_ORDER BIG_ENDIAN S_REC_LAYOUT DAMOS /end MOD_COMMON
/begin MEASUREMENT B_dsl5e "Diagnose Phase 5: Freigabe Messung" UBYTE B_TRUE 1 100 0 1 BIT_MASK 0x8 FUNCTION_LIST DSLSLRS IF_DATA DIM_X 0x380904 EXTERN BYTE IF_DATA MCMESS 0x380904 EXTERN /end MEASUREMENT
/begin MEASUREMENT B_dsla "Adaptionsphase: Bestimmung Sekundärluftmasse" UWORD B_TRUE 1 100 0 1 BIT_MASK 0x8000 FUNCTION_LIST DSLSLRS BBKHZ LAKH LAMKO LRSEB IF_DATA DIM_X 0xFD00 INTERN BYTE IF_DATA MCMESS 0xFD00 INTERN /end MEASUREMENT
/begin MEASUREMENT B_dslafa "Anfoderung Kurztest oder Adaption in DSLSXXX" UBYTE B_TRUE 1 100 0 1 BIT_MASK 0x1 FUNCTION_LIST LAKH IF_DATA DIM_X 0x380B79 EXTERN BYTE IF_DATA MCMESS 0x380B79 EXTERN /end MEASUREMENT
/begin MEASUREMENT B_dslerr "Zusammenfassung Abbruchmerkmale Sekundärluftdiagnose" UBYTE B_TRUE 1 100 0 1 BIT_MASK 0x8 FUNCTION_LIST DSLSLRS IF_DATA DIM_X 0x380900 EXTERN BYTE IF_DATA MCMESS 0x380900 EXTERN /end MEASUREMENT
/begin MEASUREMENT B_dslfa "Bedingung: Anforderung SL-System für Kurztest" UWORD B_TRUE 1 100 0 1 BIT_MASK 0x1 FUNCTION_LIST DSLSLRS SLS IF_DATA DIM_X 0xFD02 INTERN BYTE IF_DATA MCMESS 0xFD02 INTERN /end MEASUREMENT
/begin MEASUREMENT B_dslm "Diagnose Sekundärluftmasse" UBYTE B_TRUE 1 100 0 1 BIT_MASK 0x10 FUNCTION_LIST DSLSLRS IF_DATA DIM_X 0x380900 EXTERN BYTE IF_DATA MCMESS 0x380900 EXTERN /end MEASUREMENT
/begin MEASUREMENT B_dslmab "Diagnose Sekundärluftmasse, Meßabbruch" UBYTE B_TRUE 1 100 0 1 BIT_MASK 0x20 FUNCTION_LIST DSLSLRS IF_DATA DIM_X 0x380900 EXTERN BYTE IF_DATA MCMESS 0x380900 EXTERN /end MEASUREMENT
/begin MEASUREMENT B_dslme "Diagnose Sekundärluftmasse, Meßfreigabe" UBYTE B_TRUE 1 100 0 1 BIT_MASK 0x40 FUNCTION_LIST DSLSLRS IF_DATA DIM_X 0x380900 EXTERN BYTE IF_DATA MCMESS 0x380900 EXTERN /end MEASUREMENT
/begin MEASUREMENT B_dslmes "Bedingung: Freigabe Meßfenster" UBYTE B_TRUE 1 100 0 1 BIT_MASK 0x80 FUNCTION_LIST DSLSLRS IF_DATA DIM_X 0x380900 EXTERN BYTE IF_DATA MCMESS 0x380900 EXTERN /end MEASUREMENT
/begin MEASUREMENT B_dslo "Diagnose Sekundärluftmassenoffset" UBYTE B_TRUE 1 100 0 1 BIT_MASK 0x1 FUNCTION_LIST DSLSLRS IF_DATA DIM_X 0x380901 EXTERN BYTE IF_DATA MCMESS 0x380901 EXTERN /end MEASUREMENT
/begin MEASUREMENT B_dsloab "Diagnose Sekundärluftoffset, Meßabbruch" UBYTE B_TRUE 1 100 0 1 BIT_MASK 0x2 FUNCTION_LIST DSLSLRS IF_DATA DIM_X 0x380901 EXTERN BYTE IF_DATA MCMESS 0x380901 EXTERN /end MEASUREMENT
/begin MEASUREMENT B_dsloe "Diagnose Sekundärluftoffset, Meßfreigabe" UBYTE B_TRUE 1 100 0 1 BIT_MASK 0x4 FUNCTION_LIST DSLSLRS IF_DATA DIM_X 0x380901 EXTERN BYTE IF_DATA MCMESS 0x380901 EXTERN /end MEASUREMENT
/begin MEASUREMENT B_dslp4 "Bedingung  Phase 4 mindestens einmal eingeleitet" UBYTE B_TRUE 1 100 0 1 BIT_MASK 0x8 FUNCTION_LIST DSLSLRS IF_DATA DIM_X 0x380901 EXTERN BYTE IF_DATA MCMESS 0x380901 EXTERN /end MEASUREMENT
/begin MEASUREMENT B_dslp42 "Bedingung  Phase 4 mindestens einmal eingeleitet" UBYTE B_TRUE 1 100 0 1 BIT_MASK 0x1 FUNCTION_LIST DSLSLRS IF_DATA DIM_X 0x380907 EXTERN BYTE IF_DATA MCMESS 0x380907 EXTERN /end MEASUREMENT
/begin MEASUREMENT B_dslreset "Bedingung: Zurücksetzen Sekundärluftadaption/Kurztest" UBYTE B_TRUE 1 100 0 1 BIT_MASK 0x2 FUNCTION_LIST SLS IF_DATA DIM_X 0x380920 EXTERN BYTE IF_DATA MCMESS 0x380920 EXTERN /end MEASUREMENT
/begin MEASUREMENT B_dsls "Aktive Diagnose: Sekundärluft-System" UWORD B_TRUE 1 100 0 1 BIT_MASK 0x2 FUNCTION_LIST DSLSLRS BBSAWE DKATLRS DLLR DLSAHK DLSH DLSU DTEV LRAEB T2DFA TEBEB IF_DATA DIM_X 0xFD02 INTERN BYTE IF_DATA MCMESS 0xFD02 INTERN /end MEASUREMENT
/begin MEASUREMENT B_dslset "Bedingung: Setzen Sekundärluftadaption/Kurztest" UBYTE B_TRUE 1 100 0 1 BIT_MASK 0x1 FUNCTION_LIST SLS IF_DATA DIM_X 0x380920 EXTERN BYTE IF_DATA MCMESS 0x380920 EXTERN /end MEASUREMENT
/begin MEASUREMENT B_dslsk "Bedingung Diagnose Sekundärluftsystem für Kurztest" UWORD B_TRUE 1 100 0 1 BIT_MASK 0x1000 FUNCTION_LIST SWADP LRSEB IF_DATA DIM_X 0xFD82 INTERN BYTE IF_DATA MCMESS 0xFD82 INTERN /end MEASUREMENT
/begin MEASUREMENT B_dslsp4 "Bedingung: Anforderung SL-System für Sekundärluftadaption/Zusatzdiagnose" UWORD B_TRUE 1 100 0 1 BIT_MASK 0x4 FUNCTION_LIST DSLSLRS SLS IF_DATA DIM_X 0xFD02 INTERN BYTE IF_DATA MCMESS 0xFD02 INTERN /end MEASUREMENT
/begin MEASUREMENT B_dsltab "Diagnose Ventilichtheit, Meßabbruch" UBYTE B_TRUE 1 100 0 1 BIT_MASK 0x80 FUNCTION_LIST DSLSLRS IF_DATA DIM_X 0x380901 EXTERN BYTE IF_DATA MCMESS 0x380901 EXTERN /end MEASUREMENT
/begin MEASUREMENT B_dslte "Diagnose Ventildichtheit, Meßfreigabe" UBYTE B_TRUE 1 100 0 1 BIT_MASK 0x2 FUNCTION_LIST DSLSLRS IF_DATA DIM_X 0x380902 EXTERN BYTE IF_DATA MCMESS 0x380902 EXTERN /end MEASUREMENT
/begin MEASUREMENT B_dslvh "Bedingung Ladedrucksensor vorhanden" UWORD B_TRUE 1 100 0 1 BIT_MASK 0x2000 FUNCTION_LIST PROKON BGMSZS IF_DATA DIM_X 0xFD72 INTERN BYTE IF_DATA MCMESS 0xFD72 INTERN /end MEASUREMENT
/begin MEASUREMENT B_dspe "Bedingung Diagnose Sekundärluft ein" UWORD B_TRUE 1 100 0 1 BIT_MASK 0x8 FUNCTION_LIST DSLSLRS SLS IF_DATA DIM_X 0xFD02 INTERN BYTE IF_DATA MCMESS 0xFD02 INTERN /end MEASUREMENT
/begin MEASUREMENT B_dsper "Bedingung Rücksetzen ESP ein" UBYTE B_TRUE 1 100 0 1 BIT_MASK 0x4 FUNCTION_LIST DSLSLRS IF_DATA DIM_X 0x380902 EXTERN BYTE IF_DATA MCMESS 0x380902 EXTERN /end MEASUREMENT
/begin MEASUREMENT B_dspes "Bedingung Setzen ESP ein" UBYTE B_TRUE 1 100 0 1 BIT_MASK 0x8 FUNCTION_LIST DSLSLRS IF_DATA DIM_X 0x380902 EXTERN BYTE IF_DATA MCMESS 0x380902 EXTERN /end MEASUREMENT
/begin MEASUREMENT B_dssv "Bedingung Saugrohr-Drucksensor vorhanden als Hauptlastsensor" UWORD B_TRUE 1 100 0 1 BIT_MASK 0x4000 FUNCTION_LIST PROKON BGMSZS IF_DATA DIM_X 0xFD72 INTERN BYTE IF_DATA MCMESS 0xFD72 INTERN /end MEASUREMENT
/begin MEASUREMENT B_dsuv "Umgebungsdrucksensor ist vorhanden" UWORD B_TRUE 1 100 0 1 BIT_MASK 0x8000 FUNCTION_LIST PROKON BGMSZS DHFM IF_DATA DIM_X 0xFD72 INTERN BYTE IF_DATA MCMESS 0xFD72 INTERN /end MEASUREMENT
/begin MEASUREMENT B_dteaa "Bedingung Aufsteuerprüfung für TEV Diagnose aktiv" UWORD B_TRUE 1 100 0 1 BIT_MASK 0x800 FUNCTION_LIST DTEV BGTEV TEBEB IF_DATA DIM_X 0xFD88 INTERN BYTE IF_DATA MCMESS 0xFD88 INTERN /end MEASUREMENT
/begin MEASUREMENT B_dteaab "Bedingung DTEV-Abbruch wegen Verlassen Aktivierungsbedingungen" UWORD B_TRUE 1 100 0 1 BIT_MASK 0x1000 FUNCTION_LIST DTEV IF_DATA DIM_X 0xFD88 INTERN BYTE IF_DATA MCMESS 0xFD88 INTERN /end MEASUREMENT
/begin MEASUREMENT B_dteaam "Bedingung Aufsteuerprüfung für TEV Diagnose aktiv möglich" UWORD B_TRUE 1 100 0 1 BIT_MASK 0x2000 FUNCTION_LIST DTEV LLRRM IF_DATA DIM_X 0xFD88 INTERN BYTE IF_DATA MCMESS 0xFD88 INTERN /end MEASUREMENT
/begin MEASUREMENT B_dteabu "Bedingung Abbruch TE Diagnose ohne Prüfergebnis" UWORD B_TRUE 1 100 0 1 BIT_MASK 0x4000 FUNCTION_LIST DTEV T2DFA IF_DATA DIM_X 0xFD88 INTERN BYTE IF_DATA MCMESS 0xFD88 INTERN /end MEASUREMENT
/begin MEASUREMENT B_dteanfl "abgelaufene Zeit ab die, das Tastverhälnis aus DTEV größer Schwelle" UWORD B_TRUE 1 100 0 1 BIT_MASK 0x8000 FUNCTION_LIST DTEV IF_DATA DIM_X 0xFD88 INTERN BYTE IF_DATA MCMESS 0xFD88 INTERN /end MEASUREMENT
/begin MEASUREMENT B_dteend "Bedingung Diagnose TEV erfolgreich zu Ende" UWORD B_TRUE 1 100 0 1 BIT_MASK 0x1 FUNCTION_LIST DTEV IF_DATA DIM_X 0xFD8A INTERN BYTE IF_DATA MCMESS 0xFD8A INTERN /end MEASUREMENT
/begin MEASUREMENT B_dteendl "Bedingung Diagnose TEV über Luftprüfung erfolgreich zu Ende" UWORD B_TRUE 1 100 0 1 BIT_MASK 0x2 FUNCTION_LIST DTEV IF_DATA DIM_X 0xFD8A INTERN BYTE IF_DATA MCMESS 0xFD8A INTERN /end MEASUREMENT
/begin MEASUREMENT B_dteenf "Bedingung Diagnose TEV wegen System-Error nicht freigegeben" UWORD B_TRUE 1 100 0 1 BIT_MASK 0x4 FUNCTION_LIST DTEV IF_DATA DIM_X 0xFD8A INTERN BYTE IF_DATA MCMESS 0xFD8A INTERN /end MEASUREMENT
/begin MEASUREMENT B_dtefre "Bedingung fr für Diagnose TEV eingeschwungen." UWORD B_TRUE 1 100 0 1 BIT_MASK 0x8 FUNCTION_LIST DTEV IF_DATA DIM_X 0xFD8A INTERN BYTE IF_DATA MCMESS 0xFD8A INTERN /end MEASUREMENT
/begin MEASUREMENT B_dtefrr "Bedingung Lambdareglerreset bei Tankentlüftungsdiagnose" UWORD B_TRUE 1 100 0 1 BIT_MASK 0x10 FUNCTION_LIST DTEV LRSINI IF_DATA DIM_X 0xFD8A INTERN BYTE IF_DATA MCMESS 0xFD8A INTERN /end MEASUREMENT
/begin MEASUREMENT B_dtelab "Bedingung DTEV-Abbruch wegen Störung Leerlaufluftprüfung" UWORD B_TRUE 1 100 0 1 BIT_MASK 0x20 FUNCTION_LIST DTEV IF_DATA DIM_X 0xFD8A INTERN BYTE IF_DATA MCMESS 0xFD8A INTERN /end MEASUREMENT
/begin MEASUREMENT B_dtelbm "Bedingung Bewertung des Lambda Reglers bei Diagnose TEV möglich" UWORD B_TRUE 1 100 0 1 BIT_MASK 0x40 FUNCTION_LIST DTEV IF_DATA DIM_X 0xFD8A INTERN BYTE IF_DATA MCMESS 0xFD8A INTERN /end MEASUREMENT
/begin MEASUREMENT B_dtelbr "Bedingung Reset Flip-Flop Passiv-Prüfung DTEV möglich" UWORD B_TRUE 1 100 0 1 BIT_MASK 0x80 FUNCTION_LIST DTEV IF_DATA DIM_X 0xFD8A INTERN BYTE IF_DATA MCMESS 0xFD8A INTERN /end MEASUREMENT
/begin MEASUREMENT B_dtelnm "LL-Prüfung Diagnose TEV nicht möglich" UWORD B_TRUE 1 100 0 1 BIT_MASK 0x100 FUNCTION_LIST DTEV IF_DATA DIM_X 0xFD8A INTERN BYTE IF_DATA MCMESS 0xFD8A INTERN /end MEASUREMENT
/begin MEASUREMENT B_dtelnmb "Bestätigt : LL-Prüfung Diagnose TEV nicht möglich" UWORD B_TRUE 1 100 0 1 BIT_MASK 0x200 FUNCTION_LIST DTEV IF_DATA DIM_X 0xFD8A INTERN BYTE IF_DATA MCMESS 0xFD8A INTERN /end MEASUREMENT
/begin MEASUREMENT B_dtelnmv "Vorbehalt: LL-Prüfung Diagnose TEV nicht möglich" UWORD B_TRUE 1 100 0 1 BIT_MASK 0x400 FUNCTION_LIST DTEV IF_DATA DIM_X 0xFD8A INTERN BYTE IF_DATA MCMESS 0xFD8A INTERN /end MEASUREMENT
/begin MEASUREMENT B_dtenam "Bedingung TEV Diagnose nur über Aufsteuerprüfung möglich" UWORD B_TRUE 1 100 0 1 BIT_MASK 0x800 FUNCTION_LIST DTEV IF_DATA DIM_X 0xFD8A INTERN BYTE IF_DATA MCMESS 0xFD8A INTERN /end MEASUREMENT
/begin MEASUREMENT B_dtephm "Bedingung physikalische Freigabe DTEV" UWORD B_TRUE 1 100 0 1 BIT_MASK 0x1000 FUNCTION_LIST DTEV IF_DATA DIM_X 0xFD8A INTERN BYTE IF_DATA MCMESS 0xFD8A INTERN /end MEASUREMENT
/begin MEASUREMENT B_dtepm "Bedingung passive TEV Diagnose möglich" UWORD B_TRUE 1 100 0 1 BIT_MASK 0x2000 FUNCTION_LIST DTEV IF_DATA DIM_X 0xFD8A INTERN BYTE IF_DATA MCMESS 0xFD8A INTERN /end MEASUREMENT
/begin MEASUREMENT B_dterab "Bedingung DTEV-Abbruch wegen Abweichung Lambdaregler zur groß" UWORD B_TRUE 1 100 0 1 BIT_MASK 0x4000 FUNCTION_LIST DTEV IF_DATA DIM_X 0xFD8A INTERN BYTE IF_DATA MCMESS 0xFD8A INTERN /end MEASUREMENT
/begin MEASUREMENT B_dterap "Bedingung DTEV Reset durch Applikation" UWORD B_TRUE 1 100 0 1 BIT_MASK 0x8000 FUNCTION_LIST DTEV IF_DATA DIM_X 0xFD8A INTERN BYTE IF_DATA MCMESS 0xFD8A INTERN /end MEASUREMENT
/begin MEASUREMENT B_dteres "Bedingung TEV Diagnose Reset" UWORD B_TRUE 1 100 0 1 BIT_MASK 0x1 FUNCTION_LIST DTEV IF_DATA DIM_X 0xFD8C INTERN BYTE IF_DATA MCMESS 0xFD8C INTERN /end MEASUREMENT
/begin MEASUREMENT B_dternm "Bedingung kein fr-Hub für Diagnose TEV vorhanden" UWORD B_TRUE 1 100 0 1 BIT_MASK 0x2 FUNCTION_LIST DTEV IF_DATA DIM_X 0xFD8C INTERN BYTE IF_DATA MCMESS 0xFD8C INTERN /end MEASUREMENT
/begin MEASUREMENT B_dtes "Aktive Diagnose: Tankentlüftungssystem" UWORD B_TRUE 1 100 0 1 BIT_MASK 0x4 FUNCTION_LIST DTEV ATEV BBTEGA DKATLRS DLLR DLSH MDVERAD T2DFA IF_DATA DIM_X 0xFD8C INTERN BYTE IF_DATA MCMESS 0xFD8C INTERN /end MEASUREMENT
/begin MEASUREMENT B_dtest "Start für TEV-Ansteuerung" UWORD B_TRUE 1 100 0 1 BIT_MASK 0x8 FUNCTION_LIST DTEV DLSAHK LLRRM LRAEB IF_DATA DIM_X 0xFD8C INTERN BYTE IF_DATA MCMESS 0xFD8C INTERN /end MEASUREMENT
/begin MEASUREMENT B_dtezam "Bedingung Diagnose TEV für Zusteuer-/Aufsteuerprüfung ist möglich" UWORD B_TRUE 1 100 0 1 BIT_MASK 0x10 FUNCTION_LIST DTEV IF_DATA DIM_X 0xFD8C INTERN BYTE IF_DATA MCMESS 0xFD8C INTERN /end MEASUREMENT
/begin MEASUREMENT B_dtp "Aktive Diagnose: Klopfregelung Testimpuls" UWORD B_TRUE 1 100 0 1 BIT_MASK 0x1 FUNCTION_LIST GGKS DKRTP KRKE IF_DATA DIM_X 0xFD62 INTERN BYTE IF_DATA MCMESS 0xFD62 INTERN /end MEASUREMENT
/begin MEASUREMENT B_dtpb "Bedingung Diagnose: Bereitschaft zum Testpuls (Testpuls im nächsten MF)" UWORD B_TRUE 1 100 0 1 BIT_MASK 0x2 FUNCTION_LIST GGKS KRKE IF_DATA DIM_X 0xFD62 INTERN BYTE IF_DATA MCMESS 0xFD62 INTERN /end MEASUREMENT
/begin MEASUREMENT B_dupw "Bedingung Abweichung zwischen Poti 1 und 2 zu groß" UWORD B_TRUE 1 100 0 1 BIT_MASK 0x4 FUNCTION_LIST GGPED IF_DATA DIM_X 0x381EBC EXTERN BYTE IF_DATA MCMESS 0x381EBC EXTERN /end MEASUREMENT
/begin MEASUREMENT B_dupw12 "Bedingung zulässige Abweichung zwischen PWG-Poti 1 und 2 überschritten" UWORD B_TRUE 1 100 0 1 BIT_MASK 0x8 FUNCTION_LIST GGPED IF_DATA DIM_X 0x381EBC EXTERN BYTE IF_DATA MCMESS 0x381EBC EXTERN /end MEASUREMENT
/begin MEASUREMENT B_dushsch "Bed. Schwelle für Sonde h. KAT im Schub nicht unterschritten `dynamisch`" UWORD B_TRUE 1 100 0 1 BIT_MASK 0x4 FUNCTION_LIST DLSAHK IF_DATA DIM_X 0xFD24 INTERN BYTE IF_DATA MCMESS 0xFD24 INTERN /end MEASUREMENT
/begin MEASUREMENT B_dushsch2 "Bed. Schwelle für Sonde h. KAT im Schub nicht unterschritten `dynamisch` Bank2" UWORD B_TRUE 1 100 0 1 BIT_MASK 0x8 FUNCTION_LIST DLSAHK IF_DATA DIM_X 0xFD24 INTERN BYTE IF_DATA MCMESS 0xFD24 INTERN /end MEASUREMENT
/begin MEASUREMENT B_dveada "Bedingung: DV-E-Adaption sperrt Einspritzung" UWORD B_TRUE 1 100 0 1 BIT_MASK 0x1000 FUNCTION_LIST BGDVE AEVABZK IF_DATA DIM_X 0xFD34 INTERN BYTE IF_DATA MCMESS 0xFD34 INTERN /end MEASUREMENT
/begin MEASUREMENT B_dveese "Bedingung: DV-E-Endstufen-Fehler" UWORD B_TRUE 1 100 0 1 BIT_MASK 0x200 FUNCTION_LIST ADVE DDVE IF_DATA DIM_X 0xFD32 INTERN BYTE IF_DATA MCMESS 0xFD32 INTERN /end MEASUREMENT
/begin MEASUREMENT B_dveesh "Bedingung: DV-E-Enstufen-Heilung" UWORD B_TRUE 1 100 0 1 BIT_MASK 0x400 FUNCTION_LIST ADVE IF_DATA DIM_X 0xFD32 INTERN BYTE IF_DATA MCMESS 0xFD32 INTERN /end MEASUREMENT
/begin MEASUREMENT B_dveeson "Bedingung: DV-E-Endstufe ist eingeschaltet = P_dveeson" UWORD B_TRUE 1 100 0 1 BIT_MASK 0x8000 FUNCTION_LIST VHW ADVE IF_DATA DIM_X 0xFD5C INTERN BYTE IF_DATA MCMESS 0xFD5C INTERN /end MEASUREMENT
/begin MEASUREMENT B_dvete "Bedingung: Erweiterte Stellertauscherkennung" UWORD B_TRUE 1 100 0 1 BIT_MASK 0x800 FUNCTION_LIST ADVE BGDVE IF_DATA DIM_X 0xFD32 INTERN BYTE IF_DATA MCMESS 0xFD32 INTERN /end MEASUREMENT
/begin MEASUREMENT B_dvetv "Bedingung: Verriegelungsbit erweiterte Stellertauscherkennung" UWORD B_TRUE 1 100 0 1 BIT_MASK 0x2000 FUNCTION_LIST BGDVE IF_DATA DIM_X 0xFD34 INTERN BYTE IF_DATA MCMESS 0xFD34 INTERN /end MEASUREMENT
/begin MEASUREMENT B_dvs "Aktive Diagnose: Ventilhubsteuerung" UWORD B_TRUE 1 100 0 1 BIT_MASK 0x4000 FUNCTION_LIST DVS DMDDVS T2LID IF_DATA DIM_X 0xFD8C INTERN BYTE IF_DATA MCMESS 0xFD8C INTERN /end MEASUREMENT
/begin MEASUREMENT B_dvsdlurs "Aussetzererkennung über dluts durch Diagnose Ventilhubsteuerung unterbrochen" UWORD B_TRUE 1 100 0 1 BIT_MASK 0x8000 FUNCTION_LIST DVS T2LID IF_DATA DIM_X 0xFD8C INTERN BYTE IF_DATA MCMESS 0xFD8C INTERN /end MEASUREMENT
/begin MEASUREMENT B_dvsend "Bedingung Fehlereintrag bei Ventilhubfehler" UBYTE B_TRUE 1 100 0 1 BIT_MASK 0x2 FUNCTION_LIST DVS T2LID IF_DATA DIM_X 0x380CDB EXTERN BYTE IF_DATA MCMESS 0x380CDB EXTERN /end MEASUREMENT
/begin MEASUREMENT B_dvsstop "Diagnose Ventilhubsteuerung gesperrt" UWORD B_TRUE 1 100 0 1 BIT_MASK 0x2000 FUNCTION_LIST DMDSTP DVS IF_DATA DIM_X 0xFD98 INTERN WORD IF_DATA MCMESS 0xFD98 INTERN /end MEASUREMENT
/begin MEASUREMENT B_dylash "Bedingung Sonde hinter KAT dynamisch langsam `statisch`" UBYTE B_TRUE 1 100 0 1 BIT_MASK 0x1 FUNCTION_LIST DLSAHK IF_DATA DIM_X 0x382FF1 EXTERN BYTE IF_DATA MCMESS 0x382FF1 EXTERN /end MEASUREMENT
/begin MEASUREMENT B_dylash2 "Bedingung Sonde hinter KAT dynamisch langsam `statisch` Bank2" UBYTE B_TRUE 1 100 0 1 BIT_MASK 0x2 FUNCTION_LIST DLSAHK IF_DATA DIM_X 0x382FF1 EXTERN BYTE IF_DATA MCMESS 0x382FF1 EXTERN /end MEASUREMENT
/begin MEASUREMENT B_dylsu "Dynamik LSU geprüft" UWORD B_TRUE 1 100 0 1 BIT_MASK 0x8 FUNCTION_LIST DLSU IF_DATA DIM_X 0xFD2A INTERN BYTE IF_DATA MCMESS 0xFD2A INTERN /end MEASUREMENT
/begin MEASUREMENT B_dylsu2 "Dynamik LSU2 geprüft" UWORD B_TRUE 1 100 0 1 BIT_MASK 0x10 FUNCTION_LIST DLSU IF_DATA DIM_X 0xFD2A INTERN BYTE IF_DATA MCMESS 0xFD2A INTERN /end MEASUREMENT
/begin MEASUREMENT B_dylsuav "Dynamiküberwachung LSU aktiv" UWORD B_TRUE 1 100 0 1 BIT_MASK 0x20 FUNCTION_LIST DLSU T2DFA IF_DATA DIM_X 0xFD2A INTERN BYTE IF_DATA MCMESS 0xFD2A INTERN /end MEASUREMENT
/begin MEASUREMENT B_dylsuav2 "Dynamiküberwachung LSU2 aktiv" UWORD B_TRUE 1 100 0 1 BIT_MASK 0x40 FUNCTION_LIST DLSU T2DFA IF_DATA DIM_X 0xFD2A INTERN BYTE IF_DATA MCMESS 0xFD2A INTERN /end MEASUREMENT
/begin MEASUREMENT B_dza "Bedingung Drehzahlanhebung durch die Ladebilanz der Batterie" UWORD B_TRUE 1 100 0 1 BIT_MASK 0x4000 FUNCTION_LIST CAN IF_DATA DIM_X 0xFD06 INTERN BYTE IF_DATA MCMESS 0xFD06 INTERN /end MEASUREMENT
/begin MEASUREMENT B_dzai "Bedingung doppelte Zündausgabe interne Anforderung" UWORD B_TRUE 1 100 0 1 BIT_MASK 0x4 FUNCTION_LIST AZUE IF_DATA DIM_X 0xFD00 INTERN BYTE IF_DATA MCMESS 0xFD00 INTERN /end MEASUREMENT
/begin MEASUREMENT B_ebmdbgv "Bedingung Eingangsbedingungen für geschw.-abh. Momentenaufbaubegrenzung erfüllt." UWORD B_TRUE 1 100 0 1 BIT_MASK 0x80 FUNCTION_LIST MDBGV IF_DATA DIM_X 0xFD6C INTERN BYTE IF_DATA MCMESS 0xFD6C INTERN /end MEASUREMENT
/begin MEASUREMENT B_ecfuka "Bedingung ÜK-Adaptionsfaktor berechnen erlaubt" UWORD B_TRUE 1 100 0 1 BIT_MASK 0x40 FUNCTION_LIST ESUKAS IF_DATA DIM_X 0xFD56 INTERN BYTE IF_DATA MCMESS 0xFD56 INTERN /end MEASUREMENT
/begin MEASUREMENT B_ecfuka2 "Bedingung ÜK-Adaptionsfaktor berechnen erlaubt (Bank 2)" UWORD B_TRUE 1 100 0 1 BIT_MASK 0x80 FUNCTION_LIST ESUKAS IF_DATA DIM_X 0xFD56 INTERN BYTE IF_DATA MCMESS 0xFD56 INTERN /end MEASUREMENT
/begin MEASUREMENT B_eculock "Verriegelungsanforderung Wegfahrsperre" UWORD B_TRUE 1 100 0 1 BIT_MASK 0x400 FUNCTION_LIST IMS VHW IF_DATA DIM_X 0xFD5E INTERN BYTE IF_DATA MCMESS 0xFD5E INTERN /end MEASUREMENT
/begin MEASUREMENT B_edks "Bedingung Fehler Drosselklappen-Sensor" UWORD B_TRUE 1 100 0 1 BIT_MASK 0x4 FUNCTION_LIST GGDVE DHFM IF_DATA DIM_X 0xFD3A INTERN BYTE IF_DATA MCMESS 0xFD3A INTERN /end MEASUREMENT
/begin MEASUREMENT B_edkvs "Bedingung Adaptionsfehlerschwellen aktuell überschritten" UWORD B_TRUE 1 100 0 1 BIT_MASK 0x20 FUNCTION_LIST DKVS BBTEGA DKATLRS DLSAHK DLSU DMDSTP DSLSLRS DTEV LRA LRSHK T2DFA IF_DATA DIM_X 0xFD50 INTERN BYTE IF_DATA MCMESS 0xFD50 INTERN /end MEASUREMENT
/begin MEASUREMENT B_edkvs2 "Bedingung Adaptionsfehlerschwellen Bank 2 aktuell überschritten" UWORD B_TRUE 1 100 0 1 BIT_MASK 0x40 FUNCTION_LIST DKVS BBTEGA DKATLRS DLSAHK DLSU DSLSLRS DTEV LRA LRSHK T2DFA IF_DATA DIM_X 0xFD50 INTERN BYTE IF_DATA MCMESS 0xFD50 INTERN /end MEASUREMENT
/begin MEASUREMENT B_edp "Bedingung Erlaubnis Dashpot" UBYTE B_TRUE 1 100 0 1 BIT_MASK 0x10 FUNCTION_LIST MDFAW IF_DATA DIM_X 0x380C37 EXTERN BYTE IF_DATA MCMESS 0x380C37 EXTERN /end MEASUREMENT
/begin MEASUREMENT B_eds "Bedingung für EDS aktiv" UWORD B_TRUE 1 100 0 1 BIT_MASK 0x2000 FUNCTION_LIST SWADP DMDSTP IF_DATA DIM_X 0xFD82 INTERN BYTE IF_DATA MCMESS 0xFD82 INTERN /end MEASUREMENT
/begin MEASUREMENT B_edsl "Bedingung Error Ladedrucksensor" UWORD B_TRUE 1 100 0 1 BIT_MASK 0x100 FUNCTION_LIST GGDSAS BGMSZS IF_DATA DIM_X 0xFD48 INTERN BYTE IF_DATA MCMESS 0xFD48 INTERN /end MEASUREMENT
/begin MEASUREMENT B_edsuu "Bedingung Error Umgebungsdrucksensor nicht zeitentprellt" UBYTE B_TRUE 1 100 0 1 BIT_MASK 0x1 FUNCTION_LIST GGDSAS IF_DATA DIM_X 0x382FFE EXTERN BYTE IF_DATA MCMESS 0x382FFE EXTERN /end MEASUREMENT
/begin MEASUREMENT B_eev "Bedingung Endstufenfehler EV" UWORD B_TRUE 1 100 0 1 BIT_MASK 0x8000 FUNCTION_LIST DEVE DMDSTP LRSEB IF_DATA DIM_X 0xFD42 INTERN BYTE IF_DATA MCMESS 0xFD42 INTERN /end MEASUREMENT
/begin MEASUREMENT B_efrao "Bedingung Diagnoseschwellen obere multipl. Korrektur aktuell überschritten" UWORD B_TRUE 1 100 0 1 BIT_MASK 0x80 FUNCTION_LIST DKVS IF_DATA DIM_X 0xFD50 INTERN BYTE IF_DATA MCMESS 0xFD50 INTERN /end MEASUREMENT
/begin MEASUREMENT B_efrao2 "Bedingung Diagnoseschwellen obere multipl. Korr. Bank 2 aktuell überschritten" UWORD B_TRUE 1 100 0 1 BIT_MASK 0x100 FUNCTION_LIST DKVS IF_DATA DIM_X 0xFD50 INTERN BYTE IF_DATA MCMESS 0xFD50 INTERN /end MEASUREMENT
/begin MEASUREMENT B_efrau "Bedingung Diagnoseschwellen untere multipl. Korrektur aktuell überschritten" UWORD B_TRUE 1 100 0 1 BIT_MASK 0x200 FUNCTION_LIST DKVS IF_DATA DIM_X 0xFD50 INTERN BYTE IF_DATA MCMESS 0xFD50 INTERN /end MEASUREMENT
/begin MEASUREMENT B_efrau2 "Bedingung Diagnoseschwellen untere multipl. Korr. Bank 2 aktuell überschritten" UWORD B_TRUE 1 100 0 1 BIT_MASK 0x400 FUNCTION_LIST DKVS IF_DATA DIM_X 0xFD50 INTERN BYTE IF_DATA MCMESS 0xFD50 INTERN /end MEASUREMENT
/begin MEASUREMENT B_egscok "Bedingung Getriebebotschaft CAN empfangen" UWORD B_TRUE 1 100 0 1 BIT_MASK 0x4000 FUNCTION_LIST SWADP LLRNS IF_DATA DIM_X 0xFD82 INTERN BYTE IF_DATA MCMESS 0xFD82 INTERN /end MEASUREMENT
/begin MEASUREMENT B_egsnew "Bedingung, daß eine neue Getriebebotschaft erkannt wurde" UWORD B_TRUE 1 100 0 1 BIT_MASK 0x8000 FUNCTION_LIST CAN DCGE IF_DATA DIM_X 0xFD06 INTERN BYTE IF_DATA MCMESS 0xFD06 INTERN /end MEASUREMENT
/begin MEASUREMENT B_egsver "Bedingung Automatikfahrzeug mit Datensatz für HS programmiert" UWORD B_TRUE 1 100 0 1 BIT_MASK 0x1000 FUNCTION_LIST DCGE CAN MDEX STA IF_DATA DIM_X 0xFD0A INTERN BYTE IF_DATA MCMESS 0xFD0A INTERN /end MEASUREMENT
/begin MEASUREMENT B_ehfm "Bedingung Fehler HFM (ohne Entprellung)" UWORD B_TRUE 1 100 0 1 BIT_MASK 0x2 FUNCTION_LIST DHFM IF_DATA DIM_X 0xFD48 INTERN BYTE IF_DATA MCMESS 0xFD48 INTERN /end MEASUREMENT
/begin MEASUREMENT B_ehfm1 "Bedingung Fehler HFM (ohne Entprellung) (Zwischengröße ohne Abfrage von UBAT)" UWORD B_TRUE 1 100 0 1 BIT_MASK 0x4 FUNCTION_LIST DHFM IF_DATA DIM_X 0xFD48 INTERN BYTE IF_DATA MCMESS 0xFD48 INTERN /end MEASUREMENT
/begin MEASUREMENT B_ehfs "Bedingung Ersatzwert Hauptfüllungssensor" UWORD B_TRUE 1 100 0 1 BIT_MASK 0x8 FUNCTION_LIST DHFM DUF GGDVE UFRLC IF_DATA DIM_X 0xFD48 INTERN BYTE IF_DATA MCMESS 0xFD48 INTERN /end MEASUREMENT
/begin MEASUREMENT B_ehlsu "Bedingung Fehler Heizung LSU" UWORD B_TRUE 1 100 0 1 BIT_MASK 0x800 FUNCTION_LIST DHLSU DLSU GGLSU IF_DATA DIM_X 0xFD1C INTERN BYTE IF_DATA MCMESS 0xFD1C INTERN /end MEASUREMENT
/begin MEASUREMENT B_ehlsu2 "Bedingung Fehler Heizung LSU Bank2" UWORD B_TRUE 1 100 0 1 BIT_MASK 0x1000 FUNCTION_LIST DHLSU DLSU GGLSU IF_DATA DIM_X 0xFD1C INTERN BYTE IF_DATA MCMESS 0xFD1C INTERN /end MEASUREMENT
/begin MEASUREMENT B_ehsh "Bedingung Error HSH" UWORD B_TRUE 1 100 0 1 BIT_MASK 0x80 FUNCTION_LIST DHLSHK IF_DATA DIM_X 0xFD1C INTERN BYTE IF_DATA MCMESS 0xFD1C INTERN /end MEASUREMENT
/begin MEASUREMENT B_ehsh2 "Bedingung Error HSH2" UWORD B_TRUE 1 100 0 1 BIT_MASK 0x100 FUNCTION_LIST DHLSHK IF_DATA DIM_X 0xFD1C INTERN BYTE IF_DATA MCMESS 0xFD1C INTERN /end MEASUREMENT
/begin MEASUREMENT B_ekats "Summenfehler für MODE 6" UWORD B_TRUE 1 100 0 1 BIT_MASK 0x4000 FUNCTION_LIST DKATLRS IF_DATA DIM_X 0xFD20 INTERN BYTE IF_DATA MCMESS 0xFD20 INTERN /end MEASUREMENT
/begin MEASUREMENT B_ekats2 "Summenfehler für MODE 6 (Stereo 2.Bank)" UWORD B_TRUE 1 100 0 1 BIT_MASK 0x8000 FUNCTION_LIST DKATLRS IF_DATA DIM_X 0xFD20 INTERN BYTE IF_DATA MCMESS 0xFD20 INTERN /end MEASUREMENT
/begin MEASUREMENT B_ekp "Freigabe der EKP-Versorgung" UWORD B_TRUE 1 100 0 1 BIT_MASK 0x10 FUNCTION_LIST AEKP VHW IF_DATA DIM_X 0xFD90 INTERN BYTE IF_DATA MCMESS 0xFD90 INTERN /end MEASUREMENT
/begin MEASUREMENT B_ekpd "Bedingung EKP Dauerbetrieb" UBYTE B_TRUE 1 100 0 1 BIT_MASK 0x8 FUNCTION_LIST AEKP IF_DATA DIM_X 0x380D1F EXTERN BYTE IF_DATA MCMESS 0x380D1F EXTERN /end MEASUREMENT
/begin MEASUREMENT B_ekpn "Bedingung EKP-Einschaltbedingung Drehzahl erfüllt" UBYTE B_TRUE 1 100 0 1 BIT_MASK 0x10 FUNCTION_LIST AEKP IF_DATA DIM_X 0x380D1F EXTERN BYTE IF_DATA MCMESS 0x380D1F EXTERN /end MEASUREMENT
/begin MEASUREMENT B_ekpubn "Bedingung EKP-Einschaltbedingung UBatt-Einbruch und Zahnsignal erfüllt" UBYTE B_TRUE 1 100 0 1 BIT_MASK 0x20 FUNCTION_LIST AEKP IF_DATA DIM_X 0x380D1F EXTERN BYTE IF_DATA MCMESS 0x380D1F EXTERN /end MEASUREMENT
/begin MEASUREMENT B_ekpvl "Bedingung EKP-Vorlauf" UBYTE B_TRUE 1 100 0 1 BIT_MASK 0x40 FUNCTION_LIST AEKP IF_DATA DIM_X 0x380D1F EXTERN BYTE IF_DATA MCMESS 0x380D1F EXTERN /end MEASUREMENT
/begin MEASUREMENT B_elaof "Bedingung Error Lambda-Offset LSU" UWORD B_TRUE 1 100 0 1 BIT_MASK 0x80 FUNCTION_LIST DLSU IF_DATA DIM_X 0xFD2A INTERN BYTE IF_DATA MCMESS 0xFD2A INTERN /end MEASUREMENT
/begin MEASUREMENT B_elaof2 "Bedingung Error Lambda-Offset LSU2" UWORD B_TRUE 1 100 0 1 BIT_MASK 0x100 FUNCTION_LIST DLSU IF_DATA DIM_X 0xFD2A INTERN BYTE IF_DATA MCMESS 0xFD2A INTERN /end MEASUREMENT
/begin MEASUREMENT B_elmi "Bedingung Error Luftmasse bei Initialisierung" UWORD B_TRUE 1 100 0 1 BIT_MASK 0x10 FUNCTION_LIST DHFM IF_DATA DIM_X 0xFD48 INTERN BYTE IF_DATA MCMESS 0xFD48 INTERN /end MEASUREMENT
/begin MEASUREMENT B_elsd "Bedingung Erlaubnis Lastschlagdämpfung" UBYTE B_TRUE 1 100 0 1 BIT_MASK 0x20 FUNCTION_LIST MDFAW IF_DATA DIM_X 0x380C37 EXTERN BYTE IF_DATA MCMESS 0x380C37 EXTERN /end MEASUREMENT
/begin MEASUREMENT B_elsu "Bedingung Fehler oder Fehler-Vormerkung LSU (keine Betriebsbereitschaft)" UWORD B_TRUE 1 100 0 1 BIT_MASK 0x200 FUNCTION_LIST DLSU DHLSU GGLSU IF_DATA DIM_X 0xFD2A INTERN BYTE IF_DATA MCMESS 0xFD2A INTERN /end MEASUREMENT
/begin MEASUREMENT B_elsu2 "Bedingung Fehler oder Fehler-Vormerkung LSU Bank2 (keine Betriebsbereitschaft)" UWORD B_TRUE 1 100 0 1 BIT_MASK 0x400 FUNCTION_LIST DLSU DHLSU GGLSU IF_DATA DIM_X 0xFD2A INTERN BYTE IF_DATA MCMESS 0xFD2A INTERN /end MEASUREMENT
/begin MEASUREMENT B_elsuv "Bedingung Fehler LSU vertauscht rechts/links (keine Betriebsbereitschaft)" UWORD B_TRUE 1 100 0 1 BIT_MASK 0x1000 FUNCTION_LIST DLSUV DHLSU DLSU GGLSU IF_DATA DIM_X 0xFD80 INTERN BYTE IF_DATA MCMESS 0xFD80 INTERN /end MEASUREMENT
/begin MEASUREMENT B_enabale "Bedingung: Freigabe zur Berechnung der Motorabstellposition" UWORD B_TRUE 1 100 0 1 BIT_MASK 0x8 FUNCTION_LIST ALE IF_DATA DIM_X 0xFD10 INTERN BYTE IF_DATA MCMESS 0xFD10 INTERN /end MEASUREMENT
/begin MEASUREMENT B_enabddg "Ausblendung der Drehzahlgeberdiagnose für E_bm" UBYTE B_TRUE 1 100 0 1 BIT_MASK 0x1 FUNCTION_LIST DDG IF_DATA DIM_X 0x380A1F EXTERN BYTE IF_DATA MCMESS 0x380A1F EXTERN /end MEASUREMENT
/begin MEASUREMENT B_encifi "Enable cylinder individual fuel injektion" UWORD B_TRUE 1 100 0 1 BIT_MASK 0x10 FUNCTION_LIST ACIFI IF_DATA DIM_X 0xFD3E INTERN BYTE IF_DATA MCMESS 0xFD3E INTERN /end MEASUREMENT
/begin MEASUREMENT B_endthm "Bedingung:  Freigabe Thermostatdiagnose" UBYTE B_TRUE 1 100 0 1 BIT_MASK 0x10 FUNCTION_LIST GGTFM IF_DATA DIM_X 0x380B55 EXTERN BYTE IF_DATA MCMESS 0x380B55 EXTERN /end MEASUREMENT
/begin MEASUREMENT B_enfmst "Bedingung Enable für Filter; Maximum der Steigung übernehmen" UWORD B_TRUE 1 100 0 1 BIT_MASK 0x10 FUNCTION_LIST DLSAHK IF_DATA DIM_X 0xFD24 INTERN BYTE IF_DATA MCMESS 0xFD24 INTERN /end MEASUREMENT
/begin MEASUREMENT B_enfmst2 "Bedingung Enable für Filter Maximum der Steigung übernehmen Bank2" UWORD B_TRUE 1 100 0 1 BIT_MASK 0x20 FUNCTION_LIST DLSAHK IF_DATA DIM_X 0xFD24 INTERN BYTE IF_DATA MCMESS 0xFD24 INTERN /end MEASUREMENT
/begin MEASUREMENT B_enlash "Bedingung Test für Schwingungsprüfung abgeschlossen, Freigabe Zyklusbit" UWORD B_TRUE 1 100 0 1 BIT_MASK 0x40 FUNCTION_LIST DLSAHK IF_DATA DIM_X 0xFD24 INTERN BYTE IF_DATA MCMESS 0xFD24 INTERN /end MEASUREMENT
/begin MEASUREMENT B_enlash2 "Bedingung Test für Schwingungsprüfung abgeschlossen, Freigabe Zyklusbit Bank2" UWORD B_TRUE 1 100 0 1 BIT_MASK 0x80 FUNCTION_LIST DLSAHK IF_DATA DIM_X 0xFD24 INTERN BYTE IF_DATA MCMESS 0xFD24 INTERN /end MEASUREMENT
/begin MEASUREMENT B_ennptm "Bedingung:  Freigabe Unplausibilitätsprüfung Motortemperatursignal" UBYTE B_TRUE 1 100 0 1 BIT_MASK 0x20 FUNCTION_LIST GGTFM IF_DATA DIM_X 0x380B55 EXTERN BYTE IF_DATA MCMESS 0x380B55 EXTERN /end MEASUREMENT
/begin MEASUREMENT B_enqsyn "Bedingung Freigabe PG-Schnellstart" UWORD B_TRUE 1 100 0 1 BIT_MASK 0x100 FUNCTION_LIST GGDPG IF_DATA DIM_X 0xFD12 INTERN BYTE IF_DATA MCMESS 0xFD12 INTERN /end MEASUREMENT
/begin MEASUREMENT B_enrinh "Bedingung enable für Ri-Nernst mit Filter hinter KAT" UWORD B_TRUE 1 100 0 1 BIT_MASK 0x4 FUNCTION_LIST GGLSH IF_DATA DIM_X 0xFD2C INTERN BYTE IF_DATA MCMESS 0xFD2C INTERN /end MEASUREMENT
/begin MEASUREMENT B_enrinh2 "Bedingung enable für Ri-Nernst mit Filter hinter KAT Bank2" UWORD B_TRUE 1 100 0 1 BIT_MASK 0x8 FUNCTION_LIST GGLSH IF_DATA DIM_X 0xFD2C INTERN BYTE IF_DATA MCMESS 0xFD2C INTERN /end MEASUREMENT
/begin MEASUREMENT B_ensynnl "Freigabe der Synchronisation für Notlauf-Drehzahlgeber" UWORD B_TRUE 1 100 0 1 BIT_MASK 0x2000 FUNCTION_LIST NLDG IF_DATA DIM_X 0xFD16 INTERN BYTE IF_DATA MCMESS 0xFD16 INTERN /end MEASUREMENT
/begin MEASUREMENT B_entest "Bedingung Wartezeit abgeschlossen für Test-Überprüfung Sonde hinter KAT" UWORD B_TRUE 1 100 0 1 BIT_MASK 0x100 FUNCTION_LIST DLSAHK IF_DATA DIM_X 0xFD24 INTERN BYTE IF_DATA MCMESS 0xFD24 INTERN /end MEASUREMENT
/begin MEASUREMENT B_entest2 "Bedingung Wartezeit abgeschlossen für Test-Überprüfung Sonde hinter KAT Bank2" UWORD B_TRUE 1 100 0 1 BIT_MASK 0x200 FUNCTION_LIST DLSAHK IF_DATA DIM_X 0xFD24 INTERN BYTE IF_DATA MCMESS 0xFD24 INTERN /end MEASUREMENT
/begin MEASUREMENT B_entu "Bedingung VFZG Schwelle entprellt überschritten" UBYTE B_TRUE 1 100 0 1 BIT_MASK 0x1 FUNCTION_LIST GGTGET IF_DATA DIM_X 0x380B68 EXTERN BYTE IF_DATA MCMESS 0x380B68 EXTERN /end MEASUREMENT
/begin MEASUREMENT B_enws "Bedingung Fehler Nockenwellenansteuerung liegt vor" UWORD B_TRUE 1 100 0 1 BIT_MASK 0x4 FUNCTION_LIST DNWS DMDSTP DTEV ESUKAS LRAEB IF_DATA DIM_X 0xFD4A INTERN BYTE IF_DATA MCMESS 0xFD4A INTERN /end MEASUREMENT
/begin MEASUREMENT B_eobdlr "OBDII-Summenfehler. sperrt die LR" UWORD B_TRUE 1 100 0 1 BIT_MASK 0x80 FUNCTION_LIST LRSEB TEBEB IF_DATA DIM_X 0xFD7C INTERN BYTE IF_DATA MCMESS 0xFD7C INTERN /end MEASUREMENT
/begin MEASUREMENT B_eobdlr2 "OBDII-Summenfehler. sperrt die LR, Bank 2" UWORD B_TRUE 1 100 0 1 BIT_MASK 0x100 FUNCTION_LIST LRSEB IF_DATA DIM_X 0xFD7C INTERN BYTE IF_DATA MCMESS 0xFD7C INTERN /end MEASUREMENT
/begin MEASUREMENT B_erbr "Bedingung Bremsschaltersignale unplausibel" UWORD B_TRUE 1 100 0 1 BIT_MASK 0x8000 FUNCTION_LIST GGEGAS IF_DATA DIM_X 0xFD3A INTERN BYTE IF_DATA MCMESS 0xFD3A INTERN /end MEASUREMENT
/begin MEASUREMENT B_erdkt "Interner Fehler Kat-Überwachung" UWORD B_TRUE 1 100 0 1 BIT_MASK 0x1 FUNCTION_LIST DKATLRS IF_DATA DIM_X 0xFD22 INTERN BYTE IF_DATA MCMESS 0xFD22 INTERN /end MEASUREMENT
/begin MEASUREMENT B_erdkt2 "Interner Fehler Kat-Überwachung (Bank2)" UWORD B_TRUE 1 100 0 1 BIT_MASK 0x2 FUNCTION_LIST DKATLRS IF_DATA DIM_X 0xFD22 INTERN BYTE IF_DATA MCMESS 0xFD22 INTERN /end MEASUREMENT
/begin MEASUREMENT B_erinofh "Bedingung enable für Ri-Nernst ohne Filter hinter KAT" UWORD B_TRUE 1 100 0 1 BIT_MASK 0x10 FUNCTION_LIST GGLSH IF_DATA DIM_X 0xFD2C INTERN BYTE IF_DATA MCMESS 0xFD2C INTERN /end MEASUREMENT
/begin MEASUREMENT B_erinofh2 "Bedingung enable für Ri-Nernst ohne Filter hinter KAT Bank2" UWORD B_TRUE 1 100 0 1 BIT_MASK 0x20 FUNCTION_LIST GGLSH IF_DATA DIM_X 0xFD2C INTERN BYTE IF_DATA MCMESS 0xFD2C INTERN /end MEASUREMENT
/begin MEASUREMENT B_erkat "Bedingung Diagnoseschwellen additive Korr. pro Zeit aktuell überschritten" UWORD B_TRUE 1 100 0 1 BIT_MASK 0x800 FUNCTION_LIST DKVS IF_DATA DIM_X 0xFD50 INTERN BYTE IF_DATA MCMESS 0xFD50 INTERN /end MEASUREMENT
/begin MEASUREMENT B_erkat2 "Bedingung Diagnoseschwellen additive Korr. pro Zeit Bank 2 aktuell überschritten" UWORD B_TRUE 1 100 0 1 BIT_MASK 0x1000 FUNCTION_LIST DKVS IF_DATA DIM_X 0xFD50 INTERN BYTE IF_DATA MCMESS 0xFD50 INTERN /end MEASUREMENT
/begin MEASUREMENT B_erkaz "Bedingung Diagnoseschwellen additive Korr. pro Einspr.  aktuell überschritten" UWORD B_TRUE 1 100 0 1 BIT_MASK 0x2000 FUNCTION_LIST DKVS IF_DATA DIM_X 0xFD50 INTERN BYTE IF_DATA MCMESS 0xFD50 INTERN /end MEASUREMENT
/begin MEASUREMENT B_erkaz2 "Bedingung Diagnoseschw. additive Korr. pro Einspr. Bank 2 aktuell überschritten" UWORD B_TRUE 1 100 0 1 BIT_MASK 0x4000 FUNCTION_LIST DKVS IF_DATA DIM_X 0xFD50 INTERN BYTE IF_DATA MCMESS 0xFD50 INTERN /end MEASUREMENT
/begin MEASUREMENT B_erl "Bedingung für Errorpfad ldo vom rl check" UWORD B_TRUE 1 100 0 1 BIT_MASK 0x80 FUNCTION_LIST DLDR IF_DATA DIM_X 0xFD66 INTERN BYTE IF_DATA MCMESS 0xFD66 INTERN /end MEASUREMENT
/begin MEASUREMENT B_errofs "Bedingung: zulässige Sekundärluftmassen-Offset überschritten" UBYTE B_TRUE 1 100 0 1 BIT_MASK 0x10 FUNCTION_LIST DSLSLRS IF_DATA DIM_X 0x380902 EXTERN BYTE IF_DATA MCMESS 0x380902 EXTERN /end MEASUREMENT
/begin MEASUREMENT B_errofs2 "Bedingung: max. zulässiger Offsetwert überschritten, Bank 2" UBYTE B_TRUE 1 100 0 1 BIT_MASK 0x1 FUNCTION_LIST DSLSLRS IF_DATA DIM_X 0x380906 EXTERN BYTE IF_DATA MCMESS 0x380906 EXTERN /end MEASUREMENT
/begin MEASUREMENT B_esdia "Endstufendiagnose aktiv" UWORD B_TRUE 1 100 0 1 BIT_MASK 0x400 FUNCTION_LIST DECJ IF_DATA DIM_X 0xFD42 INTERN BYTE IF_DATA MCMESS 0xFD42 INTERN /end MEASUREMENT
/begin MEASUREMENT B_esls "Bedingung Falschluft durch Fehler im Sekundärluftsystem" UWORD B_TRUE 1 100 0 1 BIT_MASK 0x10 FUNCTION_LIST DSLSLRS DLSH LRSEB IF_DATA DIM_X 0xFD02 INTERN BYTE IF_DATA MCMESS 0xFD02 INTERN /end MEASUREMENT
/begin MEASUREMENT B_eslsp "lokales Errorflag: Sekundärluft-System" UBYTE B_TRUE 1 100 0 1 BIT_MASK 0x10 FUNCTION_LIST DSLSLRS T2LID IF_DATA DIM_X 0x380905 EXTERN BYTE IF_DATA MCMESS 0x380905 EXTERN /end MEASUREMENT
/begin MEASUREMENT B_eslsp2 "lokales Errorflag: Sekundärluft-System, Bank 2" UBYTE B_TRUE 1 100 0 1 BIT_MASK 0x8 FUNCTION_LIST DSLSLRS T2LID IF_DATA DIM_X 0x380906 EXTERN BYTE IF_DATA MCMESS 0x380906 EXTERN /end MEASUREMENT
/begin MEASUREMENT B_eslvp "lokale Errorflag: Sekundärluftventil" UBYTE B_TRUE 1 100 0 1 BIT_MASK 0x20 FUNCTION_LIST DSLSLRS IF_DATA DIM_X 0x380903 EXTERN BYTE IF_DATA MCMESS 0x380903 EXTERN /end MEASUREMENT
/begin MEASUREMENT B_eslvp2 "lokale Errorflag: Sekundärluftventil, Bank 2" UBYTE B_TRUE 1 100 0 1 BIT_MASK 0x40 FUNCTION_LIST DSLSLRS IF_DATA DIM_X 0x380906 EXTERN BYTE IF_DATA MCMESS 0x380906 EXTERN /end MEASUREMENT
/begin MEASUREMENT B_etum "Bedingung Fehler in Umgebungstemperatur" UBYTE B_TRUE 1 100 0 1 BIT_MASK 0x1 FUNCTION_LIST GGTFUMG BGTABS IF_DATA DIM_X 0x380B66 EXTERN BYTE IF_DATA MCMESS 0x380B66 EXTERN /end MEASUREMENT
/begin MEASUREMENT B_evabu "Bedingung Ev-Abschaltung durch Überwachungsfunktionen" UWORD B_TRUE 1 100 0 1 BIT_MASK 0x1000 FUNCTION_LIST AEVABU AEVABZK IF_DATA DIM_X 0xFD4C INTERN BYTE IF_DATA MCMESS 0xFD4C INTERN /end MEASUREMENT
/begin MEASUREMENT B_evasel "Status alle für DASE relevant. lokalen Einspritzventile d. SG werden angesteuert" UWORD B_TRUE 1 100 0 1 BIT_MASK 0x80 FUNCTION_LIST AEVAB DMDSTP IF_DATA DIM_X 0xFD4C INTERN BYTE IF_DATA MCMESS 0xFD4C INTERN /end MEASUREMENT
/begin MEASUREMENT B_evloc "Status: alle lokalen Einspritzventile werden angesteuert, = B_EVTOT bei einem SG" UWORD B_TRUE 1 100 0 1 BIT_MASK 0x4 FUNCTION_LIST BGEVAB ATEV DLSAHK DMDSTP DSLSLRS LRSEB T2DFA TEB IF_DATA DIM_X 0xFD50 INTERN BYTE IF_DATA MCMESS 0xFD50 INTERN /end MEASUREMENT
/begin MEASUREMENT B_evlsu "Bedingung Fehler LSU vorgemerkt" UWORD B_TRUE 1 100 0 1 BIT_MASK 0x800 FUNCTION_LIST DLSU IF_DATA DIM_X 0xFD2A INTERN BYTE IF_DATA MCMESS 0xFD2A INTERN /end MEASUREMENT
/begin MEASUREMENT B_evlsu2 "Bedingung Fehler LSU2 vorgemerkt" UWORD B_TRUE 1 100 0 1 BIT_MASK 0x1000 FUNCTION_LIST DLSU IF_DATA DIM_X 0xFD2A INTERN BYTE IF_DATA MCMESS 0xFD2A INTERN /end MEASUREMENT
/begin MEASUREMENT B_evs "Bedingung leistungsmindernder Fehler Ventilhubst. oder EV-Ausblendung" UWORD B_TRUE 1 100 0 1 BIT_MASK 0x80 FUNCTION_LIST MDEX DHFM NMAXMD IF_DATA DIM_X 0xFD0A INTERN BYTE IF_DATA MCMESS 0xFD0A INTERN /end MEASUREMENT
/begin MEASUREMENT B_ez "Verbot des gesamten Motorlaufs (MOTRONIC bleibt in Zahnentprellphase" UBYTE B_TRUE 1 100 0 1 BIT_MASK 0x4 FUNCTION_LIST WFS IMS IF_DATA DIM_X 0x3830B5 EXTERN BYTE IF_DATA MCMESS 0x3830B5 EXTERN /end MEASUREMENT
/begin MEASUREMENT B_fa "Bedingung Funktionsanforderung allgemein" UWORD B_TRUE 1 100 0 1 BIT_MASK 0x40 FUNCTION_LIST T2DFA BBKHZ DKATLRS DKVS DLSAHK DLSH DSLSLRS DTEV LRA LRAEB LRSEB SLS IF_DATA DIM_X 0xFD04 INTERN BYTE IF_DATA MCMESS 0xFD04 INTERN /end MEASUREMENT
/begin MEASUREMENT B_faatm "Bedingung Funktionsanforderung kurze Taupunktendezeiten" UWORD B_TRUE 1 100 0 1 BIT_MASK 0x8000 FUNCTION_LIST SWADP ATM IF_DATA DIM_X 0xFD82 INTERN BYTE IF_DATA MCMESS 0xFD82 INTERN /end MEASUREMENT
/begin MEASUREMENT B_faau "Bedingung Funktionsanforderung Abgasuntersuchung Störgrößenaufschaltung" UWORD B_TRUE 1 100 0 1 BIT_MASK 0x10 FUNCTION_LIST T2AU SGAAU T2DFA IF_DATA DIM_X 0xFD04 INTERN BYTE IF_DATA MCMESS 0xFD04 INTERN /end MEASUREMENT
/begin MEASUREMENT B_fabr "Bedingung Fahrer bremst aus CAN-Botschaft" UWORD B_TRUE 1 100 0 1 BIT_MASK 0x1 FUNCTION_LIST SWADP GGPED IF_DATA DIM_X 0xFD84 INTERN BYTE IF_DATA MCMESS 0xFD84 INTERN /end MEASUREMENT
/begin MEASUREMENT B_faevz "Bedingung Zylinderausblendung durch Tester" UWORD B_TRUE 1 100 0 1 BIT_MASK 0x80 FUNCTION_LIST T2STA AEVAB BGEVAB IF_DATA DIM_X 0xFD06 INTERN BYTE IF_DATA MCMESS 0xFD06 INTERN /end MEASUREMENT
/begin MEASUREMENT B_fakat "Bedingung Funktionsanforderung Katalysatorüberwachung" UWORD B_TRUE 1 100 0 1 BIT_MASK 0x80 FUNCTION_LIST T2DFA DKATLRS IF_DATA DIM_X 0xFD04 INTERN BYTE IF_DATA MCMESS 0xFD04 INTERN /end MEASUREMENT
/begin MEASUREMENT B_fakat2 "Bedingung Funktionanforderung Katalysatorüberwachung (Stereo 2.Bank)" UWORD B_TRUE 1 100 0 1 BIT_MASK 0x100 FUNCTION_LIST T2DFA DKATLRS IF_DATA DIM_X 0xFD04 INTERN BYTE IF_DATA MCMESS 0xFD04 INTERN /end MEASUREMENT
/begin MEASUREMENT B_fakvs "Funktionsaufforderung Diagnose Kraftstoffsystem für Schnelltest" UWORD B_TRUE 1 100 0 1 BIT_MASK 0x200 FUNCTION_LIST T2DFA DKVS LRA LRAEB IF_DATA DIM_X 0xFD04 INTERN BYTE IF_DATA MCMESS 0xFD04 INTERN /end MEASUREMENT
/begin MEASUREMENT B_falash "" UWORD B_TRUE 1 100 0 1 BIT_MASK 0x10 FUNCTION_LIST DFPM_DLSAHK IF_DATA DIM_X 0x3838B8 EXTERN BYTE IF_DATA MCMESS 0x3838B8 EXTERN /end MEASUREMENT
/begin MEASUREMENT B_falash2 "" UWORD B_TRUE 1 100 0 1 BIT_MASK 0x10 FUNCTION_LIST DFPM_DLSAHK IF_DATA DIM_X 0x3838BA EXTERN BYTE IF_DATA MCMESS 0x3838BA EXTERN /end MEASUREMENT
/begin MEASUREMENT B_falls "Bedingung: Funktionsanforderung Drehzahländerung durch Tester" UWORD B_TRUE 1 100 0 1 BIT_MASK 0x2 FUNCTION_LIST SWADP LLRNS IF_DATA DIM_X 0xFD84 INTERN BYTE IF_DATA MCMESS 0xFD84 INTERN /end MEASUREMENT
/begin MEASUREMENT B_fallsa "Bedingung: Funktionsanforderung Drehzahländerung durch Tester aktiv" UWORD B_TRUE 1 100 0 1 BIT_MASK 0x2000 FUNCTION_LIST LLRNS IF_DATA DIM_X 0xFD68 INTERN BYTE IF_DATA MCMESS 0xFD68 INTERN /end MEASUREMENT
/begin MEASUREMENT B_falr "Bedingung: Funktionsanforderung Lambdaregelung aus" UWORD B_TRUE 1 100 0 1 BIT_MASK 0x4 FUNCTION_LIST SWADP LRSEB IF_DATA DIM_X 0xFD84 INTERN BYTE IF_DATA MCMESS 0xFD84 INTERN /end MEASUREMENT
/begin MEASUREMENT B_falsh "Bedingung Funktionsanforderung Lambda-Sonde hinter KAT" UWORD B_TRUE 1 100 0 1 BIT_MASK 0x400 FUNCTION_LIST T2DFA DLSH LAMKO LRSHK IF_DATA DIM_X 0xFD04 INTERN BYTE IF_DATA MCMESS 0xFD04 INTERN /end MEASUREMENT
/begin MEASUREMENT B_falsh2 "Bedingung Funktionsanforderung Lambda-Sonde hinter KAT Bank2" UWORD B_TRUE 1 100 0 1 BIT_MASK 0x800 FUNCTION_LIST T2DFA DLSH LAMKO LRSHK IF_DATA DIM_X 0xFD04 INTERN BYTE IF_DATA MCMESS 0xFD04 INTERN /end MEASUREMENT
/begin MEASUREMENT B_falsu "Bedingung Funktionsanforderung Lambda-Sonde vor KAT" UWORD B_TRUE 1 100 0 1 BIT_MASK 0x2000 FUNCTION_LIST DLSU IF_DATA DIM_X 0xFD2A INTERN BYTE IF_DATA MCMESS 0xFD2A INTERN /end MEASUREMENT
/begin MEASUREMENT B_falsv "Bedingung Funktionsanforderung Lambda-Sonde vor KAT" UWORD B_TRUE 1 100 0 1 BIT_MASK 0x1000 FUNCTION_LIST T2DFA DLSU IF_DATA DIM_X 0xFD04 INTERN BYTE IF_DATA MCMESS 0xFD04 INTERN /end MEASUREMENT
/begin MEASUREMENT B_falsv2 "Bedingung Funktionsanforderung Lambda-Sonde vor KAT Bank2" UWORD B_TRUE 1 100 0 1 BIT_MASK 0x2000 FUNCTION_LIST T2DFA DLSU IF_DATA DIM_X 0xFD04 INTERN BYTE IF_DATA MCMESS 0xFD04 INTERN /end MEASUREMENT
/begin MEASUREMENT B_fash "Bedingung Funktionsanforderung Schwingungsprüfung" UWORD B_TRUE 1 100 0 1 BIT_MASK 0x4000 FUNCTION_LIST T2DFA DLSAHK IF_DATA DIM_X 0xFD04 INTERN BYTE IF_DATA MCMESS 0xFD04 INTERN /end MEASUREMENT
/begin MEASUREMENT B_fash2 "Bedingung Funktionsanforderung Schwingungsprüfung Bank2" UWORD B_TRUE 1 100 0 1 BIT_MASK 0x8000 FUNCTION_LIST T2DFA DLSAHK IF_DATA DIM_X 0xFD04 INTERN BYTE IF_DATA MCMESS 0xFD04 INTERN /end MEASUREMENT
/begin MEASUREMENT B_fasla "Bedingung: externe Anforderung an Sekundärluft aktiv" UWORD B_TRUE 1 100 0 1 BIT_MASK 0x4000 FUNCTION_LIST SLS BBKHZ DSLSLRS KHMD LAKH LAMKO IF_DATA DIM_X 0xFD02 INTERN BYTE IF_DATA MCMESS 0xFD02 INTERN /end MEASUREMENT
/begin MEASUREMENT B_faslarq "Bedingung: lokale Anforderung Testdurchlauf Sekundärluft starten" UBYTE B_TRUE 1 100 0 1 BIT_MASK 0x40 FUNCTION_LIST DSLSLRS IF_DATA DIM_X 0x380904 EXTERN BYTE IF_DATA MCMESS 0x380904 EXTERN /end MEASUREMENT
/begin MEASUREMENT B_fasls "Bedingung Funktionsanforderung Sekundärluftsystem" UWORD B_TRUE 1 100 0 1 BIT_MASK 0x1 FUNCTION_LIST T2DFA SLS IF_DATA DIM_X 0xFD06 INTERN BYTE IF_DATA MCMESS 0xFD06 INTERN /end MEASUREMENT
/begin MEASUREMENT B_fates "Bedingung Funktionsanforderung Tankentlüftungssystem" UWORD B_TRUE 1 100 0 1 BIT_MASK 0x2 FUNCTION_LIST T2DFA DTEV IF_DATA DIM_X 0xFD06 INTERN BYTE IF_DATA MCMESS 0xFD06 INTERN /end MEASUREMENT
/begin MEASUREMENT B_fau "Bedingung Abgasuntersuchung: Vorsteuerfaktor wirkt" UWORD B_TRUE 1 100 0 1 BIT_MASK 0x1000 FUNCTION_LIST SGAAU ESGRU IF_DATA DIM_X 0xFD02 INTERN BYTE IF_DATA MCMESS 0xFD02 INTERN /end MEASUREMENT
/begin MEASUREMENT B_fbm "Bedingung Bezugsmarkenfehler => mindestens 1 Zahn zuviel oder zuwenig erkannt" UWORD B_TRUE 1 100 0 1 BIT_MASK 0x200 FUNCTION_LIST GGDPG DDG DMDSTP IF_DATA DIM_X 0xFD12 INTERN BYTE IF_DATA MCMESS 0xFD12 INTERN /end MEASUREMENT
/begin MEASUREMENT B_fdr "Bedingung für FDR aktiv" UWORD B_TRUE 1 100 0 1 BIT_MASK 0x8 FUNCTION_LIST SWADP DMDSTP IF_DATA DIM_X 0xFD84 INTERN BYTE IF_DATA MCMESS 0xFD84 INTERN /end MEASUREMENT
/begin MEASUREMENT B_ff "Bedingung Folgefunkenzündung" UWORD B_TRUE 1 100 0 1 BIT_MASK 0x4000 FUNCTION_LIST ZUESZ AZUE IF_DATA DIM_X 0xFD8E INTERN BYTE IF_DATA MCMESS 0xFD8E INTERN /end MEASUREMENT
/begin MEASUREMENT B_ffsn2_i "Bedingung Folgefunkenzündung 2tes Ladeereignis" UWORD B_TRUE 1 100 0 1 BIT_MASK 0x8 FUNCTION_LIST AZUE IF_DATA DIM_X 0xFD00 INTERN BYTE IF_DATA MCMESS 0xFD00 INTERN /end MEASUREMENT
/begin MEASUREMENT B_ffz "Bedingung Freezeframe Zero in der ME gesetzt" UWORD B_TRUE 1 100 0 1 BIT_MASK 0x1 FUNCTION_LIST CAN IF_DATA DIM_X 0xFD08 INTERN BYTE IF_DATA MCMESS 0xFD08 INTERN /end MEASUREMENT
/begin MEASUREMENT B_ff_i "Bedingung Folgefunkenzündung: interner Puffer" UWORD B_TRUE 1 100 0 1 BIT_MASK 0x10 FUNCTION_LIST AZUE IF_DATA DIM_X 0xFD00 INTERN BYTE IF_DATA MCMESS 0xFD00 INTERN /end MEASUREMENT
/begin MEASUREMENT B_fgabgl "Bedingung Freigabe des Füllungsabgleichs" UWORD B_TRUE 1 100 0 1 BIT_MASK 0x40 FUNCTION_LIST BGMSZS IF_DATA DIM_X 0xFD46 INTERN BYTE IF_DATA MCMESS 0xFD46 INTERN /end MEASUREMENT
/begin MEASUREMENT B_fgabglgd "Bedingung Freigabe des Füllungsabgleichs durch Gradient" UWORD B_TRUE 1 100 0 1 BIT_MASK 0x80 FUNCTION_LIST BGMSZS IF_DATA DIM_X 0xFD46 INTERN BYTE IF_DATA MCMESS 0xFD46 INTERN /end MEASUREMENT
/begin MEASUREMENT B_fgr "Bedingung FGR (Tempomat) aktiv" UWORD B_TRUE 1 100 0 1 BIT_MASK 0x2000 FUNCTION_LIST MDFAW BBFGR DUF FGRAUS FGRMD MDZUL UFFGRC IF_DATA DIM_X 0xFD6C INTERN BYTE IF_DATA MCMESS 0xFD6C INTERN /end MEASUREMENT
/begin MEASUREMENT B_fgrab "FGR-/ACC-Abschaltung aus der Funktion" UWORD B_TRUE 1 100 0 1 BIT_MASK 0x2 FUNCTION_LIST BBFGR UFFGRE IF_DATA DIM_X 0xFD44 INTERN BYTE IF_DATA MCMESS 0xFD44 INTERN /end MEASUREMENT
/begin MEASUREMENT B_fgrabz "Bedingung zusätzliche FGR-Abschaltung" UWORD B_TRUE 1 100 0 1 BIT_MASK 0x10 FUNCTION_LIST SWADP BBFGR IF_DATA DIM_X 0xFD84 INTERN BYTE IF_DATA MCMESS 0xFD84 INTERN /end MEASUREMENT
/begin MEASUREMENT B_fgrai "Bedingung FGR-Abschaltung irreversibel" UWORD B_TRUE 1 100 0 1 BIT_MASK 0x4 FUNCTION_LIST BBFGR FGRLAMP IF_DATA DIM_X 0xFD44 INTERN BYTE IF_DATA MCMESS 0xFD44 INTERN /end MEASUREMENT
/begin MEASUREMENT B_fgrakt "Bedingung FGR-Regler aktiv" UBYTE B_TRUE 1 100 0 1 BIT_MASK 0x2 FUNCTION_LIST FGRMD FGRLAMP IF_DATA DIM_X 0x380AD8 EXTERN BYTE IF_DATA MCMESS 0x380AD8 EXTERN /end MEASUREMENT
/begin MEASUREMENT B_fgral "Bedingung FGR-Abschaltung langsam" UBYTE B_TRUE 1 100 0 1 BIT_MASK 0x1 FUNCTION_LIST BBFGR IF_DATA DIM_X 0x380AD4 EXTERN BYTE IF_DATA MCMESS 0x380AD4 EXTERN /end MEASUREMENT
/begin MEASUREMENT B_fgrari "Bedingung FGR-Abschaltrampe Initialisierung" UWORD B_TRUE 1 100 0 1 BIT_MASK 0x40 FUNCTION_LIST FGRAUS IF_DATA DIM_X 0xFD44 INTERN BYTE IF_DATA MCMESS 0xFD44 INTERN /end MEASUREMENT
/begin MEASUREMENT B_fgrars "Bedingung: FGR-Abschaltung reversibel schnell" UBYTE B_TRUE 1 100 0 1 BIT_MASK 0x2 FUNCTION_LIST BBFGR IF_DATA DIM_X 0x380AD4 EXTERN BYTE IF_DATA MCMESS 0x380AD4 EXTERN /end MEASUREMENT
/begin MEASUREMENT B_fgras "Bedingung: FGR-Abschaltung schnell" UWORD B_TRUE 1 100 0 1 BIT_MASK 0x8 FUNCTION_LIST BBFGR FGRAUS IF_DATA DIM_X 0xFD44 INTERN BYTE IF_DATA MCMESS 0xFD44 INTERN /end MEASUREMENT
/begin MEASUREMENT B_fgrat "Bedingung: Tip-Schalter Aus am FGR-Bedienteil betätigt" UWORD B_TRUE 1 100 0 1 BIT_MASK 0x8000 FUNCTION_LIST GGFGRH BBFGR CAN T2LID IF_DATA DIM_X 0xFD44 INTERN BYTE IF_DATA MCMESS 0xFD44 INTERN /end MEASUREMENT
/begin MEASUREMENT B_fgraus "Bedingung Hauptschalter FGR aus" UBYTE B_TRUE 1 100 0 1 BIT_MASK 0x1 FUNCTION_LIST GGFGRH IF_DATA DIM_X 0x380ADC EXTERN BYTE IF_DATA MCMESS 0x380ADC EXTERN /end MEASUREMENT
/begin MEASUREMENT B_fgrdvi "Bedingung FGR-Regler Initialisierung der gespeicherten Regelabweichung" UBYTE B_TRUE 1 100 0 1 BIT_MASK 0x4 FUNCTION_LIST FGRMD IF_DATA DIM_X 0x380AD8 EXTERN BYTE IF_DATA MCMESS 0x380AD8 EXTERN /end MEASUREMENT
/begin MEASUREMENT B_fgren "Bedingung Fahrgeschwindigkeitsregelung aktiv (Enable)" UWORD B_TRUE 1 100 0 1 BIT_MASK 0x800 FUNCTION_LIST FGRUE BBFGR CAN FGRAUS UFFGRE IF_DATA DIM_X 0xFD44 INTERN BYTE IF_DATA MCMESS 0xFD44 INTERN /end MEASUREMENT
/begin MEASUREMENT B_fgrene "Bedingung FGR-Regelung aktiv (Enable) erweitert" UWORD B_TRUE 1 100 0 1 BIT_MASK 0x80 FUNCTION_LIST FGRMD FGRUE IF_DATA DIM_X 0xFD44 INTERN BYTE IF_DATA MCMESS 0xFD44 INTERN /end MEASUREMENT
/begin MEASUREMENT B_fgrenold_um "" UBYTE B_TRUE 1 100 0 1 BIT_MASK 0x80 FUNCTION_LIST UFURAM IF_DATA DIM_X 0x382E43 EXTERN WORD IF_DATA MCMESS 0x382E43 EXTERN /end MEASUREMENT
/begin MEASUREMENT B_fgrenv "Bedingung FGR-Regelung aktiv (Enable) vorläufig" UWORD B_TRUE 1 100 0 1 BIT_MASK 0x10 FUNCTION_LIST BBFGR FGRMD FGRUE IF_DATA DIM_X 0xFD44 INTERN BYTE IF_DATA MCMESS 0xFD44 INTERN /end MEASUREMENT
/begin MEASUREMENT B_fgren_um "FGR-/ACC-Einschaltung aus Bedienhebel gültig in der Funktionsüberwachung" UBYTE B_TRUE 1 100 0 1 BIT_MASK 0x4 FUNCTION_LIST UFURAM IF_DATA DIM_X 0x382E43 EXTERN WORD IF_DATA MCMESS 0x382E43 EXTERN /end MEASUREMENT
/begin MEASUREMENT B_fgres "Bedingung FGR-Einschaltung" UBYTE B_TRUE 1 100 0 1 BIT_MASK 0x4 FUNCTION_LIST BBFGR IF_DATA DIM_X 0x380AD4 EXTERN BYTE IF_DATA MCMESS 0x380AD4 EXTERN /end MEASUREMENT
/begin MEASUREMENT B_fgresv "Bedingung FGR-Einschaltgeschwindigkeit erreicht" UWORD B_TRUE 1 100 0 1 BIT_MASK 0x20 FUNCTION_LIST BBFGR FGRMD IF_DATA DIM_X 0xFD44 INTERN BYTE IF_DATA MCMESS 0xFD44 INTERN /end MEASUREMENT
/begin MEASUREMENT B_fgrfr_uc "FGR-/ACC-Momenteneingriff erlaubt im Befehlstest" UWORD B_TRUE 1 100 0 1 BIT_MASK 0x800 FUNCTION_LIST URCEIN URCFGRC IF_DATA DIM_X 0xFD78 INTERN BYTE IF_DATA MCMESS 0xFD78 INTERN /end MEASUREMENT
/begin MEASUREMENT B_fgrhe "Bedingung: FGR-Bedienteil-Fehler" UWORD B_TRUE 1 100 0 1 BIT_MASK 0x1 FUNCTION_LIST GGFGRH BBFGR FGRLAMP IF_DATA DIM_X 0xFD46 INTERN BYTE IF_DATA MCMESS 0xFD46 INTERN /end MEASUREMENT
/begin MEASUREMENT B_fgrhsa "Bedingung: FGR-Hauptschalter aus" UWORD B_TRUE 1 100 0 1 BIT_MASK 0x2 FUNCTION_LIST GGFGRH BBFGR FGRLAMP FGRMD T2LID IF_DATA DIM_X 0xFD46 INTERN BYTE IF_DATA MCMESS 0xFD46 INTERN /end MEASUREMENT
/begin MEASUREMENT B_fgrkf "Bedingung: FGR im Zustand Konstantfahrt" UWORD B_TRUE 1 100 0 1 BIT_MASK 0x1000 FUNCTION_LIST FGRUE BBFGR IF_DATA DIM_X 0xFD44 INTERN BYTE IF_DATA MCMESS 0xFD44 INTERN /end MEASUREMENT
/begin MEASUREMENT B_fgrkfm "Bedingung: FGR im Zustand Konstantfahrt (aus ME)" UWORD B_TRUE 1 100 0 1 BIT_MASK 0x100 FUNCTION_LIST FGRMD FGRUE IF_DATA DIM_X 0xFD44 INTERN BYTE IF_DATA MCMESS 0xFD44 INTERN /end MEASUREMENT
/begin MEASUREMENT B_fgrneg "Entprellzeit nach Rücknahme eines Hebelsignals" UBYTE B_TRUE 1 100 0 1 BIT_MASK 0x8 FUNCTION_LIST GGFGRH IF_DATA DIM_X 0x380ADC EXTERN BYTE IF_DATA MCMESS 0x380ADC EXTERN /end MEASUREMENT
/begin MEASUREMENT B_fgrra "Bedingung FGR-Rampe" UBYTE B_TRUE 1 100 0 1 BIT_MASK 0x8 FUNCTION_LIST FGRMD IF_DATA DIM_X 0x380AD8 EXTERN BYTE IF_DATA MCMESS 0x380AD8 EXTERN /end MEASUREMENT
/begin MEASUREMENT B_fgrsb "Entprelltes Bedienhebelsignal Setzen und Beschleunigen" UBYTE B_TRUE 1 100 0 1 BIT_MASK 0x4 FUNCTION_LIST GGFGRH T2LID IF_DATA DIM_X 0x380ADC EXTERN BYTE IF_DATA MCMESS 0x380ADC EXTERN /end MEASUREMENT
/begin MEASUREMENT B_fgrtbe "Bedingung FGR-Taste Beschleunigen" UWORD B_TRUE 1 100 0 1 BIT_MASK 0x4 FUNCTION_LIST GGFGRH BBFGR FGRMD T2LID IF_DATA DIM_X 0xFD46 INTERN BYTE IF_DATA MCMESS 0xFD46 INTERN /end MEASUREMENT
/begin MEASUREMENT B_fgrtse "Bedingung FGR-Taste Setzen" UWORD B_TRUE 1 100 0 1 BIT_MASK 0x8 FUNCTION_LIST GGFGRH BBFGR CAN FGRMD IF_DATA DIM_X 0xFD46 INTERN BYTE IF_DATA MCMESS 0xFD46 INTERN /end MEASUREMENT
/begin MEASUREMENT B_fgrtve "Bedingung FGR-Taste Verzögern" UWORD B_TRUE 1 100 0 1 BIT_MASK 0x10 FUNCTION_LIST GGFGRH BBFGR FGRMD IF_DATA DIM_X 0xFD46 INTERN BYTE IF_DATA MCMESS 0xFD46 INTERN /end MEASUREMENT
/begin MEASUREMENT B_fgrtwa "Bedingung FGR-Taste Wiederaufnahme" UWORD B_TRUE 1 100 0 1 BIT_MASK 0x20 FUNCTION_LIST GGFGRH BBFGR CAN FGRMD T2LID IF_DATA DIM_X 0xFD46 INTERN BYTE IF_DATA MCMESS 0xFD46 INTERN /end MEASUREMENT
/begin MEASUREMENT B_fgrvem "Bedingung: FGR im Zustand Verzögern (aus ME)" UWORD B_TRUE 1 100 0 1 BIT_MASK 0x200 FUNCTION_LIST FGRMD FGRUE IF_DATA DIM_X 0xFD44 INTERN BYTE IF_DATA MCMESS 0xFD44 INTERN /end MEASUREMENT
/begin MEASUREMENT B_fgrver "Bedingung: FGR im Zustand Verzögern" UWORD B_TRUE 1 100 0 1 BIT_MASK 0x2000 FUNCTION_LIST FGRUE FGRAUS IF_DATA DIM_X 0xFD44 INTERN BYTE IF_DATA MCMESS 0xFD44 INTERN /end MEASUREMENT
/begin MEASUREMENT B_fgrwv "Entprelltes Bedienhebelsignal Wiederaufnehmen Verzögern" UBYTE B_TRUE 1 100 0 1 BIT_MASK 0x2 FUNCTION_LIST GGFGRH T2LID IF_DATA DIM_X 0x380ADC EXTERN BYTE IF_DATA MCMESS 0x380ADC EXTERN /end MEASUREMENT
/begin MEASUREMENT B_fgr_uc "FGR-/ACC-Momenteneingriff im Befehlstest erlaubt" UWORD B_TRUE 1 100 0 1 BIT_MASK 0x1000 FUNCTION_LIST URCFGRC IF_DATA DIM_X 0xFD78 INTERN BYTE IF_DATA MCMESS 0xFD78 INTERN /end MEASUREMENT
/begin MEASUREMENT B_fgr_um "FGR-/ACC-Momenteneingriff in der Funktionsüberwachung erlaubt" UWORD B_TRUE 1 100 0 1 BIT_MASK 0x20 FUNCTION_LIST UFFGRC BBFGR DUF IF_DATA DIM_X 0xFD78 INTERN BYTE IF_DATA MCMESS 0xFD78 INTERN /end MEASUREMENT
/begin MEASUREMENT B_fhz "Bedingung Frontscheibenheizung" UWORD B_TRUE 1 100 0 1 BIT_MASK 0x20 FUNCTION_LIST SWADP LLRNS IF_DATA DIM_X 0xFD84 INTERN BYTE IF_DATA MCMESS 0xFD84 INTERN /end MEASUREMENT
/begin MEASUREMENT B_fil "Bedingung PT1-Filter für SAWE aktiv" UWORD B_TRUE 1 100 0 1 BIT_MASK 0x4000 FUNCTION_LIST MDFAW LLRBB MDAUTG MDKOG IF_DATA DIM_X 0xFD6C INTERN BYTE IF_DATA MCMESS 0xFD6C INTERN /end MEASUREMENT
/begin MEASUREMENT B_firstSyn "" UWORD B_TRUE 1 100 0 1 BIT_MASK 0x1000 FUNCTION_LIST SYNC71 IF_DATA DIM_X 0xFD86 INTERN BYTE IF_DATA MCMESS 0xFD86 INTERN /end MEASUREMENT
/begin MEASUREMENT B_fkmsdks "Integratorstop fkmsdk" UWORD B_TRUE 1 100 0 1 BIT_MASK 0x800 FUNCTION_LIST FUEDK BGMSZS FUEREG IF_DATA DIM_X 0xFD4A INTERN BYTE IF_DATA MCMESS 0xFD4A INTERN /end MEASUREMENT
/begin MEASUREMENT B_fkmsmn "schnelle Massenstromadaption fkmsdks im unteren Anschlag" UWORD B_TRUE 1 100 0 1 BIT_MASK 0x100 FUNCTION_LIST BGMSZS DEGFE IF_DATA DIM_X 0xFD46 INTERN BYTE IF_DATA MCMESS 0xFD46 INTERN /end MEASUREMENT
/begin MEASUREMENT B_fkmsmx "schnelle Massenstromadaption fkmsdks im oberen Anschlag" UWORD B_TRUE 1 100 0 1 BIT_MASK 0x200 FUNCTION_LIST BGMSZS DEGFE IF_DATA DIM_X 0xFD46 INTERN BYTE IF_DATA MCMESS 0xFD46 INTERN /end MEASUREMENT
/begin MEASUREMENT B_fkpvdk "Bedingung für die Freigabe des langsamen multiplikativen Füllungsabgleichs" UWORD B_TRUE 1 100 0 1 BIT_MASK 0x400 FUNCTION_LIST BGMSZS IF_DATA DIM_X 0xFD46 INTERN BYTE IF_DATA MCMESS 0xFD46 INTERN /end MEASUREMENT
/begin MEASUREMENT B_fkpvmn "langsame Massenstromadaption fkpvdk im unteren Anschlag" UWORD B_TRUE 1 100 0 1 BIT_MASK 0x800 FUNCTION_LIST BGMSZS DEGFE IF_DATA DIM_X 0xFD46 INTERN BYTE IF_DATA MCMESS 0xFD46 INTERN /end MEASUREMENT
/begin MEASUREMENT B_fkpvmx "langsame Massenstromadaption fkpvdk im oberen Anschlag" UWORD B_TRUE 1 100 0 1 BIT_MASK 0x1000 FUNCTION_LIST BGMSZS DEGFE IF_DATA DIM_X 0xFD46 INTERN BYTE IF_DATA MCMESS 0xFD46 INTERN /end MEASUREMENT
/begin MEASUREMENT b_flags_uc "Ebene 3 Byte für Botschaftüberwachung (alte Toggle Bits)" UBYTE dez 1 100 0 255 FUNCTION_LIST URCRAM IF_DATA DIM_X 0x380C53 EXTERN WORD IF_DATA MCMESS 0x380C53 EXTERN /end MEASUREMENT
/begin MEASUREMENT b_flags_um "Flag für Bitinformationen in der Funktionsüberwachung" UBYTE dez 1 100 0 255 FUNCTION_LIST UFURAM IF_DATA DIM_X 0x382E40 EXTERN WORD IF_DATA MCMESS 0x382E40 EXTERN /end MEASUREMENT
/begin MEASUREMENT B_fodo "Bedingung fuel-on/-off adaption in dominantem Bereich aktiv" UBYTE B_TRUE 1 100 0 1 BIT_MASK 0x2 FUNCTION_LIST DMDFON IF_DATA DIM_X 0x382F11 EXTERN WORD IF_DATA MCMESS 0x382F11 EXTERN /end MEASUREMENT
/begin MEASUREMENT B_fodon "Bedingung fuel-on Adaption in drehzahldominantem Bereich aktiv" UBYTE B_TRUE 1 100 0 1 BIT_MASK 0x8 FUNCTION_LIST DMDFON IF_DATA DIM_X 0x382F11 EXTERN WORD IF_DATA MCMESS 0x382F11 EXTERN /end MEASUREMENT
/begin MEASUREMENT B_fofstp "Bedingung fuel-off Adaption gestoppt" UWORD B_TRUE 1 100 0 1 BIT_MASK 0x40 FUNCTION_LIST DMDSTP IF_DATA DIM_X 0xFD94 INTERN WORD IF_DATA MCMESS 0xFD94 INTERN /end MEASUREMENT
/begin MEASUREMENT B_fofstpt "Bedingung fuel-off Adaption gestoppt vom 2. SG" UWORD B_TRUE 1 100 0 1 BIT_MASK 0x20 FUNCTION_LIST DMDSTP IF_DATA DIM_X 0xFD0C INTERN BYTE IF_DATA MCMESS 0xFD0C INTERN /end MEASUREMENT
/begin MEASUREMENT B_fof_m "Monitor, Bedingung fuel-off Adaption aktiv" UBYTE B_TRUE 1 100 0 1 BIT_MASK 0x40 FUNCTION_LIST DMDFON IF_DATA DIM_X 0xE456 INTERN WORD IF_DATA MCMESS 0xE456 INTERN /end MEASUREMENT
/begin MEASUREMENT B_fohe "aktueller Bereich ist ein Heilbereich" UBYTE B_TRUE 1 100 0 1 BIT_MASK 0x80 FUNCTION_LIST DMDFON IF_DATA DIM_X 0x382F11 EXTERN WORD IF_DATA MCMESS 0x382F11 EXTERN /end MEASUREMENT
/begin MEASUREMENT B_fohold "fuel-on Adaption angehalten" UBYTE B_TRUE 1 100 0 1 BIT_MASK 0x4 FUNCTION_LIST DMDFON IF_DATA DIM_X 0x382F12 EXTERN WORD IF_DATA MCMESS 0x382F12 EXTERN /end MEASUREMENT
/begin MEASUREMENT B_fonstp "Bedingung fuel-on Adaption gestoppt" UWORD B_TRUE 1 100 0 1 BIT_MASK 0x80 FUNCTION_LIST DMDSTP IF_DATA DIM_X 0xFD94 INTERN WORD IF_DATA MCMESS 0xFD94 INTERN /end MEASUREMENT
/begin MEASUREMENT B_fonstpt "Bedingung fuel-on Adaption gestoppt vom 2. SG" UWORD B_TRUE 1 100 0 1 BIT_MASK 0x40 FUNCTION_LIST DMDSTP IF_DATA DIM_X 0xFD0C INTERN BYTE IF_DATA MCMESS 0xFD0C INTERN /end MEASUREMENT
/begin MEASUREMENT B_fontm "Motortemperatur genügend hoch für fuel-on-Adaption" UWORD B_TRUE 1 100 0 1 BIT_MASK 0x20 FUNCTION_LIST DMDFON IF_DATA DIM_X 0xFD94 INTERN WORD IF_DATA MCMESS 0xFD94 INTERN /end MEASUREMENT
/begin MEASUREMENT B_fon_m "Monitor, Bedingung fuel-on Adaption aktiv" UBYTE B_TRUE 1 100 0 1 BIT_MASK 0x1 FUNCTION_LIST DMDFON IF_DATA DIM_X 0xE456 INTERN WORD IF_DATA MCMESS 0xE456 INTERN /end MEASUREMENT
/begin MEASUREMENT B_fophsnl "Evabschaltung über feste Abschaltmuster ohne Notlauf Phasensuche" UWORD B_TRUE 1 100 0 1 BIT_MASK 0x100 FUNCTION_LIST AEVAB IF_DATA DIM_X 0xFD4C INTERN BYTE IF_DATA MCMESS 0xFD4C INTERN /end MEASUREMENT
/begin MEASUREMENT B_for11 "KF-Bereich 11 fertig gelernt (ready)" UBYTE B_TRUE 1 100 0 1 BIT_MASK 0x1 FUNCTION_LIST DMDFON IF_DATA DIM_X 0x382F15 EXTERN WORD IF_DATA MCMESS 0x382F15 EXTERN /end MEASUREMENT
/begin MEASUREMENT B_for12 "KF-Bereich 12 fertig gelernt (ready)" UBYTE B_TRUE 1 100 0 1 BIT_MASK 0x1 FUNCTION_LIST DMDFON IF_DATA DIM_X 0x382F16 EXTERN WORD IF_DATA MCMESS 0x382F16 EXTERN /end MEASUREMENT
/begin MEASUREMENT B_for13 "KF-Bereich 13 fertig gelernt (ready)" UBYTE B_TRUE 1 100 0 1 BIT_MASK 0x1 FUNCTION_LIST DMDFON IF_DATA DIM_X 0x382F17 EXTERN WORD IF_DATA MCMESS 0x382F17 EXTERN /end MEASUREMENT
/begin MEASUREMENT B_for21 "KF-Bereich 21 fertig gelernt (ready)" UBYTE B_TRUE 1 100 0 1 BIT_MASK 0x2 FUNCTION_LIST DMDFON IF_DATA DIM_X 0x382F15 EXTERN WORD IF_DATA MCMESS 0x382F15 EXTERN /end MEASUREMENT
/begin MEASUREMENT B_for22 "KF-Bereich 22 fertig gelernt (ready)" UBYTE B_TRUE 1 100 0 1 BIT_MASK 0x2 FUNCTION_LIST DMDFON IF_DATA DIM_X 0x382F16 EXTERN WORD IF_DATA MCMESS 0x382F16 EXTERN /end MEASUREMENT
/begin MEASUREMENT B_for23 "KF-Bereich 23 fertig gelernt (ready)" UBYTE B_TRUE 1 100 0 1 BIT_MASK 0x2 FUNCTION_LIST DMDFON IF_DATA DIM_X 0x382F17 EXTERN WORD IF_DATA MCMESS 0x382F17 EXTERN /end MEASUREMENT
/begin MEASUREMENT B_for31 "KF-Bereich 31 fertig gelernt" UBYTE B_TRUE 1 100 0 1 BIT_MASK 0x4 FUNCTION_LIST DMDFON IF_DATA DIM_X 0x382F15 EXTERN WORD IF_DATA MCMESS 0x382F15 EXTERN /end MEASUREMENT
/begin MEASUREMENT B_for32 "KF-Bereich 32 fertig gelernt" UBYTE B_TRUE 1 100 0 1 BIT_MASK 0x4 FUNCTION_LIST DMDFON IF_DATA DIM_X 0x382F16 EXTERN WORD IF_DATA MCMESS 0x382F16 EXTERN /end MEASUREMENT
/begin MEASUREMENT B_for33 "KF-Bereich 33 fertig gelernt" UBYTE B_TRUE 1 100 0 1 BIT_MASK 0x4 FUNCTION_LIST DMDFON IF_DATA DIM_X 0x382F17 EXTERN WORD IF_DATA MCMESS 0x382F17 EXTERN /end MEASUREMENT
/begin MEASUREMENT B_for41 "KF-Bereich 41 fertig gelernt" UBYTE B_TRUE 1 100 0 1 BIT_MASK 0x8 FUNCTION_LIST DMDFON IF_DATA DIM_X 0x382F15 EXTERN WORD IF_DATA MCMESS 0x382F15 EXTERN /end MEASUREMENT
/begin MEASUREMENT B_for42 "KF-Bereich 42 fertig gelernt" UBYTE B_TRUE 1 100 0 1 BIT_MASK 0x8 FUNCTION_LIST DMDFON IF_DATA DIM_X 0x382F16 EXTERN WORD IF_DATA MCMESS 0x382F16 EXTERN /end MEASUREMENT
/begin MEASUREMENT B_for43 "KF-Bereich 43 fertig gelernt" UBYTE B_TRUE 1 100 0 1 BIT_MASK 0x8 FUNCTION_LIST DMDFON IF_DATA DIM_X 0x382F17 EXTERN WORD IF_DATA MCMESS 0x382F17 EXTERN /end MEASUREMENT
/begin MEASUREMENT B_for51 "KF-Bereich 51 fertig gelernt" UBYTE B_TRUE 1 100 0 1 BIT_MASK 0x10 FUNCTION_LIST DMDFON IF_DATA DIM_X 0x382F15 EXTERN WORD IF_DATA MCMESS 0x382F15 EXTERN /end MEASUREMENT
/begin MEASUREMENT B_for52 "KF-Bereich 52 fertig gelernt" UBYTE B_TRUE 1 100 0 1 BIT_MASK 0x10 FUNCTION_LIST DMDFON IF_DATA DIM_X 0x382F16 EXTERN WORD IF_DATA MCMESS 0x382F16 EXTERN /end MEASUREMENT
/begin MEASUREMENT B_for53 "KF-Bereich 53 fertig gelernt" UBYTE B_TRUE 1 100 0 1 BIT_MASK 0x10 FUNCTION_LIST DMDFON IF_DATA DIM_X 0x382F17 EXTERN WORD IF_DATA MCMESS 0x382F17 EXTERN /end MEASUREMENT
/begin MEASUREMENT B_for61 "KF-Bereich 61 fertig gelernt" UBYTE B_TRUE 1 100 0 1 BIT_MASK 0x20 FUNCTION_LIST DMDFON IF_DATA DIM_X 0x382F15 EXTERN WORD IF_DATA MCMESS 0x382F15 EXTERN /end MEASUREMENT
/begin MEASUREMENT B_for62 "KF-Bereich 62 fertig gelernt" UBYTE B_TRUE 1 100 0 1 BIT_MASK 0x20 FUNCTION_LIST DMDFON IF_DATA DIM_X 0x382F16 EXTERN WORD IF_DATA MCMESS 0x382F16 EXTERN /end MEASUREMENT
/begin MEASUREMENT B_for63 "KF-Bereich 63 fertig gelernt" UBYTE B_TRUE 1 100 0 1 BIT_MASK 0x20 FUNCTION_LIST DMDFON IF_DATA DIM_X 0x382F17 EXTERN WORD IF_DATA MCMESS 0x382F17 EXTERN /end MEASUREMENT
/begin MEASUREMENT B_for71 "KF-Bereich 71 fertig gelernt" UBYTE B_TRUE 1 100 0 1 BIT_MASK 0x40 FUNCTION_LIST DMDFON IF_DATA DIM_X 0x382F15 EXTERN WORD IF_DATA MCMESS 0x382F15 EXTERN /end MEASUREMENT
/begin MEASUREMENT B_for72 "KF-Bereich 72 fertig gelernt" UBYTE B_TRUE 1 100 0 1 BIT_MASK 0x40 FUNCTION_LIST DMDFON IF_DATA DIM_X 0x382F16 EXTERN WORD IF_DATA MCMESS 0x382F16 EXTERN /end MEASUREMENT
/begin MEASUREMENT B_for73 "KF-Bereich 73 fertig gelernt" UBYTE B_TRUE 1 100 0 1 BIT_MASK 0x40 FUNCTION_LIST DMDFON IF_DATA DIM_X 0x382F17 EXTERN WORD IF_DATA MCMESS 0x382F17 EXTERN /end MEASUREMENT
/begin MEASUREMENT B_for81 "KF-Bereich 81 fertig gelernt" UBYTE B_TRUE 1 100 0 1 BIT_MASK 0x80 FUNCTION_LIST DMDFON IF_DATA DIM_X 0x382F15 EXTERN WORD IF_DATA MCMESS 0x382F15 EXTERN /end MEASUREMENT
/begin MEASUREMENT B_for82 "KF-Bereich 82 fertig gelernt" UBYTE B_TRUE 1 100 0 1 BIT_MASK 0x80 FUNCTION_LIST DMDFON IF_DATA DIM_X 0x382F16 EXTERN WORD IF_DATA MCMESS 0x382F16 EXTERN /end MEASUREMENT
/begin MEASUREMENT B_for83 "KF-Bereich 83 fertig gelernt" UBYTE B_TRUE 1 100 0 1 BIT_MASK 0x80 FUNCTION_LIST DMDFON IF_DATA DIM_X 0x382F17 EXTERN WORD IF_DATA MCMESS 0x382F17 EXTERN /end MEASUREMENT
/begin MEASUREMENT B_fordo_m "Monitor, Bedingung Adaption in mind. einem dominanten Bereich ready" UBYTE B_TRUE 1 100 0 1 BIT_MASK 0x20 FUNCTION_LIST DMDFON IF_DATA DIM_X 0xE3F0 INTERN WORD IF_DATA MCMESS 0xE3F0 INTERN /end MEASUREMENT
/begin MEASUREMENT B_forn01 "mindestens ein Bereich im Drehzahlbereich 01 hat fertig gelernt" UBYTE B_TRUE 1 100 0 1 BIT_MASK 0x1 FUNCTION_LIST DMDFON IF_DATA DIM_X 0x382F13 EXTERN WORD IF_DATA MCMESS 0x382F13 EXTERN /end MEASUREMENT
/begin MEASUREMENT B_forn02 "mindestens ein Bereich im Drehzahlbereich 02 hat fertig gelernt" UBYTE B_TRUE 1 100 0 1 BIT_MASK 0x2 FUNCTION_LIST DMDFON IF_DATA DIM_X 0x382F13 EXTERN WORD IF_DATA MCMESS 0x382F13 EXTERN /end MEASUREMENT
/begin MEASUREMENT B_forn03 "mindestens ein Bereich im Drehzahlbereich 03 hat fertig gelernt" UBYTE B_TRUE 1 100 0 1 BIT_MASK 0x4 FUNCTION_LIST DMDFON IF_DATA DIM_X 0x382F13 EXTERN WORD IF_DATA MCMESS 0x382F13 EXTERN /end MEASUREMENT
/begin MEASUREMENT B_forn04 "mindestens ein Bereich im Drehzahlbereich 04 hat fertig gelernt" UBYTE B_TRUE 1 100 0 1 BIT_MASK 0x8 FUNCTION_LIST DMDFON IF_DATA DIM_X 0x382F13 EXTERN WORD IF_DATA MCMESS 0x382F13 EXTERN /end MEASUREMENT
/begin MEASUREMENT B_forn05 "mindestens ein Bereich im Drehzahlbereich 05 hat fertig gelernt" UBYTE B_TRUE 1 100 0 1 BIT_MASK 0x10 FUNCTION_LIST DMDFON IF_DATA DIM_X 0x382F13 EXTERN WORD IF_DATA MCMESS 0x382F13 EXTERN /end MEASUREMENT
/begin MEASUREMENT B_forn06 "mindestens ein Bereich im Drehzahlbereich 06 hat fertig gelernt" UBYTE B_TRUE 1 100 0 1 BIT_MASK 0x20 FUNCTION_LIST DMDFON IF_DATA DIM_X 0x382F13 EXTERN WORD IF_DATA MCMESS 0x382F13 EXTERN /end MEASUREMENT
/begin MEASUREMENT B_forn07 "mindestens ein Bereich im Drehzahlbereich 07 hat fertig gelernt" UBYTE B_TRUE 1 100 0 1 BIT_MASK 0x40 FUNCTION_LIST DMDFON IF_DATA DIM_X 0x382F13 EXTERN WORD IF_DATA MCMESS 0x382F13 EXTERN /end MEASUREMENT
/begin MEASUREMENT B_forn08 "mindestens ein Bereich im Drehzahlbereich 08 hat fertig gelernt" UBYTE B_TRUE 1 100 0 1 BIT_MASK 0x80 FUNCTION_LIST DMDFON IF_DATA DIM_X 0x382F13 EXTERN WORD IF_DATA MCMESS 0x382F13 EXTERN /end MEASUREMENT
/begin MEASUREMENT B_forn_m "Monitor, Bedingung Adaption im aktuellen Drehzahlbereich ready" UBYTE B_TRUE 1 100 0 1 BIT_MASK 0x40 FUNCTION_LIST DMDFON IF_DATA DIM_X 0xE3F0 INTERN WORD IF_DATA MCMESS 0xE3F0 INTERN /end MEASUREMENT
/begin MEASUREMENT B_forset "Reset der fuel-on/-off Adaption" UWORD B_TRUE 1 100 0 1 BIT_MASK 0x4000 FUNCTION_LIST DMDFON IF_DATA DIM_X 0xFD94 INTERN WORD IF_DATA MCMESS 0xFD94 INTERN /end MEASUREMENT
/begin MEASUREMENT B_forun "Status fuel-on/-off Adaption aktiv" UBYTE B_TRUE 1 100 0 1 BIT_MASK 0x10 FUNCTION_LIST DMDFON IF_DATA DIM_X 0x382F12 EXTERN WORD IF_DATA MCMESS 0x382F12 EXTERN /end MEASUREMENT
/begin MEASUREMENT B_for_m "Monitor, Bedingung Adaption im aktuellen Bereich ready" UBYTE B_TRUE 1 100 0 1 BIT_MASK 0x10 FUNCTION_LIST DMDFON IF_DATA DIM_X 0xE3F0 INTERN WORD IF_DATA MCMESS 0xE3F0 INTERN /end MEASUREMENT
/begin MEASUREMENT B_fos "Bedingung fuel-on/-off aktueller Bereich ist ein Schubbereich" UBYTE B_TRUE 1 100 0 1 BIT_MASK 0x4 FUNCTION_LIST DMDFON IF_DATA DIM_X 0x382F11 EXTERN WORD IF_DATA MCMESS 0x382F11 EXTERN /end MEASUREMENT
/begin MEASUREMENT B_foxfg "Bedingung fuel-on/-off freigegeben" UBYTE B_TRUE 1 100 0 1 BIT_MASK 0x8 FUNCTION_LIST DMDFON IF_DATA DIM_X 0x382F12 EXTERN WORD IF_DATA MCMESS 0x382F12 EXTERN /end MEASUREMENT
/begin MEASUREMENT B_fprakt "DK-Rückstellfeder-Prüfung aktiv" UWORD B_TRUE 1 100 0 1 BIT_MASK 0x4000 FUNCTION_LIST BGDVE T2DVE IF_DATA DIM_X 0xFD34 INTERN BYTE IF_DATA MCMESS 0xFD34 INTERN /end MEASUREMENT
/begin MEASUREMENT B_fproab "Bedingung: DV-E-Prüfung öffnende Feder Abbruch, Feder öffnet nicht" UWORD B_TRUE 1 100 0 1 BIT_MASK 0x8000 FUNCTION_LIST BGDVE DDVE SREAKT IF_DATA DIM_X 0xFD34 INTERN BYTE IF_DATA MCMESS 0xFD34 INTERN /end MEASUREMENT
/begin MEASUREMENT B_fproe "Bedingung: Öffnende Federprüfung Fehler" UWORD B_TRUE 1 100 0 1 BIT_MASK 0x1 FUNCTION_LIST BGDVE DDVE IF_DATA DIM_X 0xFD36 INTERN BYTE IF_DATA MCMESS 0xFD36 INTERN /end MEASUREMENT
/begin MEASUREMENT B_fprook "Bedingung: öffnende Federprüfung i.O." UWORD B_TRUE 1 100 0 1 BIT_MASK 0x2 FUNCTION_LIST BGDVE DDVE IF_DATA DIM_X 0xFD36 INTERN BYTE IF_DATA MCMESS 0xFD36 INTERN /end MEASUREMENT
/begin MEASUREMENT B_fprordy "Bedingung: Öffnende Federprüfung fertig" UWORD B_TRUE 1 100 0 1 BIT_MASK 0x4 FUNCTION_LIST BGDVE DDVE IF_DATA DIM_X 0xFD36 INTERN BYTE IF_DATA MCMESS 0xFD36 INTERN /end MEASUREMENT
/begin MEASUREMENT B_fprovb "Bedingung: Öffnende Federprüfung verboten" UWORD B_TRUE 1 100 0 1 BIT_MASK 0x8 FUNCTION_LIST BGDVE DDVE IF_DATA DIM_X 0xFD36 INTERN BYTE IF_DATA MCMESS 0xFD36 INTERN /end MEASUREMENT
/begin MEASUREMENT B_fprrdy "DK-Rückstellfeder-Prüfung beendet" UWORD B_TRUE 1 100 0 1 BIT_MASK 0x10 FUNCTION_LIST BGDVE DDVE T2DVE IF_DATA DIM_X 0xFD36 INTERN BYTE IF_DATA MCMESS 0xFD36 INTERN /end MEASUREMENT
/begin MEASUREMENT B_fprzab "Bedingung: DV-E-Rückstellfederprüfung Abbruch, Feder schließt nicht" UWORD B_TRUE 1 100 0 1 BIT_MASK 0x20 FUNCTION_LIST BGDVE DDVE SREAKT IF_DATA DIM_X 0xFD36 INTERN BYTE IF_DATA MCMESS 0xFD36 INTERN /end MEASUREMENT
/begin MEASUREMENT B_fprze "Bedingung: Fehler in der DV-E-Rückstellfederprüfung" UWORD B_TRUE 1 100 0 1 BIT_MASK 0x40 FUNCTION_LIST BGDVE DDVE T2DVE IF_DATA DIM_X 0xFD36 INTERN BYTE IF_DATA MCMESS 0xFD36 INTERN /end MEASUREMENT
/begin MEASUREMENT B_fprzok "Bedingung: DV-E-Rückstellfederprüfung i.O." UWORD B_TRUE 1 100 0 1 BIT_MASK 0x80 FUNCTION_LIST BGDVE T2DVE IF_DATA DIM_X 0xFD36 INTERN BYTE IF_DATA MCMESS 0xFD36 INTERN /end MEASUREMENT
/begin MEASUREMENT B_fprzvb "Bedingung: DV-E-Rückstellfederprüfung verboten" UWORD B_TRUE 1 100 0 1 BIT_MASK 0x100 FUNCTION_LIST BGDVE DDVE T2DVE IF_DATA DIM_X 0xFD36 INTERN BYTE IF_DATA MCMESS 0xFD36 INTERN /end MEASUREMENT
/begin MEASUREMENT B_fpwdkap "DK-Steuerung direkt über Fahrpedal" UWORD B_TRUE 1 100 0 1 BIT_MASK 0x1 FUNCTION_LIST PROKON FUEDK IF_DATA DIM_X 0xFD74 INTERN BYTE IF_DATA MCMESS 0xFD74 INTERN /end MEASUREMENT
/begin MEASUREMENT B_frao "Einschaltbedingung für Adaption von frao" UWORD B_TRUE 1 100 0 1 BIT_MASK 0x10 FUNCTION_LIST LRA BBTEGA DKVS IF_DATA DIM_X 0xFD5A INTERN BYTE IF_DATA MCMESS 0xFD5A INTERN /end MEASUREMENT
/begin MEASUREMENT B_fraoan "Anforderung TEV schnell schließen zur Aktivierung der Gemischadaption" UWORD B_TRUE 1 100 0 1 BIT_MASK 0x4000 FUNCTION_LIST BBTEGA TEBEB IF_DATA DIM_X 0xFD4C INTERN BYTE IF_DATA MCMESS 0xFD4C INTERN /end MEASUREMENT
/begin MEASUREMENT B_fraor "Bedingung frao-Integrator außerhalb reduzierter Bereich" UWORD B_TRUE 1 100 0 1 BIT_MASK 0x20 FUNCTION_LIST LRA IF_DATA DIM_X 0xFD5A INTERN BYTE IF_DATA MCMESS 0xFD5A INTERN /end MEASUREMENT
/begin MEASUREMENT B_fraor2 "Bedingung frao2-Integrator außerhalb reduzierter Bereich" UWORD B_TRUE 1 100 0 1 BIT_MASK 0x40 FUNCTION_LIST LRA IF_DATA DIM_X 0xFD5A INTERN BYTE IF_DATA MCMESS 0xFD5A INTERN /end MEASUREMENT
/begin MEASUREMENT B_frau "Einschaltbedingung für Adaption von frau" UWORD B_TRUE 1 100 0 1 BIT_MASK 0x80 FUNCTION_LIST LRA DKVS IF_DATA DIM_X 0xFD5A INTERN BYTE IF_DATA MCMESS 0xFD5A INTERN /end MEASUREMENT
/begin MEASUREMENT B_fraur "Bedingung frau-Integrator außerhalb reduzierter Bereich" UWORD B_TRUE 1 100 0 1 BIT_MASK 0x100 FUNCTION_LIST LRA DKVS IF_DATA DIM_X 0xFD5A INTERN BYTE IF_DATA MCMESS 0xFD5A INTERN /end MEASUREMENT
/begin MEASUREMENT B_fraur2 "Bedingung frau2-Integrator außerhalb reduzierter Bereich" UWORD B_TRUE 1 100 0 1 BIT_MASK 0x200 FUNCTION_LIST LRA DKVS IF_DATA DIM_X 0xFD5A INTERN BYTE IF_DATA MCMESS 0xFD5A INTERN /end MEASUREMENT
/begin MEASUREMENT B_frdvs "Freigabe der Lambdaabfrage für die Diagnose kleiner Hub" UBYTE B_TRUE 1 100 0 1 BIT_MASK 0x1 FUNCTION_LIST DVS T2LID IF_DATA DIM_X 0x380CDB EXTERN BYTE IF_DATA MCMESS 0x380CDB EXTERN /end MEASUREMENT
/begin MEASUREMENT B_frini "Bedingung Regelfaktor fr initialisieren" UWORD B_TRUE 1 100 0 1 BIT_MASK 0x2 FUNCTION_LIST LRSINI LRS IF_DATA DIM_X 0xFD80 INTERN BYTE IF_DATA MCMESS 0xFD80 INTERN /end MEASUREMENT
/begin MEASUREMENT B_frini2 "Bedingung Regelfaktor fr initialisieren, Bank 2" UWORD B_TRUE 1 100 0 1 BIT_MASK 0x4 FUNCTION_LIST LRSINI LRS IF_DATA DIM_X 0xFD80 INTERN BYTE IF_DATA MCMESS 0xFD80 INTERN /end MEASUREMENT
/begin MEASUREMENT B_frmax "Lambda-Regelung setzt Bit sobald FR am Anschlag FRMAX" UWORD B_TRUE 1 100 0 1 BIT_MASK 0x100 FUNCTION_LIST LRS DKATLRS DLSH DLSU ESUKAS T2DFA TEB IF_DATA DIM_X 0xFD7A INTERN BYTE IF_DATA MCMESS 0xFD7A INTERN /end MEASUREMENT
/begin MEASUREMENT B_frmax2 "Lambda-Regelung setzt Bit sobald FR am Anschlag FRMAX, Bank 2" UWORD B_TRUE 1 100 0 1 BIT_MASK 0x200 FUNCTION_LIST LRS DKATLRS DLSH DLSU ESUKAS T2DFA TEB IF_DATA DIM_X 0xFD7A INTERN BYTE IF_DATA MCMESS 0xFD7A INTERN /end MEASUREMENT
/begin MEASUREMENT B_frmin "Lambda-Regelung setzt Bit sobald FR am Anschlag FRMIN" UWORD B_TRUE 1 100 0 1 BIT_MASK 0x400 FUNCTION_LIST LRS DKATLRS DLSU ESUKAS T2DFA TEB IF_DATA DIM_X 0xFD7A INTERN BYTE IF_DATA MCMESS 0xFD7A INTERN /end MEASUREMENT
/begin MEASUREMENT B_frmin2 "Lambda-Regelung setzt Bit sobald FR am Anschlag FRMIN, Bank 2" UWORD B_TRUE 1 100 0 1 BIT_MASK 0x800 FUNCTION_LIST LRS DKATLRS DLSU ESUKAS T2DFA TEB IF_DATA DIM_X 0xFD7A INTERN BYTE IF_DATA MCMESS 0xFD7A INTERN /end MEASUREMENT
/begin MEASUREMENT B_frmlash "Bedingung Mittelwert des Lambdaregelfaktors innerhalb den Schwellen" UWORD B_TRUE 1 100 0 1 BIT_MASK 0x400 FUNCTION_LIST DLSAHK IF_DATA DIM_X 0xFD24 INTERN BYTE IF_DATA MCMESS 0xFD24 INTERN /end MEASUREMENT
/begin MEASUREMENT B_frmlash2 "Bedingung Mittelwert des Lambdaregelfaktors innerhalb den Schwellen Bank2" UWORD B_TRUE 1 100 0 1 BIT_MASK 0x800 FUNCTION_LIST DLSAHK IF_DATA DIM_X 0xFD24 INTERN BYTE IF_DATA MCMESS 0xFD24 INTERN /end MEASUREMENT
/begin MEASUREMENT B_frste "Bedingung frm_w eingeschwungen (Kurztest)" UWORD B_TRUE 1 100 0 1 BIT_MASK 0x8000 FUNCTION_LIST DKVS IF_DATA DIM_X 0xFD50 INTERN BYTE IF_DATA MCMESS 0xFD50 INTERN /end MEASUREMENT
/begin MEASUREMENT B_frste2 "Bedingung frm2_w eingeschwungen (Kurztest 2. Bank)" UWORD B_TRUE 1 100 0 1 BIT_MASK 0x1 FUNCTION_LIST DKVS IF_DATA DIM_X 0xFD52 INTERN BYTE IF_DATA MCMESS 0xFD52 INTERN /end MEASUREMENT
/begin MEASUREMENT B_fs "Bedingung Fahrstufe" UWORD B_TRUE 1 100 0 1 BIT_MASK 0x40 FUNCTION_LIST BBGANG BBKHZ DTEV LLRBB LLRNS MDVERAD MDWAN SLS T2DFA IF_DATA DIM_X 0xFD34 INTERN BYTE IF_DATA MCMESS 0xFD34 INTERN /end MEASUREMENT
/begin MEASUREMENT B_fstdmn "Bedingung minimaler Tankfuellstand fuer Diagnosefunkionen" UWORD B_TRUE 1 100 0 1 BIT_MASK 0x40 FUNCTION_LIST SWADP IF_DATA DIM_X 0xFD84 INTERN BYTE IF_DATA MCMESS 0xFD84 INTERN /end MEASUREMENT
/begin MEASUREMENT B_fstdmx "Bedingung maximaler Tankfuellstand fuer Diagnosefunktionen" UWORD B_TRUE 1 100 0 1 BIT_MASK 0x80 FUNCTION_LIST SWADP IF_DATA DIM_X 0xFD84 INTERN BYTE IF_DATA MCMESS 0xFD84 INTERN /end MEASUREMENT
/begin MEASUREMENT B_fsu "Bedingung Fahrstufe, Umschaltung" UWORD B_TRUE 1 100 0 1 BIT_MASK 0x400 FUNCTION_LIST MDWAN IF_DATA DIM_X 0xFD6A INTERN BYTE IF_DATA MCMESS 0xFD6A INTERN /end MEASUREMENT
/begin MEASUREMENT B_ftaave "Bedingung: Fehlereintrag durch Tester für AAV Endstufe" UWORD B_TRUE 1 100 0 1 BIT_MASK 0x10 FUNCTION_LIST DFPM_DEKON IF_DATA DIM_X 0x383816 EXTERN BYTE IF_DATA MCMESS 0x383816 EXTERN /end MEASUREMENT
/begin MEASUREMENT B_ftagre "Bedingung: Fehlereintrag durch Tester" UWORD B_TRUE 1 100 0 1 BIT_MASK 0x10 FUNCTION_LIST DFPM_DUMMY043 IF_DATA DIM_X 0x383818 EXTERN BYTE IF_DATA MCMESS 0x383818 EXTERN /end MEASUREMENT
/begin MEASUREMENT B_ftbm "" UWORD B_TRUE 1 100 0 1 BIT_MASK 0x10 FUNCTION_LIST DFPM_DDG IF_DATA DIM_X 0x38381C EXTERN BYTE IF_DATA MCMESS 0x38381C EXTERN /end MEASUREMENT
/begin MEASUREMENT B_ftbrems "Bedingung: Fehlereintrag durch Tester für Bremsschalter" UWORD B_TRUE 1 100 0 1 BIT_MASK 0x10 FUNCTION_LIST DFPM_GGEGAS IF_DATA DIM_X 0x38381E EXTERN BYTE IF_DATA MCMESS 0x38381E EXTERN /end MEASUREMENT
/begin MEASUREMENT B_ftbwf "Bedingung Fehlereintrag durch Tester für Bewegungsfehler FPM" UWORD B_TRUE 1 100 0 1 BIT_MASK 0x10 FUNCTION_LIST DFPM_GGPED IF_DATA DIM_X 0x383820 EXTERN BYTE IF_DATA MCMESS 0x383820 EXTERN /end MEASUREMENT
/begin MEASUREMENT B_ftcas "Bedingung Fehlereintrag durch Tester: CAN-Schnittstelle ABS" UWORD B_TRUE 1 100 0 1 BIT_MASK 0x10 FUNCTION_LIST DFPM_DCAS IF_DATA DIM_X 0x383822 EXTERN BYTE IF_DATA MCMESS 0x383822 EXTERN /end MEASUREMENT
/begin MEASUREMENT B_ftcge "Bedingung Fehlereintrag durch Tester: CAN-Schnittstelle TCM" UWORD B_TRUE 1 100 0 1 BIT_MASK 0x10 FUNCTION_LIST DFPM_DCGE IF_DATA DIM_X 0x383824 EXTERN BYTE IF_DATA MCMESS 0x383824 EXTERN /end MEASUREMENT
/begin MEASUREMENT B_ftcgegs "" UWORD B_TRUE 1 100 0 1 BIT_MASK 0x10 FUNCTION_LIST DFPM_DCG IF_DATA DIM_X 0x383826 EXTERN BYTE IF_DATA MCMESS 0x383826 EXTERN /end MEASUREMENT
/begin MEASUREMENT B_ftcgggp "" UWORD B_TRUE 1 100 0 1 BIT_MASK 0x10 FUNCTION_LIST DFPM_DCG IF_DATA DIM_X 0x383828 EXTERN BYTE IF_DATA MCMESS 0x383828 EXTERN /end MEASUREMENT
/begin MEASUREMENT B_ftcgggv "" UWORD B_TRUE 1 100 0 1 BIT_MASK 0x10 FUNCTION_LIST DFPM_DCG IF_DATA DIM_X 0x38382A EXTERN BYTE IF_DATA MCMESS 0x38382A EXTERN /end MEASUREMENT
/begin MEASUREMENT B_ftcgm1v "" UWORD B_TRUE 1 100 0 1 BIT_MASK 0x10 FUNCTION_LIST DFPM_DCG IF_DATA DIM_X 0x38382C EXTERN BYTE IF_DATA MCMESS 0x38382C EXTERN /end MEASUREMENT
/begin MEASUREMENT B_ftcgm2v "" UWORD B_TRUE 1 100 0 1 BIT_MASK 0x10 FUNCTION_LIST DFPM_DCG IF_DATA DIM_X 0x38382E EXTERN BYTE IF_DATA MCMESS 0x38382E EXTERN /end MEASUREMENT
/begin MEASUREMENT B_ftcgm3v "" UWORD B_TRUE 1 100 0 1 BIT_MASK 0x10 FUNCTION_LIST DFPM_DCG IF_DATA DIM_X 0x383830 EXTERN BYTE IF_DATA MCMESS 0x383830 EXTERN /end MEASUREMENT
/begin MEASUREMENT B_ftcgmvk "" UWORD B_TRUE 1 100 0 1 BIT_MASK 0x10 FUNCTION_LIST DFPM_DCG IF_DATA DIM_X 0x383832 EXTERN BYTE IF_DATA MCMESS 0x383832 EXTERN /end MEASUREMENT
/begin MEASUREMENT B_ftcgrmm "" UWORD B_TRUE 1 100 0 1 BIT_MASK 0x10 FUNCTION_LIST DFPM_DCG IF_DATA DIM_X 0x383834 EXTERN BYTE IF_DATA MCMESS 0x383834 EXTERN /end MEASUREMENT
/begin MEASUREMENT B_ftcgrms "" UWORD B_TRUE 1 100 0 1 BIT_MASK 0x10 FUNCTION_LIST DFPM_DCG IF_DATA DIM_X 0x383836 EXTERN BYTE IF_DATA MCMESS 0x383836 EXTERN /end MEASUREMENT
/begin MEASUREMENT B_ftcgudg "" UWORD B_TRUE 1 100 0 1 BIT_MASK 0x10 FUNCTION_LIST DFPM_DCG IF_DATA DIM_X 0x383838 EXTERN BYTE IF_DATA MCMESS 0x383838 EXTERN /end MEASUREMENT
/begin MEASUREMENT B_ftcgumv "" UWORD B_TRUE 1 100 0 1 BIT_MASK 0x10 FUNCTION_LIST DFPM_DCG IF_DATA DIM_X 0x38383A EXTERN BYTE IF_DATA MCMESS 0x38383A EXTERN /end MEASUREMENT
/begin MEASUREMENT B_ftcgvgc "" UWORD B_TRUE 1 100 0 1 BIT_MASK 0x10 FUNCTION_LIST DFPM_DCG IF_DATA DIM_X 0x38383C EXTERN BYTE IF_DATA MCMESS 0x38383C EXTERN /end MEASUREMENT
/begin MEASUREMENT B_ftcgvrc "" UWORD B_TRUE 1 100 0 1 BIT_MASK 0x10 FUNCTION_LIST DFPM_DCG IF_DATA DIM_X 0x38383E EXTERN BYTE IF_DATA MCMESS 0x38383E EXTERN /end MEASUREMENT
/begin MEASUREMENT B_ftcgwk "" UWORD B_TRUE 1 100 0 1 BIT_MASK 0x10 FUNCTION_LIST DFPM_DCG IF_DATA DIM_X 0x383840 EXTERN BYTE IF_DATA MCMESS 0x383840 EXTERN /end MEASUREMENT
/begin MEASUREMENT B_ftckbi "" UWORD B_TRUE 1 100 0 1 BIT_MASK 0x10 FUNCTION_LIST DFPM_DCKBI IF_DATA DIM_X 0x383842 EXTERN BYTE IF_DATA MCMESS 0x383842 EXTERN /end MEASUREMENT
/begin MEASUREMENT B_ftcmil "" UWORD B_TRUE 1 100 0 1 BIT_MASK 0x10 FUNCTION_LIST DFPM_DCMIL IF_DATA DIM_X 0x383844 EXTERN BYTE IF_DATA MCMESS 0x383844 EXTERN /end MEASUREMENT
/begin MEASUREMENT B_ftcra "" UWORD B_TRUE 1 100 0 1 BIT_MASK 0x10 FUNCTION_LIST DFPM_GGAIRBAG IF_DATA DIM_X 0x383846 EXTERN BYTE IF_DATA MCMESS 0x383846 EXTERN /end MEASUREMENT
/begin MEASUREMENT B_ftdk "" UWORD B_TRUE 1 100 0 1 BIT_MASK 0x10 FUNCTION_LIST DFPM_DDVE IF_DATA DIM_X 0x383848 EXTERN BYTE IF_DATA MCMESS 0x383848 EXTERN /end MEASUREMENT
/begin MEASUREMENT B_ftdk1p "" UWORD B_TRUE 1 100 0 1 BIT_MASK 0x10 FUNCTION_LIST DFPM_DDVE IF_DATA DIM_X 0x38384A EXTERN BYTE IF_DATA MCMESS 0x38384A EXTERN /end MEASUREMENT
/begin MEASUREMENT B_ftdk2p "" UWORD B_TRUE 1 100 0 1 BIT_MASK 0x10 FUNCTION_LIST DFPM_DDVE IF_DATA DIM_X 0x38384C EXTERN BYTE IF_DATA MCMESS 0x38384C EXTERN /end MEASUREMENT
/begin MEASUREMENT B_ftdsl "Bedingung: Fehlereintrag durch Tester für DSL" UWORD B_TRUE 1 100 0 1 BIT_MASK 0x10 FUNCTION_LIST DFPM_GGDSAS IF_DATA DIM_X 0x383850 EXTERN BYTE IF_DATA MCMESS 0x383850 EXTERN /end MEASUREMENT
/begin MEASUREMENT B_ftdsu "Bedingung: Fehlereintrag durch Tester für DSU" UWORD B_TRUE 1 100 0 1 BIT_MASK 0x10 FUNCTION_LIST DFPM_GGDSAS IF_DATA DIM_X 0x383852 EXTERN BYTE IF_DATA MCMESS 0x383852 EXTERN /end MEASUREMENT
/begin MEASUREMENT B_ftdsvlu "Bedingung: Fehlereintrag durch Tester für DSVLU" UWORD B_TRUE 1 100 0 1 BIT_MASK 0x10 FUNCTION_LIST DFPM_GGDSAS IF_DATA DIM_X 0x383854 EXTERN BYTE IF_DATA MCMESS 0x383854 EXTERN /end MEASUREMENT
/begin MEASUREMENT B_ftdvee "" UWORD B_TRUE 1 100 0 1 BIT_MASK 0x10 FUNCTION_LIST DFPM_DDVE IF_DATA DIM_X 0x383856 EXTERN BYTE IF_DATA MCMESS 0x383856 EXTERN /end MEASUREMENT
/begin MEASUREMENT B_ftdvef "" UWORD B_TRUE 1 100 0 1 BIT_MASK 0x10 FUNCTION_LIST DFPM_DDVE IF_DATA DIM_X 0x383858 EXTERN BYTE IF_DATA MCMESS 0x383858 EXTERN /end MEASUREMENT
/begin MEASUREMENT B_ftdvefo "" UWORD B_TRUE 1 100 0 1 BIT_MASK 0x10 FUNCTION_LIST DFPM_DDVE IF_DATA DIM_X 0x38385A EXTERN BYTE IF_DATA MCMESS 0x38385A EXTERN /end MEASUREMENT
/begin MEASUREMENT B_ftdvel "" UWORD B_TRUE 1 100 0 1 BIT_MASK 0x10 FUNCTION_LIST DFPM_DDVE IF_DATA DIM_X 0x38385C EXTERN BYTE IF_DATA MCMESS 0x38385C EXTERN /end MEASUREMENT
/begin MEASUREMENT B_ftdven "" UWORD B_TRUE 1 100 0 1 BIT_MASK 0x10 FUNCTION_LIST DFPM_DDVE IF_DATA DIM_X 0x38385E EXTERN BYTE IF_DATA MCMESS 0x38385E EXTERN /end MEASUREMENT
/begin MEASUREMENT B_ftdver "" UWORD B_TRUE 1 100 0 1 BIT_MASK 0x10 FUNCTION_LIST DFPM_DDVE IF_DATA DIM_X 0x383860 EXTERN BYTE IF_DATA MCMESS 0x383860 EXTERN /end MEASUREMENT
/begin MEASUREMENT B_ftdvet "" UWORD B_TRUE 1 100 0 1 BIT_MASK 0x10 FUNCTION_LIST DFPM_DDVE IF_DATA DIM_X 0x383862 EXTERN BYTE IF_DATA MCMESS 0x383862 EXTERN /end MEASUREMENT
/begin MEASUREMENT B_ftdveu "" UWORD B_TRUE 1 100 0 1 BIT_MASK 0x10 FUNCTION_LIST DFPM_DDVE IF_DATA DIM_X 0x383864 EXTERN BYTE IF_DATA MCMESS 0x383864 EXTERN /end MEASUREMENT
/begin MEASUREMENT B_ftdveub "" UWORD B_TRUE 1 100 0 1 BIT_MASK 0x10 FUNCTION_LIST DFPM_DDVE IF_DATA DIM_X 0x383866 EXTERN BYTE IF_DATA MCMESS 0x383866 EXTERN /end MEASUREMENT
/begin MEASUREMENT B_ftdveuw "" UWORD B_TRUE 1 100 0 1 BIT_MASK 0x10 FUNCTION_LIST DFPM_DDVE IF_DATA DIM_X 0x383868 EXTERN BYTE IF_DATA MCMESS 0x383868 EXTERN /end MEASUREMENT
/begin MEASUREMENT B_ftdvev "" UWORD B_TRUE 1 100 0 1 BIT_MASK 0x10 FUNCTION_LIST DFPM_DDVE IF_DATA DIM_X 0x38386A EXTERN BYTE IF_DATA MCMESS 0x38386A EXTERN /end MEASUREMENT
/begin MEASUREMENT B_ftedab "Bedingung Spülrate für Diagnose zusteuern" UWORD B_TRUE 1 100 0 1 BIT_MASK 0x20 FUNCTION_LIST DTEV TEBEB IF_DATA DIM_X 0xFD8C INTERN BYTE IF_DATA MCMESS 0xFD8C INTERN /end MEASUREMENT
/begin MEASUREMENT B_ftegfe "Bedingung: Fehlereintrag durch Tester für DEGFE" UWORD B_TRUE 1 100 0 1 BIT_MASK 0x10 FUNCTION_LIST DFPM_EGFE IF_DATA DIM_X 0x38386C EXTERN BYTE IF_DATA MCMESS 0x38386C EXTERN /end MEASUREMENT
/begin MEASUREMENT B_ftev1 "Bedingung: Fehlereintrag durch Tester für Endstufendiagnose EV1" UWORD B_TRUE 1 100 0 1 BIT_MASK 0x10 FUNCTION_LIST DFPM_DEKON IF_DATA DIM_X 0x38386E EXTERN BYTE IF_DATA MCMESS 0x38386E EXTERN /end MEASUREMENT
/begin MEASUREMENT B_ftev2 "Bedingung: Fehlereintrag durch Tester für Endstufendiagnose EV2" UWORD B_TRUE 1 100 0 1 BIT_MASK 0x10 FUNCTION_LIST DFPM_DEKON IF_DATA DIM_X 0x383870 EXTERN BYTE IF_DATA MCMESS 0x383870 EXTERN /end MEASUREMENT
/begin MEASUREMENT B_ftev3 "Bedingung: Fehlereintrag durch Tester für Endstufendiagnose EV3" UWORD B_TRUE 1 100 0 1 BIT_MASK 0x10 FUNCTION_LIST DFPM_DEKON IF_DATA DIM_X 0x383872 EXTERN BYTE IF_DATA MCMESS 0x383872 EXTERN /end MEASUREMENT
/begin MEASUREMENT B_ftev4 "Bedingung: Fehlereintrag durch Tester für Endstufendiagnose EV4" UWORD B_TRUE 1 100 0 1 BIT_MASK 0x10 FUNCTION_LIST DFPM_DEKON IF_DATA DIM_X 0x383874 EXTERN BYTE IF_DATA MCMESS 0x383874 EXTERN /end MEASUREMENT
/begin MEASUREMENT B_ftev5 "Bedingung: Fehlereintrag durch Tester für Endstufendiagnose EV5" UWORD B_TRUE 1 100 0 1 BIT_MASK 0x10 FUNCTION_LIST DFPM_DEKON IF_DATA DIM_X 0x383876 EXTERN BYTE IF_DATA MCMESS 0x383876 EXTERN /end MEASUREMENT
/begin MEASUREMENT B_ftev6 "Bedingung: Fehlereintrag durch Tester für Endstufendiagnose EV6" UWORD B_TRUE 1 100 0 1 BIT_MASK 0x10 FUNCTION_LIST DFPM_DEKON IF_DATA DIM_X 0x383878 EXTERN BYTE IF_DATA MCMESS 0x383878 EXTERN /end MEASUREMENT
/begin MEASUREMENT B_ftfgrl "" UWORD B_TRUE 1 100 0 1 BIT_MASK 0x10 FUNCTION_LIST DFPM_DCFGRL IF_DATA DIM_X 0x38387A EXTERN BYTE IF_DATA MCMESS 0x38387A EXTERN /end MEASUREMENT
/begin MEASUREMENT B_ftfp1p "Bedingung Fehlereintrag durch Tester für Poti1 FPM" UWORD B_TRUE 1 100 0 1 BIT_MASK 0x10 FUNCTION_LIST DFPM_GGPED IF_DATA DIM_X 0x38387C EXTERN BYTE IF_DATA MCMESS 0x38387C EXTERN /end MEASUREMENT
/begin MEASUREMENT B_ftfp2p "Bedingung Fehlereintrag durch Tester für Poti2 FPM" UWORD B_TRUE 1 100 0 1 BIT_MASK 0x10 FUNCTION_LIST DFPM_GGPED IF_DATA DIM_X 0x38387E EXTERN BYTE IF_DATA MCMESS 0x38387E EXTERN /end MEASUREMENT
/begin MEASUREMENT B_ftfpp "Bedingung Fehlereintrag durch Tester für FPM" UWORD B_TRUE 1 100 0 1 BIT_MASK 0x10 FUNCTION_LIST DFPM_GGPED IF_DATA DIM_X 0x383880 EXTERN BYTE IF_DATA MCMESS 0x383880 EXTERN /end MEASUREMENT
/begin MEASUREMENT B_ftfrao "Bedingung Fehlereintrag durch Tester für FRAO" UWORD B_TRUE 1 100 0 1 BIT_MASK 0x10 FUNCTION_LIST DFPM_DKVS IF_DATA DIM_X 0x383882 EXTERN BYTE IF_DATA MCMESS 0x383882 EXTERN /end MEASUREMENT
/begin MEASUREMENT B_ftfrao2 "Bedingung Fehlereintrag durch Tester für FRAO2" UWORD B_TRUE 1 100 0 1 BIT_MASK 0x10 FUNCTION_LIST DFPM_DKVS IF_DATA DIM_X 0x383884 EXTERN BYTE IF_DATA MCMESS 0x383884 EXTERN /end MEASUREMENT
/begin MEASUREMENT B_ftfrau "Bedingung Fehlereintrag durch Tester für FRAU" UWORD B_TRUE 1 100 0 1 BIT_MASK 0x10 FUNCTION_LIST DFPM_DKVS IF_DATA DIM_X 0x383886 EXTERN BYTE IF_DATA MCMESS 0x383886 EXTERN /end MEASUREMENT
/begin MEASUREMENT B_ftfrau2 "Bedingung Fehlereintrag durch Tester für FRAU2" UWORD B_TRUE 1 100 0 1 BIT_MASK 0x10 FUNCTION_LIST DFPM_DKVS IF_DATA DIM_X 0x383888 EXTERN BYTE IF_DATA MCMESS 0x383888 EXTERN /end MEASUREMENT
/begin MEASUREMENT B_ftfrst "Bedingung Fehlereintrag durch Tester für FRST (FR-Kurztest)" UWORD B_TRUE 1 100 0 1 BIT_MASK 0x10 FUNCTION_LIST DFPM_DKVS IF_DATA DIM_X 0x38388A EXTERN BYTE IF_DATA MCMESS 0x38388A EXTERN /end MEASUREMENT
/begin MEASUREMENT B_ftfrst2 "Bedingung Fehlereintrag durch Tester für FRST (FR-Kurztest Bank 2)" UWORD B_TRUE 1 100 0 1 BIT_MASK 0x10 FUNCTION_LIST DFPM_DKVS IF_DATA DIM_X 0x38388C EXTERN BYTE IF_DATA MCMESS 0x38388C EXTERN /end MEASUREMENT
/begin MEASUREMENT B_fthsh "Bedingung Fehlereintrag durch Tester für Lambdasonden-Heizung hinter Kat" UWORD B_TRUE 1 100 0 1 BIT_MASK 0x10 FUNCTION_LIST DFPM_DHLSHK IF_DATA DIM_X 0x38388E EXTERN BYTE IF_DATA MCMESS 0x38388E EXTERN /end MEASUREMENT
/begin MEASUREMENT B_fthsh2 "Bedingung Fehlereintrag durch Tester für Lambdasonden-Heizung 2 hinter Kat" UWORD B_TRUE 1 100 0 1 BIT_MASK 0x10 FUNCTION_LIST DFPM_DHLSHK IF_DATA DIM_X 0x383890 EXTERN BYTE IF_DATA MCMESS 0x383890 EXTERN /end MEASUREMENT
/begin MEASUREMENT B_fthshe "Bedingung Fehlereintrag durch Tester für Endstufe LS-Heizung hinter Kat" UWORD B_TRUE 1 100 0 1 BIT_MASK 0x10 FUNCTION_LIST DFPM_DEKON IF_DATA DIM_X 0x383892 EXTERN BYTE IF_DATA MCMESS 0x383892 EXTERN /end MEASUREMENT
/begin MEASUREMENT B_fthshe2 "Bedingung Fehlereintrag durch Tester für Endstufe LS-Heizung hinter Kat, Bank 2" UWORD B_TRUE 1 100 0 1 BIT_MASK 0x10 FUNCTION_LIST DFPM_DEKON IF_DATA DIM_X 0x383894 EXTERN BYTE IF_DATA MCMESS 0x383894 EXTERN /end MEASUREMENT
/begin MEASUREMENT B_fthsv "Bedingung Fehlereintrag durch Tester für LSU-Heizung" UWORD B_TRUE 1 100 0 1 BIT_MASK 0x10 FUNCTION_LIST DFPM_DHLSU IF_DATA DIM_X 0x383896 EXTERN BYTE IF_DATA MCMESS 0x383896 EXTERN /end MEASUREMENT
/begin MEASUREMENT B_fthsv2 "Bedingung Fehlereintrag durch Tester für LSU-Heizung, Bank 2" UWORD B_TRUE 1 100 0 1 BIT_MASK 0x10 FUNCTION_LIST DFPM_DHLSU IF_DATA DIM_X 0x383898 EXTERN BYTE IF_DATA MCMESS 0x383898 EXTERN /end MEASUREMENT
/begin MEASUREMENT B_fthsvsa "Bedingung Fehlereintrag durch Tester für LSU-Heizung" UWORD B_TRUE 1 100 0 1 BIT_MASK 0x10 FUNCTION_LIST DFPM_DHLSU IF_DATA DIM_X 0x38389A EXTERN BYTE IF_DATA MCMESS 0x38389A EXTERN /end MEASUREMENT
/begin MEASUREMENT B_fthsvsa2 "Bedingung Fehlereintrag durch Tester für LSU-Heizung, Bank 2" UWORD B_TRUE 1 100 0 1 BIT_MASK 0x10 FUNCTION_LIST DFPM_DHLSU IF_DATA DIM_X 0x38389C EXTERN BYTE IF_DATA MCMESS 0x38389C EXTERN /end MEASUREMENT
/begin MEASUREMENT B_ftkat "Bedingung: Fehlereintrag durch Tester für Katalysator" UWORD B_TRUE 1 100 0 1 BIT_MASK 0x10 FUNCTION_LIST DFPM_DKAT IF_DATA DIM_X 0x38389E EXTERN BYTE IF_DATA MCMESS 0x38389E EXTERN /end MEASUREMENT
/begin MEASUREMENT B_ftkat2 "Bedingung: Fehlereintrag durch Tester für Katalysator, Bank2" UWORD B_TRUE 1 100 0 1 BIT_MASK 0x10 FUNCTION_LIST DFPM_DKAT IF_DATA DIM_X 0x3838A0 EXTERN BYTE IF_DATA MCMESS 0x3838A0 EXTERN /end MEASUREMENT
/begin MEASUREMENT B_ftkos "" UWORD B_TRUE 1 100 0 1 BIT_MASK 0x10 FUNCTION_LIST DFPM_DEKON IF_DATA DIM_X 0x3838A2 EXTERN BYTE IF_DATA MCMESS 0x3838A2 EXTERN /end MEASUREMENT
/begin MEASUREMENT B_ftkpe "Bedingung: Fehlereintrag durch Tester für Endstufendiagnose EKP" UWORD B_TRUE 1 100 0 1 BIT_MASK 0x10 FUNCTION_LIST DFPM_DEKON IF_DATA DIM_X 0x3838A4 EXTERN BYTE IF_DATA MCMESS 0x3838A4 EXTERN /end MEASUREMENT
/begin MEASUREMENT B_ftkrnt "" UWORD B_TRUE 1 100 0 1 BIT_MASK 0x10 FUNCTION_LIST DFPM_DKRNT IF_DATA DIM_X 0x3838A6 EXTERN BYTE IF_DATA MCMESS 0x3838A6 EXTERN /end MEASUREMENT
/begin MEASUREMENT B_ftkrof "" UWORD B_TRUE 1 100 0 1 BIT_MASK 0x10 FUNCTION_LIST DFPM_DKRNT IF_DATA DIM_X 0x3838A8 EXTERN BYTE IF_DATA MCMESS 0x3838A8 EXTERN /end MEASUREMENT
/begin MEASUREMENT B_ftkrtp "" UWORD B_TRUE 1 100 0 1 BIT_MASK 0x10 FUNCTION_LIST DFPM_DKRTP IF_DATA DIM_X 0x3838AA EXTERN BYTE IF_DATA MCMESS 0x3838AA EXTERN /end MEASUREMENT
/begin MEASUREMENT B_ftks1 "" UWORD B_TRUE 1 100 0 1 BIT_MASK 0x10 FUNCTION_LIST DFPM_DKRS IF_DATA DIM_X 0x3838AC EXTERN BYTE IF_DATA MCMESS 0x3838AC EXTERN /end MEASUREMENT
/begin MEASUREMENT B_ftks2 "" UWORD B_TRUE 1 100 0 1 BIT_MASK 0x10 FUNCTION_LIST DFPM_DKRS IF_DATA DIM_X 0x3838AE EXTERN BYTE IF_DATA MCMESS 0x3838AE EXTERN /end MEASUREMENT
/begin MEASUREMENT B_ftks3 "" UWORD B_TRUE 1 100 0 1 BIT_MASK 0x10 FUNCTION_LIST DFPM_DKRS IF_DATA DIM_X 0x3838B0 EXTERN BYTE IF_DATA MCMESS 0x3838B0 EXTERN /end MEASUREMENT
/begin MEASUREMENT B_ftks4 "" UWORD B_TRUE 1 100 0 1 BIT_MASK 0x10 FUNCTION_LIST DFPM_DKRS IF_DATA DIM_X 0x3838B2 EXTERN BYTE IF_DATA MCMESS 0x3838B2 EXTERN /end MEASUREMENT
/begin MEASUREMENT B_ftkuppl "" UWORD B_TRUE 1 100 0 1 BIT_MASK 0x10 FUNCTION_LIST DFPM_DKUPPL IF_DATA DIM_X 0x3838B4 EXTERN BYTE IF_DATA MCMESS 0x3838B4 EXTERN /end MEASUREMENT
/begin MEASUREMENT B_ftkwave "" UWORD B_TRUE 1 100 0 1 BIT_MASK 0x10 FUNCTION_LIST DFPM_DEKON IF_DATA DIM_X 0x3838B6 EXTERN BYTE IF_DATA MCMESS 0x3838B6 EXTERN /end MEASUREMENT
/begin MEASUREMENT B_ftlde "Bedingung: Fehlereintrag durch Ladedrucksteuerventil (Tester)" UWORD B_TRUE 1 100 0 1 BIT_MASK 0x10 FUNCTION_LIST DFPM_DEKON IF_DATA DIM_X 0x3838BC EXTERN BYTE IF_DATA MCMESS 0x3838BC EXTERN /end MEASUREMENT
/begin MEASUREMENT B_ftldo "Bedingung: Fehlereintrag durch Tester für LDO" UWORD B_TRUE 1 100 0 1 BIT_MASK 0x10 FUNCTION_LIST DFPM_DLDR IF_DATA DIM_X 0x3838BE EXTERN BYTE IF_DATA MCMESS 0x3838BE EXTERN /end MEASUREMENT
/begin MEASUREMENT B_ftldra "Bedingung: Fehlereintrag durch Tester für LDRA" UWORD B_TRUE 1 100 0 1 BIT_MASK 0x10 FUNCTION_LIST DFPM_DLDR IF_DATA DIM_X 0x3838C0 EXTERN BYTE IF_DATA MCMESS 0x3838C0 EXTERN /end MEASUREMENT
/begin MEASUREMENT B_ftlf1e "" UWORD B_TRUE 1 100 0 1 BIT_MASK 0x10 FUNCTION_LIST DFPM_DEKON IF_DATA DIM_X 0x3838C2 EXTERN BYTE IF_DATA MCMESS 0x3838C2 EXTERN /end MEASUREMENT
/begin MEASUREMENT B_ftlf2e "" UWORD B_TRUE 1 100 0 1 BIT_MASK 0x10 FUNCTION_LIST DFPM_DEKON IF_DATA DIM_X 0x3838C4 EXTERN BYTE IF_DATA MCMESS 0x3838C4 EXTERN /end MEASUREMENT
/begin MEASUREMENT B_ftlf3e "" UWORD B_TRUE 1 100 0 1 BIT_MASK 0x10 FUNCTION_LIST DFPM_DEKON IF_DATA DIM_X 0x3838C6 EXTERN BYTE IF_DATA MCMESS 0x3838C6 EXTERN /end MEASUREMENT
/begin MEASUREMENT B_ftllr "" UWORD B_TRUE 1 100 0 1 BIT_MASK 0x10 FUNCTION_LIST DFPM_DLLR IF_DATA DIM_X 0x3838C8 EXTERN BYTE IF_DATA MCMESS 0x3838C8 EXTERN /end MEASUREMENT
/begin MEASUREMENT B_ftlm "Bedingung: Fehlereintrag durch Tester für Luftmassensensor (HFM/DSS/DK)" UWORD B_TRUE 1 100 0 1 BIT_MASK 0x10 FUNCTION_LIST DFPM_DHFM IF_DATA DIM_X 0x3838CA EXTERN BYTE IF_DATA MCMESS 0x3838CA EXTERN /end MEASUREMENT
/begin MEASUREMENT B_ftlsh "Bedingung Fehlereintrag durch Tester Lambda Sonde hinter KAT" UWORD B_TRUE 1 100 0 1 BIT_MASK 0x10 FUNCTION_LIST DFPM_DLSH IF_DATA DIM_X 0x3838CC EXTERN BYTE IF_DATA MCMESS 0x3838CC EXTERN /end MEASUREMENT
/begin MEASUREMENT B_ftlsh2 "Bedingung Fehlereintrag durch Tester Lambda Sonde hinter KAT Bank2" UWORD B_TRUE 1 100 0 1 BIT_MASK 0x10 FUNCTION_LIST DFPM_DLSH IF_DATA DIM_X 0x3838CE EXTERN BYTE IF_DATA MCMESS 0x3838CE EXTERN /end MEASUREMENT
/begin MEASUREMENT B_ftlsv "Bedingung Fehlereintrag durch Tester Lambda Sonde vor KAT" UWORD B_TRUE 1 100 0 1 BIT_MASK 0x10 FUNCTION_LIST DFPM_DLSU IF_DATA DIM_X 0x3838D0 EXTERN BYTE IF_DATA MCMESS 0x3838D0 EXTERN /end MEASUREMENT
/begin MEASUREMENT B_ftlsv2 "Bedingung Fehlereintrag durch Tester Lambda Sonde vor KAT Bank2" UWORD B_TRUE 1 100 0 1 BIT_MASK 0x10 FUNCTION_LIST DFPM_DLSU IF_DATA DIM_X 0x3838D2 EXTERN BYTE IF_DATA MCMESS 0x3838D2 EXTERN /end MEASUREMENT
/begin MEASUREMENT B_ftlsvv "Bedingung Fehlereintrag durch Tester Lambda Sonde vertauscht vor KAT" UWORD B_TRUE 1 100 0 1 BIT_MASK 0x10 FUNCTION_LIST DFPM_LSVV IF_DATA DIM_X 0x3838D4 EXTERN BYTE IF_DATA MCMESS 0x3838D4 EXTERN /end MEASUREMENT
/begin MEASUREMENT B_ftmd "" UWORD B_TRUE 1 100 0 1 BIT_MASK 0x10 FUNCTION_LIST DFPM_DMDMIL IF_DATA DIM_X 0x3838D6 EXTERN BYTE IF_DATA MCMESS 0x3838D6 EXTERN /end MEASUREMENT
/begin MEASUREMENT B_ftmd00 "" UWORD B_TRUE 1 100 0 1 BIT_MASK 0x10 FUNCTION_LIST DFPM_DMDMIL IF_DATA DIM_X 0x3838D8 EXTERN BYTE IF_DATA MCMESS 0x3838D8 EXTERN /end MEASUREMENT
/begin MEASUREMENT B_ftmd01 "" UWORD B_TRUE 1 100 0 1 BIT_MASK 0x10 FUNCTION_LIST DFPM_DMDMIL IF_DATA DIM_X 0x3838DA EXTERN BYTE IF_DATA MCMESS 0x3838DA EXTERN /end MEASUREMENT
/begin MEASUREMENT B_ftmd02 "" UWORD B_TRUE 1 100 0 1 BIT_MASK 0x10 FUNCTION_LIST DFPM_DMDMIL IF_DATA DIM_X 0x3838DC EXTERN BYTE IF_DATA MCMESS 0x3838DC EXTERN /end MEASUREMENT
/begin MEASUREMENT B_ftmd03 "" UWORD B_TRUE 1 100 0 1 BIT_MASK 0x10 FUNCTION_LIST DFPM_DMDMIL IF_DATA DIM_X 0x3838DE EXTERN BYTE IF_DATA MCMESS 0x3838DE EXTERN /end MEASUREMENT
/begin MEASUREMENT B_ftmd04 "" UWORD B_TRUE 1 100 0 1 BIT_MASK 0x10 FUNCTION_LIST DFPM_DMDMIL IF_DATA DIM_X 0x3838E0 EXTERN BYTE IF_DATA MCMESS 0x3838E0 EXTERN /end MEASUREMENT
/begin MEASUREMENT B_ftmd05 "" UWORD B_TRUE 1 100 0 1 BIT_MASK 0x10 FUNCTION_LIST DFPM_DMDMIL IF_DATA DIM_X 0x3838E2 EXTERN BYTE IF_DATA MCMESS 0x3838E2 EXTERN /end MEASUREMENT
/begin MEASUREMENT B_ftmdb "Bedingung: Fehlereintrag durch Tester für MDB" UWORD B_TRUE 1 100 0 1 BIT_MASK 0x10 FUNCTION_LIST DFPM_MDKOG IF_DATA DIM_X 0x3838E4 EXTERN BYTE IF_DATA MCMESS 0x3838E4 EXTERN /end MEASUREMENT
/begin MEASUREMENT B_ftmsg "" UWORD B_TRUE 1 100 0 1 BIT_MASK 0x10 FUNCTION_LIST DFPM_MLS IF_DATA DIM_X 0x3838E6 EXTERN BYTE IF_DATA MCMESS 0x3838E6 EXTERN /end MEASUREMENT
/begin MEASUREMENT B_ftmsge "" UWORD B_TRUE 1 100 0 1 BIT_MASK 0x10 FUNCTION_LIST DFPM_DEKON IF_DATA DIM_X 0x3838E8 EXTERN BYTE IF_DATA MCMESS 0x3838E8 EXTERN /end MEASUREMENT
/begin MEASUREMENT B_ftn "" UWORD B_TRUE 1 100 0 1 BIT_MASK 0x10 FUNCTION_LIST DFPM_DDG IF_DATA DIM_X 0x3838EA EXTERN BYTE IF_DATA MCMESS 0x3838EA EXTERN /end MEASUREMENT
/begin MEASUREMENT B_ftnwkw "" UWORD B_TRUE 1 100 0 1 BIT_MASK 0x10 FUNCTION_LIST DFPM_DNWKW IF_DATA DIM_X 0x3838EC EXTERN BYTE IF_DATA MCMESS 0x3838EC EXTERN /end MEASUREMENT
/begin MEASUREMENT B_ftnwkw2 "" UWORD B_TRUE 1 100 0 1 BIT_MASK 0x10 FUNCTION_LIST DFPM_DNWKW IF_DATA DIM_X 0x3838EE EXTERN BYTE IF_DATA MCMESS 0x3838EE EXTERN /end MEASUREMENT
/begin MEASUREMENT B_ftnws "" UWORD B_TRUE 1 100 0 1 BIT_MASK 0x10 FUNCTION_LIST DFPM_DNWS IF_DATA DIM_X 0x3838F0 EXTERN BYTE IF_DATA MCMESS 0x3838F0 EXTERN /end MEASUREMENT
/begin MEASUREMENT B_ftnws2 "" UWORD B_TRUE 1 100 0 1 BIT_MASK 0x10 FUNCTION_LIST DFPM_DNWS IF_DATA DIM_X 0x3838F2 EXTERN BYTE IF_DATA MCMESS 0x3838F2 EXTERN /end MEASUREMENT
/begin MEASUREMENT B_ftnwse "Bedingung: Fehlereintrag durch Tester für Endstufe NWS" UWORD B_TRUE 1 100 0 1 BIT_MASK 0x10 FUNCTION_LIST DFPM_DEKON IF_DATA DIM_X 0x3838F4 EXTERN BYTE IF_DATA MCMESS 0x3838F4 EXTERN /end MEASUREMENT
/begin MEASUREMENT B_ftnwse2 "" UWORD B_TRUE 1 100 0 1 BIT_MASK 0x10 FUNCTION_LIST DFPM_DEKON IF_DATA DIM_X 0x3838F6 EXTERN BYTE IF_DATA MCMESS 0x3838F6 EXTERN /end MEASUREMENT
/begin MEASUREMENT B_ftph "Bedingung Fehlereintrag durch Tester für Phasensensor" UWORD B_TRUE 1 100 0 1 BIT_MASK 0x10 FUNCTION_LIST DFPM_DPH IF_DATA DIM_X 0x3838F8 EXTERN BYTE IF_DATA MCMESS 0x3838F8 EXTERN /end MEASUREMENT
/begin MEASUREMENT B_ftph2 "Bedingung: Fehlereintrag durch Tester für Phasengeber 2" UWORD B_TRUE 1 100 0 1 BIT_MASK 0x10 FUNCTION_LIST DFPM_DPH IF_DATA DIM_X 0x3838FA EXTERN BYTE IF_DATA MCMESS 0x3838FA EXTERN /end MEASUREMENT
/begin MEASUREMENT B_ftrkat "Bedingung Fehlereintrag durch Tester für RKAT" UWORD B_TRUE 1 100 0 1 BIT_MASK 0x10 FUNCTION_LIST DFPM_DKVS IF_DATA DIM_X 0x3838FC EXTERN BYTE IF_DATA MCMESS 0x3838FC EXTERN /end MEASUREMENT
/begin MEASUREMENT B_ftrkat2 "Bedingung Fehlereintrag durch Tester für RKAT2" UWORD B_TRUE 1 100 0 1 BIT_MASK 0x10 FUNCTION_LIST DFPM_DKVS IF_DATA DIM_X 0x3838FE EXTERN BYTE IF_DATA MCMESS 0x3838FE EXTERN /end MEASUREMENT
/begin MEASUREMENT B_ftrkaz "Bedingung Fehlereintrag durch Tester für RKAZ" UWORD B_TRUE 1 100 0 1 BIT_MASK 0x10 FUNCTION_LIST DFPM_DKVS IF_DATA DIM_X 0x383900 EXTERN BYTE IF_DATA MCMESS 0x383900 EXTERN /end MEASUREMENT
/begin MEASUREMENT B_ftrkaz2 "Bedingung Fehlereintrag durch Tester für RKAZ2" UWORD B_TRUE 1 100 0 1 BIT_MASK 0x10 FUNCTION_LIST DFPM_DKVS IF_DATA DIM_X 0x383902 EXTERN BYTE IF_DATA MCMESS 0x383902 EXTERN /end MEASUREMENT
/begin MEASUREMENT B_ftsgeep "" UWORD B_TRUE 1 100 0 1 BIT_MASK 0x10 FUNCTION_LIST DFPM_DSGEEP IF_DATA DIM_X 0x383904 EXTERN BYTE IF_DATA MCMESS 0x383904 EXTERN /end MEASUREMENT
/begin MEASUREMENT B_ftslpe "Bedingung Fehlereintrag durch Tester Sekundärluftpumpe Endstufe" UWORD B_TRUE 1 100 0 1 BIT_MASK 0x10 FUNCTION_LIST DFPM_DEKON IF_DATA DIM_X 0x383906 EXTERN BYTE IF_DATA MCMESS 0x383906 EXTERN /end MEASUREMENT
/begin MEASUREMENT B_ftsls "Bedingung: Fehlereintrag durch Tester für Katheizen" UWORD B_TRUE 1 100 0 1 BIT_MASK 0x10 FUNCTION_LIST DFPM_DSLSLRS IF_DATA DIM_X 0x383908 EXTERN BYTE IF_DATA MCMESS 0x383908 EXTERN /end MEASUREMENT
/begin MEASUREMENT B_ftsls2 "Bedingung: Fehlereintrag durch Tester für SLS, Bank2" UWORD B_TRUE 1 100 0 1 BIT_MASK 0x10 FUNCTION_LIST DFPM_DSLSLRS IF_DATA DIM_X 0x38390A EXTERN BYTE IF_DATA MCMESS 0x38390A EXTERN /end MEASUREMENT
/begin MEASUREMENT B_ftslv "Bedingung: Fehlereintrag durch Tester für SLV" UWORD B_TRUE 1 100 0 1 BIT_MASK 0x10 FUNCTION_LIST DFPM_DSLSLRS IF_DATA DIM_X 0x38390C EXTERN BYTE IF_DATA MCMESS 0x38390C EXTERN /end MEASUREMENT
/begin MEASUREMENT B_ftslv2 "Bedingung: Fehlereintrag durch Tester für SLV, Bank2" UWORD B_TRUE 1 100 0 1 BIT_MASK 0x10 FUNCTION_LIST DFPM_DSLSLRS IF_DATA DIM_X 0x38390E EXTERN BYTE IF_DATA MCMESS 0x38390E EXTERN /end MEASUREMENT
/begin MEASUREMENT B_ftslve "Bedingung Fehlereintrag durch Tester Sekundärluftventil Endstufe" UWORD B_TRUE 1 100 0 1 BIT_MASK 0x10 FUNCTION_LIST DFPM_DEKON IF_DATA DIM_X 0x383910 EXTERN BYTE IF_DATA MCMESS 0x383910 EXTERN /end MEASUREMENT
/begin MEASUREMENT B_ftswe "" UWORD B_TRUE 1 100 0 1 BIT_MASK 0x10 FUNCTION_LIST DFPM_BGRBS IF_DATA DIM_X 0x383912 EXTERN BYTE IF_DATA MCMESS 0x383912 EXTERN /end MEASUREMENT
/begin MEASUREMENT B_ftta "Bedingung Fehlereintrag durch Tester Ansauglufttemperatur" UWORD B_TRUE 1 100 0 1 BIT_MASK 0x10 FUNCTION_LIST DFPM_GGTFA IF_DATA DIM_X 0x383914 EXTERN BYTE IF_DATA MCMESS 0x383914 EXTERN /end MEASUREMENT
/begin MEASUREMENT B_fttes "Bedingung Fehlereintrag durch Tester für TEV" UWORD B_TRUE 1 100 0 1 BIT_MASK 0x10 FUNCTION_LIST DFPM_DTEV IF_DATA DIM_X 0x383916 EXTERN BYTE IF_DATA MCMESS 0x383916 EXTERN /end MEASUREMENT
/begin MEASUREMENT B_ftteve "Bedingung Fehlereintrag durch Tester Tankentlüftungsventil Endstufe" UWORD B_TRUE 1 100 0 1 BIT_MASK 0x10 FUNCTION_LIST DFPM_DEKON IF_DATA DIM_X 0x383918 EXTERN BYTE IF_DATA MCMESS 0x383918 EXTERN /end MEASUREMENT
/begin MEASUREMENT B_fttget "" UWORD B_TRUE 1 100 0 1 BIT_MASK 0x10 FUNCTION_LIST DFPM_GGTGET IF_DATA DIM_X 0x38391C EXTERN BYTE IF_DATA MCMESS 0x38391C EXTERN /end MEASUREMENT
/begin MEASUREMENT B_ftthm "Bedingung Fehlereintrag durch Tester Thermostat monitoring" UWORD B_TRUE 1 100 0 1 BIT_MASK 0x10 FUNCTION_LIST DFPM_GGTFM IF_DATA DIM_X 0x38391E EXTERN BYTE IF_DATA MCMESS 0x38391E EXTERN /end MEASUREMENT
/begin MEASUREMENT B_fttm "Bedingung Fehlereintrag durch Tester für Motor-/Kühlmittel-Temperatur" UWORD B_TRUE 1 100 0 1 BIT_MASK 0x10 FUNCTION_LIST DFPM_GGTFM IF_DATA DIM_X 0x383920 EXTERN BYTE IF_DATA MCMESS 0x383920 EXTERN /end MEASUREMENT
/begin MEASUREMENT B_fttmki "" UWORD B_TRUE 1 100 0 1 BIT_MASK 0x10 FUNCTION_LIST DFPM_DUMMY043 IF_DATA DIM_X 0x383922 EXTERN BYTE IF_DATA MCMESS 0x383922 EXTERN /end MEASUREMENT
/begin MEASUREMENT B_fttmr "" UWORD B_TRUE 1 100 0 1 BIT_MASK 0x10 FUNCTION_LIST DFPM_GGTFMR IF_DATA DIM_X 0x383924 EXTERN BYTE IF_DATA MCMESS 0x383924 EXTERN /end MEASUREMENT
/begin MEASUREMENT B_fttol "Bedingung: Fehlereintrag durch Tester" UWORD B_TRUE 1 100 0 1 BIT_MASK 0x10 FUNCTION_LIST DFPM_GGTFOL IF_DATA DIM_X 0x383926 EXTERN BYTE IF_DATA MCMESS 0x383926 EXTERN /end MEASUREMENT
/begin MEASUREMENT B_fttum "Bedingung: Fehlereintrag durch Tester" UWORD B_TRUE 1 100 0 1 BIT_MASK 0x10 FUNCTION_LIST DFPM_GGTFUMG IF_DATA DIM_X 0x383928 EXTERN BYTE IF_DATA MCMESS 0x383928 EXTERN /end MEASUREMENT
/begin MEASUREMENT B_ftub "Bedingung Fehlereintrag durch Tester für Batteriespannung (Bordnetz)" UWORD B_TRUE 1 100 0 1 BIT_MASK 0x10 FUNCTION_LIST DFPM_GGUB IF_DATA DIM_X 0x38392A EXTERN BYTE IF_DATA MCMESS 0x38392A EXTERN /end MEASUREMENT
/begin MEASUREMENT B_ftufmv "Bedingung: Fehlereintrag durch Tester: Momentvergleich" UWORD B_TRUE 1 100 0 1 BIT_MASK 0x10 FUNCTION_LIST DFPM_DUF IF_DATA DIM_X 0x38392C EXTERN BYTE IF_DATA MCMESS 0x38392C EXTERN /end MEASUREMENT
/begin MEASUREMENT B_ftufska "Bedingung: Fehlereintrag durch Tester:Sicherheits-Kraftstoff-Abschaltung" UWORD B_TRUE 1 100 0 1 BIT_MASK 0x10 FUNCTION_LIST DFPM_DUF IF_DATA DIM_X 0x38392E EXTERN BYTE IF_DATA MCMESS 0x38392E EXTERN /end MEASUREMENT
/begin MEASUREMENT B_fturram "" UWORD B_TRUE 1 100 0 1 BIT_MASK 0x10 FUNCTION_LIST DFPM_DUR IF_DATA DIM_X 0x383930 EXTERN BYTE IF_DATA MCMESS 0x383930 EXTERN /end MEASUREMENT
/begin MEASUREMENT B_fturrom "" UWORD B_TRUE 1 100 0 1 BIT_MASK 0x10 FUNCTION_LIST DFPM_DUR IF_DATA DIM_X 0x383932 EXTERN BYTE IF_DATA MCMESS 0x383932 EXTERN /end MEASUREMENT
/begin MEASUREMENT B_fturrst "" UWORD B_TRUE 1 100 0 1 BIT_MASK 0x10 FUNCTION_LIST DFPM_DUR IF_DATA DIM_X 0x383934 EXTERN BYTE IF_DATA MCMESS 0x383934 EXTERN /end MEASUREMENT
/begin MEASUREMENT B_ftuvse "Bedingung: Fehlereintrag durch Umluftventil turbo (Tester)" UWORD B_TRUE 1 100 0 1 BIT_MASK 0x10 FUNCTION_LIST DFPM_DEKON IF_DATA DIM_X 0x383936 EXTERN BYTE IF_DATA MCMESS 0x383936 EXTERN /end MEASUREMENT
/begin MEASUREMENT B_ftvfz "Bedingung Fehlereintrag durch Tester für Fehlerpfad VFZ" UWORD B_TRUE 1 100 0 1 BIT_MASK 0x10 FUNCTION_LIST DFPM_DVFZ IF_DATA DIM_X 0x383938 EXTERN BYTE IF_DATA MCMESS 0x383938 EXTERN /end MEASUREMENT
/begin MEASUREMENT B_ftvs01 "" UWORD B_TRUE 1 100 0 1 BIT_MASK 0x10 FUNCTION_LIST DFPM_DVS IF_DATA DIM_X 0x38393A EXTERN BYTE IF_DATA MCMESS 0x38393A EXTERN /end MEASUREMENT
/begin MEASUREMENT B_ftvs02 "" UWORD B_TRUE 1 100 0 1 BIT_MASK 0x10 FUNCTION_LIST DFPM_DVS IF_DATA DIM_X 0x38393C EXTERN BYTE IF_DATA MCMESS 0x38393C EXTERN /end MEASUREMENT
/begin MEASUREMENT B_ftvs03 "" UWORD B_TRUE 1 100 0 1 BIT_MASK 0x10 FUNCTION_LIST DFPM_DVS IF_DATA DIM_X 0x38393E EXTERN BYTE IF_DATA MCMESS 0x38393E EXTERN /end MEASUREMENT
/begin MEASUREMENT B_ftvs04 "" UWORD B_TRUE 1 100 0 1 BIT_MASK 0x10 FUNCTION_LIST DFPM_DVS IF_DATA DIM_X 0x383940 EXTERN BYTE IF_DATA MCMESS 0x383940 EXTERN /end MEASUREMENT
/begin MEASUREMENT B_ftvs05 "" UWORD B_TRUE 1 100 0 1 BIT_MASK 0x10 FUNCTION_LIST DFPM_DVS IF_DATA DIM_X 0x383942 EXTERN BYTE IF_DATA MCMESS 0x383942 EXTERN /end MEASUREMENT
/begin MEASUREMENT B_ftvs06 "" UWORD B_TRUE 1 100 0 1 BIT_MASK 0x10 FUNCTION_LIST DFPM_DVS IF_DATA DIM_X 0x383944 EXTERN BYTE IF_DATA MCMESS 0x383944 EXTERN /end MEASUREMENT
/begin MEASUREMENT B_ftvs1e "" UWORD B_TRUE 1 100 0 1 BIT_MASK 0x10 FUNCTION_LIST DFPM_DEKON IF_DATA DIM_X 0x383946 EXTERN BYTE IF_DATA MCMESS 0x383946 EXTERN /end MEASUREMENT
/begin MEASUREMENT B_ftvs2e "" UWORD B_TRUE 1 100 0 1 BIT_MASK 0x10 FUNCTION_LIST DFPM_DEKON IF_DATA DIM_X 0x383948 EXTERN BYTE IF_DATA MCMESS 0x383948 EXTERN /end MEASUREMENT
/begin MEASUREMENT B_ftvsb1 "" UWORD B_TRUE 1 100 0 1 BIT_MASK 0x10 FUNCTION_LIST DFPM_DVS IF_DATA DIM_X 0x38394A EXTERN BYTE IF_DATA MCMESS 0x38394A EXTERN /end MEASUREMENT
/begin MEASUREMENT B_ftvsb2 "" UWORD B_TRUE 1 100 0 1 BIT_MASK 0x10 FUNCTION_LIST DFPM_DVS IF_DATA DIM_X 0x38394C EXTERN BYTE IF_DATA MCMESS 0x38394C EXTERN /end MEASUREMENT
/begin MEASUREMENT B_ftvss "" UWORD B_TRUE 1 100 0 1 BIT_MASK 0x10 FUNCTION_LIST DFPM_DVS IF_DATA DIM_X 0x38394E EXTERN BYTE IF_DATA MCMESS 0x38394E EXTERN /end MEASUREMENT
/begin MEASUREMENT B_ftwfs "" UWORD B_TRUE 1 100 0 1 BIT_MASK 0x10 FUNCTION_LIST DFPM_WFS IF_DATA DIM_X 0x383950 EXTERN BYTE IF_DATA MCMESS 0x383950 EXTERN /end MEASUREMENT
/begin MEASUREMENT B_furena "Bedingung Aktivierung des Füllungsreglers" UWORD B_TRUE 1 100 0 1 BIT_MASK 0x1000 FUNCTION_LIST FUEREG IF_DATA DIM_X 0xFD4A INTERN BYTE IF_DATA MCMESS 0xFD4A INTERN /end MEASUREMENT
/begin MEASUREMENT B_fwe "Bedingung Faktor Wiedereinsetzen" UWORD B_TRUE 1 100 0 1 BIT_MASK 0x40 FUNCTION_LIST ESWE IF_DATA DIM_X 0xFD58 INTERN BYTE IF_DATA MCMESS 0xFD58 INTERN /end MEASUREMENT
/begin MEASUREMENT B_gae "Bedingung Grundadaption eingeschwungen" UWORD B_TRUE 1 100 0 1 BIT_MASK 0x2 FUNCTION_LIST DKVS BBTEGA DTEV IF_DATA DIM_X 0xFD52 INTERN BYTE IF_DATA MCMESS 0xFD52 INTERN /end MEASUREMENT
/begin MEASUREMENT B_gaefra "Bedingung Grundadaption (fra-Integrator) eingeschwungen" UWORD B_TRUE 1 100 0 1 BIT_MASK 0x4 FUNCTION_LIST DKVS BBTEGA IF_DATA DIM_X 0xFD52 INTERN BYTE IF_DATA MCMESS 0xFD52 INTERN /end MEASUREMENT
/begin MEASUREMENT B_gaefra2 "Bedingung Grundadaption (fra2-Integrator) eingeschwungen" UWORD B_TRUE 1 100 0 1 BIT_MASK 0x8 FUNCTION_LIST DKVS BBTEGA IF_DATA DIM_X 0xFD52 INTERN BYTE IF_DATA MCMESS 0xFD52 INTERN /end MEASUREMENT
/begin MEASUREMENT B_gaeing "Bedingung Grundadaption Bank 1 eingeschwungen" UWORD B_TRUE 1 100 0 1 BIT_MASK 0x10 FUNCTION_LIST DKVS DLSAHK IF_DATA DIM_X 0xFD52 INTERN BYTE IF_DATA MCMESS 0xFD52 INTERN /end MEASUREMENT
/begin MEASUREMENT B_gaeing2 "Bedingung Grundadaption Bank 2 eingeschwungenen" UWORD B_TRUE 1 100 0 1 BIT_MASK 0x20 FUNCTION_LIST DKVS DLSAHK IF_DATA DIM_X 0xFD52 INTERN BYTE IF_DATA MCMESS 0xFD52 INTERN /end MEASUREMENT
/begin MEASUREMENT B_gangok "Bedingung Gangwechselerkennung prinziell erlaubt" UWORD B_TRUE 1 100 0 1 BIT_MASK 0x400 FUNCTION_LIST DKUPPL IF_DATA DIM_X 0xFD30 INTERN BYTE IF_DATA MCMESS 0xFD30 INTERN /end MEASUREMENT
/begin MEASUREMENT B_gap "Bedingung Gemischadaptionsphase aktiv" UWORD B_TRUE 1 100 0 1 BIT_MASK 0x8000 FUNCTION_LIST BBTEGA DTEV LRAEB IF_DATA DIM_X 0xFD4C INTERN BYTE IF_DATA MCMESS 0xFD4C INTERN /end MEASUREMENT
/begin MEASUREMENT B_gapnldg "Information über die Position der Lücke" UWORD B_TRUE 1 100 0 1 BIT_MASK 0x4000 FUNCTION_LIST NLDG IF_DATA DIM_X 0xFD16 INTERN BYTE IF_DATA MCMESS 0xFD16 INTERN /end MEASUREMENT
/begin MEASUREMENT B_gasp "Bedingung Grundadaption gesperrt" UWORD B_TRUE 1 100 0 1 BIT_MASK 0x40 FUNCTION_LIST LRAEB BBTEGA T2DFA IF_DATA DIM_X 0xFD5C INTERN BYTE IF_DATA MCMESS 0xFD5C INTERN /end MEASUREMENT
/begin MEASUREMENT B_ges "Bedingung Getriebeschutz über Zylinderausblendung" UWORD B_TRUE 1 100 0 1 BIT_MASK 0x2 FUNCTION_LIST CAN MDEX IF_DATA DIM_X 0xFD08 INTERN BYTE IF_DATA MCMESS 0xFD08 INTERN /end MEASUREMENT
/begin MEASUREMENT B_getrstat "Bedingung Getriebeversion von Motorbotschaft richtig kodiert" UWORD B_TRUE 1 100 0 1 BIT_MASK 0x4 FUNCTION_LIST CAN IF_DATA DIM_X 0xFD08 INTERN BYTE IF_DATA MCMESS 0xFD08 INTERN /end MEASUREMENT
/begin MEASUREMENT B_glf "Bedingung Gleichlauf zwischen Poti 1 und Poti 2 verletzt" UWORD B_TRUE 1 100 0 1 BIT_MASK 0x4 FUNCTION_LIST GGPED IF_DATA DIM_X 0xFD3C INTERN BYTE IF_DATA MCMESS 0xFD3C INTERN /end MEASUREMENT
/begin MEASUREMENT B_grdst "Bedingung Grundeinstellung" UWORD B_TRUE 1 100 0 1 BIT_MASK 0x4 FUNCTION_LIST T2DFA BBTEGA DTEV IF_DATA DIM_X 0xFD06 INTERN BYTE IF_DATA MCMESS 0xFD06 INTERN /end MEASUREMENT
/begin MEASUREMENT B_gsaf "Bedingung Getriebe-Schalteingriff-Anforderung" UWORD B_TRUE 1 100 0 1 BIT_MASK 0x8 FUNCTION_LIST CAN MDAUTG MDEX IF_DATA DIM_X 0xFD08 INTERN BYTE IF_DATA MCMESS 0xFD08 INTERN /end MEASUREMENT
/begin MEASUREMENT B_gsch "Bedingung Getriebeschaltung aktiv" UWORD B_TRUE 1 100 0 1 BIT_MASK 0x10 FUNCTION_LIST CAN IF_DATA DIM_X 0xFD08 INTERN BYTE IF_DATA MCMESS 0xFD08 INTERN /end MEASUREMENT
/begin MEASUREMENT B_gwhs "Bedingung Gangwechsel bei Handschalter" UWORD B_TRUE 1 100 0 1 BIT_MASK 0x80 FUNCTION_LIST BBGANG ARMD BBFGR IF_DATA DIM_X 0xFD34 INTERN BYTE IF_DATA MCMESS 0xFD34 INTERN /end MEASUREMENT
/begin MEASUREMENT B_gwrte "Bedingung fr-Grenzwertregelung Tankentlüftung aktiv" UWORD B_TRUE 1 100 0 1 BIT_MASK 0x1 FUNCTION_LIST TEB IF_DATA DIM_X 0xFD88 INTERN BYTE IF_DATA MCMESS 0xFD88 INTERN /end MEASUREMENT
/begin MEASUREMENT B_hag "Bedingung Höhenadaption gültig" UWORD B_TRUE 1 100 0 1 BIT_MASK 0x200 FUNCTION_LIST GGDSAS BBKHZ DSLSLRS DTEV GGLSU T2DFA IF_DATA DIM_X 0xFD48 INTERN BYTE IF_DATA MCMESS 0xFD48 INTERN /end MEASUREMENT
/begin MEASUREMENT B_hast0 "Zeit nach Startende überschritten bei aktuellem Start" UBYTE B_TRUE 1 100 0 1 BIT_MASK 0x1 FUNCTION_LIST STA IF_DATA DIM_X 0x3830C9 EXTERN BYTE IF_DATA MCMESS 0x3830C9 EXTERN /end MEASUREMENT
/begin MEASUREMENT B_hast1 "Zeit nach Startende überschritten bei vorherigem Start" UBYTE B_TRUE 1 100 0 1 BIT_MASK 0x2 FUNCTION_LIST STA IF_DATA DIM_X 0x3830C9 EXTERN BYTE IF_DATA MCMESS 0x3830C9 EXTERN /end MEASUREMENT
/begin MEASUREMENT B_helsu "Diagnose Heizerkopplung LSU erfolgt" UWORD B_TRUE 1 100 0 1 BIT_MASK 0x4000 FUNCTION_LIST DLSU IF_DATA DIM_X 0xFD2A INTERN BYTE IF_DATA MCMESS 0xFD2A INTERN /end MEASUREMENT
/begin MEASUREMENT B_helsu2 "Diagnose Heizerkopplung LSU2 erfolgt" UWORD B_TRUE 1 100 0 1 BIT_MASK 0x8000 FUNCTION_LIST DLSU IF_DATA DIM_X 0xFD2A INTERN BYTE IF_DATA MCMESS 0xFD2A INTERN /end MEASUREMENT
/begin MEASUREMENT B_hfm "Bedingung HFM messbereit" UWORD B_TRUE 1 100 0 1 BIT_MASK 0x20 FUNCTION_LIST DHFM BGMSZS BGSRM DHFM IF_DATA DIM_X 0xFD48 INTERN BYTE IF_DATA MCMESS 0xFD48 INTERN /end MEASUREMENT
/begin MEASUREMENT B_hmx "Bedingung LSU maximal beheizt" UWORD B_TRUE 1 100 0 1 BIT_MASK 0x8 FUNCTION_LIST HLSU IF_DATA DIM_X 0xFD80 INTERN BYTE IF_DATA MCMESS 0xFD80 INTERN /end MEASUREMENT
/begin MEASUREMENT B_hmx2 "Bedingung LSU2 maximal beheizt" UWORD B_TRUE 1 100 0 1 BIT_MASK 0x10 FUNCTION_LIST HLSU IF_DATA DIM_X 0xFD80 INTERN BYTE IF_DATA MCMESS 0xFD80 INTERN /end MEASUREMENT
/begin MEASUREMENT B_holp1 "Bedingung Hochohmigkeit im Leerlauf an PWG-Poti 1 erkannt" UWORD B_TRUE 1 100 0 1 BIT_MASK 0x10 FUNCTION_LIST GGPED IF_DATA DIM_X 0x381EBC EXTERN BYTE IF_DATA MCMESS 0x381EBC EXTERN /end MEASUREMENT
/begin MEASUREMENT B_holp1a "Bedingung Hochohmigkeit im Leerlauf an PWG-Poti 1 im aktuellen Fahrzyklus" UWORD B_TRUE 1 100 0 1 BIT_MASK 0x20 FUNCTION_LIST GGPED IF_DATA DIM_X 0x381EBC EXTERN BYTE IF_DATA MCMESS 0x381EBC EXTERN /end MEASUREMENT
/begin MEASUREMENT B_holp1l "Bedingung Hochohmigkeit im Leerlauf an PWG-Poti 1 im letzten Fahrzyklus" UBYTE B_TRUE 1 100 0 1 BIT_MASK 0x1 FUNCTION_LIST GGPED IF_DATA DIM_X 0x382FF8 EXTERN BYTE IF_DATA MCMESS 0x382FF8 EXTERN /end MEASUREMENT
/begin MEASUREMENT B_holp2 "Bedingung Hochohmigkeit im Leerlauf an PWG-Poti 2 erkannt" UWORD B_TRUE 1 100 0 1 BIT_MASK 0x40 FUNCTION_LIST GGPED IF_DATA DIM_X 0x381EBC EXTERN BYTE IF_DATA MCMESS 0x381EBC EXTERN /end MEASUREMENT
/begin MEASUREMENT B_holp2a "Bedingung Hochohmigkeit im Leerlauf an PWG-Poti 2 im aktuellen Fahrzyklus" UWORD B_TRUE 1 100 0 1 BIT_MASK 0x80 FUNCTION_LIST GGPED IF_DATA DIM_X 0x381EBC EXTERN BYTE IF_DATA MCMESS 0x381EBC EXTERN /end MEASUREMENT
/begin MEASUREMENT B_holp2l "Bedingung Hochohmigkeit im Leerlauf an PWG-Poti 2 im letzten Fahrzyklus" UBYTE B_TRUE 1 100 0 1 BIT_MASK 0x2 FUNCTION_LIST GGPED IF_DATA DIM_X 0x382FF8 EXTERN BYTE IF_DATA MCMESS 0x382FF8 EXTERN /end MEASUREMENT
/begin MEASUREMENT B_hop1mn "Bedingung Bereichsverletzung nach unten an Poti 1 in Hochohmigkeitsprüfung" UWORD B_TRUE 1 100 0 1 BIT_MASK 0x100 FUNCTION_LIST GGPED IF_DATA DIM_X 0x381EBC EXTERN BYTE IF_DATA MCMESS 0x381EBC EXTERN /end MEASUREMENT
/begin MEASUREMENT B_hop2mn "Bedingung Bereichsverletzung nach unten an Poti 2 in Hochohmigkeitsprüfung" UWORD B_TRUE 1 100 0 1 BIT_MASK 0x200 FUNCTION_LIST GGPED IF_DATA DIM_X 0x381EBC EXTERN BYTE IF_DATA MCMESS 0x381EBC EXTERN /end MEASUREMENT
/begin MEASUREMENT B_hopakt "Bedingung Hochohmigkeitsprüfung aktiv" UWORD B_TRUE 1 100 0 1 BIT_MASK 0x400 FUNCTION_LIST GGPED IF_DATA DIM_X 0x381EBC EXTERN BYTE IF_DATA MCMESS 0x381EBC EXTERN /end MEASUREMENT
/begin MEASUREMENT B_hpnmot "Bedingung Hochpunkt Drehzahlschwingung" UBYTE B_TRUE 1 100 0 1 BIT_MASK 0x1 FUNCTION_LIST ARMD IF_DATA DIM_X 0x380C27 EXTERN BYTE IF_DATA MCMESS 0x380C27 EXTERN /end MEASUREMENT
/begin MEASUREMENT B_hsha "Bedingung Sonde hinter Kat ausreichend beheizt" UWORD B_TRUE 1 100 0 1 BIT_MASK 0x20 FUNCTION_LIST HLSHK DLSH IF_DATA DIM_X 0xFD30 INTERN BYTE IF_DATA MCMESS 0xFD30 INTERN /end MEASUREMENT
/begin MEASUREMENT B_hsha2 "Bedingung Sonde 2 hinter Kat ausreichend beheizt" UWORD B_TRUE 1 100 0 1 BIT_MASK 0x40 FUNCTION_LIST HLSHK DLSH IF_DATA DIM_X 0xFD30 INTERN BYTE IF_DATA MCMESS 0xFD30 INTERN /end MEASUREMENT
/begin MEASUREMENT B_hshe "Bedingung Endstufe Sondenheizung hinter Kat angesteuert" UWORD B_TRUE 1 100 0 1 BIT_MASK 0x80 FUNCTION_LIST HLSHK DHLSHKE T2DFA VHW IF_DATA DIM_X 0xFD30 INTERN BYTE IF_DATA MCMESS 0xFD30 INTERN /end MEASUREMENT
/begin MEASUREMENT B_hshe2 "Bedingung Endstufe Sondenheizung2 hinter Kat angesteuert" UWORD B_TRUE 1 100 0 1 BIT_MASK 0x100 FUNCTION_LIST HLSHK DHLSHKE T2DFA VHW IF_DATA DIM_X 0xFD30 INTERN BYTE IF_DATA MCMESS 0xFD30 INTERN /end MEASUREMENT
/begin MEASUREMENT B_hsokh "Bedingung Sondenheizung OK hinter Kat" UWORD B_TRUE 1 100 0 1 BIT_MASK 0x200 FUNCTION_LIST DHLSHK IF_DATA DIM_X 0xFD1C INTERN BYTE IF_DATA MCMESS 0xFD1C INTERN /end MEASUREMENT
/begin MEASUREMENT B_hsokh2 "Bedingung Sondenheizung 2 OK hinter Kat" UWORD B_TRUE 1 100 0 1 BIT_MASK 0x400 FUNCTION_LIST DHLSHK IF_DATA DIM_X 0xFD1C INTERN BYTE IF_DATA MCMESS 0xFD1C INTERN /end MEASUREMENT
/begin MEASUREMENT B_hsrdy "Bedingung Sondenheizung geprüft für 'ready-Byte'" UBYTE B_TRUE 1 100 0 1 BIT_MASK 0x40 FUNCTION_LIST DIMC IF_DATA DIM_X 0x382FD0 EXTERN BYTE IF_DATA MCMESS 0x382FD0 EXTERN /end MEASUREMENT
/begin MEASUREMENT B_hst "Bedingung Heißstart" UBYTE B_TRUE 1 100 0 1 BIT_MASK 0x1 FUNCTION_LIST ESSTT ESNST GGTFM IF_DATA DIM_X 0x383002 EXTERN BYTE IF_DATA MCMESS 0x383002 EXTERN /end MEASUREMENT
/begin MEASUREMENT B_hsv "Bedingung Heizung Sonde vor Kat einschaltbereit" UWORD B_TRUE 1 100 0 1 BIT_MASK 0x20 FUNCTION_LIST HLSU DHLSU DLSU GGLSU IF_DATA DIM_X 0xFD80 INTERN BYTE IF_DATA MCMESS 0xFD80 INTERN /end MEASUREMENT
/begin MEASUREMENT B_hsv2 "Bedingung Heizung Sonde2 vor Kat einschaltbereit" UWORD B_TRUE 1 100 0 1 BIT_MASK 0x40 FUNCTION_LIST HLSU DHLSU DLSU GGLSU IF_DATA DIM_X 0xFD80 INTERN BYTE IF_DATA MCMESS 0xFD80 INTERN /end MEASUREMENT
/begin MEASUREMENT B_hsve "Bedingung Endstufe Sondenheizung vor Kat angesteuert" UWORD B_TRUE 1 100 0 1 BIT_MASK 0x80 FUNCTION_LIST HLSU DHLSU DLSU VHW IF_DATA DIM_X 0xFD80 INTERN BYTE IF_DATA MCMESS 0xFD80 INTERN /end MEASUREMENT
/begin MEASUREMENT B_hsve2 "Bedingung Endstufe Sondenheizung2 vor Kat angesteuert" UWORD B_TRUE 1 100 0 1 BIT_MASK 0x100 FUNCTION_LIST HLSU DHLSU DLSU VHW IF_DATA DIM_X 0xFD80 INTERN BYTE IF_DATA MCMESS 0xFD80 INTERN /end MEASUREMENT
/begin MEASUREMENT B_iflsd "Bedingung Initialisierung Filter Lastschlagdämpfung" UBYTE B_TRUE 1 100 0 1 BIT_MASK 0x1 FUNCTION_LIST MDFAW IF_DATA DIM_X 0x380C37 EXTERN BYTE IF_DATA MCMESS 0x380C37 EXTERN /end MEASUREMENT
/begin MEASUREMENT B_iklrest "Bedingung: Retriggerung I-Klein" UWORD B_TRUE 1 100 0 1 BIT_MASK 0x1000 FUNCTION_LIST ADVE IF_DATA DIM_X 0xFD32 INTERN BYTE IF_DATA MCMESS 0xFD32 INTERN /end MEASUREMENT
/begin MEASUREMENT B_iklstar "Bedingung: I-Klein soll starten" UWORD B_TRUE 1 100 0 1 BIT_MASK 0x2000 FUNCTION_LIST ADVE IF_DATA DIM_X 0xFD32 INTERN BYTE IF_DATA MCMESS 0xFD32 INTERN /end MEASUREMENT
/begin MEASUREMENT B_imlkvse "Bedingung Luftmassenintegral Rücksetzen" UBYTE B_TRUE 1 100 0 1 BIT_MASK 0x2 FUNCTION_LIST DKVS IF_DATA DIM_X 0x383001 EXTERN BYTE IF_DATA MCMESS 0x383001 EXTERN /end MEASUREMENT
/begin MEASUREMENT B_incr "Bedingung Inkrementierung Startadaptionsfaktor" UWORD B_TRUE 1 100 0 1 BIT_MASK 0x80 FUNCTION_LIST STADAP IF_DATA DIM_X 0x382370 EXTERN BYTE IF_DATA MCMESS 0x382370 EXTERN /end MEASUREMENT
/begin MEASUREMENT B_iniar "Bedingung Initialisierung der AR-Funktion" UBYTE B_TRUE 1 100 0 1 BIT_MASK 0x2 FUNCTION_LIST ARMD IF_DATA DIM_X 0x380C27 EXTERN BYTE IF_DATA MCMESS 0x380C27 EXTERN /end MEASUREMENT
/begin MEASUREMENT B_iniarv "Bedingung Initialisierung der Filterfunktion verzögert" UBYTE B_TRUE 1 100 0 1 BIT_MASK 0x4 FUNCTION_LIST ARMD IF_DATA DIM_X 0x380C27 EXTERN BYTE IF_DATA MCMESS 0x380C27 EXTERN /end MEASUREMENT
/begin MEASUREMENT B_i_ska "Funktions-Fehlerreaktion irreversible SKA (Sicherheits-Kraftstoffabschaltung)" UBYTE B_TRUE 1 100 0 1 BIT_MASK 0x4 FUNCTION_LIST UFURAM IF_DATA DIM_X 0x382E42 EXTERN WORD IF_DATA MCMESS 0x382E42 EXTERN /end MEASUREMENT
/begin MEASUREMENT B_i_ska_fr "FR-Fehlerreaktion irreversible SKA (Sicherheits-Kraftstoff-Abschaltung)" UWORD B_TRUE 1 100 0 1 BIT_MASK 0x2 FUNCTION_LIST SREAKT UFEING URADCC IF_DATA DIM_X 0xFD3E INTERN BYTE IF_DATA MCMESS 0xFD3E INTERN /end MEASUREMENT
/begin MEASUREMENT B_i_ska_uc "Ebene 3 irreversibles Fehlerbit fuer BT" UWORD B_TRUE 1 100 0 1 BIT_MASK 0x8000 FUNCTION_LIST URCMVER URCAUS URCREAC IF_DATA DIM_X 0xFD78 INTERN BYTE IF_DATA MCMESS 0xFD78 INTERN /end MEASUREMENT
/begin MEASUREMENT B_i_ska_um "Fehlerreaktion irrev. SKA (Sicherheitskraftstoffabschaltung) aus Fkt-Überwachung" UWORD B_TRUE 1 100 0 1 BIT_MASK 0x1000 FUNCTION_LIST UFURAM ADVE AEVABU BGDVE DUF FUEDKSA SREAKT UFMVER UFNC UFREAC UFRLC UFSPSC UFZWC URADCC IF_DATA DIM_X 0xFD76 INTERN BYTE IF_DATA MCMESS 0xFD76 INTERN /end MEASUREMENT
/begin MEASUREMENT B_katfz "Bedingung Kat in Fahrzeug eingebaut" UWORD B_TRUE 1 100 0 1 BIT_MASK 0x2 FUNCTION_LIST PROKON BBKHZ IF_DATA DIM_X 0xFD74 INTERN BYTE IF_DATA MCMESS 0xFD74 INTERN /end MEASUREMENT
/begin MEASUREMENT B_kath "Bedingung Kat Heizung in Fahrzeug eingebaut" UWORD B_TRUE 1 100 0 1 BIT_MASK 0x4 FUNCTION_LIST PROKON DIMC IF_DATA DIM_X 0xFD74 INTERN BYTE IF_DATA MCMESS 0xFD74 INTERN /end MEASUREMENT
/begin MEASUREMENT B_kathrdy "Bedingung Katalysator-Heizungen geprüft für 'ready-Byte'" UBYTE B_TRUE 1 100 0 1 BIT_MASK 0x2 FUNCTION_LIST DIMC IF_DATA DIM_X 0x382FD0 EXTERN BYTE IF_DATA MCMESS 0x382FD0 EXTERN /end MEASUREMENT
/begin MEASUREMENT B_katrdy "Bedingung Katalysatoren geprüft für 'ready-Byte'" UBYTE B_TRUE 1 100 0 1 BIT_MASK 0x1 FUNCTION_LIST DIMC IF_DATA DIM_X 0x382FD0 EXTERN BYTE IF_DATA MCMESS 0x382FD0 EXTERN /end MEASUREMENT
/begin MEASUREMENT B_kbi1new "Bedingung CAN-Kombi1-Botschaft empfangen" UWORD B_TRUE 1 100 0 1 BIT_MASK 0x20 FUNCTION_LIST CAN DCKBI IF_DATA DIM_X 0xFD08 INTERN BYTE IF_DATA MCMESS 0xFD08 INTERN /end MEASUREMENT
/begin MEASUREMENT B_kbi2new "Bedingung CAN-Kombi2-Botschaft empfangen" UWORD B_TRUE 1 100 0 1 BIT_MASK 0x40 FUNCTION_LIST CAN BGTABS DCKBI IF_DATA DIM_X 0xFD08 INTERN BYTE IF_DATA MCMESS 0xFD08 INTERN /end MEASUREMENT
/begin MEASUREMENT B_kbimdred "Bedingung verminderte Leistung - Info an Kombiinstrument" UWORD B_TRUE 1 100 0 1 BIT_MASK 0x100 FUNCTION_LIST MDEX CAN IF_DATA DIM_X 0xFD0A INTERN BYTE IF_DATA MCMESS 0xFD0A INTERN /end MEASUREMENT
/begin MEASUREMENT B_kd "Bedingung Kick-Down" UWORD B_TRUE 1 100 0 1 BIT_MASK 0x8 FUNCTION_LIST GGPED KOS IF_DATA DIM_X 0xFD3C INTERN BYTE IF_DATA MCMESS 0xFD3C INTERN /end MEASUREMENT
/begin MEASUREMENT B_keinre "Bedingung: Einrechnen des K-Faktors bei Drehzahldynamik" UWORD B_TRUE 1 100 0 1 BIT_MASK 0x8 FUNCTION_LIST KRKE IF_DATA DIM_X 0xFD64 INTERN BYTE IF_DATA MCMESS 0xFD64 INTERN /end MEASUREMENT
/begin MEASUREMENT B_kfnb "Bedingung Konstantfahrt nach Beschleunigen" UBYTE B_TRUE 1 100 0 1 BIT_MASK 0x10 FUNCTION_LIST FGRMD IF_DATA DIM_X 0x380AD8 EXTERN BYTE IF_DATA MCMESS 0x380AD8 EXTERN /end MEASUREMENT
/begin MEASUREMENT B_kfnv "Bedingung Konstantfahrt nach Verzögern" UBYTE B_TRUE 1 100 0 1 BIT_MASK 0x20 FUNCTION_LIST FGRMD IF_DATA DIM_X 0x380AD8 EXTERN BYTE IF_DATA MCMESS 0x380AD8 EXTERN /end MEASUREMENT
/begin MEASUREMENT B_kfwee "Bedingung Kennfeld KFWEE aktiv" UWORD B_TRUE 1 100 0 1 BIT_MASK 0x8 FUNCTION_LIST ESVW IF_DATA DIM_X 0xFD58 INTERN BYTE IF_DATA MCMESS 0xFD58 INTERN /end MEASUREMENT
/begin MEASUREMENT B_kh "Bedingung Kat-Heizung" UWORD B_TRUE 1 100 0 1 BIT_MASK 0x800 FUNCTION_LIST BBKHZ ATM BBSAWE DMDLU DSLSLRS KHMD LAKH LAMKO LLRMR LRS MDAUTG MDKOG NWS SLS ZWMIN IF_DATA DIM_X 0xFD5E INTERN BYTE IF_DATA MCMESS 0xFD5E INTERN /end MEASUREMENT
/begin MEASUREMENT B_kha "Anforderung Katheizen" UWORD B_TRUE 1 100 0 1 BIT_MASK 0x1000 FUNCTION_LIST BBKHZ DSLSLRS SLS IF_DATA DIM_X 0xFD5E INTERN BYTE IF_DATA MCMESS 0xFD5E INTERN /end MEASUREMENT
/begin MEASUREMENT B_khab "Bedingung Katheizen Abbruch" UWORD B_TRUE 1 100 0 1 BIT_MASK 0x2000 FUNCTION_LIST BBKHZ SLS IF_DATA DIM_X 0xFD5E INTERN BYTE IF_DATA MCMESS 0xFD5E INTERN /end MEASUREMENT
/begin MEASUREMENT B_khll "Bedingung Katheizen Leerlauf (Abbruchbedingung)" UWORD B_TRUE 1 100 0 1 BIT_MASK 0x4000 FUNCTION_LIST BBKHZ IF_DATA DIM_X 0xFD5E INTERN BYTE IF_DATA MCMESS 0xFD5E INTERN /end MEASUREMENT
/begin MEASUREMENT B_khlle "Bedingung Leerlauf während Katheizen verlassen" UWORD B_TRUE 1 100 0 1 BIT_MASK 0x8000 FUNCTION_LIST BBKHZ IF_DATA DIM_X 0xFD5E INTERN BYTE IF_DATA MCMESS 0xFD5E INTERN /end MEASUREMENT
/begin MEASUREMENT B_khllmx "Bedingung max. Katheitzeit im Leerlauf erreicht" UWORD B_TRUE 1 100 0 1 BIT_MASK 0x1 FUNCTION_LIST BBKHZ IF_DATA DIM_X 0xFD60 INTERN BYTE IF_DATA MCMESS 0xFD60 INTERN /end MEASUREMENT
/begin MEASUREMENT B_khn "Bedingung Katheiz-Drehzahl" UWORD B_TRUE 1 100 0 1 BIT_MASK 0x2 FUNCTION_LIST BBKHZ IF_DATA DIM_X 0xFD60 INTERN BYTE IF_DATA MCMESS 0xFD60 INTERN /end MEASUREMENT
/begin MEASUREMENT B_khnws "Bedingung NWS schalten bei Katheizen" UBYTE B_TRUE 1 100 0 1 BIT_MASK 0x1 FUNCTION_LIST NWS IF_DATA DIM_X 0x380B06 EXTERN BYTE IF_DATA MCMESS 0x380B06 EXTERN /end MEASUREMENT
/begin MEASUREMENT B_kkl_um "erkannter Low-Pegel am FGR-Bedienhebelschalter Kontrollkontakt in Funktionsüberw" UBYTE B_TRUE 1 100 0 1 BIT_MASK 0x40 FUNCTION_LIST UFURAM IF_DATA DIM_X 0x382E43 EXTERN WORD IF_DATA MCMESS 0x382E43 EXTERN /end MEASUREMENT
/begin MEASUREMENT B_kkrdy "Bedingung Klimakühlmittel geprüft für 'ready-Byte'" UBYTE B_TRUE 1 100 0 1 BIT_MASK 0x10 FUNCTION_LIST DIMC IF_DATA DIM_X 0x382FD0 EXTERN BYTE IF_DATA MCMESS 0x382FD0 EXTERN /end MEASUREMENT
/begin MEASUREMENT B_kl "Bedingung für erkannte Klopfer" UWORD B_TRUE 1 100 0 1 BIT_MASK 0x10 FUNCTION_LIST KRKE KRDY KRRA IF_DATA DIM_X 0xFD64 INTERN BYTE IF_DATA MCMESS 0xFD64 INTERN /end MEASUREMENT
/begin MEASUREMENT B_kl15 "Bedingung Klemme 15" UWORD B_TRUE 1 100 0 1 BIT_MASK 0x200 FUNCTION_LIST GGZDGON ACIFI ADVE AZUE CAN DHLSU GGTFM MLS MOTAUS STA VHW WFS IF_DATA DIM_X 0xFD70 INTERN BYTE IF_DATA MCMESS 0xFD70 INTERN /end MEASUREMENT
/begin MEASUREMENT B_kl15Old "" UBYTE B_TRUE 1 100 0 1 BIT_MASK 0x8 FUNCTION_LIST STA IF_DATA DIM_X 0x3830C9 EXTERN BYTE IF_DATA MCMESS 0x3830C9 EXTERN /end MEASUREMENT
/begin MEASUREMENT B_klafbg "Eingangsgröße für KLAF ist begrenzt" UBYTE B_TRUE 1 100 0 1 BIT_MASK 0x2 FUNCTION_LIST FUEDK IF_DATA DIM_X 0x380AFD EXTERN BYTE IF_DATA MCMESS 0x380AFD EXTERN /end MEASUREMENT
/begin MEASUREMENT B_kldynrm "Bedingung normales Klopfen bei adapt. Lastdynamik" UWORD B_TRUE 1 100 0 1 BIT_MASK 0x40 FUNCTION_LIST KRDY IF_DATA DIM_X 0xFD62 INTERN BYTE IF_DATA MCMESS 0xFD62 INTERN /end MEASUREMENT
/begin MEASUREMENT B_kldystk "Bedingung starkes Klopfen bei adapt. Lastdynamik" UWORD B_TRUE 1 100 0 1 BIT_MASK 0x80 FUNCTION_LIST KRDY IF_DATA DIM_X 0xFD62 INTERN BYTE IF_DATA MCMESS 0xFD62 INTERN /end MEASUREMENT
/begin MEASUREMENT B_klima "Bedingung Klimaanlage" UWORD B_TRUE 1 100 0 1 BIT_MASK 0x8 FUNCTION_LIST PROKON IF_DATA DIM_X 0xFD74 INTERN BYTE IF_DATA MCMESS 0xFD74 INTERN /end MEASUREMENT
/begin MEASUREMENT B_kllknl "Synchronisationsbedingung für zphflsyn=3 erfüllt" UWORD B_TRUE 1 100 0 1 BIT_MASK 0x8000 FUNCTION_LIST NLDG IF_DATA DIM_X 0xFD16 INTERN BYTE IF_DATA MCMESS 0xFD16 INTERN /end MEASUREMENT
/begin MEASUREMENT B_kmmil "MIL-Ansteuerung mit Relevanz zu Kilometererfassung" UBYTE B_TRUE 1 100 0 1 BIT_MASK 0x1 FUNCTION_LIST DMIL BGKMST IF_DATA DIM_X 0x382FD6 EXTERN BYTE IF_DATA MCMESS 0x382FD6 EXTERN /end MEASUREMENT
/begin MEASUREMENT B_kmmilsct "Ausgabe ""km bei MIL on"" für Scan Tool abschalten (0 = keine Ausgabe in PID $21)" UWORD B_TRUE 1 100 0 1 BIT_MASK 0x10 FUNCTION_LIST PROKON TC1MOD IF_DATA DIM_X 0xFD74 INTERN BYTE IF_DATA MCMESS 0xFD74 INTERN /end MEASUREMENT
/begin MEASUREMENT B_ko "Bedingung Kompressor freigegeben" UBYTE B_TRUE 1 100 0 1 BIT_MASK 0x1 FUNCTION_LIST KOS IF_DATA DIM_X 0x380D25 EXTERN BYTE IF_DATA MCMESS 0x380D25 EXTERN /end MEASUREMENT
/begin MEASUREMENT B_koa "Bedingung für Kompressorausschalten" UWORD B_TRUE 1 100 0 1 BIT_MASK 0x200 FUNCTION_LIST KOS IF_DATA DIM_X 0xFD90 INTERN BYTE IF_DATA MCMESS 0xFD90 INTERN /end MEASUREMENT
/begin MEASUREMENT B_koe "Bedingung für Kompressoreinschalten" UWORD B_TRUE 1 100 0 1 BIT_MASK 0x400 FUNCTION_LIST KOS BBSAWE CAN DEKON2 DKOSE DTEV MDVERAD MDVERB MLS VHW IF_DATA DIM_X 0xFD90 INTERN BYTE IF_DATA MCMESS 0xFD90 INTERN /end MEASUREMENT
/begin MEASUREMENT B_koena "Bedingung Kompressor freigegeben" UBYTE B_TRUE 1 100 0 1 BIT_MASK 0x2 FUNCTION_LIST KOS IF_DATA DIM_X 0x380D25 EXTERN BYTE IF_DATA MCMESS 0x380D25 EXTERN /end MEASUREMENT
/begin MEASUREMENT B_komnoff "Bedingung Kompresszor-Mindestabschaltzeit abgelaufen" UBYTE B_TRUE 1 100 0 1 BIT_MASK 0x8 FUNCTION_LIST KOS IF_DATA DIM_X 0x380D25 EXTERN BYTE IF_DATA MCMESS 0x380D25 EXTERN /end MEASUREMENT
/begin MEASUREMENT B_komnon "Bedingung Kompresszor-Mindesteinschaltzeit abgelaufen" UBYTE B_TRUE 1 100 0 1 BIT_MASK 0x10 FUNCTION_LIST KOS IF_DATA DIM_X 0x380D25 EXTERN BYTE IF_DATA MCMESS 0x380D25 EXTERN /end MEASUREMENT
/begin MEASUREMENT B_komxoff "Bedingung Kompresszor-Höchstabschaltzeit abgelaufen" UBYTE B_TRUE 1 100 0 1 BIT_MASK 0x20 FUNCTION_LIST KOS IF_DATA DIM_X 0x380D25 EXTERN BYTE IF_DATA MCMESS 0x380D25 EXTERN /end MEASUREMENT
/begin MEASUREMENT B_kooff "Bedingung für hartes Kompressorabschalten" UBYTE B_TRUE 1 100 0 1 BIT_MASK 0x4 FUNCTION_LIST KOS IF_DATA DIM_X 0x380D25 EXTERN BYTE IF_DATA MCMESS 0x380D25 EXTERN /end MEASUREMENT
/begin MEASUREMENT B_kosta "Bedingung für Einfrieren des aktuellen Kompressorzustandes" UBYTE B_TRUE 1 100 0 1 BIT_MASK 0x40 FUNCTION_LIST KOS IF_DATA DIM_X 0x380D25 EXTERN BYTE IF_DATA MCMESS 0x380D25 EXTERN /end MEASUREMENT
/begin MEASUREMENT B_kr "Bedingung Klopregelung aktiv" UWORD B_TRUE 1 100 0 1 BIT_MASK 0x40 FUNCTION_LIST KRRA DKRS GGKS KRKE RUNTIME IF_DATA DIM_X 0xFD64 INTERN BYTE IF_DATA MCMESS 0xFD64 INTERN /end MEASUREMENT
/begin MEASUREMENT B_kra "KR-Adaption aktiv" UWORD B_TRUE 1 100 0 1 BIT_MASK 0x80 FUNCTION_LIST KRRA IF_DATA DIM_X 0xFD64 INTERN BYTE IF_DATA MCMESS 0xFD64 INTERN /end MEASUREMENT
/begin MEASUREMENT B_krdws "Bedingung Klopfregelung Sicherheitsspätverstellung" UWORD B_TRUE 1 100 0 1 BIT_MASK 0x40 FUNCTION_LIST DKRS KRRA MDEX T2LID IF_DATA DIM_X 0xFD60 INTERN BYTE IF_DATA MCMESS 0xFD60 INTERN /end MEASUREMENT
/begin MEASUREMENT B_krldy "Bedingung Lastdynamik für Klopferkennung aktiv" UWORD B_TRUE 1 100 0 1 BIT_MASK 0x100 FUNCTION_LIST KRDY DKRS KRKE KRRA IF_DATA DIM_X 0xFD62 INTERN BYTE IF_DATA MCMESS 0xFD62 INTERN /end MEASUREMENT
/begin MEASUREMENT B_krldya "Bedingung Lastdynamikvorhalt und -adaption aktiv" UWORD B_TRUE 1 100 0 1 BIT_MASK 0x200 FUNCTION_LIST KRDY KRRA IF_DATA DIM_X 0xFD62 INTERN BYTE IF_DATA MCMESS 0xFD62 INTERN /end MEASUREMENT
/begin MEASUREMENT B_krldyf "Bedingung Adaption Lastdynamikvorhalt nach früh freigegeben" UWORD B_TRUE 1 100 0 1 BIT_MASK 0x400 FUNCTION_LIST KRDY IF_DATA DIM_X 0xFD62 INTERN BYTE IF_DATA MCMESS 0xFD62 INTERN /end MEASUREMENT
/begin MEASUREMENT B_krndy "Bedingung Drehzahldynamik für Klopferkennung aktiv" UWORD B_TRUE 1 100 0 1 BIT_MASK 0x800 FUNCTION_LIST KRDY DKRS KRKE KRRA IF_DATA DIM_X 0xFD62 INTERN BYTE IF_DATA MCMESS 0xFD62 INTERN /end MEASUREMENT
/begin MEASUREMENT B_krnl "Notlauf Klopferkennung bei Phasennotlauf und/oder Doppelzündung" UWORD B_TRUE 1 100 0 1 BIT_MASK 0x80 FUNCTION_LIST DKRS IF_DATA DIM_X 0xFD60 INTERN BYTE IF_DATA MCMESS 0xFD60 INTERN /end MEASUREMENT
/begin MEASUREMENT B_krsyne "Klopfregelung Synchronisationsfehler bei Phasenfehler" UWORD B_TRUE 1 100 0 1 BIT_MASK 0x100 FUNCTION_LIST DKRS IF_DATA DIM_X 0xFD60 INTERN BYTE IF_DATA MCMESS 0xFD60 INTERN /end MEASUREMENT
/begin MEASUREMENT B_krvsnw "Bedingung Sperren Klopferkennung wegen Umschaltung NW oder Ventilhub" UWORD B_TRUE 1 100 0 1 BIT_MASK 0x20 FUNCTION_LIST KRKE IF_DATA DIM_X 0xFD64 INTERN BYTE IF_DATA MCMESS 0xFD64 INTERN /end MEASUREMENT
/begin MEASUREMENT B_kscan "Getriebeeinschaltvorgang aktiv, (Knallstartbit)" UWORD B_TRUE 1 100 0 1 BIT_MASK 0x80 FUNCTION_LIST CAN MDEX NMAXMD IF_DATA DIM_X 0xFD08 INTERN BYTE IF_DATA MCMESS 0xFD08 INTERN /end MEASUREMENT
/begin MEASUREMENT B_kstai "Bedingung Inkrementierung/Dekrementierung Startadaptionsfaktor" UWORD B_TRUE 1 100 0 1 BIT_MASK 0x100 FUNCTION_LIST STADAP IF_DATA DIM_X 0x382370 EXTERN BYTE IF_DATA MCMESS 0x382370 EXTERN /end MEASUREMENT
/begin MEASUREMENT B_kstaue "Startmengenadaptionswerte beim nächsten Start gültig" UWORD B_TRUE 1 100 0 1 BIT_MASK 0x200 FUNCTION_LIST STADAP IF_DATA DIM_X 0x382370 EXTERN BYTE IF_DATA MCMESS 0x382370 EXTERN /end MEASUREMENT
/begin MEASUREMENT B_kupgw "Bedingung Kupplung betätigt bis erkannter Gangwechsel" UBYTE B_TRUE 1 100 0 1 BIT_MASK 0x8 FUNCTION_LIST ARMD IF_DATA DIM_X 0x380C27 EXTERN BYTE IF_DATA MCMESS 0x380C27 EXTERN /end MEASUREMENT
/begin MEASUREMENT B_kuppl "Bedingung Kupplung betätigt" UWORD B_TRUE 1 100 0 1 BIT_MASK 0x1 FUNCTION_LIST GGEGAS ARMD BBFGR BBSAWE DMDSTP LDOB LLRBB LLRMR LLRNS NMAXMD NWS SLS T2DFA T2LID VS IF_DATA DIM_X 0xFD3C INTERN BYTE IF_DATA MCMESS 0xFD3C INTERN /end MEASUREMENT
/begin MEASUREMENT B_kupplv "Bedingung Kupplung betätigt verzögert" UWORD B_TRUE 1 100 0 1 BIT_MASK 0x2 FUNCTION_LIST GGEGAS MDFAW MDKOG IF_DATA DIM_X 0xFD3C INTERN BYTE IF_DATA MCMESS 0xFD3C INTERN /end MEASUREMENT
/begin MEASUREMENT B_kvsffl "Bedingung: Freigabe des Fehlers trotz Tank leer" UWORD B_TRUE 1 100 0 1 BIT_MASK 0x40 FUNCTION_LIST DKVS IF_DATA DIM_X 0xFD52 INTERN BYTE IF_DATA MCMESS 0xFD52 INTERN /end MEASUREMENT
/begin MEASUREMENT B_kw "Bedingung Kat warmhalten" UWORD B_TRUE 1 100 0 1 BIT_MASK 0x4 FUNCTION_LIST BBKHZ ATM KHMD MDAUTG MDKOG ZWMIN IF_DATA DIM_X 0xFD60 INTERN BYTE IF_DATA MCMESS 0xFD60 INTERN /end MEASUREMENT
/begin MEASUREMENT B_kwav "Bedingung Kühlwasserabsperrventil ansteuern" UWORD B_TRUE 1 100 0 1 BIT_MASK 0x1000 FUNCTION_LIST AKWAV DKWAVE GGTFM VHW IF_DATA DIM_X 0xFD90 INTERN BYTE IF_DATA MCMESS 0xFD90 INTERN /end MEASUREMENT
/begin MEASUREMENT B_kwav_c "Anforderung über CAN: Kühlwasserabsperrventil ansteuern" UWORD B_TRUE 1 100 0 1 BIT_MASK 0x100 FUNCTION_LIST CAN AKWAV IF_DATA DIM_X 0xFD08 INTERN BYTE IF_DATA MCMESS 0xFD08 INTERN /end MEASUREMENT
/begin MEASUREMENT B_lalgf "Bedingung Laufgrenze ""Lambda fett"" aktiv" UWORD B_TRUE 1 100 0 1 BIT_MASK 0x400 FUNCTION_LIST LAMKO IF_DATA DIM_X 0xFD58 INTERN BYTE IF_DATA MCMESS 0xFD58 INTERN /end MEASUREMENT
/begin MEASUREMENT B_lalgf2 "Bedingung Laufgrenze ""Lambda fett"" aktiv" UWORD B_TRUE 1 100 0 1 BIT_MASK 0x800 FUNCTION_LIST LAMKO IF_DATA DIM_X 0xFD58 INTERN BYTE IF_DATA MCMESS 0xFD58 INTERN /end MEASUREMENT
/begin MEASUREMENT B_lambts "Lambda für Bauteileschutz ist aktiv" UWORD B_TRUE 1 100 0 1 BIT_MASK 0x1000 FUNCTION_LIST LAMKO IF_DATA DIM_X 0xFD58 INTERN BYTE IF_DATA MCMESS 0xFD58 INTERN /end MEASUREMENT
/begin MEASUREMENT B_lambts2 "Lambda für Bauteileschutz ist aktiv (Bank2)" UWORD B_TRUE 1 100 0 1 BIT_MASK 0x2000 FUNCTION_LIST LAMKO IF_DATA DIM_X 0xFD58 INTERN BYTE IF_DATA MCMESS 0xFD58 INTERN /end MEASUREMENT
/begin MEASUREMENT B_lamend "Bedingung Ende der Lambdaverstellung in %LAMKO" UWORD B_TRUE 1 100 0 1 BIT_MASK 0x1000 FUNCTION_LIST DLSAHK IF_DATA DIM_X 0xFD24 INTERN BYTE IF_DATA MCMESS 0xFD24 INTERN /end MEASUREMENT
/begin MEASUREMENT B_lamend2 "Bedingung Ende der Lambdaverstellung in %LAMKO Bank2" UWORD B_TRUE 1 100 0 1 BIT_MASK 0x2000 FUNCTION_LIST DLSAHK IF_DATA DIM_X 0xFD24 INTERN BYTE IF_DATA MCMESS 0xFD24 INTERN /end MEASUREMENT
/begin MEASUREMENT B_lamka "Lambda für Kat-Ausräumen aktiv" UWORD B_TRUE 1 100 0 1 BIT_MASK 0x4000 FUNCTION_LIST LAMKO TEBEB IF_DATA DIM_X 0xFD58 INTERN BYTE IF_DATA MCMESS 0xFD58 INTERN /end MEASUREMENT
/begin MEASUREMENT B_lamka2 "Lambda für Kat-Ausräumen aktiv" UWORD B_TRUE 1 100 0 1 BIT_MASK 0x8000 FUNCTION_LIST LAMKO TEBEB IF_DATA DIM_X 0xFD58 INTERN BYTE IF_DATA MCMESS 0xFD58 INTERN /end MEASUREMENT
/begin MEASUREMENT B_lamkhe "keine Lambdaanforderung seitens LAKH" UWORD B_TRUE 1 100 0 1 BIT_MASK 0x10 FUNCTION_LIST LAKH IF_DATA DIM_X 0xFD60 INTERN BYTE IF_DATA MCMESS 0xFD60 INTERN /end MEASUREMENT
/begin MEASUREMENT B_lamlash "Bedingung für Abmagern/Anfetten in %LAMKO" UWORD B_TRUE 1 100 0 1 BIT_MASK 0x4000 FUNCTION_LIST DLSAHK LAMKO IF_DATA DIM_X 0xFD24 INTERN BYTE IF_DATA MCMESS 0xFD24 INTERN /end MEASUREMENT
/begin MEASUREMENT B_lamlash2 "Bedingung für Abmagern in %LAMKO Bank2" UWORD B_TRUE 1 100 0 1 BIT_MASK 0x8000 FUNCTION_LIST DLSAHK LAMKO IF_DATA DIM_X 0xFD24 INTERN BYTE IF_DATA MCMESS 0xFD24 INTERN /end MEASUREMENT
/begin MEASUREMENT B_lamnse "Bedingung Ende lamns_w-Berechnung" UWORD B_TRUE 1 100 0 1 BIT_MASK 0x1000 FUNCTION_LIST ESNST LAMKO IF_DATA DIM_X 0xFD52 INTERN BYTE IF_DATA MCMESS 0xFD52 INTERN /end MEASUREMENT
/begin MEASUREMENT B_lamnswl "Lambda-Motor-Soll für Nachstart und Warmlauf aktiv" UWORD B_TRUE 1 100 0 1 BIT_MASK 0x1 FUNCTION_LIST LAMKO IF_DATA DIM_X 0xFD5A INTERN BYTE IF_DATA MCMESS 0xFD5A INTERN /end MEASUREMENT
/begin MEASUREMENT B_lamsdef "Bedingung : definierte Soll-Lambda" UWORD B_TRUE 1 100 0 1 BIT_MASK 0x2 FUNCTION_LIST LAMKO TEBEB IF_DATA DIM_X 0xFD5A INTERN BYTE IF_DATA MCMESS 0xFD5A INTERN /end MEASUREMENT
/begin MEASUREMENT B_lamverg "Bedingung Vergleich Lambdasoll in %DLSAHK mit %LAMKO übereinstimmend" UWORD B_TRUE 1 100 0 1 BIT_MASK 0x1 FUNCTION_LIST DLSAHK IF_DATA DIM_X 0xFD26 INTERN BYTE IF_DATA MCMESS 0xFD26 INTERN /end MEASUREMENT
/begin MEASUREMENT B_lamverg2 "Bedingung Vergleich Lambdasoll in %DLSAHK mit %LAMKO übereinstimmend Bank2" UWORD B_TRUE 1 100 0 1 BIT_MASK 0x2 FUNCTION_LIST DLSAHK IF_DATA DIM_X 0xFD26 INTERN BYTE IF_DATA MCMESS 0xFD26 INTERN /end MEASUREMENT
/begin MEASUREMENT B_lawlon "lamwl_w ist aktiv" UWORD B_TRUE 1 100 0 1 BIT_MASK 0x80 FUNCTION_LIST ESWL IF_DATA DIM_X 0xFD58 INTERN BYTE IF_DATA MCMESS 0xFD58 INTERN /end MEASUREMENT
/begin MEASUREMENT B_ldb "Bedingung für Ladedruckregelbereitschaft" UWORD B_TRUE 1 100 0 1 BIT_MASK 0x8 FUNCTION_LIST BBLDR LDTVMA IF_DATA DIM_X 0xFD66 INTERN BYTE IF_DATA MCMESS 0xFD66 INTERN /end MEASUREMENT
/begin MEASUREMENT B_lddy "Flag für Bedingung LDR-Dynamikbetrieb" UWORD B_TRUE 1 100 0 1 BIT_MASK 0x2000 FUNCTION_LIST LDRPID IF_DATA DIM_X 0xFD66 INTERN BYTE IF_DATA MCMESS 0xFD66 INTERN /end MEASUREMENT
/begin MEASUREMENT B_ldef "Bedingung : definierte Soll-Lambda Bank1" UWORD B_TRUE 1 100 0 1 BIT_MASK 0x4 FUNCTION_LIST LAMKO IF_DATA DIM_X 0xFD5A INTERN BYTE IF_DATA MCMESS 0xFD5A INTERN /end MEASUREMENT
/begin MEASUREMENT B_ldef2 "Bedingung : definierte Soll-Lambda Bank2" UWORD B_TRUE 1 100 0 1 BIT_MASK 0x8 FUNCTION_LIST LAMKO IF_DATA DIM_X 0xFD5A INTERN BYTE IF_DATA MCMESS 0xFD5A INTERN /end MEASUREMENT
/begin MEASUREMENT B_ldimxa "Bedingung für Adaption Begrenzungswert I-Anteil LDR" UWORD B_TRUE 1 100 0 1 BIT_MASK 0x4000 FUNCTION_LIST LDRPID IF_DATA DIM_X 0xFD66 INTERN BYTE IF_DATA MCMESS 0xFD66 INTERN /end MEASUREMENT
/begin MEASUREMENT B_ldimxn "Bedingung für Negativ-Korrektur ldimxr" UWORD B_TRUE 1 100 0 1 BIT_MASK 0x8000 FUNCTION_LIST LDRPID IF_DATA DIM_X 0xFD66 INTERN BYTE IF_DATA MCMESS 0xFD66 INTERN /end MEASUREMENT
/begin MEASUREMENT B_ldimxp "Bedingung für Positiv-Korrektur ldimxr" UWORD B_TRUE 1 100 0 1 BIT_MASK 0x1 FUNCTION_LIST LDRPID IF_DATA DIM_X 0xFD68 INTERN BYTE IF_DATA MCMESS 0xFD68 INTERN /end MEASUREMENT
/begin MEASUREMENT B_ldob "Bedingung: Overboost aktiv" UWORD B_TRUE 1 100 0 1 BIT_MASK 0x400 FUNCTION_LIST LDOB DLDR LAMFAW LDRPLS IF_DATA DIM_X 0xFD66 INTERN BYTE IF_DATA MCMESS 0xFD66 INTERN /end MEASUREMENT
/begin MEASUREMENT B_ldobsp "Bedingung LDR Overboost innerhalb Sperrzeit" UWORD B_TRUE 1 100 0 1 BIT_MASK 0x800 FUNCTION_LIST LDOB LDRPLS IF_DATA DIM_X 0xFD66 INTERN BYTE IF_DATA MCMESS 0xFD66 INTERN /end MEASUREMENT
/begin MEASUREMENT B_ldr "Flag für Bedingung LDR aktiv" UWORD B_TRUE 1 100 0 1 BIT_MASK 0x10 FUNCTION_LIST BBLDR BGMSZS DLDR LDOB LDRPID RUNTIME IF_DATA DIM_X 0xFD66 INTERN BYTE IF_DATA MCMESS 0xFD66 INTERN /end MEASUREMENT
/begin MEASUREMENT B_ldra "Bedingung für Ersatzmaßnahme bei E_ldra" UWORD B_TRUE 1 100 0 1 BIT_MASK 0x100 FUNCTION_LIST DLDR BBLDR IF_DATA DIM_X 0xFD66 INTERN BYTE IF_DATA MCMESS 0xFD66 INTERN /end MEASUREMENT
/begin MEASUREMENT B_ldrbu "Flag für Bedingung LDR backup Regler aktiv" UWORD B_TRUE 1 100 0 1 BIT_MASK 0x20 FUNCTION_LIST BBLDR LDTVMA IF_DATA DIM_X 0xFD66 INTERN BYTE IF_DATA MCMESS 0xFD66 INTERN /end MEASUREMENT
/begin MEASUREMENT B_ldrugd "Bedingung ungedrosselt, Freigabe durch LDR" UBYTE B_TRUE 1 100 0 1 BIT_MASK 0x4 FUNCTION_LIST FUEDK DHFM IF_DATA DIM_X 0x380AFD EXTERN BYTE IF_DATA MCMESS 0x380AFD EXTERN /end MEASUREMENT
/begin MEASUREMENT B_lds "Flag für Bedingung LDR Steuerung" UWORD B_TRUE 1 100 0 1 BIT_MASK 0x40 FUNCTION_LIST BBLDR LDTVMA IF_DATA DIM_X 0xFD66 INTERN BYTE IF_DATA MCMESS 0xFD66 INTERN /end MEASUREMENT
/begin MEASUREMENT B_ldsafw "LDR läuft auf Steuerung mit Festwert LDRAPP" UWORD B_TRUE 1 100 0 1 BIT_MASK 0x20 FUNCTION_LIST PROKON LDTVMA IF_DATA DIM_X 0xFD74 INTERN BYTE IF_DATA MCMESS 0xFD74 INTERN /end MEASUREMENT
/begin MEASUREMENT B_ldsapp "LDR läuft auf Steuerung mit KFLDRAPP" UWORD B_TRUE 1 100 0 1 BIT_MASK 0x40 FUNCTION_LIST PROKON LDTVMA IF_DATA DIM_X 0xFD74 INTERN BYTE IF_DATA MCMESS 0xFD74 INTERN /end MEASUREMENT
/begin MEASUREMENT B_ldsua "Bedingung LDR Schubumluftventil aktiv (offen)" UWORD B_TRUE 1 100 0 1 BIT_MASK 0x2000 FUNCTION_LIST LDUVST DLDUVSE VHW IF_DATA DIM_X 0xFD64 INTERN BYTE IF_DATA MCMESS 0xFD64 INTERN /end MEASUREMENT
/begin MEASUREMENT B_ldsuad "Bedingung Turbo Umluftsteuerung dynamisch aktiv" UWORD B_TRUE 1 100 0 1 BIT_MASK 0x4000 FUNCTION_LIST LDUVST IF_DATA DIM_X 0xFD64 INTERN BYTE IF_DATA MCMESS 0xFD64 INTERN /end MEASUREMENT
/begin MEASUREMENT B_ldsuas "Bedingung Turbo Umluftsteuerung stationär aktiv" UWORD B_TRUE 1 100 0 1 BIT_MASK 0x8000 FUNCTION_LIST LDUVST IF_DATA DIM_X 0xFD64 INTERN BYTE IF_DATA MCMESS 0xFD64 INTERN /end MEASUREMENT
/begin MEASUREMENT B_ldvl "Bedingung für LDR-Vollast" UWORD B_TRUE 1 100 0 1 BIT_MASK 0x2 FUNCTION_LIST LDRPID IF_DATA DIM_X 0xFD68 INTERN BYTE IF_DATA MCMESS 0xFD68 INTERN /end MEASUREMENT
/begin MEASUREMENT B_lf1nbres "Bedingung für Aufbau Drehmomentenreserve bei Motorlüfter Stufe 1 Normalbetr. ein" UWORD B_TRUE 1 100 0 1 BIT_MASK 0x800 FUNCTION_LIST MLS MDVERB IF_DATA DIM_X 0xFD6A INTERN BYTE IF_DATA MCMESS 0xFD6A INTERN /end MEASUREMENT
/begin MEASUREMENT B_lf1s "Bedingung Lüfter 1.Stufe ein" UWORD B_TRUE 1 100 0 1 BIT_MASK 0x1000 FUNCTION_LIST MLS DMLSE MDVERB VHW IF_DATA DIM_X 0xFD6A INTERN BYTE IF_DATA MCMESS 0xFD6A INTERN /end MEASUREMENT
/begin MEASUREMENT B_lf2nbres "Bedingung für Aufbau Drehmomentreserve bei Motorlüfterstufe 2 Normalbetr. ein" UWORD B_TRUE 1 100 0 1 BIT_MASK 0x2000 FUNCTION_LIST MLS MDVERB IF_DATA DIM_X 0xFD6A INTERN BYTE IF_DATA MCMESS 0xFD6A INTERN /end MEASUREMENT
/begin MEASUREMENT B_lf2s "Bedingung Lüfter 2.Stufe ein" UWORD B_TRUE 1 100 0 1 BIT_MASK 0x4000 FUNCTION_LIST MLS DMLSE MDVERB VHW IF_DATA DIM_X 0xFD6A INTERN BYTE IF_DATA MCMESS 0xFD6A INTERN /end MEASUREMENT
/begin MEASUREMENT B_lf3s "Bedingung Lüfter 3.Stufe ein" UWORD B_TRUE 1 100 0 1 BIT_MASK 0x8000 FUNCTION_LIST MLS DMLSE VHW IF_DATA DIM_X 0xFD6A INTERN BYTE IF_DATA MCMESS 0xFD6A INTERN /end MEASUREMENT
/begin MEASUREMENT B_lfgr_c "Tempostatleuchte o.k. über CAN" UWORD B_TRUE 1 100 0 1 BIT_MASK 0x200 FUNCTION_LIST CAN DCFGRL IF_DATA DIM_X 0xFD08 INTERN BYTE IF_DATA MCMESS 0xFD08 INTERN /end MEASUREMENT
/begin MEASUREMENT B_lkklnl "Synchronisationsbedingung für zphflsyn=1 erfüllt" UWORD B_TRUE 1 100 0 1 BIT_MASK 0x1 FUNCTION_LIST NLDG IF_DATA DIM_X 0xFD18 INTERN BYTE IF_DATA MCMESS 0xFD18 INTERN /end MEASUREMENT
/begin MEASUREMENT B_ll "Bedingung Leerlauf" UWORD B_TRUE 1 100 0 1 BIT_MASK 0x8000 FUNCTION_LIST MDFAW ARMD BBKHZ BBLDR BBSAWE BBTEGA BGRLP CAN DKATLRS DLLR DMDLU DMDSTP DSLSLRS DTEV DVS ESUK ESWE FUEDKSA GGDSAS GGHFM GGLSU GGTFA KHMD KRDY LDRLMX LDUVST LLRBB LLRMR LLRNS LRSEB MDAUTG MDKOG MLS NLPH NWS SGAAU SLS T2DFA T2LID T2STA VS WANWKW IF_DATA DIM_X 0xFD6C INTERN BYTE IF_DATA MCMESS 0xFD6C INTERN /end MEASUREMENT
/begin MEASUREMENT B_lldia "Diagnose Leerlaufregelung freigegeben" UWORD B_TRUE 1 100 0 1 BIT_MASK 0x40 FUNCTION_LIST DLLR IF_DATA DIM_X 0xFD68 INTERN BYTE IF_DATA MCMESS 0xFD68 INTERN /end MEASUREMENT
/begin MEASUREMENT B_llr "Bedingung Leerlaufregelung" UWORD B_TRUE 1 100 0 1 BIT_MASK 0x100 FUNCTION_LIST LLRBB DLLR DTEV DVS LLRRM MDVERAD RUNTIME T2DFA IF_DATA DIM_X 0xFD68 INTERN BYTE IF_DATA MCMESS 0xFD68 INTERN /end MEASUREMENT
/begin MEASUREMENT B_llrein "Bedingung LLR ist aktiv" UWORD B_TRUE 1 100 0 1 BIT_MASK 0x200 FUNCTION_LIST LLRBB FUEDK LLRNS LLRRM MDKOG MDKOL MDVER MDVERAD STMD ZUE IF_DATA DIM_X 0xFD68 INTERN BYTE IF_DATA MCMESS 0xFD68 INTERN /end MEASUREMENT
/begin MEASUREMENT B_llri "Bedingung I-Anteil der LLR aktiv" UWORD B_TRUE 1 100 0 1 BIT_MASK 0x400 FUNCTION_LIST LLRBB LLRRM IF_DATA DIM_X 0xFD68 INTERN BYTE IF_DATA MCMESS 0xFD68 INTERN /end MEASUREMENT
/begin MEASUREMENT B_llrpd "Bedingung PD-Anteil der LLR aktiv" UWORD B_TRUE 1 100 0 1 BIT_MASK 0x800 FUNCTION_LIST LLRBB LLRRM IF_DATA DIM_X 0xFD68 INTERN BYTE IF_DATA MCMESS 0xFD68 INTERN /end MEASUREMENT
/begin MEASUREMENT B_ll_um "Bedingung Leerlauf für Ebene II" UBYTE B_TRUE 1 100 0 1 BIT_MASK 0x1 FUNCTION_LIST UFURAM IF_DATA DIM_X 0x382E40 EXTERN WORD IF_DATA MCMESS 0x382E40 EXTERN /end MEASUREMENT
/begin MEASUREMENT B_lmpasr "" UWORD B_TRUE 1 100 0 1 BIT_MASK 0x400 FUNCTION_LIST CAN IF_DATA DIM_X 0xFD08 INTERN BYTE IF_DATA MCMESS 0xFD08 INTERN /end MEASUREMENT
/begin MEASUREMENT B_lmsslof "Bedingung Lambda-Motor-Soll-Sekundärluftanteil, Aus" UBYTE B_TRUE 1 100 0 1 BIT_MASK 0x8 FUNCTION_LIST SLS BBKHZ IF_DATA DIM_X 0x38091F EXTERN BYTE IF_DATA MCMESS 0x38091F EXTERN /end MEASUREMENT
/begin MEASUREMENT B_lr "LREB: Bedingung Lambdaregelung (vor Kat); (Bank 1)" UWORD B_TRUE 1 100 0 1 BIT_MASK 0x200 FUNCTION_LIST LRSEB BBTEGA DKATLRS DKVS DLSAHK DTEV LRAEB LRSHK SGAAU T2DFA TEB TEBEB IF_DATA DIM_X 0xFD7C INTERN BYTE IF_DATA MCMESS 0xFD7C INTERN /end MEASUREMENT
/begin MEASUREMENT B_lr2 "Bedingung Lambdaregelung (vor Kat); Bank 2" UWORD B_TRUE 1 100 0 1 BIT_MASK 0x400 FUNCTION_LIST LRSEB BBTEGA DKATLRS DKVS DLSAHK DTEV LRAEB LRSHK SGAAU T2DFA TEB TEBEB IF_DATA DIM_X 0xFD7C INTERN BYTE IF_DATA MCMESS 0xFD7C INTERN /end MEASUREMENT
/begin MEASUREMENT B_lr2s "CARB FREEZE FRAME, Bank1 bit 1, LR: Regelbetrieb mit zwei Sonden" UBYTE B_TRUE 1 100 0 1 BIT_MASK 0x2 FUNCTION_LIST LRSEB IF_DATA DIM_X 0x380C8A EXTERN BYTE IF_DATA MCMESS 0x380C8A EXTERN /end MEASUREMENT
/begin MEASUREMENT B_lr2s2 "CARB FREEZE FRAME, Bank2 Bit 1, LR: Regelbetrieb mit zwei Sonden" UBYTE B_TRUE 1 100 0 1 BIT_MASK 0x2 FUNCTION_LIST LRSEB IF_DATA DIM_X 0x380C8B EXTERN BYTE IF_DATA MCMESS 0x380C8B EXTERN /end MEASUREMENT
/begin MEASUREMENT B_lra "Bedingung Gemischadaption freigegeben" UWORD B_TRUE 1 100 0 1 BIT_MASK 0x80 FUNCTION_LIST LRAEB DKVS LRA IF_DATA DIM_X 0xFD5C INTERN BYTE IF_DATA MCMESS 0xFD5C INTERN /end MEASUREMENT
/begin MEASUREMENT B_lra2 "Bedingung Gemischadaption 2 freigegeben" UWORD B_TRUE 1 100 0 1 BIT_MASK 0x100 FUNCTION_LIST LRAEB DKVS LRA IF_DATA DIM_X 0xFD5C INTERN BYTE IF_DATA MCMESS 0xFD5C INTERN /end MEASUREMENT
/begin MEASUREMENT B_lrar "Bedingung reduzierte Korrekturbereiche in der LRA" UWORD B_TRUE 1 100 0 1 BIT_MASK 0x2 FUNCTION_LIST TEB DLLR LRA IF_DATA DIM_X 0xFD88 INTERN BYTE IF_DATA MCMESS 0xFD88 INTERN /end MEASUREMENT
/begin MEASUREMENT B_lrare "Bedingung Reset LRA" UWORD B_TRUE 1 100 0 1 BIT_MASK 0x400 FUNCTION_LIST LRA DKVS IF_DATA DIM_X 0xFD5A INTERN BYTE IF_DATA MCMESS 0xFD5A INTERN /end MEASUREMENT
/begin MEASUREMENT B_lrare2 "Bedingung Reset LRA Bank 2" UWORD B_TRUE 1 100 0 1 BIT_MASK 0x800 FUNCTION_LIST LRA IF_DATA DIM_X 0xFD5A INTERN BYTE IF_DATA MCMESS 0xFD5A INTERN /end MEASUREMENT
/begin MEASUREMENT B_lrareb "Bedingung Resetbereitschaft LRA" UWORD B_TRUE 1 100 0 1 BIT_MASK 0x1000 FUNCTION_LIST LRA IF_DATA DIM_X 0xFD5A INTERN BYTE IF_DATA MCMESS 0xFD5A INTERN /end MEASUREMENT
/begin MEASUREMENT B_lrhk "Bedingung Lambdaregelung hinter Kat" UWORD B_TRUE 1 100 0 1 BIT_MASK 0x400 FUNCTION_LIST LRSHK DLSAHK DLSH DLSSA DLSU IF_DATA DIM_X 0xFD7E INTERN BYTE IF_DATA MCMESS 0xFD7E INTERN /end MEASUREMENT
/begin MEASUREMENT B_lrhk2 "Bedingung Lambdaregelung hinter Kat (Bank 2)" UWORD B_TRUE 1 100 0 1 BIT_MASK 0x800 FUNCTION_LIST LRSHK DLSAHK DLSH DLSSA DLSU IF_DATA DIM_X 0xFD7E INTERN BYTE IF_DATA MCMESS 0xFD7E INTERN /end MEASUREMENT
/begin MEASUREMENT B_lrhkb "LRHK: Bedingung Lambdaregelung h. Kat, bankspez. Parameter Bank 1" UWORD B_TRUE 1 100 0 1 BIT_MASK 0x1000 FUNCTION_LIST LRSHK IF_DATA DIM_X 0xFD7E INTERN BYTE IF_DATA MCMESS 0xFD7E INTERN /end MEASUREMENT
/begin MEASUREMENT B_lrhkb2 "LRHK: Bedingung Lambdaregelung h. Kat, bankspez. Parameter Bank 2" UWORD B_TRUE 1 100 0 1 BIT_MASK 0x2000 FUNCTION_LIST LRSHK IF_DATA DIM_X 0xFD7E INTERN BYTE IF_DATA MCMESS 0xFD7E INTERN /end MEASUREMENT
/begin MEASUREMENT B_lrhkg "LRHK: bankunabhängige Bedingung Lambdaregelung hinter Kat" UWORD B_TRUE 1 100 0 1 BIT_MASK 0x4000 FUNCTION_LIST LRSHK IF_DATA DIM_X 0xFD7E INTERN BYTE IF_DATA MCMESS 0xFD7E INTERN /end MEASUREMENT
/begin MEASUREMENT B_lrhkp "LRHK: Freigabebedingung P-Anteil Lambdaregelung hinter Kat" UWORD B_TRUE 1 100 0 1 BIT_MASK 0x8000 FUNCTION_LIST LRSHK DLSU IF_DATA DIM_X 0xFD7E INTERN BYTE IF_DATA MCMESS 0xFD7E INTERN /end MEASUREMENT
/begin MEASUREMENT B_lrhkp2 "LRHK Bank2: Freigabebedingung P-Anteil Lambdaregelung hinter Kat" UWORD B_TRUE 1 100 0 1 BIT_MASK 0x1 FUNCTION_LIST LRSHK DLSU IF_DATA DIM_X 0xFD80 INTERN BYTE IF_DATA MCMESS 0xFD80 INTERN /end MEASUREMENT
/begin MEASUREMENT B_lrin "Steuerbit LRS intern" UWORD B_TRUE 1 100 0 1 BIT_MASK 0x1000 FUNCTION_LIST LRS IF_DATA DIM_X 0xFD7A INTERN BYTE IF_DATA MCMESS 0xFD7A INTERN /end MEASUREMENT
/begin MEASUREMENT B_lrin2 "Steuerbit LRS intern, Bank2" UWORD B_TRUE 1 100 0 1 BIT_MASK 0x2000 FUNCTION_LIST LRS IF_DATA DIM_X 0xFD7A INTERN BYTE IF_DATA MCMESS 0xFD7A INTERN /end MEASUREMENT
/begin MEASUREMENT B_lrka "Bedingung Katalysator-Ausräumen" UWORD B_TRUE 1 100 0 1 BIT_MASK 0x10 FUNCTION_LIST LRSKA DKATLRS LRS LRSHK T2DFA IF_DATA DIM_X 0xFD7A INTERN BYTE IF_DATA MCMESS 0xFD7A INTERN /end MEASUREMENT
/begin MEASUREMENT B_lrka2 "Bedingung Katalysator-Ausräumen für Stereo-LR Bank 2" UWORD B_TRUE 1 100 0 1 BIT_MASK 0x20 FUNCTION_LIST LRSKA DKATLRS LRS LRSHK IF_DATA DIM_X 0xFD7A INTERN BYTE IF_DATA MCMESS 0xFD7A INTERN /end MEASUREMENT
/begin MEASUREMENT B_lrkae "Bedingung gesteuertes Katalysator-Ausräumen möglich" UWORD B_TRUE 1 100 0 1 BIT_MASK 0x40 FUNCTION_LIST LRSKA IF_DATA DIM_X 0xFD7A INTERN BYTE IF_DATA MCMESS 0xFD7A INTERN /end MEASUREMENT
/begin MEASUREMENT B_lrkae2 "Bedingung gesteuertes Katalysator-Ausräumen möglich, Bank 2" UWORD B_TRUE 1 100 0 1 BIT_MASK 0x80 FUNCTION_LIST LRSKA IF_DATA DIM_X 0xFD7A INTERN BYTE IF_DATA MCMESS 0xFD7A INTERN /end MEASUREMENT
/begin MEASUREMENT B_lrms "Bedingung Abmagerungsverbot für stetige Regelung" UWORD B_TRUE 1 100 0 1 BIT_MASK 0x800 FUNCTION_LIST LRSEB LRS IF_DATA DIM_X 0xFD7C INTERN BYTE IF_DATA MCMESS 0xFD7C INTERN /end MEASUREMENT
/begin MEASUREMENT B_lrnakt "Lernaktiv Bit" UWORD B_TRUE 1 100 0 1 BIT_MASK 0x200 FUNCTION_LIST BGDVE DDVE T2DVE IF_DATA DIM_X 0xFD36 INTERN BYTE IF_DATA MCMESS 0xFD36 INTERN /end MEASUREMENT
/begin MEASUREMENT B_lrnda "LR Bank1 aktiv bei Bedingungen : B_lrpspa & B_lrkasn & !E_obdlr" UWORD B_TRUE 1 100 0 1 BIT_MASK 0x1000 FUNCTION_LIST LRSEB ESWL T2DFA IF_DATA DIM_X 0xFD7C INTERN BYTE IF_DATA MCMESS 0xFD7C INTERN /end MEASUREMENT
/begin MEASUREMENT B_lrnda2 "LR Bank2 aktiv bei Bedingungen : B_lrpspa & B_lrkasn & !E_obdlr" UWORD B_TRUE 1 100 0 1 BIT_MASK 0x2000 FUNCTION_LIST LRSEB ESWL T2DFA IF_DATA DIM_X 0xFD7C INTERN BYTE IF_DATA MCMESS 0xFD7C INTERN /end MEASUREMENT
/begin MEASUREMENT B_lrndia "Bedingung: DV-E-Adaption und Prüfungen per Diagnose-Tester aktivieren" UWORD B_TRUE 1 100 0 1 BIT_MASK 0x40 FUNCTION_LIST T2DVE BGDVE IF_DATA DIM_X 0xFD06 INTERN BYTE IF_DATA MCMESS 0xFD06 INTERN /end MEASUREMENT
/begin MEASUREMENT B_lrnerf "Lernerfolg Bit" UBYTE B_TRUE 1 100 0 1 BIT_MASK 0x8 FUNCTION_LIST BGDVE DDVE T2DVE IF_DATA DIM_X 0x382FF7 EXTERN BYTE IF_DATA MCMESS 0x382FF7 EXTERN /end MEASUREMENT
/begin MEASUREMENT B_lrnfg "Lernfreigabe Bit" UWORD B_TRUE 1 100 0 1 BIT_MASK 0x400 FUNCTION_LIST BGDVE T2DVE IF_DATA DIM_X 0xFD36 INTERN BYTE IF_DATA MCMESS 0xFD36 INTERN /end MEASUREMENT
/begin MEASUREMENT B_lrnrdy "Lernen ist beendet" UWORD B_TRUE 1 100 0 1 BIT_MASK 0x800 FUNCTION_LIST BGDVE ADVE DDVE T2DVE IF_DATA DIM_X 0xFD36 INTERN BYTE IF_DATA MCMESS 0xFD36 INTERN /end MEASUREMENT
/begin MEASUREMENT B_lrntesa "Bedingung: UMA-Lernen u. Verst.abgl wegen Tester-Anford. aktiviert" UWORD B_TRUE 1 100 0 1 BIT_MASK 0x1000 FUNCTION_LIST BGDVE IF_DATA DIM_X 0xFD36 INTERN BYTE IF_DATA MCMESS 0xFD36 INTERN /end MEASUREMENT
/begin MEASUREMENT B_lrnvb "Lernverbot Bit" UWORD B_TRUE 1 100 0 1 BIT_MASK 0x2000 FUNCTION_LIST BGDVE DDVE T2DVE IF_DATA DIM_X 0xFD36 INTERN BYTE IF_DATA MCMESS 0xFD36 INTERN /end MEASUREMENT
/begin MEASUREMENT B_lrnws "Lernwertspeicherung Bit" UBYTE B_TRUE 1 100 0 1 BIT_MASK 0x1 FUNCTION_LIST BGDVE DDVE IF_DATA DIM_X 0x382FF7 EXTERN BYTE IF_DATA MCMESS 0x382FF7 EXTERN /end MEASUREMENT
/begin MEASUREMENT B_lrrl "LREB: Von Last abhängige Bedingung Lambdaregelung (vor Kat)" UWORD B_TRUE 1 100 0 1 BIT_MASK 0x4000 FUNCTION_LIST LRSEB IF_DATA DIM_X 0xFD7C INTERN BYTE IF_DATA MCMESS 0xFD7C INTERN /end MEASUREMENT
/begin MEASUREMENT B_lrs "LRSEB: Bedingung Lambdaregelung intern(vor Kat); (Bank 1)" UWORD B_TRUE 1 100 0 1 BIT_MASK 0x8000 FUNCTION_LIST LRSEB DLSU DLSUV DSLSLRS ESUKAS LRS RUNTIME IF_DATA DIM_X 0xFD7C INTERN BYTE IF_DATA MCMESS 0xFD7C INTERN /end MEASUREMENT
/begin MEASUREMENT B_lrs2 "LRSEB: Bedingung Lambdaregelung intern(vor Kat); (Bank 2)" UWORD B_TRUE 1 100 0 1 BIT_MASK 0x1 FUNCTION_LIST LRSEB DLSU DLSUV DSLSLRS ESUKAS LRS IF_DATA DIM_X 0xFD7E INTERN BYTE IF_DATA MCMESS 0xFD7E INTERN /end MEASUREMENT
/begin MEASUREMENT B_lrsresf "Bedingung Fr-Reset bei lamsons<LALIUSMN" UBYTE B_TRUE 1 100 0 1 BIT_MASK 0x20 FUNCTION_LIST LRSEB LRS IF_DATA DIM_X 0x380C8A EXTERN BYTE IF_DATA MCMESS 0x380C8A EXTERN /end MEASUREMENT
/begin MEASUREMENT B_lrsresuk "Bedingung fr-Reset bei großer ÜK (B_lrms)" UBYTE B_TRUE 1 100 0 1 BIT_MASK 0x40 FUNCTION_LIST LRSEB LRS IF_DATA DIM_X 0x380C8A EXTERN BYTE IF_DATA MCMESS 0x380C8A EXTERN /end MEASUREMENT
/begin MEASUREMENT B_lrssa "LRSEB: Einschaltbed. für Lambdareg. nach Schub bei langsamer Sonde" UWORD B_TRUE 1 100 0 1 BIT_MASK 0x2 FUNCTION_LIST LRSEB TEBEB IF_DATA DIM_X 0xFD7E INTERN BYTE IF_DATA MCMESS 0xFD7E INTERN /end MEASUREMENT
/begin MEASUREMENT B_lrssa2 "Einschaltbed. für Lambdareg. nach Schub bei langsamer Sonde, Bank2" UWORD B_TRUE 1 100 0 1 BIT_MASK 0x4 FUNCTION_LIST LRSEB TEBEB IF_DATA DIM_X 0xFD7E INTERN BYTE IF_DATA MCMESS 0xFD7E INTERN /end MEASUREMENT
/begin MEASUREMENT B_lrssp "Lamda-Regelung setzt Bit, wenn Zusatzamplitude Vorzeichenwechsel" UWORD B_TRUE 1 100 0 1 BIT_MASK 0x4000 FUNCTION_LIST LRS LRSHK IF_DATA DIM_X 0xFD7A INTERN BYTE IF_DATA MCMESS 0xFD7A INTERN /end MEASUREMENT
/begin MEASUREMENT B_lrvk "CARB FREEZE FRAME, Bank1 Bit 4, LR: Regelung nur mit einer Sonde (vor KAT)" UBYTE B_TRUE 1 100 0 1 BIT_MASK 0x10 FUNCTION_LIST LRSEB IF_DATA DIM_X 0x380C8A EXTERN BYTE IF_DATA MCMESS 0x380C8A EXTERN /end MEASUREMENT
/begin MEASUREMENT B_lrvk2 "CARB FREEZE FRAME, Bank2 Bit 4, LR: Regelung nur mit einer Sonde (vor KAT)" UBYTE B_TRUE 1 100 0 1 BIT_MASK 0x10 FUNCTION_LIST LRSEB IF_DATA DIM_X 0x380C8B EXTERN BYTE IF_DATA MCMESS 0x380C8B EXTERN /end MEASUREMENT
/begin MEASUREMENT B_ls "Bedingung: Lastschlagbegrenzung kleiner Fahrerwunsch (=1)" UBYTE B_TRUE 1 100 0 1 BIT_MASK 0x2 FUNCTION_LIST MDFAW IF_DATA DIM_X 0x380C37 EXTERN BYTE IF_DATA MCMESS 0x380C37 EXTERN /end MEASUREMENT
/begin MEASUREMENT B_ls3 "Bedingung 3. Lambda-Sonde nach Auslaß vorbaut (Bank1)" UWORD B_TRUE 1 100 0 1 BIT_MASK 0x80 FUNCTION_LIST PROKON IF_DATA DIM_X 0xFD74 INTERN BYTE IF_DATA MCMESS 0xFD74 INTERN /end MEASUREMENT
/begin MEASUREMENT B_ls32 "Bedingung 3. Lambda-Sonde nach Auslaß vorbaut (Bank2)" UWORD B_TRUE 1 100 0 1 BIT_MASK 0x100 FUNCTION_LIST PROKON IF_DATA DIM_X 0xFD74 INTERN BYTE IF_DATA MCMESS 0xFD74 INTERN /end MEASUREMENT
/begin MEASUREMENT B_ls4 "Bedingung 4. Lambda-Sonde nach Auslaß vorbaut (Bank1)" UWORD B_TRUE 1 100 0 1 BIT_MASK 0x200 FUNCTION_LIST PROKON IF_DATA DIM_X 0xFD74 INTERN BYTE IF_DATA MCMESS 0xFD74 INTERN /end MEASUREMENT
/begin MEASUREMENT B_ls42 "Bedingung 4. Lambda-Sonde nach Auslaß vorbaut (Bank2)" UWORD B_TRUE 1 100 0 1 BIT_MASK 0x400 FUNCTION_LIST PROKON IF_DATA DIM_X 0xFD74 INTERN BYTE IF_DATA MCMESS 0xFD74 INTERN /end MEASUREMENT
/begin MEASUREMENT B_lsahksp "allgemeine Stop-Bedingungen für die DLSAHK" UWORD B_TRUE 1 100 0 1 BIT_MASK 0x4 FUNCTION_LIST DLSAHK IF_DATA DIM_X 0xFD26 INTERN BYTE IF_DATA MCMESS 0xFD26 INTERN /end MEASUREMENT
/begin MEASUREMENT B_lsahksp2 "allgemeine Stop-Bedingungen für die DLSAHK Bank2" UWORD B_TRUE 1 100 0 1 BIT_MASK 0x8 FUNCTION_LIST DLSAHK IF_DATA DIM_X 0xFD26 INTERN BYTE IF_DATA MCMESS 0xFD26 INTERN /end MEASUREMENT
/begin MEASUREMENT B_lsd "Bedingung: Pos. Lastschlagdämpfung aktiv" UWORD B_TRUE 1 100 0 1 BIT_MASK 0x1 FUNCTION_LIST MDFAW DKUPPL FUEDK MDAUTG MDKOG MDKOL RUNTIME IF_DATA DIM_X 0xFD6E INTERN BYTE IF_DATA MCMESS 0xFD6E INTERN /end MEASUREMENT
/begin MEASUREMENT B_lsh "Bedingung Lambda-Sonde hinter Kat verbaut" UWORD B_TRUE 1 100 0 1 BIT_MASK 0x800 FUNCTION_LIST PROKON GGLSH TC1MOD TC5MOD IF_DATA DIM_X 0xFD74 INTERN BYTE IF_DATA MCMESS 0xFD74 INTERN /end MEASUREMENT
/begin MEASUREMENT B_lsh2 "Bedingung Lambda-Sonde hinter Kat verbaut (Bank2)" UWORD B_TRUE 1 100 0 1 BIT_MASK 0x1000 FUNCTION_LIST PROKON GGLSH TC1MOD TC5MOD IF_DATA DIM_X 0xFD74 INTERN BYTE IF_DATA MCMESS 0xFD74 INTERN /end MEASUREMENT
/begin MEASUREMENT B_lshklt "Bedingung Lambdasonde hinter Kat kalt" UWORD B_TRUE 1 100 0 1 BIT_MASK 0x200 FUNCTION_LIST DLSH IF_DATA DIM_X 0xFD28 INTERN BYTE IF_DATA MCMESS 0xFD28 INTERN /end MEASUREMENT
/begin MEASUREMENT B_lsrdy "Bedingung Lambda-Sonden geprüft für 'ready-Byte'" UBYTE B_TRUE 1 100 0 1 BIT_MASK 0x20 FUNCTION_LIST DIMC IF_DATA DIM_X 0x382FD0 EXTERN BYTE IF_DATA MCMESS 0x382FD0 EXTERN /end MEASUREMENT
/begin MEASUREMENT B_lsuab "Bedingung Abgleich stetige Lambda-Sonde LSU" UWORD B_TRUE 1 100 0 1 BIT_MASK 0x8000 FUNCTION_LIST GGLSU DLSU VHW IF_DATA DIM_X 0xFD2E INTERN BYTE IF_DATA MCMESS 0xFD2E INTERN /end MEASUREMENT
/begin MEASUREMENT B_lsuab2 "Bedingung Abgleich stetige Lambda-Sonde LSU2" UWORD B_TRUE 1 100 0 1 BIT_MASK 0x1 FUNCTION_LIST GGLSU DLSU VHW IF_DATA DIM_X 0xFD30 INTERN BYTE IF_DATA MCMESS 0xFD30 INTERN /end MEASUREMENT
/begin MEASUREMENT B_lsuft "LSU Bank1 fett, nicht plausibel" UWORD B_TRUE 1 100 0 1 BIT_MASK 0x400 FUNCTION_LIST DLSU IF_DATA DIM_X 0x381D14 EXTERN BYTE IF_DATA MCMESS 0x381D14 EXTERN /end MEASUREMENT
/begin MEASUREMENT B_lsuft2 "LSU Bank2 fett, nicht plausibel" UWORD B_TRUE 1 100 0 1 BIT_MASK 0x2000 FUNCTION_LIST DLSU IF_DATA DIM_X 0x381D14 EXTERN BYTE IF_DATA MCMESS 0x381D14 EXTERN /end MEASUREMENT
/begin MEASUREMENT B_lsumr "LSU Bank1 mager, nicht plausibel" UWORD B_TRUE 1 100 0 1 BIT_MASK 0x200 FUNCTION_LIST DLSU IF_DATA DIM_X 0x381D14 EXTERN BYTE IF_DATA MCMESS 0x381D14 EXTERN /end MEASUREMENT
/begin MEASUREMENT B_lsumr2 "LSU Bank2 mager, nicht plausibel" UWORD B_TRUE 1 100 0 1 BIT_MASK 0x1000 FUNCTION_LIST DLSU IF_DATA DIM_X 0x381D14 EXTERN BYTE IF_DATA MCMESS 0x381D14 EXTERN /end MEASUREMENT
/begin MEASUREMENT B_lsumx "Maximalwert der LSU-Spannung überschritten (CJ110)" UWORD B_TRUE 1 100 0 1 BIT_MASK 0x1 FUNCTION_LIST DLSU IF_DATA DIM_X 0xFD2C INTERN BYTE IF_DATA MCMESS 0xFD2C INTERN /end MEASUREMENT
/begin MEASUREMENT B_lsumx2 "Maximalwert der LSU2-Spannung überschritten (CJ110)" UWORD B_TRUE 1 100 0 1 BIT_MASK 0x2 FUNCTION_LIST DLSU IF_DATA DIM_X 0xFD2C INTERN BYTE IF_DATA MCMESS 0xFD2C INTERN /end MEASUREMENT
/begin MEASUREMENT B_lsuna "LSU nicht aktiv, Bank1" UWORD B_TRUE 1 100 0 1 BIT_MASK 0x100 FUNCTION_LIST DLSU IF_DATA DIM_X 0x381D14 EXTERN BYTE IF_DATA MCMESS 0x381D14 EXTERN /end MEASUREMENT
/begin MEASUREMENT B_lsuna2 "LSU nicht aktiv, Bank2" UWORD B_TRUE 1 100 0 1 BIT_MASK 0x800 FUNCTION_LIST DLSU IF_DATA DIM_X 0x381D14 EXTERN BYTE IF_DATA MCMESS 0x381D14 EXTERN /end MEASUREMENT
/begin MEASUREMENT B_lsv "Bedingung Lambda-Sonde vor Kat verbaut, 1. Sonde nach Auslaß (Bank1)" UWORD B_TRUE 1 100 0 1 BIT_MASK 0x2000 FUNCTION_LIST PROKON GGLSH TC1MOD TC5MOD IF_DATA DIM_X 0xFD74 INTERN BYTE IF_DATA MCMESS 0xFD74 INTERN /end MEASUREMENT
/begin MEASUREMENT B_lsv2 "Bedingung Lambda-Sonde vor Kat verbaut, 1. Sonde nach Auslaß (Bank2)" UWORD B_TRUE 1 100 0 1 BIT_MASK 0x4000 FUNCTION_LIST PROKON GGLSH TC1MOD TC5MOD IF_DATA DIM_X 0xFD74 INTERN BYTE IF_DATA MCMESS 0xFD74 INTERN /end MEASUREMENT
/begin MEASUREMENT B_lsvvsp "Bedingung Vertauschte Lambda-Sonden, Regelung sperren" UWORD B_TRUE 1 100 0 1 BIT_MASK 0x100 FUNCTION_LIST SWADP LRA IF_DATA DIM_X 0xFD84 INTERN BYTE IF_DATA MCMESS 0xFD84 INTERN /end MEASUREMENT
/begin MEASUREMENT B_luaerk_m "Monitor, Aussetzer erkannt in DMDLUA" UBYTE B_TRUE 1 100 0 1 BIT_MASK 0x2 FUNCTION_LIST DMDLUA NLPH IF_DATA DIM_X 0xE3F0 INTERN WORD IF_DATA MCMESS 0xE3F0 INTERN /end MEASUREMENT
/begin MEASUREMENT B_luecke "Aktuelles Segment liegt über der Referenzlücke" UWORD B_TRUE 1 100 0 1 BIT_MASK 0x400 FUNCTION_LIST GGDPG ALE IF_DATA DIM_X 0xFD12 INTERN BYTE IF_DATA MCMESS 0xFD12 INTERN /end MEASUREMENT
/begin MEASUREMENT B_luena "Bedingung LU-Berechnung erlaubt (ohne Verzugszeit)" UWORD B_TRUE 1 100 0 1 BIT_MASK 0x2 FUNCTION_LIST DMDSTP IF_DATA DIM_X 0xFD92 INTERN WORD IF_DATA MCMESS 0xFD92 INTERN /end MEASUREMENT
/begin MEASUREMENT B_luerk_m "Monitor, Aussetzer erkannt in DMDLU" UBYTE B_TRUE 1 100 0 1 BIT_MASK 0x4 FUNCTION_LIST DMDLU NLPH IF_DATA DIM_X 0xE456 INTERN WORD IF_DATA MCMESS 0xE456 INTERN /end MEASUREMENT
/begin MEASUREMENT B_lustop "Laufunruhe-Berechnung gesperrt" UWORD B_TRUE 1 100 0 1 BIT_MASK 0x2000 FUNCTION_LIST DMDSTP DVS IF_DATA DIM_X 0xFD94 INTERN WORD IF_DATA MCMESS 0xFD94 INTERN /end MEASUREMENT
/begin MEASUREMENT B_lustopt "Laufunruhe-Berechnung gesperrt vom 2. SG" UWORD B_TRUE 1 100 0 1 BIT_MASK 0x80 FUNCTION_LIST DMDSTP IF_DATA DIM_X 0xFD0C INTERN BYTE IF_DATA MCMESS 0xFD0C INTERN /end MEASUREMENT
/begin MEASUREMENT B_lustopu "Laufunruhe-Berechnung gesperrt, unverzögert" UWORD B_TRUE 1 100 0 1 BIT_MASK 0x4 FUNCTION_LIST DMDSTP IF_DATA DIM_X 0xFD92 INTERN WORD IF_DATA MCMESS 0xFD92 INTERN /end MEASUREMENT
/begin MEASUREMENT B_lustop_m "Laufunruhe-Berechnung gesperrt, Monitor-Größe" UBYTE B_TRUE 1 100 0 1 BIT_MASK 0x8 FUNCTION_LIST DMDLU NLPH IF_DATA DIM_X 0xE456 INTERN WORD IF_DATA MCMESS 0xE456 INTERN /end MEASUREMENT
/begin MEASUREMENT B_lwugd "Bedingung Anforderung Deaktivierung Pedalüberweg während Dashpot" UWORD B_TRUE 1 100 0 1 BIT_MASK 0x2 FUNCTION_LIST MDFAW IF_DATA DIM_X 0xFD6E INTERN BYTE IF_DATA MCMESS 0xFD6E INTERN /end MEASUREMENT
/begin MEASUREMENT B_m8te "Bedingung Fkt-Anforderung Tankentlüftung nach SAE J1979 Mode 8 TID $01" UBYTE B_TRUE 1 100 0 1 BIT_MASK 0x1 FUNCTION_LIST SCATT DTEV TC8MOD TEBEB IF_DATA DIM_X 0x380A16 EXTERN BYTE IF_DATA MCMESS 0x380A16 EXTERN /end MEASUREMENT
/begin MEASUREMENT B_m9cvn "Bedingung zur Berechnung der Checksumme (CVN) nach SAE/ISO Mode/Service $09" UBYTE B_TRUE 1 100 0 1 BIT_MASK 0x1 FUNCTION_LIST TC9MOD IF_DATA DIM_X 0x380A17 EXTERN BYTE IF_DATA MCMESS 0x380A17 EXTERN /end MEASUREMENT
/begin MEASUREMENT B_m9cvnclr "Bedingung zum Löschen der Checksumme (CVN)" UBYTE B_TRUE 1 100 0 1 BIT_MASK 0x2 FUNCTION_LIST SCATT IF_DATA DIM_X 0x380A16 EXTERN BYTE IF_DATA MCMESS 0x380A16 EXTERN /end MEASUREMENT
/begin MEASUREMENT B_m9cvnout "Bedingung; Checksumme (CVN) im Mode/Service $09 mind. 1-mal ausgegeben" UBYTE B_TRUE 1 100 0 1 BIT_MASK 0x2 FUNCTION_LIST TC9MOD SCATT IF_DATA DIM_X 0x380A17 EXTERN BYTE IF_DATA MCMESS 0x380A17 EXTERN /end MEASUREMENT
/begin MEASUREMENT B_madfk "Bedingung Momentenadaption Fahrstufe und Klimakompressor ein" UWORD B_TRUE 1 100 0 1 BIT_MASK 0x40 FUNCTION_LIST MDVERAD IF_DATA DIM_X 0xFD6A INTERN BYTE IF_DATA MCMESS 0xFD6A INTERN /end MEASUREMENT
/begin MEASUREMENT B_madfs "Bedingung Momentenadaption Fahrstufe ein" UWORD B_TRUE 1 100 0 1 BIT_MASK 0x80 FUNCTION_LIST MDVERAD IF_DATA DIM_X 0xFD6A INTERN BYTE IF_DATA MCMESS 0xFD6A INTERN /end MEASUREMENT
/begin MEASUREMENT B_madko "Bedingung Momentenadaption Klimakompressor ein" UWORD B_TRUE 1 100 0 1 BIT_MASK 0x100 FUNCTION_LIST MDVERAD IF_DATA DIM_X 0xFD6A INTERN BYTE IF_DATA MCMESS 0xFD6A INTERN /end MEASUREMENT
/begin MEASUREMENT B_madll "Bedingung Momentenadaption ohne Last" UWORD B_TRUE 1 100 0 1 BIT_MASK 0x200 FUNCTION_LIST MDVERAD IF_DATA DIM_X 0xFD6A INTERN BYTE IF_DATA MCMESS 0xFD6A INTERN /end MEASUREMENT
/begin MEASUREMENT B_maxflsh "Kurzsschluß nach UBatt bei Sonde hinter KAT erkannt" UBYTE B_TRUE 1 100 0 1 BIT_MASK 0x1 FUNCTION_LIST DLSH IF_DATA DIM_X 0x380A80 EXTERN BYTE IF_DATA MCMESS 0x380A80 EXTERN /end MEASUREMENT
/begin MEASUREMENT B_maxflsh2 "Kurzsschluß nach UBatt bei Sonde hinter KAT erkannt, Bank 2" UBYTE B_TRUE 1 100 0 1 BIT_MASK 0x2 FUNCTION_LIST DLSH IF_DATA DIM_X 0x380A80 EXTERN BYTE IF_DATA MCMESS 0x380A80 EXTERN /end MEASUREMENT
/begin MEASUREMENT B_maxflsu "Lambdaoffset vor / hinter Kat zu groß, Bank1" UWORD B_TRUE 1 100 0 1 BIT_MASK 0x1 FUNCTION_LIST DLSU IF_DATA DIM_X 0x381D14 EXTERN BYTE IF_DATA MCMESS 0x381D14 EXTERN /end MEASUREMENT
/begin MEASUREMENT B_maxflsu2 "Lambdaoffset vor / hinter Kat zu groß, Bank2" UWORD B_TRUE 1 100 0 1 BIT_MASK 0x10 FUNCTION_LIST DLSU IF_DATA DIM_X 0x381D14 EXTERN BYTE IF_DATA MCMESS 0x381D14 EXTERN /end MEASUREMENT
/begin MEASUREMENT B_maxlash "Maximalwert für Schwingungs-Prüfung hinter KAT erkannt" UWORD B_TRUE 1 100 0 1 BIT_MASK 0x10 FUNCTION_LIST DLSAHK IF_DATA DIM_X 0xFD26 INTERN BYTE IF_DATA MCMESS 0xFD26 INTERN /end MEASUREMENT
/begin MEASUREMENT B_maxlash2 "Maximalwert für Schwingungs-Prüfung hinter KAT erkannt Bank2" UWORD B_TRUE 1 100 0 1 BIT_MASK 0x20 FUNCTION_LIST DLSAHK IF_DATA DIM_X 0xFD26 INTERN BYTE IF_DATA MCMESS 0xFD26 INTERN /end MEASUREMENT
/begin MEASUREMENT B_mcacti "Bedingung McMESS aktiv" UWORD B_TRUE 1 100 0 1 BIT_MASK 0x400 FUNCTION_LIST VS_VERST IF_DATA DIM_X 0xFD06 INTERN BYTE IF_DATA MCMESS 0xFD06 INTERN /end MEASUREMENT
/begin MEASUREMENT B_mdarv "kritische Aussetzerrate vorhanden" UWORD B_TRUE 1 100 0 1 BIT_MASK 0x2000 FUNCTION_LIST DMDMIL ARMD BBLDR DKATLRS DLSAHK DLSU DMDSTP DSLSLRS DTEV ESUKAS LRAEB LRSHK T2DFA IF_DATA DIM_X 0xFD0E INTERN BYTE IF_DATA MCMESS 0xFD0E INTERN /end MEASUREMENT
/begin MEASUREMENT B_mddrla "Bedingung Misfire Detection Lastgradient für Aussetzererkennung" UWORD B_TRUE 1 100 0 1 BIT_MASK 0x20 FUNCTION_LIST DMDSTP IF_DATA DIM_X 0xFD96 INTERN WORD IF_DATA MCMESS 0xFD96 INTERN /end MEASUREMENT
/begin MEASUREMENT B_mde8e "Bedingung Mode $08 erlaubt" UWORD B_TRUE 1 100 0 1 BIT_MASK 0x8000 FUNCTION_LIST PROKON IF_DATA DIM_X 0xFD74 INTERN BYTE IF_DATA MCMESS 0xFD74 INTERN /end MEASUREMENT
/begin MEASUREMENT B_mde9e "Bedingung Mode $09 erlaubt" UWORD B_TRUE 1 100 0 1 BIT_MASK 0x1 FUNCTION_LIST PROKON SCATT IF_DATA DIM_X 0xFD76 INTERN BYTE IF_DATA MCMESS 0xFD76 INTERN /end MEASUREMENT
/begin MEASUREMENT B_mdee "Bedingung Momentenreduzierung über Einspritzausblendung erlaubt" UWORD B_TRUE 1 100 0 1 BIT_MASK 0x2000 FUNCTION_LIST MDRED1 IF_DATA DIM_X 0xFD6E INTERN BYTE IF_DATA MCMESS 0xFD6E INTERN /end MEASUREMENT
/begin MEASUREMENT B_mdein "Bedingung Momenteneingriff aktiv" UWORD B_TRUE 1 100 0 1 BIT_MASK 0x10 FUNCTION_LIST MDKOG DMDSTP LLRBB IF_DATA DIM_X 0xFD6E INTERN BYTE IF_DATA MCMESS 0xFD6E INTERN /end MEASUREMENT
/begin MEASUREMENT B_mderk "Aussetzer erkannt, Verknüpfung mehrerer Funktionen" UWORD B_TRUE 1 100 0 1 BIT_MASK 0x10 FUNCTION_LIST DMDLAD IF_DATA DIM_X 0xFD94 INTERN WORD IF_DATA MCMESS 0xFD94 INTERN /end MEASUREMENT
/begin MEASUREMENT B_mdkat "Katschädigende Aussetzerrate überschritten (zur Ausblendung anderer Funktionen)" UWORD B_TRUE 1 100 0 1 BIT_MASK 0x4000 FUNCTION_LIST DMDMIL DKATLRS LRSEB IF_DATA DIM_X 0xFD0E INTERN BYTE IF_DATA MCMESS 0xFD0E INTERN /end MEASUREMENT
/begin MEASUREMENT B_mdmin "Bedingung minimal erreichbares indiziertes Moment erreicht" UWORD B_TRUE 1 100 0 1 BIT_MASK 0x4000 FUNCTION_LIST MDFUE LLRRM IF_DATA DIM_X 0xFD4A INTERN BYTE IF_DATA MCMESS 0xFD4A INTERN /end MEASUREMENT
/begin MEASUREMENT B_mdng "Bedingung Misfire Detection Drehzahlgradient für Aussetzererkennung" UWORD B_TRUE 1 100 0 1 BIT_MASK 0x2 FUNCTION_LIST DMDSTP IF_DATA DIM_X 0xFD96 INTERN WORD IF_DATA MCMESS 0xFD96 INTERN /end MEASUREMENT
/begin MEASUREMENT B_mdnmot "Bedingung Misfire Detection obere und untere Drehzahlgrenze" UWORD B_TRUE 1 100 0 1 BIT_MASK 0x4 FUNCTION_LIST DMDSTP IF_DATA DIM_X 0xFD96 INTERN WORD IF_DATA MCMESS 0xFD96 INTERN /end MEASUREMENT
/begin MEASUREMENT B_mdnstab "Bedingung Drehzahlstabilisierung aktiv" UWORD B_TRUE 1 100 0 1 BIT_MASK 0x2 FUNCTION_LIST MDNSTAB IF_DATA DIM_X 0xFD6A INTERN BYTE IF_DATA MCMESS 0xFD6A INTERN /end MEASUREMENT
/begin MEASUREMENT B_mdredhyein "" UWORD B_TRUE 1 100 0 1 BIT_MASK 0x4000 FUNCTION_LIST MDRED1 IF_DATA DIM_X 0xFD6E INTERN BYTE IF_DATA MCMESS 0xFD6E INTERN /end MEASUREMENT
/begin MEASUREMENT B_mdrl "Bedingung Misfire Detection untere Lastgrenze" UWORD B_TRUE 1 100 0 1 BIT_MASK 0x8 FUNCTION_LIST DMDSTP IF_DATA DIM_X 0xFD96 INTERN WORD IF_DATA MCMESS 0xFD96 INTERN /end MEASUREMENT
/begin MEASUREMENT B_mdstim_m "Monitor, Zündungsaussetzer eingestellt, Stimuli-Signal vom Aussetzergenerator" UBYTE B_TRUE 1 100 0 1 BIT_MASK 0x2 FUNCTION_LIST DMDLU NLPH IF_DATA DIM_X 0xE456 INTERN WORD IF_DATA MCMESS 0xE456 INTERN /end MEASUREMENT
/begin MEASUREMENT B_mdstopt "Misfire Detection gesperrt vom 2. SG" UWORD B_TRUE 1 100 0 1 BIT_MASK 0x100 FUNCTION_LIST DMDSTP IF_DATA DIM_X 0xFD0C INTERN BYTE IF_DATA MCMESS 0xFD0C INTERN /end MEASUREMENT
/begin MEASUREMENT B_mdstop_m "Monitor, Misfire Detection gesperrt" UBYTE B_TRUE 1 100 0 1 BIT_MASK 0x80 FUNCTION_LIST DMDSTP NLPH IF_DATA DIM_X 0xE456 INTERN WORD IF_DATA MCMESS 0xE456 INTERN /end MEASUREMENT
/begin MEASUREMENT B_mdtnst "Bedingung Misfire Detection Zeit nach Startende" UWORD B_TRUE 1 100 0 1 BIT_MASK 0x10 FUNCTION_LIST DMDSTP IF_DATA DIM_X 0xFD96 INTERN WORD IF_DATA MCMESS 0xFD96 INTERN /end MEASUREMENT
/begin MEASUREMENT B_mdzyl1_m "Monitor, Zylinder-1-Kennung" UBYTE B_TRUE 1 100 0 1 BIT_MASK 0x10 FUNCTION_LIST DMDLU IF_DATA DIM_X 0xE456 INTERN WORD IF_DATA MCMESS 0xE456 INTERN /end MEASUREMENT
/begin MEASUREMENT B_meaoper "ml-/nmot-/rl-Bedingung: Freigabe Meßfenster in Block MEASURE" UBYTE B_TRUE 1 100 0 1 BIT_MASK 0x80 FUNCTION_LIST DSLSLRS IF_DATA DIM_X 0x380905 EXTERN BYTE IF_DATA MCMESS 0x380905 EXTERN /end MEASUREMENT
/begin MEASUREMENT B_mfact "Bedingung Medianfilter aktiv" UBYTE B_TRUE 1 100 0 1 BIT_MASK 0x8 FUNCTION_LIST FUEDK IF_DATA DIM_X 0x380AFD EXTERN BYTE IF_DATA MCMESS 0x380AFD EXTERN /end MEASUREMENT
/begin MEASUREMENT B_mibeg "Bedingung Momentenbegrenzung ist aktiv" UWORD B_TRUE 1 100 0 1 BIT_MASK 0x20 FUNCTION_LIST MDKOG DUF MDAUTG MDKOL IF_DATA DIM_X 0xFD6E INTERN BYTE IF_DATA MCMESS 0xFD6E INTERN /end MEASUREMENT
/begin MEASUREMENT B_mibegdau "Bedingung: Momentenüberwachung begrenzt dauerhaft" UWORD B_TRUE 1 100 0 1 BIT_MASK 0x40 FUNCTION_LIST MDKOG IF_DATA DIM_X 0xFD6E INTERN BYTE IF_DATA MCMESS 0xFD6E INTERN /end MEASUREMENT
/begin MEASUREMENT B_mibgv "Bedingung geschw.-abh. Momentenaufbaubegrenzung wirkt." UWORD B_TRUE 1 100 0 1 BIT_MASK 0x100 FUNCTION_LIST MDBGV IF_DATA DIM_X 0xFD6C INTERN BYTE IF_DATA MCMESS 0xFD6C INTERN /end MEASUREMENT
/begin MEASUREMENT B_mil "MIL-Ansteuerung" UBYTE B_TRUE 1 100 0 1 BIT_MASK 0x20 FUNCTION_LIST DMIL IF_DATA DIM_X 0x380A11 EXTERN BYTE IF_DATA MCMESS 0x380A11 EXTERN /end MEASUREMENT
/begin MEASUREMENT B_milblk "MIL-Ansteuerung blinkend" UBYTE B_TRUE 1 100 0 1 BIT_MASK 0x8 FUNCTION_LIST DMIL IF_DATA DIM_X 0x380A11 EXTERN BYTE IF_DATA MCMESS 0x380A11 EXTERN /end MEASUREMENT
/begin MEASUREMENT B_mileb "MIL-Ansteuerung eigenbestimmt" UBYTE B_TRUE 1 100 0 1 BIT_MASK 0x2 FUNCTION_LIST DMIL IF_DATA DIM_X 0x380A11 EXTERN BYTE IF_DATA MCMESS 0x380A11 EXTERN /end MEASUREMENT
/begin MEASUREMENT B_milfb "MIL-Ansteuerung fremdbestimmt durch externes SG" UWORD B_TRUE 1 100 0 1 BIT_MASK 0x200 FUNCTION_LIST SWADP DMIL IF_DATA DIM_X 0xFD84 INTERN BYTE IF_DATA MCMESS 0xFD84 INTERN /end MEASUREMENT
/begin MEASUREMENT B_milfb1 "" UBYTE B_TRUE 1 100 0 1 BIT_MASK 0x80 FUNCTION_LIST DMIL IF_DATA DIM_X 0x380A11 EXTERN BYTE IF_DATA MCMESS 0x380A11 EXTERN /end MEASUREMENT
/begin MEASUREMENT B_milmd "MIL-Ansteuerung an durch Aussetzererkennung, bei ti-Abschaltung" UWORD B_TRUE 1 100 0 1 BIT_MASK 0x8000 FUNCTION_LIST DMDMIL DMIL IF_DATA DIM_X 0xFD0E INTERN BYTE IF_DATA MCMESS 0xFD0E INTERN /end MEASUREMENT
/begin MEASUREMENT B_milok_c "MIL o.k. über CAN" UWORD B_TRUE 1 100 0 1 BIT_MASK 0x800 FUNCTION_LIST CAN DCMIL IF_DATA DIM_X 0xFD08 INTERN BYTE IF_DATA MCMESS 0xFD08 INTERN /end MEASUREMENT
/begin MEASUREMENT B_milst "MIL-Ansteuerung Prueffunktion bei Start" UBYTE B_TRUE 1 100 0 1 BIT_MASK 0x1 FUNCTION_LIST DMIL FGRLAMP IF_DATA DIM_X 0x380A11 EXTERN BYTE IF_DATA MCMESS 0x380A11 EXTERN /end MEASUREMENT
/begin MEASUREMENT B_milstat "MIL - Status für Scan Tool Mode $01 PID $01" UBYTE B_TRUE 1 100 0 1 BIT_MASK 0x40 FUNCTION_LIST DMIL TC1MOD IF_DATA DIM_X 0x380A11 EXTERN BYTE IF_DATA MCMESS 0x380A11 EXTERN /end MEASUREMENT
/begin MEASUREMENT B_milstp "Auswertung Aussetzererkennung (%DMDMIL) gesperrt" UWORD B_TRUE 1 100 0 1 BIT_MASK 0x200 FUNCTION_LIST DMDSTP DMDMIL DMDUE IF_DATA DIM_X 0xFD0C INTERN BYTE IF_DATA MCMESS 0xFD0C INTERN /end MEASUREMENT
/begin MEASUREMENT B_minflsh "Adernschluß oder KS nach Masse bei Sonde  hinter KAT erkannt" UBYTE B_TRUE 1 100 0 1 BIT_MASK 0x4 FUNCTION_LIST DLSH IF_DATA DIM_X 0x380A80 EXTERN BYTE IF_DATA MCMESS 0x380A80 EXTERN /end MEASUREMENT
/begin MEASUREMENT B_minflsh2 "Adernschluß oder KS nach Masse bei Sonde hinter KAT erkannt Bank2" UBYTE B_TRUE 1 100 0 1 BIT_MASK 0x8 FUNCTION_LIST DLSH IF_DATA DIM_X 0x380A80 EXTERN BYTE IF_DATA MCMESS 0x380A80 EXTERN /end MEASUREMENT
/begin MEASUREMENT B_minflsu "Dynamikfehler LSU, Bank1" UWORD B_TRUE 1 100 0 1 BIT_MASK 0x2 FUNCTION_LIST DLSU IF_DATA DIM_X 0x381D14 EXTERN BYTE IF_DATA MCMESS 0x381D14 EXTERN /end MEASUREMENT
/begin MEASUREMENT B_minflsu2 "Dynamikfehler LSU, Bank2" UWORD B_TRUE 1 100 0 1 BIT_MASK 0x20 FUNCTION_LIST DLSU IF_DATA DIM_X 0x381D14 EXTERN BYTE IF_DATA MCMESS 0x381D14 EXTERN /end MEASUREMENT
/begin MEASUREMENT B_minlash "Minimalwert für Schwingungsprüfung hinter KAT erkannt" UWORD B_TRUE 1 100 0 1 BIT_MASK 0x40 FUNCTION_LIST DLSAHK IF_DATA DIM_X 0xFD26 INTERN BYTE IF_DATA MCMESS 0xFD26 INTERN /end MEASUREMENT
/begin MEASUREMENT B_minlash2 "Minimalwert für Schwingungsprüfung hinter KAT erkannt Bank2" UWORD B_TRUE 1 100 0 1 BIT_MASK 0x80 FUNCTION_LIST DLSAHK IF_DATA DIM_X 0xFD26 INTERN BYTE IF_DATA MCMESS 0xFD26 INTERN /end MEASUREMENT
/begin MEASUREMENT B_mldyn "Bedingung erforderliche Luftmasse im Schubbetrieb für Dynamikmessung erreicht" UWORD B_TRUE 1 100 0 1 BIT_MASK 0x100 FUNCTION_LIST DLSAHK IF_DATA DIM_X 0xFD26 INTERN BYTE IF_DATA MCMESS 0xFD26 INTERN /end MEASUREMENT
/begin MEASUREMENT B_mlrsa "LRSEB: Ausschaltbed. für Lambdareg. auf bei und nach Schub über Luftmassenschw." UWORD B_TRUE 1 100 0 1 BIT_MASK 0x8 FUNCTION_LIST LRSEB TEBEB IF_DATA DIM_X 0xFD7E INTERN BYTE IF_DATA MCMESS 0xFD7E INTERN /end MEASUREMENT
/begin MEASUREMENT B_mluecke "Bedingung mittleres Lückensegment bei Motoren mit ungerader Zylinderanzahl" UWORD B_TRUE 1 100 0 1 BIT_MASK 0x800 FUNCTION_LIST GGDPG ALE IF_DATA DIM_X 0xFD12 INTERN BYTE IF_DATA MCMESS 0xFD12 INTERN /end MEASUREMENT
/begin MEASUREMENT B_mlustest "Bedingung ml is innerhalb den Schwellen" UBYTE B_TRUE 1 100 0 1 BIT_MASK 0x1 FUNCTION_LIST DLSAHK T2DFA IF_DATA DIM_X 0x380A7B EXTERN BYTE IF_DATA MCMESS 0x380A7B EXTERN /end MEASUREMENT
/begin MEASUREMENT B_mnaave "Fehlerart: Kurzschluß Masse Absperrventil Aktivkohlefilter (Endstufe)" UWORD B_TRUE 1 100 0 1 BIT_MASK 0x200 FUNCTION_LIST DFPM_DEKON IF_DATA DIM_X 0x383816 EXTERN BYTE IF_DATA MCMESS 0x383816 EXTERN /end MEASUREMENT
/begin MEASUREMENT B_mnagre "Fehlertype: Kurzschluß nach Masse Endstufe AGR-Ventil" UWORD B_TRUE 1 100 0 1 BIT_MASK 0x200 FUNCTION_LIST DFPM_DUMMY043 IF_DATA DIM_X 0x383818 EXTERN BYTE IF_DATA MCMESS 0x383818 EXTERN /end MEASUREMENT
/begin MEASUREMENT B_mnbm "Fehlertyp: häufige Korrektur bei einem Zahn zuwenig" UWORD B_TRUE 1 100 0 1 BIT_MASK 0x200 FUNCTION_LIST DFPM_DDG IF_DATA DIM_X 0x38381C EXTERN BYTE IF_DATA MCMESS 0x38381C EXTERN /end MEASUREMENT
/begin MEASUREMENT B_mnbrems "Fehlertyp BREMS (Bremssschalter): Minimalwert unterschritten" UWORD B_TRUE 1 100 0 1 BIT_MASK 0x200 FUNCTION_LIST DFPM_GGEGAS IF_DATA DIM_X 0x38381E EXTERN BYTE IF_DATA MCMESS 0x38381E EXTERN /end MEASUREMENT
/begin MEASUREMENT B_mnbwf "Fehlertyp min.: PWG Bewegung" UWORD B_TRUE 1 100 0 1 BIT_MASK 0x200 FUNCTION_LIST DFPM_GGPED IF_DATA DIM_X 0x383820 EXTERN BYTE IF_DATA MCMESS 0x383820 EXTERN /end MEASUREMENT
/begin MEASUREMENT B_mncas "Fehlertyp min.: CAN-Schnittstelle, Timeout ASC" UWORD B_TRUE 1 100 0 1 BIT_MASK 0x200 FUNCTION_LIST DFPM_DCAS IF_DATA DIM_X 0x383822 EXTERN BYTE IF_DATA MCMESS 0x383822 EXTERN /end MEASUREMENT
/begin MEASUREMENT B_mncge "Fehlertyp min.: CAN-Schnittstelle, Timeout EGS" UWORD B_TRUE 1 100 0 1 BIT_MASK 0x200 FUNCTION_LIST DFPM_DCGE IF_DATA DIM_X 0x383824 EXTERN BYTE IF_DATA MCMESS 0x383824 EXTERN /end MEASUREMENT
/begin MEASUREMENT B_mncgegs "Fehlertype: Min-Fehler EGS; Steuergerät" UWORD B_TRUE 1 100 0 1 BIT_MASK 0x200 FUNCTION_LIST DFPM_DCG IF_DATA DIM_X 0x383826 EXTERN BYTE IF_DATA MCMESS 0x383826 EXTERN /end MEASUREMENT
/begin MEASUREMENT B_mncgggp "Fehlertype: Min-Fehler EGS; Gang unplausibel" UWORD B_TRUE 1 100 0 1 BIT_MASK 0x200 FUNCTION_LIST DFPM_DCG IF_DATA DIM_X 0x383828 EXTERN BYTE IF_DATA MCMESS 0x383828 EXTERN /end MEASUREMENT
/begin MEASUREMENT B_mncgggv "Fehlertype: Min-Fehler EGS; Gangvergleich negativ" UWORD B_TRUE 1 100 0 1 BIT_MASK 0x200 FUNCTION_LIST DFPM_DCG IF_DATA DIM_X 0x38382A EXTERN BYTE IF_DATA MCMESS 0x38382A EXTERN /end MEASUREMENT
/begin MEASUREMENT B_mncgm1v "Fehlertype: Min-Fehler EGS; Magnetventil 1-2/4-5 Schaltung" UWORD B_TRUE 1 100 0 1 BIT_MASK 0x200 FUNCTION_LIST DFPM_DCG IF_DATA DIM_X 0x38382C EXTERN BYTE IF_DATA MCMESS 0x38382C EXTERN /end MEASUREMENT
/begin MEASUREMENT B_mncgm2v "Fehlertype: Min-Fehler EGS; Magnetventil 2-3 Schaltung" UWORD B_TRUE 1 100 0 1 BIT_MASK 0x200 FUNCTION_LIST DFPM_DCG IF_DATA DIM_X 0x38382E EXTERN BYTE IF_DATA MCMESS 0x38382E EXTERN /end MEASUREMENT
/begin MEASUREMENT B_mncgm3v "Fehlertype: Min-Fehler EGS; Magnetventil 3-4 Schaltung" UWORD B_TRUE 1 100 0 1 BIT_MASK 0x200 FUNCTION_LIST DFPM_DCG IF_DATA DIM_X 0x383830 EXTERN BYTE IF_DATA MCMESS 0x383830 EXTERN /end MEASUREMENT
/begin MEASUREMENT B_mncgmvk "Fehlertype: Min-Fehler EGS; Magnetventil Wandlerkupplung" UWORD B_TRUE 1 100 0 1 BIT_MASK 0x200 FUNCTION_LIST DFPM_DCG IF_DATA DIM_X 0x383832 EXTERN BYTE IF_DATA MCMESS 0x383832 EXTERN /end MEASUREMENT
/begin MEASUREMENT B_mncgrmm "Fehlertype: Min-Fehler EGS; Regelmagnetventil Modulierdruck" UWORD B_TRUE 1 100 0 1 BIT_MASK 0x200 FUNCTION_LIST DFPM_DCG IF_DATA DIM_X 0x383834 EXTERN BYTE IF_DATA MCMESS 0x383834 EXTERN /end MEASUREMENT
/begin MEASUREMENT B_mncgrms "Fehlertype: Min-Fehler EGS; Regelmagnetventil Schaltdruck" UWORD B_TRUE 1 100 0 1 BIT_MASK 0x200 FUNCTION_LIST DFPM_DCG IF_DATA DIM_X 0x383836 EXTERN BYTE IF_DATA MCMESS 0x383836 EXTERN /end MEASUREMENT
/begin MEASUREMENT B_mncgudg "Fehlertype: Min-Fehler EGS; Versorgungsspannung Drehzahlsensoren" UWORD B_TRUE 1 100 0 1 BIT_MASK 0x200 FUNCTION_LIST DFPM_DCG IF_DATA DIM_X 0x383838 EXTERN BYTE IF_DATA MCMESS 0x383838 EXTERN /end MEASUREMENT
/begin MEASUREMENT B_mncgumv "Fehlertype: Min-Fehler EGS; Versorgungsspannung Magnetventile" UWORD B_TRUE 1 100 0 1 BIT_MASK 0x200 FUNCTION_LIST DFPM_DCG IF_DATA DIM_X 0x38383A EXTERN BYTE IF_DATA MCMESS 0x38383A EXTERN /end MEASUREMENT
/begin MEASUREMENT B_mncgvgc "Fehlertype: Min-Fehler EGS; Verteilergetr.-Stellung unplaus." UWORD B_TRUE 1 100 0 1 BIT_MASK 0x200 FUNCTION_LIST DFPM_DCG IF_DATA DIM_X 0x38383C EXTERN BYTE IF_DATA MCMESS 0x38383C EXTERN /end MEASUREMENT
/begin MEASUREMENT B_mncgvrc "Fehlertype: Min-Fehler EGS; Raddrehzahl hinten unplausibel" UWORD B_TRUE 1 100 0 1 BIT_MASK 0x200 FUNCTION_LIST DFPM_DCG IF_DATA DIM_X 0x38383E EXTERN BYTE IF_DATA MCMESS 0x38383E EXTERN /end MEASUREMENT
/begin MEASUREMENT B_mncgwk "Fehlertype: Min-Fehler EGS; Wandlerkupplung" UWORD B_TRUE 1 100 0 1 BIT_MASK 0x200 FUNCTION_LIST DFPM_DCG IF_DATA DIM_X 0x383840 EXTERN BYTE IF_DATA MCMESS 0x383840 EXTERN /end MEASUREMENT
/begin MEASUREMENT B_mnckbi "Fehlertyp min.: CAN-Schnittstelle, Timeout Botschaft Kombi" UWORD B_TRUE 1 100 0 1 BIT_MASK 0x200 FUNCTION_LIST DFPM_DCKBI IF_DATA DIM_X 0x383842 EXTERN BYTE IF_DATA MCMESS 0x383842 EXTERN /end MEASUREMENT
/begin MEASUREMENT B_mncmil "Fehlerart:MIL über CAN min.-Fehler" UWORD B_TRUE 1 100 0 1 BIT_MASK 0x200 FUNCTION_LIST DFPM_DCMIL IF_DATA DIM_X 0x383844 EXTERN BYTE IF_DATA MCMESS 0x383844 EXTERN /end MEASUREMENT
/begin MEASUREMENT B_mncra "" UWORD B_TRUE 1 100 0 1 BIT_MASK 0x200 FUNCTION_LIST DFPM_GGAIRBAG IF_DATA DIM_X 0x383846 EXTERN BYTE IF_DATA MCMESS 0x383846 EXTERN /end MEASUREMENT
/begin MEASUREMENT B_mndk "Fehlertype: Kurzschluß nach Masse Drosselklappenpoti" UWORD B_TRUE 1 100 0 1 BIT_MASK 0x200 FUNCTION_LIST DFPM_DDVE IF_DATA DIM_X 0x383848 EXTERN BYTE IF_DATA MCMESS 0x383848 EXTERN /end MEASUREMENT
/begin MEASUREMENT B_mndk1p "Fehlertyp min.: Drosselklappe 1. Poti" UWORD B_TRUE 1 100 0 1 BIT_MASK 0x200 FUNCTION_LIST DFPM_DDVE IF_DATA DIM_X 0x38384A EXTERN BYTE IF_DATA MCMESS 0x38384A EXTERN /end MEASUREMENT
/begin MEASUREMENT B_mndk2p "Fehlertyp min.: Drosselklappe 2. Poti" UWORD B_TRUE 1 100 0 1 BIT_MASK 0x200 FUNCTION_LIST DFPM_DDVE IF_DATA DIM_X 0x38384C EXTERN BYTE IF_DATA MCMESS 0x38384C EXTERN /end MEASUREMENT
/begin MEASUREMENT B_mndsl "Bedingung min. Fehler Ladedrucksensor" UWORD B_TRUE 1 100 0 1 BIT_MASK 0x200 FUNCTION_LIST DFPM_GGDSAS IF_DATA DIM_X 0x383850 EXTERN BYTE IF_DATA MCMESS 0x383850 EXTERN /end MEASUREMENT
/begin MEASUREMENT B_mndsu "Bedingung: min-Fehler Umgebungsdrucksensor" UWORD B_TRUE 1 100 0 1 BIT_MASK 0x200 FUNCTION_LIST DFPM_GGDSAS IF_DATA DIM_X 0x383852 EXTERN BYTE IF_DATA MCMESS 0x383852 EXTERN /end MEASUREMENT
/begin MEASUREMENT B_mndsvlu "Bedingung: min. Fehler Drucksensorsignalvergleich (DS-L DS-U)" UWORD B_TRUE 1 100 0 1 BIT_MASK 0x200 FUNCTION_LIST DFPM_GGDSAS IF_DATA DIM_X 0x383854 EXTERN BYTE IF_DATA MCMESS 0x383854 EXTERN /end MEASUREMENT
/begin MEASUREMENT B_mndvee "Fehlerzyp min.: DV-E Endstufe" UWORD B_TRUE 1 100 0 1 BIT_MASK 0x200 FUNCTION_LIST DFPM_DDVE IF_DATA DIM_X 0x383856 EXTERN BYTE IF_DATA MCMESS 0x383856 EXTERN /end MEASUREMENT
/begin MEASUREMENT B_mndvef "Fehlertyp min.: DV-E Fehler bei Prüfung der öffnenden Feder" UWORD B_TRUE 1 100 0 1 BIT_MASK 0x200 FUNCTION_LIST DFPM_DDVE IF_DATA DIM_X 0x383858 EXTERN BYTE IF_DATA MCMESS 0x383858 EXTERN /end MEASUREMENT
/begin MEASUREMENT B_mndvefo "Fehlertyp min.: Fehler bei Federprüfung ""Öffnen""" UWORD B_TRUE 1 100 0 1 BIT_MASK 0x200 FUNCTION_LIST DFPM_DDVE IF_DATA DIM_X 0x38385A EXTERN BYTE IF_DATA MCMESS 0x38385A EXTERN /end MEASUREMENT
/begin MEASUREMENT B_mndvel "Fehlertyp min.: DV-E Lageabweichung" UWORD B_TRUE 1 100 0 1 BIT_MASK 0x200 FUNCTION_LIST DFPM_DDVE IF_DATA DIM_X 0x38385C EXTERN BYTE IF_DATA MCMESS 0x38385C EXTERN /end MEASUREMENT
/begin MEASUREMENT B_mndven "Fehlertyp min.: DV-E Fehler bei Prüfung Notluftposition" UWORD B_TRUE 1 100 0 1 BIT_MASK 0x200 FUNCTION_LIST DFPM_DDVE IF_DATA DIM_X 0x38385E EXTERN BYTE IF_DATA MCMESS 0x38385E EXTERN /end MEASUREMENT
/begin MEASUREMENT B_mndver "Fehlerzyp min.: DV-E Regelbereich, kurzfristig überschritten" UWORD B_TRUE 1 100 0 1 BIT_MASK 0x200 FUNCTION_LIST DFPM_DDVE IF_DATA DIM_X 0x383860 EXTERN BYTE IF_DATA MCMESS 0x383860 EXTERN /end MEASUREMENT
/begin MEASUREMENT B_mndvet "" UWORD B_TRUE 1 100 0 1 BIT_MASK 0x200 FUNCTION_LIST DFPM_DDVE IF_DATA DIM_X 0x383862 EXTERN BYTE IF_DATA MCMESS 0x383862 EXTERN /end MEASUREMENT
/begin MEASUREMENT B_mndveu "Fehlertyp min.: DV-E Fehler beim UMA-Lernen" UWORD B_TRUE 1 100 0 1 BIT_MASK 0x200 FUNCTION_LIST DFPM_DDVE IF_DATA DIM_X 0x383864 EXTERN BYTE IF_DATA MCMESS 0x383864 EXTERN /end MEASUREMENT
/begin MEASUREMENT B_mndveub "Fehlertyp min.: DV-E-Adaption Abbruch wg. Umweltbed/Unterspng" UWORD B_TRUE 1 100 0 1 BIT_MASK 0x200 FUNCTION_LIST DFPM_DDVE IF_DATA DIM_X 0x383866 EXTERN BYTE IF_DATA MCMESS 0x383866 EXTERN /end MEASUREMENT
/begin MEASUREMENT B_mndveuw "" UWORD B_TRUE 1 100 0 1 BIT_MASK 0x200 FUNCTION_LIST DFPM_DDVE IF_DATA DIM_X 0x383868 EXTERN BYTE IF_DATA MCMESS 0x383868 EXTERN /end MEASUREMENT
/begin MEASUREMENT B_mndvev "Fehlertyp min.: DV-E Fehler bei Verstärkerabgleich" UWORD B_TRUE 1 100 0 1 BIT_MASK 0x200 FUNCTION_LIST DFPM_DDVE IF_DATA DIM_X 0x38386A EXTERN BYTE IF_DATA MCMESS 0x38386A EXTERN /end MEASUREMENT
/begin MEASUREMENT B_mnegfe "Bedingung: MIN-Fehler Eingangsgrößen Füllungserfassung" UWORD B_TRUE 1 100 0 1 BIT_MASK 0x200 FUNCTION_LIST DFPM_EGFE IF_DATA DIM_X 0x38386C EXTERN BYTE IF_DATA MCMESS 0x38386C EXTERN /end MEASUREMENT
/begin MEASUREMENT B_mnev1 "Fehlerart: Kurzschluß Masse an Endstufe EV1" UWORD B_TRUE 1 100 0 1 BIT_MASK 0x200 FUNCTION_LIST DFPM_DEKON IF_DATA DIM_X 0x38386E EXTERN BYTE IF_DATA MCMESS 0x38386E EXTERN /end MEASUREMENT
/begin MEASUREMENT B_mnev2 "Fehlerart: Kurzschluß Masse an Endstufe EV2" UWORD B_TRUE 1 100 0 1 BIT_MASK 0x200 FUNCTION_LIST DFPM_DEKON IF_DATA DIM_X 0x383870 EXTERN BYTE IF_DATA MCMESS 0x383870 EXTERN /end MEASUREMENT
/begin MEASUREMENT B_mnev3 "Fehlerart: Kurzschluß Masse an Endstufe EV3" UWORD B_TRUE 1 100 0 1 BIT_MASK 0x200 FUNCTION_LIST DFPM_DEKON IF_DATA DIM_X 0x383872 EXTERN BYTE IF_DATA MCMESS 0x383872 EXTERN /end MEASUREMENT
/begin MEASUREMENT B_mnev4 "Fehlerart: Kurzschluß Masse an Endstufe EV4" UWORD B_TRUE 1 100 0 1 BIT_MASK 0x200 FUNCTION_LIST DFPM_DEKON IF_DATA DIM_X 0x383874 EXTERN BYTE IF_DATA MCMESS 0x383874 EXTERN /end MEASUREMENT
/begin MEASUREMENT B_mnev5 "Fehlerart: Kurzschluß Masse an Endstufe EV5" UWORD B_TRUE 1 100 0 1 BIT_MASK 0x200 FUNCTION_LIST DFPM_DEKON IF_DATA DIM_X 0x383876 EXTERN BYTE IF_DATA MCMESS 0x383876 EXTERN /end MEASUREMENT
/begin MEASUREMENT B_mnev6 "Fehlerart: Kurzschluß Masse an Endstufe EV6" UWORD B_TRUE 1 100 0 1 BIT_MASK 0x200 FUNCTION_LIST DFPM_DEKON IF_DATA DIM_X 0x383878 EXTERN BYTE IF_DATA MCMESS 0x383878 EXTERN /end MEASUREMENT
/begin MEASUREMENT B_mnfgrl "Fehlertyp min.: FGR-Lampe über CAN" UWORD B_TRUE 1 100 0 1 BIT_MASK 0x200 FUNCTION_LIST DFPM_DCFGRL IF_DATA DIM_X 0x38387A EXTERN BYTE IF_DATA MCMESS 0x38387A EXTERN /end MEASUREMENT
/begin MEASUREMENT B_mnfp1p "Fehlertyp min.: Fahrpedal 1. Poti" UWORD B_TRUE 1 100 0 1 BIT_MASK 0x200 FUNCTION_LIST DFPM_GGPED IF_DATA DIM_X 0x38387C EXTERN BYTE IF_DATA MCMESS 0x38387C EXTERN /end MEASUREMENT
/begin MEASUREMENT B_mnfp2p "Fehlertyp min.: Fahrpedal 2. Poti" UWORD B_TRUE 1 100 0 1 BIT_MASK 0x200 FUNCTION_LIST DFPM_GGPED IF_DATA DIM_X 0x38387E EXTERN BYTE IF_DATA MCMESS 0x38387E EXTERN /end MEASUREMENT
/begin MEASUREMENT B_mnfpp "Fehlertyp min.: Fahrpedal Potentiometer" UWORD B_TRUE 1 100 0 1 BIT_MASK 0x200 FUNCTION_LIST DFPM_GGPED IF_DATA DIM_X 0x383880 EXTERN BYTE IF_DATA MCMESS 0x383880 EXTERN /end MEASUREMENT
/begin MEASUREMENT B_mnfrao "Bedingung untere Plausibilitätsschwelle unterschritten (obere Multipl.)" UWORD B_TRUE 1 100 0 1 BIT_MASK 0x200 FUNCTION_LIST DFPM_DKVS IF_DATA DIM_X 0x383882 EXTERN BYTE IF_DATA MCMESS 0x383882 EXTERN /end MEASUREMENT
/begin MEASUREMENT B_mnfrao2 "Bedingung untere Plausibilitätsschwelle unterschritten (Stereo)" UWORD B_TRUE 1 100 0 1 BIT_MASK 0x200 FUNCTION_LIST DFPM_DKVS IF_DATA DIM_X 0x383884 EXTERN BYTE IF_DATA MCMESS 0x383884 EXTERN /end MEASUREMENT
/begin MEASUREMENT B_mnfrau "Bedingung untere Plausibilitätsschwelle unterschritten (untere Multipl.)" UWORD B_TRUE 1 100 0 1 BIT_MASK 0x200 FUNCTION_LIST DFPM_DKVS IF_DATA DIM_X 0x383886 EXTERN BYTE IF_DATA MCMESS 0x383886 EXTERN /end MEASUREMENT
/begin MEASUREMENT B_mnfrau2 "Bedingung untere Plausibilitätsschwelle unterschritten (Stereo)" UWORD B_TRUE 1 100 0 1 BIT_MASK 0x200 FUNCTION_LIST DFPM_DKVS IF_DATA DIM_X 0x383888 EXTERN BYTE IF_DATA MCMESS 0x383888 EXTERN /end MEASUREMENT
/begin MEASUREMENT B_mnfrst "Bedingung untere Plausibilitätsschwelle unterschritten(short test)" UWORD B_TRUE 1 100 0 1 BIT_MASK 0x200 FUNCTION_LIST DFPM_DKVS IF_DATA DIM_X 0x38388A EXTERN BYTE IF_DATA MCMESS 0x38388A EXTERN /end MEASUREMENT
/begin MEASUREMENT B_mnfrst2 "Bedingung untere Plausibilitätsschwelle unterschritten(short test Stereo" UWORD B_TRUE 1 100 0 1 BIT_MASK 0x200 FUNCTION_LIST DFPM_DKVS IF_DATA DIM_X 0x38388C EXTERN BYTE IF_DATA MCMESS 0x38388C EXTERN /end MEASUREMENT
/begin MEASUREMENT B_mnhfm "Bedingung untere Plausibilitätsschwelle unterschritten" UWORD B_TRUE 1 100 0 1 BIT_MASK 0x40 FUNCTION_LIST DHFM IF_DATA DIM_X 0xFD48 INTERN BYTE IF_DATA MCMESS 0xFD48 INTERN /end MEASUREMENT
/begin MEASUREMENT B_mnhlsu "Kurzschluß Heizung LSU1 nach Masse" UWORD B_TRUE 1 100 0 1 BIT_MASK 0x2000 FUNCTION_LIST DHLSU IF_DATA DIM_X 0xFD1C INTERN BYTE IF_DATA MCMESS 0xFD1C INTERN /end MEASUREMENT
/begin MEASUREMENT B_mnhlsu2 "Kurzschluß Heizung LSU2 nach Masse" UWORD B_TRUE 1 100 0 1 BIT_MASK 0x4000 FUNCTION_LIST DHLSU IF_DATA DIM_X 0xFD1C INTERN BYTE IF_DATA MCMESS 0xFD1C INTERN /end MEASUREMENT
/begin MEASUREMENT B_mnhsh "Kurzschluß Heizung Lambdasonde hinter Kat nach Masse" UWORD B_TRUE 1 100 0 1 BIT_MASK 0x200 FUNCTION_LIST DFPM_DHLSHK IF_DATA DIM_X 0x38388E EXTERN BYTE IF_DATA MCMESS 0x38388E EXTERN /end MEASUREMENT
/begin MEASUREMENT B_mnhsh2 "Kurzschluß Heizung Lambdasonde2 hinter Kat nach Masse" UWORD B_TRUE 1 100 0 1 BIT_MASK 0x200 FUNCTION_LIST DFPM_DHLSHK IF_DATA DIM_X 0x383890 EXTERN BYTE IF_DATA MCMESS 0x383890 EXTERN /end MEASUREMENT
/begin MEASUREMENT B_mnhshe "Kurzschluß Heizung Lambdasonde hinter Kat nach Masse (Endstufe)" UWORD B_TRUE 1 100 0 1 BIT_MASK 0x200 FUNCTION_LIST DFPM_DEKON IF_DATA DIM_X 0x383892 EXTERN BYTE IF_DATA MCMESS 0x383892 EXTERN /end MEASUREMENT
/begin MEASUREMENT B_mnhshe2 "Kurzschluß Heizung Lambdasonde2 hinter Kat nach Masse (Endstufe)" UWORD B_TRUE 1 100 0 1 BIT_MASK 0x200 FUNCTION_LIST DFPM_DEKON IF_DATA DIM_X 0x383894 EXTERN BYTE IF_DATA MCMESS 0x383894 EXTERN /end MEASUREMENT
/begin MEASUREMENT B_mnhsv "Kurzschluß Heizung Lambdasonde vor Kat nach Masse" UWORD B_TRUE 1 100 0 1 BIT_MASK 0x200 FUNCTION_LIST DFPM_DHLSU IF_DATA DIM_X 0x383896 EXTERN BYTE IF_DATA MCMESS 0x383896 EXTERN /end MEASUREMENT
/begin MEASUREMENT B_mnhsv2 "Kurzschluß Heizung Lambdasonde2 vor Kat nach Masse" UWORD B_TRUE 1 100 0 1 BIT_MASK 0x200 FUNCTION_LIST DFPM_DHLSU IF_DATA DIM_X 0x383898 EXTERN BYTE IF_DATA MCMESS 0x383898 EXTERN /end MEASUREMENT
/begin MEASUREMENT B_mnhsvsa "Min-Fehler erkannt" UWORD B_TRUE 1 100 0 1 BIT_MASK 0x200 FUNCTION_LIST DFPM_DHLSU IF_DATA DIM_X 0x38389A EXTERN BYTE IF_DATA MCMESS 0x38389A EXTERN /end MEASUREMENT
/begin MEASUREMENT B_mnhsvsa2 "Min-Fehler erkannt Bank 2" UWORD B_TRUE 1 100 0 1 BIT_MASK 0x200 FUNCTION_LIST DFPM_DHLSU IF_DATA DIM_X 0x38389C EXTERN BYTE IF_DATA MCMESS 0x38389C EXTERN /end MEASUREMENT
/begin MEASUREMENT B_mnkat "Fehlertyp 'Minimalwert' erkannt (Katalysator defekt)" UWORD B_TRUE 1 100 0 1 BIT_MASK 0x200 FUNCTION_LIST DFPM_DKAT IF_DATA DIM_X 0x38389E EXTERN BYTE IF_DATA MCMESS 0x38389E EXTERN /end MEASUREMENT
/begin MEASUREMENT B_mnkat2 "Fehlertyp min.: Katalysator Bank2" UWORD B_TRUE 1 100 0 1 BIT_MASK 0x200 FUNCTION_LIST DFPM_DKAT IF_DATA DIM_X 0x3838A0 EXTERN BYTE IF_DATA MCMESS 0x3838A0 EXTERN /end MEASUREMENT
/begin MEASUREMENT B_mnkos "Fehlertype: Kurzschluß nach Masse Endstufe Klimakompressor" UWORD B_TRUE 1 100 0 1 BIT_MASK 0x200 FUNCTION_LIST DFPM_DEKON IF_DATA DIM_X 0x3838A2 EXTERN BYTE IF_DATA MCMESS 0x3838A2 EXTERN /end MEASUREMENT
/begin MEASUREMENT B_mnkpe "Bedingung für Fehlertyp Kurzschluß nach Masse für EKP-Relais Endstufe erkannt" UWORD B_TRUE 1 100 0 1 BIT_MASK 0x200 FUNCTION_LIST DFPM_DEKON IF_DATA DIM_X 0x3838A4 EXTERN BYTE IF_DATA MCMESS 0x3838A4 EXTERN /end MEASUREMENT
/begin MEASUREMENT B_mnkrnt "Fehlertyp min.: Klopfregelung Nulltest" UWORD B_TRUE 1 100 0 1 BIT_MASK 0x200 FUNCTION_LIST DFPM_DKRNT IF_DATA DIM_X 0x3838A6 EXTERN BYTE IF_DATA MCMESS 0x3838A6 EXTERN /end MEASUREMENT
/begin MEASUREMENT B_mnkrof "Fehlertyp min.: Klopfregelung Offset" UWORD B_TRUE 1 100 0 1 BIT_MASK 0x200 FUNCTION_LIST DFPM_DKRNT IF_DATA DIM_X 0x3838A8 EXTERN BYTE IF_DATA MCMESS 0x3838A8 EXTERN /end MEASUREMENT
/begin MEASUREMENT B_mnkrtp "Fehlertyp min.: Klopfregelung Testimpuls" UWORD B_TRUE 1 100 0 1 BIT_MASK 0x200 FUNCTION_LIST DFPM_DKRTP IF_DATA DIM_X 0x3838AA EXTERN BYTE IF_DATA MCMESS 0x3838AA EXTERN /end MEASUREMENT
/begin MEASUREMENT B_mnks1 "Bedingung: Min-Fehler Klopfsensor 1" UWORD B_TRUE 1 100 0 1 BIT_MASK 0x200 FUNCTION_LIST DFPM_DKRS IF_DATA DIM_X 0x3838AC EXTERN BYTE IF_DATA MCMESS 0x3838AC EXTERN /end MEASUREMENT
/begin MEASUREMENT B_mnks2 "Bedingung: Min-Fehler Klopfsensor 2" UWORD B_TRUE 1 100 0 1 BIT_MASK 0x200 FUNCTION_LIST DFPM_DKRS IF_DATA DIM_X 0x3838AE EXTERN BYTE IF_DATA MCMESS 0x3838AE EXTERN /end MEASUREMENT
/begin MEASUREMENT B_mnks3 "Bedingung: Min-Fehler Klopfsensor 3" UWORD B_TRUE 1 100 0 1 BIT_MASK 0x200 FUNCTION_LIST DFPM_DKRS IF_DATA DIM_X 0x3838B0 EXTERN BYTE IF_DATA MCMESS 0x3838B0 EXTERN /end MEASUREMENT
/begin MEASUREMENT B_mnks4 "Bedingung: Min-fehler Klopfsensor 4" UWORD B_TRUE 1 100 0 1 BIT_MASK 0x200 FUNCTION_LIST DFPM_DKRS IF_DATA DIM_X 0x3838B2 EXTERN BYTE IF_DATA MCMESS 0x3838B2 EXTERN /end MEASUREMENT
/begin MEASUREMENT B_mnkuppl "Fehlertyp KUPPL: Minimalwert unterschritten" UWORD B_TRUE 1 100 0 1 BIT_MASK 0x200 FUNCTION_LIST DFPM_DKUPPL IF_DATA DIM_X 0x3838B4 EXTERN BYTE IF_DATA MCMESS 0x3838B4 EXTERN /end MEASUREMENT
/begin MEASUREMENT B_mnkwave "Fehlertype: Kurzschluß nach Masse Kühlwasserabsperrventil Endstufe" UWORD B_TRUE 1 100 0 1 BIT_MASK 0x200 FUNCTION_LIST DFPM_DEKON IF_DATA DIM_X 0x3838B6 EXTERN BYTE IF_DATA MCMESS 0x3838B6 EXTERN /end MEASUREMENT
/begin MEASUREMENT B_mnlash "Fehlertyp 'Minimalwert' für Schwingungsprüfung hinter KAT erkannt" UWORD B_TRUE 1 100 0 1 BIT_MASK 0x200 FUNCTION_LIST DFPM_DLSAHK IF_DATA DIM_X 0x3838B8 EXTERN BYTE IF_DATA MCMESS 0x3838B8 EXTERN /end MEASUREMENT
/begin MEASUREMENT B_mnlash2 "Fehlertyp 'Minimalwert' für Schwingungsprüfung hinter KAT erkannt Bank2" UWORD B_TRUE 1 100 0 1 BIT_MASK 0x200 FUNCTION_LIST DFPM_DLSAHK IF_DATA DIM_X 0x3838BA EXTERN BYTE IF_DATA MCMESS 0x3838BA EXTERN /end MEASUREMENT
/begin MEASUREMENT B_mnlde "Fehlertyp: Kurzschluß Masse LDR-Taktventil" UWORD B_TRUE 1 100 0 1 BIT_MASK 0x200 FUNCTION_LIST DFPM_DEKON IF_DATA DIM_X 0x3838BC EXTERN BYTE IF_DATA MCMESS 0x3838BC EXTERN /end MEASUREMENT
/begin MEASUREMENT B_mnldo "Bedingung MIN-Fehler Fehlerpfad ldo" UWORD B_TRUE 1 100 0 1 BIT_MASK 0x200 FUNCTION_LIST DFPM_DLDR IF_DATA DIM_X 0x3838BE EXTERN BYTE IF_DATA MCMESS 0x3838BE EXTERN /end MEASUREMENT
/begin MEASUREMENT B_mnldra "Bedingung MIN-Fehler Fehlerpfad ldra" UWORD B_TRUE 1 100 0 1 BIT_MASK 0x200 FUNCTION_LIST DFPM_DLDR IF_DATA DIM_X 0x3838C0 EXTERN BYTE IF_DATA MCMESS 0x3838C0 EXTERN /end MEASUREMENT
/begin MEASUREMENT B_mnlf1e "Fehlertype: Kurzschluß nach Masse Endstufe Lüfter1" UWORD B_TRUE 1 100 0 1 BIT_MASK 0x200 FUNCTION_LIST DFPM_DEKON IF_DATA DIM_X 0x3838C2 EXTERN BYTE IF_DATA MCMESS 0x3838C2 EXTERN /end MEASUREMENT
/begin MEASUREMENT B_mnlf2e "Fehlertype: Kurzschluß nach Masse Endstufe Lüfter2" UWORD B_TRUE 1 100 0 1 BIT_MASK 0x200 FUNCTION_LIST DFPM_DEKON IF_DATA DIM_X 0x3838C4 EXTERN BYTE IF_DATA MCMESS 0x3838C4 EXTERN /end MEASUREMENT
/begin MEASUREMENT B_mnlf3e "Fehlertype: Kurzschluß nach Masse Endstufe Lüfter3" UWORD B_TRUE 1 100 0 1 BIT_MASK 0x200 FUNCTION_LIST DFPM_DEKON IF_DATA DIM_X 0x3838C6 EXTERN BYTE IF_DATA MCMESS 0x3838C6 EXTERN /end MEASUREMENT
/begin MEASUREMENT B_mnllr "Fehler 'Leerlaufdrehzahl zu klein'" UWORD B_TRUE 1 100 0 1 BIT_MASK 0x200 FUNCTION_LIST DFPM_DLLR IF_DATA DIM_X 0x3838C8 EXTERN BYTE IF_DATA MCMESS 0x3838C8 EXTERN /end MEASUREMENT
/begin MEASUREMENT B_mnlm "Bedingung: min-Fehler Hauptfüllungssensor" UWORD B_TRUE 1 100 0 1 BIT_MASK 0x200 FUNCTION_LIST DFPM_DHFM IF_DATA DIM_X 0x3838CA EXTERN BYTE IF_DATA MCMESS 0x3838CA EXTERN /end MEASUREMENT
/begin MEASUREMENT B_mnlsh "Fehlertyp 'Minimalwert' hinter KAT erkannt" UWORD B_TRUE 1 100 0 1 BIT_MASK 0x200 FUNCTION_LIST DFPM_DLSH IF_DATA DIM_X 0x3838CC EXTERN BYTE IF_DATA MCMESS 0x3838CC EXTERN /end MEASUREMENT
/begin MEASUREMENT B_mnlsh2 "Fehlertyp 'Minimalwert' hinter KAT erkannt  Bank2" UWORD B_TRUE 1 100 0 1 BIT_MASK 0x200 FUNCTION_LIST DFPM_DLSH IF_DATA DIM_X 0x3838CE EXTERN BYTE IF_DATA MCMESS 0x3838CE EXTERN /end MEASUREMENT
/begin MEASUREMENT B_mnlsv "Fehlertyp 'Minimalwert' vor KAT erkannt" UWORD B_TRUE 1 100 0 1 BIT_MASK 0x200 FUNCTION_LIST DFPM_DLSU IF_DATA DIM_X 0x3838D0 EXTERN BYTE IF_DATA MCMESS 0x3838D0 EXTERN /end MEASUREMENT
/begin MEASUREMENT B_mnlsv2 "Fehlertyp 'Minimalwert' vor KAT erkannt  Bank2" UWORD B_TRUE 1 100 0 1 BIT_MASK 0x200 FUNCTION_LIST DFPM_DLSU IF_DATA DIM_X 0x3838D2 EXTERN BYTE IF_DATA MCMESS 0x3838D2 EXTERN /end MEASUREMENT
/begin MEASUREMENT B_mnlsvv "MIN-Fehler: Vertauschte Lambda-Sonden" UWORD B_TRUE 1 100 0 1 BIT_MASK 0x200 FUNCTION_LIST DFPM_LSVV IF_DATA DIM_X 0x3838D4 EXTERN BYTE IF_DATA MCMESS 0x3838D4 EXTERN /end MEASUREMENT
/begin MEASUREMENT B_mnmd "Fehlertyp min.: Aussetzer, Summenfehler (multiple)" UWORD B_TRUE 1 100 0 1 BIT_MASK 0x200 FUNCTION_LIST DFPM_DMDMIL IF_DATA DIM_X 0x3838D6 EXTERN BYTE IF_DATA MCMESS 0x3838D6 EXTERN /end MEASUREMENT
/begin MEASUREMENT B_mnmd00 "Fehlertyp min.: Aussetzer Zündung 0" UWORD B_TRUE 1 100 0 1 BIT_MASK 0x200 FUNCTION_LIST DFPM_DMDMIL IF_DATA DIM_X 0x3838D8 EXTERN BYTE IF_DATA MCMESS 0x3838D8 EXTERN /end MEASUREMENT
/begin MEASUREMENT B_mnmd01 "Fehlertyp min.: Aussetzer Zündung 1" UWORD B_TRUE 1 100 0 1 BIT_MASK 0x200 FUNCTION_LIST DFPM_DMDMIL IF_DATA DIM_X 0x3838DA EXTERN BYTE IF_DATA MCMESS 0x3838DA EXTERN /end MEASUREMENT
/begin MEASUREMENT B_mnmd02 "Fehlertyp min.: Aussetzer Zündung 2" UWORD B_TRUE 1 100 0 1 BIT_MASK 0x200 FUNCTION_LIST DFPM_DMDMIL IF_DATA DIM_X 0x3838DC EXTERN BYTE IF_DATA MCMESS 0x3838DC EXTERN /end MEASUREMENT
/begin MEASUREMENT B_mnmd03 "Fehlertyp min.: Aussetzer Zündung 3" UWORD B_TRUE 1 100 0 1 BIT_MASK 0x200 FUNCTION_LIST DFPM_DMDMIL IF_DATA DIM_X 0x3838DE EXTERN BYTE IF_DATA MCMESS 0x3838DE EXTERN /end MEASUREMENT
/begin MEASUREMENT B_mnmd04 "Fehlertyp min.: Aussetzer Zündung 4" UWORD B_TRUE 1 100 0 1 BIT_MASK 0x200 FUNCTION_LIST DFPM_DMDMIL IF_DATA DIM_X 0x3838E0 EXTERN BYTE IF_DATA MCMESS 0x3838E0 EXTERN /end MEASUREMENT
/begin MEASUREMENT B_mnmd05 "Fehlertyp min.: Aussetzer Zündung 5" UWORD B_TRUE 1 100 0 1 BIT_MASK 0x200 FUNCTION_LIST DFPM_DMDMIL IF_DATA DIM_X 0x3838E2 EXTERN BYTE IF_DATA MCMESS 0x3838E2 EXTERN /end MEASUREMENT
/begin MEASUREMENT B_mnmdb "Fehlertyp min.: Momentanüberwachung begrenzt dauerhaft" UWORD B_TRUE 1 100 0 1 BIT_MASK 0x200 FUNCTION_LIST DFPM_MDKOG IF_DATA DIM_X 0x3838E4 EXTERN BYTE IF_DATA MCMESS 0x3838E4 EXTERN /end MEASUREMENT
/begin MEASUREMENT B_mnmsg "Fehlertype: Wert unterschritten Motorraumspülgebläse" UWORD B_TRUE 1 100 0 1 BIT_MASK 0x200 FUNCTION_LIST DFPM_MLS IF_DATA DIM_X 0x3838E6 EXTERN BYTE IF_DATA MCMESS 0x3838E6 EXTERN /end MEASUREMENT
/begin MEASUREMENT B_mnmsge "Fehlertype: Kurzschluß nach Masse Endstufe Motorraumspülgebläse" UWORD B_TRUE 1 100 0 1 BIT_MASK 0x200 FUNCTION_LIST DFPM_DEKON IF_DATA DIM_X 0x3838E8 EXTERN BYTE IF_DATA MCMESS 0x3838E8 EXTERN /end MEASUREMENT
/begin MEASUREMENT B_mnn "Fehlerart: Synchronisationsmarke häufig nicht gefunden" UWORD B_TRUE 1 100 0 1 BIT_MASK 0x200 FUNCTION_LIST DFPM_DDG IF_DATA DIM_X 0x3838EA EXTERN BYTE IF_DATA MCMESS 0x3838EA EXTERN /end MEASUREMENT
/begin MEASUREMENT B_mnnwkw "Fehlerart: Nockenwelle spätverstellt" UWORD B_TRUE 1 100 0 1 BIT_MASK 0x200 FUNCTION_LIST DFPM_DNWKW IF_DATA DIM_X 0x3838EC EXTERN BYTE IF_DATA MCMESS 0x3838EC EXTERN /end MEASUREMENT
/begin MEASUREMENT B_mnnwkw2 "Fehlerart: Nockenwelle 2 spätverstellt" UWORD B_TRUE 1 100 0 1 BIT_MASK 0x200 FUNCTION_LIST DFPM_DNWKW IF_DATA DIM_X 0x3838EE EXTERN BYTE IF_DATA MCMESS 0x3838EE EXTERN /end MEASUREMENT
/begin MEASUREMENT B_mnnws "Fehlerart: Nockenwellenverstellung Frühposition nicht erreicht" UWORD B_TRUE 1 100 0 1 BIT_MASK 0x200 FUNCTION_LIST DFPM_DNWS IF_DATA DIM_X 0x3838F0 EXTERN BYTE IF_DATA MCMESS 0x3838F0 EXTERN /end MEASUREMENT
/begin MEASUREMENT B_mnnws2 "Fehlerart: Nockenwellenverstellung 2 Frühposition nicht erreicht" UWORD B_TRUE 1 100 0 1 BIT_MASK 0x200 FUNCTION_LIST DFPM_DNWS IF_DATA DIM_X 0x3838F2 EXTERN BYTE IF_DATA MCMESS 0x3838F2 EXTERN /end MEASUREMENT
/begin MEASUREMENT B_mnnwse "Fehlerart: Kurzschluß Masse Nockenwellensteuerungsventil Endstufe" UWORD B_TRUE 1 100 0 1 BIT_MASK 0x200 FUNCTION_LIST DFPM_DEKON IF_DATA DIM_X 0x3838F4 EXTERN BYTE IF_DATA MCMESS 0x3838F4 EXTERN /end MEASUREMENT
/begin MEASUREMENT B_mnnwse2 "Fehlertype: Kurzschluss nach Masse Nockenwellensteuerung Bank2 Endstufe" UWORD B_TRUE 1 100 0 1 BIT_MASK 0x200 FUNCTION_LIST DFPM_DEKON IF_DATA DIM_X 0x3838F6 EXTERN BYTE IF_DATA MCMESS 0x3838F6 EXTERN /end MEASUREMENT
/begin MEASUREMENT B_mnph "Fehlerart: Kurzschluß Masse Phasengeber" UWORD B_TRUE 1 100 0 1 BIT_MASK 0x200 FUNCTION_LIST DFPM_DPH IF_DATA DIM_X 0x3838F8 EXTERN BYTE IF_DATA MCMESS 0x3838F8 EXTERN /end MEASUREMENT
/begin COMPU_METHOD B_TRUE "boolsche Zustände, positive Logik" TAB_VERB "%6.3" "" COMPU_TAB_REF B_TRUE /end COMPU_METHOD
/begin COMPU_VTAB B_TRUE "boolsche Zustände, positive Logik" TAB_VERB 2 0 "----" 1 "TRUE" /end COMPU_VTAB
/begin COMPU_METHOD dez "1 : 1 Umrechnug (dez/hex)" RAT_FUNC "%6.2" "" COEFFS 0 1 0 0 0 1 /end COMPU_METHOD
/end MODULE
/end PROJECT
