/begin PROJECT _7804367 "156"
/begin HEADER "" VERSION "_7804367" PROJECT_NO _7804367 /end HEADER
/begin MODULE DIM ""
/begin MOD_COMMON "" BYTE_ORDER BIG_ENDIAN S_REC_LAYOUT DAMOS /end MOD_COMMON
/begin MEASUREMENT rkr_3_A "Referenzpegel Klopfregelung" UBYTE spg_ub_b5 1 100 0 4.98047 FUNCTION_LIST KRKE DKRS IF_DATA DIM_X 0x380BB0 EXTERN WORD IF_DATA MCMESS 0x380BB0 EXTERN /end MEASUREMENT
/begin MEASUREMENT rkr_4_A "Referenzpegel Klopfregelung" UBYTE spg_ub_b5 1 100 0 4.98047 FUNCTION_LIST KRKE DKRS IF_DATA DIM_X 0x380BB1 EXTERN WORD IF_DATA MCMESS 0x380BB1 EXTERN /end MEASUREMENT
/begin MEASUREMENT rkr_5_A "Referenzpegel Klopfregelung" UBYTE spg_ub_b5 1 100 0 4.98047 FUNCTION_LIST KRKE DKRS IF_DATA DIM_X 0x380BB2 EXTERN WORD IF_DATA MCMESS 0x380BB2 EXTERN /end MEASUREMENT
/begin MEASUREMENT rkr_6_A "Referenzpegel Klopfregelung" UBYTE spg_ub_b5 1 100 0 4.98047 FUNCTION_LIST KRKE DKRS IF_DATA DIM_X 0x380BB3 EXTERN WORD IF_DATA MCMESS 0x380BB3 EXTERN /end MEASUREMENT
/begin MEASUREMENT rkr_7_A "Referenzpegel Klopfregelung" UBYTE spg_ub_b5 1 100 0 4.98047 FUNCTION_LIST KRKE DKRS IF_DATA DIM_X 0x380BB4 EXTERN WORD IF_DATA MCMESS 0x380BB4 EXTERN /end MEASUREMENT
/begin MEASUREMENT rkrmx "nach oben begrenzter Referenzpegel" UBYTE spg_ub_b5 1 100 0 4.98047 FUNCTION_LIST KRKE IF_DATA DIM_X 0xFAF2 INTERN WORD IF_DATA MCMESS 0xFAF2 INTERN /end MEASUREMENT
/begin MEASUREMENT rkrmx1w "aktueller Wert der KL RKRMX1N" UBYTE spg_ub_b320 1 100 0 318.75 FUNCTION_LIST KRKE IF_DATA DIM_X 0x380BA2 EXTERN WORD IF_DATA MCMESS 0x380BA2 EXTERN /end MEASUREMENT
/begin MEASUREMENT rkrmx2w "aktueller Wert der KL RKRMX2N" UBYTE spg_ub_b320 1 100 0 318.75 FUNCTION_LIST KRKE IF_DATA DIM_X 0x380BA3 EXTERN WORD IF_DATA MCMESS 0x380BA3 EXTERN /end MEASUREMENT
/begin MEASUREMENT rkrn_u_0 "normierter Referenzpegel KR (Byte) SW-Zylinder 0" UBYTE spg_q0p1563 1 100 0 39.8565 FUNCTION_LIST DFFTCNV DFFTK IF_DATA DIM_X 0x3809F9 EXTERN WORD IF_DATA MCMESS 0x3809F9 EXTERN /end MEASUREMENT
/begin MEASUREMENT rkrn_u_1 "normierter Referenzpegel KR (Byte) SW-Zylinder 1" UBYTE spg_q0p1563 1 100 0 39.8565 FUNCTION_LIST DFFTCNV DFFTK IF_DATA DIM_X 0x3809FA EXTERN WORD IF_DATA MCMESS 0x3809FA EXTERN /end MEASUREMENT
/begin MEASUREMENT rkrn_w_0__A "normierter Referenzpegel Klopfregelung" UWORD spg_uw_b1280 1 100 0 1279.98 FUNCTION_LIST DKRS DFFTCNV T2LID IF_DATA DIM_X 0x382432 EXTERN WORD IF_DATA MCMESS 0x382432 EXTERN /end MEASUREMENT
/begin MEASUREMENT rkrn_w_1__A "normierter Referenzpegel Klopfregelung" UWORD spg_uw_b1280 1 100 0 1279.98 FUNCTION_LIST DKRS DFFTCNV T2LID IF_DATA DIM_X 0x382434 EXTERN WORD IF_DATA MCMESS 0x382434 EXTERN /end MEASUREMENT
/begin MEASUREMENT rkrn_w_2__A "normierter Referenzpegel Klopfregelung" UWORD spg_uw_b1280 1 100 0 1279.98 FUNCTION_LIST DKRS DFFTCNV T2LID IF_DATA DIM_X 0x382436 EXTERN WORD IF_DATA MCMESS 0x382436 EXTERN /end MEASUREMENT
/begin MEASUREMENT rkrn_w_3__A "normierter Referenzpegel Klopfregelung" UWORD spg_uw_b1280 1 100 0 1279.98 FUNCTION_LIST DKRS DFFTCNV T2LID IF_DATA DIM_X 0x382438 EXTERN WORD IF_DATA MCMESS 0x382438 EXTERN /end MEASUREMENT
/begin MEASUREMENT rkrn_w_4__A "normierter Referenzpegel Klopfregelung" UWORD spg_uw_b1280 1 100 0 1279.98 FUNCTION_LIST DKRS DFFTCNV T2LID IF_DATA DIM_X 0x38243A EXTERN WORD IF_DATA MCMESS 0x38243A EXTERN /end MEASUREMENT
/begin MEASUREMENT rkrn_w_5__A "normierter Referenzpegel Klopfregelung" UWORD spg_uw_b1280 1 100 0 1279.98 FUNCTION_LIST DKRS DFFTCNV T2LID IF_DATA DIM_X 0x38243C EXTERN WORD IF_DATA MCMESS 0x38243C EXTERN /end MEASUREMENT
/begin MEASUREMENT rkrn_w_6__A "normierter Referenzpegel Klopfregelung" UWORD spg_uw_b1280 1 100 0 1279.98 FUNCTION_LIST DKRS DFFTCNV T2LID IF_DATA DIM_X 0x38243E EXTERN WORD IF_DATA MCMESS 0x38243E EXTERN /end MEASUREMENT
/begin MEASUREMENT rkrn_w_7__A "normierter Referenzpegel Klopfregelung" UWORD spg_uw_b1280 1 100 0 1279.98 FUNCTION_LIST DKRS DFFTCNV T2LID IF_DATA DIM_X 0x382440 EXTERN WORD IF_DATA MCMESS 0x382440 EXTERN /end MEASUREMENT
/begin MEASUREMENT rkr_tst "Referenzpegel Klopfregelung rollierend mit Zyl.zähler" UBYTE spg_ub_b5 1 100 0 4.98047 FUNCTION_LIST KRKE IF_DATA DIM_X 0x380BB5 EXTERN WORD IF_DATA MCMESS 0x380BB5 EXTERN /end MEASUREMENT
/begin MEASUREMENT rkte_w "Relativer Gemischanteil Tankentlüftung" SWORD rel_sw_q0p0468 1 100 -1536 1535.95 FUNCTION_LIST TEB GK KVA T2LID IF_DATA DIM_X 0x382BC4 EXTERN WORD IF_DATA MCMESS 0x382BC4 EXTERN /end MEASUREMENT
/begin MEASUREMENT rkuke_w "rel. Kraftstoffmasse Übergangskompensation Ersatzwert" SWORD rel_sw_q0p1875 1 100 -6144 6143.81 FUNCTION_LIST ESUK IF_DATA DIM_X 0x382296 EXTERN WORD IF_DATA MCMESS 0x382296 EXTERN /end MEASUREMENT
/begin MEASUREMENT rkukg_w "rel. Kraftstoffmasse Übergangskompensation" SWORD rel_sw_b1536 1 100 -1536 1535.95 FUNCTION_LIST ESUK GK IF_DATA DIM_X 0x382298 EXTERN WORD IF_DATA MCMESS 0x382298 EXTERN /end MEASUREMENT
/begin MEASUREMENT rkukkl_w "Kurz- und Langzeitanteil der UK" SWORD rel_sw_q0p1875 1 100 -6144 6143.81 FUNCTION_LIST ESUK IF_DATA DIM_X 0x38229A EXTERN WORD IF_DATA MCMESS 0x38229A EXTERN /end MEASUREMENT
/begin MEASUREMENT rkukkt_w "rk-Kurzzeitanteil der UK totzeitverschoben (UK-Adaption)" SWORD rel_sw_q0p1875 1 100 -6144 6143.81 FUNCTION_LIST ESUKAS IF_DATA DIM_X 0x3822C8 EXTERN WORD IF_DATA MCMESS 0x3822C8 EXTERN /end MEASUREMENT
/begin MEASUREMENT rkukk_w "rk-Kurzzeitanteil der UK" SWORD rel_sw_q0p1875 1 100 -6144 6143.81 FUNCTION_LIST ESUK ESUKAS IF_DATA DIM_X 0x38229C EXTERN WORD IF_DATA MCMESS 0x38229C EXTERN /end MEASUREMENT
/begin MEASUREMENT rkukl_w "rk-Langzeitanteil der UK" SWORD rel_sw_q0p1875 1 100 -6144 6143.81 FUNCTION_LIST ESUK IF_DATA DIM_X 0x38229E EXTERN WORD IF_DATA MCMESS 0x38229E EXTERN /end MEASUREMENT
/begin MEASUREMENT rkuk_w "rel. Kraftstoffmasse Übergangskompensation ohne Verstelleingriffe" SWORD rel_sw_q0p1875 1 100 -6144 6143.81 FUNCTION_LIST ESUK IF_DATA DIM_X 0x3822A0 EXTERN WORD IF_DATA MCMESS 0x3822A0 EXTERN /end MEASUREMENT
/begin MEASUREMENT rk_w "relative Kraftstoffmasse" UWORD rel_uw_b3072 1 100 0 3071.95 FUNCTION_LIST GK KVA RKTI IF_DATA DIM_X 0x382314 EXTERN WORD IF_DATA MCMESS 0x382314 EXTERN /end MEASUREMENT
/begin MEASUREMENT rl "relative Luftfüllung" UBYTE rel_ub_q0p75 1 100 0 191.25 FUNCTION_LIST BGSRM ATM BGTMPK CAN DFFT DKATLRS DLLR DLSU DMDDLU DMDDVS DMDFON DMDLU DMDLUA DMDLU_C DMDMIL DMDSTP DVS ESGRU ESNST ESNWS ESUKAS esvs ESVW ESWL GGDVE GGHFM GGKS GGLSU GK KRRA LAMBTS LDRLMX LDTVMA LRA LRS LRSEB LRSHK NLPH NMAXMD RUNTIME SSTBER87 T2DFA TEB UFRLC ZWGRU ZWMIN IF_DATA DIM_X 0xFADB INTERN WORD IF_DATA MCMESS 0xFADB INTERN /end MEASUREMENT
/begin MEASUREMENT rlc_c_um "Fehlerzähler für rl-Vergleich mit der Funktion in der Funktionsüberwachung" UBYTE t40ms_ub_b10200 1 100 0 10200 FUNCTION_LIST UFRLC IF_DATA DIM_X 0x382E56 EXTERN WORD IF_DATA MCMESS 0x382E56 EXTERN /end MEASUREMENT
/begin MEASUREMENT rldkofkb_w "gewichtete relative Luftfüllung aus DK-Signal berechnet ohne Einrechnung fkmsdk" UWORD rel_uw_q0p0234 1 100 0 1535.98 FUNCTION_LIST BGMSZS IF_DATA DIM_X 0x38201C EXTERN WORD IF_DATA MCMESS 0x38201C EXTERN /end MEASUREMENT
/begin MEASUREMENT rldkofk_w "relative Luftfüllung aus DK-Signal berechnet ohne Einrechnung von fkmsdk" UWORD rel_uw_q0p0234 1 100 0 1535.98 FUNCTION_LIST BGMSZS IF_DATA DIM_X 0x38201E EXTERN WORD IF_DATA MCMESS 0x38201E EXTERN /end MEASUREMENT
/begin MEASUREMENT rldkthp "Hochpaßgefiltertes rl-Signal" SBYTE rel_sb_q0p75 1 100 -96 95.25 FUNCTION_LIST DKATLRS IF_DATA DIM_X 0x380A71 EXTERN WORD IF_DATA MCMESS 0x380A71 EXTERN /end MEASUREMENT
/begin MEASUREMENT rldkthp2 "Hochpaßgefiltertes rl-Signal, Bank2" SBYTE rel_sb_q0p75 1 100 -96 95.25 FUNCTION_LIST DKATLRS IF_DATA DIM_X 0x380A72 EXTERN WORD IF_DATA MCMESS 0x380A72 EXTERN /end MEASUREMENT
/begin MEASUREMENT rldvs_w "relative Luftfüllung durch Drosselventile am Saugrohr 16-Bit" UWORD rel_uw_q0p0234 1 100 0 1535.98 FUNCTION_LIST BGMSZS BGRLP IF_DATA DIM_X 0x382020 EXTERN WORD IF_DATA MCMESS 0x382020 EXTERN /end MEASUREMENT
/begin MEASUREMENT rlfgks_w "Korrigierte relative  Sollfrischluft (Luft, die über DK und TEV fließt)" UWORD rel_uw_q0p0234 1 100 0 1535.98 FUNCTION_LIST FUEDK IF_DATA DIM_X 0x382152 EXTERN WORD IF_DATA MCMESS 0x382152 EXTERN /end MEASUREMENT
/begin MEASUREMENT rlf_ptr_um "Pointer für Schieberegister des Lastfilters" UBYTE dez 1 100 0 255 FUNCTION_LIST UFRLC IF_DATA DIM_X 0x382E57 EXTERN WORD IF_DATA MCMESS 0x382E57 EXTERN /end MEASUREMENT
/begin MEASUREMENT rlf_reg_um_0___A "" UBYTE rel_ub_q0p75 1 100 0 191.25 FUNCTION_LIST UFRLC IF_DATA DIM_X 0x382E58 EXTERN WORD IF_DATA MCMESS 0x382E58 EXTERN /end MEASUREMENT
/begin MEASUREMENT rlf_reg_um_1___A "" UBYTE rel_ub_q0p75 1 100 0 191.25 FUNCTION_LIST UFRLC IF_DATA DIM_X 0x382E59 EXTERN WORD IF_DATA MCMESS 0x382E59 EXTERN /end MEASUREMENT
/begin MEASUREMENT rlf_reg_um_2___A "" UBYTE rel_ub_q0p75 1 100 0 191.25 FUNCTION_LIST UFRLC IF_DATA DIM_X 0x382E5A EXTERN WORD IF_DATA MCMESS 0x382E5A EXTERN /end MEASUREMENT
/begin MEASUREMENT rlf_reg_um_3___A "" UBYTE rel_ub_q0p75 1 100 0 191.25 FUNCTION_LIST UFRLC IF_DATA DIM_X 0x382E5B EXTERN WORD IF_DATA MCMESS 0x382E5B EXTERN /end MEASUREMENT
/begin MEASUREMENT rlf_reg_um_4___A "" UBYTE rel_ub_q0p75 1 100 0 191.25 FUNCTION_LIST UFRLC IF_DATA DIM_X 0x382E5C EXTERN WORD IF_DATA MCMESS 0x382E5C EXTERN /end MEASUREMENT
/begin MEASUREMENT rlf_reg_um_5___A "" UBYTE rel_ub_q0p75 1 100 0 191.25 FUNCTION_LIST UFRLC IF_DATA DIM_X 0x382E5D EXTERN WORD IF_DATA MCMESS 0x382E5D EXTERN /end MEASUREMENT
/begin MEASUREMENT rlf_reg_um_6___A "" UBYTE rel_ub_q0p75 1 100 0 191.25 FUNCTION_LIST UFRLC IF_DATA DIM_X 0x382E5E EXTERN WORD IF_DATA MCMESS 0x382E5E EXTERN /end MEASUREMENT
/begin MEASUREMENT rlf_reg_um_7___A "" UBYTE rel_ub_q0p75 1 100 0 191.25 FUNCTION_LIST UFRLC IF_DATA DIM_X 0x382E5F EXTERN WORD IF_DATA MCMESS 0x382E5F EXTERN /end MEASUREMENT
/begin MEASUREMENT rlgas_w "Füllungsgradient über ein Arbeitsspiel bestimmt" SWORD relNWU_q0p0234 1 100 -768 767.977 FUNCTION_LIST BGRLG IF_DATA DIM_X 0x382054 EXTERN WORD IF_DATA MCMESS 0x382054 EXTERN /end MEASUREMENT
/begin MEASUREMENT rlipf_low_um "" UBYTE rel_ub_q0p0029 1 100 0 0.74707 FUNCTION_LIST UFRLC IF_DATA DIM_X 0x382E60 EXTERN WORD IF_DATA MCMESS 0x382E60 EXTERN /end MEASUREMENT
/begin MEASUREMENT rlipf_um "relative Luftfüllung aus Nebenlastsignal hinter Tiefpaß in der Funktionsüberw." UBYTE rel_ub_q0p75 1 100 0 191.25 FUNCTION_LIST UFRLC IF_DATA DIM_X 0x382E61 EXTERN WORD IF_DATA MCMESS 0x382E61 EXTERN /end MEASUREMENT
/begin MEASUREMENT rlip_c_um "Fehlerzähler für rl/rlip-Vergleich in der Funktionsüberwachung" UBYTE t40ms_ub_b10200 1 100 0 10200 FUNCTION_LIST UFRLC IF_DATA DIM_X 0x382E62 EXTERN WORD IF_DATA MCMESS 0x382E62 EXTERN /end MEASUREMENT
/begin MEASUREMENT rlip_um "relative Luftfüllung aus Nebenlastsignal für die Funktionsüberwachung" UBYTE rel_ub_q0p75 1 100 0 191.25 FUNCTION_LIST UFRLC IF_DATA DIM_X 0x382E63 EXTERN WORD IF_DATA MCMESS 0x382E63 EXTERN /end MEASUREMENT
/begin MEASUREMENT rlmax_w "maximal erreichbare Füllung bei Turbo" UWORD rel_uw_q0p0234 1 100 0 1535.98 FUNCTION_LIST LDRLMX LDRPLS MDFUE MDMAX T2LID IF_DATA DIM_X 0x3824BE EXTERN WORD IF_DATA MCMESS 0x3824BE EXTERN /end MEASUREMENT
/begin MEASUREMENT rlmin_w "minimal zulässiges rl" UWORD rel_uw_q0p0234 1 100 0 1535.98 FUNCTION_LIST MDFUE MDKOG IF_DATA DIM_X 0x3821BC EXTERN WORD IF_DATA MCMESS 0x3821BC EXTERN /end MEASUREMENT
/begin MEASUREMENT rlmp_w "rel. extrapolierte Luftfuellung (Word)" UWORD rel_uw_q0p0234 1 100 0 1535.98 FUNCTION_LIST BGRLP IF_DATA DIM_X 0x38220E EXTERN WORD IF_DATA MCMESS 0x38220E EXTERN /end MEASUREMENT
/begin MEASUREMENT rlmxko_w "Maximalfüllung korrigiert (ohne Begrenzungen)" UWORD rel_uw_q0p0234 1 100 0 1535.98 FUNCTION_LIST LDRLMX IF_DATA DIM_X 0x3824C0 EXTERN WORD IF_DATA MCMESS 0x3824C0 EXTERN /end MEASUREMENT
/begin MEASUREMENT rlmx_w "Rohwert Maximalfuellung" UWORD rel_uw_q0p0234 1 100 0 1535.98 FUNCTION_LIST LDRLMX T2LID IF_DATA DIM_X 0x3824C2 EXTERN WORD IF_DATA MCMESS 0x3824C2 EXTERN /end MEASUREMENT
/begin MEASUREMENT rlnotn "rel.Luftfüllung bei Haupt- und Nebenlastsignalfehler in Abhängigkeit von nmot" UBYTE rel_ub_q0p75 1 100 0 191.25 FUNCTION_LIST BGMSZS IF_DATA DIM_X 0x380AEE EXTERN WORD IF_DATA MCMESS 0x380AEE EXTERN /end MEASUREMENT
/begin MEASUREMENT rlossCtr_w "" UWORD dez 1 100 0 65535 FUNCTION_LIST RUNTIME IF_DATA DIM_X 0x383A30 EXTERN WORD IF_DATA MCMESS 0x383A30 EXTERN /end MEASUREMENT
/begin MEASUREMENT rlp "rel. Luftfüllung praediziert für Einspritzberechnung" UBYTE rel_ub_q0p75 1 100 0 191.25 FUNCTION_LIST BGRLP T2LID IF_DATA DIM_X 0x380B16 EXTERN WORD IF_DATA MCMESS 0x380B16 EXTERN /end MEASUREMENT
/begin MEASUREMENT rlp_w "rel. Luftfüllung praediziert für Einspritzberechnung (Word)" UWORD rel_uw_q0p0234 1 100 0 1535.98 FUNCTION_LIST BGRLP ESUK GK KRDY IF_DATA DIM_X 0x382210 EXTERN WORD IF_DATA MCMESS 0x382210 EXTERN /end MEASUREMENT
/begin MEASUREMENT rlrohmp_w "rel. Luftfüllung Saugrohrzufluss bei Saugrohrdruck psmp_w (Word)" UWORD rel_uw_q0p0234 1 100 0 1535.98 FUNCTION_LIST BGRLP IF_DATA DIM_X 0x382212 EXTERN WORD IF_DATA MCMESS 0x382212 EXTERN /end MEASUREMENT
/begin MEASUREMENT rlroh_w "relative Luftfüllung: Rohwert vom Lastsensor (word)" UWORD rel_uw_q0p0234 1 100 0 1535.98 FUNCTION_LIST BGMSZS BGSRM IF_DATA DIM_X 0x382022 EXTERN WORD IF_DATA MCMESS 0x382022 EXTERN /end MEASUREMENT
/begin MEASUREMENT rlrsp_w_0__A "Beginn Ringspeicher relative Füllung" UWORD rel_uw_q0p0234 1 100 0 1535.98 FUNCTION_LIST BGRLG IF_DATA DIM_X 0x382056 EXTERN WORD IF_DATA MCMESS 0x382056 EXTERN /end MEASUREMENT
/begin MEASUREMENT rlrsp_w_1__A "Beginn Ringspeicher relative Füllung" UWORD rel_uw_q0p0234 1 100 0 1535.98 FUNCTION_LIST BGRLG IF_DATA DIM_X 0x382058 EXTERN WORD IF_DATA MCMESS 0x382058 EXTERN /end MEASUREMENT
/begin MEASUREMENT rlrsp_w_2__A "Beginn Ringspeicher relative Füllung" UWORD rel_uw_q0p0234 1 100 0 1535.98 FUNCTION_LIST BGRLG IF_DATA DIM_X 0x38205A EXTERN WORD IF_DATA MCMESS 0x38205A EXTERN /end MEASUREMENT
/begin MEASUREMENT rlrsp_w_3__A "Beginn Ringspeicher relative Füllung" UWORD rel_uw_q0p0234 1 100 0 1535.98 FUNCTION_LIST BGRLG IF_DATA DIM_X 0x38205C EXTERN WORD IF_DATA MCMESS 0x38205C EXTERN /end MEASUREMENT
/begin MEASUREMENT rlrsp_w_4__A "Beginn Ringspeicher relative Füllung" UWORD rel_uw_q0p0234 1 100 0 1535.98 FUNCTION_LIST BGRLG IF_DATA DIM_X 0x38205E EXTERN WORD IF_DATA MCMESS 0x38205E EXTERN /end MEASUREMENT
/begin MEASUREMENT rlrsp_w_5__A "Beginn Ringspeicher relative Füllung" UWORD rel_uw_q0p0234 1 100 0 1535.98 FUNCTION_LIST BGRLG IF_DATA DIM_X 0x382060 EXTERN WORD IF_DATA MCMESS 0x382060 EXTERN /end MEASUREMENT
/begin MEASUREMENT rlrsp_w_6__A "Beginn Ringspeicher relative Füllung" UWORD rel_uw_q0p0234 1 100 0 1535.98 FUNCTION_LIST BGRLG IF_DATA DIM_X 0x382062 EXTERN WORD IF_DATA MCMESS 0x382062 EXTERN /end MEASUREMENT
/begin MEASUREMENT rlrsp_w_7__A "Beginn Ringspeicher relative Füllung" UWORD rel_uw_q0p0234 1 100 0 1535.98 FUNCTION_LIST BGRLG IF_DATA DIM_X 0x382064 EXTERN WORD IF_DATA MCMESS 0x382064 EXTERN /end MEASUREMENT
/begin MEASUREMENT rlshk "Soll-Füllung höhenkorrigiert" UBYTE rel_ub_q0p75 1 100 0 191.25 FUNCTION_LIST FE NWS SU IF_DATA DIM_X 0x380AFC EXTERN WORD IF_DATA MCMESS 0x380AFC EXTERN /end MEASUREMENT
/begin MEASUREMENT rlsnw "Auswahl zwischen rlsol_w und rlshk zur Adressierung von KFNW" UBYTE rel_ub_q0p75 1 100 0 191.25 FUNCTION_LIST NWS IF_DATA DIM_X 0x380B04 EXTERN WORD IF_DATA MCMESS 0x380B04 EXTERN /end MEASUREMENT
/begin MEASUREMENT rlsol_w "Soll-Füllung" UWORD rel_uw_q0p0234 1 100 0 1535.98 FUNCTION_LIST MDFUE CAN FE FUEDK FUEREG LDRPLS LDTVMA MDKOG NWS IF_DATA DIM_X 0x3821BE EXTERN WORD IF_DATA MCMESS 0x3821BE EXTERN /end MEASUREMENT
/begin MEASUREMENT rlst08_uc "rlst08_um im Befehlstest" UWORD dez 1 100 0 65535 FUNCTION_LIST URCEINS URCMIST IF_DATA DIM_X 0x382930 EXTERN WORD IF_DATA MCMESS 0x382930 EXTERN /end MEASUREMENT
/begin MEASUREMENT rlst08_um "Stützstelle der SSV RLV08_UM" UWORD dez 1 100 0 65535 FUNCTION_LIST UFEINS UFMIST IF_DATA DIM_X 0x382E9C EXTERN WORD IF_DATA MCMESS 0x382E9C EXTERN /end MEASUREMENT
/begin MEASUREMENT rltedte_w "Aus DTEV ermittelte relative Füllung über das Tankentlüftungsventil" UWORD rel_uw_q0p0234 1 100 0 1535.98 FUNCTION_LIST DTEV MDFUE IF_DATA DIM_X 0x382C4C EXTERN WORD IF_DATA MCMESS 0x382C4C EXTERN /end MEASUREMENT
/begin MEASUREMENT rlteev_w "Relative Füllung verursacht durch Regeneriergas Tankentlüftung" UWORD rel_uw_b192 1 100 0 191.997 FUNCTION_LIST TEB IF_DATA DIM_X 0x382BC6 EXTERN WORD IF_DATA MCMESS 0x382BC6 EXTERN /end MEASUREMENT
/begin MEASUREMENT rlugd_w "Füllung im ungedrosselten Zustand" UWORD rel_uw_q0p0234 1 100 0 1535.98 FUNCTION_LIST MDMAX IF_DATA DIM_X 0x3826B8 EXTERN WORD IF_DATA MCMESS 0x3826B8 EXTERN /end MEASUREMENT
/begin MEASUREMENT rlumsch_w "Sollluft am Umschaltpunkt von Schicht- nach Homogenbetrieb" UWORD rel_uw_q0p0234 1 100 0 1535.98 FUNCTION_LIST BGMSZS IF_DATA DIM_X 0x382024 EXTERN WORD IF_DATA MCMESS 0x382024 EXTERN /end MEASUREMENT
/begin MEASUREMENT rlvppl "Relative Luftfüllung (dichtekorrigiert) für Berechnung DK-Winkel-Ersatzwert" UBYTE rel_ub_q0p75 1 100 0 191.25 FUNCTION_LIST GGDVE IF_DATA DIM_X 0x380AB8 EXTERN WORD IF_DATA MCMESS 0x380AB8 EXTERN /end MEASUREMENT
/begin MEASUREMENT rlzo_um "obere Toleranzgrenze für rl aus Nebenlastsignal in der Funktionsüberwachung" UBYTE rel_ub_q0p75 1 100 0 191.25 FUNCTION_LIST UFRLC IF_DATA DIM_X 0x380C4D EXTERN WORD IF_DATA MCMESS 0x380C4D EXTERN /end MEASUREMENT
/begin MEASUREMENT rlzuhfs_w "relative Luftfüllung (zufließend) mit Hauptfüllungssensor bestimmt" UWORD rel_uw_q0p0234 1 100 0 1535.98 FUNCTION_LIST BGMSZS IF_DATA DIM_X 0x382026 EXTERN WORD IF_DATA MCMESS 0x382026 EXTERN /end MEASUREMENT
/begin MEASUREMENT rl_m "Monitor, relative Luftfüllung" UBYTE rel_ub_q0p75 1 100 0 191.25 FUNCTION_LIST DMDLU IF_DATA DIM_X 0xE459 INTERN WORD IF_DATA MCMESS 0xE459 INTERN /end MEASUREMENT
/begin MEASUREMENT rl_uc "relative Luftfüllung im Befehlstest" UBYTE rel_ub_q0p75 1 100 0 191.25 FUNCTION_LIST URCEIN URCEINS URCMIST IF_DATA DIM_X 0x380C5D EXTERN WORD IF_DATA MCMESS 0x380C5D EXTERN /end MEASUREMENT
/begin MEASUREMENT rl_um "relative Luftfüllung in der Funktionsüberwachung" UBYTE rel_ub_q0p75 1 100 0 191.25 FUNCTION_LIST UFRLC UFEINS UFMIST IF_DATA DIM_X 0x382E64 EXTERN WORD IF_DATA MCMESS 0x382E64 EXTERN /end MEASUREMENT
/begin MEASUREMENT rl_w "relative Luftfüllung (Word)" UWORD rel_uw_q0p0234 1 100 0 1535.98 FUNCTION_LIST BGSRM BGRLG BGRLP DLDR DSLSLRS FUEREG KRDY LAKH LRS MDBAS MDEX MDMAX MDVER SSTBER87 T2LID UFRLC VMAXMD IF_DATA DIM_X 0xFAE0 INTERN WORD IF_DATA MCMESS 0xFAE0 INTERN /end MEASUREMENT
/begin MEASUREMENT rl_w_kge "Eingang relative Füllung (Word) für mehrfach verwendete Kenngr." UWORD rel_uw_q0p0234 1 100 0 1535.98 FUNCTION_LIST MDBAS MDMAX IF_DATA DIM_X 0x382626 EXTERN WORD IF_DATA MCMESS 0x382626 EXTERN /end MEASUREMENT
/begin MEASUREMENT rl_w_um "relative Luftfüllung (Word) in der Funktionsüberwachung" UWORD rel_uw_q0p0234 1 100 0 1535.98 FUNCTION_LIST UFRLC IF_DATA DIM_X 0x3828DA EXTERN WORD IF_DATA MCMESS 0x3828DA EXTERN /end MEASUREMENT
/begin MEASUREMENT rml "relative Luftmasse (calc. load value) nach SAE J1979" UBYTE rel_ub_b99p6 1 100 0 99.6094 FUNCTION_LIST BGRML DFFT TC1MOD IF_DATA DIM_X 0x3809D6 EXTERN WORD IF_DATA MCMESS 0x3809D6 EXTERN /end MEASUREMENT
/begin MEASUREMENT rmsl "relative Sekundärluftmasse" UBYTE fak_ub_b2 1 100 0 1.99219 FUNCTION_LIST DSLSLRS T2LID IF_DATA DIM_X 0x380911 EXTERN WORD IF_DATA MCMESS 0x380911 EXTERN /end MEASUREMENT
/begin MEASUREMENT rmsl2 "relative Sekundärluftmasse, Bank 2" UBYTE fak_ub_b2 1 100 0 1.99219 FUNCTION_LIST DSLSLRS T2LID IF_DATA DIM_X 0x380912 EXTERN WORD IF_DATA MCMESS 0x380912 EXTERN /end MEASUREMENT
/begin MEASUREMENT rmslt "relative Sekundärluftmasse ohne Offset- Korrektur" UBYTE fak_ub_b2 1 100 0 1.99219 FUNCTION_LIST DSLSLRS IF_DATA DIM_X 0x380913 EXTERN WORD IF_DATA MCMESS 0x380913 EXTERN /end MEASUREMENT
/begin MEASUREMENT rmslt2 "relative Sekundärluftmasse ohne Offset- Korrektur, Bank 2" UBYTE fak_ub_b2 1 100 0 1.99219 FUNCTION_LIST DSLSLRS IF_DATA DIM_X 0x380914 EXTERN WORD IF_DATA MCMESS 0x380914 EXTERN /end MEASUREMENT
/begin MEASUREMENT rmstevf_w "aktueller Meßwert für relative TEV-Güte" SWORD rel_sw_b200 1 100 -200 199.994 FUNCTION_LIST DTEV IF_DATA DIM_X 0x382C4E EXTERN WORD IF_DATA MCMESS 0x382C4E EXTERN /end MEASUREMENT
/begin MEASUREMENT rmstevuf_w "aktueller, unsigned Meßwert für relative TEV-Güte" UWORD rel_uw_b200 1 100 0 199.997 FUNCTION_LIST DTEV IF_DATA DIM_X 0x382C50 EXTERN WORD IF_DATA MCMESS 0x382C50 EXTERN /end MEASUREMENT
/begin MEASUREMENT rmstev_w "Langzeitgespeicherter Meßwert der relativen TEV-Güte" UWORD rel_uw_b200 1 100 0 199.997 FUNCTION_LIST DTEV IF_DATA DIM_X 0x383E70 EXTERN WORD IF_DATA MCMESS 0x383E70 EXTERN /end MEASUREMENT
/begin MEASUREMENT romErrPage "" UBYTE dez 1 100 0 255 FUNCTION_LIST UFURAM IF_DATA DIM_X 0x3830BE EXTERN WORD IF_DATA MCMESS 0x3830BE EXTERN /end MEASUREMENT
/begin MEASUREMENT romRstC_um "Zähler im DauerRAM für Resets bei ROM-Check-Fehler in der Init. in der FU" UBYTE dez 1 100 0 255 FUNCTION_LIST URROM IF_DATA DIM_X 0x3830C5 EXTERN WORD IF_DATA MCMESS 0x3830C5 EXTERN /end MEASUREMENT
/begin MEASUREMENT romz_c_um "Fehlerzähler im Dauer-RAM für ROM-Prüfung (Diagnose) in der Funktionsüberwachung" UBYTE dez 1 100 0 255 FUNCTION_LIST UFURAM IF_DATA DIM_X 0x3830BF EXTERN WORD IF_DATA MCMESS 0x3830BF EXTERN /end MEASUREMENT
/begin MEASUREMENT rstMon_0_A "" UWORD dez 1 100 0 65535 FUNCTION_LIST rstmon IF_DATA DIM_X 0x383E54 EXTERN WORD IF_DATA MCMESS 0x383E54 EXTERN /end MEASUREMENT
/begin MEASUREMENT rstMon_1_A "" UWORD dez 1 100 0 65535 FUNCTION_LIST rstmon IF_DATA DIM_X 0x383E56 EXTERN WORD IF_DATA MCMESS 0x383E56 EXTERN /end MEASUREMENT
/begin MEASUREMENT rstMon_2_A "" UWORD dez 1 100 0 65535 FUNCTION_LIST rstmon IF_DATA DIM_X 0x383E58 EXTERN WORD IF_DATA MCMESS 0x383E58 EXTERN /end MEASUREMENT
/begin MEASUREMENT rstMon_3_A "" UWORD dez 1 100 0 65535 FUNCTION_LIST rstmon IF_DATA DIM_X 0x383E5A EXTERN WORD IF_DATA MCMESS 0x383E5A EXTERN /end MEASUREMENT
/begin MEASUREMENT rstMon_4_A "" UWORD dez 1 100 0 65535 FUNCTION_LIST rstmon IF_DATA DIM_X 0x383E5C EXTERN WORD IF_DATA MCMESS 0x383E5C EXTERN /end MEASUREMENT
/begin MEASUREMENT rstMon_5_A "" UWORD dez 1 100 0 65535 FUNCTION_LIST rstmon IF_DATA DIM_X 0x383E5E EXTERN WORD IF_DATA MCMESS 0x383E5E EXTERN /end MEASUREMENT
/begin MEASUREMENT rstMon_6_A "" UWORD dez 1 100 0 65535 FUNCTION_LIST rstmon IF_DATA DIM_X 0x383E60 EXTERN WORD IF_DATA MCMESS 0x383E60 EXTERN /end MEASUREMENT
/begin MEASUREMENT rstMon_7_A "" UWORD dez 1 100 0 65535 FUNCTION_LIST rstmon IF_DATA DIM_X 0x383E62 EXTERN WORD IF_DATA MCMESS 0x383E62 EXTERN /end MEASUREMENT
/begin MEASUREMENT rstMon_8_A "" UWORD dez 1 100 0 65535 FUNCTION_LIST rstmon IF_DATA DIM_X 0x383E64 EXTERN WORD IF_DATA MCMESS 0x383E64 EXTERN /end MEASUREMENT
/begin MEASUREMENT rstMon_9_A "" UWORD dez 1 100 0 65535 FUNCTION_LIST rstmon IF_DATA DIM_X 0x383E66 EXTERN WORD IF_DATA MCMESS 0x383E66 EXTERN /end MEASUREMENT
/begin MEASUREMENT rstMon_10_A "" UWORD dez 1 100 0 65535 FUNCTION_LIST rstmon IF_DATA DIM_X 0x383E68 EXTERN WORD IF_DATA MCMESS 0x383E68 EXTERN /end MEASUREMENT
/begin MEASUREMENT rstMon_11_A "" UWORD dez 1 100 0 65535 FUNCTION_LIST rstmon IF_DATA DIM_X 0x383E6A EXTERN WORD IF_DATA MCMESS 0x383E6A EXTERN /end MEASUREMENT
/begin MEASUREMENT rstMon_um "" UWORD dez 1 100 0 65535 FUNCTION_LIST DUR IF_DATA DIM_X 0x382EB8 EXTERN WORD IF_DATA MCMESS 0x382EB8 EXTERN /end MEASUREMENT
/begin MEASUREMENT rstpfad "Reset-Pfad als Umweltbedingung für Rechnerüberwachungs-Diagnoseeintrag" UBYTE dez 1 100 0 255 FUNCTION_LIST DUR DFFT DFPM IF_DATA DIM_X 0x380C83 EXTERN WORD IF_DATA MCMESS 0x380C83 EXTERN /end MEASUREMENT
/begin MEASUREMENT rst_tv "Variable im Dauer-RAM zur Anforderung Reset-Tastverhältnis aus der Fkt-Überwach." UBYTE dez 1 100 0 255 FUNCTION_LIST UFURAM UMKOMF URDELAY IF_DATA DIM_X 0x3830C0 EXTERN WORD IF_DATA MCMESS 0x3830C0 EXTERN /end MEASUREMENT
/begin MEASUREMENT rst_tv_active "" UBYTE dez 1 100 0 255 FUNCTION_LIST URDELAY IF_DATA DIM_X 0x3830C4 EXTERN WORD IF_DATA MCMESS 0x3830C4 EXTERN /end MEASUREMENT
/begin MEASUREMENT R_burn "Raster erkannte Verbrennung für Startmengenadaption" UWORD B_TRUE 1 100 0 1 BIT_MASK 0x1000 FUNCTION_LIST STADAP IF_DATA DIM_X 0xFD5C INTERN BYTE IF_DATA MCMESS 0xFD5C INTERN /end MEASUREMENT
/begin MEASUREMENT r_flags_uc "Byte für Fehlerreaktions-Bits des Befehlstest" UBYTE dez 1 100 0 255 FUNCTION_LIST URCRAM IF_DATA DIM_X 0x380C55 EXTERN WORD IF_DATA MCMESS 0x380C55 EXTERN /end MEASUREMENT
/begin MEASUREMENT r_flags_um "Byte für Fehlerreaktions-Bits der Funktionsüberwachung" UBYTE dez 1 100 0 255 FUNCTION_LIST UFURAM IF_DATA DIM_X 0x382E42 EXTERN WORD IF_DATA MCMESS 0x382E42 EXTERN /end MEASUREMENT
/begin MEASUREMENT sbmcorm "Summierer für Lückenkorrektur um minus einen Zahn" UBYTE dez 1 100 0 255 FUNCTION_LIST DDG IF_DATA DIM_X 0x380A20 EXTERN WORD IF_DATA MCMESS 0x380A20 EXTERN /end MEASUREMENT
/begin MEASUREMENT sbmcorp "Summierer für Lückenkorrektur um plus einen Zahn" UBYTE dez 1 100 0 255 FUNCTION_LIST DDG IF_DATA DIM_X 0x380A21 EXTERN WORD IF_DATA MCMESS 0x380A21 EXTERN /end MEASUREMENT
/begin MEASUREMENT sbmlos_w "Summierer für Bezugsmarkenverluste" UWORD dez 1 100 0 65535 FUNCTION_LIST DDG IF_DATA DIM_X 0x383962 EXTERN WORD IF_DATA MCMESS 0x383962 EXTERN /end MEASUREMENT
/begin MEASUREMENT scattBits "" UBYTE dez 1 100 0 255 FUNCTION_LIST SCATT IF_DATA DIM_X 0x380A16 EXTERN WORD IF_DATA MCMESS 0x380A16 EXTERN /end MEASUREMENT
/begin MEASUREMENT sdwfk_w "Speicherinhalt der Wandfilmdifferenz für Kurzzeitanteil" SWORD rel_sw_q0p1875 1 100 -6144 6143.81 FUNCTION_LIST ESUK IF_DATA DIM_X 0x3822A2 EXTERN WORD IF_DATA MCMESS 0x3822A2 EXTERN /end MEASUREMENT
/begin MEASUREMENT sdwfl_w "Speicherinhalt der Wandfilmdifferenz für Langzeitanteil" SWORD rel_sw_q0p1875 1 100 -6144 6143.81 FUNCTION_LIST ESUK IF_DATA DIM_X 0x3822A4 EXTERN WORD IF_DATA MCMESS 0x3822A4 EXTERN /end MEASUREMENT
/begin MEASUREMENT segz_0_A "" UBYTE dez 1 100 0 255 FUNCTION_LIST ACIFI IF_DATA DIM_X 0xFA62 INTERN WORD IF_DATA MCMESS 0xFA62 INTERN /end MEASUREMENT
/begin MEASUREMENT segz_1_A "" UBYTE dez 1 100 0 255 FUNCTION_LIST ACIFI IF_DATA DIM_X 0xFA63 INTERN WORD IF_DATA MCMESS 0xFA63 INTERN /end MEASUREMENT
/begin MEASUREMENT segz_2_A "" UBYTE dez 1 100 0 255 FUNCTION_LIST ACIFI IF_DATA DIM_X 0xFA64 INTERN WORD IF_DATA MCMESS 0xFA64 INTERN /end MEASUREMENT
/begin MEASUREMENT segz_3_A "" UBYTE dez 1 100 0 255 FUNCTION_LIST ACIFI IF_DATA DIM_X 0xFA65 INTERN WORD IF_DATA MCMESS 0xFA65 INTERN /end MEASUREMENT
/begin MEASUREMENT segz_4_A "" UBYTE dez 1 100 0 255 FUNCTION_LIST ACIFI IF_DATA DIM_X 0xFA66 INTERN WORD IF_DATA MCMESS 0xFA66 INTERN /end MEASUREMENT
/begin MEASUREMENT segz_5_A "" UBYTE dez 1 100 0 255 FUNCTION_LIST ACIFI IF_DATA DIM_X 0xFA67 INTERN WORD IF_DATA MCMESS 0xFA67 INTERN /end MEASUREMENT
/begin MEASUREMENT segz_6_A "" UBYTE dez 1 100 0 255 FUNCTION_LIST ACIFI IF_DATA DIM_X 0xFA68 INTERN WORD IF_DATA MCMESS 0xFA68 INTERN /end MEASUREMENT
/begin MEASUREMENT segz_7_A "" UBYTE dez 1 100 0 255 FUNCTION_LIST ACIFI IF_DATA DIM_X 0xFA69 INTERN WORD IF_DATA MCMESS 0xFA69 INTERN /end MEASUREMENT
/begin MEASUREMENT sen_c95_0__A "Klopfsensoreingang am Klopfauswerte-IC" UBYTE dezsub1 1 100 1 256 FUNCTION_LIST GGKS DKRS IF_DATA DIM_X 0x380B8D EXTERN WORD IF_DATA MCMESS 0x380B8D EXTERN /end MEASUREMENT
/begin MEASUREMENT sen_c95_1__A "Klopfsensoreingang am Klopfauswerte-IC" UBYTE dezsub1 1 100 1 256 FUNCTION_LIST GGKS DKRS IF_DATA DIM_X 0x380B8E EXTERN WORD IF_DATA MCMESS 0x380B8E EXTERN /end MEASUREMENT
/begin MEASUREMENT sen_c95_2__A "Klopfsensoreingang am Klopfauswerte-IC" UBYTE dezsub1 1 100 1 256 FUNCTION_LIST GGKS DKRS IF_DATA DIM_X 0x380B8F EXTERN WORD IF_DATA MCMESS 0x380B8F EXTERN /end MEASUREMENT
/begin MEASUREMENT sen_c95_3__A "Klopfsensoreingang am Klopfauswerte-IC" UBYTE dezsub1 1 100 1 256 FUNCTION_LIST GGKS DKRS IF_DATA DIM_X 0x380B90 EXTERN WORD IF_DATA MCMESS 0x380B90 EXTERN /end MEASUREMENT
/begin MEASUREMENT sen_c95_4__A "Klopfsensoreingang am Klopfauswerte-IC" UBYTE dezsub1 1 100 1 256 FUNCTION_LIST GGKS DKRS IF_DATA DIM_X 0x380B91 EXTERN WORD IF_DATA MCMESS 0x380B91 EXTERN /end MEASUREMENT
/begin MEASUREMENT sen_c95_5__A "Klopfsensoreingang am Klopfauswerte-IC" UBYTE dezsub1 1 100 1 256 FUNCTION_LIST GGKS DKRS IF_DATA DIM_X 0x380B92 EXTERN WORD IF_DATA MCMESS 0x380B92 EXTERN /end MEASUREMENT
/begin MEASUREMENT sen_c95_6__A "Klopfsensoreingang am Klopfauswerte-IC" UBYTE dezsub1 1 100 1 256 FUNCTION_LIST GGKS DKRS IF_DATA DIM_X 0x380B93 EXTERN WORD IF_DATA MCMESS 0x380B93 EXTERN /end MEASUREMENT
/begin MEASUREMENT sen_c95_7__A "Klopfsensoreingang am Klopfauswerte-IC" UBYTE dezsub1 1 100 1 256 FUNCTION_LIST GGKS DKRS IF_DATA DIM_X 0x380B94 EXTERN WORD IF_DATA MCMESS 0x380B94 EXTERN /end MEASUREMENT
/begin MEASUREMENT sfpaaa "Status Fehlerpfad: Tabellenanfang" UWORD dez 1 100 0 65535 FUNCTION_LIST DFPM_DFPM IF_DATA DIM_X 0x383814 EXTERN WORD IF_DATA MCMESS 0x383814 EXTERN /end MEASUREMENT
/begin MEASUREMENT sfpaave "Status Fehlerpfad: AAV-Ventil Endstufe" UWORD default 1 100 0 65535 FUNCTION_LIST DFPM_DEKON IF_DATA DIM_X 0x383816 EXTERN WORD IF_DATA MCMESS 0x383816 EXTERN /end MEASUREMENT
/begin MEASUREMENT sfpagre "Status Fehlerpfad: AGR-Ventil Endstufe" UWORD default 1 100 0 65535 FUNCTION_LIST DFPM_DUMMY043 IF_DATA DIM_X 0x383818 EXTERN WORD IF_DATA MCMESS 0x383818 EXTERN /end MEASUREMENT
/begin MEASUREMENT sfpagrf "Status Fehlerpfad: Überwachung AGR-Flow" UWORD dez 1 100 0 65535 FUNCTION_LIST DFPM_DUMMY043 IF_DATA DIM_X 0x38381A EXTERN WORD IF_DATA MCMESS 0x38381A EXTERN /end MEASUREMENT
/begin MEASUREMENT sfpbm "Status Fehlerpfad: Bezugsmarkengeber" UWORD dez 1 100 0 65535 FUNCTION_LIST DFPM_DDG IF_DATA DIM_X 0x38381C EXTERN WORD IF_DATA MCMESS 0x38381C EXTERN /end MEASUREMENT
/begin MEASUREMENT sfpbrems "Status Fehlerpfad BREMS: Bremsschalter" UWORD dez 1 100 0 65535 FUNCTION_LIST DFPM_GGEGAS IF_DATA DIM_X 0x38381E EXTERN WORD IF_DATA MCMESS 0x38381E EXTERN /end MEASUREMENT
/begin MEASUREMENT sfpbwf "Statuswort:  PWG Bewegung" UWORD dez 1 100 0 65535 FUNCTION_LIST DFPM_GGPED IF_DATA DIM_X 0x383820 EXTERN WORD IF_DATA MCMESS 0x383820 EXTERN /end MEASUREMENT
/begin MEASUREMENT sfpcas "Status Fehlerpfad: Diagnose CAN-Timeout ASC-Schnittstelle" UWORD dez 1 100 0 65535 FUNCTION_LIST DFPM_DCAS IF_DATA DIM_X 0x383822 EXTERN WORD IF_DATA MCMESS 0x383822 EXTERN /end MEASUREMENT
/begin MEASUREMENT sfpcge "Status Fehlerpfad: Diagnose CAN-Timeout EGS-Schnittstelle" UWORD dez 1 100 0 65535 FUNCTION_LIST DFPM_DCGE IF_DATA DIM_X 0x383824 EXTERN WORD IF_DATA MCMESS 0x383824 EXTERN /end MEASUREMENT
/begin MEASUREMENT sfpcgegs "Status Fehlerpfad: EGS, Steuergerät" UWORD dez 1 100 0 65535 FUNCTION_LIST DFPM_DCG IF_DATA DIM_X 0x383826 EXTERN WORD IF_DATA MCMESS 0x383826 EXTERN /end MEASUREMENT
/begin MEASUREMENT sfpcgggp "Status Fehlerpfad: EGS, Gang unplausibel" UWORD dez 1 100 0 65535 FUNCTION_LIST DFPM_DCG IF_DATA DIM_X 0x383828 EXTERN WORD IF_DATA MCMESS 0x383828 EXTERN /end MEASUREMENT
/begin MEASUREMENT sfpcgggv "Status Fehlerpfad: EGS, Gangvergleich negativ" UWORD dez 1 100 0 65535 FUNCTION_LIST DFPM_DCG IF_DATA DIM_X 0x38382A EXTERN WORD IF_DATA MCMESS 0x38382A EXTERN /end MEASUREMENT
/begin MEASUREMENT sfpcgm1v "Status Fehlerpfad: EGS, Magnetventil 1-2/4-5 Schaltung" UWORD dez 1 100 0 65535 FUNCTION_LIST DFPM_DCG IF_DATA DIM_X 0x38382C EXTERN WORD IF_DATA MCMESS 0x38382C EXTERN /end MEASUREMENT
/begin MEASUREMENT sfpcgm2v "Status Fehlerpfad: EGS, Magnetventil 2-3 Schaltung" UWORD dez 1 100 0 65535 FUNCTION_LIST DFPM_DCG IF_DATA DIM_X 0x38382E EXTERN WORD IF_DATA MCMESS 0x38382E EXTERN /end MEASUREMENT
/begin MEASUREMENT sfpcgm3v "Status Fehlerpfad: EGS, Magnetventil 3-4 Schaltung" UWORD dez 1 100 0 65535 FUNCTION_LIST DFPM_DCG IF_DATA DIM_X 0x383830 EXTERN WORD IF_DATA MCMESS 0x383830 EXTERN /end MEASUREMENT
/begin MEASUREMENT sfpcgmvk "Status Fehlerpfad: EGS, Magnetventil Wandlerkupplung" UWORD dez 1 100 0 65535 FUNCTION_LIST DFPM_DCG IF_DATA DIM_X 0x383832 EXTERN WORD IF_DATA MCMESS 0x383832 EXTERN /end MEASUREMENT
/begin MEASUREMENT sfpcgrmm "Status Fehlerpfad: EGS, Regelmagnetventil Modulierdruck" UWORD dez 1 100 0 65535 FUNCTION_LIST DFPM_DCG IF_DATA DIM_X 0x383834 EXTERN WORD IF_DATA MCMESS 0x383834 EXTERN /end MEASUREMENT
/begin MEASUREMENT sfpcgrms "Status Fehlerpfad: EGS, Regelmagnetventil Schaltdruck" UWORD dez 1 100 0 65535 FUNCTION_LIST DFPM_DCG IF_DATA DIM_X 0x383836 EXTERN WORD IF_DATA MCMESS 0x383836 EXTERN /end MEASUREMENT
/begin MEASUREMENT sfpcgudg "Status Fehlerpfad: EGS, Versorgungsspannung Drehzahlsensoren" UWORD dez 1 100 0 65535 FUNCTION_LIST DFPM_DCG IF_DATA DIM_X 0x383838 EXTERN WORD IF_DATA MCMESS 0x383838 EXTERN /end MEASUREMENT
/begin MEASUREMENT sfpcgumv "Status Fehlerpfad: EGS, Versorgungsspannung Magnetventile" UWORD dez 1 100 0 65535 FUNCTION_LIST DFPM_DCG IF_DATA DIM_X 0x38383A EXTERN WORD IF_DATA MCMESS 0x38383A EXTERN /end MEASUREMENT
/begin MEASUREMENT sfpcgvgc "Status Fehlerpfad: EGS, Verteilergetr.-Stellung unplausibel" UWORD dez 1 100 0 65535 FUNCTION_LIST DFPM_DCG IF_DATA DIM_X 0x38383C EXTERN WORD IF_DATA MCMESS 0x38383C EXTERN /end MEASUREMENT
/begin MEASUREMENT sfpcgvrc "Status Fehlerpfad: EGS, Raddrehzahl hinten unplausibel" UWORD dez 1 100 0 65535 FUNCTION_LIST DFPM_DCG IF_DATA DIM_X 0x38383E EXTERN WORD IF_DATA MCMESS 0x38383E EXTERN /end MEASUREMENT
/begin MEASUREMENT sfpcgwk "Status Fehlerpfad: EGS, Wandlerkupplung" UWORD dez 1 100 0 65535 FUNCTION_LIST DFPM_DCG IF_DATA DIM_X 0x383840 EXTERN WORD IF_DATA MCMESS 0x383840 EXTERN /end MEASUREMENT
/begin MEASUREMENT sfpckbi "Status Fehlerpfad: Diagnose CAN-Timeout KBI-Schnittstelle" UWORD dez 1 100 0 65535 FUNCTION_LIST DFPM_DCKBI IF_DATA DIM_X 0x383842 EXTERN WORD IF_DATA MCMESS 0x383842 EXTERN /end MEASUREMENT
/begin MEASUREMENT sfpcmil "Status Fehlerpfad: Diagnose MIL über CAN" UWORD dez 1 100 0 65535 FUNCTION_LIST DFPM_DCMIL IF_DATA DIM_X 0x383844 EXTERN WORD IF_DATA MCMESS 0x383844 EXTERN /end MEASUREMENT
/begin MEASUREMENT sfpcra "Status Fehlerpfad: EKP Crashfunktion" UWORD dez 1 100 0 65535 FUNCTION_LIST DFPM_GGAIRBAG IF_DATA DIM_X 0x383846 EXTERN WORD IF_DATA MCMESS 0x383846 EXTERN /end MEASUREMENT
/begin MEASUREMENT sfpdk "Status Fehlerpfad DK: Drosselklappe" UWORD dez 1 100 0 65535 FUNCTION_LIST DFPM_DDVE IF_DATA DIM_X 0x383848 EXTERN WORD IF_DATA MCMESS 0x383848 EXTERN /end MEASUREMENT
/begin MEASUREMENT sfpdk1p "Status Fehlerpfad DK1P: Drosselklappe 1. Poti" UWORD dez 1 100 0 65535 FUNCTION_LIST DFPM_DDVE IF_DATA DIM_X 0x38384A EXTERN WORD IF_DATA MCMESS 0x38384A EXTERN /end MEASUREMENT
/begin MEASUREMENT sfpdk2p "Status Fehlerpfad DK2P: Drosselklappe 2. Poti" UWORD dez 1 100 0 65535 FUNCTION_LIST DFPM_DDVE IF_DATA DIM_X 0x38384C EXTERN WORD IF_DATA MCMESS 0x38384C EXTERN /end MEASUREMENT
/begin MEASUREMENT sfpdpl "Status Fehlerpfad: Dauerplus" UWORD dez 1 100 0 65535 FUNCTION_LIST DFPM_DUMMY043 IF_DATA DIM_X 0x38384E EXTERN WORD IF_DATA MCMESS 0x38384E EXTERN /end MEASUREMENT
/begin MEASUREMENT sfpdsl "Status Fehlerpfad: Drucksensor Ladedruck" UWORD dez 1 100 0 65535 FUNCTION_LIST DFPM_GGDSAS IF_DATA DIM_X 0x383850 EXTERN WORD IF_DATA MCMESS 0x383850 EXTERN /end MEASUREMENT
/begin MEASUREMENT sfpdsu "Status Fehlerpfad: Umgebungsdrucksensor" UWORD dez 1 100 0 65535 FUNCTION_LIST DFPM_GGDSAS IF_DATA DIM_X 0x383852 EXTERN WORD IF_DATA MCMESS 0x383852 EXTERN /end MEASUREMENT
/begin MEASUREMENT sfpdsvlu "Status Fehlerpfad:Drucksensorsignalvergleich (DS-L DS-U)" UWORD dez 1 100 0 65535 FUNCTION_LIST DFPM_GGDSAS IF_DATA DIM_X 0x383854 EXTERN WORD IF_DATA MCMESS 0x383854 EXTERN /end MEASUREMENT
/begin MEASUREMENT sfpdvee "Statuswort: DV-E Endstufe" UWORD dez 1 100 0 65535 FUNCTION_LIST DFPM_DDVE IF_DATA DIM_X 0x383856 EXTERN WORD IF_DATA MCMESS 0x383856 EXTERN /end MEASUREMENT
/begin MEASUREMENT sfpdvef "Statuswort: DV-E Fehler bei Federprüfung" UWORD dez 1 100 0 65535 FUNCTION_LIST DFPM_DDVE IF_DATA DIM_X 0x383858 EXTERN WORD IF_DATA MCMESS 0x383858 EXTERN /end MEASUREMENT
/begin MEASUREMENT sfpdvefo "Status Fehlerpfad: DV-E-Fehler bei Federprüfung ""Öffnen""" UWORD dez 1 100 0 65535 FUNCTION_LIST DFPM_DDVE IF_DATA DIM_X 0x38385A EXTERN WORD IF_DATA MCMESS 0x38385A EXTERN /end MEASUREMENT
/begin MEASUREMENT sfpdvel "Statuswort: DV-E Lageabweichung" UWORD dez 1 100 0 65535 FUNCTION_LIST DFPM_DDVE IF_DATA DIM_X 0x38385C EXTERN WORD IF_DATA MCMESS 0x38385C EXTERN /end MEASUREMENT
/begin MEASUREMENT sfpdven "Statuswort: DV-E Fehler bei Prüfung Notluftposition" UWORD dez 1 100 0 65535 FUNCTION_LIST DFPM_DDVE IF_DATA DIM_X 0x38385E EXTERN WORD IF_DATA MCMESS 0x38385E EXTERN /end MEASUREMENT
/begin MEASUREMENT sfpdver "Statuswort: DV-E Regelbereich" UWORD dez 1 100 0 65535 FUNCTION_LIST DFPM_DDVE IF_DATA DIM_X 0x383860 EXTERN WORD IF_DATA MCMESS 0x383860 EXTERN /end MEASUREMENT
/begin MEASUREMENT sfpdvet "Status Fehlerpfad: DV-E-Tauchserkennung ohne Adaption" UWORD dez 1 100 0 65535 FUNCTION_LIST DFPM_DDVE IF_DATA DIM_X 0x383862 EXTERN WORD IF_DATA MCMESS 0x383862 EXTERN /end MEASUREMENT
/begin MEASUREMENT sfpdveu "Statuswort: DV-E Fehler beim UMA-Lernen" UWORD dez 1 100 0 65535 FUNCTION_LIST DFPM_DDVE IF_DATA DIM_X 0x383864 EXTERN WORD IF_DATA MCMESS 0x383864 EXTERN /end MEASUREMENT
/begin MEASUREMENT sfpdveub "Status Fehlerpfad: DV-E-Adaption Abbruch wg. Umweltbedingung" UWORD dez 1 100 0 65535 FUNCTION_LIST DFPM_DDVE IF_DATA DIM_X 0x383866 EXTERN WORD IF_DATA MCMESS 0x383866 EXTERN /end MEASUREMENT
/begin MEASUREMENT sfpdveuw "Status Fehlerpfad: UMA-Wiederlernen" UWORD dez 1 100 0 65535 FUNCTION_LIST DFPM_DDVE IF_DATA DIM_X 0x383868 EXTERN WORD IF_DATA MCMESS 0x383868 EXTERN /end MEASUREMENT
/begin MEASUREMENT sfpdvev "Statuswort: DV-E Fehler bei Verstärkerabgleich" UWORD dez 1 100 0 65535 FUNCTION_LIST DFPM_DDVE IF_DATA DIM_X 0x38386A EXTERN WORD IF_DATA MCMESS 0x38386A EXTERN /end MEASUREMENT
/begin MEASUREMENT sfpegfe "Status Fehlerpfad: Diagose der Eingangsgrößen der Füllungserfassung" UWORD dez 1 100 0 65535 FUNCTION_LIST DFPM_EGFE IF_DATA DIM_X 0x38386C EXTERN WORD IF_DATA MCMESS 0x38386C EXTERN /end MEASUREMENT
/begin MEASUREMENT sfpev1 "Status Fehlerpfad: EV1" UWORD default 1 100 0 65535 FUNCTION_LIST DFPM_DEKON IF_DATA DIM_X 0x38386E EXTERN WORD IF_DATA MCMESS 0x38386E EXTERN /end MEASUREMENT
/begin MEASUREMENT sfpev2 "Status Fehlerpfad: EV2" UWORD default 1 100 0 65535 FUNCTION_LIST DFPM_DEKON IF_DATA DIM_X 0x383870 EXTERN WORD IF_DATA MCMESS 0x383870 EXTERN /end MEASUREMENT
/begin MEASUREMENT sfpev3 "Status Fehlerpfad: EV3" UWORD default 1 100 0 65535 FUNCTION_LIST DFPM_DEKON IF_DATA DIM_X 0x383872 EXTERN WORD IF_DATA MCMESS 0x383872 EXTERN /end MEASUREMENT
/begin MEASUREMENT sfpev4 "Status Fehlerpfad: EV4" UWORD default 1 100 0 65535 FUNCTION_LIST DFPM_DEKON IF_DATA DIM_X 0x383874 EXTERN WORD IF_DATA MCMESS 0x383874 EXTERN /end MEASUREMENT
/begin MEASUREMENT sfpev5 "Status Fehlerpfad: EV5" UWORD default 1 100 0 65535 FUNCTION_LIST DFPM_DEKON IF_DATA DIM_X 0x383876 EXTERN WORD IF_DATA MCMESS 0x383876 EXTERN /end MEASUREMENT
/begin MEASUREMENT sfpev6 "Status Fehlerpfad: EV6" UWORD default 1 100 0 65535 FUNCTION_LIST DFPM_DEKON IF_DATA DIM_X 0x383878 EXTERN WORD IF_DATA MCMESS 0x383878 EXTERN /end MEASUREMENT
/begin MEASUREMENT sfpfgrl "Status Fehlerpfad: Diagnose FGR-Lampe über CAN" UWORD dez 1 100 0 65535 FUNCTION_LIST DFPM_DCFGRL IF_DATA DIM_X 0x38387A EXTERN WORD IF_DATA MCMESS 0x38387A EXTERN /end MEASUREMENT
/begin MEASUREMENT sfpfp1p "Status Fehlerpfad: Fahrpedal 1.Potentiometer" UWORD dez 1 100 0 65535 FUNCTION_LIST DFPM_GGPED IF_DATA DIM_X 0x38387C EXTERN WORD IF_DATA MCMESS 0x38387C EXTERN /end MEASUREMENT
/begin MEASUREMENT sfpfp2p "Status Fehlerpfad: Fahrpedal 2.Potentiometer" UWORD dez 1 100 0 65535 FUNCTION_LIST DFPM_GGPED IF_DATA DIM_X 0x38387E EXTERN WORD IF_DATA MCMESS 0x38387E EXTERN /end MEASUREMENT
/begin MEASUREMENT sfpfpp "Status Fehlerpfad: Fahrpedal Potentiometer" UWORD dez 1 100 0 65535 FUNCTION_LIST DFPM_GGPED IF_DATA DIM_X 0x383880 EXTERN WORD IF_DATA MCMESS 0x383880 EXTERN /end MEASUREMENT
/begin MEASUREMENT sfpfrao "Status Fehlerpfad: LR-Adaption oberer multiplikativer Bereich" UWORD dez 1 100 0 65535 FUNCTION_LIST DFPM_DKVS IF_DATA DIM_X 0x383882 EXTERN WORD IF_DATA MCMESS 0x383882 EXTERN /end MEASUREMENT
/begin MEASUREMENT sfpfrao2 "Status Fehlerpfad: LR Adaption oberer multiplikativer Bereich (Bank2)" UWORD dez 1 100 0 65535 FUNCTION_LIST DFPM_DKVS IF_DATA DIM_X 0x383884 EXTERN WORD IF_DATA MCMESS 0x383884 EXTERN /end MEASUREMENT
/begin MEASUREMENT sfpfrau "Status Fehlerpfad: LR Adaption unterer multiplikativer Bereich" UWORD dez 1 100 0 65535 FUNCTION_LIST DFPM_DKVS IF_DATA DIM_X 0x383886 EXTERN WORD IF_DATA MCMESS 0x383886 EXTERN /end MEASUREMENT
/begin MEASUREMENT sfpfrau2 "Status Fehlerpfad: LR Adaption unterer multiplikativer Bereich (Bank2)" UWORD dez 1 100 0 65535 FUNCTION_LIST DFPM_DKVS IF_DATA DIM_X 0x383888 EXTERN WORD IF_DATA MCMESS 0x383888 EXTERN /end MEASUREMENT
/begin MEASUREMENT sfpfrst "Status Fehlerpfad: LR-Abweichung" UWORD dez 1 100 0 65535 FUNCTION_LIST DFPM_DKVS IF_DATA DIM_X 0x38388A EXTERN WORD IF_DATA MCMESS 0x38388A EXTERN /end MEASUREMENT
/begin MEASUREMENT sfpfrst2 "Status Fehlerpfad: LR-Abweichung Bank 2" UWORD dez 1 100 0 65535 FUNCTION_LIST DFPM_DKVS IF_DATA DIM_X 0x38388C EXTERN WORD IF_DATA MCMESS 0x38388C EXTERN /end MEASUREMENT
/begin MEASUREMENT sfphsh "Status Fehlerpfad: Heizung Lambdasonde hinter Kat" UWORD dez 1 100 0 65535 FUNCTION_LIST DFPM_DHLSHK IF_DATA DIM_X 0x38388E EXTERN WORD IF_DATA MCMESS 0x38388E EXTERN /end MEASUREMENT
/begin MEASUREMENT sfphsh2 "Status Fehlerpfad: Heizung Lambdasonde 2 hinter Kat" UWORD dez 1 100 0 65535 FUNCTION_LIST DFPM_DHLSHK IF_DATA DIM_X 0x383890 EXTERN WORD IF_DATA MCMESS 0x383890 EXTERN /end MEASUREMENT
/begin MEASUREMENT sfphshe "Status Fehlerpfad: Endstufe Heizung Lambdasonde hinter Kat" UWORD default 1 100 0 65535 FUNCTION_LIST DFPM_DEKON IF_DATA DIM_X 0x383892 EXTERN WORD IF_DATA MCMESS 0x383892 EXTERN /end MEASUREMENT
/begin MEASUREMENT sfphshe2 "Status Fehlerpfad: Endstufe Heizung Lambdasonde 2 hinter Kat" UWORD default 1 100 0 65535 FUNCTION_LIST DFPM_DEKON IF_DATA DIM_X 0x383894 EXTERN WORD IF_DATA MCMESS 0x383894 EXTERN /end MEASUREMENT
/begin MEASUREMENT sfphsv "Status Fehlerpfad: Heizung Lambdasonde vor Kat" UWORD dez 1 100 0 65535 FUNCTION_LIST DFPM_DHLSU IF_DATA DIM_X 0x383896 EXTERN WORD IF_DATA MCMESS 0x383896 EXTERN /end MEASUREMENT
/begin MEASUREMENT sfphsv2 "Status Fehlerpfad: Heizung Lambdasonde 2 vor Kat" UWORD dez 1 100 0 65535 FUNCTION_LIST DFPM_DHLSU IF_DATA DIM_X 0x383898 EXTERN WORD IF_DATA MCMESS 0x383898 EXTERN /end MEASUREMENT
/begin MEASUREMENT sfphsvsa "Status Fehlerpfad: Heizung Lambdasonde vor Kat" UWORD dez 1 100 0 65535 FUNCTION_LIST DFPM_DHLSU IF_DATA DIM_X 0x38389A EXTERN WORD IF_DATA MCMESS 0x38389A EXTERN /end MEASUREMENT
/begin MEASUREMENT sfphsvsa2 "Status Fehlerpfad: Heizung Lambdasonde 2 vor Kat" UWORD dez 1 100 0 65535 FUNCTION_LIST DFPM_DHLSU IF_DATA DIM_X 0x38389C EXTERN WORD IF_DATA MCMESS 0x38389C EXTERN /end MEASUREMENT
/begin MEASUREMENT sfpkat "Status Fehlerpfad: Katalysator-Überwachung" UWORD dez 1 100 0 65535 FUNCTION_LIST DFPM_DKAT IF_DATA DIM_X 0x38389E EXTERN WORD IF_DATA MCMESS 0x38389E EXTERN /end MEASUREMENT
/begin MEASUREMENT sfpkat2 "Status Fehlerpfad: Katalysator-Überwachung Bank 2" UWORD dez 1 100 0 65535 FUNCTION_LIST DFPM_DKAT IF_DATA DIM_X 0x3838A0 EXTERN WORD IF_DATA MCMESS 0x3838A0 EXTERN /end MEASUREMENT
/begin MEASUREMENT sfpkos "Status Fehlerpfad: Klimakompressorsteuerung" UWORD default 1 100 0 65535 FUNCTION_LIST DFPM_DEKON IF_DATA DIM_X 0x3838A2 EXTERN WORD IF_DATA MCMESS 0x3838A2 EXTERN /end MEASUREMENT
/begin MEASUREMENT sfpkpe "Status Fehlerpfad: EKP-Relais Endstufe" UWORD default 1 100 0 65535 FUNCTION_LIST DFPM_DEKON IF_DATA DIM_X 0x3838A4 EXTERN WORD IF_DATA MCMESS 0x3838A4 EXTERN /end MEASUREMENT
/begin MEASUREMENT sfpkrnt "Status Fehlerpfad: Klopfregelung Nulltest" UWORD dez 1 100 0 65535 FUNCTION_LIST DFPM_DKRNT IF_DATA DIM_X 0x3838A6 EXTERN WORD IF_DATA MCMESS 0x3838A6 EXTERN /end MEASUREMENT
/begin MEASUREMENT sfpkrof "Status Fehlerpfad: Klopfregelung Offset" UWORD dez 1 100 0 65535 FUNCTION_LIST DFPM_DKRNT IF_DATA DIM_X 0x3838A8 EXTERN WORD IF_DATA MCMESS 0x3838A8 EXTERN /end MEASUREMENT
/begin MEASUREMENT sfpkrtp "Status Fehlerpfad: Klopfregelung Testimpuls" UWORD dez 1 100 0 65535 FUNCTION_LIST DFPM_DKRTP IF_DATA DIM_X 0x3838AA EXTERN WORD IF_DATA MCMESS 0x3838AA EXTERN /end MEASUREMENT
/begin MEASUREMENT sfpks1 "Status Fehlerpfad: Klopfsensor 1" UWORD dez 1 100 0 65535 FUNCTION_LIST DFPM_DKRS IF_DATA DIM_X 0x3838AC EXTERN WORD IF_DATA MCMESS 0x3838AC EXTERN /end MEASUREMENT
/begin MEASUREMENT sfpks2 "Status Fehlerpfad: Klopfsensor 2" UWORD dez 1 100 0 65535 FUNCTION_LIST DFPM_DKRS IF_DATA DIM_X 0x3838AE EXTERN WORD IF_DATA MCMESS 0x3838AE EXTERN /end MEASUREMENT
/begin MEASUREMENT sfpks3 "Status Fehlerpfad: Klopfsensor 3" UWORD dez 1 100 0 65535 FUNCTION_LIST DFPM_DKRS IF_DATA DIM_X 0x3838B0 EXTERN WORD IF_DATA MCMESS 0x3838B0 EXTERN /end MEASUREMENT
/begin MEASUREMENT sfpks4 "Status Fehlerpfad: Klopfsensor 4" UWORD dez 1 100 0 65535 FUNCTION_LIST DFPM_DKRS IF_DATA DIM_X 0x3838B2 EXTERN WORD IF_DATA MCMESS 0x3838B2 EXTERN /end MEASUREMENT
/begin MEASUREMENT sfpkuppl "Status Fehlerpfad KUPPL: Gebergröße Kupplung" UWORD dez 1 100 0 65535 FUNCTION_LIST DFPM_DKUPPL IF_DATA DIM_X 0x3838B4 EXTERN WORD IF_DATA MCMESS 0x3838B4 EXTERN /end MEASUREMENT
/begin MEASUREMENT sfpkwave "Status Fehlerpfad: Kühlwasserabsperrventil Endstufe" UWORD default 1 100 0 65535 FUNCTION_LIST DFPM_DEKON IF_DATA DIM_X 0x3838B6 EXTERN WORD IF_DATA MCMESS 0x3838B6 EXTERN /end MEASUREMENT
/begin MEASUREMENT sfplash "Status Fehlerpfad: Lambdasondenalterung hinter Kat" UWORD dez 1 100 0 65535 FUNCTION_LIST DFPM_DLSAHK IF_DATA DIM_X 0x3838B8 EXTERN WORD IF_DATA MCMESS 0x3838B8 EXTERN /end MEASUREMENT
/begin MEASUREMENT sfplash2 "Status Fehlerpfad: Lambdasondenalterung hinter Kat Bank2" UWORD dez 1 100 0 65535 FUNCTION_LIST DFPM_DLSAHK IF_DATA DIM_X 0x3838BA EXTERN WORD IF_DATA MCMESS 0x3838BA EXTERN /end MEASUREMENT
/begin MEASUREMENT sfplde "Status Fehlerpfad: Ladedrucksteuerventil Endstufe" UWORD default 1 100 0 65535 FUNCTION_LIST DFPM_DEKON IF_DATA DIM_X 0x3838BC EXTERN WORD IF_DATA MCMESS 0x3838BC EXTERN /end MEASUREMENT
/begin MEASUREMENT sfpldo "Status Fehlerpfad: Überladefehler LDR" UWORD dez 1 100 0 65535 FUNCTION_LIST DFPM_DLDR IF_DATA DIM_X 0x3838BE EXTERN WORD IF_DATA MCMESS 0x3838BE EXTERN /end MEASUREMENT
/begin MEASUREMENT sfpldra "Status Fehlerpfad: Regelabweichung LDR" UWORD dez 1 100 0 65535 FUNCTION_LIST DFPM_DLDR IF_DATA DIM_X 0x3838C0 EXTERN WORD IF_DATA MCMESS 0x3838C0 EXTERN /end MEASUREMENT
/begin MEASUREMENT sfplf1e "Status Fehlerpfad: Lüfter1 Endstufe" UWORD default 1 100 0 65535 FUNCTION_LIST DFPM_DEKON IF_DATA DIM_X 0x3838C2 EXTERN WORD IF_DATA MCMESS 0x3838C2 EXTERN /end MEASUREMENT
/begin MEASUREMENT sfplf2e "Status Fehlerpfad: Lüfter2 Endstufe" UWORD default 1 100 0 65535 FUNCTION_LIST DFPM_DEKON IF_DATA DIM_X 0x3838C4 EXTERN WORD IF_DATA MCMESS 0x3838C4 EXTERN /end MEASUREMENT
/begin MEASUREMENT sfplf3e "Status Fehlerpfad: Lüfter3 Endstufe" UWORD default 1 100 0 65535 FUNCTION_LIST DFPM_DEKON IF_DATA DIM_X 0x3838C6 EXTERN WORD IF_DATA MCMESS 0x3838C6 EXTERN /end MEASUREMENT
/begin MEASUREMENT sfpllr "Status Fehlerpfad: Leerlaufregelung" UWORD dez 1 100 0 65535 FUNCTION_LIST DFPM_DLLR IF_DATA DIM_X 0x3838C8 EXTERN WORD IF_DATA MCMESS 0x3838C8 EXTERN /end MEASUREMENT
/begin MEASUREMENT sfplm "Status Fehlerpfad: Hauptfüllungssensor" UWORD dez 1 100 0 65535 FUNCTION_LIST DFPM_DHFM IF_DATA DIM_X 0x3838CA EXTERN WORD IF_DATA MCMESS 0x3838CA EXTERN /end MEASUREMENT
/begin MEASUREMENT sfplsh "Status Fehlerpfad: Diagnose Lambdasonde hinter Kat" UWORD dez 1 100 0 65535 FUNCTION_LIST DFPM_DLSH IF_DATA DIM_X 0x3838CC EXTERN WORD IF_DATA MCMESS 0x3838CC EXTERN /end MEASUREMENT
/begin MEASUREMENT sfplsh2 "Status Fehlerpfad: Diagnose Lambdasonde hinter Kat Bank2" UWORD dez 1 100 0 65535 FUNCTION_LIST DFPM_DLSH IF_DATA DIM_X 0x3838CE EXTERN WORD IF_DATA MCMESS 0x3838CE EXTERN /end MEASUREMENT
/begin MEASUREMENT sfplsv "Status Fehlerpfad: Diagnose Lambdasonde vor Kat" UWORD dez 1 100 0 65535 FUNCTION_LIST DFPM_DLSU IF_DATA DIM_X 0x3838D0 EXTERN WORD IF_DATA MCMESS 0x3838D0 EXTERN /end MEASUREMENT
/begin MEASUREMENT sfplsv2 "Status Fehlerpfad: Diagnose Lambdasonde vor Kat Bank2" UWORD dez 1 100 0 65535 FUNCTION_LIST DFPM_DLSU IF_DATA DIM_X 0x3838D2 EXTERN WORD IF_DATA MCMESS 0x3838D2 EXTERN /end MEASUREMENT
/begin MEASUREMENT sfplsvv "Status Fehlerpfad: Diagnose Lambdasonde vertauscht vor Kat" UWORD dez 1 100 0 65535 FUNCTION_LIST DFPM_LSVV IF_DATA DIM_X 0x3838D4 EXTERN WORD IF_DATA MCMESS 0x3838D4 EXTERN /end MEASUREMENT
/begin MEASUREMENT sfpmd "Statuswort:  Aussetzer, Summenfehler (multiple)" UWORD dez 1 100 0 65535 FUNCTION_LIST DFPM_DMDMIL IF_DATA DIM_X 0x3838D6 EXTERN WORD IF_DATA MCMESS 0x3838D6 EXTERN /end MEASUREMENT
/begin MEASUREMENT sfpmd00 "Statuswort:  Aussetzer Zündung 0" UWORD dez 1 100 0 65535 FUNCTION_LIST DFPM_DMDMIL IF_DATA DIM_X 0x3838D8 EXTERN WORD IF_DATA MCMESS 0x3838D8 EXTERN /end MEASUREMENT
/begin MEASUREMENT sfpmd01 "Statuswort:  Aussetzer Zündung 1" UWORD dez 1 100 0 65535 FUNCTION_LIST DFPM_DMDMIL IF_DATA DIM_X 0x3838DA EXTERN WORD IF_DATA MCMESS 0x3838DA EXTERN /end MEASUREMENT
/begin MEASUREMENT sfpmd02 "Statuswort:  Aussetzer Zündung 2" UWORD dez 1 100 0 65535 FUNCTION_LIST DFPM_DMDMIL IF_DATA DIM_X 0x3838DC EXTERN WORD IF_DATA MCMESS 0x3838DC EXTERN /end MEASUREMENT
/begin MEASUREMENT sfpmd03 "Statuswort:  Aussetzer Zündung 3" UWORD dez 1 100 0 65535 FUNCTION_LIST DFPM_DMDMIL IF_DATA DIM_X 0x3838DE EXTERN WORD IF_DATA MCMESS 0x3838DE EXTERN /end MEASUREMENT
/begin MEASUREMENT sfpmd04 "Statuswort:  Aussetzer Zündung 4" UWORD dez 1 100 0 65535 FUNCTION_LIST DFPM_DMDMIL IF_DATA DIM_X 0x3838E0 EXTERN WORD IF_DATA MCMESS 0x3838E0 EXTERN /end MEASUREMENT
/begin MEASUREMENT sfpmd05 "Statuswort:  Aussetzer Zündung 5" UWORD dez 1 100 0 65535 FUNCTION_LIST DFPM_DMDMIL IF_DATA DIM_X 0x3838E2 EXTERN WORD IF_DATA MCMESS 0x3838E2 EXTERN /end MEASUREMENT
/begin MEASUREMENT sfpmdb "Status Fehlerpfad: Momentanüberwachung begrenzt dauerhaft" UWORD dez 1 100 0 65535 FUNCTION_LIST DFPM_MDKOG IF_DATA DIM_X 0x3838E4 EXTERN WORD IF_DATA MCMESS 0x3838E4 EXTERN /end MEASUREMENT
/begin MEASUREMENT sfpmsg "Status Fehlerpfad: Motorraumspülgebläse" UWORD dez 1 100 0 65535 FUNCTION_LIST DFPM_MLS IF_DATA DIM_X 0x3838E6 EXTERN WORD IF_DATA MCMESS 0x3838E6 EXTERN /end MEASUREMENT
/begin MEASUREMENT sfpmsge "Status Fehlerpfad: Motorraumspülgebläse Endstufe" UWORD default 1 100 0 65535 FUNCTION_LIST DFPM_DEKON IF_DATA DIM_X 0x3838E8 EXTERN WORD IF_DATA MCMESS 0x3838E8 EXTERN /end MEASUREMENT
/begin MEASUREMENT sfpn "Status Fehlerpfad: Drehzahlgeber" UWORD dez 1 100 0 65535 FUNCTION_LIST DFPM_DDG IF_DATA DIM_X 0x3838EA EXTERN WORD IF_DATA MCMESS 0x3838EA EXTERN /end MEASUREMENT
/begin MEASUREMENT sfpnwkw "Status Fehlerpfad: Zuordnung Nockenwelle zu Kurbelwelle" UWORD default 1 100 0 65535 FUNCTION_LIST DFPM_DNWKW IF_DATA DIM_X 0x3838EC EXTERN WORD IF_DATA MCMESS 0x3838EC EXTERN /end MEASUREMENT
/begin MEASUREMENT sfpnwkw2 "Status Fehlerpfad: Zuordnung Nockenwelle 2 zu Kurbelwelle" UWORD default 1 100 0 65535 FUNCTION_LIST DFPM_DNWKW IF_DATA DIM_X 0x3838EE EXTERN WORD IF_DATA MCMESS 0x3838EE EXTERN /end MEASUREMENT
/begin MEASUREMENT sfpnws "Status Fehlerpfad: Nockenwellensteuerung" UWORD dez 1 100 0 65535 FUNCTION_LIST DFPM_DNWS IF_DATA DIM_X 0x3838F0 EXTERN WORD IF_DATA MCMESS 0x3838F0 EXTERN /end MEASUREMENT
/begin MEASUREMENT sfpnws2 "Status Fehlerpfad: Nockenwellensteuerung Bank 2" UWORD dez 1 100 0 65535 FUNCTION_LIST DFPM_DNWS IF_DATA DIM_X 0x3838F2 EXTERN WORD IF_DATA MCMESS 0x3838F2 EXTERN /end MEASUREMENT
/begin MEASUREMENT sfpnwse "Status Fehlerpfad: Nockenwellensteuerungsventil Endstufe" UWORD default 1 100 0 65535 FUNCTION_LIST DFPM_DEKON IF_DATA DIM_X 0x3838F4 EXTERN WORD IF_DATA MCMESS 0x3838F4 EXTERN /end MEASUREMENT
/begin MEASUREMENT sfpnwse2 "Status Fehlerpfad: Nockenwellensteuerung Bank2 Endstufe" UWORD default 1 100 0 65535 FUNCTION_LIST DFPM_DEKON IF_DATA DIM_X 0x3838F6 EXTERN WORD IF_DATA MCMESS 0x3838F6 EXTERN /end MEASUREMENT
/begin MEASUREMENT sfpph "Status Fehlerpfad: Phasengeber" UWORD dez 1 100 0 65535 FUNCTION_LIST DFPM_DPH IF_DATA DIM_X 0x3838F8 EXTERN WORD IF_DATA MCMESS 0x3838F8 EXTERN /end MEASUREMENT
/begin MEASUREMENT sfpph2 "Status Fehlerpfad: Phasengeber Bank 2" UWORD dez 1 100 0 65535 FUNCTION_LIST DFPM_DPH IF_DATA DIM_X 0x3838FA EXTERN WORD IF_DATA MCMESS 0x3838FA EXTERN /end MEASUREMENT
/begin MEASUREMENT sfprkat "Status Fehlerpfad: LR Adaption additive Korrektur pro Zeit" UWORD dez 1 100 0 65535 FUNCTION_LIST DFPM_DKVS IF_DATA DIM_X 0x3838FC EXTERN WORD IF_DATA MCMESS 0x3838FC EXTERN /end MEASUREMENT
/begin MEASUREMENT sfprkat2 "Status Fehlerpfad: LR Adaption additive Korrektur pro Zeit (Bank 2)" UWORD dez 1 100 0 65535 FUNCTION_LIST DFPM_DKVS IF_DATA DIM_X 0x3838FE EXTERN WORD IF_DATA MCMESS 0x3838FE EXTERN /end MEASUREMENT
/begin MEASUREMENT sfprkaz "Status Fehlerpfad: LR Adaption additive Korrektur pro Zündung" UWORD dez 1 100 0 65535 FUNCTION_LIST DFPM_DKVS IF_DATA DIM_X 0x383900 EXTERN WORD IF_DATA MCMESS 0x383900 EXTERN /end MEASUREMENT
/begin MEASUREMENT sfprkaz2 "Status Fehlerpfad: LR Adaption additive Korrektur pro Zündung (Bank 2)" UWORD dez 1 100 0 65535 FUNCTION_LIST DFPM_DKVS IF_DATA DIM_X 0x383902 EXTERN WORD IF_DATA MCMESS 0x383902 EXTERN /end MEASUREMENT
/begin MEASUREMENT sfpsgeep "Status Fehlerpfad: Steuergerät defekt (EEPROM)" UWORD default 1 100 0 65535 FUNCTION_LIST DFPM_DSGEEP IF_DATA DIM_X 0x383904 EXTERN WORD IF_DATA MCMESS 0x383904 EXTERN /end MEASUREMENT
/begin MEASUREMENT sfpslpe "Status Fehlerpfad: Sekundärluftpumpe Endstufe" UWORD default 1 100 0 65535 FUNCTION_LIST DFPM_DEKON IF_DATA DIM_X 0x383906 EXTERN WORD IF_DATA MCMESS 0x383906 EXTERN /end MEASUREMENT
/begin MEASUREMENT sfpsls "Status Fehlerpfad: Diagnose Sekundärluftsystem" UWORD dez 1 100 0 65535 FUNCTION_LIST DFPM_DSLSLRS IF_DATA DIM_X 0x383908 EXTERN WORD IF_DATA MCMESS 0x383908 EXTERN /end MEASUREMENT
/begin MEASUREMENT sfpsls2 "Status Fehlerpfad: Diagnose Sekundärluftsystem, Bank 2" UWORD dez 1 100 0 65535 FUNCTION_LIST DFPM_DSLSLRS IF_DATA DIM_X 0x38390A EXTERN WORD IF_DATA MCMESS 0x38390A EXTERN /end MEASUREMENT
/begin MEASUREMENT sfpslv "Status Fehlerpfad: Diagnose Sekundärluftventil" UWORD dez 1 100 0 65535 FUNCTION_LIST DFPM_DSLSLRS IF_DATA DIM_X 0x38390C EXTERN WORD IF_DATA MCMESS 0x38390C EXTERN /end MEASUREMENT
/begin MEASUREMENT sfpslv2 "Status Fehlerpfad: Diagnose Sekundärluftventil, Bank 2" UWORD dez 1 100 0 65535 FUNCTION_LIST DFPM_DSLSLRS IF_DATA DIM_X 0x38390E EXTERN WORD IF_DATA MCMESS 0x38390E EXTERN /end MEASUREMENT
/begin MEASUREMENT sfpslve "Status Fehlerpfad: Sekundärluftventil Endstufe" UWORD default 1 100 0 65535 FUNCTION_LIST DFPM_DEKON IF_DATA DIM_X 0x383910 EXTERN WORD IF_DATA MCMESS 0x383910 EXTERN /end MEASUREMENT
/begin MEASUREMENT sfpswe "Status Fehlerpfad: Schlechtwegerkennung" UWORD dez 1 100 0 65535 FUNCTION_LIST DFPM_BGRBS IF_DATA DIM_X 0x383912 EXTERN WORD IF_DATA MCMESS 0x383912 EXTERN /end MEASUREMENT
/begin MEASUREMENT sfpta "Status Fehlerpfad: Ansauglufttemperatur (Ladeluft-) TANS" UWORD dez 1 100 0 65535 FUNCTION_LIST DFPM_GGTFA IF_DATA DIM_X 0x383914 EXTERN WORD IF_DATA MCMESS 0x383914 EXTERN /end MEASUREMENT
/begin MEASUREMENT sfptes "Status Fehlerpfad: Tankdiagnose, TEV defekt offen" UWORD default 1 100 0 65535 FUNCTION_LIST DFPM_DTEV IF_DATA DIM_X 0x383916 EXTERN WORD IF_DATA MCMESS 0x383916 EXTERN /end MEASUREMENT
/begin MEASUREMENT sfpteve "Status Fehlerpfad: Tanklüftungsventil Endstufe" UWORD default 1 100 0 65535 FUNCTION_LIST DFPM_DEKON IF_DATA DIM_X 0x383918 EXTERN WORD IF_DATA MCMESS 0x383918 EXTERN /end MEASUREMENT
/begin MEASUREMENT sfpteve2 "Status Fehlerpfad: Tanklüftungsventil Endstufe Bank 2" UWORD dez 1 100 0 65535 FUNCTION_LIST DFPM_DUMMY043 IF_DATA DIM_X 0x38391A EXTERN WORD IF_DATA MCMESS 0x38391A EXTERN /end MEASUREMENT
/begin MEASUREMENT sfptget "Status Fehlerpfad: Getriebetemperatur TGET" UWORD default 1 100 0 65535 FUNCTION_LIST DFPM_GGTGET IF_DATA DIM_X 0x38391C EXTERN WORD IF_DATA MCMESS 0x38391C EXTERN /end MEASUREMENT
/begin MEASUREMENT sfpthm "Status Fehlerpfad: Thermostat Motor(-Kühlung) THM" UWORD default 1 100 0 65535 FUNCTION_LIST DFPM_GGTFM IF_DATA DIM_X 0x38391E EXTERN WORD IF_DATA MCMESS 0x38391E EXTERN /end MEASUREMENT
/begin MEASUREMENT sfptm "Status Fehlerpfad: Motortemperatur TMOT" UWORD dez 1 100 0 65535 FUNCTION_LIST DFPM_GGTFM IF_DATA DIM_X 0x383920 EXTERN WORD IF_DATA MCMESS 0x383920 EXTERN /end MEASUREMENT
/begin MEASUREMENT sfptmki "Status Fehlerpfad: Motortemperatur aus Kombiinstrument TMKI" UWORD default 1 100 0 65535 FUNCTION_LIST DFPM_DUMMY043 IF_DATA DIM_X 0x383922 EXTERN WORD IF_DATA MCMESS 0x383922 EXTERN /end MEASUREMENT
/begin MEASUREMENT sfptmr "Status Fehlerpfad: Motorraumtemperatur TMR" UWORD default 1 100 0 65535 FUNCTION_LIST DFPM_GGTFMR IF_DATA DIM_X 0x383924 EXTERN WORD IF_DATA MCMESS 0x383924 EXTERN /end MEASUREMENT
/begin MEASUREMENT sfptol "Status Fehlerpfad: (Motor-) Oeltemperatur TOL" UWORD dez 1 100 0 65535 FUNCTION_LIST DFPM_GGTFOL IF_DATA DIM_X 0x383926 EXTERN WORD IF_DATA MCMESS 0x383926 EXTERN /end MEASUREMENT
/begin MEASUREMENT sfptum "Status Fehlerpfad: Umgebungstemperatur TUM" UWORD dez 1 100 0 65535 FUNCTION_LIST DFPM_GGTFUMG IF_DATA DIM_X 0x383928 EXTERN WORD IF_DATA MCMESS 0x383928 EXTERN /end MEASUREMENT
/begin MEASUREMENT sfpub "Status Fehlerpfad: Batteriespannung UB (Bordnetz)" UWORD dez 1 100 0 65535 FUNCTION_LIST DFPM_GGUB IF_DATA DIM_X 0x38392A EXTERN WORD IF_DATA MCMESS 0x38392A EXTERN /end MEASUREMENT
/begin MEASUREMENT sfpufmv "Statuswort: Funktionsüberwachung: Momentenvergleich" UWORD dez 1 100 0 65535 FUNCTION_LIST DFPM_DUF IF_DATA DIM_X 0x38392C EXTERN WORD IF_DATA MCMESS 0x38392C EXTERN /end MEASUREMENT
/begin MEASUREMENT sfpufska "Statuswort: Funktionsüberwachung: Sicherheits-Kraftstoff-Abschaltung" UWORD dez 1 100 0 65535 FUNCTION_LIST DFPM_DUF IF_DATA DIM_X 0x38392E EXTERN WORD IF_DATA MCMESS 0x38392E EXTERN /end MEASUREMENT
/begin MEASUREMENT sfpurram "Statuswort: Rechnerüberwachung: RAM" UWORD dez 1 100 0 65535 FUNCTION_LIST DFPM_DUR IF_DATA DIM_X 0x383930 EXTERN WORD IF_DATA MCMESS 0x383930 EXTERN /end MEASUREMENT
/begin MEASUREMENT sfpurrom "Statuswort: Rechnerüberwachung: ROM" UWORD dez 1 100 0 65535 FUNCTION_LIST DFPM_DUR IF_DATA DIM_X 0x383932 EXTERN WORD IF_DATA MCMESS 0x383932 EXTERN /end MEASUREMENT
/begin MEASUREMENT sfpurrst "Statuswort: Rechnerüberwachung: Reset" UWORD dez 1 100 0 65535 FUNCTION_LIST DFPM_DUR IF_DATA DIM_X 0x383934 EXTERN WORD IF_DATA MCMESS 0x383934 EXTERN /end MEASUREMENT
/begin MEASUREMENT sfpuvse "Status Fehlerpfad: Endstufe Umluftventil Turbo" UWORD default 1 100 0 65535 FUNCTION_LIST DFPM_DEKON IF_DATA DIM_X 0x383936 EXTERN WORD IF_DATA MCMESS 0x383936 EXTERN /end MEASUREMENT
/begin MEASUREMENT sfpvfz "Status Fehlerpfad: Fahrzeuggeschwindigkeit" UWORD dez 1 100 0 65535 FUNCTION_LIST DFPM_DVFZ IF_DATA DIM_X 0x383938 EXTERN WORD IF_DATA MCMESS 0x383938 EXTERN /end MEASUREMENT
/begin MEASUREMENT sfpvs01 "Status Fehlerpfad: Ventilhubsteuerung Zdg.1" UWORD dez 1 100 0 65535 FUNCTION_LIST DFPM_DVS IF_DATA DIM_X 0x38393A EXTERN WORD IF_DATA MCMESS 0x38393A EXTERN /end MEASUREMENT
/begin MEASUREMENT sfpvs02 "Status Fehlerpfad: Ventilhubsteuerung Zdg.2" UWORD dez 1 100 0 65535 FUNCTION_LIST DFPM_DVS IF_DATA DIM_X 0x38393C EXTERN WORD IF_DATA MCMESS 0x38393C EXTERN /end MEASUREMENT
/begin MEASUREMENT sfpvs03 "Status Fehlerpfad: Ventilhubsteuerung Zdg.3" UWORD dez 1 100 0 65535 FUNCTION_LIST DFPM_DVS IF_DATA DIM_X 0x38393E EXTERN WORD IF_DATA MCMESS 0x38393E EXTERN /end MEASUREMENT
/begin MEASUREMENT sfpvs04 "Status Fehlerpfad: Ventilhubsteuerung Zdg.4" UWORD dez 1 100 0 65535 FUNCTION_LIST DFPM_DVS IF_DATA DIM_X 0x383940 EXTERN WORD IF_DATA MCMESS 0x383940 EXTERN /end MEASUREMENT
/begin MEASUREMENT sfpvs05 "Status Fehlerpfad: Ventilhubsteuerung Zdg.5" UWORD dez 1 100 0 65535 FUNCTION_LIST DFPM_DVS IF_DATA DIM_X 0x383942 EXTERN WORD IF_DATA MCMESS 0x383942 EXTERN /end MEASUREMENT
/begin MEASUREMENT sfpvs06 "Status Fehlerpfad: Ventilhubsteuerung Zdg.6" UWORD dez 1 100 0 65535 FUNCTION_LIST DFPM_DVS IF_DATA DIM_X 0x383944 EXTERN WORD IF_DATA MCMESS 0x383944 EXTERN /end MEASUREMENT
/begin MEASUREMENT sfpvs1e "Status Fehlerpfad: Endstufe Ventilhubsteuerung 1" UWORD default 1 100 0 65535 FUNCTION_LIST DFPM_DEKON IF_DATA DIM_X 0x383946 EXTERN WORD IF_DATA MCMESS 0x383946 EXTERN /end MEASUREMENT
/begin MEASUREMENT sfpvs2e "Status Fehlerpfad: Endstufe Ventilhubsteuerung 2" UWORD default 1 100 0 65535 FUNCTION_LIST DFPM_DEKON IF_DATA DIM_X 0x383948 EXTERN WORD IF_DATA MCMESS 0x383948 EXTERN /end MEASUREMENT
/begin MEASUREMENT sfpvsb1 "Status Fehlerpfad: Ventilhubsteuerung Bank1" UWORD dez 1 100 0 65535 FUNCTION_LIST DFPM_DVS IF_DATA DIM_X 0x38394A EXTERN WORD IF_DATA MCMESS 0x38394A EXTERN /end MEASUREMENT
/begin MEASUREMENT sfpvsb2 "Status Fehlerpfad: Ventilhubsteuerung Bank2" UWORD dez 1 100 0 65535 FUNCTION_LIST DFPM_DVS IF_DATA DIM_X 0x38394C EXTERN WORD IF_DATA MCMESS 0x38394C EXTERN /end MEASUREMENT
/begin MEASUREMENT sfpvss "Status Fehlerpfad: Ventilhubsteuerung Summenfehler" UWORD dez 1 100 0 65535 FUNCTION_LIST DFPM_DVS IF_DATA DIM_X 0x38394E EXTERN WORD IF_DATA MCMESS 0x38394E EXTERN /end MEASUREMENT
/begin MEASUREMENT sfpwfs "Status Fehlerpfad: Wegfahrsperre" UWORD dez 1 100 0 65535 FUNCTION_LIST DFPM_WFS IF_DATA DIM_X 0x383950 EXTERN WORD IF_DATA MCMESS 0x383950 EXTERN /end MEASUREMENT
/begin MEASUREMENT sfpzzz "Dummy: Tabellenende" UWORD dez 1 100 0 65535 FUNCTION_LIST DFPM_DFPM IF_DATA DIM_X 0x383952 EXTERN WORD IF_DATA MCMESS 0x383952 EXTERN /end MEASUREMENT
/begin MEASUREMENT sgaauBits "" UBYTE dez 1 100 0 255 FUNCTION_LIST SLS IF_DATA DIM_X 0x38091F EXTERN WORD IF_DATA MCMESS 0x38091F EXTERN /end MEASUREMENT
/begin MEASUREMENT sgaauLokBits "" UBYTE dez 1 100 0 255 FUNCTION_LIST SLS IF_DATA DIM_X 0x380920 EXTERN WORD IF_DATA MCMESS 0x380920 EXTERN /end MEASUREMENT
/begin MEASUREMENT skapfad "SKA-Pfad als Umweltbedingung für Funktionsüberwachungs-Diagnoseeintrag" UBYTE dez 1 100 0 255 FUNCTION_LIST DUF DFFT DFPM IF_DATA DIM_X 0x380C82 EXTERN WORD IF_DATA MCMESS 0x380C82 EXTERN /end MEASUREMENT
/begin MEASUREMENT slfoo "" SWORD dtsegn_b720divZyl 1 100 -120 119.996 FUNCTION_LIST DMDFON IF_DATA DIM_X 0x38168E EXTERN WORD IF_DATA MCMESS 0x38168E EXTERN /end MEASUREMENT
/begin MEASUREMENT slsninkr "Inkrementverfeinerung Schliessbeginnwinkel in 0.75 Grad" UBYTE dez 1 100 0 255 FUNCTION_LIST AZUE IF_DATA DIM_X 0xF8E6 INTERN WORD IF_DATA MCMESS 0xF8E6 INTERN /end MEASUREMENT
/begin MEASUREMENT slsninkr2 "Inkrementverfeinerung Schliessbeginnwinkel Überlappung nach Klopfen in 0,75 Grad" UBYTE dez 1 100 0 255 FUNCTION_LIST AZUE IF_DATA DIM_X 0xF8E7 INTERN WORD IF_DATA MCMESS 0xF8E7 INTERN /end MEASUREMENT
/begin MEASUREMENT slsninkr_r "Inkrementverfeinerung Schliessbeginnwinkel in 0.75 Grad abs. Winkel bzgl .TR0" UBYTE dez 1 100 0 255 FUNCTION_LIST AZUE IF_DATA DIM_X 0xF8E8 INTERN WORD IF_DATA MCMESS 0xF8E8 INTERN /end MEASUREMENT
/begin MEASUREMENT slsnzahn "Schliessbeginnwinkel in Zahnquantisierung 6 Grad" UBYTE dez 1 100 0 255 FUNCTION_LIST AZUE IF_DATA DIM_X 0xF8E9 INTERN WORD IF_DATA MCMESS 0xF8E9 INTERN /end MEASUREMENT
/begin MEASUREMENT slsnzahn2 "Schliessbeginnwinkel in Zahnquantisierung für Überlappung nach Klopfen 6 Grad" UBYTE dez 1 100 0 255 FUNCTION_LIST AZUE IF_DATA DIM_X 0xF8EA INTERN WORD IF_DATA MCMESS 0xF8EA INTERN /end MEASUREMENT
/begin MEASUREMENT slsnzahn_r "Schliessbeginnwinkel in Zahnquantisierung 6 Grad abs. Winkel bzgl. TR Zyl.0" UBYTE dez 1 100 0 255 FUNCTION_LIST AZUE IF_DATA DIM_X 0xF8EB INTERN WORD IF_DATA MCMESS 0xF8EB INTERN /end MEASUREMENT
/begin MEASUREMENT sn2zkvek "Nächster zu schließender Zündkreis 2tes Schließereignis" UWORD dez 1 100 0 65535 FUNCTION_LIST AZUE IF_DATA DIM_X 0xF8FC INTERN WORD IF_DATA MCMESS 0xF8FC INTERN /end MEASUREMENT
/begin MEASUREMENT snobm "Summierer für nicht gefundene Bezugsmarken im Start" UBYTE dez 1 100 0 255 FUNCTION_LIST DDG IF_DATA DIM_X 0x382FDA EXTERN WORD IF_DATA MCMESS 0x382FDA EXTERN /end MEASUREMENT
/begin MEASUREMENT snzkvek "Nächster zu schließender Zündkreis" UWORD dez 1 100 0 65535 FUNCTION_LIST AZUE IF_DATA DIM_X 0xF8FE INTERN WORD IF_DATA MCMESS 0xF8FE INTERN /end MEASUREMENT
/begin MEASUREMENT sp1p_a_um "10ms alter Wert f. Sollwert-Poti 1 (PWG) vom Überwachungsmodul für den ADC-Test" UBYTE spg_ub_q0p019 1 100 0 4.98047 FUNCTION_LIST URADCC IF_DATA DIM_X 0x382E83 EXTERN WORD IF_DATA MCMESS 0x382E83 EXTERN /end MEASUREMENT
/begin MEASUREMENT sp1p_st_um "Stationärzähler für Sollwertpoti 1 vom Überwachungsmodul" UBYTE t10msxs_ub_b2p55 1 100 0 2.55 FUNCTION_LIST URADCC IF_DATA DIM_X 0x382E84 EXTERN WORD IF_DATA MCMESS 0x382E84 EXTERN /end MEASUREMENT
/begin MEASUREMENT sp1s_a_um "10ms alter Wert f. Sollwert-Poti 1 (PWG) für die Funktionsüberwachung" UBYTE spg_ub_q0p019 1 100 0 4.98047 FUNCTION_LIST URADCC IF_DATA DIM_X 0x382E85 EXTERN WORD IF_DATA MCMESS 0x382E85 EXTERN /end MEASUREMENT
/begin MEASUREMENT sp1s_st_um "Stationärzähler für Sollwertpoti 1" UBYTE t10msxs_ub_b2p55 1 100 0 2.55 FUNCTION_LIST URADCC IF_DATA DIM_X 0x382E86 EXTERN WORD IF_DATA MCMESS 0x382E86 EXTERN /end MEASUREMENT
/begin MEASUREMENT sp1s_um "aktueller Wert für Sollwert-Poti 1 (PWG) für die Funktionsüberwachung" UBYTE spg_ub_q0p019 1 100 0 4.98047 FUNCTION_LIST UFSPSC IF_DATA DIM_X 0x382E65 EXTERN WORD IF_DATA MCMESS 0x382E65 EXTERN /end MEASUREMENT
/begin MEASUREMENT sp2s_um "aktueller Wert für Sollwert-Poti 2 (PWG) für die Funktionsüberwachung" UBYTE spg_ub_q0p0098 1 100 0 2.49023 FUNCTION_LIST UFSPSC IF_DATA DIM_X 0x382E66 EXTERN WORD IF_DATA MCMESS 0x382E66 EXTERN /end MEASUREMENT
/begin MEASUREMENT spsc_c_um "Fehlerzähler bei zueinander unplausiblen Sollwerten in der Funktionsüberwachung" UBYTE t40ms_ub_b10200 1 100 0 10200 FUNCTION_LIST UFSPSC IF_DATA DIM_X 0x382E67 EXTERN WORD IF_DATA MCMESS 0x382E67 EXTERN /end MEASUREMENT
/begin MEASUREMENT spsnst08_uc "" UWORD dez 1 100 0 65535 FUNCTION_LIST URCEINS URCMZUL IF_DATA DIM_X 0x382932 EXTERN WORD IF_DATA MCMESS 0x382932 EXTERN /end MEASUREMENT
/begin MEASUREMENT spsnst08_um "" UWORD dez 1 100 0 65535 FUNCTION_LIST UFEINS UFMZUL IF_DATA DIM_X 0x382E9E EXTERN WORD IF_DATA MCMESS 0x382E9E EXTERN /end MEASUREMENT
/begin MEASUREMENT spsn_uc "nach unten auf Leerlauf begrenzter Pedalwert (8 Bit) im Befehlstest" UBYTE spg_ub_q0p019 1 100 0 4.98047 FUNCTION_LIST URCEIN URCEINS URCMZUL URCREAC IF_DATA DIM_X 0x380C5E EXTERN WORD IF_DATA MCMESS 0x380C5E EXTERN /end MEASUREMENT
/begin MEASUREMENT spsn_um "Pedalsollwert (8 Bit) in der Funktionsüberwachung" UBYTE spg_ub_q0p019 1 100 0 4.98047 FUNCTION_LIST UFSPSC UFEINS UFMZUL UFREAC IF_DATA DIM_X 0x382E68 EXTERN WORD IF_DATA MCMESS 0x382E68 EXTERN /end MEASUREMENT
/begin MEASUREMENT srst_c_um "Zähler im Dauer-RAM für Software-Reset (Diagnose) aus der Funktionsüberwachung" UBYTE dez 1 100 0 255 FUNCTION_LIST UFURAM IF_DATA DIM_X 0x3830C1 EXTERN WORD IF_DATA MCMESS 0x3830C1 EXTERN /end MEASUREMENT
/begin MEASUREMENT staBits "" UBYTE dez 1 100 0 255 FUNCTION_LIST STA IF_DATA DIM_X 0x3830C9 EXTERN WORD IF_DATA MCMESS 0x3830C9 EXTERN /end MEASUREMENT
/begin MEASUREMENT stactr "Startadaptionscounter" UBYTE dez 1 100 0 255 FUNCTION_LIST STADAP IF_DATA DIM_X 0x380B4B EXTERN WORD IF_DATA MCMESS 0x380B4B EXTERN /end MEASUREMENT
/begin MEASUREMENT STADAPlokBits "" UWORD dez 1 100 0 65535 FUNCTION_LIST STADAP IF_DATA DIM_X 0x382370 EXTERN WORD IF_DATA MCMESS 0x382370 EXTERN /end MEASUREMENT
/begin MEASUREMENT stateaevab "Nr des aktiven Zustandes in AEVAB" UBYTE dez 1 100 0 255 FUNCTION_LIST AEVAB BGEVAB IF_DATA DIM_X 0x380B11 EXTERN WORD IF_DATA MCMESS 0x380B11 EXTERN /end MEASUREMENT
/begin MEASUREMENT stateQsyn "Zustand der Schnellstart State-Machine GEN_QSYN" UBYTE dez 1 100 0 255 FUNCTION_LIST GGDPG IF_DATA DIM_X 0xF9D6 INTERN WORD IF_DATA MCMESS 0xF9D6 INTERN /end MEASUREMENT
/begin MEASUREMENT stat_gra "Status FGR für Lampenansteuerung über CAN" UBYTE dez 1 100 0 255 FUNCTION_LIST FGRLAMP CAN IF_DATA DIM_X 0x380AD5 EXTERN WORD IF_DATA MCMESS 0x380AD5 EXTERN /end MEASUREMENT
/begin MEASUREMENT stkrlx "Laststützstelle für die KR-Adaption" UBYTE dez 1 100 0 255 FUNCTION_LIST KRRA IF_DATA DIM_X 0x380BE2 EXTERN WORD IF_DATA MCMESS 0x380BE2 EXTERN /end MEASUREMENT
/begin MEASUREMENT stkrnx "Drehzahlstützstelle für die KR-Adaption" UBYTE dez 1 100 0 255 FUNCTION_LIST KRRA KRDY IF_DATA DIM_X 0x380BE3 EXTERN WORD IF_DATA MCMESS 0x380BE3 EXTERN /end MEASUREMENT
/begin MEASUREMENT stldia "Aktuelle Stützstelle für LDR Adaption" UBYTE dez 1 100 0 255 FUNCTION_LIST LDRPID IF_DATA DIM_X 0x380BFC EXTERN WORD IF_DATA MCMESS 0x380BFC EXTERN /end MEASUREMENT
/begin MEASUREMENT sumode "Zustand der Saugrohrumschaltung" UBYTE dez 1 100 0 255 FUNCTION_LIST SU BGSRM IF_DATA DIM_X 0x380B08 EXTERN WORD IF_DATA MCMESS 0x380B08 EXTERN /end MEASUREMENT
/begin MEASUREMENT swOffDlBits "" UWORD dez 1 100 0 65535 FUNCTION_LIST MOTAUS AEKP _EEPROM MLS URROM V7804X_T WANWKW WFS IF_DATA DIM_X 0x383A22 EXTERN WORD IF_DATA MCMESS 0x383A22 EXTERN /end MEASUREMENT
/begin MEASUREMENT swout "Schließwinkel" UWORD zw_ub_q0p75 1 100 0 49151.3 FUNCTION_LIST AZUE IF_DATA DIM_X 0xF900 INTERN WORD IF_DATA MCMESS 0xF900 INTERN /end MEASUREMENT
/begin MEASUREMENT synchroCtr "" UWORD dez 1 100 0 65535 FUNCTION_LIST V7804X_T IF_DATA DIM_X 0x380D3E EXTERN WORD IF_DATA MCMESS 0x380D3E EXTERN /end MEASUREMENT
/begin MEASUREMENT synstate "Aktueller Synchronisierzustand" UBYTE dez 1 100 0 255 FUNCTION_LIST SYSYNC ACIFI NLDG NLPH IF_DATA DIM_X 0xF9D9 INTERN WORD IF_DATA MCMESS 0xF9D9 INTERN /end MEASUREMENT
/begin MEASUREMENT synstate_o "Sychronisationszustand des vorherigen Synchros" UBYTE dez 1 100 0 255 FUNCTION_LIST SYSYNC ACIFI IF_DATA DIM_X 0xF9DA INTERN WORD IF_DATA MCMESS 0xF9DA INTERN /end MEASUREMENT
/begin MEASUREMENT systemStackUsage "" UWORD fak_uw_b1 1 100 0 0.999985 FUNCTION_LIST STACKMON IF_DATA DIM_X 0x382B14 EXTERN WORD IF_DATA MCMESS 0x382B14 EXTERN /end MEASUREMENT
/begin MEASUREMENT szfuba_w "Schließzeit Funkenband" UWORD tsegment_sy 1 100 0 43.69 FUNCTION_LIST ZUESZ AZUE IF_DATA DIM_X 0xFB48 INTERN WORD IF_DATA MCMESS 0xFB48 INTERN /end MEASUREMENT
/begin MEASUREMENT szout_w "Schließzeitausgabe" UWORD txms_uw_q0p1 1 100 0 6553.5 FUNCTION_LIST ZUESZ IF_DATA DIM_X 0x382CE6 EXTERN WORD IF_DATA MCMESS 0x382CE6 EXTERN /end MEASUREMENT
/begin MEASUREMENT sztcalc_w "Schliesszeit in Timer 1 Inkrementen" UWORD tsegment_sy 1 100 0 43.69 FUNCTION_LIST ZUESZ IF_DATA DIM_X 0x382CE8 EXTERN WORD IF_DATA MCMESS 0x382CE8 EXTERN /end MEASUREMENT
/begin MEASUREMENT S_ac "Klima-Anforderung aktiv" UWORD B_TRUE 1 100 0 1 BIT_MASK 0x40 FUNCTION_LIST KOLS KOS T2LID IF_DATA DIM_X 0xFD90 INTERN BYTE IF_DATA MCMESS 0xFD90 INTERN /end MEASUREMENT
/begin MEASUREMENT S_ac_c "CAN Signal : Klima-Anforderung aktiv" UWORD B_TRUE 1 100 0 1 BIT_MASK 0x1000 FUNCTION_LIST CAN KOLS IF_DATA DIM_X 0xFD08 INTERN BYTE IF_DATA MCMESS 0xFD08 INTERN /end MEASUREMENT
/begin MEASUREMENT S_ac_prev "" UWORD B_TRUE 1 100 0 1 BIT_MASK 0x80 FUNCTION_LIST KOLS IF_DATA DIM_X 0xFD90 INTERN BYTE IF_DATA MCMESS 0xFD90 INTERN /end MEASUREMENT
/begin MEASUREMENT S_asr "Status ASR-Aktiv über CAN" UWORD B_TRUE 1 100 0 1 BIT_MASK 0x200 FUNCTION_LIST MDEX IF_DATA DIM_X 0xFD0A INTERN BYTE IF_DATA MCMESS 0xFD0A INTERN /end MEASUREMENT
/begin MEASUREMENT S_asr_can "ASR-Statusinformation vom CAN" UWORD B_TRUE 1 100 0 1 BIT_MASK 0x2000 FUNCTION_LIST CAN MDEX IF_DATA DIM_X 0xFD08 INTERN BYTE IF_DATA MCMESS 0xFD08 INTERN /end MEASUREMENT
/begin MEASUREMENT S_au "Schalter Start Abgasuntersuchung" UWORD B_TRUE 1 100 0 1 BIT_MASK 0x2 FUNCTION_LIST VHW SGAAU T2LID IF_DATA DIM_X 0xFD5E INTERN BYTE IF_DATA MCMESS 0xFD5E INTERN /end MEASUREMENT
/begin MEASUREMENT S_bls "Schalter Bremslicht" UWORD B_TRUE 1 100 0 1 BIT_MASK 0x4 FUNCTION_LIST VHW GGEGAS IF_DATA DIM_X 0xFD5E INTERN BYTE IF_DATA MCMESS 0xFD5E INTERN /end MEASUREMENT
/begin MEASUREMENT S_blsc "Schalter Bremslicht, über CAN empfangen" UWORD B_TRUE 1 100 0 1 BIT_MASK 0x4000 FUNCTION_LIST CAN GGEGAS IF_DATA DIM_X 0xFD08 INTERN BYTE IF_DATA MCMESS 0xFD08 INTERN /end MEASUREMENT
/begin MEASUREMENT S_brs "Schalter Bremstest" UWORD B_TRUE 1 100 0 1 BIT_MASK 0x8 FUNCTION_LIST VHW GGEGAS IF_DATA DIM_X 0xFD5E INTERN BYTE IF_DATA MCMESS 0xFD5E INTERN /end MEASUREMENT
/begin MEASUREMENT S_brsc "Schalter Bremstest, über CAN empfangen" UWORD B_TRUE 1 100 0 1 BIT_MASK 0x8000 FUNCTION_LIST CAN GGEGAS IF_DATA DIM_X 0xFD08 INTERN BYTE IF_DATA MCMESS 0xFD08 INTERN /end MEASUREMENT
/begin MEASUREMENT S_cra "PWM-Eingang Crashsignal" UWORD B_TRUE 1 100 0 1 BIT_MASK 0x10 FUNCTION_LIST VHW GGAIRB IF_DATA DIM_X 0xFD5E INTERN BYTE IF_DATA MCMESS 0xFD5E INTERN /end MEASUREMENT
/begin MEASUREMENT S_dp "Schalter Dashpot (1=ein)" UBYTE B_TRUE 1 100 0 1 BIT_MASK 0x40 FUNCTION_LIST MDFAW IF_DATA DIM_X 0x380C37 EXTERN BYTE IF_DATA MCMESS 0x380C37 EXTERN /end MEASUREMENT
/begin MEASUREMENT S_fgraus_c "Bedienhebel FGR aus über CAN" UWORD B_TRUE 1 100 0 1 BIT_MASK 0x1 FUNCTION_LIST CAN GGFGRH IF_DATA DIM_X 0xFD0A INTERN BYTE IF_DATA MCMESS 0xFD0A INTERN /end MEASUREMENT
/begin MEASUREMENT S_fgren_c "FGR Enabel über CAN" UWORD B_TRUE 1 100 0 1 BIT_MASK 0x2 FUNCTION_LIST CAN FGRLAMP GGFGRH IF_DATA DIM_X 0xFD0A INTERN BYTE IF_DATA MCMESS 0xFD0A INTERN /end MEASUREMENT
/begin MEASUREMENT S_fgrhs_c "Bedienhebel FGR Hauptschalter über CAN" UWORD B_TRUE 1 100 0 1 BIT_MASK 0x4 FUNCTION_LIST CAN GGFGRH IF_DATA DIM_X 0xFD0A INTERN BYTE IF_DATA MCMESS 0xFD0A INTERN /end MEASUREMENT
/begin MEASUREMENT S_fgrsb_c "Bedienhebel FGR setzten/beschleunigen über CAN" UWORD B_TRUE 1 100 0 1 BIT_MASK 0x8 FUNCTION_LIST CAN GGFGRH IF_DATA DIM_X 0xFD0A INTERN BYTE IF_DATA MCMESS 0xFD0A INTERN /end MEASUREMENT
/begin MEASUREMENT S_fgrwv_c "Bedienhebel FGR wiederaufnehmen/verzögern über CAN" UWORD B_TRUE 1 100 0 1 BIT_MASK 0x10 FUNCTION_LIST CAN GGFGRH IF_DATA DIM_X 0xFD0A INTERN BYTE IF_DATA MCMESS 0xFD0A INTERN /end MEASUREMENT
/begin MEASUREMENT s_flags_uc "Byte für Status-Bits des Befehlstests" UBYTE dez 1 100 0 255 FUNCTION_LIST URCRAM IF_DATA DIM_X 0x380C56 EXTERN WORD IF_DATA MCMESS 0x380C56 EXTERN /end MEASUREMENT
/begin MEASUREMENT s_flags_um "Byte für Status-Bits der Funktionsüberwachung" UBYTE dez 1 100 0 255 FUNCTION_LIST UFURAM IF_DATA DIM_X 0x382E43 EXTERN WORD IF_DATA MCMESS 0x382E43 EXTERN /end MEASUREMENT
/begin MEASUREMENT S_fs "Schalter Fahrstufe" UWORD B_TRUE 1 100 0 1 BIT_MASK 0x400 FUNCTION_LIST MDEX BBGANG IF_DATA DIM_X 0xFD0A INTERN BYTE IF_DATA MCMESS 0xFD0A INTERN /end MEASUREMENT
/begin MEASUREMENT S_kl15 "Schalter Klemme 15" UWORD B_TRUE 1 100 0 1 BIT_MASK 0x20 FUNCTION_LIST VHW GGZDGON IF_DATA DIM_X 0xFD5E INTERN BYTE IF_DATA MCMESS 0xFD5E INTERN /end MEASUREMENT
/begin MEASUREMENT S_kupp "Schalter Kupplung" UWORD B_TRUE 1 100 0 1 BIT_MASK 0x40 FUNCTION_LIST VHW DKUPPL GGEGAS IF_DATA DIM_X 0xFD5E INTERN BYTE IF_DATA MCMESS 0xFD5E INTERN /end MEASUREMENT
/begin MEASUREMENT S_kuppc "Schalter Kupplung, über CAN empfangen" UWORD B_TRUE 1 100 0 1 BIT_MASK 0x20 FUNCTION_LIST CAN DKUPPL GGEGAS IF_DATA DIM_X 0xFD0A INTERN BYTE IF_DATA MCMESS 0xFD0A INTERN /end MEASUREMENT
/begin MEASUREMENT S_lfs2 "Schalter Elektro-Motor-Lüfter Stufe 2" UWORD B_TRUE 1 100 0 1 BIT_MASK 0x80 FUNCTION_LIST VHW MLS T2LID IF_DATA DIM_X 0xFD5E INTERN BYTE IF_DATA MCMESS 0xFD5E INTERN /end MEASUREMENT
/begin MEASUREMENT S_ls "Schalter Lastschlagdämpfung (1=ein)" UBYTE B_TRUE 1 100 0 1 BIT_MASK 0x4 FUNCTION_LIST MDFAW IF_DATA DIM_X 0x380C37 EXTERN BYTE IF_DATA MCMESS 0x380C37 EXTERN /end MEASUREMENT
/begin MEASUREMENT S_msr "Eingang Momentenschlupfreduzierung" UWORD B_TRUE 1 100 0 1 BIT_MASK 0x800 FUNCTION_LIST MDEX IF_DATA DIM_X 0xFD0A INTERN BYTE IF_DATA MCMESS 0xFD0A INTERN /end MEASUREMENT
/begin MEASUREMENT S_msr_can "MSR-Statusinformation vom CAN" UWORD B_TRUE 1 100 0 1 BIT_MASK 0x40 FUNCTION_LIST CAN MDEX IF_DATA DIM_X 0xFD0A INTERN BYTE IF_DATA MCMESS 0xFD0A INTERN /end MEASUREMENT
/begin MEASUREMENT S_stf "Schalter Startfreigabe" UWORD B_TRUE 1 100 0 1 BIT_MASK 0x100 FUNCTION_LIST VHW CAN STA T2LID IF_DATA DIM_X 0xFD5E INTERN BYTE IF_DATA MCMESS 0xFD5E INTERN /end MEASUREMENT
/begin MEASUREMENT S_tal "Schalter Tank leer bzw. Reserve" UWORD B_TRUE 1 100 0 1 BIT_MASK 0x200 FUNCTION_LIST VHW T2LID IF_DATA DIM_X 0xFD5E INTERN BYTE IF_DATA MCMESS 0xFD5E INTERN /end MEASUREMENT
/begin MEASUREMENT tabgm "Abgastemperatur vor Kat aus Modell" UBYTE temp_ub_q5_o50 1 100 -50 1225 FUNCTION_LIST ATM DFFT DHLSU DLSU HLSU T2LID IF_DATA DIM_X 0x380A3F EXTERN WORD IF_DATA MCMESS 0x380A3F EXTERN /end MEASUREMENT
/begin MEASUREMENT tabgm2 "Abgastemperatur vor Kat aus Modell Bank2" UBYTE temp_ub_q5_o50 1 100 -50 1225 FUNCTION_LIST ATM DFFT DHLSU DLSU HLSU IF_DATA DIM_X 0x380A40 EXTERN WORD IF_DATA MCMESS 0x380A40 EXTERN /end MEASUREMENT
/begin MEASUREMENT tabgm2_w "Abgastemperatur vor Kat aus Modell (Word) Bank2" UWORD temp_uw_q0p0195_o50 1 100 -50 1229.98 FUNCTION_LIST ATM TEMPKON IF_DATA DIM_X 0x381BC8 EXTERN WORD IF_DATA MCMESS 0x381BC8 EXTERN /end MEASUREMENT
/begin MEASUREMENT tabgmab "Abgastemperatur beim Abstellen des Motors" UBYTE temp_ub_q5_o50 1 100 -50 1225 FUNCTION_LIST ATM IF_DATA DIM_X 0x382FDE EXTERN WORD IF_DATA MCMESS 0x382FDE EXTERN /end MEASUREMENT
/begin MEASUREMENT tabgmab2 "Abgastemperatur beim Abstellen des Motors (Modell) Bank2" UBYTE temp_ub_q5_o50 1 100 -50 1225 FUNCTION_LIST ATM IF_DATA DIM_X 0x382FDF EXTERN WORD IF_DATA MCMESS 0x382FDF EXTERN /end MEASUREMENT
/begin MEASUREMENT tabgmst "Abgastemperatur bei Motorstart" UBYTE temp_ub_q5_o50 1 100 -50 1225 FUNCTION_LIST ATM SSTBER87 IF_DATA DIM_X 0x380A41 EXTERN WORD IF_DATA MCMESS 0x380A41 EXTERN /end MEASUREMENT
/begin MEASUREMENT tabgmst2 "Abgastemperatur bei Motorstart Bank2" UBYTE temp_ub_q5_o50 1 100 -50 1225 FUNCTION_LIST ATM SSTBER87 IF_DATA DIM_X 0x380A42 EXTERN WORD IF_DATA MCMESS 0x380A42 EXTERN /end MEASUREMENT
/begin MEASUREMENT tabgm_w "Abgastemperatur vor Kat aus Modell (Word)" UWORD temp_uw_q0p0195_o50 1 100 -50 1229.98 FUNCTION_LIST ATM LAMBTS TEMPKON IF_DATA DIM_X 0x381BCA EXTERN WORD IF_DATA MCMESS 0x381BCA EXTERN /end MEASUREMENT
/begin MEASUREMENT tabsmn_w "Abstellzeit aus relativem Minutenzähler" UWORD t1sxs_uw_q1 1 100 0 65535 FUNCTION_LIST BGTABS IF_DATA DIM_X 0x382218 EXTERN WORD IF_DATA MCMESS 0x382218 EXTERN /end MEASUREMENT
/begin MEASUREMENT tabsnl_w "Abstellzeit aus SG-Nachlauf" UWORD t1sxs_uw_q1 1 100 0 65535 FUNCTION_LIST BGTABS IF_DATA DIM_X 0x3839B4 EXTERN WORD IF_DATA MCMESS 0x3839B4 EXTERN /end MEASUREMENT
/begin MEASUREMENT tabstatm_w "Abstellzeit im SG-Nachlauf für ATM" UWORD t1sxs_uw_q1 1 100 0 65535 FUNCTION_LIST ATM IF_DATA DIM_X 0x381BCC EXTERN WORD IF_DATA MCMESS 0x381BCC EXTERN /end MEASUREMENT
/begin MEASUREMENT tabstmx_w "Abstellzeit Maximumabfrage für ATM" UWORD t1sxs_uw_q1 1 100 0 65535 FUNCTION_LIST ATM IF_DATA DIM_X 0x38397C EXTERN WORD IF_DATA MCMESS 0x38397C EXTERN /end MEASUREMENT
/begin MEASUREMENT tabstm_w "Abstellzeit aus Abkühlung des Motors" UWORD t1sxs_uw_q1 1 100 0 65535 FUNCTION_LIST BGTABS IF_DATA DIM_X 0x38221A EXTERN WORD IF_DATA MCMESS 0x38221A EXTERN /end MEASUREMENT
/begin MEASUREMENT tabst_w "Abstellzeit" UWORD t1sxs_uw_q1 1 100 0 65535 FUNCTION_LIST BGTABS AEKP ATM DHLSU ESNST ESSTT GGTFM HLSU NLDG SSTBER87 IF_DATA DIM_X 0x38221C EXTERN WORD IF_DATA MCMESS 0x38221C EXTERN /end MEASUREMENT
/begin MEASUREMENT tadtea "TEV-Tastverhältnis aus Tankentlüftungsdiagnose" UBYTE rel_ub_b99p6 1 100 0 99.6094 FUNCTION_LIST DTEV ATEV IF_DATA DIM_X 0x380CD2 EXTERN WORD IF_DATA MCMESS 0x380CD2 EXTERN /end MEASUREMENT
/begin MEASUREMENT tadteazs "Letzter Tastverhältniswert aus Tankentlüftungsdiagnose" UBYTE rel_ub_b99p6 1 100 0 99.6094 FUNCTION_LIST DTEV IF_DATA DIM_X 0x380CD3 EXTERN WORD IF_DATA MCMESS 0x380CD3 EXTERN /end MEASUREMENT
/begin MEASUREMENT tags_w "AGR Temperatur bei Einleitung ins Saugrohr (Word)" UWORD temp_sw_q0p75 1 100 0 49151.3 FUNCTION_LIST SWADP BGTMPK IF_DATA DIM_X 0x382B36 EXTERN WORD IF_DATA MCMESS 0x382B36 EXTERN /end MEASUREMENT
/begin MEASUREMENT talsuf "gefilterte Abgastemperatur aus Modell" UBYTE temp_ub_q5_o50 1 100 -50 1225 FUNCTION_LIST DHLSU IF_DATA DIM_X 0x380A56 EXTERN WORD IF_DATA MCMESS 0x380A56 EXTERN /end MEASUREMENT
/begin MEASUREMENT talsuf2 "gefilterte Abgastemperatur aus Modell, Bank2" UBYTE temp_ub_q5_o50 1 100 -50 1225 FUNCTION_LIST DHLSU IF_DATA DIM_X 0x380A57 EXTERN WORD IF_DATA MCMESS 0x380A57 EXTERN /end MEASUREMENT
/begin MEASUREMENT talt_um "Timerwert des vorhergehenden Berechnungszeitpunkts im 40ms-Raster" UWORD dez 1 100 0 65535 FUNCTION_LIST UFNC IF_DATA DIM_X 0x382E8E EXTERN WORD IF_DATA MCMESS 0x382E8E EXTERN /end MEASUREMENT
/begin MEASUREMENT tanhkm2_w "Abgastemperatur nach Hauptkat aus Modell, Bank2" UWORD temp_q0p0234_o273 1 100 -273.15 1262.83 FUNCTION_LIST TEMPKON HLSHK IF_DATA DIM_X 0x381E24 EXTERN WORD IF_DATA MCMESS 0x381E24 EXTERN /end MEASUREMENT
/begin MEASUREMENT tanhkm_w "Abgastemperatur hinter Hauptkat aus Modell" UWORD temp_q0p0234_o273 1 100 -273.15 1262.83 FUNCTION_LIST TEMPKON HLSHK IF_DATA DIM_X 0x381E26 EXTERN WORD IF_DATA MCMESS 0x381E26 EXTERN /end MEASUREMENT
/begin MEASUREMENT tankfst "Tankfüllstand" UBYTE fuel_ub_q0p5 1 100 0 127.5 FUNCTION_LIST CAN DFFTK GGFST IF_DATA DIM_X 0x380964 EXTERN WORD IF_DATA MCMESS 0x380964 EXTERN /end MEASUREMENT
/begin MEASUREMENT tans "Ansaugluft - Temperatur" UBYTE temp_ub_q0p75_o48 1 100 -48 143.25 FUNCTION_LIST GGTFA ATEV ATM BBKHZ BBSTT BBTEGA BGDVE BGTABS BGTEV BGTMPK CAN DFFT DFPM DLLR DSLSLRS ESNST ESSTT GGTFM GGTFUMG HLSU LDOB LDRLMX LDRPID LLRMR LRAEB LRSEB MDZUL MLS NWS SLS SSTBER87 SU T2DFA T2DVE T2LID TEB UFEING ZWSTT ZWWL IF_DATA DIM_X 0x380B53 EXTERN WORD IF_DATA MCMESS 0x380B53 EXTERN /end MEASUREMENT
/begin MEASUREMENT tansab "Ansauglufttemperatur beim Abstellen" UBYTE temp_ub_q0p75_o48 1 100 -48 143.25 FUNCTION_LIST GGTFA ESSTT GGTFM IF_DATA DIM_X 0x383006 EXTERN WORD IF_DATA MCMESS 0x383006 EXTERN /end MEASUREMENT
/begin MEASUREMENT tanslin "Ansauglufttemperatur, linearisiert und umgerechnet" UBYTE temp_ub_q0p75_o48 1 100 -48 143.25 FUNCTION_LIST GGTFA DFFTK TC1MOD IF_DATA DIM_X 0x380B52 EXTERN WORD IF_DATA MCMESS 0x380B52 EXTERN /end MEASUREMENT
/begin MEASUREMENT tansst "Ansaugluft-Temperatur bei Start" UBYTE temp_ub_q0p75_o48 1 100 -48 143.25 FUNCTION_LIST LRSEB IF_DATA DIM_X 0x380C8C EXTERN WORD IF_DATA MCMESS 0x380C8C EXTERN /end MEASUREMENT
/begin MEASUREMENT tans_um "Ansaugluft-Temperatur in der Funktionsüberwachung" UBYTE temp_ub_q0p75_o48 1 100 -48 143.25 FUNCTION_LIST UFEING UFNSC IF_DATA DIM_X 0x382E48 EXTERN WORD IF_DATA MCMESS 0x382E48 EXTERN /end MEASUREMENT
/begin MEASUREMENT tas_w "Zeit über ein Arbeitsspiel für rlgas_w" UWORD t_q16us 1 100 0 1.04856e+006 FUNCTION_LIST BGRLG IF_DATA DIM_X 0x382066 EXTERN WORD IF_DATA MCMESS 0x382066 EXTERN /end MEASUREMENT
/begin MEASUREMENT tateist "aktuelles Ist-Tastverhältnis Tankentlüftungsventil" UBYTE rel_ub_b99p6 1 100 0 99.6094 FUNCTION_LIST ATEV DFFTK T2LID IF_DATA DIM_X 0x380CAB EXTERN WORD IF_DATA MCMESS 0x380CAB EXTERN /end MEASUREMENT
/begin MEASUREMENT tateist_w "aktuelles Ist-Tastverhältnis Tankentlüftungsventil (16 Bit)" UWORD rel_uw_b100 1 100 0 99.9985 FUNCTION_LIST ATEV BGTEV IF_DATA DIM_X 0x382B5E EXTERN WORD IF_DATA MCMESS 0x382B5E EXTERN /end MEASUREMENT
/begin MEASUREMENT tateout "ausgegebenes Tastverhältnis für Tankentlüftungsventil" UBYTE rel_ub_b99p6 1 100 0 99.6094 FUNCTION_LIST ATEV DTEV DTEVE SGAAU VHW IF_DATA DIM_X 0x380CAC EXTERN WORD IF_DATA MCMESS 0x380CAC EXTERN /end MEASUREMENT
/begin MEASUREMENT tateout_w "ausgegebenes Tastverhältnis für Tankentlüftungsventil (16 Bit)" UWORD rel_uw_b100 1 100 0 99.9985 FUNCTION_LIST ATEV IF_DATA DIM_X 0x382B60 EXTERN WORD IF_DATA MCMESS 0x382B60 EXTERN /end MEASUREMENT
/begin MEASUREMENT tateroh "Rohwert Tastverhältnis TEV" UBYTE rel_ub_b99p6 1 100 0 99.6094 FUNCTION_LIST ATEV IF_DATA DIM_X 0x380CAD EXTERN WORD IF_DATA MCMESS 0x380CAD EXTERN /end MEASUREMENT
/begin MEASUREMENT tateroh_w "Rohwert Tastverhältnis TEV (16 Bit)" UWORD rel_uw_b100 1 100 0 99.9985 FUNCTION_LIST ATEV IF_DATA DIM_X 0x382B62 EXTERN WORD IF_DATA MCMESS 0x382B62 EXTERN /end MEASUREMENT
/begin MEASUREMENT tatesoll "gewünschtes Soll-Tastverhältnis Tankentlüftungsventil" UBYTE rel_ub_b99p6 1 100 0 99.6094 FUNCTION_LIST ATEV T2LID TEBEB IF_DATA DIM_X 0x380CAE EXTERN WORD IF_DATA MCMESS 0x380CAE EXTERN /end MEASUREMENT
/begin MEASUREMENT tatesoll_w "gewünschtes Soll-Tastverhältnis Tankentlüftungsventil (16 Bit)" UWORD rel_uw_b100 1 100 0 99.9985 FUNCTION_LIST ATEV IF_DATA DIM_X 0x382B64 EXTERN WORD IF_DATA MCMESS 0x382B64 EXTERN /end MEASUREMENT
/begin MEASUREMENT tatmkf "Abgastemperatur vor Kat aus Kennfeld KFTATM" UBYTE temp_ub_q5_o50 1 100 -50 1225 FUNCTION_LIST ATM IF_DATA DIM_X 0x380A43 EXTERN WORD IF_DATA MCMESS 0x380A43 EXTERN /end MEASUREMENT
/begin MEASUREMENT tatmkf2 "Abgastemperatur vor Kat aus Kennfeld KFTATM Bank2" UBYTE temp_ub_q5_o50 1 100 -50 1225 FUNCTION_LIST ATM IF_DATA DIM_X 0x380A44 EXTERN WORD IF_DATA MCMESS 0x380A44 EXTERN /end MEASUREMENT
/begin MEASUREMENT tatmsta "Abgastemperatur vor Kat aus Modell stationär" UBYTE temp_ub_q5_o50 1 100 -50 1225 FUNCTION_LIST ATM IF_DATA DIM_X 0x380A45 EXTERN WORD IF_DATA MCMESS 0x380A45 EXTERN /end MEASUREMENT
/begin MEASUREMENT tatmsta2 "Abgastemperatur vor Kat aus Modell stationär Bank2" UBYTE temp_ub_q5_o50 1 100 -50 1225 FUNCTION_LIST ATM IF_DATA DIM_X 0x380A46 EXTERN WORD IF_DATA MCMESS 0x380A46 EXTERN /end MEASUREMENT
/begin MEASUREMENT tatu "Ansaugluft- oder Umgebungstemperatur" UBYTE temp_ub_q0p75_o48 1 100 -48 143.25 FUNCTION_LIST ATM IF_DATA DIM_X 0x380A47 EXTERN WORD IF_DATA MCMESS 0x380A47 EXTERN /end MEASUREMENT
/begin MEASUREMENT tavvkm2_w "Abgastemperatur vor Vorkat aus Modell, Bank2" UWORD temp_q0p0234_o273 1 100 -273.15 1262.83 FUNCTION_LIST TEMPKON IF_DATA DIM_X 0x381E28 EXTERN WORD IF_DATA MCMESS 0x381E28 EXTERN /end MEASUREMENT
/begin MEASUREMENT tavvkm_w "Abgastemperatur vor Vorkat aus Modell" UWORD temp_q0p0234_o273 1 100 -273.15 1262.83 FUNCTION_LIST TEMPKON IF_DATA DIM_X 0x381E2A EXTERN WORD IF_DATA MCMESS 0x381E2A EXTERN /end MEASUREMENT
/begin MEASUREMENT tbtrnxo "Betriebsstundenzählerstand bei Überdrehzahl, oberer Bereich" UWORD t6minxh_b6553p5 1 100 0 6553.5 FUNCTION_LIST AMUENE T2LID IF_DATA DIM_X 0x38395E EXTERN WORD IF_DATA MCMESS 0x38395E EXTERN /end MEASUREMENT
/begin MEASUREMENT tbtrnxu "Betriebsstundenzählerstand bei Überdrehzahl, unterer Bereich" UWORD t6minxh_b6553p5 1 100 0 6553.5 FUNCTION_LIST AMUENE T2LID IF_DATA DIM_X 0x383960 EXTERN WORD IF_DATA MCMESS 0x383960 EXTERN /end MEASUREMENT
/begin MEASUREMENT tc6kata "Anzahl der Ausgabe-Codes SCAN-Tool Mode6 aus Kat-Diagnose" UBYTE dez 1 100 0 255 FUNCTION_LIST DKATLRS IF_DATA DIM_X 0x382FEA EXTERN WORD IF_DATA MCMESS 0x382FEA EXTERN /end MEASUREMENT
/begin MEASUREMENT tc6katc "Ausgabe-Code SCAN-Tool Mode 6 aus KAT-Diagnose" UBYTE dez 1 100 0 255 FUNCTION_LIST DKATLRS TC6MOD IF_DATA DIM_X 0x382FEB EXTERN WORD IF_DATA MCMESS 0x382FEB EXTERN /end MEASUREMENT
/begin MEASUREMENT tc6katc2 "Ausgabe-Code SCAN-Tool Mode 6 aus KAT-Diagnose, Bank2" UBYTE dez 1 100 0 255 FUNCTION_LIST DKATLRS TC6MOD IF_DATA DIM_X 0x382FEC EXTERN WORD IF_DATA MCMESS 0x382FEC EXTERN /end MEASUREMENT
/begin MEASUREMENT tc6kats "Ausgabe Schwellwert SCAN-Tool Mode 6 aus KAT-Diagnose" UBYTE dez 1 100 0 255 FUNCTION_LIST DKATLRS TC6MOD IF_DATA DIM_X 0x382FED EXTERN WORD IF_DATA MCMESS 0x382FED EXTERN /end MEASUREMENT
/begin MEASUREMENT tc6kats2 "Ausgabe Schwellwert SCAN-Tool Mode 6 aus KAT-Diagnose" UBYTE dez 1 100 0 255 FUNCTION_LIST DKATLRS TC6MOD IF_DATA DIM_X 0x382FEE EXTERN WORD IF_DATA MCMESS 0x382FEE EXTERN /end MEASUREMENT
/begin MEASUREMENT tc6katw "Ausgabe Prüfwert SCAN-Tool Mode 6 aus KAT-Diagnose" UBYTE dez 1 100 0 255 FUNCTION_LIST DKATLRS TC6MOD IF_DATA DIM_X 0x382FEF EXTERN WORD IF_DATA MCMESS 0x382FEF EXTERN /end MEASUREMENT
/begin MEASUREMENT tc6katw2 "Ausgabe Prüfwert SCAN-Tool Mode 6 aus KAT-Diagnose, Bank2" UBYTE dez 1 100 0 255 FUNCTION_LIST DKATLRS TC6MOD IF_DATA DIM_X 0x382FF0 EXTERN WORD IF_DATA MCMESS 0x382FF0 EXTERN /end MEASUREMENT
/begin MEASUREMENT tc6tesc "Ausgabe-Code SCAN-Tool Mode 6 aus TES-Diagnose" UBYTE dez 1 100 0 255 FUNCTION_LIST DTEV TC6MOD IF_DATA DIM_X 0x38311A EXTERN WORD IF_DATA MCMESS 0x38311A EXTERN /end MEASUREMENT
/begin MEASUREMENT tc6tess "Ausgabe Schwellwert SCAN-Tool Mode 6 aus TES-Diagnose" UWORD dez 1 100 0 65535 FUNCTION_LIST DTEV TC6MOD IF_DATA DIM_X 0x383E72 EXTERN WORD IF_DATA MCMESS 0x383E72 EXTERN /end MEASUREMENT
/begin MEASUREMENT tc6tesw "Ausgabe Prüfwert SCAN-Tool Mode 6 aus TES-Diagnose" UWORD dez 1 100 0 65535 FUNCTION_LIST DTEV TC6MOD IF_DATA DIM_X 0x383E74 EXTERN WORD IF_DATA MCMESS 0x383E74 EXTERN /end MEASUREMENT
/begin MEASUREMENT tcap_um "Timerwert des aktuellen Berechnungszeitpunkts im 40ms-Raster" UWORD dez 1 100 0 65535 FUNCTION_LIST UFNC IF_DATA DIM_X 0x382E90 EXTERN WORD IF_DATA MCMESS 0x382E90 EXTERN /end MEASUREMENT
/begin MEASUREMENT tdknach_w "Zeitzähler im Nachlauf bis stromlose DK in NLP einschwingt" UWORD t10msxs_uw_b655p35 1 100 0 655.35 FUNCTION_LIST BGDVE IF_DATA DIM_X 0x381E74 EXTERN WORD IF_DATA MCMESS 0x381E74 EXTERN /end MEASUREMENT
/begin MEASUREMENT tdlrtm_w "Diagnosezeit für Überschreitung Motortemperaturschwelle für Lambda-Regelung" UWORD t100msxs_uw_b6553p5 1 100 0 6553.5 FUNCTION_LIST GGTFM IF_DATA DIM_X 0x382380 EXTERN WORD IF_DATA MCMESS 0x382380 EXTERN /end MEASUREMENT
/begin MEASUREMENT tdtesta "Zeit DTEV Aufsteuerprüfung aktiv" UBYTE t100msxs_ub_b25p5 1 100 0 25.5 FUNCTION_LIST DTEV IF_DATA DIM_X 0x380CD4 EXTERN WORD IF_DATA MCMESS 0x380CD4 EXTERN /end MEASUREMENT
/begin MEASUREMENT tdtetevo "Zeit Tastverhälnis aus DTEV größer Schwelle" UBYTE t100msxs_ub_b25p5 1 100 0 25.5 FUNCTION_LIST DTEV IF_DATA DIM_X 0x380CD5 EXTERN WORD IF_DATA MCMESS 0x380CD5 EXTERN /end MEASUREMENT
/begin MEASUREMENT tdwfsvn_w "" UWORD t10msxs_uw_b655p35 1 100 0 655.35 FUNCTION_LIST WFS IF_DATA DIM_X 0x38281C EXTERN WORD IF_DATA MCMESS 0x38281C EXTERN /end MEASUREMENT
/begin MEASUREMENT te2_w "effektive Einspritzzeit Bank2 (word)" UWORD tinjection_sy 1 100 0 174.76 FUNCTION_LIST RKTI TEB IF_DATA DIM_X 0x38235E EXTERN WORD IF_DATA MCMESS 0x38235E EXTERN /end MEASUREMENT
/begin MEASUREMENT tedi "Istwert der Einschaltdauer der LSU-Heizung nach Start" UBYTE t10msxs_ub_b2p55 1 100 0 2.55 FUNCTION_LIST HLSU IF_DATA DIM_X 0x380C91 EXTERN WORD IF_DATA MCMESS 0x380C91 EXTERN /end MEASUREMENT
/begin MEASUREMENT tedi2 "Istwert der Einschaltdauer der LSU-Heizung Bank2 nach Start" UBYTE t10msxs_ub_b2p55 1 100 0 2.55 FUNCTION_LIST HLSU IF_DATA DIM_X 0x380C92 EXTERN WORD IF_DATA MCMESS 0x380C92 EXTERN /end MEASUREMENT
/begin MEASUREMENT tedst "Einschaltdauer der LSU-Heizung nach Start" UBYTE t10msxs_ub_b2p55 1 100 0 2.55 FUNCTION_LIST HLSU IF_DATA DIM_X 0x380C93 EXTERN WORD IF_DATA MCMESS 0x380C93 EXTERN /end MEASUREMENT
/begin MEASUREMENT tedst2 "Einschaltdauer der Heizung LSU2 nach Start" UBYTE t10msxs_ub_b2p55 1 100 0 2.55 FUNCTION_LIST HLSU IF_DATA DIM_X 0x380C94 EXTERN WORD IF_DATA MCMESS 0x380C94 EXTERN /end MEASUREMENT
/begin MEASUREMENT tedtml "Einschaltdauer der LSU-Heizung abhängig von der Abgastemperatur und ml" UBYTE t10msxs_ub_b2p55 1 100 0 2.55 FUNCTION_LIST HLSU IF_DATA DIM_X 0x380C95 EXTERN WORD IF_DATA MCMESS 0x380C95 EXTERN /end MEASUREMENT
/begin MEASUREMENT tedtml2 "Einschaltdauer der LSU-Heizung abhängig von der Abgastemperatur2 und ml" UBYTE t10msxs_ub_b2p55 1 100 0 2.55 FUNCTION_LIST HLSU IF_DATA DIM_X 0x380C96 EXTERN WORD IF_DATA MCMESS 0x380C96 EXTERN /end MEASUREMENT
/begin MEASUREMENT tedub "korrigierte Einschaltdauer der LSU-Heizung" UBYTE t10msxs_ub_b2p55 1 100 0 2.55 FUNCTION_LIST HLSU IF_DATA DIM_X 0x380C97 EXTERN WORD IF_DATA MCMESS 0x380C97 EXTERN /end MEASUREMENT
/begin MEASUREMENT tedub2 "korrigierte Einschaltdauer der LSU-Heizung Bank2" UBYTE t10msxs_ub_b2p55 1 100 0 2.55 FUNCTION_LIST HLSU IF_DATA DIM_X 0x380C98 EXTERN WORD IF_DATA MCMESS 0x380C98 EXTERN /end MEASUREMENT
/begin MEASUREMENT tephc "Phasenzähler Grundadaption / Tankentlüftung" UWORD t100msxs_uw_b6553p6 1 100 0 6553.5 FUNCTION_LIST BBTEGA IF_DATA DIM_X 0x3821F2 EXTERN WORD IF_DATA MCMESS 0x3821F2 EXTERN /end MEASUREMENT
/begin MEASUREMENT tevfa2_w "effektive Einspritzzeit vor Feinabgleich (word)" UWORD tinjection_sy 1 100 0 174.76 FUNCTION_LIST RKTI IF_DATA DIM_X 0x382360 EXTERN WORD IF_DATA MCMESS 0x382360 EXTERN /end MEASUREMENT
/begin MEASUREMENT tevfa_w "effektive Einspritzzeit vor Feinabgleich (word)" UWORD tinjection_sy 1 100 0 174.76 FUNCTION_LIST RKTI IF_DATA DIM_X 0x382362 EXTERN WORD IF_DATA MCMESS 0x382362 EXTERN /end MEASUREMENT
/begin MEASUREMENT tevfa_w_kge "" UWORD tinjection_sy 1 100 0 174.76 FUNCTION_LIST RKTI IF_DATA DIM_X 0x382364 EXTERN WORD IF_DATA MCMESS 0x382364 EXTERN /end MEASUREMENT
/begin MEASUREMENT tevper "Periodendauer bei Ansteuerung Tankentlüftungsventil" UBYTE t500usxms_ub_q0p5 1 100 0 127.5 FUNCTION_LIST ATEV VHW IF_DATA DIM_X 0x380CA9 EXTERN WORD IF_DATA MCMESS 0x380CA9 EXTERN /end MEASUREMENT
/begin MEASUREMENT te_w "effektive Einspritzzeit (word)" UWORD tinjection_sy 1 100 0 174.76 FUNCTION_LIST RKTI BGRLP T2LID TEB IF_DATA DIM_X 0x382366 EXTERN WORD IF_DATA MCMESS 0x382366 EXTERN /end MEASUREMENT
/begin MEASUREMENT tfab "Flagbyte: Rückmeldungen Kurztests Eingangsbedingungen" UBYTE dez 1 100 0 255 FUNCTION_LIST T2DFA IF_DATA DIM_X 0x380924 EXTERN WORD IF_DATA MCMESS 0x380924 EXTERN /end MEASUREMENT
/begin MEASUREMENT tfab1 "Flagbyte: Rückmeldungen Kurztests Eingangsbedingungen" UBYTE dez 1 100 0 255 FUNCTION_LIST T2DFA IF_DATA DIM_X 0x380925 EXTERN WORD IF_DATA MCMESS 0x380925 EXTERN /end MEASUREMENT
/begin MEASUREMENT tfab2 "Flagbyte: Rückmeldungen Kurztests Eingangsbedingungen" UBYTE dez 1 100 0 255 FUNCTION_LIST T2DFA IF_DATA DIM_X 0x380926 EXTERN WORD IF_DATA MCMESS 0x380926 EXTERN /end MEASUREMENT
/begin MEASUREMENT tfaba "Flagbyte: Rückmeldungen Kurztests Funktion läuft" UBYTE dez 1 100 0 255 FUNCTION_LIST T2DFA IF_DATA DIM_X 0x380927 EXTERN WORD IF_DATA MCMESS 0x380927 EXTERN /end MEASUREMENT
/begin MEASUREMENT tfaba1 "Flagbyte: Rückmeldungen Kurztests Funktion läuft" UBYTE dez 1 100 0 255 FUNCTION_LIST T2DFA IF_DATA DIM_X 0x380928 EXTERN WORD IF_DATA MCMESS 0x380928 EXTERN /end MEASUREMENT
/begin MEASUREMENT tfae "Flagbyte: Rückmeldungen Kurztests Errorbits" UBYTE dez 1 100 0 255 FUNCTION_LIST T2DFA IF_DATA DIM_X 0x380929 EXTERN WORD IF_DATA MCMESS 0x380929 EXTERN /end MEASUREMENT
/begin MEASUREMENT tfae1 "Flagbyte: Rückmeldungen Kurztests Errorbits" UBYTE dez 1 100 0 255 FUNCTION_LIST T2DFA IF_DATA DIM_X 0x38092A EXTERN WORD IF_DATA MCMESS 0x38092A EXTERN /end MEASUREMENT
/begin MEASUREMENT tfae2 "Flagbyte: Rückmeldungen Kurztests Errorbits" UBYTE dez 1 100 0 255 FUNCTION_LIST T2DFA IF_DATA DIM_X 0x38092B EXTERN WORD IF_DATA MCMESS 0x38092B EXTERN /end MEASUREMENT
/begin MEASUREMENT tfae3 "Flagbyte: Rückmeldungen Kurztests Errorbits" UBYTE dez 1 100 0 255 FUNCTION_LIST T2DFA IF_DATA DIM_X 0x38092C EXTERN WORD IF_DATA MCMESS 0x38092C EXTERN /end MEASUREMENT
/begin MEASUREMENT tfas "Flagbyte: Rückmeldungen Kurztests Sperrbits gesetzt" UBYTE dez 1 100 0 255 FUNCTION_LIST T2DFA IF_DATA DIM_X 0x38092D EXTERN WORD IF_DATA MCMESS 0x38092D EXTERN /end MEASUREMENT
/begin MEASUREMENT tfas1 "Flagbyte: Rückmeldungen Kurztests Sperrbits gesetzt" UBYTE dez 1 100 0 255 FUNCTION_LIST T2DFA IF_DATA DIM_X 0x38092E EXTERN WORD IF_DATA MCMESS 0x38092E EXTERN /end MEASUREMENT
/begin MEASUREMENT tfas2 "Flagbyte: Rückmeldungen Kurztests Sperrbits gesetzt" UBYTE dez 1 100 0 255 FUNCTION_LIST T2DFA IF_DATA DIM_X 0x38092F EXTERN WORD IF_DATA MCMESS 0x38092F EXTERN /end MEASUREMENT
/begin MEASUREMENT tfas3 "Flagbyte: Rückmeldungen Kurztests Sperrbits gesetzt" UBYTE dez 1 100 0 255 FUNCTION_LIST T2DFA IF_DATA DIM_X 0x380930 EXTERN WORD IF_DATA MCMESS 0x380930 EXTERN /end MEASUREMENT
/begin MEASUREMENT tfaw "Flagbyte: Rückmeldungen Kurztests erforderliche Schwellen" UBYTE dez 1 100 0 255 FUNCTION_LIST T2DFA IF_DATA DIM_X 0x380931 EXTERN WORD IF_DATA MCMESS 0x380931 EXTERN /end MEASUREMENT
/begin MEASUREMENT tfaw1 "Flagbyte: Rückmeldungen Kurztests erforderliche Schwellen" UBYTE dez 1 100 0 255 FUNCTION_LIST T2DFA IF_DATA DIM_X 0x380932 EXTERN WORD IF_DATA MCMESS 0x380932 EXTERN /end MEASUREMENT
/begin MEASUREMENT tfaw2 "Flagbyte: Rückmeldungen Kurztests erforderliche Schwellen" UBYTE dez 1 100 0 255 FUNCTION_LIST T2DFA IF_DATA DIM_X 0x380933 EXTERN WORD IF_DATA MCMESS 0x380933 EXTERN /end MEASUREMENT
/begin MEASUREMENT tfaw3 "Flagbyte: Rückmeldungen Kurztests erforderliche Schwellen" UBYTE dez 1 100 0 255 FUNCTION_LIST T2DFA IF_DATA DIM_X 0x380934 EXTERN WORD IF_DATA MCMESS 0x380934 EXTERN /end MEASUREMENT
/begin MEASUREMENT tfaw4 "Flagbyte: Rückmeldungen Kurztests erforderliche Schwellen" UBYTE dez 1 100 0 255 FUNCTION_LIST T2DFA IF_DATA DIM_X 0x380935 EXTERN WORD IF_DATA MCMESS 0x380935 EXTERN /end MEASUREMENT
/begin MEASUREMENT tfaz "Flagbyte: Rückmeldungen Kurztests Zyklusbits" UBYTE dez 1 100 0 255 FUNCTION_LIST T2DFA IF_DATA DIM_X 0x380936 EXTERN WORD IF_DATA MCMESS 0x380936 EXTERN /end MEASUREMENT
/begin MEASUREMENT tfaz1 "Flagbyte: Rückmeldungen Kurztests Zyklusbits" UBYTE dez 1 100 0 255 FUNCTION_LIST T2DFA IF_DATA DIM_X 0x380937 EXTERN WORD IF_DATA MCMESS 0x380937 EXTERN /end MEASUREMENT
/begin MEASUREMENT tfaz2 "Flagbyte: Rückmeldungen Kurztests Zyklusbits" UBYTE dez 1 100 0 255 FUNCTION_LIST T2DFA IF_DATA DIM_X 0x380938 EXTERN WORD IF_DATA MCMESS 0x380938 EXTERN /end MEASUREMENT
/begin MEASUREMENT tfaz3 "Flagbyte: Rückmeldungen Kurztests Zyklusbits" UBYTE dez 1 100 0 255 FUNCTION_LIST T2DFA IF_DATA DIM_X 0x380939 EXTERN WORD IF_DATA MCMESS 0x380939 EXTERN /end MEASUREMENT
/begin MEASUREMENT tfgrenum_c "" UBYTE t40ms_ub_b10200 1 100 0 10200 FUNCTION_LIST UFFGRE IF_DATA DIM_X 0x382E4B EXTERN WORD IF_DATA MCMESS 0x382E4B EXTERN /end MEASUREMENT
/begin MEASUREMENT tfst "Tankfüllstand" UBYTE fuel_ub_q0p5 1 100 0 127.5 FUNCTION_LIST GGFST DFFT T2LID IF_DATA DIM_X 0x380A99 EXTERN WORD IF_DATA MCMESS 0x380A99 EXTERN /end MEASUREMENT
/begin MEASUREMENT tfwdksom_w "Zeitkonstante für Filterung Drosselklappenwinkel ohne Momentenstruktur" UWORD zk10msxs_uw_b655 1 100 0.0100002 655.36 FUNCTION_LIST SWADP FUEDK IF_DATA DIM_X 0x382B38 EXTERN WORD IF_DATA MCMESS 0x382B38 EXTERN /end MEASUREMENT
/begin MEASUREMENT tfwdks_w "Zeitkonstante für wdks Filterung" UWORD zk10msxs_uw_b655 1 100 0.0100002 655.36 FUNCTION_LIST FUEDK IF_DATA DIM_X 0x382154 EXTERN WORD IF_DATA MCMESS 0x382154 EXTERN /end MEASUREMENT
/begin MEASUREMENT tget "Getriebetemperatur" UBYTE temp_ub_q0p75_o48 1 100 -48 143.25 FUNCTION_LIST GGTGET AKWAV DFFTK IF_DATA DIM_X 0x380B69 EXTERN WORD IF_DATA MCMESS 0x380B69 EXTERN /end MEASUREMENT
/begin MEASUREMENT tgetlin "Getriebetemperatur, linearisiert und umgerechnet" UBYTE temp_ub_q0p75_o48 1 100 -48 143.25 FUNCTION_LIST GGTGET IF_DATA DIM_X 0x380B6A EXTERN WORD IF_DATA MCMESS 0x380B6A EXTERN /end MEASUREMENT
/begin MEASUREMENT thhaist "Auszeit für Sondenheizung hinter Kat" UBYTE t10msxs_ub_b2p55 1 100 0 2.55 FUNCTION_LIST HLSHK IF_DATA DIM_X 0x380A8F EXTERN WORD IF_DATA MCMESS 0x380A8F EXTERN /end MEASUREMENT
/begin MEASUREMENT thhaist2 "Auszeit für Sondenheizung2 hinter Kat" UBYTE t10msxs_ub_b2p55 1 100 0 2.55 FUNCTION_LIST HLSHK IF_DATA DIM_X 0x380A90 EXTERN WORD IF_DATA MCMESS 0x380A90 EXTERN /end MEASUREMENT
/begin MEASUREMENT thhat "unkorrigierte Ausschaltzeit der Sondenheizung hinter Kat" UBYTE t10msxs_q0p01_o0p05 1 100 -0.05 2.5 FUNCTION_LIST HLSHK IF_DATA DIM_X 0x380A91 EXTERN WORD IF_DATA MCMESS 0x380A91 EXTERN /end MEASUREMENT
/begin MEASUREMENT thhat2 "unkorrigierte Ausschaltzeit der Sondenheizung 2 hinter Kat" UBYTE t10msxs_q0p01_o0p05 1 100 -0.05 2.5 FUNCTION_LIST HLSHK IF_DATA DIM_X 0x380A92 EXTERN WORD IF_DATA MCMESS 0x380A92 EXTERN /end MEASUREMENT
/begin MEASUREMENT ti2_w "Einspritzzeit für Zylinder 2 (word)" UWORD tinjection5_sy 1 100 0 873.8 FUNCTION_LIST RKTI IF_DATA DIM_X 0x382368 EXTERN WORD IF_DATA MCMESS 0x382368 EXTERN /end MEASUREMENT
/begin MEASUREMENT tikatm "Abgastemperatur im Katalysator aus Modell" UBYTE temp_ub_q5_o50 1 100 -50 1225 FUNCTION_LIST SWADP DKATLRS DSLSLRS IF_DATA DIM_X 0x380C9A EXTERN WORD IF_DATA MCMESS 0x380C9A EXTERN /end MEASUREMENT
/begin MEASUREMENT tikatm2 "Abgastemperatur im Katalysator aus Modell Bank 2" UBYTE temp_ub_q5_o50 1 100 -50 1225 FUNCTION_LIST SWADP DKATLRS IF_DATA DIM_X 0x380C9B EXTERN WORD IF_DATA MCMESS 0x380C9B EXTERN /end MEASUREMENT
/begin MEASUREMENT timeout "" UBYTE t10msxs_ub_b2p55 1 100 0 2.55 FUNCTION_LIST WFS IF_DATA DIM_X 0x380C49 EXTERN WORD IF_DATA MCMESS 0x380C49 EXTERN /end MEASUREMENT
/begin MEASUREMENT timtalr_w "Timer für Verzögerung Reset Bit Tank leer" UWORD t200msxs_uw_q0p2 1 100 0 13107 FUNCTION_LIST GGFST IF_DATA DIM_X 0x381E36 EXTERN WORD IF_DATA MCMESS 0x381E36 EXTERN /end MEASUREMENT
/begin MEASUREMENT timtals_w "Timer für Verzögerung Setzen Bit Tank leer" UWORD t200msxs_uw_q0p2 1 100 0 13107 FUNCTION_LIST GGFST IF_DATA DIM_X 0x381E38 EXTERN WORD IF_DATA MCMESS 0x381E38 EXTERN /end MEASUREMENT
/begin MEASUREMENT tinkr "Zeit pro Winkelinkrement" UWORD dez 1 100 0 65535 FUNCTION_LIST AZUE IF_DATA DIM_X 0xF902 INTERN WORD IF_DATA MCMESS 0xF902 INTERN /end MEASUREMENT
/begin MEASUREMENT tispldpx_w "Schwelle für Zeit für Initialspülung bis LDP-Membran abgefallen ist" UWORD dez 1 100 0 65535 FUNCTION_LIST SWADP IF_DATA DIM_X 0x382B1C EXTERN WORD IF_DATA MCMESS 0x382B1C EXTERN /end MEASUREMENT
/begin MEASUREMENT tispldp_w "Zeit für Initialspülung bis LDP-Membran abgefallen ist" UWORD dez 1 100 0 65535 FUNCTION_LIST SWADP IF_DATA DIM_X 0x382B1E EXTERN WORD IF_DATA MCMESS 0x382B1E EXTERN /end MEASUREMENT
/begin MEASUREMENT tistzyl "Zylindernummer der ersten Einspritzung und Zündung" UBYTE dez 1 100 0 255 FUNCTION_LIST ACIFI ESSTT IF_DATA DIM_X 0xFA6A INTERN WORD IF_DATA MCMESS 0xFA6A INTERN /end MEASUREMENT
/begin MEASUREMENT ti_b1 "Einspritzzeit für EV's auf Bank1" UWORD tinjection_sy 1 100 0 174.76 FUNCTION_LIST RKTI ACIFI IF_DATA DIM_X 0x38236A EXTERN WORD IF_DATA MCMESS 0x38236A EXTERN /end MEASUREMENT
/begin MEASUREMENT ti_b2 "Einspritzzeit für EV's auf Bank2" UWORD tinjection_sy 1 100 0 174.76 FUNCTION_LIST RKTI ACIFI IF_DATA DIM_X 0x38236C EXTERN WORD IF_DATA MCMESS 0x38236C EXTERN /end MEASUREMENT
/begin MEASUREMENT ti_ev0 "Einspritzzeit 1. Zylinder in Zündfolge" UWORD tinjection_sy 1 100 0 174.76 FUNCTION_LIST ACIFI EVI TIMU IF_DATA DIM_X 0xFA90 INTERN WORD IF_DATA MCMESS 0xFA90 INTERN /end MEASUREMENT
/begin MEASUREMENT ti_ev1 "Einspritzzeit 2. Zylinder in Zündfolge" UWORD tinjection_sy 1 100 0 174.76 FUNCTION_LIST ACIFI EVI TIMU IF_DATA DIM_X 0xFA92 INTERN WORD IF_DATA MCMESS 0xFA92 INTERN /end MEASUREMENT
/begin MEASUREMENT ti_ev2 "Einspritzzeit 3. Zylinder in Zündfolge" UWORD tinjection_sy 1 100 0 174.76 FUNCTION_LIST ACIFI EVI TIMU IF_DATA DIM_X 0xFA94 INTERN WORD IF_DATA MCMESS 0xFA94 INTERN /end MEASUREMENT
/begin MEASUREMENT ti_ev3 "Einspritzzeit 4. Zylinder in Zündfolge" UWORD tinjection_sy 1 100 0 174.76 FUNCTION_LIST ACIFI EVI TIMU IF_DATA DIM_X 0xFA96 INTERN WORD IF_DATA MCMESS 0xFA96 INTERN /end MEASUREMENT
/begin MEASUREMENT ti_ev4 "Einspritzzeit 5. Zylinder in Zündfolge" UWORD tinjection_sy 1 100 0 174.76 FUNCTION_LIST ACIFI EVI TIMU IF_DATA DIM_X 0xFA98 INTERN WORD IF_DATA MCMESS 0xFA98 INTERN /end MEASUREMENT
/begin MEASUREMENT ti_ev5 "Einspritzzeit 6. Zylinder in Zündfolge" UWORD tinjection_sy 1 100 0 174.76 FUNCTION_LIST ACIFI EVI TIMU IF_DATA DIM_X 0xFA9A INTERN WORD IF_DATA MCMESS 0xFA9A INTERN /end MEASUREMENT
/begin MEASUREMENT ti_ev6 "Einspritzzeit 7. Zylinder in Zündfolge" UWORD tinjection_sy 1 100 0 174.76 FUNCTION_LIST ACIFI IF_DATA DIM_X 0xFA9C INTERN WORD IF_DATA MCMESS 0xFA9C INTERN /end MEASUREMENT
/begin MEASUREMENT ti_ev7 "Einspritzzeit 8. Zylinder in Zündfolge" UWORD tinjection_sy 1 100 0 174.76 FUNCTION_LIST ACIFI IF_DATA DIM_X 0xFA9E INTERN WORD IF_DATA MCMESS 0xFA9E INTERN /end MEASUREMENT
/begin MEASUREMENT ti_sto_0 "ausgegebene Einspritzzeit für Nachspritzer 1. Zyl. in Zündfolge" UWORD tinjection_sy 1 100 0 174.76 FUNCTION_LIST ACIFI IF_DATA DIM_X 0xFAA0 INTERN WORD IF_DATA MCMESS 0xFAA0 INTERN /end MEASUREMENT
/begin MEASUREMENT ti_sto_1 "ausgegebene Einspritzzeit für Nachspritzer 2. Zyl. in Zündfolge" UWORD tinjection_sy 1 100 0 174.76 FUNCTION_LIST ACIFI IF_DATA DIM_X 0xFAA2 INTERN WORD IF_DATA MCMESS 0xFAA2 INTERN /end MEASUREMENT
/begin MEASUREMENT ti_sto_2 "ausgegebene Einspritzzeit für Nachspritzer 3. Zyl. in Zündfolge" UWORD tinjection_sy 1 100 0 174.76 FUNCTION_LIST ACIFI IF_DATA DIM_X 0xFAA4 INTERN WORD IF_DATA MCMESS 0xFAA4 INTERN /end MEASUREMENT
/begin MEASUREMENT ti_sto_3 "ausgegebene Einspritzzeit für Nachspritzer 4. Zyl. in Zündfolge" UWORD tinjection_sy 1 100 0 174.76 FUNCTION_LIST ACIFI IF_DATA DIM_X 0xFAA6 INTERN WORD IF_DATA MCMESS 0xFAA6 INTERN /end MEASUREMENT
/begin MEASUREMENT ti_sto_4 "ausgegebene Einspritzzeit für Nachspritzer 5. Zyl. in Zündfolge" UWORD tinjection_sy 1 100 0 174.76 FUNCTION_LIST ACIFI IF_DATA DIM_X 0xFAA8 INTERN WORD IF_DATA MCMESS 0xFAA8 INTERN /end MEASUREMENT
/begin MEASUREMENT ti_sto_5 "ausgegebene Einspritzzeit für Nachspritzer 6. Zyl. in Zündfolge" UWORD tinjection_sy 1 100 0 174.76 FUNCTION_LIST ACIFI IF_DATA DIM_X 0xFAAA INTERN WORD IF_DATA MCMESS 0xFAAA INTERN /end MEASUREMENT
/begin MEASUREMENT ti_sto_6 "ausgegebene Einspritzzeit für Nachspritzer 7. Zyl. in Zündfolge" UWORD tinjection_sy 1 100 0 174.76 FUNCTION_LIST ACIFI IF_DATA DIM_X 0xFAAC INTERN WORD IF_DATA MCMESS 0xFAAC INTERN /end MEASUREMENT
/begin MEASUREMENT ti_sto_7 "ausgegebene Einspritzzeit für Nachspritzer 8. Zyl. in Zündfolge" UWORD tinjection_sy 1 100 0 174.76 FUNCTION_LIST ACIFI IF_DATA DIM_X 0xFAAE INTERN WORD IF_DATA MCMESS 0xFAAE INTERN /end MEASUREMENT
/begin MEASUREMENT ti_tvu_w "Batteriespannungsabhängige Einspritzzeitkorrektur CPU-Quantisierung" UWORD tinjection_sy 1 100 0 174.76 FUNCTION_LIST RKTI ACIFI EVI IF_DATA DIM_X 0xFAE4 INTERN WORD IF_DATA MCMESS 0xFAE4 INTERN /end MEASUREMENT
/begin MEASUREMENT ti_w "Einspritzzeit" UWORD tinjection5_sy 1 100 0 873.8 FUNCTION_LIST RKTI IF_DATA DIM_X 0x38236E EXTERN WORD IF_DATA MCMESS 0x38236E EXTERN /end MEASUREMENT
/begin MEASUREMENT tkatm "Katalysatortemperatur aus Modell" UBYTE temp_ub_q5_o50 1 100 -50 1225 FUNCTION_LIST ATM BBKHZ BBSAWE DFFT DHLSHK DKATLRS DLSAHK DLSH DSLSLRS LRSHK T2DFA T2LID IF_DATA DIM_X 0x380A48 EXTERN WORD IF_DATA MCMESS 0x380A48 EXTERN /end MEASUREMENT
/begin MEASUREMENT tkatm2 "Katalysatortemperatur aus Modell,  Bank2" UBYTE temp_ub_q5_o50 1 100 -50 1225 FUNCTION_LIST ATM DFFT DHLSHK DKATLRS DLSAHK DLSH LRSHK IF_DATA DIM_X 0x380A49 EXTERN WORD IF_DATA MCMESS 0x380A49 EXTERN /end MEASUREMENT
/begin MEASUREMENT tkatm2_w "Katalysatortemperatur aus Modell (Word) Bank2" UWORD temp_uw_q0p0195_o50 1 100 -50 1229.98 FUNCTION_LIST ATM LRSKA TEMPKON IF_DATA DIM_X 0x381BCE EXTERN WORD IF_DATA MCMESS 0x381BCE EXTERN /end MEASUREMENT
/begin MEASUREMENT tkatmab "Abgastemperatur hinter Kat beim Abstellen des Motors (Modell)" UBYTE temp_ub_q5_o50 1 100 -50 1225 FUNCTION_LIST ATM IF_DATA DIM_X 0x382FE0 EXTERN WORD IF_DATA MCMESS 0x382FE0 EXTERN /end MEASUREMENT
/begin MEASUREMENT tkatmab2 "Abgastemperatur hinter Kat beim Abstellen des Motors (Modell) Bank2" UBYTE temp_ub_q5_o50 1 100 -50 1225 FUNCTION_LIST ATM IF_DATA DIM_X 0x382FE1 EXTERN WORD IF_DATA MCMESS 0x382FE1 EXTERN /end MEASUREMENT
/begin MEASUREMENT tkatmf "gefilterte Katalysatortemperatur aus Modell" UBYTE temp_ub_q5_o50 1 100 -50 1225 FUNCTION_LIST DHLSHK DFFTK T2LID IF_DATA DIM_X 0x380A54 EXTERN WORD IF_DATA MCMESS 0x380A54 EXTERN /end MEASUREMENT
/begin MEASUREMENT tkatmf2 "gefilterte Katalysatortemperatur aus Modell, Bank2" UBYTE temp_ub_q5_o50 1 100 -50 1225 FUNCTION_LIST DHLSHK DFFTK IF_DATA DIM_X 0x380A55 EXTERN WORD IF_DATA MCMESS 0x380A55 EXTERN /end MEASUREMENT
/begin MEASUREMENT tkatmst "Katalysatortemperatur Modell Startwert = f(Abstellwert, Abstellzeit)" UBYTE temp_ub_q5_o50 1 100 -50 1225 FUNCTION_LIST ATM SSTBER87 IF_DATA DIM_X 0x380A4A EXTERN WORD IF_DATA MCMESS 0x380A4A EXTERN /end MEASUREMENT
/begin MEASUREMENT tkatmst2 "Katalysatortemperatur Modell Startwert = f(Abstellwert,Abstellzeit) Bank2" UBYTE temp_ub_q5_o50 1 100 -50 1225 FUNCTION_LIST ATM SSTBER87 IF_DATA DIM_X 0x380A4B EXTERN WORD IF_DATA MCMESS 0x380A4B EXTERN /end MEASUREMENT
/begin MEASUREMENT tkatm_w "Katalysatortemperatur aus Modell (Word)" UWORD temp_uw_q0p0195_o50 1 100 -50 1229.98 FUNCTION_LIST ATM LAMBTS LRSKA TEMPKON IF_DATA DIM_X 0x381BD0 EXTERN WORD IF_DATA MCMESS 0x381BD0 EXTERN /end MEASUREMENT
/begin MEASUREMENT tkdkte "Eingangstemperatur für Katalysator-Diagnose" UBYTE temp_ub_q5_o50 1 100 -50 1225 FUNCTION_LIST DKATLRS IF_DATA DIM_X 0x380A5C EXTERN WORD IF_DATA MCMESS 0x380A5C EXTERN /end MEASUREMENT
/begin MEASUREMENT tkdkte2 "Eingangstemperatur für Katalysator-Diagnose, Bank2" UBYTE temp_ub_q5_o50 1 100 -50 1225 FUNCTION_LIST DKATLRS IF_DATA DIM_X 0x380A5D EXTERN WORD IF_DATA MCMESS 0x380A5D EXTERN /end MEASUREMENT
/begin MEASUREMENT tkdkth "hochpaßgefilterte Katalysator-Temperatur nach Halteglied" UBYTE temp_ub_q5 1 100 0 1275 FUNCTION_LIST DKATLRS IF_DATA DIM_X 0x380A73 EXTERN WORD IF_DATA MCMESS 0x380A73 EXTERN /end MEASUREMENT
/begin MEASUREMENT tkdkth2 "hochpaßgefilterte Katalysator-Temperatur nach Halteglied" UBYTE temp_ub_q5 1 100 0 1275 FUNCTION_LIST DKATLRS IF_DATA DIM_X 0x380A74 EXTERN WORD IF_DATA MCMESS 0x380A74 EXTERN /end MEASUREMENT
/begin MEASUREMENT tkdkthp "hochpaßgefilterte Katalysator-Temperatur" UBYTE temp_ub_q5 1 100 0 1275 FUNCTION_LIST DKATLRS IF_DATA DIM_X 0x380A5E EXTERN WORD IF_DATA MCMESS 0x380A5E EXTERN /end MEASUREMENT
/begin MEASUREMENT tkdkthp2 "hochpaßgefilterte Katalysator-Temperatur" UBYTE temp_ub_q5 1 100 0 1275 FUNCTION_LIST DKATLRS IF_DATA DIM_X 0x380A5F EXTERN WORD IF_DATA MCMESS 0x380A5F EXTERN /end MEASUREMENT
/begin MEASUREMENT tlf2aus "Entprellzähler für Schalter S_LFS2 aus" UBYTE t100msxs_ub_b25p5 1 100 0 25.5 FUNCTION_LIST MLS IF_DATA DIM_X 0x380C22 EXTERN WORD IF_DATA MCMESS 0x380C22 EXTERN /end MEASUREMENT
/begin MEASUREMENT tlf2ein "Entprellzähler für Schalter S_LFS2 ein" UBYTE t100msxs_ub_b25p5 1 100 0 25.5 FUNCTION_LIST MLS IF_DATA DIM_X 0x380C23 EXTERN WORD IF_DATA MCMESS 0x380C23 EXTERN /end MEASUREMENT
/begin MEASUREMENT tlf3aus "Zeitzähler Verzögerungszeit für Lüfter3 aus" UBYTE t100msxs_ub_b25p5 1 100 0 25.5 FUNCTION_LIST MLS IF_DATA DIM_X 0x380C24 EXTERN WORD IF_DATA MCMESS 0x380C24 EXTERN /end MEASUREMENT
/begin MEASUREMENT tloop_w "" UWORD t50msxs_q0p05 1 100 0 3276.75 FUNCTION_LIST BGDVE IF_DATA DIM_X 0x381E76 EXTERN WORD IF_DATA MCMESS 0x381E76 EXTERN /end MEASUREMENT
/begin MEASUREMENT tlrs_w "Totzeit der Lambdaregelstrecke" UWORD tz10msxs_uw_b327p68 1 100 0.00500008 327.68 FUNCTION_LIST LRS ESUKAS IF_DATA DIM_X 0x3829C6 EXTERN WORD IF_DATA MCMESS 0x3829C6 EXTERN /end MEASUREMENT
/begin MEASUREMENT tmadb "Bereich Motortemperatur für Startmengenadaption" UBYTE dez 1 100 0 255 FUNCTION_LIST STADAP IF_DATA DIM_X 0x380B4C EXTERN WORD IF_DATA MCMESS 0x380B4C EXTERN /end MEASUREMENT
/begin MEASUREMENT tmCorCtr_w "Zähler Lückenkorrektur bei fehlendem Zahn" UWORD dez 1 100 0 65535 FUNCTION_LIST GGDPG DDG IF_DATA DIM_X 0x381B52 EXTERN WORD IF_DATA MCMESS 0x381B52 EXTERN /end MEASUREMENT
/begin MEASUREMENT tmew "Motortemperatur-Ersatzwert aus Modell" UBYTE temp_ub_q0p75_o48 1 100 -48 143.25 FUNCTION_LIST GGTFM DFFT IF_DATA DIM_X 0x380B58 EXTERN WORD IF_DATA MCMESS 0x380B58 EXTERN /end MEASUREMENT
/begin MEASUREMENT tmewab "Motortemperatur-Ersatzwert aus Modell beim Abstellen" UBYTE temp_ub_q0p75_o48 1 100 -48 143.25 FUNCTION_LIST GGTFM IF_DATA DIM_X 0x38300A EXTERN WORD IF_DATA MCMESS 0x38300A EXTERN /end MEASUREMENT
/begin MEASUREMENT tmfa_w "Meßfensteranfang Klopfregelung" UWORD tknockcon_sy 1 100 0 0.17476 FUNCTION_LIST GGKS IF_DATA DIM_X 0x382454 EXTERN WORD IF_DATA MCMESS 0x382454 EXTERN /end MEASUREMENT
/begin MEASUREMENT tmfln_w "Meßfensterlänge Klopfregelung Nulltest" UWORD tknockcon_sy 1 100 0 0.17476 FUNCTION_LIST GGKS DKRNT IF_DATA DIM_X 0x382456 EXTERN WORD IF_DATA MCMESS 0x382456 EXTERN /end MEASUREMENT
/begin MEASUREMENT tmfl_w "Meßfensterlänge Klopfregelung" UWORD tknockcon_sy 1 100 0 0.17476 FUNCTION_LIST GGKS IF_DATA DIM_X 0x382458 EXTERN WORD IF_DATA MCMESS 0x382458 EXTERN /end MEASUREMENT
/begin MEASUREMENT tmki "Motortemperatur aus Kombiinstrument" UBYTE temp_ub_q0p75_o48 1 100 -48 143.25 FUNCTION_LIST SWADP GGTFM SSTBER87 IF_DATA DIM_X 0x380CA2 EXTERN WORD IF_DATA MCMESS 0x380CA2 EXTERN /end MEASUREMENT
/begin MEASUREMENT tmlastz "Abwärtszähler zum Resetieren der AR beim Verzögern" UBYTE t10msxs_ub_b2p55 1 100 0 2.55 FUNCTION_LIST ARMD IF_DATA DIM_X 0x380C2A EXTERN WORD IF_DATA MCMESS 0x380C2A EXTERN /end MEASUREMENT
/begin MEASUREMENT tmnuka "Minimalzeit zwischen 2 Adaptionsvorgängen (ÜK-Adaption)" UWORD t10msxs_ub_b2p55 1 100 0 655.35 FUNCTION_LIST ESUKAS IF_DATA DIM_X 0x3822CA EXTERN WORD IF_DATA MCMESS 0x3822CA EXTERN /end MEASUREMENT
/begin MEASUREMENT tmot "Motor-Temperatur" UBYTE temp_ub_q0p75_o48 1 100 -48 143.25 FUNCTION_LIST GGTFM ACIFI AKWAV ARMD ATM BBKHZ BBSAWE BBSTT BGDVE BGTMPK CAN DDG DFFT DFPM DLLR DLSH DMDLU DMDMIL DNWS DSLSLRS DTEV DVFZ DWUC ESNWS ESUK ESUKAS esvs ESVW ESWL GGDPG GGKS GGTFMR GGTFOL GGTGET HLSHK HLSU KHMD KOS KRDY KRRA LAKH LAMKO LDRLMX LLRMR LLRNS LLRRM LRAEB LRS LRSEB MDBAS MDBGRG MDBGV MDEX MDFUE MDRED1 MDVER MDVERAD MDWAN MDZUL MLS NLDG NLPH SGAAU SLS SSTBER87 STA STADAP STMD SU SWADP T2DFA T2DVE T2LID T2STA TEB TEBEB UFEING WANWKW ZUESZ ZWMIN ZWWL IF_DATA DIM_X 0x380B5F EXTERN WORD IF_DATA MCMESS 0x380B5F EXTERN /end MEASUREMENT
/begin MEASUREMENT tmotab "Motortemperatur beim Abstellen" UBYTE temp_ub_q0p75_o48 1 100 -48 143.25 FUNCTION_LIST GGTFM AEKP BGTABS DLSH DSLSLRS ESSTT IF_DATA DIM_X 0x38300B EXTERN WORD IF_DATA MCMESS 0x38300B EXTERN /end MEASUREMENT
/begin MEASUREMENT tmotdif_w "Differenz aktuelle Motortemperatur zur Motor warm Temperatur" SWORD temp_sw_q0p75 1 100 -24576 24575.3 FUNCTION_LIST BGTMPK IF_DATA DIM_X 0x382106 EXTERN WORD IF_DATA MCMESS 0x382106 EXTERN /end MEASUREMENT
/begin MEASUREMENT tmotfil "gefilterte Motortemperatur" UBYTE temp_ub_q0p75_o48 1 100 -48 143.25 FUNCTION_LIST BGTMPK IF_DATA DIM_X 0x382FFF EXTERN WORD IF_DATA MCMESS 0x382FFF EXTERN /end MEASUREMENT
/begin MEASUREMENT tmotlin "Motortemperatur, linearisiert und umgerechnet" UBYTE temp_ub_q0p75_o48 1 100 -48 143.25 FUNCTION_LIST GGTFM DFFT DFFTCNV DFPM LRSEB TC1MOD IF_DATA DIM_X 0x380B59 EXTERN WORD IF_DATA MCMESS 0x380B59 EXTERN /end MEASUREMENT
/begin MEASUREMENT tmotlinab "gemessene Motor-Abstelltemperatur, linearisiert und umgerechnet" UBYTE temp_ub_q0p75_o48 1 100 -48 143.25 FUNCTION_LIST GGTFM IF_DATA DIM_X 0x383008 EXTERN WORD IF_DATA MCMESS 0x383008 EXTERN /end MEASUREMENT
/begin MEASUREMENT tmotlin_w "Motortemperatur, linearisiert und umgerechnet, 16Bit-Wort" UWORD temp_uw_q0p75_o48 1 100 -48 143.997 FUNCTION_LIST GGTFM IF_DATA DIM_X 0x382382 EXTERN WORD IF_DATA MCMESS 0x382382 EXTERN /end MEASUREMENT
/begin MEASUREMENT tmotvt "Motortemperatur vor Tiefpaßfilter" UBYTE temp_ub_q0p75_o48 1 100 -48 143.25 FUNCTION_LIST GGTFM IF_DATA DIM_X 0x380B5A EXTERN WORD IF_DATA MCMESS 0x380B5A EXTERN /end MEASUREMENT
/begin MEASUREMENT tmot_u "Motor-Temperatur mit def. Quantisierung für FSP-Umwelten" UBYTE temp_ub_q1_o40 1 100 -40 215 FUNCTION_LIST DFFTCNV DFFT IF_DATA DIM_X 0x3809FB EXTERN WORD IF_DATA MCMESS 0x3809FB EXTERN /end MEASUREMENT
/begin MEASUREMENT tmot_um "Motor-Temperatur in der Funktionsüberwachung" UBYTE temp_ub_q0p75_o48 1 100 -48 143.25 FUNCTION_LIST UFEING UFNSC IF_DATA DIM_X 0x382E49 EXTERN WORD IF_DATA MCMESS 0x382E49 EXTERN /end MEASUREMENT
/begin MEASUREMENT tmpumast "Status für temporäre UMA-Adaption" UBYTE dez 1 100 0 255 FUNCTION_LIST BGDVE IF_DATA DIM_X 0x380AAC EXTERN WORD IF_DATA MCMESS 0x380AAC EXTERN /end MEASUREMENT
/begin MEASUREMENT tmr "Motorraumtemperatur" UBYTE temp_ub_q0p75_o48 1 100 -48 143.25 FUNCTION_LIST GGTFMR DFFTK MLS T2LID IF_DATA DIM_X 0x380B60 EXTERN WORD IF_DATA MCMESS 0x380B60 EXTERN /end MEASUREMENT
/begin MEASUREMENT tmrlin "Motorraumtemperatur, linearisiert und umgerechnet" UBYTE temp_ub_q0p75_o48 1 100 -48 143.25 FUNCTION_LIST GGTFMR DFFTK IF_DATA DIM_X 0x380B61 EXTERN WORD IF_DATA MCMESS 0x380B61 EXTERN /end MEASUREMENT
/begin MEASUREMENT tmrmin "" UBYTE temp_ub_q0p75_o48 1 100 -48 143.25 FUNCTION_LIST MLS IF_DATA DIM_X 0x380C25 EXTERN WORD IF_DATA MCMESS 0x380C25 EXTERN /end MEASUREMENT
/begin MEASUREMENT tmrstart "" UBYTE temp_ub_q0p75_o48 1 100 -48 143.25 FUNCTION_LIST MLS IF_DATA DIM_X 0x380C26 EXTERN WORD IF_DATA MCMESS 0x380C26 EXTERN /end MEASUREMENT
/begin MEASUREMENT tmrw "Motortemperatur-Referenzwert aus Modell" UBYTE temp_ub_q0p75_o48 1 100 -48 143.25 FUNCTION_LIST GGTFM DFFT DFFTK LRSEB IF_DATA DIM_X 0x380B5B EXTERN WORD IF_DATA MCMESS 0x380B5B EXTERN /end MEASUREMENT
/begin MEASUREMENT tmrwend "Endwert für Referenzwert Motortemperatur-Modell" UBYTE temp_ub_q0p75_o48 1 100 -48 143.25 FUNCTION_LIST GGTFM IF_DATA DIM_X 0x380B5C EXTERN WORD IF_DATA MCMESS 0x380B5C EXTERN /end MEASUREMENT
/begin MEASUREMENT tmsgnl_w "" UWORD t100msxs_uw_b6553p6 1 100 0 6553.5 FUNCTION_LIST MLS IF_DATA DIM_X 0x3825B0 EXTERN WORD IF_DATA MCMESS 0x3825B0 EXTERN /end MEASUREMENT
/begin MEASUREMENT tmsnp "Motor-Starttemperatur des Betriebszyklus' mit erstmaliger tmot-Unplausibilität" UBYTE temp_ub_q0p75_o48 1 100 -48 143.25 FUNCTION_LIST GGTFM IF_DATA DIM_X 0x383009 EXTERN WORD IF_DATA MCMESS 0x383009 EXTERN /end MEASUREMENT
/begin MEASUREMENT tmst "Motorstarttemperatur" UBYTE temp_ub_q0p75_o48 1 100 -48 143.25 FUNCTION_LIST GGTFM ATM BBKHZ BBSAWE BBTEGA BGTABS DKATLRS DMDSTP DSLSLRS ESNST ESSTT ESUK ESVW ESWL GGTFOL KHMD KOS LAKH LRSEB NWS SLS SSTBER87 STADAP ZWMIN ZWSTT ZWWL IF_DATA DIM_X 0x380B5D EXTERN WORD IF_DATA MCMESS 0x380B5D EXTERN /end MEASUREMENT
/begin MEASUREMENT tmstem "Motortemperatur bei Startende in Memory" UBYTE temp_ub_q0p75_o48 1 100 -48 143.25 FUNCTION_LIST DWUC IF_DATA DIM_X 0x380A14 EXTERN WORD IF_DATA MCMESS 0x380A14 EXTERN /end MEASUREMENT
/begin MEASUREMENT tn2 "Segmentzeit pro Zündung" UWORD tinjection_sy 1 100 0 174.76 FUNCTION_LIST TIMU ACIFI GGKS IF_DATA DIM_X 0xFAB4 INTERN WORD IF_DATA MCMESS 0xFAB4 INTERN /end MEASUREMENT
/begin MEASUREMENT tn2fgr_w "Doppelte Nennerzeitkonstante FGR-Regler" UWORD t20msxs_uw_q0p02 1 100 0 1310.7 FUNCTION_LIST FGRMD IF_DATA DIM_X 0x381FA2 EXTERN WORD IF_DATA MCMESS 0x381FA2 EXTERN /end MEASUREMENT
/begin MEASUREMENT tnachl_w "SG-Nachlaufzeit" UWORD t100msxs_uw_b6553p6 1 100 0 6553.5 FUNCTION_LIST MOTAUS AEKP IF_DATA DIM_X 0x383A24 EXTERN WORD IF_DATA MCMESS 0x383A24 EXTERN /end MEASUREMENT
/begin MEASUREMENT tnbm1_w "Zahnperiodenzeit des zweitletzten NBM Signals" UWORD dez 1 100 0 65535 FUNCTION_LIST GGDPG BGNMOT IF_DATA DIM_X 0x381B54 EXTERN WORD IF_DATA MCMESS 0x381B54 EXTERN /end MEASUREMENT
/begin MEASUREMENT tnbm2_w "Zahnperiodenzeit des drittletzten NBM Signals" UWORD dez 1 100 0 65535 FUNCTION_LIST GGDPG IF_DATA DIM_X 0x381B56 EXTERN WORD IF_DATA MCMESS 0x381B56 EXTERN /end MEASUREMENT
/begin MEASUREMENT tnbmphs0_w "Zahnperiodendauer eines NBM-Signals durch linearen Algorithmus" UWORD t5usxus_q5 1 100 0 327675 FUNCTION_LIST NLDG IF_DATA DIM_X 0x381B7C EXTERN WORD IF_DATA MCMESS 0x381B7C EXTERN /end MEASUREMENT
/begin MEASUREMENT tnbm_w "Zahnperiodenzeit des letzten NBM Signals" UWORD dez 1 100 0 65535 FUNCTION_LIST GGDPG BGNMOT IF_DATA DIM_X 0x381B58 EXTERN WORD IF_DATA MCMESS 0x381B58 EXTERN /end MEASUREMENT
/begin MEASUREMENT tnmax_w "Zeit bis zur Umschaltung der Abstimmung der Drehzahlbegrenzung" UWORD t10msxs_uw_b655p35 1 100 0 655.35 FUNCTION_LIST NMAXMD IF_DATA DIM_X 0x3826CE EXTERN WORD IF_DATA MCMESS 0x3826CE EXTERN /end MEASUREMENT
/begin MEASUREMENT tnscCtr_w "" UWORD t20msxs_uw_q0p02 1 100 0 1310.7 FUNCTION_LIST MDZUL IF_DATA DIM_X 0x3826C6 EXTERN WORD IF_DATA MCMESS 0x3826C6 EXTERN /end MEASUREMENT
/begin MEASUREMENT tnse_u "Zeit nach Startende Byte" UBYTE t_q25p6 1 100 0 6528 FUNCTION_LIST DFFTCNV DFFTK IF_DATA DIM_X 0x3809E2 EXTERN WORD IF_DATA MCMESS 0x3809E2 EXTERN /end MEASUREMENT
/begin MEASUREMENT tnse_w "Zeitzähler ab Startende (16bit)" UWORD t100msxs_uw_b6553p5 1 100 0 6553.5 FUNCTION_LIST BBSTT BBTEGA DFFTCNV DLLR DTEV LLRMR T2DFA T2LID IF_DATA DIM_X 0x382B58 EXTERN WORD IF_DATA MCMESS 0x382B58 EXTERN /end MEASUREMENT
/begin MEASUREMENT tnsofCtr "" UBYTE t20msxs_ub_b5p1 1 100 0 5.1 FUNCTION_LIST MDZUL IF_DATA DIM_X 0x380C42 EXTERN WORD IF_DATA MCMESS 0x380C42 EXTERN /end MEASUREMENT
/begin MEASUREMENT tnst "Zeit nach Startende" UBYTE t1sxs_ub_b255 1 100 0 255 FUNCTION_LIST SWADP IF_DATA DIM_X 0x380CA3 EXTERN WORD IF_DATA MCMESS 0x380CA3 EXTERN /end MEASUREMENT
/begin MEASUREMENT tnstmd "" UBYTE t40msxs_ub_q0p04 1 100 0 10.2 FUNCTION_LIST DMDLU_C IF_DATA DIM_X 0xF9AB INTERN WORD IF_DATA MCMESS 0xF9AB INTERN /end MEASUREMENT
/begin MEASUREMENT tnst_w "Zeit nach Startende" UWORD t10msxs_uw_b655p35 1 100 0 655.35 FUNCTION_LIST BBSTT BBKHZ DLSU DNWS DSLSLRS ESUKAS GGFST MLS SGAAU SLS STA SWADP IF_DATA DIM_X 0x382B5A EXTERN WORD IF_DATA MCMESS 0x382B5A EXTERN /end MEASUREMENT
/begin MEASUREMENT tntevzu "Zeit nach Schließen des TEVs" UBYTE t100msxs_ub_b25p5 1 100 0 25.5 FUNCTION_LIST DTEV IF_DATA DIM_X 0x380CD6 EXTERN WORD IF_DATA MCMESS 0x380CD6 EXTERN /end MEASUREMENT
/begin MEASUREMENT toel "Öltemperatur" UBYTE temp_ub_q1_o60 1 100 -60 195 FUNCTION_LIST GGTFOL GGTFM IF_DATA DIM_X 0x380B62 EXTERN WORD IF_DATA MCMESS 0x380B62 EXTERN /end MEASUREMENT
/begin MEASUREMENT toelk_u "(Motor-) Öltemperatur, Absoluttemperatur (intern in Kelvin) 8bit" UBYTE temp_q6_o273 1 100 -273.15 1256.85 FUNCTION_LIST DFFTCNV DFFTK IF_DATA DIM_X 0x3809E3 EXTERN WORD IF_DATA MCMESS 0x3809E3 EXTERN /end MEASUREMENT
/begin MEASUREMENT toelk_w "(Motor-) Öltemperatur, Ausgabe in Grad C, intern in Kelvin" UWORD temp_q0p0234_o273 1 100 -273.15 1262.83 FUNCTION_LIST GGTFOL DFFTCNV IF_DATA DIM_X 0x3823C0 EXTERN WORD IF_DATA MCMESS 0x3823C0 EXTERN /end MEASUREMENT
/begin MEASUREMENT tol "Motor-ÖL-Temperatur" UBYTE temp_ub_q0p75_o48 1 100 -48 143.25 FUNCTION_LIST GGTFOL CAN LLRNS NWS T2LID T2STA VS IF_DATA DIM_X 0x380B63 EXTERN WORD IF_DATA MCMESS 0x380B63 EXTERN /end MEASUREMENT
/begin MEASUREMENT tolab "(Motor-) Oeltemperatur beim Abstellen" UBYTE temp_ub_q0p75_o48 1 100 -48 143.25 FUNCTION_LIST GGTFOL IF_DATA DIM_X 0x38300C EXTERN WORD IF_DATA MCMESS 0x38300C EXTERN /end MEASUREMENT
/begin MEASUREMENT toldmntm "errechnete minimale Öltemperatur" UBYTE temp_ub_q0p75_o48 1 100 -48 143.25 FUNCTION_LIST GGTFOL IF_DATA DIM_X 0x380B64 EXTERN WORD IF_DATA MCMESS 0x380B64 EXTERN /end MEASUREMENT
/begin MEASUREMENT tollin "(Motor-)Oeltemperatur, linearisiert und umgerechnet" UBYTE temp_ub_q0p75_o48 1 100 -48 143.25 FUNCTION_LIST GGTFOL DFFTK IF_DATA DIM_X 0x380B65 EXTERN WORD IF_DATA MCMESS 0x380B65 EXTERN /end MEASUREMENT
/begin MEASUREMENT tooth_rale "Erster rückdrehender Zahn im Segment" UBYTE kw_q6 1 100 0 1530 FUNCTION_LIST ALE IF_DATA DIM_X 0x380A19 EXTERN WORD IF_DATA MCMESS 0x380A19 EXTERN /end MEASUREMENT
/begin MEASUREMENT topl_w "Operating time seit Urstart (mit EEPROM)" UWORD t6minxh_b6553p5 1 100 0 6553.5 FUNCTION_LIST DTOP AMUENE DUMWEX IF_DATA DIM_X 0x383954 EXTERN WORD IF_DATA MCMESS 0x383954 EXTERN /end MEASUREMENT
/begin MEASUREMENT topsec_w "Operating time Sekundentakt (word)" UWORD t100msxs_uw_b6553p5 1 100 0 6553.5 FUNCTION_LIST DTOP IF_DATA DIM_X 0x383956 EXTERN WORD IF_DATA MCMESS 0x383956 EXTERN /end MEASUREMENT
/begin MEASUREMENT top_w "Operating time seit powerfail" UWORD t6minxh_b6553p5 1 100 0 6553.5 FUNCTION_LIST DTOP DFPM STADAP T2LID IF_DATA DIM_X 0x383958 EXTERN WORD IF_DATA MCMESS 0x383958 EXTERN /end MEASUREMENT
/begin MEASUREMENT tpbauka "Entrellzeit für Erkennung Beschleunigung (ÜK-Adaption)" UBYTE t10msxs_ub_b2p55 1 100 0 2.55 FUNCTION_LIST ESUKAS IF_DATA DIM_X 0x380B33 EXTERN WORD IF_DATA MCMESS 0x380B33 EXTERN /end MEASUREMENT
/begin MEASUREMENT tpCorCtr_w "Zähler Lückenkorrektur bei einem zusätzlichen Zahn" UWORD dez 1 100 0 65535 FUNCTION_LIST GGDPG DDG IF_DATA DIM_X 0x381B5A EXTERN WORD IF_DATA MCMESS 0x381B5A EXTERN /end MEASUREMENT
/begin MEASUREMENT tPh1_w "Segmentzeit des letzten Phasensegments" UWORD t40usxus_q40 1 100 0 2.6214e+006 FUNCTION_LIST NLDG IF_DATA DIM_X 0x381B7E EXTERN WORD IF_DATA MCMESS 0x381B7E EXTERN /end MEASUREMENT
/begin MEASUREMENT tpldptcx_w "Schwelle Zeit für bis LDP-Membran abgefallen ist nachdem TEV geöffnet wurde" UWORD dez 1 100 0 65535 FUNCTION_LIST SWADP IF_DATA DIM_X 0x382B20 EXTERN WORD IF_DATA MCMESS 0x382B20 EXTERN /end MEASUREMENT
/begin MEASUREMENT tpldptc_w "Zeit für bis LDP-Membran abgefallen ist nachdem TEV geöffnet wurde" UWORD dez 1 100 0 65535 FUNCTION_LIST SWADP IF_DATA DIM_X 0x382B22 EXTERN WORD IF_DATA MCMESS 0x382B22 EXTERN /end MEASUREMENT
/begin MEASUREMENT tplsu "Tripanzahl für Entprellung von B_nplsv" UBYTE dez 1 100 0 255 FUNCTION_LIST DLSU T2LID IF_DATA DIM_X 0x382FF4 EXTERN WORD IF_DATA MCMESS 0x382FF4 EXTERN /end MEASUREMENT
/begin MEASUREMENT tpnt_aktiv "Aktivierung von KR-Funktionen" UBYTE dez 1 100 0 255 FUNCTION_LIST GGKS DKRNT DKRTP IF_DATA DIM_X 0x380B95 EXTERN WORD IF_DATA MCMESS 0x380B95 EXTERN /end MEASUREMENT
/begin MEASUREMENT tpsvkmf2_u "gefilterter Periodendauerwert des Sondensignals vor Kat, Bank2 (Byte)" UBYTE t10msxs_ub_b10p2 1 100 0 10.2 FUNCTION_LIST DFFTCNV DFFT IF_DATA DIM_X 0x3809FC EXTERN WORD IF_DATA MCMESS 0x3809FC EXTERN /end MEASUREMENT
/begin MEASUREMENT tpsvkmf2_w "gefilterter Periodendauerwert des Sondensignals vor Kat, Bank2 (Word)" UWORD t10msxs_uw_b655p35 1 100 0 655.35 FUNCTION_LIST SWADP DFFTCNV IF_DATA DIM_X 0x383E6C EXTERN WORD IF_DATA MCMESS 0x383E6C EXTERN /end MEASUREMENT
/begin MEASUREMENT tpsvkmf_u "gefilterter Periodendauerwert des Sondensignals vor Kat. (Byte)" UBYTE t10msxs_ub_b10p2 1 100 0 10.2 FUNCTION_LIST DFFTCNV DFFT IF_DATA DIM_X 0x3809FD EXTERN WORD IF_DATA MCMESS 0x3809FD EXTERN /end MEASUREMENT
/begin MEASUREMENT tpsvkmf_w "gefilterter Periodendauerwert des Sondensignals vor Kat. (Word)" UWORD t10msxs_uw_b655p35 1 100 0 655.35 FUNCTION_LIST SWADP DFFTCNV IF_DATA DIM_X 0x383E6E EXTERN WORD IF_DATA MCMESS 0x383E6E EXTERN /end MEASUREMENT
/begin MEASUREMENT tpvauka "Entprellzeit für Erkennung Verzögerung (ÜK-Adaption)" UBYTE t10msxs_ub_b2p55 1 100 0 2.55 FUNCTION_LIST ESUKAS IF_DATA DIM_X 0x380B34 EXTERN WORD IF_DATA MCMESS 0x380B34 EXTERN /end MEASUREMENT
/begin MEASUREMENT trevovCtr "" UWORD dez 1 100 0 65535 FUNCTION_LIST TREV_OV DMDTSB IF_DATA DIM_X 0xFA14 INTERN WORD IF_DATA MCMESS 0xFA14 INTERN /end MEASUREMENT
/begin MEASUREMENT trmin "Relative Zeit in Minuten" UBYTE tmin_q1p5 1 100 0 382.5 FUNCTION_LIST CAN BGTABS IF_DATA DIM_X 0x380965 EXTERN WORD IF_DATA MCMESS 0x380965 EXTERN /end MEASUREMENT
/begin MEASUREMENT trminaus_w "Relative Zeit des Motorabstellens in Minuten" UWORD tmin_uw_q1 1 100 0 65535 FUNCTION_LIST BGTABS IF_DATA DIM_X 0x3839B6 EXTERN WORD IF_DATA MCMESS 0x3839B6 EXTERN /end MEASUREMENT
/begin MEASUREMENT trminein_w "Relative Zeit des Motorstarts in Minuten" UWORD tmin_uw_q1 1 100 0 65535 FUNCTION_LIST BGTABS IF_DATA DIM_X 0x38221E EXTERN WORD IF_DATA MCMESS 0x38221E EXTERN /end MEASUREMENT
/begin MEASUREMENT trmin_w "Relative Zeit in Minuten" UWORD tmin_uw_q1 1 100 0 65535 FUNCTION_LIST SWADP IF_DATA DIM_X 0x382B24 EXTERN WORD IF_DATA MCMESS 0x382B24 EXTERN /end MEASUREMENT
/begin MEASUREMENT tr_zahn "Zahnzähler (Winkel an TR-Marke)" UWORD dez 1 100 0 65535 FUNCTION_LIST SYNC71 IF_DATA DIM_X 0xFB34 INTERN WORD IF_DATA MCMESS 0xFB34 INTERN /end MEASUREMENT
/begin MEASUREMENT tr_zahn2 "Zahnzähler (Winkel an TR-Marke)" UWORD dez 1 100 0 65535 FUNCTION_LIST SYNC71 IF_DATA DIM_X 0xFB36 INTERN WORD IF_DATA MCMESS 0xFB36 INTERN /end MEASUREMENT
/begin MEASUREMENT tr_zahnabs "Winkellage in Geberzaehnen der TR-Marke bzgl. TR Marke Zyl. 0" UWORD dez 1 100 0 65535 FUNCTION_LIST AZUE IF_DATA DIM_X 0xF904 INTERN WORD IF_DATA MCMESS 0xF904 INTERN /end MEASUREMENT
/begin MEASUREMENT tr_zeit "Timerstand zum Zeitpunkt der TR-Marke" UWORD dez 1 100 0 65535 FUNCTION_LIST SYNC71 BGNMOT IF_DATA DIM_X 0xFB38 INTERN WORD IF_DATA MCMESS 0xFB38 INTERN /end MEASUREMENT
/begin MEASUREMENT tr_zeit2 "Timerstand zum Zeitpunkt der TR-Marke" UWORD dez 1 100 0 65535 FUNCTION_LIST SYNC71 IF_DATA DIM_X 0xFB3A INTERN WORD IF_DATA MCMESS 0xFB3A INTERN /end MEASUREMENT
/begin MEASUREMENT tr_zeit_msb "" UBYTE dez 1 100 0 255 FUNCTION_LIST SYNC71 BGNMOT IF_DATA DIM_X 0xFB32 INTERN WORD IF_DATA MCMESS 0xFB32 INTERN /end MEASUREMENT
/begin MEASUREMENT ts01 "Segmentdauer Zylinder 1" UWORD tsquant 1 100 0 43690 FUNCTION_LIST DMDFON IF_DATA DIM_X 0x38160E EXTERN WORD IF_DATA MCMESS 0x38160E EXTERN /end MEASUREMENT
/begin MEASUREMENT ts02 "Segmentdauer Zylinder 2" UWORD tsquant 1 100 0 43690 FUNCTION_LIST DMDFON IF_DATA DIM_X 0x381610 EXTERN WORD IF_DATA MCMESS 0x381610 EXTERN /end MEASUREMENT
/begin MEASUREMENT ts03 "Segmentdauer Zylinder 3" UWORD tsquant 1 100 0 43690 FUNCTION_LIST DMDFON IF_DATA DIM_X 0x381612 EXTERN WORD IF_DATA MCMESS 0x381612 EXTERN /end MEASUREMENT
/begin MEASUREMENT ts04 "Segmentdauer Zylinder 4" UWORD tsquant 1 100 0 43690 FUNCTION_LIST DMDFON IF_DATA DIM_X 0x381614 EXTERN WORD IF_DATA MCMESS 0x381614 EXTERN /end MEASUREMENT
/begin MEASUREMENT ts05 "Segmentdauer Zylinder 5" UWORD tsquant 1 100 0 43690 FUNCTION_LIST DMDFON IF_DATA DIM_X 0x381616 EXTERN WORD IF_DATA MCMESS 0x381616 EXTERN /end MEASUREMENT
/begin MEASUREMENT ts06 "Segmentdauer Zylinder 6" UWORD tsquant 1 100 0 43690 FUNCTION_LIST DMDFON IF_DATA DIM_X 0x381618 EXTERN WORD IF_DATA MCMESS 0x381618 EXTERN /end MEASUREMENT
/begin MEASUREMENT ts07 "Segmentdauer Zylinder 7" UWORD tsquant 1 100 0 43690 FUNCTION_LIST DMDFON IF_DATA DIM_X 0x38161A EXTERN WORD IF_DATA MCMESS 0x38161A EXTERN /end MEASUREMENT
/begin MEASUREMENT ts08 "Segmentdauer Zylinder 8" UWORD tsquant 1 100 0 43690 FUNCTION_LIST DMDFON IF_DATA DIM_X 0x38161C EXTERN WORD IF_DATA MCMESS 0x38161C EXTERN /end MEASUREMENT
/begin MEASUREMENT tsaka "Timer Schubdauer für Katalysator-Ausräumen" UBYTE t20msxs_ub_b5p1 1 100 0 5.1 FUNCTION_LIST LRSKA IF_DATA DIM_X 0x380C86 EXTERN WORD IF_DATA MCMESS 0x380C86 EXTERN /end MEASUREMENT
/begin MEASUREMENT tsaka2 "Timer Schubdauer für Katalysator-Ausräumen für Stereo_LR Bank 2" UBYTE t20msxs_ub_b5p1 1 100 0 5.1 FUNCTION_LIST LRSKA IF_DATA DIM_X 0x380C87 EXTERN WORD IF_DATA MCMESS 0x380C87 EXTERN /end MEASUREMENT
/begin MEASUREMENT tsas_w "Zeit über ein Arbeitsspiel für ngas_w" UWORD tsquantl 1 100 0 699040 FUNCTION_LIST BGNG IF_DATA DIM_X 0x381B32 EXTERN WORD IF_DATA MCMESS 0x381B32 EXTERN /end MEASUREMENT
/begin MEASUREMENT tseghi "Winkel-Segmentzeit, high, low byte des high word" UBYTE dez 1 100 0 255 FUNCTION_LIST BGNMOT BGNG TIMU IF_DATA DIM_X 0xF9AD INTERN WORD IF_DATA MCMESS 0xF9AD INTERN /end MEASUREMENT
/begin MEASUREMENT tsegph_w "Periodendauer eines Phasensegments" UWORD t40usxus_q40 1 100 0 2.6214e+006 FUNCTION_LIST NLDG IF_DATA DIM_X 0x381B80 EXTERN WORD IF_DATA MCMESS 0x381B80 EXTERN /end MEASUREMENT
/begin MEASUREMENT tsegrsp_w_0__A "Beginn Ringspeicher für Segmentzeit" UWORD tsquant 1 100 0 43690 FUNCTION_LIST BGNG BGRLG IF_DATA DIM_X 0xF9C2 INTERN WORD IF_DATA MCMESS 0xF9C2 INTERN /end MEASUREMENT
/begin MEASUREMENT tsegrsp_w_1__A "Beginn Ringspeicher für Segmentzeit" UWORD tsquant 1 100 0 43690 FUNCTION_LIST BGNG BGRLG IF_DATA DIM_X 0xF9C4 INTERN WORD IF_DATA MCMESS 0xF9C4 INTERN /end MEASUREMENT
/begin MEASUREMENT tsegrsp_w_2__A "Beginn Ringspeicher für Segmentzeit" UWORD tsquant 1 100 0 43690 FUNCTION_LIST BGNG BGRLG IF_DATA DIM_X 0xF9C6 INTERN WORD IF_DATA MCMESS 0xF9C6 INTERN /end MEASUREMENT
/begin MEASUREMENT tsegrsp_w_3__A "Beginn Ringspeicher für Segmentzeit" UWORD tsquant 1 100 0 43690 FUNCTION_LIST BGNG BGRLG IF_DATA DIM_X 0xF9C8 INTERN WORD IF_DATA MCMESS 0xF9C8 INTERN /end MEASUREMENT
/begin MEASUREMENT tsegrsp_w_4__A "Beginn Ringspeicher für Segmentzeit" UWORD tsquant 1 100 0 43690 FUNCTION_LIST BGNG BGRLG IF_DATA DIM_X 0xF9CA INTERN WORD IF_DATA MCMESS 0xF9CA INTERN /end MEASUREMENT
/begin MEASUREMENT tsegrsp_w_5__A "Beginn Ringspeicher für Segmentzeit" UWORD tsquant 1 100 0 43690 FUNCTION_LIST BGNG BGRLG IF_DATA DIM_X 0xF9CC INTERN WORD IF_DATA MCMESS 0xF9CC INTERN /end MEASUREMENT
/begin MEASUREMENT tsegrsp_w_6__A "Beginn Ringspeicher für Segmentzeit" UWORD tsquant 1 100 0 43690 FUNCTION_LIST BGNG BGRLG IF_DATA DIM_X 0xF9CE INTERN WORD IF_DATA MCMESS 0xF9CE INTERN /end MEASUREMENT
/begin MEASUREMENT tsegrsp_w_7__A "Beginn Ringspeicher für Segmentzeit" UWORD tsquant 1 100 0 43690 FUNCTION_LIST BGNG BGRLG IF_DATA DIM_X 0xF9D0 INTERN WORD IF_DATA MCMESS 0xF9D0 INTERN /end MEASUREMENT
/begin MEASUREMENT tseg_w "Winkel-Segmentzeit" UWORD tsegment_sy 1 100 0 43.69 FUNCTION_LIST BGNMOT BGNG TIMU VS IF_DATA DIM_X 0xF9B0 INTERN WORD IF_DATA MCMESS 0xF9B0 INTERN /end MEASUREMENT
/begin MEASUREMENT tsges_w "Saugrohrgesamttemperatur (nach AGR-Einleitung) (word)" SWORD temp_sw_q0p75 1 100 -24576 24575.3 FUNCTION_LIST BGTMPK IF_DATA DIM_X 0x382108 EXTERN WORD IF_DATA MCMESS 0x382108 EXTERN /end MEASUREMENT
/begin MEASUREMENT tsk_m "Monitor korrigierte Segmentdauer" UWORD tsquant 1 100 0 43690 FUNCTION_LIST DMDFON IF_DATA DIM_X 0xE45C INTERN WORD IF_DATA MCMESS 0xE45C INTERN /end MEASUREMENT
/begin MEASUREMENT tspuka "Sperrzeit für Freigabe der ÜK-Adaption" UBYTE t100msxs_ub_b25p5 1 100 0 25.5 FUNCTION_LIST ESUKAS IF_DATA DIM_X 0x380B2F EXTERN WORD IF_DATA MCMESS 0x380B2F EXTERN /end MEASUREMENT
/begin MEASUREMENT tspuka2 "Sperrzeit für Freigabe der ÜK-Adaption Bank 2" UBYTE t100msxs_ub_b25p5 1 100 0 25.5 FUNCTION_LIST ESUKAS IF_DATA DIM_X 0x380B30 EXTERN WORD IF_DATA MCMESS 0x380B30 EXTERN /end MEASUREMENT
/begin MEASUREMENT tsroh_w "Segmentzeit unkorrigiert" UWORD tsquant 1 100 0 43690 FUNCTION_LIST DMDTSB IF_DATA DIM_X 0x38199A EXTERN WORD IF_DATA MCMESS 0x38199A EXTERN /end MEASUREMENT
/begin MEASUREMENT tstarte "Summierte Startzeit von Drehbeginn bis Startende (mehrere Starts)" UWORD t100msxs_uw_b6553p6 1 100 0 6553.5 FUNCTION_LIST DLSU IF_DATA DIM_X 0x383982 EXTERN WORD IF_DATA MCMESS 0x383982 EXTERN /end MEASUREMENT
/begin MEASUREMENT ts_m "Monitor Segmentdauer" UWORD tsquant 1 100 0 43690 FUNCTION_LIST DMDFON IF_DATA DIM_X 0xE454 INTERN WORD IF_DATA MCMESS 0xE454 INTERN /end MEASUREMENT
/begin MEASUREMENT ttmumad_w "" UWORD t50msxs_q0p05 1 100 0 3276.75 FUNCTION_LIST BGDVE IF_DATA DIM_X 0x381E78 EXTERN WORD IF_DATA MCMESS 0x381E78 EXTERN /end MEASUREMENT
/begin MEASUREMENT ttooth10ms "Zähler 10 ms Raster ohne Zahninterrupt" UBYTE dez 1 100 0 255 FUNCTION_LIST GGDPG ALE IF_DATA DIM_X 0x380A2A EXTERN WORD IF_DATA MCMESS 0x380A2A EXTERN /end MEASUREMENT
/begin MEASUREMENT tumg "Umgebungstemperatur" UBYTE temp_ub_q0p75_o48 1 100 -48 143.25 FUNCTION_LIST GGTFUMG ATM BGTABS DFFT GGTGET KOLS T2LID IF_DATA DIM_X 0x380B67 EXTERN WORD IF_DATA MCMESS 0x380B67 EXTERN /end MEASUREMENT
/begin MEASUREMENT tumginp "Umgebungstemperatur als Eingangsgröße für Kennfeld KFDTMTU" UBYTE temp_ub_q0p75_o48 1 100 -48 143.25 FUNCTION_LIST GGTFM IF_DATA DIM_X 0x380B5E EXTERN WORD IF_DATA MCMESS 0x380B5E EXTERN /end MEASUREMENT
/begin MEASUREMENT tumgta "Umgebungstemperatur aus Ansauglufttemperatur" UBYTE temp_ub_q0p75_o48 1 100 -48 143.25 FUNCTION_LIST GGTFUMG IF_DATA DIM_X 0x38300D EXTERN WORD IF_DATA MCMESS 0x38300D EXTERN /end MEASUREMENT
/begin MEASUREMENT tumg_c "Umgebungstemperatur empfangen von CAN-Kombiinstrument" UBYTE temp_ub_q0p5_o40 1 100 -40 87.5 FUNCTION_LIST CAN DFFTK GGTFUMG IF_DATA DIM_X 0x380966 EXTERN WORD IF_DATA MCMESS 0x380966 EXTERN /end MEASUREMENT
/begin MEASUREMENT tumta "Umgebungstemperatur aus Ansauglufttemperatur" UBYTE temp_ub_q0p75_o48 1 100 -48 143.25 FUNCTION_LIST BGTABS IF_DATA DIM_X 0x383000 EXTERN WORD IF_DATA MCMESS 0x383000 EXTERN /end MEASUREMENT
/begin MEASUREMENT tum_ein "Umgebungstemperatur für Abstellzeitberechnung" UBYTE temp_ub_q0p75_o48 1 100 -48 143.25 FUNCTION_LIST BGTABS IF_DATA DIM_X 0x380B1A EXTERN WORD IF_DATA MCMESS 0x380B1A EXTERN /end MEASUREMENT
/begin MEASUREMENT tvausct "Zeitzähler für Sperrzeit Abgasuntersuchung Störgrößenaufschaltung n. Abbruch" UWORD t100msxs_uw_b6553p5 1 100 0 6553.5 FUNCTION_LIST SGAAU IF_DATA DIM_X 0x380E90 EXTERN WORD IF_DATA MCMESS 0x380E90 EXTERN /end MEASUREMENT
/begin MEASUREMENT tvcwkos_ctr "" UBYTE dez 1 100 0 255 FUNCTION_LIST DEKON2 IF_DATA DIM_X 0x380AD3 EXTERN WORD IF_DATA MCMESS 0x380AD3 EXTERN /end MEASUREMENT
/begin MEASUREMENT tvdkbz_um_c "" UBYTE t40ms_ub_b10200 1 100 0 120 FUNCTION_LIST UFFGRE IF_DATA DIM_X 0x382E4C EXTERN WORD IF_DATA MCMESS 0x382E4C EXTERN /end MEASUREMENT
/begin MEASUREMENT tvfrrdte "Verzögerungszeit für Zurücksetzen des Lambda-Reglers nach Schließen des TEVs" UBYTE t100msxs_ub_b25p5 1 100 0 25.5 FUNCTION_LIST DTEV IF_DATA DIM_X 0x380CD7 EXTERN WORD IF_DATA MCMESS 0x380CD7 EXTERN /end MEASUREMENT
/begin MEASUREMENT tvfznw_t "" UBYTE t10msxs_ub_b2p55 1 100 0 2.55 FUNCTION_LIST ACIFI IF_DATA DIM_X 0xFA6B INTERN WORD IF_DATA MCMESS 0xFA6B INTERN /end MEASUREMENT
/begin MEASUREMENT tvrnr "Verzögerungszeit bis zum wirklichen Ev-Abschaltende" UBYTE dez 1 100 0 255 FUNCTION_LIST AEVAB IF_DATA DIM_X 0x380B12 EXTERN WORD IF_DATA MCMESS 0x380B12 EXTERN /end MEASUREMENT
/begin MEASUREMENT tvtevptu "Verzugszeit von TEV  (druck-, batteriespannung- und temperaturabhängig)" UBYTE t500usxms_ub_q0p5 1 100 0 127.5 FUNCTION_LIST ATEV IF_DATA DIM_X 0x380CAA EXTERN WORD IF_DATA MCMESS 0x380CAA EXTERN /end MEASUREMENT
/begin MEASUREMENT tvu_w "Batteriespannungskorrektur" UWORD tinjection_sy 1 100 0 174.76 FUNCTION_LIST AES BGRLP RKTI IF_DATA DIM_X 0x3821EA EXTERN WORD IF_DATA MCMESS 0x3821EA EXTERN /end MEASUREMENT
/begin MEASUREMENT twan "Öltemperatur im Wandler" UBYTE temp_ub_q1_o50 1 100 -50 205 FUNCTION_LIST CAN DFFTK MDWAN IF_DATA DIM_X 0x380967 EXTERN WORD IF_DATA MCMESS 0x380967 EXTERN /end MEASUREMENT
/begin MEASUREMENT twan_kge "" UBYTE temp_ub_q1_o50 1 100 -50 205 FUNCTION_LIST MDWAN IF_DATA DIM_X 0x380C1F EXTERN WORD IF_DATA MCMESS 0x380C1F EXTERN /end MEASUREMENT
/begin MEASUREMENT twdkttk2_w "Temperaturabhängige Wartezeit" UWORD t50msxs_uw_b3276p75 1 100 0 3276.75 FUNCTION_LIST DKATLRS IF_DATA DIM_X 0x381C48 EXTERN WORD IF_DATA MCMESS 0x381C48 EXTERN /end MEASUREMENT
/begin MEASUREMENT twdkttk_w "Temperaturabhängige Wartezeit" UWORD t50msxs_uw_b3276p75 1 100 0 3276.75 FUNCTION_LIST DKATLRS IF_DATA DIM_X 0x381C4A EXTERN WORD IF_DATA MCMESS 0x381C4A EXTERN /end MEASUREMENT
/begin MEASUREMENT twdlssh2_w "Timer für Mindestprüfzeit für DLSSA-Extremwertbestimmung hinter KAT Bank2" UWORD t50msxs_uw_b3276p75 1 100 0 3276.75 FUNCTION_LIST DLSSA IF_DATA DIM_X 0x381FE4 EXTERN WORD IF_DATA MCMESS 0x381FE4 EXTERN /end MEASUREMENT
/begin MEASUREMENT twdlssh_w "Timer für Mindestprüfzeit für DLSSA-Extremwertbestimmung hinter KAT" UWORD t50msxs_uw_b3276p75 1 100 0 3276.75 FUNCTION_LIST DLSSA IF_DATA DIM_X 0x381FE6 EXTERN WORD IF_DATA MCMESS 0x381FE6 EXTERN /end MEASUREMENT
/begin MEASUREMENT twfssr "Zeitzähler für Aufsummierung WFS-Vorfreigaben nach Reset" UBYTE t100msxs_ub_b25p5 1 100 0 25.5 FUNCTION_LIST WFS IF_DATA DIM_X 0x3830B4 EXTERN WORD IF_DATA MCMESS 0x3830B4 EXTERN /end MEASUREMENT
/begin MEASUREMENT twfsvnn_w "" UWORD t10msxs_uw_b655p35 1 100 0 655.35 FUNCTION_LIST WFS IF_DATA DIM_X 0x38281E EXTERN WORD IF_DATA MCMESS 0x38281E EXTERN /end MEASUREMENT
/begin MEASUREMENT TYP_aave "Fehlertyp: Endstufe AKF-Absperrventil (AAV)" UWORD B_TRUE 1 100 0 1 BIT_MASK 0xf00 FUNCTION_LIST DFPM_DEKON IF_DATA DIM_X 0x383816 EXTERN BYTE IF_DATA MCMESS 0x383816 EXTERN /end MEASUREMENT
/begin MEASUREMENT TYP_agre "" UWORD B_TRUE 1 100 0 1 BIT_MASK 0xf00 FUNCTION_LIST DFPM_DUMMY043 IF_DATA DIM_X 0x383818 EXTERN BYTE IF_DATA MCMESS 0x383818 EXTERN /end MEASUREMENT
/begin MEASUREMENT TYP_bm "" UWORD B_TRUE 1 100 0 1 BIT_MASK 0xf00 FUNCTION_LIST DFPM_DDG IF_DATA DIM_X 0x38381C EXTERN BYTE IF_DATA MCMESS 0x38381C EXTERN /end MEASUREMENT
/begin MEASUREMENT TYP_brems "Fehlertyp: Gebergröße Bremsschalter" UWORD B_TRUE 1 100 0 1 BIT_MASK 0xf00 FUNCTION_LIST DFPM_GGEGAS IF_DATA DIM_X 0x38381E EXTERN BYTE IF_DATA MCMESS 0x38381E EXTERN /end MEASUREMENT
/begin MEASUREMENT TYP_bwf "Fehlertyp:  PWG Bewegung" UWORD B_TRUE 1 100 0 1 BIT_MASK 0xf00 FUNCTION_LIST DFPM_GGPED IF_DATA DIM_X 0x383820 EXTERN BYTE IF_DATA MCMESS 0x383820 EXTERN /end MEASUREMENT
/begin MEASUREMENT TYP_cas "" UWORD B_TRUE 1 100 0 1 BIT_MASK 0xf00 FUNCTION_LIST DFPM_DCAS IF_DATA DIM_X 0x383822 EXTERN BYTE IF_DATA MCMESS 0x383822 EXTERN /end MEASUREMENT
/begin MEASUREMENT TYP_cge "" UWORD B_TRUE 1 100 0 1 BIT_MASK 0xf00 FUNCTION_LIST DFPM_DCGE IF_DATA DIM_X 0x383824 EXTERN BYTE IF_DATA MCMESS 0x383824 EXTERN /end MEASUREMENT
/begin MEASUREMENT TYP_cgegs "" UWORD B_TRUE 1 100 0 1 BIT_MASK 0xf00 FUNCTION_LIST DFPM_DCG IF_DATA DIM_X 0x383826 EXTERN BYTE IF_DATA MCMESS 0x383826 EXTERN /end MEASUREMENT
/begin MEASUREMENT TYP_cgggp "" UWORD B_TRUE 1 100 0 1 BIT_MASK 0xf00 FUNCTION_LIST DFPM_DCG IF_DATA DIM_X 0x383828 EXTERN BYTE IF_DATA MCMESS 0x383828 EXTERN /end MEASUREMENT
/begin MEASUREMENT TYP_cgggv "" UWORD B_TRUE 1 100 0 1 BIT_MASK 0xf00 FUNCTION_LIST DFPM_DCG IF_DATA DIM_X 0x38382A EXTERN BYTE IF_DATA MCMESS 0x38382A EXTERN /end MEASUREMENT
/begin MEASUREMENT TYP_cgm1v "" UWORD B_TRUE 1 100 0 1 BIT_MASK 0xf00 FUNCTION_LIST DFPM_DCG IF_DATA DIM_X 0x38382C EXTERN BYTE IF_DATA MCMESS 0x38382C EXTERN /end MEASUREMENT
/begin MEASUREMENT TYP_cgm2v "" UWORD B_TRUE 1 100 0 1 BIT_MASK 0xf00 FUNCTION_LIST DFPM_DCG IF_DATA DIM_X 0x38382E EXTERN BYTE IF_DATA MCMESS 0x38382E EXTERN /end MEASUREMENT
/begin MEASUREMENT TYP_cgm3v "" UWORD B_TRUE 1 100 0 1 BIT_MASK 0xf00 FUNCTION_LIST DFPM_DCG IF_DATA DIM_X 0x383830 EXTERN BYTE IF_DATA MCMESS 0x383830 EXTERN /end MEASUREMENT
/begin MEASUREMENT TYP_cgmvk "" UWORD B_TRUE 1 100 0 1 BIT_MASK 0xf00 FUNCTION_LIST DFPM_DCG IF_DATA DIM_X 0x383832 EXTERN BYTE IF_DATA MCMESS 0x383832 EXTERN /end MEASUREMENT
/begin MEASUREMENT TYP_cgrmm "" UWORD B_TRUE 1 100 0 1 BIT_MASK 0xf00 FUNCTION_LIST DFPM_DCG IF_DATA DIM_X 0x383834 EXTERN BYTE IF_DATA MCMESS 0x383834 EXTERN /end MEASUREMENT
/begin MEASUREMENT TYP_cgrms "" UWORD B_TRUE 1 100 0 1 BIT_MASK 0xf00 FUNCTION_LIST DFPM_DCG IF_DATA DIM_X 0x383836 EXTERN BYTE IF_DATA MCMESS 0x383836 EXTERN /end MEASUREMENT
/begin MEASUREMENT TYP_cgudg "" UWORD B_TRUE 1 100 0 1 BIT_MASK 0xf00 FUNCTION_LIST DFPM_DCG IF_DATA DIM_X 0x383838 EXTERN BYTE IF_DATA MCMESS 0x383838 EXTERN /end MEASUREMENT
/begin MEASUREMENT TYP_cgumv "" UWORD B_TRUE 1 100 0 1 BIT_MASK 0xf00 FUNCTION_LIST DFPM_DCG IF_DATA DIM_X 0x38383A EXTERN BYTE IF_DATA MCMESS 0x38383A EXTERN /end MEASUREMENT
/begin MEASUREMENT TYP_cgvgc "" UWORD B_TRUE 1 100 0 1 BIT_MASK 0xf00 FUNCTION_LIST DFPM_DCG IF_DATA DIM_X 0x38383C EXTERN BYTE IF_DATA MCMESS 0x38383C EXTERN /end MEASUREMENT
/begin MEASUREMENT TYP_cgvrc "" UWORD B_TRUE 1 100 0 1 BIT_MASK 0xf00 FUNCTION_LIST DFPM_DCG IF_DATA DIM_X 0x38383E EXTERN BYTE IF_DATA MCMESS 0x38383E EXTERN /end MEASUREMENT
/begin MEASUREMENT TYP_cgwk "" UWORD B_TRUE 1 100 0 1 BIT_MASK 0xf00 FUNCTION_LIST DFPM_DCG IF_DATA DIM_X 0x383840 EXTERN BYTE IF_DATA MCMESS 0x383840 EXTERN /end MEASUREMENT
/begin MEASUREMENT TYP_ckbi "" UWORD B_TRUE 1 100 0 1 BIT_MASK 0xf00 FUNCTION_LIST DFPM_DCKBI IF_DATA DIM_X 0x383842 EXTERN BYTE IF_DATA MCMESS 0x383842 EXTERN /end MEASUREMENT
/begin MEASUREMENT TYP_cmil "" UWORD B_TRUE 1 100 0 1 BIT_MASK 0xf00 FUNCTION_LIST DFPM_DCMIL IF_DATA DIM_X 0x383844 EXTERN BYTE IF_DATA MCMESS 0x383844 EXTERN /end MEASUREMENT
/begin MEASUREMENT TYP_cra "" UWORD B_TRUE 1 100 0 1 BIT_MASK 0xf00 FUNCTION_LIST DFPM_GGAIRBAG IF_DATA DIM_X 0x383846 EXTERN BYTE IF_DATA MCMESS 0x383846 EXTERN /end MEASUREMENT
/begin MEASUREMENT TYP_dk "" UWORD B_TRUE 1 100 0 1 BIT_MASK 0xf00 FUNCTION_LIST DFPM_DDVE IF_DATA DIM_X 0x383848 EXTERN BYTE IF_DATA MCMESS 0x383848 EXTERN /end MEASUREMENT
/begin MEASUREMENT TYP_dk1p "" UWORD B_TRUE 1 100 0 1 BIT_MASK 0xf00 FUNCTION_LIST DFPM_DDVE IF_DATA DIM_X 0x38384A EXTERN BYTE IF_DATA MCMESS 0x38384A EXTERN /end MEASUREMENT
/begin MEASUREMENT TYP_dk2p "" UWORD B_TRUE 1 100 0 1 BIT_MASK 0xf00 FUNCTION_LIST DFPM_DDVE IF_DATA DIM_X 0x38384C EXTERN BYTE IF_DATA MCMESS 0x38384C EXTERN /end MEASUREMENT
/begin MEASUREMENT TYP_dsl "" UWORD B_TRUE 1 100 0 1 BIT_MASK 0xf00 FUNCTION_LIST DFPM_GGDSAS IF_DATA DIM_X 0x383850 EXTERN BYTE IF_DATA MCMESS 0x383850 EXTERN /end MEASUREMENT
/begin MEASUREMENT TYP_dsu "" UWORD B_TRUE 1 100 0 1 BIT_MASK 0xf00 FUNCTION_LIST DFPM_GGDSAS IF_DATA DIM_X 0x383852 EXTERN BYTE IF_DATA MCMESS 0x383852 EXTERN /end MEASUREMENT
/begin MEASUREMENT TYP_dsvlu "" UWORD B_TRUE 1 100 0 1 BIT_MASK 0xf00 FUNCTION_LIST DFPM_GGDSAS IF_DATA DIM_X 0x383854 EXTERN BYTE IF_DATA MCMESS 0x383854 EXTERN /end MEASUREMENT
/begin MEASUREMENT TYP_dvee "Fehlertyp: DV-E Endstufe" UWORD B_TRUE 1 100 0 1 BIT_MASK 0xf00 FUNCTION_LIST DFPM_DDVE IF_DATA DIM_X 0x383856 EXTERN BYTE IF_DATA MCMESS 0x383856 EXTERN /end MEASUREMENT
/begin MEASUREMENT TYP_dvef "Fehlertyp: DV-E Fehler bei Federprüfung" UWORD B_TRUE 1 100 0 1 BIT_MASK 0xf00 FUNCTION_LIST DFPM_DDVE IF_DATA DIM_X 0x383858 EXTERN BYTE IF_DATA MCMESS 0x383858 EXTERN /end MEASUREMENT
/begin MEASUREMENT TYP_dvefo "" UWORD B_TRUE 1 100 0 1 BIT_MASK 0xf00 FUNCTION_LIST DFPM_DDVE IF_DATA DIM_X 0x38385A EXTERN BYTE IF_DATA MCMESS 0x38385A EXTERN /end MEASUREMENT
/begin MEASUREMENT TYP_dvel "Fehlertyp: DV-E Lageabweichung" UWORD B_TRUE 1 100 0 1 BIT_MASK 0xf00 FUNCTION_LIST DFPM_DDVE IF_DATA DIM_X 0x38385C EXTERN BYTE IF_DATA MCMESS 0x38385C EXTERN /end MEASUREMENT
/begin MEASUREMENT TYP_dven "Fehlertyp: DV-E Fehler bei Prüfung Notluftposition" UWORD B_TRUE 1 100 0 1 BIT_MASK 0xf00 FUNCTION_LIST DFPM_DDVE IF_DATA DIM_X 0x38385E EXTERN BYTE IF_DATA MCMESS 0x38385E EXTERN /end MEASUREMENT
/begin MEASUREMENT TYP_dver "Fehlertyp: DV-E Regelbereich" UWORD B_TRUE 1 100 0 1 BIT_MASK 0xf00 FUNCTION_LIST DFPM_DDVE IF_DATA DIM_X 0x383860 EXTERN BYTE IF_DATA MCMESS 0x383860 EXTERN /end MEASUREMENT
/begin MEASUREMENT TYP_dvet "" UWORD B_TRUE 1 100 0 1 BIT_MASK 0xf00 FUNCTION_LIST DFPM_DDVE IF_DATA DIM_X 0x383862 EXTERN BYTE IF_DATA MCMESS 0x383862 EXTERN /end MEASUREMENT
/begin MEASUREMENT TYP_dveu "Fehlertyp: DV-E Fehler beim UMA-Lernen" UWORD B_TRUE 1 100 0 1 BIT_MASK 0xf00 FUNCTION_LIST DFPM_DDVE IF_DATA DIM_X 0x383864 EXTERN BYTE IF_DATA MCMESS 0x383864 EXTERN /end MEASUREMENT
/begin MEASUREMENT TYP_dveub "" UWORD B_TRUE 1 100 0 1 BIT_MASK 0xf00 FUNCTION_LIST DFPM_DDVE IF_DATA DIM_X 0x383866 EXTERN BYTE IF_DATA MCMESS 0x383866 EXTERN /end MEASUREMENT
/begin MEASUREMENT TYP_dveuw "" UWORD B_TRUE 1 100 0 1 BIT_MASK 0xf00 FUNCTION_LIST DFPM_DDVE IF_DATA DIM_X 0x383868 EXTERN BYTE IF_DATA MCMESS 0x383868 EXTERN /end MEASUREMENT
/begin MEASUREMENT TYP_dvev "Fehlertyp: DV-E Fehler bei Verstärkerabgleich" UWORD B_TRUE 1 100 0 1 BIT_MASK 0xf00 FUNCTION_LIST DFPM_DDVE IF_DATA DIM_X 0x38386A EXTERN BYTE IF_DATA MCMESS 0x38386A EXTERN /end MEASUREMENT
/begin MEASUREMENT TYP_egfe "" UWORD B_TRUE 1 100 0 1 BIT_MASK 0xf00 FUNCTION_LIST DFPM_EGFE IF_DATA DIM_X 0x38386C EXTERN BYTE IF_DATA MCMESS 0x38386C EXTERN /end MEASUREMENT
/begin MEASUREMENT TYP_ev1 "" UWORD B_TRUE 1 100 0 1 BIT_MASK 0xf00 FUNCTION_LIST DFPM_DEKON IF_DATA DIM_X 0x38386E EXTERN BYTE IF_DATA MCMESS 0x38386E EXTERN /end MEASUREMENT
/begin MEASUREMENT TYP_ev2 "" UWORD B_TRUE 1 100 0 1 BIT_MASK 0xf00 FUNCTION_LIST DFPM_DEKON IF_DATA DIM_X 0x383870 EXTERN BYTE IF_DATA MCMESS 0x383870 EXTERN /end MEASUREMENT
/begin MEASUREMENT TYP_ev3 "" UWORD B_TRUE 1 100 0 1 BIT_MASK 0xf00 FUNCTION_LIST DFPM_DEKON IF_DATA DIM_X 0x383872 EXTERN BYTE IF_DATA MCMESS 0x383872 EXTERN /end MEASUREMENT
/begin MEASUREMENT TYP_ev4 "" UWORD B_TRUE 1 100 0 1 BIT_MASK 0xf00 FUNCTION_LIST DFPM_DEKON IF_DATA DIM_X 0x383874 EXTERN BYTE IF_DATA MCMESS 0x383874 EXTERN /end MEASUREMENT
/begin MEASUREMENT TYP_ev5 "" UWORD B_TRUE 1 100 0 1 BIT_MASK 0xf00 FUNCTION_LIST DFPM_DEKON IF_DATA DIM_X 0x383876 EXTERN BYTE IF_DATA MCMESS 0x383876 EXTERN /end MEASUREMENT
/begin MEASUREMENT TYP_ev6 "" UWORD B_TRUE 1 100 0 1 BIT_MASK 0xf00 FUNCTION_LIST DFPM_DEKON IF_DATA DIM_X 0x383878 EXTERN BYTE IF_DATA MCMESS 0x383878 EXTERN /end MEASUREMENT
/begin MEASUREMENT TYP_fgrl "" UWORD B_TRUE 1 100 0 1 BIT_MASK 0xf00 FUNCTION_LIST DFPM_DCFGRL IF_DATA DIM_X 0x38387A EXTERN BYTE IF_DATA MCMESS 0x38387A EXTERN /end MEASUREMENT
/begin MEASUREMENT TYP_fp1p "" UWORD B_TRUE 1 100 0 1 BIT_MASK 0xf00 FUNCTION_LIST DFPM_GGPED IF_DATA DIM_X 0x38387C EXTERN BYTE IF_DATA MCMESS 0x38387C EXTERN /end MEASUREMENT
/begin MEASUREMENT TYP_fp2p "" UWORD B_TRUE 1 100 0 1 BIT_MASK 0xf00 FUNCTION_LIST DFPM_GGPED IF_DATA DIM_X 0x38387E EXTERN BYTE IF_DATA MCMESS 0x38387E EXTERN /end MEASUREMENT
/begin MEASUREMENT TYP_fpp "" UWORD B_TRUE 1 100 0 1 BIT_MASK 0xf00 FUNCTION_LIST DFPM_GGPED IF_DATA DIM_X 0x383880 EXTERN BYTE IF_DATA MCMESS 0x383880 EXTERN /end MEASUREMENT
/begin MEASUREMENT TYP_frao "" UWORD B_TRUE 1 100 0 1 BIT_MASK 0xf00 FUNCTION_LIST DFPM_DKVS IF_DATA DIM_X 0x383882 EXTERN BYTE IF_DATA MCMESS 0x383882 EXTERN /end MEASUREMENT
/begin MEASUREMENT TYP_frao2 "" UWORD B_TRUE 1 100 0 1 BIT_MASK 0xf00 FUNCTION_LIST DFPM_DKVS IF_DATA DIM_X 0x383884 EXTERN BYTE IF_DATA MCMESS 0x383884 EXTERN /end MEASUREMENT
/begin MEASUREMENT TYP_frau "" UWORD B_TRUE 1 100 0 1 BIT_MASK 0xf00 FUNCTION_LIST DFPM_DKVS IF_DATA DIM_X 0x383886 EXTERN BYTE IF_DATA MCMESS 0x383886 EXTERN /end MEASUREMENT
/begin MEASUREMENT TYP_frau2 "" UWORD B_TRUE 1 100 0 1 BIT_MASK 0xf00 FUNCTION_LIST DFPM_DKVS IF_DATA DIM_X 0x383888 EXTERN BYTE IF_DATA MCMESS 0x383888 EXTERN /end MEASUREMENT
/begin MEASUREMENT TYP_frst "" UWORD B_TRUE 1 100 0 1 BIT_MASK 0xf00 FUNCTION_LIST DFPM_DKVS IF_DATA DIM_X 0x38388A EXTERN BYTE IF_DATA MCMESS 0x38388A EXTERN /end MEASUREMENT
/begin MEASUREMENT TYP_frst2 "" UWORD B_TRUE 1 100 0 1 BIT_MASK 0xf00 FUNCTION_LIST DFPM_DKVS IF_DATA DIM_X 0x38388C EXTERN BYTE IF_DATA MCMESS 0x38388C EXTERN /end MEASUREMENT
/begin MEASUREMENT TYP_hsh "Fehlertyp: Heizung Lambdasonde 1 hinter Kat" UWORD B_TRUE 1 100 0 1 BIT_MASK 0xf00 FUNCTION_LIST DFPM_DHLSHK IF_DATA DIM_X 0x38388E EXTERN BYTE IF_DATA MCMESS 0x38388E EXTERN /end MEASUREMENT
/begin MEASUREMENT TYP_hsh2 "Fehlertyp: Heizung Lambdasonde 2 hinter Kat" UWORD B_TRUE 1 100 0 1 BIT_MASK 0xf00 FUNCTION_LIST DFPM_DHLSHK IF_DATA DIM_X 0x383890 EXTERN BYTE IF_DATA MCMESS 0x383890 EXTERN /end MEASUREMENT
/begin MEASUREMENT TYP_hshe "Fehlertyp: Endstufe Heizung Lambdasonde 1 hinter Kat" UWORD B_TRUE 1 100 0 1 BIT_MASK 0xf00 FUNCTION_LIST DFPM_DEKON IF_DATA DIM_X 0x383892 EXTERN BYTE IF_DATA MCMESS 0x383892 EXTERN /end MEASUREMENT
/begin MEASUREMENT TYP_hshe2 "Fehlertyp: Endstufe Heizung Lambdasonde 2 hinter Kat" UWORD B_TRUE 1 100 0 1 BIT_MASK 0xf00 FUNCTION_LIST DFPM_DEKON IF_DATA DIM_X 0x383894 EXTERN BYTE IF_DATA MCMESS 0x383894 EXTERN /end MEASUREMENT
/begin MEASUREMENT TYP_hsv "Fehlertyp: Heizung Lambdasonde 1 vor Kat" UWORD B_TRUE 1 100 0 1 BIT_MASK 0xf00 FUNCTION_LIST DFPM_DHLSU IF_DATA DIM_X 0x383896 EXTERN BYTE IF_DATA MCMESS 0x383896 EXTERN /end MEASUREMENT
/begin MEASUREMENT TYP_hsv2 "Fehlertyp: Heizung Lambdasonde 2 vor Kat" UWORD B_TRUE 1 100 0 1 BIT_MASK 0xf00 FUNCTION_LIST DFPM_DHLSU IF_DATA DIM_X 0x383898 EXTERN BYTE IF_DATA MCMESS 0x383898 EXTERN /end MEASUREMENT
/begin MEASUREMENT TYP_hsvsa "" UWORD B_TRUE 1 100 0 1 BIT_MASK 0xf00 FUNCTION_LIST DFPM_DHLSU IF_DATA DIM_X 0x38389A EXTERN BYTE IF_DATA MCMESS 0x38389A EXTERN /end MEASUREMENT
/begin MEASUREMENT TYP_hsvsa2 "" UWORD B_TRUE 1 100 0 1 BIT_MASK 0xf00 FUNCTION_LIST DFPM_DHLSU IF_DATA DIM_X 0x38389C EXTERN BYTE IF_DATA MCMESS 0x38389C EXTERN /end MEASUREMENT
/begin MEASUREMENT TYP_kat "Fehlertyp: Katalysator-Diagnose" UWORD B_TRUE 1 100 0 1 BIT_MASK 0xf00 FUNCTION_LIST DFPM_DKAT IF_DATA DIM_X 0x38389E EXTERN BYTE IF_DATA MCMESS 0x38389E EXTERN /end MEASUREMENT
/begin MEASUREMENT TYP_kat2 "" UWORD B_TRUE 1 100 0 1 BIT_MASK 0xf00 FUNCTION_LIST DFPM_DKAT IF_DATA DIM_X 0x3838A0 EXTERN BYTE IF_DATA MCMESS 0x3838A0 EXTERN /end MEASUREMENT
/begin MEASUREMENT TYP_kos "" UWORD B_TRUE 1 100 0 1 BIT_MASK 0xf00 FUNCTION_LIST DFPM_DEKON IF_DATA DIM_X 0x3838A2 EXTERN BYTE IF_DATA MCMESS 0x3838A2 EXTERN /end MEASUREMENT
/begin MEASUREMENT TYP_kpe "Fehlertyp: EKP-Relais Endstufe" UWORD B_TRUE 1 100 0 1 BIT_MASK 0xf00 FUNCTION_LIST DFPM_DEKON IF_DATA DIM_X 0x3838A4 EXTERN BYTE IF_DATA MCMESS 0x3838A4 EXTERN /end MEASUREMENT
/begin MEASUREMENT TYP_krnt "" UWORD B_TRUE 1 100 0 1 BIT_MASK 0xf00 FUNCTION_LIST DFPM_DKRNT IF_DATA DIM_X 0x3838A6 EXTERN BYTE IF_DATA MCMESS 0x3838A6 EXTERN /end MEASUREMENT
/begin MEASUREMENT TYP_krof "" UWORD B_TRUE 1 100 0 1 BIT_MASK 0xf00 FUNCTION_LIST DFPM_DKRNT IF_DATA DIM_X 0x3838A8 EXTERN BYTE IF_DATA MCMESS 0x3838A8 EXTERN /end MEASUREMENT
/begin MEASUREMENT TYP_krtp "" UWORD B_TRUE 1 100 0 1 BIT_MASK 0xf00 FUNCTION_LIST DFPM_DKRTP IF_DATA DIM_X 0x3838AA EXTERN BYTE IF_DATA MCMESS 0x3838AA EXTERN /end MEASUREMENT
/begin MEASUREMENT TYP_ks1 "" UWORD B_TRUE 1 100 0 1 BIT_MASK 0xf00 FUNCTION_LIST DFPM_DKRS IF_DATA DIM_X 0x3838AC EXTERN BYTE IF_DATA MCMESS 0x3838AC EXTERN /end MEASUREMENT
/begin MEASUREMENT TYP_ks2 "" UWORD B_TRUE 1 100 0 1 BIT_MASK 0xf00 FUNCTION_LIST DFPM_DKRS IF_DATA DIM_X 0x3838AE EXTERN BYTE IF_DATA MCMESS 0x3838AE EXTERN /end MEASUREMENT
/begin MEASUREMENT TYP_ks3 "" UWORD B_TRUE 1 100 0 1 BIT_MASK 0xf00 FUNCTION_LIST DFPM_DKRS IF_DATA DIM_X 0x3838B0 EXTERN BYTE IF_DATA MCMESS 0x3838B0 EXTERN /end MEASUREMENT
/begin MEASUREMENT TYP_ks4 "" UWORD B_TRUE 1 100 0 1 BIT_MASK 0xf00 FUNCTION_LIST DFPM_DKRS IF_DATA DIM_X 0x3838B2 EXTERN BYTE IF_DATA MCMESS 0x3838B2 EXTERN /end MEASUREMENT
/begin MEASUREMENT TYP_kuppl "Fehlertyp: Gebergröße Kupplungsschalter" UWORD B_TRUE 1 100 0 1 BIT_MASK 0xf00 FUNCTION_LIST DFPM_DKUPPL IF_DATA DIM_X 0x3838B4 EXTERN BYTE IF_DATA MCMESS 0x3838B4 EXTERN /end MEASUREMENT
/begin MEASUREMENT TYP_kwave "" UWORD B_TRUE 1 100 0 1 BIT_MASK 0xf00 FUNCTION_LIST DFPM_DEKON IF_DATA DIM_X 0x3838B6 EXTERN BYTE IF_DATA MCMESS 0x3838B6 EXTERN /end MEASUREMENT
/begin MEASUREMENT TYP_lash "Fehlertyp: Lambda- Sondenalterung hinter Kat" UWORD B_TRUE 1 100 0 1 BIT_MASK 0xf00 FUNCTION_LIST DFPM_DLSAHK IF_DATA DIM_X 0x3838B8 EXTERN BYTE IF_DATA MCMESS 0x3838B8 EXTERN /end MEASUREMENT
/begin MEASUREMENT TYP_lash2 "Fehlertyp: Lambda-Sondenalterung hinter Kat Bank2" UWORD B_TRUE 1 100 0 1 BIT_MASK 0xf00 FUNCTION_LIST DFPM_DLSAHK IF_DATA DIM_X 0x3838BA EXTERN BYTE IF_DATA MCMESS 0x3838BA EXTERN /end MEASUREMENT
/begin MEASUREMENT TYP_lde "" UWORD B_TRUE 1 100 0 1 BIT_MASK 0xf00 FUNCTION_LIST DFPM_DEKON IF_DATA DIM_X 0x3838BC EXTERN BYTE IF_DATA MCMESS 0x3838BC EXTERN /end MEASUREMENT
/begin MEASUREMENT TYP_ldo "" UWORD B_TRUE 1 100 0 1 BIT_MASK 0xf00 FUNCTION_LIST DFPM_DLDR IF_DATA DIM_X 0x3838BE EXTERN BYTE IF_DATA MCMESS 0x3838BE EXTERN /end MEASUREMENT
/begin MEASUREMENT TYP_ldra "" UWORD B_TRUE 1 100 0 1 BIT_MASK 0xf00 FUNCTION_LIST DFPM_DLDR IF_DATA DIM_X 0x3838C0 EXTERN BYTE IF_DATA MCMESS 0x3838C0 EXTERN /end MEASUREMENT
/begin MEASUREMENT TYP_lf1e "" UWORD B_TRUE 1 100 0 1 BIT_MASK 0xf00 FUNCTION_LIST DFPM_DEKON IF_DATA DIM_X 0x3838C2 EXTERN BYTE IF_DATA MCMESS 0x3838C2 EXTERN /end MEASUREMENT
/begin MEASUREMENT TYP_lf2e "" UWORD B_TRUE 1 100 0 1 BIT_MASK 0xf00 FUNCTION_LIST DFPM_DEKON IF_DATA DIM_X 0x3838C4 EXTERN BYTE IF_DATA MCMESS 0x3838C4 EXTERN /end MEASUREMENT
/begin MEASUREMENT TYP_lf3e "" UWORD B_TRUE 1 100 0 1 BIT_MASK 0xf00 FUNCTION_LIST DFPM_DEKON IF_DATA DIM_X 0x3838C6 EXTERN BYTE IF_DATA MCMESS 0x3838C6 EXTERN /end MEASUREMENT
/begin MEASUREMENT TYP_LLR "" UWORD B_TRUE 1 100 0 1 BIT_MASK 0xf00 FUNCTION_LIST DFPM_DLLR IF_DATA DIM_X 0x3838C8 EXTERN BYTE IF_DATA MCMESS 0x3838C8 EXTERN /end MEASUREMENT
/begin MEASUREMENT TYP_lm "" UWORD B_TRUE 1 100 0 1 BIT_MASK 0xf00 FUNCTION_LIST DFPM_DHFM IF_DATA DIM_X 0x3838CA EXTERN BYTE IF_DATA MCMESS 0x3838CA EXTERN /end MEASUREMENT
/begin MEASUREMENT TYP_lsh "Fehlertyp: Lambdasonde 1 hinter Kat" UWORD B_TRUE 1 100 0 1 BIT_MASK 0xf00 FUNCTION_LIST DFPM_DLSH IF_DATA DIM_X 0x3838CC EXTERN BYTE IF_DATA MCMESS 0x3838CC EXTERN /end MEASUREMENT
/begin MEASUREMENT TYP_lsh2 "Fehlertyp: Lambdasonde 2 hinter Kat" UWORD B_TRUE 1 100 0 1 BIT_MASK 0xf00 FUNCTION_LIST DFPM_DLSH IF_DATA DIM_X 0x3838CE EXTERN BYTE IF_DATA MCMESS 0x3838CE EXTERN /end MEASUREMENT
/begin MEASUREMENT TYP_lsv "Fehlertyp: Lambdasonde 1 vor Kat" UWORD B_TRUE 1 100 0 1 BIT_MASK 0xf00 FUNCTION_LIST DFPM_DLSU IF_DATA DIM_X 0x3838D0 EXTERN BYTE IF_DATA MCMESS 0x3838D0 EXTERN /end MEASUREMENT
/begin MEASUREMENT TYP_lsv2 "Fehlertyp: Lambdasonde 2 vor Kat" UWORD B_TRUE 1 100 0 1 BIT_MASK 0xf00 FUNCTION_LIST DFPM_DLSU IF_DATA DIM_X 0x3838D2 EXTERN BYTE IF_DATA MCMESS 0x3838D2 EXTERN /end MEASUREMENT
/begin MEASUREMENT TYP_LSVV "" UWORD B_TRUE 1 100 0 1 BIT_MASK 0xf00 FUNCTION_LIST DFPM_LSVV IF_DATA DIM_X 0x3838D4 EXTERN BYTE IF_DATA MCMESS 0x3838D4 EXTERN /end MEASUREMENT
/begin MEASUREMENT TYP_md "Fehlertyp:  Aussetzer, Summenfehler (multiple)" UWORD B_TRUE 1 100 0 1 BIT_MASK 0xf00 FUNCTION_LIST DFPM_DMDMIL IF_DATA DIM_X 0x3838D6 EXTERN BYTE IF_DATA MCMESS 0x3838D6 EXTERN /end MEASUREMENT
/begin MEASUREMENT TYP_md00 "Fehlertyp:  Aussetzer Zündung 0" UWORD B_TRUE 1 100 0 1 BIT_MASK 0xf00 FUNCTION_LIST DFPM_DMDMIL IF_DATA DIM_X 0x3838D8 EXTERN BYTE IF_DATA MCMESS 0x3838D8 EXTERN /end MEASUREMENT
/begin MEASUREMENT TYP_md01 "Fehlertyp:  Aussetzer Zündung 1" UWORD B_TRUE 1 100 0 1 BIT_MASK 0xf00 FUNCTION_LIST DFPM_DMDMIL IF_DATA DIM_X 0x3838DA EXTERN BYTE IF_DATA MCMESS 0x3838DA EXTERN /end MEASUREMENT
/begin MEASUREMENT TYP_md02 "Fehlertyp:  Aussetzer Zündung 2" UWORD B_TRUE 1 100 0 1 BIT_MASK 0xf00 FUNCTION_LIST DFPM_DMDMIL IF_DATA DIM_X 0x3838DC EXTERN BYTE IF_DATA MCMESS 0x3838DC EXTERN /end MEASUREMENT
/begin MEASUREMENT TYP_md03 "Fehlertyp:  Aussetzer Zündung 3" UWORD B_TRUE 1 100 0 1 BIT_MASK 0xf00 FUNCTION_LIST DFPM_DMDMIL IF_DATA DIM_X 0x3838DE EXTERN BYTE IF_DATA MCMESS 0x3838DE EXTERN /end MEASUREMENT
/begin MEASUREMENT TYP_md04 "Fehlertyp:  Aussetzer Zündung 4" UWORD B_TRUE 1 100 0 1 BIT_MASK 0xf00 FUNCTION_LIST DFPM_DMDMIL IF_DATA DIM_X 0x3838E0 EXTERN BYTE IF_DATA MCMESS 0x3838E0 EXTERN /end MEASUREMENT
/begin MEASUREMENT TYP_md05 "Fehlertyp:  Aussetzer Zündung 5" UWORD B_TRUE 1 100 0 1 BIT_MASK 0xf00 FUNCTION_LIST DFPM_DMDMIL IF_DATA DIM_X 0x3838E2 EXTERN BYTE IF_DATA MCMESS 0x3838E2 EXTERN /end MEASUREMENT
/begin MEASUREMENT TYP_mdb "Fehlertyp: Momentenbegrenzung (begrenzt dauerhaft) aktiv" UWORD B_TRUE 1 100 0 1 BIT_MASK 0xf00 FUNCTION_LIST DFPM_MDKOG IF_DATA DIM_X 0x3838E4 EXTERN BYTE IF_DATA MCMESS 0x3838E4 EXTERN /end MEASUREMENT
/begin MEASUREMENT TYP_msg "" UWORD B_TRUE 1 100 0 1 BIT_MASK 0xf00 FUNCTION_LIST DFPM_MLS IF_DATA DIM_X 0x3838E6 EXTERN BYTE IF_DATA MCMESS 0x3838E6 EXTERN /end MEASUREMENT
/begin MEASUREMENT TYP_msge "" UWORD B_TRUE 1 100 0 1 BIT_MASK 0xf00 FUNCTION_LIST DFPM_DEKON IF_DATA DIM_X 0x3838E8 EXTERN BYTE IF_DATA MCMESS 0x3838E8 EXTERN /end MEASUREMENT
/begin MEASUREMENT TYP_n "" UWORD B_TRUE 1 100 0 1 BIT_MASK 0xf00 FUNCTION_LIST DFPM_DDG IF_DATA DIM_X 0x3838EA EXTERN BYTE IF_DATA MCMESS 0x3838EA EXTERN /end MEASUREMENT
/begin MEASUREMENT TYP_nwkw "" UWORD B_TRUE 1 100 0 1 BIT_MASK 0xf00 FUNCTION_LIST DFPM_DNWKW IF_DATA DIM_X 0x3838EC EXTERN BYTE IF_DATA MCMESS 0x3838EC EXTERN /end MEASUREMENT
/begin MEASUREMENT TYP_nwkw2 "" UWORD B_TRUE 1 100 0 1 BIT_MASK 0xf00 FUNCTION_LIST DFPM_DNWKW IF_DATA DIM_X 0x3838EE EXTERN BYTE IF_DATA MCMESS 0x3838EE EXTERN /end MEASUREMENT
/begin MEASUREMENT TYP_nws "" UWORD B_TRUE 1 100 0 1 BIT_MASK 0xf00 FUNCTION_LIST DFPM_DNWS IF_DATA DIM_X 0x3838F0 EXTERN BYTE IF_DATA MCMESS 0x3838F0 EXTERN /end MEASUREMENT
/begin MEASUREMENT TYP_nws2 "" UWORD B_TRUE 1 100 0 1 BIT_MASK 0xf00 FUNCTION_LIST DFPM_DNWS IF_DATA DIM_X 0x3838F2 EXTERN BYTE IF_DATA MCMESS 0x3838F2 EXTERN /end MEASUREMENT
/begin MEASUREMENT TYP_nwse "" UWORD B_TRUE 1 100 0 1 BIT_MASK 0xf00 FUNCTION_LIST DFPM_DEKON IF_DATA DIM_X 0x3838F4 EXTERN BYTE IF_DATA MCMESS 0x3838F4 EXTERN /end MEASUREMENT
/begin MEASUREMENT TYP_nwse2 "" UWORD B_TRUE 1 100 0 1 BIT_MASK 0xf00 FUNCTION_LIST DFPM_DEKON IF_DATA DIM_X 0x3838F6 EXTERN BYTE IF_DATA MCMESS 0x3838F6 EXTERN /end MEASUREMENT
/begin MEASUREMENT TYP_ph "" UWORD B_TRUE 1 100 0 1 BIT_MASK 0xf00 FUNCTION_LIST DFPM_DPH IF_DATA DIM_X 0x3838F8 EXTERN BYTE IF_DATA MCMESS 0x3838F8 EXTERN /end MEASUREMENT
/begin MEASUREMENT TYP_ph2 "" UWORD B_TRUE 1 100 0 1 BIT_MASK 0xf00 FUNCTION_LIST DFPM_DPH IF_DATA DIM_X 0x3838FA EXTERN BYTE IF_DATA MCMESS 0x3838FA EXTERN /end MEASUREMENT
/begin MEASUREMENT TYP_rkat "" UWORD B_TRUE 1 100 0 1 BIT_MASK 0xf00 FUNCTION_LIST DFPM_DKVS IF_DATA DIM_X 0x3838FC EXTERN BYTE IF_DATA MCMESS 0x3838FC EXTERN /end MEASUREMENT
/begin MEASUREMENT TYP_rkat2 "" UWORD B_TRUE 1 100 0 1 BIT_MASK 0xf00 FUNCTION_LIST DFPM_DKVS IF_DATA DIM_X 0x3838FE EXTERN BYTE IF_DATA MCMESS 0x3838FE EXTERN /end MEASUREMENT
/begin MEASUREMENT TYP_rkaz "" UWORD B_TRUE 1 100 0 1 BIT_MASK 0xf00 FUNCTION_LIST DFPM_DKVS IF_DATA DIM_X 0x383900 EXTERN BYTE IF_DATA MCMESS 0x383900 EXTERN /end MEASUREMENT
/begin MEASUREMENT TYP_rkaz2 "" UWORD B_TRUE 1 100 0 1 BIT_MASK 0xf00 FUNCTION_LIST DFPM_DKVS IF_DATA DIM_X 0x383902 EXTERN BYTE IF_DATA MCMESS 0x383902 EXTERN /end MEASUREMENT
/begin MEASUREMENT TYP_sgeep "" UWORD B_TRUE 1 100 0 1 BIT_MASK 0xf00 FUNCTION_LIST DFPM_DSGEEP IF_DATA DIM_X 0x383904 EXTERN BYTE IF_DATA MCMESS 0x383904 EXTERN /end MEASUREMENT
/begin MEASUREMENT TYP_slpe "" UWORD B_TRUE 1 100 0 1 BIT_MASK 0xf00 FUNCTION_LIST DFPM_DEKON IF_DATA DIM_X 0x383906 EXTERN BYTE IF_DATA MCMESS 0x383906 EXTERN /end MEASUREMENT
/begin MEASUREMENT TYP_sls "Fehlertyp: Sekundärluftsystem" UWORD B_TRUE 1 100 0 1 BIT_MASK 0xf00 FUNCTION_LIST DFPM_DSLSLRS IF_DATA DIM_X 0x383908 EXTERN BYTE IF_DATA MCMESS 0x383908 EXTERN /end MEASUREMENT
/begin MEASUREMENT TYP_sls2 "Fehlertyp: Sekundärluftsystem, Bank 2" UWORD B_TRUE 1 100 0 1 BIT_MASK 0xf00 FUNCTION_LIST DFPM_DSLSLRS IF_DATA DIM_X 0x38390A EXTERN BYTE IF_DATA MCMESS 0x38390A EXTERN /end MEASUREMENT
/begin MEASUREMENT TYP_slv "Fehlertyp: Dichtheit Sekundärluftventil" UWORD B_TRUE 1 100 0 1 BIT_MASK 0xf00 FUNCTION_LIST DFPM_DSLSLRS IF_DATA DIM_X 0x38390C EXTERN BYTE IF_DATA MCMESS 0x38390C EXTERN /end MEASUREMENT
/begin MEASUREMENT TYP_slv2 "Fehlertyp: Dichtheit Sekundärluftventil, Bank 2" UWORD B_TRUE 1 100 0 1 BIT_MASK 0xf00 FUNCTION_LIST DFPM_DSLSLRS IF_DATA DIM_X 0x38390E EXTERN BYTE IF_DATA MCMESS 0x38390E EXTERN /end MEASUREMENT
/begin MEASUREMENT TYP_slve "" UWORD B_TRUE 1 100 0 1 BIT_MASK 0xf00 FUNCTION_LIST DFPM_DEKON IF_DATA DIM_X 0x383910 EXTERN BYTE IF_DATA MCMESS 0x383910 EXTERN /end MEASUREMENT
/begin MEASUREMENT TYP_swe "" UWORD B_TRUE 1 100 0 1 BIT_MASK 0xf00 FUNCTION_LIST DFPM_BGRBS IF_DATA DIM_X 0x383912 EXTERN BYTE IF_DATA MCMESS 0x383912 EXTERN /end MEASUREMENT
/begin MEASUREMENT TYP_ta "" UWORD B_TRUE 1 100 0 1 BIT_MASK 0xf00 FUNCTION_LIST DFPM_GGTFA IF_DATA DIM_X 0x383914 EXTERN BYTE IF_DATA MCMESS 0x383914 EXTERN /end MEASUREMENT
/begin MEASUREMENT TYP_tes "Fehlertyp: Tankdiagnose, TEV offen" UWORD B_TRUE 1 100 0 1 BIT_MASK 0xf00 FUNCTION_LIST DFPM_DTEV IF_DATA DIM_X 0x383916 EXTERN BYTE IF_DATA MCMESS 0x383916 EXTERN /end MEASUREMENT
/begin MEASUREMENT TYP_teve "" UWORD B_TRUE 1 100 0 1 BIT_MASK 0xf00 FUNCTION_LIST DFPM_DEKON IF_DATA DIM_X 0x383918 EXTERN BYTE IF_DATA MCMESS 0x383918 EXTERN /end MEASUREMENT
/begin MEASUREMENT TYP_tget "" UWORD B_TRUE 1 100 0 1 BIT_MASK 0xf00 FUNCTION_LIST DFPM_GGTGET IF_DATA DIM_X 0x38391C EXTERN BYTE IF_DATA MCMESS 0x38391C EXTERN /end MEASUREMENT
/begin MEASUREMENT TYP_thm "" UWORD B_TRUE 1 100 0 1 BIT_MASK 0xf00 FUNCTION_LIST DFPM_GGTFM IF_DATA DIM_X 0x38391E EXTERN BYTE IF_DATA MCMESS 0x38391E EXTERN /end MEASUREMENT
/begin MEASUREMENT TYP_tm "" UWORD B_TRUE 1 100 0 1 BIT_MASK 0xf00 FUNCTION_LIST DFPM_GGTFM IF_DATA DIM_X 0x383920 EXTERN BYTE IF_DATA MCMESS 0x383920 EXTERN /end MEASUREMENT
/begin MEASUREMENT TYP_tmki "" UWORD B_TRUE 1 100 0 1 BIT_MASK 0xf00 FUNCTION_LIST DFPM_DUMMY043 IF_DATA DIM_X 0x383922 EXTERN BYTE IF_DATA MCMESS 0x383922 EXTERN /end MEASUREMENT
/begin MEASUREMENT TYP_tmr "" UWORD B_TRUE 1 100 0 1 BIT_MASK 0xf00 FUNCTION_LIST DFPM_GGTFMR IF_DATA DIM_X 0x383924 EXTERN BYTE IF_DATA MCMESS 0x383924 EXTERN /end MEASUREMENT
/begin MEASUREMENT TYP_tol "" UWORD B_TRUE 1 100 0 1 BIT_MASK 0xf00 FUNCTION_LIST DFPM_GGTFOL IF_DATA DIM_X 0x383926 EXTERN BYTE IF_DATA MCMESS 0x383926 EXTERN /end MEASUREMENT
/begin MEASUREMENT TYP_tum "" UWORD B_TRUE 1 100 0 1 BIT_MASK 0xf00 FUNCTION_LIST DFPM_GGTFUMG IF_DATA DIM_X 0x383928 EXTERN BYTE IF_DATA MCMESS 0x383928 EXTERN /end MEASUREMENT
/begin MEASUREMENT TYP_ub "" UWORD B_TRUE 1 100 0 1 BIT_MASK 0xf00 FUNCTION_LIST DFPM_GGUB IF_DATA DIM_X 0x38392A EXTERN BYTE IF_DATA MCMESS 0x38392A EXTERN /end MEASUREMENT
/begin MEASUREMENT TYP_ufmv "Fehlertyp: Funktionsüberwachung: Momentenvergleich" UWORD B_TRUE 1 100 0 1 BIT_MASK 0xf00 FUNCTION_LIST DFPM_DUF IF_DATA DIM_X 0x38392C EXTERN BYTE IF_DATA MCMESS 0x38392C EXTERN /end MEASUREMENT
/begin MEASUREMENT TYP_ufska "Fehlertyp: Funktionsüberwachung: Sicherheits-Kraftstoff-Abschaltung" UWORD B_TRUE 1 100 0 1 BIT_MASK 0xf00 FUNCTION_LIST DFPM_DUF IF_DATA DIM_X 0x38392E EXTERN BYTE IF_DATA MCMESS 0x38392E EXTERN /end MEASUREMENT
/begin MEASUREMENT TYP_urram "Fehlertyp: Rechnerüberwachung: RAM" UWORD B_TRUE 1 100 0 1 BIT_MASK 0xf00 FUNCTION_LIST DFPM_DUR IF_DATA DIM_X 0x383930 EXTERN BYTE IF_DATA MCMESS 0x383930 EXTERN /end MEASUREMENT
/begin MEASUREMENT TYP_urrom "Fehlertyp: Rechnerüberwachung: ROM" UWORD B_TRUE 1 100 0 1 BIT_MASK 0xf00 FUNCTION_LIST DFPM_DUR IF_DATA DIM_X 0x383932 EXTERN BYTE IF_DATA MCMESS 0x383932 EXTERN /end MEASUREMENT
/begin MEASUREMENT TYP_urrst "Fehlertyp: Rechnerüberwachung: Reset" UWORD B_TRUE 1 100 0 1 BIT_MASK 0xf00 FUNCTION_LIST DFPM_DUR IF_DATA DIM_X 0x383934 EXTERN BYTE IF_DATA MCMESS 0x383934 EXTERN /end MEASUREMENT
/begin MEASUREMENT TYP_uvse "" UWORD B_TRUE 1 100 0 1 BIT_MASK 0xf00 FUNCTION_LIST DFPM_DEKON IF_DATA DIM_X 0x383936 EXTERN BYTE IF_DATA MCMESS 0x383936 EXTERN /end MEASUREMENT
/begin MEASUREMENT TYP_vfz "" UWORD B_TRUE 1 100 0 1 BIT_MASK 0xf00 FUNCTION_LIST DFPM_DVFZ IF_DATA DIM_X 0x383938 EXTERN BYTE IF_DATA MCMESS 0x383938 EXTERN /end MEASUREMENT
/begin MEASUREMENT TYP_vs01 "" UWORD B_TRUE 1 100 0 1 BIT_MASK 0xf00 FUNCTION_LIST DFPM_DVS IF_DATA DIM_X 0x38393A EXTERN BYTE IF_DATA MCMESS 0x38393A EXTERN /end MEASUREMENT
/begin MEASUREMENT TYP_vs02 "" UWORD B_TRUE 1 100 0 1 BIT_MASK 0xf00 FUNCTION_LIST DFPM_DVS IF_DATA DIM_X 0x38393C EXTERN BYTE IF_DATA MCMESS 0x38393C EXTERN /end MEASUREMENT
/begin MEASUREMENT TYP_vs03 "" UWORD B_TRUE 1 100 0 1 BIT_MASK 0xf00 FUNCTION_LIST DFPM_DVS IF_DATA DIM_X 0x38393E EXTERN BYTE IF_DATA MCMESS 0x38393E EXTERN /end MEASUREMENT
/begin MEASUREMENT TYP_vs04 "" UWORD B_TRUE 1 100 0 1 BIT_MASK 0xf00 FUNCTION_LIST DFPM_DVS IF_DATA DIM_X 0x383940 EXTERN BYTE IF_DATA MCMESS 0x383940 EXTERN /end MEASUREMENT
/begin MEASUREMENT TYP_vs05 "" UWORD B_TRUE 1 100 0 1 BIT_MASK 0xf00 FUNCTION_LIST DFPM_DVS IF_DATA DIM_X 0x383942 EXTERN BYTE IF_DATA MCMESS 0x383942 EXTERN /end MEASUREMENT
/begin MEASUREMENT TYP_vs06 "" UWORD B_TRUE 1 100 0 1 BIT_MASK 0xf00 FUNCTION_LIST DFPM_DVS IF_DATA DIM_X 0x383944 EXTERN BYTE IF_DATA MCMESS 0x383944 EXTERN /end MEASUREMENT
/begin MEASUREMENT TYP_vs1e "" UWORD B_TRUE 1 100 0 1 BIT_MASK 0xf00 FUNCTION_LIST DFPM_DEKON IF_DATA DIM_X 0x383946 EXTERN BYTE IF_DATA MCMESS 0x383946 EXTERN /end MEASUREMENT
/begin MEASUREMENT TYP_vs2e "" UWORD B_TRUE 1 100 0 1 BIT_MASK 0xf00 FUNCTION_LIST DFPM_DEKON IF_DATA DIM_X 0x383948 EXTERN BYTE IF_DATA MCMESS 0x383948 EXTERN /end MEASUREMENT
/begin MEASUREMENT TYP_vsb1 "" UWORD B_TRUE 1 100 0 1 BIT_MASK 0xf00 FUNCTION_LIST DFPM_DVS IF_DATA DIM_X 0x38394A EXTERN BYTE IF_DATA MCMESS 0x38394A EXTERN /end MEASUREMENT
/begin MEASUREMENT TYP_vsb2 "" UWORD B_TRUE 1 100 0 1 BIT_MASK 0xf00 FUNCTION_LIST DFPM_DVS IF_DATA DIM_X 0x38394C EXTERN BYTE IF_DATA MCMESS 0x38394C EXTERN /end MEASUREMENT
/begin MEASUREMENT TYP_vss "" UWORD B_TRUE 1 100 0 1 BIT_MASK 0xf00 FUNCTION_LIST DFPM_DVS IF_DATA DIM_X 0x38394E EXTERN BYTE IF_DATA MCMESS 0x38394E EXTERN /end MEASUREMENT
/begin MEASUREMENT TYP_wfs "" UWORD B_TRUE 1 100 0 1 BIT_MASK 0xf00 FUNCTION_LIST DFPM_WFS IF_DATA DIM_X 0x383950 EXTERN BYTE IF_DATA MCMESS 0x383950 EXTERN /end MEASUREMENT
/begin MEASUREMENT tz2fgr_w "Doppelte Zählerzeitkonstante FGR-Regler" UWORD t20msxs_uw_q0p02 1 100 0 1310.7 FUNCTION_LIST FGRMD IF_DATA DIM_X 0x381FA4 EXTERN WORD IF_DATA MCMESS 0x381FA4 EXTERN /end MEASUREMENT
/begin MEASUREMENT tzarni "Zeitzähler AR nach Initialisierung" UBYTE t10msxs_ub_b2p55 1 100 0 2.55 FUNCTION_LIST ARMD IF_DATA DIM_X 0x380C2B EXTERN WORD IF_DATA MCMESS 0x380C2B EXTERN /end MEASUREMENT
/begin MEASUREMENT tzlrdkt_w "Lambdaregler-Periodendauer aus Katdiagnose" UWORD t10msxs_uw_b655p35 1 100 0 655.35 FUNCTION_LIST DKATLRS LRS IF_DATA DIM_X 0x381C60 EXTERN WORD IF_DATA MCMESS 0x381C60 EXTERN /end MEASUREMENT
/begin MEASUREMENT tznd "Tatsächlich angesteuerte Schliesszeit in Zündbereich 1" UWORD tsquant 1 100 0 43690 FUNCTION_LIST AZUE IF_DATA DIM_X 0xF906 INTERN WORD IF_DATA MCMESS 0xF906 INTERN /end MEASUREMENT
/begin MEASUREMENT tznd2 "Tatsächlich angesteuerte Schliesszeit in Zündbereich 1 2tes Zündereignis" UWORD tsquant 1 100 0 43690 FUNCTION_LIST AZUE IF_DATA DIM_X 0xF908 INTERN WORD IF_DATA MCMESS 0xF908 INTERN /end MEASUREMENT
/begin MEASUREMENT UADKI "eingelesener Integratorwert von Klopfauswerteschaltung" UWORD dez 1 100 0 65535 FUNCTION_LIST GGKS IF_DATA DIM_X 0xFAE6 INTERN WORD IF_DATA MCMESS 0xFAE6 INTERN /end MEASUREMENT
/begin MEASUREMENT UADMFA "eingelesener Integratorwert von Klopfauswerteschaltung bei Meßfensteranfang" UWORD dez 1 100 0 65535 FUNCTION_LIST GGKS IF_DATA DIM_X 0xFAE8 INTERN WORD IF_DATA MCMESS 0xFAE8 INTERN /end MEASUREMENT
/begin MEASUREMENT ub "Batteriespannung" UBYTE spg_ubatt 1 100 0 19.38 FUNCTION_LIST GGUB ADVE AEKP AES ATEV BGDVE BGLBZ DCAS DCGE DCKBI DECJ DFFT DHFM DHLSHK DHLSU DLSH GGDVE GGLSU HLSHK HLSU MOTAUS SSTBER87 STADAP T2DFA T2DVE T2LID VS ZUESZ IF_DATA DIM_X 0x380A9A EXTERN WORD IF_DATA MCMESS 0x380A9A EXTERN /end MEASUREMENT
/begin MEASUREMENT ubf "gefilterte Batteriespannung für Batteriespannungsregelung" UBYTE spg_ubatt 1 100 0 19.38 FUNCTION_LIST BGLBZ SLS IF_DATA DIM_X 0x380A95 EXTERN WORD IF_DATA MCMESS 0x380A95 EXTERN /end MEASUREMENT
/begin MEASUREMENT ubsol "Soll-Batteriespannung" UBYTE spg_ubatt 1 100 0 19.38 FUNCTION_LIST BGLBZ IF_DATA DIM_X 0x380A96 EXTERN WORD IF_DATA MCMESS 0x380A96 EXTERN /end MEASUREMENT
/begin MEASUREMENT ubsq "Bordnetzspannung, umgerechnet in Standard-Quantisierung" UBYTE spg_q0p1 1 100 0 25.5 FUNCTION_LIST SWADP GGTFM IF_DATA DIM_X 0x380CA4 EXTERN WORD IF_DATA MCMESS 0x380CA4 EXTERN /end MEASUREMENT
/begin MEASUREMENT udimfgr "Spannung zum umsetzen der Dimminformation" UBYTE spg_ub_b5 1 100 0 4.98047 FUNCTION_LIST ADC IF_DATA DIM_X 0x38094D EXTERN WORD IF_DATA MCMESS 0x38094D EXTERN /end MEASUREMENT
/begin MEASUREMENT udknlp1 "Spannung DK-Poti 1 im NLP" UWORD spg_q1p221_mV 1 100 0 79.9988 FUNCTION_LIST BGDVE ADVE DFFTCNV IF_DATA DIM_X 0x381E7A EXTERN WORD IF_DATA MCMESS 0x381E7A EXTERN /end MEASUREMENT
/begin MEASUREMENT udknlp1r "Dauer-RAM: Spannung DK-Poti 1 im NLP" UWORD spg_q1p221_mV 1 100 0 79.9988 FUNCTION_LIST BGDVE T2LID IF_DATA DIM_X 0x383998 EXTERN WORD IF_DATA MCMESS 0x383998 EXTERN /end MEASUREMENT
/begin MEASUREMENT udknlp1_u "" UBYTE spg_ub_b5 1 100 0 4.98047 FUNCTION_LIST DFFTCNV DFFTK IF_DATA DIM_X 0x3809FE EXTERN WORD IF_DATA MCMESS 0x3809FE EXTERN /end MEASUREMENT
/begin MEASUREMENT udknlp2 "Spannung DK-Poti 2 im NLP" UWORD spg_q1p221_mV 1 100 0 79.9988 FUNCTION_LIST BGDVE ADVE IF_DATA DIM_X 0x381E7C EXTERN WORD IF_DATA MCMESS 0x381E7C EXTERN /end MEASUREMENT
/begin MEASUREMENT udknlp2r "Dauer-RAM: Spannung DK-Poti 2 im NLP" UWORD spg_q1p221_mV 1 100 0 79.9988 FUNCTION_LIST BGDVE IF_DATA DIM_X 0x38399A EXTERN WORD IF_DATA MCMESS 0x38399A EXTERN /end MEASUREMENT
/begin MEASUREMENT udkp1a "Spannung Drosselklappen-Poti 1 am (unteren) Anschlag" UBYTE spg_ub_q0p019 1 100 0 4.98047 FUNCTION_LIST BGDVE DFFTK UFRLC IF_DATA DIM_X 0x380AAD EXTERN WORD IF_DATA MCMESS 0x380AAD EXTERN /end MEASUREMENT
/begin MEASUREMENT udkp1aalt "temp. Spannung DK-Poti 1 am unteren DK-Anschlag" UWORD spg_q1p221_mV 1 100 0 79.9988 FUNCTION_LIST BGDVE IF_DATA DIM_X 0x381E7E EXTERN WORD IF_DATA MCMESS 0x381E7E EXTERN /end MEASUREMENT
/begin MEASUREMENT udkp1asr_w "Dauer-RAM: Spannung DK-Poti 1 am unteren DK-Anschlag, stationärer Anteil" UWORD spg_q1p221_mV 1 100 0 79.9988 FUNCTION_LIST BGDVE IF_DATA DIM_X 0x38399C EXTERN WORD IF_DATA MCMESS 0x38399C EXTERN /end MEASUREMENT
/begin MEASUREMENT udkp1as_w "Spannung DK-Poti 1 am unteren Anschlag, stationärer Anteil" UWORD spg_q1p221_mV 1 100 0 79.9988 FUNCTION_LIST BGDVE IF_DATA DIM_X 0x381E80 EXTERN WORD IF_DATA MCMESS 0x381E80 EXTERN /end MEASUREMENT
/begin MEASUREMENT udkp1a_w "Spannung DK-Poti 1 am unteren Anschlag" UWORD spg_q1p221_mV 1 100 0 79.9988 FUNCTION_LIST BGDVE GGDVE T2LID IF_DATA DIM_X 0x381E82 EXTERN WORD IF_DATA MCMESS 0x381E82 EXTERN /end MEASUREMENT
/begin MEASUREMENT udkp1rob "realer DK-Poti-1-Wert am ob. Abgleichpkt." UWORD spg_uw_q0p00488 1 100 0 319.995 FUNCTION_LIST BGDVE IF_DATA DIM_X 0x381E84 EXTERN WORD IF_DATA MCMESS 0x381E84 EXTERN /end MEASUREMENT
/begin MEASUREMENT udkp1run "realer DK-Poti-1-Wert am unt. Abgleichpkt." UWORD spg_uw_q0p00488 1 100 0 319.995 FUNCTION_LIST BGDVE IF_DATA DIM_X 0x381E86 EXTERN WORD IF_DATA MCMESS 0x381E86 EXTERN /end MEASUREMENT
/begin MEASUREMENT udkp1sv "Maximalwert DK-Poti 1 für Verwendung des verstärkten Signals" UBYTE spg_ub_q0p019 1 100 0 4.98047 FUNCTION_LIST BGDVE GGDVE IF_DATA DIM_X 0x380AAE EXTERN WORD IF_DATA MCMESS 0x380AAE EXTERN /end MEASUREMENT
/begin MEASUREMENT udkp1vor "Dauer-RAM: Spannungsoffset bei DK-Poti-1-Verstärkung" SWORD spg_sw_q0p001222 1 100 -40.0425 40.0413 FUNCTION_LIST BGDVE IF_DATA DIM_X 0x38399E EXTERN WORD IF_DATA MCMESS 0x38399E EXTERN /end MEASUREMENT
/begin MEASUREMENT udkp1vou "Diagnose: 8 Bit Kopie von udkp1vo_w als Umweltgröße" SBYTE spg_q0p00977 1 100 -1.25 1.24023 FUNCTION_LIST BGDVE IF_DATA DIM_X 0x380AA1 EXTERN WORD IF_DATA MCMESS 0x380AA1 EXTERN /end MEASUREMENT
/begin MEASUREMENT udkp1vo_w "Spannungsoffset Verstärker DK-Poti 1" SWORD spg_sw_q0p001222 1 100 -40.0425 40.0413 FUNCTION_LIST BGDVE GGDVE IF_DATA DIM_X 0x381E88 EXTERN WORD IF_DATA MCMESS 0x381E88 EXTERN /end MEASUREMENT
/begin MEASUREMENT udkp1vrob "realer verstärkter DK-Poti-1-Wert am ob. Abgleichpkt." UWORD spg_uw_q0p00488 1 100 0 319.995 FUNCTION_LIST BGDVE IF_DATA DIM_X 0x381E8A EXTERN WORD IF_DATA MCMESS 0x381E8A EXTERN /end MEASUREMENT
/begin MEASUREMENT udkp1vrun "realer verstärkter DK-Poti-1-Wert am unt. Abgleichpkt." UWORD spg_uw_q0p00488 1 100 0 319.995 FUNCTION_LIST BGDVE IF_DATA DIM_X 0x381E8C EXTERN WORD IF_DATA MCMESS 0x381E8C EXTERN /end MEASUREMENT
/begin MEASUREMENT udkp1vv "Diagnose: 8 Bit Kopie von udkp1vv_w als Umweltgröße" UBYTE spg_q0p03125 1 100 0 7.96875 FUNCTION_LIST BGDVE IF_DATA DIM_X 0x380AA2 EXTERN WORD IF_DATA MCMESS 0x380AA2 EXTERN /end MEASUREMENT
/begin MEASUREMENT udkp1vvr "Dauer-RAM: Verstärkung bei DK-Poti-1-Verstärkung" UWORD fak_q0p0039 1 100 0 255.996 FUNCTION_LIST BGDVE IF_DATA DIM_X 0x3839A0 EXTERN WORD IF_DATA MCMESS 0x3839A0 EXTERN /end MEASUREMENT
/begin MEASUREMENT udkp1vv_w "Verstärkung DK-Poti 1" UWORD fak_q0p0039 1 100 0 255.996 FUNCTION_LIST BGDVE GGDVE IF_DATA DIM_X 0x381E8E EXTERN WORD IF_DATA MCMESS 0x381E8E EXTERN /end MEASUREMENT
/begin MEASUREMENT udkp1v_w "Verstärkte Spannung DK-Poti 1" UWORD spg_uw_q0p00488 1 100 0 319.995 FUNCTION_LIST VHW BGDVE GGDVE IF_DATA DIM_X 0x3823D2 EXTERN WORD IF_DATA MCMESS 0x3823D2 EXTERN /end MEASUREMENT
/begin MEASUREMENT udkp1_u "Spannung Drosselklappen-Poti 1 (Byte)" UBYTE spg_ub_b5 1 100 0 4.98047 FUNCTION_LIST DFFTCNV DFFT IF_DATA DIM_X 0x3809FF EXTERN WORD IF_DATA MCMESS 0x3809FF EXTERN /end MEASUREMENT
/begin MEASUREMENT udkp1_w "Spannung DK-Poti 1" UWORD spg_uw_q0p001222 1 100 0 80.0838 FUNCTION_LIST VHW ADVE BGDVE DFFTCNV GGDVE T2LID IF_DATA DIM_X 0x3823D4 EXTERN WORD IF_DATA MCMESS 0x3823D4 EXTERN /end MEASUREMENT
/begin MEASUREMENT udkp2a "Spannung Drosselklappen-Poti 2 am (unteren) Anschlag" UBYTE spg_ub_q0p019 1 100 0 4.98047 FUNCTION_LIST BGDVE UFRLC IF_DATA DIM_X 0x380AAF EXTERN WORD IF_DATA MCMESS 0x380AAF EXTERN /end MEASUREMENT
/begin MEASUREMENT udkp2aalt "temp. Spannung DK-Poti 2 am unteren DK-Anschlag" UWORD spg_q1p221_mV 1 100 0 79.9988 FUNCTION_LIST BGDVE IF_DATA DIM_X 0x381E90 EXTERN WORD IF_DATA MCMESS 0x381E90 EXTERN /end MEASUREMENT
/begin MEASUREMENT udkp2asr_w "Dauer-RAM: Spannung DK-Poti 2 am unteren DK-Anschlag, stationärer Anteil" UWORD spg_q1p221_mV 1 100 0 79.9988 FUNCTION_LIST BGDVE IF_DATA DIM_X 0x3839A2 EXTERN WORD IF_DATA MCMESS 0x3839A2 EXTERN /end MEASUREMENT
/begin MEASUREMENT udkp2as_w "Spannung DK-Poti 2 am unteren Anschlag, stationärer Anteil" UWORD spg_q1p221_mV 1 100 0 79.9988 FUNCTION_LIST BGDVE IF_DATA DIM_X 0x3839A4 EXTERN WORD IF_DATA MCMESS 0x3839A4 EXTERN /end MEASUREMENT
/begin MEASUREMENT udkp2a_w "Spannung DK-Poti 2 am unteren Anschlag" UWORD spg_q1p221_mV 1 100 0 79.9988 FUNCTION_LIST BGDVE GGDVE T2LID IF_DATA DIM_X 0x381E92 EXTERN WORD IF_DATA MCMESS 0x381E92 EXTERN /end MEASUREMENT
/begin MEASUREMENT udkp2_u "Spannung Drosselklappen-Poti 2 (Byte)" UBYTE spg_ub_b5 1 100 0 4.98047 FUNCTION_LIST DFFTCNV DFFT IF_DATA DIM_X 0x380A00 EXTERN WORD IF_DATA MCMESS 0x380A00 EXTERN /end MEASUREMENT
/begin MEASUREMENT udkp2_w "Spannung DK-Poti 2" UWORD spg_uw_q0p001222 1 100 0 80.0838 FUNCTION_LIST VHW ADVE BGDVE DFFTCNV GGDVE T2LID IF_DATA DIM_X 0x3823D6 EXTERN WORD IF_DATA MCMESS 0x3823D6 EXTERN /end MEASUREMENT
/begin MEASUREMENT udkpat_w "temporärer UEA-Offset des DK-Poti" UWORD spg_q1p221_mV 1 100 0 79.9988 FUNCTION_LIST BGDVE IF_DATA DIM_X 0x381E94 EXTERN WORD IF_DATA MCMESS 0x381E94 EXTERN /end MEASUREMENT
/begin MEASUREMENT udksnoa_w "KS-Diagnose: Aktueller Wert obere Schwelle (UDKSNO)" UWORD spg_uw_b1280 1 100 0 1279.98 FUNCTION_LIST DKRS IF_DATA DIM_X 0x382442 EXTERN WORD IF_DATA MCMESS 0x382442 EXTERN /end MEASUREMENT
/begin MEASUREMENT udksnua_w "KS-Diagnose: Aktueller Wert untere Schwelle (UDKSNU)" UWORD spg_uw_b1280 1 100 0 1279.98 FUNCTION_LIST DKRS IF_DATA DIM_X 0x382444 EXTERN WORD IF_DATA MCMESS 0x382444 EXTERN /end MEASUREMENT
/begin MEASUREMENT udsl_u "Spannung Drucksensor Ladedruck (word)" UBYTE spg_ub_b5 1 100 0 4.98047 FUNCTION_LIST DFFTCNV DFFTK IF_DATA DIM_X 0x380A01 EXTERN WORD IF_DATA MCMESS 0x380A01 EXTERN /end MEASUREMENT
/begin MEASUREMENT udsl_w "Spannung Drucksensor Ladedruck (word)" UWORD spg_q0p00488 1 100 0 319.995 FUNCTION_LIST ADC DFFTCNV GGDSAS T2LID VHW IF_DATA DIM_X 0x380F5C EXTERN WORD IF_DATA MCMESS 0x380F5C EXTERN /end MEASUREMENT
/begin MEASUREMENT udst_w "Ausgangsspannung Tankdrucksensor nach AD-Wandler" UWORD spg_q0p00488 1 100 0 319.995 FUNCTION_LIST ADC T2LID VHW IF_DATA DIM_X 0x380F5E EXTERN WORD IF_DATA MCMESS 0x380F5E EXTERN /end MEASUREMENT
/begin MEASUREMENT udsu_u "Spannung Umgebungsdrucksensor (Byte)" UBYTE spg_ub_b5 1 100 0 4.98047 FUNCTION_LIST DFFTCNV DFFTK IF_DATA DIM_X 0x380A02 EXTERN WORD IF_DATA MCMESS 0x380A02 EXTERN /end MEASUREMENT
/begin MEASUREMENT udsu_w "Spannung Umgebungsdrucksensor (word 10-Bit von ADC)" UWORD spg_q0p00488 1 100 0 319.995 FUNCTION_LIST ADC DFFTCNV GGDSAS T2LID VHW IF_DATA DIM_X 0x380F60 EXTERN WORD IF_DATA MCMESS 0x380F60 EXTERN /end MEASUREMENT
/begin MEASUREMENT uefkt1 "" UBYTE fak_ub_q0p0996 1 100 0 25.4 FUNCTION_LIST CAN IF_DATA DIM_X 0x380968 EXTERN WORD IF_DATA MCMESS 0x380968 EXTERN /end MEASUREMENT
/begin MEASUREMENT uefkt2 "" UBYTE fak_ub_q0p0996 1 100 0 25.4 FUNCTION_LIST CAN IF_DATA DIM_X 0x380969 EXTERN WORD IF_DATA MCMESS 0x380969 EXTERN /end MEASUREMENT
/begin MEASUREMENT uhfm_w "HFM-Spannung" UWORD spg_uw_q0p00488 1 100 0 319.995 FUNCTION_LIST VHW DHFM GGHFM T2LID IF_DATA DIM_X 0x3823D8 EXTERN WORD IF_DATA MCMESS 0x3823D8 EXTERN /end MEASUREMENT
/begin MEASUREMENT uhsh "Spannung an der Heizerendstufe hinter Kat" UBYTE spg_ub_b5 1 100 0 4.98047 FUNCTION_LIST ADC DFFT T2LID VHW IF_DATA DIM_X 0x38094E EXTERN WORD IF_DATA MCMESS 0x38094E EXTERN /end MEASUREMENT
/begin MEASUREMENT uhsh2 "Spannung an der Heizerendstufe 2 hinter Kat" UBYTE spg_ub_b5 1 100 0 4.98047 FUNCTION_LIST ADC DFFT T2LID VHW IF_DATA DIM_X 0x38094F EXTERN WORD IF_DATA MCMESS 0x38094F EXTERN /end MEASUREMENT
/begin MEASUREMENT uhsv "Spannung an der Heizerendstufe vor Kat" UBYTE spg_ub_b5 1 100 0 4.98047 FUNCTION_LIST ADC DFFT DHLSU T2LID VHW IF_DATA DIM_X 0x380950 EXTERN WORD IF_DATA MCMESS 0x380950 EXTERN /end MEASUREMENT
/begin MEASUREMENT uhsv2 "Spannung an der Heizerendstufe 2 vor Kat" UBYTE spg_ub_b5 1 100 0 4.98047 FUNCTION_LIST ADC DFFT DHLSU T2LID VHW IF_DATA DIM_X 0x380951 EXTERN WORD IF_DATA MCMESS 0x380951 EXTERN /end MEASUREMENT
/begin MEASUREMENT uma2_res "Antwortbeitrag des Befehlstests" SWORD dez 1 100 -32768 32767 FUNCTION_LIST UMKOMF URCAUS IF_DATA DIM_X 0x382884 EXTERN WORD IF_DATA MCMESS 0x382884 EXTERN /end MEASUREMENT
/begin MEASUREMENT umErrorCtrFr "" UBYTE dez 1 100 0 255 FUNCTION_LIST UMKOMF IF_DATA DIM_X 0x3830BB EXTERN WORD IF_DATA MCMESS 0x3830BB EXTERN /end MEASUREMENT
/begin MEASUREMENT umrst_c_um "Zähler im Dauer-RAM für Software-Reset (Diagnose) aus %UMKOM" UBYTE dez 1 100 0 255 FUNCTION_LIST UFURAM UMKOMF IF_DATA DIM_X 0x3830C2 EXTERN WORD IF_DATA MCMESS 0x3830C2 EXTERN /end MEASUREMENT
/begin MEASUREMENT umsrln_w "Umrechnungsfaktor Füllung in Massenstrom" UWORD m_uw_q0p0005 1 100 0 32.7675 FUNCTION_LIST BGMSZS BGRLP BGSRM DTEV FUEDK IF_DATA DIM_X 0x382028 EXTERN WORD IF_DATA MCMESS 0x382028 EXTERN /end MEASUREMENT
/begin MEASUREMENT upw2ll_w "Spannungswert von PWG-Poti 2 vor der Bewegung" UWORD spg_uw_q0p00488 1 100 0 319.995 FUNCTION_LIST GGPED IF_DATA DIM_X 0x3839A8 EXTERN WORD IF_DATA MCMESS 0x3839A8 EXTERN /end MEASUREMENT
/begin MEASUREMENT upwg1_u "Spannung PWG-Poti 1 (Byte)" UBYTE spg_ub_b5 1 100 0 4.98047 FUNCTION_LIST DFFTCNV DFFT IF_DATA DIM_X 0x380A03 EXTERN WORD IF_DATA MCMESS 0x380A03 EXTERN /end MEASUREMENT
/begin MEASUREMENT upwg1_w "Spannung PWG-Poti 1 (Word)" UWORD spg_uw_b5 1 100 0 319.995 FUNCTION_LIST GGPEDV DFFTCNV GGPED T2LID IF_DATA DIM_X 0x381EE2 EXTERN WORD IF_DATA MCMESS 0x381EE2 EXTERN /end MEASUREMENT
/begin MEASUREMENT upwg2d_u "Verdoppelte PWG-Poti-2-Spannung (Byte)" UBYTE spg_ub_b5 1 100 0 4.98047 FUNCTION_LIST DFFTCNV DFFT IF_DATA DIM_X 0x380A04 EXTERN WORD IF_DATA MCMESS 0x380A04 EXTERN /end MEASUREMENT
/begin MEASUREMENT upwg2d_w "Verdoppelte PWG-Poti-2-Spannung (Word)" UWORD spg_uw_q0p00488 1 100 0 319.995 FUNCTION_LIST GGPED DFFTCNV IF_DATA DIM_X 0x381EBE EXTERN WORD IF_DATA MCMESS 0x381EBE EXTERN /end MEASUREMENT
/begin MEASUREMENT upwg2fil_w "Gefilterte Poti 2 Spannung" UWORD spg_uw_q0p00488 1 100 0 319.995 FUNCTION_LIST GGPED IF_DATA DIM_X 0x381EC0 EXTERN WORD IF_DATA MCMESS 0x381EC0 EXTERN /end MEASUREMENT
/begin MEASUREMENT upwg2_u "Spannung PWG-Poti 2 (Byte)" UBYTE spg_ub_b5 1 100 0 4.98047 FUNCTION_LIST DFFTCNV DFFT IF_DATA DIM_X 0x380A05 EXTERN WORD IF_DATA MCMESS 0x380A05 EXTERN /end MEASUREMENT
/begin MEASUREMENT upwg2_w "Spannung PWG-Poti 2 (Word)" UWORD spg_uw_b5 1 100 0 319.995 FUNCTION_LIST GGPEDV DFFTCNV GGPED T2LID IF_DATA DIM_X 0x381EE4 EXTERN WORD IF_DATA MCMESS 0x381EE4 EXTERN /end MEASUREMENT
/begin MEASUREMENT upwgej_w "Entjitterte PWG-Poti-Spannung" UWORD spg_uw_q0p00488 1 100 0 319.995 FUNCTION_LIST GGPED IF_DATA DIM_X 0x381EC2 EXTERN WORD IF_DATA MCMESS 0x381EC2 EXTERN /end MEASUREMENT
/begin MEASUREMENT upwg_w "Resultierende PWG-Poti-Spannung nach Plausibilitätsprüfung" UWORD spg_uw_q0p00488 1 100 0 319.995 FUNCTION_LIST GGPED IF_DATA DIM_X 0x381EC4 EXTERN WORD IF_DATA MCMESS 0x381EC4 EXTERN /end MEASUREMENT
/begin MEASUREMENT urddktp "Regelspannungsdifferenz, tiefpaßgefiltert" SBYTE spg_sb_q0p01043 1 100 -1.33522 1.32478 FUNCTION_LIST DKATLRS IF_DATA DIM_X 0x380A75 EXTERN WORD IF_DATA MCMESS 0x380A75 EXTERN /end MEASUREMENT
/begin MEASUREMENT urddktp2 "Regelspannungsdifferenz, tiefpaßgefiltert, Bank2" SBYTE spg_sb_q0p01043 1 100 -1.33522 1.32478 FUNCTION_LIST DKATLRS IF_DATA DIM_X 0x380A76 EXTERN WORD IF_DATA MCMESS 0x380A76 EXTERN /end MEASUREMENT
/begin MEASUREMENT urmcksco_0_A "Checksumme über Code der Funktionsüberwachung im zyklischen ROM-Test" UWORD dez 1 100 0 65535 FUNCTION_LIST URMEM IF_DATA DIM_X 0x383A36 EXTERN WORD IF_DATA MCMESS 0x383A36 EXTERN /end MEASUREMENT
/begin MEASUREMENT urmcksco_1_A "Checksumme über Code der Funktionsüberwachung im zyklischen ROM-Test" UWORD dez 1 100 0 65535 FUNCTION_LIST URMEM IF_DATA DIM_X 0x383A38 EXTERN WORD IF_DATA MCMESS 0x383A38 EXTERN /end MEASUREMENT
/begin MEASUREMENT urmcksda_0_A "Checksumme über Daten der Funktionsüberwachung im zyklischen ROM-Test" UWORD dez 1 100 0 65535 FUNCTION_LIST URMEM IF_DATA DIM_X 0x383A3A EXTERN WORD IF_DATA MCMESS 0x383A3A EXTERN /end MEASUREMENT
/begin MEASUREMENT urmcksda_1_A "Checksumme über Daten der Funktionsüberwachung im zyklischen ROM-Test" UWORD dez 1 100 0 65535 FUNCTION_LIST URMEM IF_DATA DIM_X 0x383A3C EXTERN WORD IF_DATA MCMESS 0x383A3C EXTERN /end MEASUREMENT
/begin MEASUREMENT urmpatco_0_A "Patch-Adresse im Code der Funktionsüberwachung für Überprüfung zykl. ROM-Test" UWORD dez 1 100 0 65535 FUNCTION_LIST URMEM IF_DATA DIM_X 0x382938 EXTERN WORD IF_DATA MCMESS 0x382938 EXTERN /end MEASUREMENT
/begin MEASUREMENT urmpatco_1_A "Patch-Adresse im Code der Funktionsüberwachung für Überprüfung zykl. ROM-Test" UWORD dez 1 100 0 65535 FUNCTION_LIST URMEM IF_DATA DIM_X 0x38293A EXTERN WORD IF_DATA MCMESS 0x38293A EXTERN /end MEASUREMENT
/begin MEASUREMENT usbeh2_w "Spannung (word) Lambdasonde mit Widerstand belastet hinter KAT Bank2" UWORD spg_uw_q0p00488_o1 1 100 -1 318.995 FUNCTION_LIST GGLSH IF_DATA DIM_X 0x381D86 EXTERN WORD IF_DATA MCMESS 0x381D86 EXTERN /end MEASUREMENT
/begin MEASUREMENT usbeh_w "Spannung (word) Lambdasonde mit Widerstand belastet hinter KAT" UWORD spg_uw_q0p00488_o1 1 100 -1 318.995 FUNCTION_LIST GGLSH IF_DATA DIM_X 0x381D88 EXTERN WORD IF_DATA MCMESS 0x381D88 EXTERN /end MEASUREMENT
/begin MEASUREMENT userStackUsage "" UWORD fak_uw_b1 1 100 0 0.999985 FUNCTION_LIST STACKMON IF_DATA DIM_X 0x382B16 EXTERN WORD IF_DATA MCMESS 0x382B16 EXTERN /end MEASUREMENT
/begin MEASUREMENT ushb2_w "Spannung (word) Lambdasonde mit Widerstand belastet hinter KAT Bank2" UWORD spg_uw_q0p00488_o1 1 100 -1 318.995 FUNCTION_LIST GGLSH IF_DATA DIM_X 0x381D8A EXTERN WORD IF_DATA MCMESS 0x381D8A EXTERN /end MEASUREMENT
/begin MEASUREMENT ushb_w "Spannung (word) Lambdasonde mit Widerstand belastet hinter KAT" UWORD spg_uw_q0p00488_o1 1 100 -1 318.995 FUNCTION_LIST GGLSH IF_DATA DIM_X 0x381D8C EXTERN WORD IF_DATA MCMESS 0x381D8C EXTERN /end MEASUREMENT
/begin MEASUREMENT ushdktp "Spannung Lambdsonde hinter KAt, tiefpassgefiltert" UBYTE spg_ub_q0p0052 1 100 0 1.33 FUNCTION_LIST DKATLRS T2LID IF_DATA DIM_X 0x380A77 EXTERN WORD IF_DATA MCMESS 0x380A77 EXTERN /end MEASUREMENT
/begin MEASUREMENT ushdktp2 "Spannung Lambdsonde hinter KAt, tiefpassgefiltert" UBYTE spg_ub_q0p0052 1 100 0 1.33 FUNCTION_LIST DKATLRS T2LID IF_DATA DIM_X 0x380A78 EXTERN WORD IF_DATA MCMESS 0x380A78 EXTERN /end MEASUREMENT
/begin MEASUREMENT ushfmxstg "Gefilterte maximale Steigung der Sondenspannung hinter KAT" UBYTE spgg_q0p52 1 100 0 132.6 FUNCTION_LIST DLSAHK T2LID IF_DATA DIM_X 0x382FF2 EXTERN WORD IF_DATA MCMESS 0x382FF2 EXTERN /end MEASUREMENT
/begin MEASUREMENT ushfmxstg2 "Gefilterte maximale Steigung der Sondenspannung hinter KAT Bank2" UBYTE spgg_q0p52 1 100 0 132.6 FUNCTION_LIST DLSAHK T2LID IF_DATA DIM_X 0x382FF3 EXTERN WORD IF_DATA MCMESS 0x382FF3 EXTERN /end MEASUREMENT
/begin COMPU_METHOD B_TRUE "boolsche Zustände, positive Logik" TAB_VERB "%6.3" "" COMPU_TAB_REF B_TRUE /end COMPU_METHOD
/begin COMPU_VTAB B_TRUE "boolsche Zustände, positive Logik" TAB_VERB 2 0 "----" 1 "TRUE" /end COMPU_VTAB
/begin COMPU_METHOD dez "1 : 1 Umrechnug (dez/hex)" RAT_FUNC "%6.2" "" COEFFS 0 1 0 0 0 1 /end COMPU_METHOD
/begin COMPU_METHOD dezsub1 "" RAT_FUNC "%6.2" "-" COEFFS 0 1 -1 0 0 1 /end COMPU_METHOD
/begin COMPU_METHOD dtsegn_b720divZyl "" RAT_FUNC "%6.4" "grad/KW" COEFFS 0 273.067 0 0 0 1 /end COMPU_METHOD
/begin COMPU_METHOD fak_q0p0039 "" RAT_FUNC "%6.4" "-" COEFFS 0 256 0 0 0 1 /end COMPU_METHOD
/begin COMPU_METHOD fak_ub_b2 "" RAT_FUNC "%6.4" "-" COEFFS 0 256 0 0 0 2 /end COMPU_METHOD
/begin COMPU_METHOD fak_ub_q0p0996 "" RAT_FUNC "%6.3" "-" COEFFS 0 255 0 0 0 25.4 /end COMPU_METHOD
/begin COMPU_METHOD fak_uw_b1 "" RAT_FUNC "%7.6" "-" COEFFS 0 65536 0 0 0 1 /end COMPU_METHOD
/begin COMPU_METHOD fuel_ub_q0p5 "" RAT_FUNC "%6.3" "l" COEFFS 0 1 0 0 0 0.5 /end COMPU_METHOD
/begin COMPU_METHOD kw_q6 "" RAT_FUNC "%6.2" "°KW" COEFFS 0 1 0 0 0 6 /end COMPU_METHOD
/begin COMPU_METHOD m_uw_q0p0005 "" RAT_FUNC "%6.5" "kg/h" COEFFS 0 1 0 0 0 0.0005 /end COMPU_METHOD
/begin COMPU_METHOD relNWU_q0p0234 "" RAT_FUNC "%6.4" "%/NWU" COEFFS 0 32 0 0 0 0.75 /end COMPU_METHOD
/begin COMPU_METHOD rel_sb_q0p75 "" RAT_FUNC "%6.3" "%" COEFFS 0 1 0 0 0 0.75 /end COMPU_METHOD
/begin COMPU_METHOD rel_sw_b1536 "" RAT_FUNC "%6.4" "%" COEFFS 0 65536 0 0 0 3072 /end COMPU_METHOD
/begin COMPU_METHOD rel_sw_b200 "" RAT_FUNC "%6.4" "%" COEFFS 0 65536 0 0 0 400 /end COMPU_METHOD
/begin COMPU_METHOD rel_sw_q0p0468 "" RAT_FUNC "%6.4" "%" COEFFS 0 65536 0 0 0 3072 /end COMPU_METHOD
/begin COMPU_METHOD rel_sw_q0p1875 "" RAT_FUNC "%6.3" "%" COEFFS 0 65536 0 0 0 12288 /end COMPU_METHOD
/begin COMPU_METHOD rel_ub_b99p6 "" RAT_FUNC "%6.3" "%" COEFFS 0 256 0 0 0 100 /end COMPU_METHOD
/begin COMPU_METHOD rel_ub_q0p0029 "" RAT_FUNC "%6.4" "%" COEFFS 0 256 0 0 0 0.75 /end COMPU_METHOD
/begin COMPU_METHOD rel_ub_q0p75 "" RAT_FUNC "%6.3" "%" COEFFS 0 1 0 0 0 0.75 /end COMPU_METHOD
/begin COMPU_METHOD rel_uw_b100 "" RAT_FUNC "%6.4" "%" COEFFS 0 65536 0 0 0 100 /end COMPU_METHOD
/begin COMPU_METHOD rel_uw_b192 "" RAT_FUNC "%6.4" "%" COEFFS 0 65536 0 0 0 192 /end COMPU_METHOD
/begin COMPU_METHOD rel_uw_b200 "" RAT_FUNC "%6.4" "%" COEFFS 0 65536 0 0 0 200 /end COMPU_METHOD
/begin COMPU_METHOD rel_uw_b3072 "" RAT_FUNC "%6.4" "%" COEFFS 0 65536 0 0 0 3072 /end COMPU_METHOD
/begin COMPU_METHOD rel_uw_q0p0234 "" RAT_FUNC "%6.4" "%" COEFFS 0 32 0 0 0 0.75 /end COMPU_METHOD
/begin COMPU_METHOD spgg_q0p52 "" RAT_FUNC "%6.3" "mV/ms" COEFFS 0 1 0 0 0 0.52 /end COMPU_METHOD
/begin COMPU_METHOD spg_q0p00488 "" RAT_FUNC "%6.4" "V" COEFFS 0 1024 0 0 0 5 /end COMPU_METHOD
/begin COMPU_METHOD spg_q0p00977 "" RAT_FUNC "%6.4" "V" COEFFS 0 256 0 0 0 2.5 /end COMPU_METHOD
/begin COMPU_METHOD spg_q0p03125 "" RAT_FUNC "%6.4" "V" COEFFS 0 256 0 0 0 8 /end COMPU_METHOD
/begin COMPU_METHOD spg_q0p1 "" RAT_FUNC "%6.3" "V" COEFFS 0 1 0 0 0 0.1 /end COMPU_METHOD
/begin COMPU_METHOD spg_q0p1563 "" RAT_FUNC "%6.3" "V" COEFFS 0 1 0 0 0 0.1563 /end COMPU_METHOD
/begin COMPU_METHOD spg_q1p221_mV "" RAT_FUNC "%6.4" "V" COEFFS 0 65536 0 0 0 80 /end COMPU_METHOD
/begin COMPU_METHOD spg_sb_q0p01043 "" RAT_FUNC "%6.4" "V" COEFFS 0 255 0 0 0 2.66 /end COMPU_METHOD
/begin COMPU_METHOD spg_sw_q0p001222 "" RAT_FUNC "%6.4" "V" COEFFS 0 1 0 0 0 0.001222 /end COMPU_METHOD
/begin COMPU_METHOD spg_ubatt "" RAT_FUNC "%6.4" "V" COEFFS 0 1 0 0 0 0.076 /end COMPU_METHOD
/begin COMPU_METHOD spg_ub_b320 "" RAT_FUNC "%6.2" "V" COEFFS 0 1 0 0 0 1.25 /end COMPU_METHOD
/begin COMPU_METHOD spg_ub_b5 "" RAT_FUNC "%6.4" "V" COEFFS 0 256 0 0 0 5 /end COMPU_METHOD
/begin COMPU_METHOD spg_ub_q0p0052 "" RAT_FUNC "%6.4" "V" COEFFS 0 255 0 0 0 1.33 /end COMPU_METHOD
/begin COMPU_METHOD spg_ub_q0p0098 "" RAT_FUNC "%6.4" "V" COEFFS 0 256 0 0 0 2.5 /end COMPU_METHOD
/begin COMPU_METHOD spg_ub_q0p019 "" RAT_FUNC "%6.4" "V" COEFFS 0 256 0 0 0 5 /end COMPU_METHOD
/begin COMPU_METHOD spg_uw_b1280 "" RAT_FUNC "%6.4" "V" COEFFS 0 1000 0 0 0 19.5313 /end COMPU_METHOD
/begin COMPU_METHOD spg_uw_b5 "" RAT_FUNC "%6.4" "V" COEFFS 0 1024 0 0 0 5 /end COMPU_METHOD
/begin COMPU_METHOD spg_uw_q0p001222 "" RAT_FUNC "%6.4" "V" COEFFS 0 1 0 0 0 0.001222 /end COMPU_METHOD
/begin COMPU_METHOD spg_uw_q0p00488 "" RAT_FUNC "%6.4" "V" COEFFS 0 1024 0 0 0 5 /end COMPU_METHOD
/begin COMPU_METHOD spg_uw_q0p00488_o1 "" RAT_FUNC "%6.3" "V" COEFFS 0 1024 1024 0 0 5 /end COMPU_METHOD
/begin COMPU_METHOD t100msxs_ub_b25p5 "" RAT_FUNC "%6.3" "s" COEFFS 0 1 0 0 0 0.1 /end COMPU_METHOD
/begin COMPU_METHOD t100msxs_uw_b6553p5 "" RAT_FUNC "%6.3" "s" COEFFS 0 1 0 0 0 0.1 /end COMPU_METHOD
/begin COMPU_METHOD t100msxs_uw_b6553p6 "" RAT_FUNC "%6.3" "s" COEFFS 0 10 0 0 0 1 /end COMPU_METHOD
/begin COMPU_METHOD t10msxs_q0p01_o0p05 "" RAT_FUNC "%6.4" "s" COEFFS 0 1 0.05 0 0 0.01 /end COMPU_METHOD
/begin COMPU_METHOD t10msxs_ub_b10p2 "" RAT_FUNC "%6.4" "s" COEFFS 0 1 0 0 0 0.04 /end COMPU_METHOD
/begin COMPU_METHOD t10msxs_ub_b2p55 "" RAT_FUNC "%6.4" "s" COEFFS 0 1 0 0 0 0.01 /end COMPU_METHOD
/begin COMPU_METHOD t10msxs_uw_b655p35 "" RAT_FUNC "%6.4" "s" COEFFS 0 1 0 0 0 0.01 /end COMPU_METHOD
/begin COMPU_METHOD t1sxs_ub_b255 "" RAT_FUNC "%6.2" "s" COEFFS 0 1 0 0 0 1 /end COMPU_METHOD
/begin COMPU_METHOD t1sxs_uw_q1 "" RAT_FUNC "%6.2" "s" COEFFS 0 1 0 0 0 1 /end COMPU_METHOD
/begin COMPU_METHOD t200msxs_uw_q0p2 "" RAT_FUNC "%6.3" "s" COEFFS 0 1 0 0 0 0.2 /end COMPU_METHOD
/begin COMPU_METHOD t20msxs_ub_b5p1 "" RAT_FUNC "%6.4" "s" COEFFS 0 1 0 0 0 0.02 /end COMPU_METHOD
/begin COMPU_METHOD t20msxs_uw_q0p02 "" RAT_FUNC "%6.4" "s" COEFFS 0 1 0 0 0 0.02 /end COMPU_METHOD
/begin COMPU_METHOD t40msxs_ub_q0p04 "" RAT_FUNC "%6.4" "s" COEFFS 0 1 0 0 0 0.04 /end COMPU_METHOD
/begin COMPU_METHOD t40ms_ub_b10200 "" RAT_FUNC "%7.2" "ms" COEFFS 0 1 0 0 0 40 /end COMPU_METHOD
/begin COMPU_METHOD t40usxus_q40 "" RAT_FUNC "%6.1" "us" COEFFS 0 1 0 0 0 40 /end COMPU_METHOD
/begin COMPU_METHOD t500usxms_ub_q0p5 "" RAT_FUNC "%6.3" "ms" COEFFS 0 1 0 0 0 0.5 /end COMPU_METHOD
/begin COMPU_METHOD t50msxs_q0p05 "" RAT_FUNC "%6.4" "s" COEFFS 0 1 0 0 0 0.05 /end COMPU_METHOD
/begin COMPU_METHOD t50msxs_uw_b3276p75 "" RAT_FUNC "%6.4" "s" COEFFS 0 1 0 0 0 0.05 /end COMPU_METHOD
/begin COMPU_METHOD t5usxus_q5 "" RAT_FUNC "%6.2" "us" COEFFS 0 1 0 0 0 5 /end COMPU_METHOD
/begin COMPU_METHOD t6minxh_b6553p5 "" RAT_FUNC "%6.3" "h" COEFFS 0 10 0 0 0 1 /end COMPU_METHOD
/begin COMPU_METHOD temp_q0p0234_o273 "" RAT_FUNC "%6.1" "Grad C" COEFFS 0 1 273.15 0 0 0.0234375 /end COMPU_METHOD
/begin COMPU_METHOD temp_q6_o273 "" RAT_FUNC "%6.1" "Grad C" COEFFS 0 1 273.15 0 0 6 /end COMPU_METHOD
/begin COMPU_METHOD temp_sw_q0p75 "" RAT_FUNC "%6.3" "Grad C" COEFFS 0 4 0 0 0 3 /end COMPU_METHOD
/begin COMPU_METHOD temp_ub_q0p5_o40 "" RAT_FUNC "%6.2" "Grad C" COEFFS 0 1 40 0 0 0.5 /end COMPU_METHOD
/begin COMPU_METHOD temp_ub_q0p75_o48 "" RAT_FUNC "%6.2" "Grad C" COEFFS 0 1 48 0 0 0.75 /end COMPU_METHOD
/begin COMPU_METHOD temp_ub_q1_o40 "" RAT_FUNC "%6.2" "Grad C" COEFFS 0 1 40 0 0 1 /end COMPU_METHOD
/begin COMPU_METHOD temp_ub_q1_o50 "" RAT_FUNC "%6.2" "Grad C" COEFFS 0 1 50 0 0 1 /end COMPU_METHOD
/begin COMPU_METHOD temp_ub_q1_o60 "" RAT_FUNC "%6.2" "Grad C" COEFFS 0 1 60 0 0 1 /end COMPU_METHOD
/begin COMPU_METHOD temp_ub_q5 "" RAT_FUNC "%6.2" "Grad C" COEFFS 0 1 0 0 0 5 /end COMPU_METHOD
/begin COMPU_METHOD temp_ub_q5_o50 "" RAT_FUNC "%6.2" "Grad C" COEFFS 0 1 50 0 0 5 /end COMPU_METHOD
/begin COMPU_METHOD temp_uw_q0p0195_o50 "" RAT_FUNC "%6.2" "Grad C" COEFFS 0 256 12800 0 0 5 /end COMPU_METHOD
/begin COMPU_METHOD temp_uw_q0p75_o48 "" RAT_FUNC "%6.2" "Grad C" COEFFS 0 1 48 0 0 0.00292969 /end COMPU_METHOD
/begin COMPU_METHOD tinjection5_sy "" RAT_FUNC "%6.4" "ms" COEFFS 0 75 0 0 0 1 /end COMPU_METHOD
/begin COMPU_METHOD tinjection_sy "" RAT_FUNC "%6.4" "ms" COEFFS 0 375 0 0 0 1 /end COMPU_METHOD
/begin COMPU_METHOD tknockcon_sy "" RAT_FUNC "%8.7" "s" COEFFS 0 375000 0 0 0 1 /end COMPU_METHOD
/begin COMPU_METHOD tmin_q1p5 "" RAT_FUNC "%6.2" "min" COEFFS 0 1 0 0 0 1.5 /end COMPU_METHOD
/begin COMPU_METHOD tmin_uw_q1 "" RAT_FUNC "%6.2" "min" COEFFS 0 1 0 0 0 1 /end COMPU_METHOD
/begin COMPU_METHOD tsegment_sy "" RAT_FUNC "%6.5" "ms" COEFFS 0 1500 0 0 0 1 /end COMPU_METHOD
/begin COMPU_METHOD tsquant "Umrechnung Segmentzeit in DMD" RAT_FUNC "%6.3" "us" COEFFS 0 1.5 0 0 0 1 /end COMPU_METHOD
/begin COMPU_METHOD tsquantl "" RAT_FUNC "%6.1" "us" COEFFS 0 0.09375 0 0 0 1 /end COMPU_METHOD
/begin COMPU_METHOD txms_uw_q0p1 "" RAT_FUNC "%6.3" "ms" COEFFS 0 10 0 0 0 1 /end COMPU_METHOD
/begin COMPU_METHOD tz10msxs_uw_b327p68 "" RAT_FUNC "%6.2" "s" COEFFS 0 0 327.68 0 1 0 /end COMPU_METHOD
/begin COMPU_METHOD t_q16us "" RAT_FUNC "%6.1" "us" COEFFS 0 1 0 0 0 16 /end COMPU_METHOD
/begin COMPU_METHOD t_q25p6 "" RAT_FUNC "%6.1" "s" COEFFS 0 1 0 0 0 25.6 /end COMPU_METHOD
/begin COMPU_METHOD zk10msxs_uw_b655 "" RAT_FUNC "%10.4" "s" COEFFS 0 0 65536 0 100 0 /end COMPU_METHOD
/begin COMPU_METHOD zw_ub_q0p75 "" RAT_FUNC "%6.3" "Grad KW" COEFFS 0 255 0 0 0 191.25 /end COMPU_METHOD
/begin COMPU_METHOD default "" RAT_FUNC "%6.2" "" COEFFS 0 1 0 0 0 1 /end COMPU_METHOD
/end MODULE
/end PROJECT
