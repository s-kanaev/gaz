/begin PROJECT _7804367 "156"
/begin HEADER "" VERSION "_7804367" PROJECT_NO _7804367 /end HEADER
/begin MODULE DIM ""
/begin MOD_COMMON "" BYTE_ORDER BIG_ENDIAN S_REC_LAYOUT DAMOS /end MOD_COMMON
/begin CHARACTERISTIC CLAKAT2 "Fehlerklasse: Katalysator Bank 2" VALUE 0x810915 KwUb 255.0 dez 0.00 255.0 FUNCTION_LIST DFPM_DKAT IF_DATA DIM_X DIRECT 0x810915 /end CHARACTERISTIC
/begin CHARACTERISTIC CLAKOS "Fehlerklasse: Kompressor-Endstufe" VALUE 0x810916 KwUb 255.0 dez 0.00 255.0 FUNCTION_LIST DFPM_DEKON IF_DATA DIM_X DIRECT 0x810916 /end CHARACTERISTIC
/begin CHARACTERISTIC CLAKPE "Fehlerklasse: EKP-Relais Endstufe" VALUE 0x810917 KwUb 255.0 dez 0.00 255.0 FUNCTION_LIST DFPM_DEKON IF_DATA DIM_X DIRECT 0x810917 /end CHARACTERISTIC
/begin CHARACTERISTIC CLAKRNT "Fehlerklasse: Klopfregelung Nulltest" VALUE 0x810918 KwUb 255.0 dez 0.00 255.0 FUNCTION_LIST DFPM_DKRNT IF_DATA DIM_X DIRECT 0x810918 /end CHARACTERISTIC
/begin CHARACTERISTIC CLAKROF "Fehlerklasse: Klopfreglung Offset" VALUE 0x810919 KwUb 255.0 dez 0.00 255.0 FUNCTION_LIST DFPM_DKRNT IF_DATA DIM_X DIRECT 0x810919 /end CHARACTERISTIC
/begin CHARACTERISTIC CLAKRTP "Fehlerklasse: Klopfregelung Testimpuls" VALUE 0x81091A KwUb 255.0 dez 0.00 255.0 FUNCTION_LIST DFPM_DKRTP IF_DATA DIM_X DIRECT 0x81091A /end CHARACTERISTIC
/begin CHARACTERISTIC CLAKS1 "Fehlerklasse: Klopfsensor 1" VALUE 0x81091B KwUb 255.0 dez 0.00 255.0 FUNCTION_LIST DFPM_DKRS IF_DATA DIM_X DIRECT 0x81091B /end CHARACTERISTIC
/begin CHARACTERISTIC CLAKS2 "Fehlerklasse: Klopfsensor 2" VALUE 0x81091C KwUb 255.0 dez 0.00 255.0 FUNCTION_LIST DFPM_DKRS IF_DATA DIM_X DIRECT 0x81091C /end CHARACTERISTIC
/begin CHARACTERISTIC CLAKS3 "Fehlerklasse: Klopfsensor 3" VALUE 0x81091D KwUb 255.0 dez 0.00 255.0 FUNCTION_LIST DFPM_DKRS IF_DATA DIM_X DIRECT 0x81091D /end CHARACTERISTIC
/begin CHARACTERISTIC CLAKS4 "Fehlerklasse: Klopfsensor 4" VALUE 0x81091E KwUb 255.0 dez 0.00 255.0 FUNCTION_LIST DFPM_DKRS IF_DATA DIM_X DIRECT 0x81091E /end CHARACTERISTIC
/begin CHARACTERISTIC CLAKUPPL "Fehlerklasse: Pedalwertgeber Kupplung" VALUE 0x81091F KwUb 255.0 dez 0.00 255.0 FUNCTION_LIST DFPM_DKUPPL IF_DATA DIM_X DIRECT 0x81091F /end CHARACTERISTIC
/begin CHARACTERISTIC CLAKWAVE "Fehlerklasse: Kühlwasserabsperrventil Endstufe" VALUE 0x810920 KwUb 255.0 dez 0.00 255.0 FUNCTION_LIST DFPM_DEKON IF_DATA DIM_X DIRECT 0x810920 /end CHARACTERISTIC
/begin CHARACTERISTIC CLALASH "Fehlerklasse: Lambdasondenalterung hinter Kat" VALUE 0x810921 KwUb 255.0 dez 0.00 255.0 FUNCTION_LIST DFPM_DLSAHK IF_DATA DIM_X DIRECT 0x810921 /end CHARACTERISTIC
/begin CHARACTERISTIC CLALASH2 "Fehlerklasse: Lambdasondenalterung hinter Kat Bank2" VALUE 0x810922 KwUb 255.0 dez 0.00 255.0 FUNCTION_LIST DFPM_DLSAHK IF_DATA DIM_X DIRECT 0x810922 /end CHARACTERISTIC
/begin CHARACTERISTIC CLALDE "Fehlerklasse: LDR-Taktventil Endstufe" VALUE 0x810923 KwUb 255.0 dez 0.00 255.0 FUNCTION_LIST DFPM_DEKON IF_DATA DIM_X DIRECT 0x810923 /end CHARACTERISTIC
/begin CHARACTERISTIC CLALDO "Fehlerklasse: LDR Überladefehler" VALUE 0x810924 KwUb 255.0 dez 0.00 255.0 FUNCTION_LIST DFPM_DLDR IF_DATA DIM_X DIRECT 0x810924 /end CHARACTERISTIC
/begin CHARACTERISTIC CLALDRA "Fehlerklasse: LDR Regelabweichungsfehler" VALUE 0x810925 KwUb 255.0 dez 0.00 255.0 FUNCTION_LIST DFPM_DLDR IF_DATA DIM_X DIRECT 0x810925 /end CHARACTERISTIC
/begin CHARACTERISTIC CLALF1E "Fehlerklasse: Lüfter1 (Endstufe)" VALUE 0x810926 KwUb 255.0 dez 0.00 255.0 FUNCTION_LIST DFPM_DEKON IF_DATA DIM_X DIRECT 0x810926 /end CHARACTERISTIC
/begin CHARACTERISTIC CLALF2E "Fehlerklasse: Lüfter2 (Endstufe)" VALUE 0x810927 KwUb 255.0 dez 0.00 255.0 FUNCTION_LIST DFPM_DEKON IF_DATA DIM_X DIRECT 0x810927 /end CHARACTERISTIC
/begin CHARACTERISTIC CLALF3E "Fehlerklasse: Lüfter3 (Endstufe)" VALUE 0x810928 KwUb 255.0 dez 0.00 255.0 FUNCTION_LIST DFPM_DEKON IF_DATA DIM_X DIRECT 0x810928 /end CHARACTERISTIC
/begin CHARACTERISTIC CLALLR "Fehlerklasse: Leerlaufregelung" VALUE 0x810929 KwUb 255.0 dez 0.00 255.0 FUNCTION_LIST DFPM_DLLR IF_DATA DIM_X DIRECT 0x810929 /end CHARACTERISTIC
/begin CHARACTERISTIC CLALM "Fehlerklasse: Hauptfüllungssignal" VALUE 0x81092A KwUb 255.0 dez 0.00 255.0 FUNCTION_LIST DFPM_DHFM IF_DATA DIM_X DIRECT 0x81092A /end CHARACTERISTIC
/begin CHARACTERISTIC CLALSH "Fehlerklasse: Lambdasonde hinter Kat" VALUE 0x81092B KwUb 255.0 dez 0.00 255.0 FUNCTION_LIST DFPM_DLSH IF_DATA DIM_X DIRECT 0x81092B /end CHARACTERISTIC
/begin CHARACTERISTIC CLALSH2 "Fehlerklasse: Lambdasonde 2 hinter Kat" VALUE 0x81092C KwUb 255.0 dez 0.00 255.0 FUNCTION_LIST DFPM_DLSH IF_DATA DIM_X DIRECT 0x81092C /end CHARACTERISTIC
/begin CHARACTERISTIC CLALSV "Fehlerklasse: Lambdasonde vor Kat" VALUE 0x81092D KwUb 255.0 dez 0.00 255.0 FUNCTION_LIST DFPM_DLSU IF_DATA DIM_X DIRECT 0x81092D /end CHARACTERISTIC
/begin CHARACTERISTIC CLALSV2 "Fehlerklasse: Lambdasonde 2 vor Kat" VALUE 0x81092E KwUb 255.0 dez 0.00 255.0 FUNCTION_LIST DFPM_DLSU IF_DATA DIM_X DIRECT 0x81092E /end CHARACTERISTIC
/begin CHARACTERISTIC CLALSVV "Fehlerklasse: Vertauschte Lambda-Sonden vor Kat" VALUE 0x81092F KwUb 255.0 dez 0.00 255.0 FUNCTION_LIST DFPM_LSVV IF_DATA DIM_X DIRECT 0x81092F /end CHARACTERISTIC
/begin CHARACTERISTIC CLAMD "Fehlerklasse:  Aussetzer, Summenfehler (multiple)" VALUE 0x810930 KwUb 255.0 dez 0.00 255.0 FUNCTION_LIST DFPM_DMDMIL IF_DATA DIM_X DIRECT 0x810930 /end CHARACTERISTIC
/begin CHARACTERISTIC CLAMD00 "Fehlerklasse:  Aussetzer Zyl. 0" VALUE 0x810931 KwUb 255.0 dez 0.00 255.0 FUNCTION_LIST DFPM_DMDMIL IF_DATA DIM_X DIRECT 0x810931 /end CHARACTERISTIC
/begin CHARACTERISTIC CLAMD01 "Fehlerklasse:  Aussetzer Zyl. 1" VALUE 0x810932 KwUb 255.0 dez 0.00 255.0 FUNCTION_LIST DFPM_DMDMIL IF_DATA DIM_X DIRECT 0x810932 /end CHARACTERISTIC
/begin CHARACTERISTIC CLAMD02 "Fehlerklasse:  Aussetzer Zylinder 2" VALUE 0x810933 KwUb 255.0 dez 0.00 255.0 FUNCTION_LIST DFPM_DMDMIL IF_DATA DIM_X DIRECT 0x810933 /end CHARACTERISTIC
/begin CHARACTERISTIC CLAMD03 "Fehlerklasse:  Aussetzer Zylinder 3" VALUE 0x810934 KwUb 255.0 dez 0.00 255.0 FUNCTION_LIST DFPM_DMDMIL IF_DATA DIM_X DIRECT 0x810934 /end CHARACTERISTIC
/begin CHARACTERISTIC CLAMD04 "Fehlerklasse:  Aussetzer Zylinder 4" VALUE 0x810935 KwUb 255.0 dez 0.00 255.0 FUNCTION_LIST DFPM_DMDMIL IF_DATA DIM_X DIRECT 0x810935 /end CHARACTERISTIC
/begin CHARACTERISTIC CLAMD05 "Fehlerklasse:  Aussetzer Zylinder 5" VALUE 0x810936 KwUb 255.0 dez 0.00 255.0 FUNCTION_LIST DFPM_DMDMIL IF_DATA DIM_X DIRECT 0x810936 /end CHARACTERISTIC
/begin CHARACTERISTIC CLAMDB "Fehlerklasse: Momentbgrenzung Sollmoment" VALUE 0x810937 KwUb 255.0 dez 0.00 255.0 FUNCTION_LIST DFPM_MDKOG IF_DATA DIM_X DIRECT 0x810937 /end CHARACTERISTIC
/begin CHARACTERISTIC CLAMSG "Fehlerklasse: Motorraumspülgebläse" VALUE 0x810938 KwUb 255.0 dez 0.00 255.0 FUNCTION_LIST DFPM_MLS IF_DATA DIM_X DIRECT 0x810938 /end CHARACTERISTIC
/begin CHARACTERISTIC CLAMSGE "Fehlerklasse: Motorraumspülgebläse (Endstufe)" VALUE 0x810939 KwUb 255.0 dez 0.00 255.0 FUNCTION_LIST DFPM_DEKON IF_DATA DIM_X DIRECT 0x810939 /end CHARACTERISTIC
/begin CHARACTERISTIC CLAN "Fehlerklasse: Drehzahlgeber" VALUE 0x81093A KwUb 255.0 dez 0.00 255.0 FUNCTION_LIST DFPM_DDG IF_DATA DIM_X DIRECT 0x81093A /end CHARACTERISTIC
/begin CHARACTERISTIC CLANWKW "Fehlerklasse: Zuordnung Nockenwelle zu Kurbelwelle" VALUE 0x81093B KwUb 255.0 dez 0.00 255.0 FUNCTION_LIST DFPM_DNWKW IF_DATA DIM_X DIRECT 0x81093B /end CHARACTERISTIC
/begin CHARACTERISTIC CLANWKW2 "Fehlerklasse: Zuordnung Nockenwelle 2 zu Kurbelwelle" VALUE 0x81093C KwUb 255.0 dez 0.00 255.0 FUNCTION_LIST DFPM_DNWKW IF_DATA DIM_X DIRECT 0x81093C /end CHARACTERISTIC
/begin CHARACTERISTIC CLANWS "Fehlerklasse: Nockenwellensteuerung" VALUE 0x81093D KwUb 255.0 dez 0.00 255.0 FUNCTION_LIST DFPM_DNWS IF_DATA DIM_X DIRECT 0x81093D /end CHARACTERISTIC
/begin CHARACTERISTIC CLANWS2 "Fehlerklasse: Nockenwellensteuerung Bank 2" VALUE 0x81093E KwUb 255.0 dez 0.00 255.0 FUNCTION_LIST DFPM_DNWS IF_DATA DIM_X DIRECT 0x81093E /end CHARACTERISTIC
/begin CHARACTERISTIC CLANWSE "Fehlerklasse: Nockenwellensteuerungsventil Endstufe" VALUE 0x81093F KwUb 255.0 dez 0.00 255.0 FUNCTION_LIST DFPM_DEKON IF_DATA DIM_X DIRECT 0x81093F /end CHARACTERISTIC
/begin CHARACTERISTIC CLANWSE2 "Fehlerklasse: Nockenwellensteuerungsventil Endstufe Bank 2" VALUE 0x810940 KwUb 255.0 dez 0.00 255.0 FUNCTION_LIST DFPM_DEKON IF_DATA DIM_X DIRECT 0x810940 /end CHARACTERISTIC
/begin CHARACTERISTIC CLAPH "Fehlerklasse: Phasengeber" VALUE 0x810941 KwUb 255.0 dez 0.00 255.0 FUNCTION_LIST DFPM_DPH IF_DATA DIM_X DIRECT 0x810941 /end CHARACTERISTIC
/begin CHARACTERISTIC CLAPH2 "Fehlerklasse: Phasengeber Bank 2" VALUE 0x810942 KwUb 255.0 dez 0.00 255.0 FUNCTION_LIST DFPM_DPH IF_DATA DIM_X DIRECT 0x810942 /end CHARACTERISTIC
/begin CHARACTERISTIC CLARKAT "Fehlerklasse: LR-Adaption additiver Bereich pro Zeit" VALUE 0x810943 KwUb 255.0 dez 0.00 255.0 FUNCTION_LIST DFPM_DKVS IF_DATA DIM_X DIRECT 0x810943 /end CHARACTERISTIC
/begin CHARACTERISTIC CLARKAT2 "Fehlerklasse: LR-Adaption additiver Bereich pro Zeit Bank 2" VALUE 0x810944 KwUb 255.0 dez 0.00 255.0 FUNCTION_LIST DFPM_DKVS IF_DATA DIM_X DIRECT 0x810944 /end CHARACTERISTIC
/begin CHARACTERISTIC CLARKAZ "Fehlerklasse: LR-Adaption additiver Bereich pro Zündung" VALUE 0x810945 KwUb 255.0 dez 0.00 255.0 FUNCTION_LIST DFPM_DKVS IF_DATA DIM_X DIRECT 0x810945 /end CHARACTERISTIC
/begin CHARACTERISTIC CLARKAZ2 "Fehlerklasse: LR-Adaption additiver Bereich pro Zündung Bank 2" VALUE 0x810946 KwUb 255.0 dez 0.00 255.0 FUNCTION_LIST DFPM_DKVS IF_DATA DIM_X DIRECT 0x810946 /end CHARACTERISTIC
/begin CHARACTERISTIC CLASGEEP "Fehlerklasse: SG defekt (EEPROM)" VALUE 0x810947 KwUb 255.0 dez 0.00 255.0 FUNCTION_LIST DFPM_DSGEEP IF_DATA DIM_X DIRECT 0x810947 /end CHARACTERISTIC
/begin CHARACTERISTIC CLASLPE "Fehlerklasse: Sekundärluftpumpe Endstufe" VALUE 0x810948 KwUb 255.0 dez 0.00 255.0 FUNCTION_LIST DFPM_DEKON IF_DATA DIM_X DIRECT 0x810948 /end CHARACTERISTIC
/begin CHARACTERISTIC CLASLS "Fehlerklasse: Sekundärluftsystem" VALUE 0x810949 KwUb 255.0 dez 0.00 255.0 FUNCTION_LIST DFPM_DSLSLRS IF_DATA DIM_X DIRECT 0x810949 /end CHARACTERISTIC
/begin CHARACTERISTIC CLASLS2 "Fehlerklasse: Sekundärluftsystem, Bank 2" VALUE 0x81094A KwUb 255.0 dez 0.00 255.0 FUNCTION_LIST DFPM_DSLSLRS IF_DATA DIM_X DIRECT 0x81094A /end CHARACTERISTIC
/begin CHARACTERISTIC CLASLV "Fehlerklasse: Dichtheit Sekundärluftventil" VALUE 0x81094B KwUb 255.0 dez 0.00 255.0 FUNCTION_LIST DFPM_DSLSLRS IF_DATA DIM_X DIRECT 0x81094B /end CHARACTERISTIC
/begin CHARACTERISTIC CLASLV2 "Fehlerklasse: Dichtheit Sekundärluftventil, Bank 2" VALUE 0x81094C KwUb 255.0 dez 0.00 255.0 FUNCTION_LIST DFPM_DSLSLRS IF_DATA DIM_X DIRECT 0x81094C /end CHARACTERISTIC
/begin CHARACTERISTIC CLASLVE "Fehlerklasse: Sekundärluftventil Endstufe" VALUE 0x81094D KwUb 255.0 dez 0.00 255.0 FUNCTION_LIST DFPM_DEKON IF_DATA DIM_X DIRECT 0x81094D /end CHARACTERISTIC
/begin CHARACTERISTIC CLASWE "Fehlerklasse: Beschleunigungssensor der Schlechtwegerkennung" VALUE 0x81094E KwUb 255.0 dez 0.00 255.0 FUNCTION_LIST DFPM_BGRBS IF_DATA DIM_X DIRECT 0x81094E /end CHARACTERISTIC
/begin CHARACTERISTIC CLATA "Fehlerklasse: Ansauglufttemperatur TANS (/Ladeluft-)" VALUE 0x81094F KwUb 255.0 dez 0.00 255.0 FUNCTION_LIST DFPM_GGTFA IF_DATA DIM_X DIRECT 0x81094F /end CHARACTERISTIC
/begin CHARACTERISTIC CLATES "Fehlerklasse: Tankdiagnose, TEV offen" VALUE 0x810950 KwUb 255.0 dez 0.00 255.0 FUNCTION_LIST DFPM_DTEV IF_DATA DIM_X DIRECT 0x810950 /end CHARACTERISTIC
/begin CHARACTERISTIC CLATEVE "Fehlerklasse: Tankentlüftungsventil Endstufe" VALUE 0x810951 KwUb 255.0 dez 0.00 255.0 FUNCTION_LIST DFPM_DEKON IF_DATA DIM_X DIRECT 0x810951 /end CHARACTERISTIC
/begin CHARACTERISTIC CLATEVE2 "Fehlerklasse: Tankentlüftungsventil Endstufe Bank 2" VALUE 0x810952 KwUb 255.0 dez 0.00 255.0 FUNCTION_LIST DFPM_DUMMY043 IF_DATA DIM_X DIRECT 0x810952 /end CHARACTERISTIC
/begin CHARACTERISTIC CLATGET "Fehlerklasse: Getriebetemperatur TGET" VALUE 0x810953 KwUb 255.0 dez 0.00 255.0 FUNCTION_LIST DFPM_GGTGET IF_DATA DIM_X DIRECT 0x810953 /end CHARACTERISTIC
/begin CHARACTERISTIC CLATHM "Fehlerklasse: Thermostat-Diagnose THM" VALUE 0x810954 KwUb 255.0 dez 0.00 255.0 FUNCTION_LIST DFPM_GGTFM IF_DATA DIM_X DIRECT 0x810954 /end CHARACTERISTIC
/begin CHARACTERISTIC CLATM "Fehlerklasse: Motortemperatur TMOT" VALUE 0x810955 KwUb 255.0 dez 0.00 255.0 FUNCTION_LIST DFPM_GGTFM IF_DATA DIM_X DIRECT 0x810955 /end CHARACTERISTIC
/begin CHARACTERISTIC CLATMKI "Fehlerklasse: Motortemperatur aus Kombiinstrument TMKI" VALUE 0x810956 KwUb 255.0 dez 0.00 255.0 FUNCTION_LIST DFPM_DUMMY043 IF_DATA DIM_X DIRECT 0x810956 /end CHARACTERISTIC
/begin CHARACTERISTIC CLATMR "Fehlerklasse: Motortaumtemperatur TMR" VALUE 0x810957 KwUb 255.0 dez 0.00 255.0 FUNCTION_LIST DFPM_GGTFMR IF_DATA DIM_X DIRECT 0x810957 /end CHARACTERISTIC
/begin CHARACTERISTIC CLATOL "Fehlerklasse: (Motor-) Oeltemperatur TOL" VALUE 0x810958 KwUb 255.0 dez 0.00 255.0 FUNCTION_LIST DFPM_GGTFOL IF_DATA DIM_X DIRECT 0x810958 /end CHARACTERISTIC
/begin CHARACTERISTIC CLATUM "Fehlerklasse: Umgebungstemperatur TUM" VALUE 0x810959 KwUb 255.0 dez 0.00 255.0 FUNCTION_LIST DFPM_GGTFUMG IF_DATA DIM_X DIRECT 0x810959 /end CHARACTERISTIC
/begin CHARACTERISTIC CLAUB "Fehlerklasse: Batteriespannung UB (Bordnetz)" VALUE 0x81095A KwUb 255.0 dez 0.00 255.0 FUNCTION_LIST DFPM_GGUB IF_DATA DIM_X DIRECT 0x81095A /end CHARACTERISTIC
/begin CHARACTERISTIC CLAUFMV "Fehlerklasse: Funktionsüberwachung: Momentenvergleich" VALUE 0x81095B KwUb 255.0 dez 0.00 255.0 FUNCTION_LIST DFPM_DUF IF_DATA DIM_X DIRECT 0x81095B /end CHARACTERISTIC
/begin CHARACTERISTIC CLAUFSKA "Fehlerklasse: Funktionsüberwachung: Sicherheits-Kraftstoff-Abschaltung" VALUE 0x81095C KwUb 255.0 dez 0.00 255.0 FUNCTION_LIST DFPM_DUF IF_DATA DIM_X DIRECT 0x81095C /end CHARACTERISTIC
/begin CHARACTERISTIC CLAURRAM "Fehlerklasse: Rechnerüberwachung: RAM" VALUE 0x81095D KwUb 255.0 dez 0.00 255.0 FUNCTION_LIST DFPM_DUR IF_DATA DIM_X DIRECT 0x81095D /end CHARACTERISTIC
/begin CHARACTERISTIC CLAURROM "Fehlerklasse: Rechnerüberwachung: ROM" VALUE 0x81095E KwUb 255.0 dez 0.00 255.0 FUNCTION_LIST DFPM_DUR IF_DATA DIM_X DIRECT 0x81095E /end CHARACTERISTIC
/begin CHARACTERISTIC CLAURRST "Fehlerklasse: Rechnerüberwachung: Reset" VALUE 0x81095F KwUb 255.0 dez 0.00 255.0 FUNCTION_LIST DFPM_DUR IF_DATA DIM_X DIRECT 0x81095F /end CHARACTERISTIC
/begin CHARACTERISTIC CLAUVSE "Fehlerklasse: Endstufe Umluftventil Turbo" VALUE 0x810960 KwUb 255.0 dez 0.00 255.0 FUNCTION_LIST DFPM_DEKON IF_DATA DIM_X DIRECT 0x810960 /end CHARACTERISTIC
/begin CHARACTERISTIC CLAVFZ "Fehlerklasse: Geschwindigkeitssignal" VALUE 0x810961 KwUb 255.0 dez 0.00 255.0 FUNCTION_LIST DFPM_DVFZ IF_DATA DIM_X DIRECT 0x810961 /end CHARACTERISTIC
/begin CHARACTERISTIC CLAVS01 "" VALUE 0x810962 KwUb 255.0 dez 0.00 255.0 FUNCTION_LIST DFPM_DVS IF_DATA DIM_X DIRECT 0x810962 /end CHARACTERISTIC
/begin CHARACTERISTIC CLAVS02 "" VALUE 0x810963 KwUb 255.0 dez 0.00 255.0 FUNCTION_LIST DFPM_DVS IF_DATA DIM_X DIRECT 0x810963 /end CHARACTERISTIC
/begin CHARACTERISTIC CLAVS03 "" VALUE 0x810964 KwUb 255.0 dez 0.00 255.0 FUNCTION_LIST DFPM_DVS IF_DATA DIM_X DIRECT 0x810964 /end CHARACTERISTIC
/begin CHARACTERISTIC CLAVS04 "" VALUE 0x810965 KwUb 255.0 dez 0.00 255.0 FUNCTION_LIST DFPM_DVS IF_DATA DIM_X DIRECT 0x810965 /end CHARACTERISTIC
/begin CHARACTERISTIC CLAVS05 "" VALUE 0x810966 KwUb 255.0 dez 0.00 255.0 FUNCTION_LIST DFPM_DVS IF_DATA DIM_X DIRECT 0x810966 /end CHARACTERISTIC
/begin CHARACTERISTIC CLAVS06 "" VALUE 0x810967 KwUb 255.0 dez 0.00 255.0 FUNCTION_LIST DFPM_DVS IF_DATA DIM_X DIRECT 0x810967 /end CHARACTERISTIC
/begin CHARACTERISTIC CLAVS1E "Fehlerklasse: Endstufe Ventilhubsteuerung 1" VALUE 0x810968 KwUb 255.0 dez 0.00 255.0 FUNCTION_LIST DFPM_DEKON IF_DATA DIM_X DIRECT 0x810968 /end CHARACTERISTIC
/begin CHARACTERISTIC CLAVS2E "Fehlerklasse: Endstufe Ventilhubsteuerung 2" VALUE 0x810969 KwUb 255.0 dez 0.00 255.0 FUNCTION_LIST DFPM_DEKON IF_DATA DIM_X DIRECT 0x810969 /end CHARACTERISTIC
/begin CHARACTERISTIC CLAVSB1 "" VALUE 0x81096A KwUb 255.0 dez 0.00 255.0 FUNCTION_LIST DFPM_DVS IF_DATA DIM_X DIRECT 0x81096A /end CHARACTERISTIC
/begin CHARACTERISTIC CLAVSB2 "" VALUE 0x81096B KwUb 255.0 dez 0.00 255.0 FUNCTION_LIST DFPM_DVS IF_DATA DIM_X DIRECT 0x81096B /end CHARACTERISTIC
/begin CHARACTERISTIC CLAVSS "" VALUE 0x81096C KwUb 255.0 dez 0.00 255.0 FUNCTION_LIST DFPM_DVS IF_DATA DIM_X DIRECT 0x81096C /end CHARACTERISTIC
/begin CHARACTERISTIC CLAWFS "Fehlerklasse: Wegfahrsperre" VALUE 0x81096D KwUb 255.0 dez 0.00 255.0 FUNCTION_LIST DFPM_WFS IF_DATA DIM_X DIRECT 0x81096D /end CHARACTERISTIC
/begin CHARACTERISTIC CLAZZZ "Dummy: Tabellenende" VALUE 0x81096E KwUb 255.0 dez 0.00 255.0 FUNCTION_LIST DFPM_DFPM IF_DATA DIM_X DIRECT 0x81096E /end CHARACTERISTIC
/begin CHARACTERISTIC CLRS "Codewort für Betriebsmodi LRS" VALUE 0x811FF0 KwUb 255.0 dez 0.00 255.0 FUNCTION_LIST LRS LRSEB IF_DATA DIM_X DIRECT 0x811FF0 /end CHARACTERISTIC
/begin CHARACTERISTIC CLRSHK "Codewort für Freigabe LRSHK und Auswahl Initialisierung" VALUE 0x812134 KwUb 255.0 dez 0.00 255.0 FUNCTION_LIST LRSHK IF_DATA DIM_X DIRECT 0x812134 /end CHARACTERISTIC
/begin CHARACTERISTIC CLRSKA "Code-Wort Funktionsart Kat-Ausräumen" VALUE 0x8198D0 KwUb 255.0 dez 0.00 255.0 FUNCTION_LIST LRSKA IF_DATA DIM_X DIRECT 0x8198D0 /end CHARACTERISTIC
/begin CHARACTERISTIC CLRZWTMS "Codewort Zwangseinschaltung LR gemäß CARB-Forderung" VALUE 0x8198EA KwUb 255.0 dez 0.00 255.0 FUNCTION_LIST LRSEB IF_DATA DIM_X DIRECT 0x8198EA /end CHARACTERISTIC
/begin CHARACTERISTIC CMSR_DAT_UC "" VAL_BLK 0x811CAC KwbUb 99.61 rel_ub_q0p3906 0.00 99.61 NUMBER 16 FUNCTION_LIST URCEIN IF_DATA DIM_X DIRECT 0x811CAC /end CHARACTERISTIC
/begin CHARACTERISTIC CNFKUPPL "Konfigurationsflag für die Auswertung des Kuplg.schalters in der LLR" VALUE 0x8114CA KwUb 255.0 dez 0.00 255.0 FUNCTION_LIST LLRBB IF_DATA DIM_X DIRECT 0x8114CA /end CHARACTERISTIC
/begin CHARACTERISTIC CNFMDVER "Codewort zur Konfiguration von MDVER" VALUE 0x8197CC KwUb 255.0 dez 0.00 255.0 FUNCTION_LIST MDVER IF_DATA DIM_X DIRECT 0x8197CC /end CHARACTERISTIC
/begin CHARACTERISTIC CORTINC "Wert der bei Zahnkorrektur aufaddiert wird" VALUE 0x810BFB KwUb 255.0 dez 0.00 255.0 FUNCTION_LIST DDG IF_DATA DIM_X DIRECT 0x810BFB /end CHARACTERISTIC
/begin CHARACTERISTIC CORTINIT "Initialisierungswert für Zähler Zahnkorrektur" VALUE 0x8181B3 KwUb 255.0 dez 0.00 255.0 FUNCTION_LIST DDG IF_DATA DIM_X DIRECT 0x8181B3 /end CHARACTERISTIC
/begin CHARACTERISTIC CORTMX "Maximal zulässiger Wert für den Zahnkorrekturzähler" VALUE 0x810BFC KwUb 255.0 dez 0.00 255.0 FUNCTION_LIST DDG IF_DATA DIM_X DIRECT 0x810BFC /end CHARACTERISTIC
/begin CHARACTERISTIC CPLRA "Codewort für Umschaltung DKVS von HFM- auf P-System" VALUE 0x818808 KwUb 255.0 dez 0.00 255.0 FUNCTION_LIST DKVS IF_DATA DIM_X DIRECT 0x818808 /end CHARACTERISTIC
/begin CHARACTERISTIC CREDSTU "Codewort für Reduzierstufe ein/aus" VALUE 0x811B4F KwUb 255.0 dez 0.00 255.0 FUNCTION_LIST MDRED1 IF_DATA DIM_X DIRECT 0x811B4F /end CHARACTERISTIC
/begin CHARACTERISTIC CRFRMAX "Größte erlaubte Frequenz für Abschalten der EKP" VALUE 0x812B52 KwUb 1.700 t10msxs_ub_b2p55 0.00 1.700 FUNCTION_LIST GGAIRB IF_DATA DIM_X DIRECT 0x812B52 /end CHARACTERISTIC
/begin CHARACTERISTIC CRFRMIN "Kleinste erlaubte Frequenz für Abschalten der EKP" VALUE 0x812B53 KwUb 1.700 t10msxs_ub_b2p55 0.00 1.700 FUNCTION_LIST GGAIRB IF_DATA DIM_X DIRECT 0x812B53 /end CHARACTERISTIC
/begin CHARACTERISTIC CRGRTV "Entprellzähler für Crasherkennung" VALUE 0x812B54 KwUb 255.0 dez 0.00 255.0 FUNCTION_LIST GGAIRB IF_DATA DIM_X DIRECT 0x812B54 /end CHARACTERISTIC
/begin CHARACTERISTIC CRHLCNT "Heilungszähler Airbag-STeuergerät Crashsignal" VALUE 0x812B55 KwUb 255.0 dez 0.00 255.0 FUNCTION_LIST GGAIRB IF_DATA DIM_X DIRECT 0x812B55 /end CHARACTERISTIC
/begin CHARACTERISTIC CRMAXERR "Entprellzähler für Crashsignalfehlererkeuung" VALUE 0x812B56 KwUb 255.0 dez 0.00 255.0 FUNCTION_LIST GGAIRB IF_DATA DIM_X DIRECT 0x812B56 /end CHARACTERISTIC
/begin CHARACTERISTIC CRTIMOUT "Wartezeit bis zum Erkennen, daß das Signal fehlt." VALUE 0x812B57 KwUb 1.700 t10msxs_ub_b2p55 0.00 1.700 FUNCTION_LIST GGAIRB IF_DATA DIM_X DIRECT 0x812B57 /end CHARACTERISTIC
/begin CHARACTERISTIC CRTVMAX "Größtes Tastverhältnis für EKP-Abschaltung" VALUE 0x812B58 KwUb 1.700 t10msxs_ub_b2p55 0.00 1.700 FUNCTION_LIST GGAIRB IF_DATA DIM_X DIRECT 0x812B58 /end CHARACTERISTIC
/begin CHARACTERISTIC CRTVMIN "Kleinstes Tastverhältnis für EKP-Abschaltung" VALUE 0x812B59 KwUb 1.700 t10msxs_ub_b2p55 0.00 1.700 FUNCTION_LIST GGAIRB IF_DATA DIM_X DIRECT 0x812B59 /end CHARACTERISTIC
/begin CHARACTERISTIC CSU "Codewort für Saugrohrumschaltung" VALUE 0x818778 KwUb 255.0 dez 0.00 255.0 FUNCTION_LIST SU IF_DATA DIM_X DIRECT 0x818778 /end CHARACTERISTIC
/begin CHARACTERISTIC CUKA "Codewort ÜK-Adaption" VALUE 0x811336 KwUb 255.0 dez 0.00 255.0 FUNCTION_LIST ESUKAS IF_DATA DIM_X DIRECT 0x811336 /end CHARACTERISTIC
/begin CHARACTERISTIC CWALE "Auslauferkennung aktiv" VALUE 0x810BF8 KwUb 255.0 dez 0.00 255.0 FUNCTION_LIST ALE IF_DATA DIM_X DIRECT 0x810BF8 /end CHARACTERISTIC
/begin CHARACTERISTIC CWARMD "Codewort Antiruckelfunktion" VALUE 0x811692 KwUb 255.0 dez 0.00 255.0 FUNCTION_LIST ARMD IF_DATA DIM_X DIRECT 0x811692 /end CHARACTERISTIC
/begin CHARACTERISTIC CWAU "Codewort Aktivierung MIL blinken bei Abgasuntersuchung" VALUE 0x818130 KwUb 255.0 dez 0.00 255.0 FUNCTION_LIST SGAAU IF_DATA DIM_X DIRECT 0x818130 /end CHARACTERISTIC
/begin CHARACTERISTIC CWBBFGR "Codewort für BBFGR" VALUE 0x810F29 KwUb 255.0 dez 0.00 255.0 FUNCTION_LIST BBFGR IF_DATA DIM_X DIRECT 0x810F29 /end CHARACTERISTIC
/begin CHARACTERISTIC CWBGMSGR "Codewort für die Gradientenbildung in der BGMSZS" VALUE 0x810F3B KwUb 4.000 DEZ 1.000 5.000 FUNCTION_LIST BGMSZS IF_DATA DIM_X DIRECT 0x810F3B /end CHARACTERISTIC
/begin CHARACTERISTIC CWBGMSZS "Codewort für die BGMSZS" VALUE 0x810F3C KwUb 255.0 DEZ 0.00 255.0 FUNCTION_LIST BGMSZS IF_DATA DIM_X DIRECT 0x810F3C /end CHARACTERISTIC
/begin CHARACTERISTIC CWBWEEN "Codewort zur Deaktivierung der Bewegungserkennung" VALUE 0x810E2D KwUb 255.0 dez 0.00 255.0 FUNCTION_LIST GGPED IF_DATA DIM_X DIRECT 0x810E2D /end CHARACTERISTIC
/begin CHARACTERISTIC CWDALA "Codewort DMDMIL Dauerlaufzähler" VALUE 0x810898 KwUb 255.0 dez 0.00 255.0 FUNCTION_LIST DMDMIL IF_DATA DIM_X DIRECT 0x810898 /end CHARACTERISTIC
/begin CHARACTERISTIC CWDEGFE "Codewort für Abschaltung der Funktion %DEGFE" VALUE 0x8184CF KwUb 255.0 dez 0.00 255.0 FUNCTION_LIST DEGFE IF_DATA DIM_X DIRECT 0x8184CF /end CHARACTERISTIC
/begin CHARACTERISTIC CWDHFM "Codewort in DHFM" VALUE 0x8184D4 KwUb 255.0 dez 0.00 255.0 FUNCTION_LIST DHFM IF_DATA DIM_X DIRECT 0x8184D4 /end CHARACTERISTIC
/begin CHARACTERISTIC CWDKNOLU "" VALUE 0x81848D KwUb 255.0 dez 0.00 255.0 FUNCTION_LIST ADVE IF_DATA DIM_X DIRECT 0x81848D /end CHARACTERISTIC
/begin CHARACTERISTIC CWDKRNT "Codewort: KR-Diagnose Integratorsteigung" VALUE 0x811484 KwUb 255.0 dez 0.00 255.0 FUNCTION_LIST DKRNT IF_DATA DIM_X DIRECT 0x811484 /end CHARACTERISTIC
/begin CHARACTERISTIC CWDKROF "Codewort: KR-Diagnose Resetwert" VALUE 0x811485 KwUb 255.0 dez 0.00 255.0 FUNCTION_LIST DKRNT IF_DATA DIM_X DIRECT 0x811485 /end CHARACTERISTIC
/begin CHARACTERISTIC CWDKRTP "Codewort: KR-Diagnose Testimpuls" VALUE 0x811489 KwUb 255.0 dez 0.00 255.0 FUNCTION_LIST DKRTP GGKS IF_DATA DIM_X DIRECT 0x811489 /end CHARACTERISTIC
/begin CHARACTERISTIC CWDKS1 "Codewort: Klopfsensordiagnose Sensor1" VALUE 0x819165 KwUb 255.0 dez 0.00 255.0 FUNCTION_LIST DKRS IF_DATA DIM_X DIRECT 0x819165 /end CHARACTERISTIC
/begin CHARACTERISTIC CWDKS2 "Codewort: Klopfsensordiagnose Sensor 2" VALUE 0x819166 KwUb 255.0 dez 0.00 255.0 FUNCTION_LIST DKRS IF_DATA DIM_X DIRECT 0x819166 /end CHARACTERISTIC
/begin CHARACTERISTIC CWDKS3 "Codewort: Klopfsensordiagnose Sensor 3" VALUE 0x819167 KwUb 255.0 dez 0.00 255.0 FUNCTION_LIST DKRS IF_DATA DIM_X DIRECT 0x819167 /end CHARACTERISTIC
/begin CHARACTERISTIC CWDKS4 "Codewort: Klopfsensordiagnose Sensor 4" VALUE 0x819168 KwUb 255.0 dez 0.00 255.0 FUNCTION_LIST DKRS IF_DATA DIM_X DIRECT 0x819168 /end CHARACTERISTIC
/begin CHARACTERISTIC CWDLRIKL "" VALUE 0x810C7E KwUb 255.0 dez 0.00 255.0 FUNCTION_LIST ADVE IF_DATA DIM_X DIRECT 0x810C7E /end CHARACTERISTIC
/begin CHARACTERISTIC CWDLSAHK "Codewort CWDLSAHK für Alterung Sonde hinter KAT" VALUE 0x8183E9 KwUb 255.0 dez 0.00 255.0 FUNCTION_LIST DLSAHK IF_DATA DIM_X DIRECT 0x8183E9 /end CHARACTERISTIC
/begin CHARACTERISTIC CWDMDE "Codewort für EOBD-Appl. DMDMIL (Heilung ohne Fensterabd.)" VALUE 0x8181AD KwUb 255.0 dez 0.00 255.0 FUNCTION_LIST DMDMIL IF_DATA DIM_X DIRECT 0x8181AD /end CHARACTERISTIC
/begin CHARACTERISTIC CWDMFAB "Codewort Sw-Schalter für Änderungsbegrenzung" VALUE 0x811B49 KwUb 255.0 DEZ 0.00 255.0 FUNCTION_LIST MDFAW IF_DATA DIM_X DIRECT 0x811B49 /end CHARACTERISTIC
/begin CHARACTERISTIC CWDMLLR "Codewort Umschaltung keine Auftrennung Luft/Zündung in LLR" VALUE 0x8198C3 KwUb 255.0 dez 0.00 255.0 FUNCTION_LIST PROKON IF_DATA DIM_X DIRECT 0x8198C3 /end CHARACTERISTIC
/begin CHARACTERISTIC CWDSLSA "Codewort in der Diagnose Sekundärluftsystem" VALUE 0x8180FC KwUb 255.0 dez 0.00 255.0 FUNCTION_LIST DSLSLRS IF_DATA DIM_X DIRECT 0x8180FC /end CHARACTERISTIC
/begin CHARACTERISTIC CWDSLSY "Codewort in der Diagnose Sekundärluftsystem" VALUE 0x8180FD KwUb 255.0 dez 0.00 255.0 FUNCTION_LIST DSLSLRS IF_DATA DIM_X DIRECT 0x8180FD /end CHARACTERISTIC
/begin CHARACTERISTIC CWDTEAPP "Applikationscodeword für DTEV immer aktiv und Umschaltung von HFM auf P-System" VALUE 0x819B38 KwUb 255.0 dez 0.00 255.0 FUNCTION_LIST DTEV IF_DATA DIM_X DIRECT 0x819B38 /end CHARACTERISTIC
/begin CHARACTERISTIC CWDTHM "Codewort DTHM-Funktion" VALUE 0x81900C KwUb 255.0 dez 0.00 255.0 FUNCTION_LIST GGTFM IF_DATA DIM_X DIRECT 0x81900C /end CHARACTERISTIC
/begin CHARACTERISTIC CWDTKWAV "Codewort Berücksichtigung Kühlwasser-Absperrventil für Diagnose" VALUE 0x81900D KwUb 255.0 dez 0.00 255.0 FUNCTION_LIST GGTFM IF_DATA DIM_X DIRECT 0x81900D /end CHARACTERISTIC
/begin CHARACTERISTIC CWDVEFO "Codeword öffnende Federprüfung" VALUE 0x810D2F KwUb 255.0 dez 0.00 255.0 FUNCTION_LIST BGDVE IF_DATA DIM_X DIRECT 0x810D2F /end CHARACTERISTIC
/begin CHARACTERISTIC CWDVMX "Codewort SW-Schalter für Integratorinit. bei VMAX-Regelung" VALUE 0x811C33 KwUb 255.0 dez 0.00 255.0 FUNCTION_LIST VMAXMD IF_DATA DIM_X DIRECT 0x811C33 /end CHARACTERISTIC
/begin CHARACTERISTIC CWDVS "Codewort in DVS" VALUE 0x8122F3 KwUb 255.0 dez 0.00 255.0 FUNCTION_LIST DVS IF_DATA DIM_X DIRECT 0x8122F3 /end CHARACTERISTIC
/begin CHARACTERISTIC CWEGSEUR "Unterbrechungsschalter f. B_milfb" VALUE 0x8181AF KwUb 255.0 dez 0.00 255.0 FUNCTION_LIST DMIL IF_DATA DIM_X DIRECT 0x8181AF /end CHARACTERISTIC
/begin CHARACTERISTIC CWERFIL "Codewort zur Auswahl Filtervar. für die Ausgabe von AS.-Fehler an das Scan Tool" VALUE 0x811C48 KwUb 255.0 dez 0.00 255.0 FUNCTION_LIST PROKON IF_DATA DIM_X DIRECT 0x811C48 /end CHARACTERISTIC
/begin CHARACTERISTIC CWESWEZ "Codewort Freigabe Kraftstoffmehrmenge bei Wiedereinsetzen" VALUE 0x818496 KwUb 255.0 dez 0.00 255.0 FUNCTION_LIST ACIFI IF_DATA DIM_X DIRECT 0x818496 /end CHARACTERISTIC
/begin CHARACTERISTIC CWFASL "Codewort: Testereingriff Sekundärluftdiagnose" VALUE 0x818134 KwUb 255.0 dez 0.00 255.0 FUNCTION_LIST SLS T2DFA IF_DATA DIM_X DIRECT 0x818134 /end CHARACTERISTIC
/begin CHARACTERISTIC CWFGRMD "Codewort für FGRMD" VALUE 0x810F37 KwUb 255.0 dez 0.00 255.0 FUNCTION_LIST FGRMD IF_DATA DIM_X DIRECT 0x810F37 /end CHARACTERISTIC
/begin CHARACTERISTIC CWFKMSDKA "Codewort für Massenstromadaption aktiv" VALUE 0x810F3D KwUb 255.0 dez 0.00 255.0 FUNCTION_LIST BGMSZS IF_DATA DIM_X DIRECT 0x810F3D /end CHARACTERISTIC
/begin CHARACTERISTIC CWFUEDK "Codewort FUEDK" VALUE 0x8110A8 KwUb 255.0 dez 0.00 255.0 FUNCTION_LIST FUEDK IF_DATA DIM_X DIRECT 0x8110A8 /end CHARACTERISTIC
/begin CHARACTERISTIC CWGGLSH "Codeword für Ri-Auswertung für Sonde hinter KAT" VALUE 0x818423 KwUb 255.0 dez 0.00 255.0 FUNCTION_LIST GGLSH IF_DATA DIM_X DIRECT 0x818423 /end CHARACTERISTIC
/begin CHARACTERISTIC CWGGLSU "Codewort für GGLSU" VALUE 0x810C72 KwUb 255.0 dez 0.00 255.0 FUNCTION_LIST GGLSU IF_DATA DIM_X DIRECT 0x810C72 /end CHARACTERISTIC
/begin CHARACTERISTIC CWGT "Codewort für Ansteuerung Kühlwasserabsperrventil für Handschalter" VALUE 0x819DB8 KwUb 255.0 dez 0.00 255.0 FUNCTION_LIST AKWAV IF_DATA DIM_X DIRECT 0x819DB8 /end CHARACTERISTIC
/begin CHARACTERISTIC CWITLK "Codewort für Aktivierung Interlock-Funktion" VALUE 0x8121B4 KwUb 255.0 dez 0.00 255.0 FUNCTION_LIST STA IF_DATA DIM_X DIRECT 0x8121B4 /end CHARACTERISTIC
/begin CHARACTERISTIC CWKATUM "Codewort für Umschalten in der Katdiagnose" VALUE 0x810C66 KwUb 255.0 dez 0.00 255.0 FUNCTION_LIST DKATLRS IF_DATA DIM_X DIRECT 0x810C66 /end CHARACTERISTIC
/begin CHARACTERISTIC CWKBID "Codewort zur Ausgabe drehmomentmindernder Kriterien auf Kombi-Display" VALUE 0x810224 KwUb 255.0 dez 0.00 255.0 FUNCTION_LIST MDEX IF_DATA DIM_X DIRECT 0x810224 /end CHARACTERISTIC
/begin CHARACTERISTIC CWKHMD "Codewort für Drehmomentenreserve bei Katheizen" VALUE 0x81913D KwUb 255.0 dez 0.00 255.0 FUNCTION_LIST KHMD IF_DATA DIM_X DIRECT 0x81913D /end CHARACTERISTIC
/begin CHARACTERISTIC CWKHZ "Codewort für Katheizsteuerung" VALUE 0x819105 KwUb 255.0 dez 0.00 255.0 FUNCTION_LIST BBKHZ IF_DATA DIM_X DIRECT 0x819105 /end CHARACTERISTIC
/begin CHARACTERISTIC CWKLIMA "Codewort für Klimaanlage" VALUE 0x8198C4 KwUb 255.0 dez 0.00 255.0 FUNCTION_LIST PROKON IF_DATA DIM_X DIRECT 0x8198C4 /end CHARACTERISTIC
/begin CHARACTERISTIC CWKMMIL "Kilometerstand Abspeichern bei MIL fremdbestimmt" VALUE 0x8181B0 KwUb 255.0 dez 0.00 255.0 FUNCTION_LIST DMIL IF_DATA DIM_X DIRECT 0x8181B0 /end CHARACTERISTIC
/begin CHARACTERISTIC CWKMMILSCT "Ausgabe ""Km bei MIL on""  für Scan Tool abschalten (0 = keine Ausgabe in PID $21)" VALUE 0x8198C5 KwUb 255.0 dez 0.00 255.0 FUNCTION_LIST PROKON IF_DATA DIM_X DIRECT 0x8198C5 /end CHARACTERISTIC
/begin CHARACTERISTIC CWKONABG "Codewort für Konfiguration Abgasbehandlung" VALUE 0x8198C6 KwUb 255.0 dez 0.00 255.0 FUNCTION_LIST PROKON IF_DATA DIM_X DIRECT 0x8198C6 /end CHARACTERISTIC
/begin CHARACTERISTIC CWKONFZ1 "Codewort für Konfiguration Fahrzeug" VALUE 0x8198C7 KwUb 255.0 dez 0.00 255.0 FUNCTION_LIST PROKON IF_DATA DIM_X DIRECT 0x8198C7 /end CHARACTERISTIC
/begin CHARACTERISTIC CWKONGTM "Codewort für Konfiguration Größe Temperatur Motor TMOT" VALUE 0x81900E KwUb 255.0 dez 0.00 255.0 FUNCTION_LIST GGTFM IF_DATA DIM_X DIRECT 0x81900E /end CHARACTERISTIC
/begin CHARACTERISTIC CWKONLS "Codewort für Konfiguration Lambda Sonden" VALUE 0x8198C8 KwUb 255.0 dez 0.00 255.0 FUNCTION_LIST PROKON IF_DATA DIM_X DIRECT 0x8198C8 /end CHARACTERISTIC
/begin CHARACTERISTIC CWKR "Codewort Klopfregeleung" VALUE 0x8191E8 KwUb 1.000 dez 0.00 1.000 FUNCTION_LIST KRDY IF_DATA DIM_X DIRECT 0x8191E8 /end CHARACTERISTIC
/begin CHARACTERISTIC CWKR2 "Codewort zur Konfigurierung der KR" VALUE 0x8191EA KwUb 3.000 dez 0.00 3.000 FUNCTION_LIST KRKE KRDY IF_DATA DIM_X DIRECT 0x8191EA /end CHARACTERISTIC
/begin CHARACTERISTIC CWKRAPP "Codewort für Applikation KR" VALUE 0x81916B KwUb 255.0 dez 0.00 255.0 FUNCTION_LIST GGKS IF_DATA DIM_X DIRECT 0x81916B /end CHARACTERISTIC
/begin CHARACTERISTIC CWKUPPLV "Kodewort Ausschaltverzögerung Kupplungsschalter erlaubt." VALUE 0x810E29 KwUb 255.0 dez 0.00 255.0 FUNCTION_LIST GGEGAS IF_DATA DIM_X DIRECT 0x810E29 /end CHARACTERISTIC
/begin CHARACTERISTIC CWLAMKH "Codewort Lambdakoordination bei Kat-heizen" VALUE 0x811410 KwUb 255.0 dez 0.00 255.0 FUNCTION_LIST LAMKO IF_DATA DIM_X DIRECT 0x811410 /end CHARACTERISTIC
/begin CHARACTERISTIC CWLDIMX "Codewort für Applikationsverfahren KFLDIMX/KFLDIOPU" VALUE 0x8195C5 KwUb 255.0 dez 0.00 255.0 FUNCTION_LIST LDRPID IF_DATA DIM_X DIRECT 0x8195C5 /end CHARACTERISTIC
/begin CHARACTERISTIC CWLDRLMX "Codewort rlmax-Berechnung Turbo" VALUE 0x8184F9 KwUb 255.0 dez 0.00 255.0 FUNCTION_LIST BGSRM IF_DATA DIM_X DIRECT 0x8184F9 /end CHARACTERISTIC
/begin CHARACTERISTIC CWLUE3LL "Codewort Aktivierung Lüfterstufe3 auch bei LL" VALUE 0x8197EF KwUb 255.0 dez 0.00 255.0 FUNCTION_LIST MLS IF_DATA DIM_X DIRECT 0x8197EF /end CHARACTERISTIC
/begin CHARACTERISTIC CWMDAPP "Codewort Applikation ohne Drehmomentfunktionen" VALUE 0x8198C9 KwUb 255.0 dez 0.00 255.0 FUNCTION_LIST PROKON IF_DATA DIM_X DIRECT 0x8198C9 /end CHARACTERISTIC
/begin CHARACTERISTIC CWMDEX "Codewort externe Momenteneingriffe" VALUE 0x810225 KwUb 255.0 dez 0.00 255.0 FUNCTION_LIST MDEX MDAUTG IF_DATA DIM_X DIRECT 0x810225 /end CHARACTERISTIC
/begin CHARACTERISTIC CWMDKOG "Codewort MDKOG: Zündwinkelspätverstellung bei Unterdruckbegrenzung" VALUE 0x811B4B KwUb 255.0 dez 0.00 255.0 FUNCTION_LIST MDKOG IF_DATA DIM_X DIRECT 0x811B4B /end CHARACTERISTIC
/begin CHARACTERISTIC CWMDTES "Codewort für Ausblenden bei TES u. TEVE Fehler." VALUE 0x81818C KwUb 255.0 dez 0.00 255.0 FUNCTION_LIST DMDSTP IF_DATA DIM_X DIRECT 0x81818C /end CHARACTERISTIC
/begin CHARACTERISTIC CWNLPH "Freigabe der jeweiligen Phasengebernotlauffunktion" VALUE 0x810C4F KwUb 255.0 dez 0.00 255.0 FUNCTION_LIST NLPH IF_DATA DIM_X DIRECT 0x810C4F /end CHARACTERISTIC
/begin CHARACTERISTIC CWNMXGNG "Codewort zur Anforderung gangabhängige Drehzahlbegrenzung" VALUE 0x811C21 KwUb 255.0 dez 0.00 255.0 FUNCTION_LIST NMAXMD IF_DATA DIM_X DIRECT 0x811C21 /end CHARACTERISTIC
/begin CHARACTERISTIC CWNNOT "" VALUE 0x8121BF KwUb 255.0 dez 0.00 255.0 FUNCTION_LIST SWADP IF_DATA DIM_X DIRECT 0x8121BF /end CHARACTERISTIC
/begin CHARACTERISTIC CWNOASR "" VALUE 0x8121C0 KwUb 255.0 dez 0.00 255.0 FUNCTION_LIST SWADP IF_DATA DIM_X DIRECT 0x8121C0 /end CHARACTERISTIC
/begin CHARACTERISTIC CWNOKM "Codwort nokm" VALUE 0x8181B1 KwUb 255.0 dez 0.00 255.0 FUNCTION_LIST DMIL IF_DATA DIM_X DIRECT 0x8181B1 /end CHARACTERISTIC
/begin CHARACTERISTIC CWNOMST "Codeword nomst" VALUE 0x8181B2 KwUb 255.0 dez 0.00 255.0 FUNCTION_LIST DMIL IF_DATA DIM_X DIRECT 0x8181B2 /end CHARACTERISTIC
/begin CHARACTERISTIC CWNWREF "Nockenwellenverhalten im Start" VALUE 0x810BFF KwUb 255.0 dez 0.00 255.0 FUNCTION_LIST GGDPG NLDG IF_DATA DIM_X DIRECT 0x810BFF /end CHARACTERISTIC
/begin CHARACTERISTIC CWNWS "Codewort Nockenwellensteuerung" VALUE 0x8186A6 KwUb 255.0 dez 0.00 255.0 FUNCTION_LIST NWS IF_DATA DIM_X DIRECT 0x8186A6 /end CHARACTERISTIC
/begin CHARACTERISTIC CWOBD "Codewort für Konfiguration OBD Zertifikationsnachweis" VALUE 0x8198CA KwUb 255.0 dez 0.00 255.0 FUNCTION_LIST PROKON TC1MOD IF_DATA DIM_X DIRECT 0x8198CA /end CHARACTERISTIC
/begin CHARACTERISTIC CWPKAPP "Codewort Applikation Druckreferenz für Kraftstoffdruckregler" VALUE 0x8187F4 KwUb 255.0 dez 0.00 255.0 FUNCTION_LIST AES IF_DATA DIM_X DIRECT 0x8187F4 /end CHARACTERISTIC
/begin CHARACTERISTIC CWPWF "Codewort Powerfail" VALUE 0x81996C KwUb 255.0 dez 0.00 255.0 FUNCTION_LIST STARTUPF IF_DATA DIM_X DIRECT 0x81996C /end CHARACTERISTIC
/begin CHARACTERISTIC CWRLAPPL "Codewort Vorgabe rlsol_w während Applikationsphase" VALUE 0x8110AE KwUb 255.0 dez 0.00 255.0 FUNCTION_LIST MDFUE FUEREG IF_DATA DIM_X DIRECT 0x8110AE /end CHARACTERISTIC
/begin CHARACTERISTIC CWSAC_C "Codewort zur Umschaltung S_ac von Generierung aus PWM auf Bezug vom CAN" VALUE 0x812B5A KwUb 255.0 dez 0.00 255.0 FUNCTION_LIST KOLS IF_DATA DIM_X DIRECT 0x812B5A /end CHARACTERISTIC
/begin CHARACTERISTIC CWSAWE "Codewort Schubabschalten - Wiedereinsetzen" VALUE 0x8114C0 KwUb 255.0 dez 0.00 255.0 FUNCTION_LIST BBSAWE IF_DATA DIM_X DIRECT 0x8114C0 /end CHARACTERISTIC
/begin CHARACTERISTIC CWSBRC "Codewort Schalter Bremstest / Bremslicht über CAN" VALUE 0x810E2A KwUb 255.0 dez 0.00 255.0 FUNCTION_LIST GGEGAS IF_DATA DIM_X DIRECT 0x810E2A /end CHARACTERISTIC
/begin CHARACTERISTIC CWSCTMDE "Codewort zum abschalten bestimmter Scan Tool Modes/Services (Bit=0 ->  Mode aus)" VALUE 0x811C49 KwUb 255.0 dez 0.00 255.0 FUNCTION_LIST PROKON IF_DATA DIM_X DIRECT 0x811C49 /end CHARACTERISTIC
/begin CHARACTERISTIC CWSKUPPC "Codewort S_kupp über CAN" VALUE 0x810E2B KwUb 255.0 dez 0.00 255.0 FUNCTION_LIST GGEGAS DKUPPL IF_DATA DIM_X DIRECT 0x810E2B /end CHARACTERISTIC
/begin CHARACTERISTIC CWSLS "Codewort für Sekundärluftsystem" VALUE 0x8121C1 KwUb 255.0 dez 0.00 255.0 FUNCTION_LIST SWADP DIMC SLS IF_DATA DIM_X DIRECT 0x8121C1 /end CHARACTERISTIC
/begin CHARACTERISTIC CWSTDMD "Codewort zur Auswahl Startfreigabe: 1 -> B_st, 0 -> nmot" VALUE 0x81054B KwUb 255.0 dez 0.00 255.0 FUNCTION_LIST DMDSTP IF_DATA DIM_X DIRECT 0x81054B /end CHARACTERISTIC
/begin CHARACTERISTIC CWSTPCNF "Codewort Ausblendkriterien 1 -> Kriterium aktiv" VALUE 0x81054C KwUb 255.0 dez 0.00 255.0 FUNCTION_LIST DMDSTP IF_DATA DIM_X DIRECT 0x81054C /end CHARACTERISTIC
/begin CHARACTERISTIC CWTEZW "Codewort Zündwinkeleingriff bei TEV-Prüfung" VALUE 0x811B4C KwUb 255.0 dez 0.00 255.0 FUNCTION_LIST MDKOG IF_DATA DIM_X DIRECT 0x811B4C /end CHARACTERISTIC
/begin CHARACTERISTIC CWTF "Codewort für Konfiguration Temperaturfühler" VALUE 0x8198CB KwUb 255.0 dez 0.00 255.0 FUNCTION_LIST PROKON IF_DATA DIM_X DIRECT 0x8198CB /end CHARACTERISTIC
/begin CHARACTERISTIC CWUHR "Codewort für Uhr" VALUE 0x8198CC KwUb 255.0 dez 0.00 255.0 FUNCTION_LIST PROKON IF_DATA DIM_X DIRECT 0x8198CC /end CHARACTERISTIC
/begin CHARACTERISTIC CWVFZGC "Codewort Fahrzeuggeschwindigkeit über CAN" VALUE 0x810C7D KwUb 255.0 dez 0.00 255.0 FUNCTION_LIST GGVFZG IF_DATA DIM_X DIRECT 0x810C7D /end CHARACTERISTIC
/begin CHARACTERISTIC CWVHS "Codewort Ventilhubsteuerung" VALUE 0x819BA7 KwUb 255.0 dez 0.00 255.0 FUNCTION_LIST VS MDVER IF_DATA DIM_X DIRECT 0x819BA7 /end CHARACTERISTIC
/begin CHARACTERISTIC CWVSV "Codewort für Deaktivierung VS_VERST (CWVSV = 0: VS_VERST nicht aktiv)" VALUE 0x810221 KwUb 255.0 dez 0.00 255.0 FUNCTION_LIST VS_VERST MCMESS_PROT IF_DATA DIM_X DIRECT 0x810221 /end CHARACTERISTIC
/begin CHARACTERISTIC CWVWKNWS "Code Wort: Vorlagerungswinkelkorrektur bei NWS" VALUE 0x818B61 KwUb 255.0 dez 0.00 255.0 FUNCTION_LIST ESVW IF_DATA DIM_X DIRECT 0x818B61 /end CHARACTERISTIC
/begin CHARACTERISTIC CWWDKSPE "Codewort: prädizierende DK-Sollwertentjitterung aktiv" VALUE 0x8110AA KwUb 255.0 dez 0.00 255.0 FUNCTION_LIST FUEDKSA IF_DATA DIM_X DIRECT 0x8110AA /end CHARACTERISTIC
/begin CHARACTERISTIC CWWK "Codewort Wandlerkupplung über CAN" VALUE 0x81023A KwUb 255.0 dez 0.00 255.0 FUNCTION_LIST WK IF_DATA DIM_X DIRECT 0x81023A /end CHARACTERISTIC
/begin CHARACTERISTIC CWWL "Codewort für Warmlaufsteuerung" VALUE 0x818C40 KwUb 255.0 dez 0.00 255.0 FUNCTION_LIST ESWL IF_DATA DIM_X DIRECT 0x818C40 /end CHARACTERISTIC
/begin CHARACTERISTIC CWZWVMX "Codewort Zündwinkeleingriff bei VMAX-Begrenzung" VALUE 0x811B4D KwUb 255.0 dez 0.00 255.0 FUNCTION_LIST MDKOG IF_DATA DIM_X DIRECT 0x811B4D /end CHARACTERISTIC
/begin CHARACTERISTIC CW_AZUE "Konfigurationscodewort Zündausgabe" VALUE 0x810054 KwUb 255.0 DEZ 0.00 255.0 FUNCTION_LIST AZUE IF_DATA DIM_X DIRECT 0x810054 /end CHARACTERISTIC
/begin CHARACTERISTIC CW_FUBND "Codewort für Funkenbandzündung" VALUE 0x8123D3 KwUb 255.0 DEZ 0.00 255.0 FUNCTION_LIST ZUESZ IF_DATA DIM_X DIRECT 0x8123D3 /end CHARACTERISTIC
/begin CHARACTERISTIC CW_NOROMCHKRESET "" VALUE 0x811FE6 KwUb 255.0 dez 0.00 255.0 FUNCTION_LIST URROM IF_DATA DIM_X DIRECT 0x811FE6 /end CHARACTERISTIC
/begin CHARACTERISTIC CW_TABST "" VALUE 0x81900F KwUb 255.0 dez 0.00 255.0 FUNCTION_LIST GGTFM IF_DATA DIM_X DIRECT 0x81900F /end CHARACTERISTIC
/begin CHARACTERISTIC C_WANVER "Codewort zur Umschaltung der Quelle von mdwan_w" VALUE 0x811670 KwUb 255.0 dez 0.00 255.0 FUNCTION_LIST MDWAN IF_DATA DIM_X DIRECT 0x811670 /end CHARACTERISTIC
/begin CHARACTERISTIC DANTGESWNV "Schwelle Aktivierung D-Anteil (Geschwindigkeit) im unverstärkten Bereich" VALUE 0x813D1E KwSw 1599.976 relDK_q0p02441 -800.0000 799.9756 FUNCTION_LIST ADVE IF_DATA DIM_X DIRECT 0x813D1E /end CHARACTERISTIC
/begin CHARACTERISTIC DANTGESWV "Schwelle Aktivierung D-Anteil (Geschwindigkeit) im verstärkten Bereich" VALUE 0x813D20 KwSw 1599.976 relDK_q0p02441 -800.0000 799.9756 FUNCTION_LIST ADVE IF_DATA DIM_X DIRECT 0x813D20 /end CHARACTERISTIC
/begin CHARACTERISTIC DANTSCHWNV "Schwelle Aktivierung D-Anteil (Abweichung) im unverstärkten Bereich" VALUE 0x813D22 KwSw 1599.976 relDK_q0p02441 -800.0000 799.9756 FUNCTION_LIST ADVE IF_DATA DIM_X DIRECT 0x813D22 /end CHARACTERISTIC
/begin CHARACTERISTIC DANTSCHWV "Schwelle Aktivierung D-Anteil (Abweichung) im verstärkten Bereich" VALUE 0x813D24 KwSw 1599.976 relDK_q0p02441 -800.0000 799.9756 FUNCTION_LIST ADVE IF_DATA DIM_X DIRECT 0x813D24 /end CHARACTERISTIC
/begin CHARACTERISTIC DASA "Anzahl der SAS-Phasen zur Erkennung LLS Fehler" VALUE 0x8196DE KwUb 255.0 dez 0.00 255.0 FUNCTION_LIST DLLR IF_DATA DIM_X DIRECT 0x8196DE /end CHARACTERISTIC
/begin CHARACTERISTIC DASE_CMD "Codewort DMD-Ausblendbedingungen abschalten - nur für Testzwecke !!!" VALUE 0x81054D KwUb 7.000 dez 0.00 7.000 FUNCTION_LIST DMDSTP IF_DATA DIM_X DIRECT 0x81054D /end CHARACTERISTIC
/begin CHARACTERISTIC DBZ_MN_UC "" VALUE 0x811E4D KwUb 255.0 dez 0.00 255.0 FUNCTION_LIST URCMSRC IF_DATA DIM_X DIRECT 0x811E4D /end CHARACTERISTIC
/begin CHARACTERISTIC DBZ_MN_UM "kleinstes zulässiges Delta des Botschaftszählers" VALUE 0x817D75 KwUb 255.0 dez 0.00 255.0 FUNCTION_LIST UFMSRC IF_DATA DIM_X DIRECT 0x817D75 /end CHARACTERISTIC
/begin CHARACTERISTIC DBZ_MX_UC "" VALUE 0x811E4E KwUb 255.0 dez 0.00 255.0 FUNCTION_LIST URCMSRC IF_DATA DIM_X DIRECT 0x811E4E /end CHARACTERISTIC
/begin CHARACTERISTIC DBZ_MX_UM "größtes zulässiges Delta des Botschaftszählers" VALUE 0x817D76 KwUb 255.0 dez 0.00 255.0 FUNCTION_LIST UFMSRC IF_DATA DIM_X DIRECT 0x817D76 /end CHARACTERISTIC
/begin CHARACTERISTIC DDFUELSAN "Schwelle für Delta Füllungssensor alpha/n-system" VALUE 0x8148DA KwUw 0.9999847 fak_uw_b1 0.00 0.9999847 FUNCTION_LIST BGMSZS IF_DATA DIM_X DIRECT 0x8148DA /end CHARACTERISTIC
/begin CHARACTERISTIC DDRLDKZU "Deltadifferenz zwischen rl aus Haupt- und Nebenlastsignal" VALUE 0x8148DC KwSw 1535.977 rel_sw_q0p0234 -768.0000 767.9766 FUNCTION_LIST BGMSZS IF_DATA DIM_X DIRECT 0x8148DC /end CHARACTERISTIC
/begin CHARACTERISTIC DECKSTAI "Decrement-Step für STADAP-Faktor" CURVE 0x81141B KlAUbSstUbWSb 1.000 fak_sb_b1 -1.000 0.00 FUNCTION_LIST STADAP IF_DATA DIM_X DIRECT 0x81141B /begin AXIS_DESCR STD_AXIS tmadb dez 3 0.00 255.0 DEPOSIT ABSOLUT /end AXIS_DESCR /end CHARACTERISTIC
/begin CHARACTERISTIC DFAFRG "Aufreglungsfaktor nach Einschalten des Füllungsreglers" VALUE 0x818634 KwUb 0.9961 fak_ub_b1 0.00 0.9961 FUNCTION_LIST FUEREG IF_DATA DIM_X DIRECT 0x818634 /end CHARACTERISTIC
/begin CHARACTERISTIC DFKMSMN "Delta FKMSDKMN zum Rücksetzen von B_fkmsmn" VALUE 0x8184C7 KwUb 3.984 fak_ub_b4 0.00 3.984 FUNCTION_LIST BGMSZS IF_DATA DIM_X DIRECT 0x8184C7 /end CHARACTERISTIC
/begin CHARACTERISTIC DFKMSMX "Delta FKMSDKMX zum Rücksetzen von B_fkmsmx" VALUE 0x8184C8 KwUb 3.984 fak_ub_b4 0.00 3.984 FUNCTION_LIST BGMSZS IF_DATA DIM_X DIRECT 0x8184C8 /end CHARACTERISTIC
/begin CHARACTERISTIC DFKPVMN "Delta FKPVDKMN zum Rücksetzen von B_fkpvmn" VALUE 0x8184C9 KwUb 3.984 fak_ub_b4 0.00 3.984 FUNCTION_LIST BGMSZS IF_DATA DIM_X DIRECT 0x8184C9 /end CHARACTERISTIC
/begin CHARACTERISTIC DFKPVMX "Delta FKPVDKMX zum Rücksetzen von B_fkpvmx" VALUE 0x8184CA KwUb 3.984 fak_ub_b4 0.00 3.984 FUNCTION_LIST BGMSZS IF_DATA DIM_X DIRECT 0x8184CA /end CHARACTERISTIC
/begin CHARACTERISTIC DFRMDTEE "Delta-frm-Schwelle für Erkennung der eingeschwungenen Gemischkorrektur" VALUE 0x81E2F2 KwUw 0.03125000 fak_uw_b2 0.00 0.03125000 FUNCTION_LIST DTEV IF_DATA DIM_X DIRECT 0x81E2F2 /end CHARACTERISTIC
/begin CHARACTERISTIC DFRMDTEF "Regelhubschwelle für Fettkorrektur des fr für Prüfung i.O." VALUE 0x81E2F4 KwSw 0.2000122 fak_sw_b1 -0.2000122 0.00 FUNCTION_LIST DTEV IF_DATA DIM_X DIRECT 0x81E2F4 /end CHARACTERISTIC
/begin CHARACTERISTIC DFRMDTEM "Regelhubschwelle für Magerkorrektur des fr für Prüfung i.O." VALUE 0x81E2F6 KwSw 0.2000122 fak_sw_b1 0.00 0.2000122 FUNCTION_LIST DTEV IF_DATA DIM_X DIRECT 0x81E2F6 /end CHARACTERISTIC
/begin CHARACTERISTIC DFRMOFNX "frm-Offset-Schwelle (negativ): Kontrolle Vorsteuerproblem" VALUE 0x819FF6 KwSw 1.999969 fak_sw_b1 -1.000000 0.9999695 FUNCTION_LIST DSLSLRS IF_DATA DIM_X DIRECT 0x819FF6 /end CHARACTERISTIC
/begin CHARACTERISTIC DFRMOFNXKT "frm-Offset-Schwelle (negativ): Kontrolle Vorsteuerproblem (Kurztest)" VALUE 0x819FF8 KwSw 1.999969 fak_sw_b1 -1.000000 0.9999695 FUNCTION_LIST DSLSLRS IF_DATA DIM_X DIRECT 0x819FF8 /end CHARACTERISTIC
/begin CHARACTERISTIC DFRMOFPX "frm-Offset-Schwelle (positiv): Kontrolle Vorsteuerproblem" VALUE 0x819FFA KwSw 1.999969 fak_sw_b1 -1.000000 0.9999695 FUNCTION_LIST DSLSLRS IF_DATA DIM_X DIRECT 0x819FFA /end CHARACTERISTIC
/begin CHARACTERISTIC DFRMOFPXKT "frm-Offset-Schwelle (positiv): Kontrolle Vorsteuerproblem (Kurztest)" VALUE 0x819FFC KwSw 1.999969 fak_sw_b1 -1.000000 0.9999695 FUNCTION_LIST DSLSLRS IF_DATA DIM_X DIRECT 0x819FFC /end CHARACTERISTIC
/begin CHARACTERISTIC DFRMST "Delta frm-schwelle für Erkennung der eingeschwungenen Grundadaption" VALUE 0x818809 KwUb 1.992 fak_ub_b2 0.00 1.992 FUNCTION_LIST DKVS IF_DATA DIM_X DIRECT 0x818809 /end CHARACTERISTIC
/begin CHARACTERISTIC DFRMVS "Grenzwert Lambdareglerabweichung für Löschbedingung" VALUE 0x8122F4 KwUb 1.992 fak_ub_b2 0.00 1.992 FUNCTION_LIST DVS IF_DATA DIM_X DIRECT 0x8122F4 /end CHARACTERISTIC
/begin CHARACTERISTIC DFSEFO2N "drehzahlabh. max. plausible Abweichungen der FSE-Werte" CURVE 0x81023E GklWSb 3.735 dtsegn_b11p25divZyl -1.875 1.860 FUNCTION_LIST DMDFON IF_DATA DIM_X DIRECT 0x81023E
 /begin AXIS_DESCR COM_AXIS nmot nmot_ub_q40 8 0.00 10200. AXIS_PTS_REF SDZ08DMUB2 /end AXIS_DESCR
/end CHARACTERISTIC
/begin CHARACTERISTIC DFSEFON "drehzahlabh. max. plausible Abweichungen der FSE-Werte" CURVE 0x810246 GklWSb 3.735 dtsegn_b11p25divZyl -1.875 1.860 FUNCTION_LIST DMDFON IF_DATA DIM_X DIRECT 0x810246
 /begin AXIS_DESCR COM_AXIS nmot nmot_ub_q40 8 0.00 10200. AXIS_PTS_REF SDZ08DMUB /end AXIS_DESCR
/end CHARACTERISTIC
/begin CHARACTERISTIC DFSERES "Differenz der Adaptionswerte zum Auslösen eines Reset der fuel-on/-off adaption" VALUE 0x81024E KwUb 3.735 dtsegn_b11p25divZyl 0.00 3.735 FUNCTION_LIST DMDFON IF_DATA DIM_X DIRECT 0x81024E /end CHARACTERISTIC
/begin CHARACTERISTIC DFTEAHB "Schwelle Gemischanteil Tankentlüftung zum Setzen Bit ""Hohe Beladung""" VALUE 0x8199EE KwSb 1.992 fak_sb_b1 -1.000 0.9922 FUNCTION_LIST TEB IF_DATA DIM_X DIRECT 0x8199EE /end CHARACTERISTIC
/begin CHARACTERISTIC DFTEDS "Hysteresebreite Beladung für Umschaltung auf Dauertankentlüftung" VALUE 0x81C702 KwSw 127.9980 fak_sw_b64 -64.00000 63.99805 FUNCTION_LIST BBTEGA IF_DATA DIM_X DIRECT 0x81C702 /end CHARACTERISTIC
/begin CHARACTERISTIC DIF_DAT "Datenreferenz: Prüflabel" ASCII 0x81FC66 KwbUb 255.0 KennText 0.00 255.0 NUMBER 16 FUNCTION_LIST ZIF IF_DATA DIM_X DIRECT 0x81FC66 /end CHARACTERISTIC
/begin CHARACTERISTIC DKATCW "einmaliger Lauf bzw. Initialisierung der DKAT-Funktion" VALUE 0x8183B8 KwUb 255.0 dez 0.00 255.0 FUNCTION_LIST DKATLRS IF_DATA DIM_X DIRECT 0x8183B8 /end CHARACTERISTIC
/begin CHARACTERISTIC DKBZ_MN_UM "kleinstes zulässiges Delta des Kombi-Botschaftszählers" VALUE 0x817D05 KwUb 1.000 dez 0.00 1.000 FUNCTION_LIST UFFGRE IF_DATA DIM_X DIRECT 0x817D05 /end CHARACTERISTIC
/begin CHARACTERISTIC DKBZ_MX_UM "größtes zulässiges Delta des Kombi-Botschaftzählers" VALUE 0x817D06 KwUb 252.0 dez 3.000 255.0 FUNCTION_LIST UFFGRE IF_DATA DIM_X DIRECT 0x817D06 /end CHARACTERISTIC
/begin CHARACTERISTIC DKLAGERT "zulässige Fehlerzeit für DK-Soll-/Istvergleich" VALUE 0x810C7F KwUb 5.100 t20msxs_ub_b5p1 0.00 5.100 FUNCTION_LIST ADVE IF_DATA DIM_X DIRECT 0x810C7F /end CHARACTERISTIC
/begin CHARACTERISTIC DKNOTBEGR "Sollwertbegrenzung bei DK-Potinotfahren als f(nmot)" CURVE 0x813F56 KlAUbSstUbWUw 100.0000 relDK_uw_b100 0.00 100.0000 FUNCTION_LIST FUEDKSA IF_DATA DIM_X DIRECT 0x813F56 /begin AXIS_DESCR STD_AXIS nmot nmot_ub_q40 8 0.00 10200. DEPOSIT ABSOLUT /end AXIS_DESCR /end CHARACTERISTIC
/begin CHARACTERISTIC DKPSTGMIN "min. Steigung des DK-Poti zur Umr. abs. auf rel. Winkel im worst case" VALUE 0x813D80 KwUw 39.99939 rel_uw_b40 0.00 39.99939 FUNCTION_LIST BGDVE IF_DATA DIM_X DIRECT 0x813D80 /end CHARACTERISTIC
/begin CHARACTERISTIC DKROFN "Grenzwert der Integratorsteigung für Nulltest" CURVE 0x815722 KlAUwSstUwWUw 7323.536 tknockintgrad_sy 0.00 7323.536 FUNCTION_LIST DKRNT IF_DATA DIM_X DIRECT 0x815722
 /begin AXIS_DESCR STD_AXIS tmfln_w tknockcon_sy 6 0.00 0.1747600 DEPOSIT ABSOLUT /end AXIS_DESCR
/end CHARACTERISTIC
/begin CHARACTERISTIC DKROKD "Obere Drehzahlschwelle für Nulltest-Diagnose Klopfregelung" VALUE 0x81916C KwUb 10200. nmot_ub_q40 0.00 10200. FUNCTION_LIST GGKS DKRNT IF_DATA DIM_X DIRECT 0x81916C /end CHARACTERISTIC
/begin CHARACTERISTIC DKROKMX "Maximaler Offsetkompensationswert" VALUE 0x81148B KwUb 4.980 spg_ub_b5 0.00 4.980 FUNCTION_LIST GGKS IF_DATA DIM_X DIRECT 0x81148B /end CHARACTERISTIC
/begin CHARACTERISTIC DKROKO "Obere Drehzahlschwelle für Ermittlung Offsetkompensationswert" VALUE 0x81916D KwUb 10200. nmot_ub_q40 0.00 10200. FUNCTION_LIST GGKS IF_DATA DIM_X DIRECT 0x81916D /end CHARACTERISTIC
/begin CHARACTERISTIC DKROKU "Untere Drehzahlschwelle für Ermittlung Offsetkompensationswert" VALUE 0x811486 KwUb 10200. nmot_ub_q40 0.00 10200. FUNCTION_LIST DKRNT IF_DATA DIM_X DIRECT 0x811486 /end CHARACTERISTIC
/begin CHARACTERISTIC DLAHINI "Initwert Integrator dlahi der stetigen LRHK" VALUE 0x816DC8 KwSw 1.999969 fak_sw_b1 -1.000000 0.9999695 FUNCTION_LIST LRSHK IF_DATA DIM_X DIRECT 0x816DC8 /end CHARACTERISTIC
/begin CHARACTERISTIC DLAHINI2 "Initwert Integrator dlahi der stetigen LRHK, Bank2" VALUE 0x816DCA KwSw 1.999969 fak_sw_b1 -1.000000 0.9999695 FUNCTION_LIST LRSHK IF_DATA DIM_X DIRECT 0x816DCA /end CHARACTERISTIC
/begin CHARACTERISTIC DLAHISATO "obere Grenze für dlahisa, CARB-Tester, DLSSALRS" VALUE 0x8184B9 KwUb 0.09961 fak_ub_b0p1_o0p05 -0.05000 0.04961 FUNCTION_LIST DLSSA TC5MOD IF_DATA DIM_X DIRECT 0x8184B9 /end CHARACTERISTIC
/begin CHARACTERISTIC DLAHISATU "untere Grenze für dlahisa, CARB-Tester, DLSSALRS" VALUE 0x8184BA KwUb 0.09961 fak_ub_b0p1_o0p05 -0.05000 0.04961 FUNCTION_LIST DLSSA TC5MOD IF_DATA DIM_X DIRECT 0x8184BA /end CHARACTERISTIC
/begin CHARACTERISTIC DLAMELSH "Delta-Lambda-Sollwert für elektrische Sonendiagnose hinter KAT (Kurztrip)" VALUE 0x81B8D8 KwUw 15.99976 fak_uw_b16 0.00 15.99976 FUNCTION_LIST DLSH IF_DATA DIM_X DIRECT 0x81B8D8 /end CHARACTERISTIC
/begin CHARACTERISTIC DLAMLASHF "Delta-Lambda-Sollwert (Fett) für Test Schwingungsprüfung hinter KAT" VALUE 0x81B8BA KwUw 15.99976 fak_uw_b16 0.00 15.99976 FUNCTION_LIST DLSAHK IF_DATA DIM_X DIRECT 0x81B8BA /end CHARACTERISTIC
/begin CHARACTERISTIC DLAMLASHM "Delta-Lambda-Sollwert (Mager) für Test Schwingungsprüfung hinter KAT" VALUE 0x81B8BC KwUw 15.99976 fak_uw_b16 0.00 15.99976 FUNCTION_LIST DLSAHK IF_DATA DIM_X DIRECT 0x81B8BC /end CHARACTERISTIC
/begin CHARACTERISTIC DLAMNSWL "max. Abweichung für lamnswl_w=1.0" VALUE 0x81137F KwUb 0.9961 fak_ub_b1 0.00 0.9961 FUNCTION_LIST ESWL IF_DATA DIM_X DIRECT 0x81137F /end CHARACTERISTIC
/begin CHARACTERISTIC DLAMOB "Delta Lambda bei Overboost" CURVE 0x818F7D KlAUbSstUbWUb 1.992 fak_ub_b2 0.00 1.992 FUNCTION_LIST LAMFAW IF_DATA DIM_X DIRECT 0x818F7D /begin AXIS_DESCR STD_AXIS nmot nmot_ub_q40 6 0.00 10200. DEPOSIT ABSOLUT /end AXIS_DESCR /end CHARACTERISTIC
/begin CHARACTERISTIC DLAMXSA "max Regeldifferenz, für die nach SA die LRS gesperrt bleibt" VALUE 0x816D90 KwUw 15.99976 fak_uw_b16 0.00 15.99976 FUNCTION_LIST LRSEB IF_DATA DIM_X DIRECT 0x816D90 /end CHARACTERISTIC
/begin CHARACTERISTIC DLBTS "Delta Lambdasoll für Bauteileschutz" CURVE 0x81C90C KlAUbSstUbWSb 1.000 fak_sb_b1 -1.000 0.00 FUNCTION_LIST LAMBTS IF_DATA DIM_X DIRECT 0x81C90C
 /begin AXIS_DESCR STD_AXIS detazwbs rel_ub_b127p5 8 0.00 127.5 DEPOSIT ABSOLUT /end AXIS_DESCR
/end CHARACTERISTIC
/begin CHARACTERISTIC DLRDWDKSS1 "DLR, obere Grenze zur Parameterumschaltung" VALUE 0x813D26 KwSw 99.99847 relDK_q0p00152 -50.00000 49.99847 FUNCTION_LIST ADVE IF_DATA DIM_X DIRECT 0x813D26 /end CHARACTERISTIC
/begin CHARACTERISTIC DLRDWDKSS2 "DLR, untere Grenze zur Parameterumschaltung" VALUE 0x813D28 KwSw 99.99847 relDK_q0p00152 -50.00000 49.99847 FUNCTION_LIST ADVE IF_DATA DIM_X DIRECT 0x813D28 /end CHARACTERISTIC
/begin CHARACTERISTIC DLRHAFTMN "min. notwendiger I-Anteil im Haftreibunsfall" VALUE 0x81B996 KwSw 100.0000 rel_q0p1957 -100.0000 0.00 FUNCTION_LIST ADVE IF_DATA DIM_X DIRECT 0x81B996 /end CHARACTERISTIC
/begin CHARACTERISTIC DLRHAFTST "max. Sollwertgradient zur Aktivierung der Haftreibunsroutine" VALUE 0x81B998 KwSw 99.99847 relDK_q0p00152 -50.00000 49.99847 FUNCTION_LIST ADVE IF_DATA DIM_X DIRECT 0x81B998 /end CHARACTERISTIC
/begin CHARACTERISTIC DLRIAMAXA "maximal zulässiger I-Anteil" VALUE 0x813D2A KwUw 100.0000 rel_q0p1957 0.00 100.0000 FUNCTION_LIST ADVE IF_DATA DIM_X DIRECT 0x813D2A /end CHARACTERISTIC
/begin CHARACTERISTIC DLRIKLPAR "DLR, I-Klein Parameter" VALUE 0x810C80 KwUb 15.94 relDK_q0p0625 0.00 15.94 FUNCTION_LIST ADVE IF_DATA DIM_X DIRECT 0x810C80 /end CHARACTERISTIC
/begin CHARACTERISTIC DLRININI "I-Anteil bei Inititialisierung der NLP-Funktion" VALUE 0x813D2C KwUw 100.0000 rel_q0p1957 0.00 100.0000 FUNCTION_LIST ADVE IF_DATA DIM_X DIRECT 0x813D2C /end CHARACTERISTIC
/begin CHARACTERISTIC DLRKDONLP0 "DLR, D-Parameter über NLP" VALUE 0x810C81 KwUb 1020. relDK_q4 0.00 1020. FUNCTION_LIST ADVE IF_DATA DIM_X DIRECT 0x810C81 /end CHARACTERISTIC
/begin CHARACTERISTIC DLRKDUNLP0 "DLR, D-Parameter unter NLP (schwach)" VALUE 0x810C82 KwUb 1020. relDK_q4 0.00 1020. FUNCTION_LIST ADVE IF_DATA DIM_X DIRECT 0x810C82 /end CHARACTERISTIC
/begin CHARACTERISTIC DLRKDUNLP1 "DLR, D-Parameter unter NLP (mittel)" VALUE 0x810C83 KwUb 1020. relDK_q4 0.00 1020. FUNCTION_LIST ADVE IF_DATA DIM_X DIRECT 0x810C83 /end CHARACTERISTIC
/begin CHARACTERISTIC DLRKDUNLP2 "DLR, D-Parameter unter NLP (stark)" VALUE 0x810C84 KwUb 1020. relDK_q4 0.00 1020. FUNCTION_LIST ADVE IF_DATA DIM_X DIRECT 0x810C84 /end CHARACTERISTIC
/begin CHARACTERISTIC DLRKDUNLP3 "DLR, D-Parameter unter NLP (unverstärktes Poti)" VALUE 0x810C85 KwUb 1020. relDK_q4 0.00 1020. FUNCTION_LIST ADVE IF_DATA DIM_X DIRECT 0x810C85 /end CHARACTERISTIC
/begin CHARACTERISTIC DLRKIONLP0 "I-Anteil als f(abs(dwdkdlr_w)), über NLP" VAL_BLK 0x810C86 KwbUb 15.94 relDK_q0p0625 0.00 15.94 NUMBER 32 FUNCTION_LIST ADVE IF_DATA DIM_X DIRECT 0x810C86 /end CHARACTERISTIC
/begin CHARACTERISTIC DLRKIUNLP0 "I-Anteil als f(abs(dwdkdlr_w)), unter NLP (schwach)" VAL_BLK 0x810CA6 KwbUb 15.94 relDK_q0p0625 0.00 15.94 NUMBER 32 FUNCTION_LIST ADVE IF_DATA DIM_X DIRECT 0x810CA6 /end CHARACTERISTIC
/begin CHARACTERISTIC DLRKIUNLP1 "I-Anteil als f(abs(dwdkdlr_w)), unter NLP (mittel)" VAL_BLK 0x810CC6 KwbUb 15.94 relDK_q0p0625 0.00 15.94 NUMBER 32 FUNCTION_LIST ADVE IF_DATA DIM_X DIRECT 0x810CC6 /end CHARACTERISTIC
/begin CHARACTERISTIC DLRKIUNLP2 "I-Anteil als f(abs(dwdkdlr_w)), unter NLP (stark)" VAL_BLK 0x810CE6 KwbUb 15.94 relDK_q0p0625 0.00 15.94 NUMBER 32 FUNCTION_LIST ADVE IF_DATA DIM_X DIRECT 0x810CE6 /end CHARACTERISTIC
/begin CHARACTERISTIC DLRKIUNLP3 "I-Anteil als f(abs(dwdkdlr_w)), unter NLP (stark)" VAL_BLK 0x810D06 KwbUb 15.94 relDK_q0p0625 0.00 15.94 NUMBER 32 FUNCTION_LIST ADVE IF_DATA DIM_X DIRECT 0x810D06 /end CHARACTERISTIC
/begin CHARACTERISTIC DLRKPONLP0 "DLR, P-Parameter über NLP" VALUE 0x810D26 KwUb 255.0 relDK_q1 0.00 255.0 FUNCTION_LIST ADVE IF_DATA DIM_X DIRECT 0x810D26 /end CHARACTERISTIC
/begin CHARACTERISTIC DLRKPUNLP0 "DLR, P-Parameter unter NLP (schwach)" VALUE 0x810D27 KwUb 255.0 relDK_q1 0.00 255.0 FUNCTION_LIST ADVE IF_DATA DIM_X DIRECT 0x810D27 /end CHARACTERISTIC
/begin CHARACTERISTIC DLRKPUNLP1 "DLR, P-Parameter unter NLP (mittel)" VALUE 0x810D28 KwUb 255.0 relDK_q1 0.00 255.0 FUNCTION_LIST ADVE IF_DATA DIM_X DIRECT 0x810D28 /end CHARACTERISTIC
/begin CHARACTERISTIC DLRKPUNLP2 "DLR, P-Parameter unter NLP (stark)" VALUE 0x810D29 KwUb 255.0 relDK_q1 0.00 255.0 FUNCTION_LIST ADVE IF_DATA DIM_X DIRECT 0x810D29 /end CHARACTERISTIC
/begin CHARACTERISTIC DLRKPUNLP3 "DLR, P-Parameter unter NLP (unverstärktes Poti)" VALUE 0x810D2A KwUb 255.0 relDK_q1 0.00 255.0 FUNCTION_LIST ADVE IF_DATA DIM_X DIRECT 0x810D2A /end CHARACTERISTIC
/begin CHARACTERISTIC DLRKREIS "DLR, Faktor Kreisverstärkung" VALUE 0x81848E KwUb 1.992 fak_ub_b2 0.00 1.992 FUNCTION_LIST ADVE IF_DATA DIM_X DIRECT 0x81848E /end CHARACTERISTIC
/begin CHARACTERISTIC DLRKREISST "DLR, Faktor Kreisverstärkung zur Zeit des Motorstarts" VALUE 0x81848F KwUb 1.992 fak_ub_b2 0.00 1.992 FUNCTION_LIST ADVE IF_DATA DIM_X DIRECT 0x81848F /end CHARACTERISTIC
/begin CHARACTERISTIC DLRNLPD "Unschärfebereich für DK-Notluftposition" VALUE 0x813D2E KwUw 100.0000 relDK_uw_b100 0.00 100.0000 FUNCTION_LIST ADVE IF_DATA DIM_X DIRECT 0x813D2E /end CHARACTERISTIC
/begin CHARACTERISTIC DLRPID0T "Fehlerzeit für DLR-Stellbereich im Anschlag zur erweiterten Stellertauscherkenng" VALUE 0x813D30 KwUw 655.3500 t10msxs_uw_b655p35 0.00 655.3500 FUNCTION_LIST ADVE IF_DATA DIM_X DIRECT 0x813D30 /end CHARACTERISTIC
/begin CHARACTERISTIC DLRPID1T "zulässige Fehlerzeit 1 für DLR-Stellbereich am Anschlag" VALUE 0x813D32 KwUw 655.3500 t10msxs_uw_b655p35 0.00 655.3500 FUNCTION_LIST ADVE IF_DATA DIM_X DIRECT 0x813D32 /end CHARACTERISTIC
/begin CHARACTERISTIC DLRPID2T "zulässige Fehlerzeit 2 für DLR-Stellbereich am Anschlag" VALUE 0x813D34 KwUw 655.3500 t10msxs_uw_b655p35 0.00 655.3500 FUNCTION_LIST ADVE IF_DATA DIM_X DIRECT 0x813D34 /end CHARACTERISTIC
/begin CHARACTERISTIC DLRPIDMAX "max. zulässiges PWM-Tastverhältnis für DLR" VALUE 0x813D36 KwUw 99.99847 rel_uw_b100 0.00 99.99847 FUNCTION_LIST ADVE IF_DATA DIM_X DIRECT 0x813D36 /end CHARACTERISTIC
/begin CHARACTERISTIC DLRPIDMIN "min. zulässiges PWM-Tastverhältnis für DLR" VALUE 0x813D38 KwUw 99.99847 rel_uw_b100 0.00 99.99847 FUNCTION_LIST ADVE IF_DATA DIM_X DIRECT 0x813D38 /end CHARACTERISTIC
/begin CHARACTERISTIC DLRPIDSTMN "min. Schwelle für PWM-Tastverhältnis des DLR bei temp. UMA-Adapt." VALUE 0x813D82 KwUw 99.99847 rel_uw_b100 0.00 99.99847 FUNCTION_LIST BGDVE IF_DATA DIM_X DIRECT 0x813D82 /end CHARACTERISTIC
/begin CHARACTERISTIC DLRUBSOLL "DLR, Batterie Normalspannung" VALUE 0x818490 KwUb 19.38 spg_ubatt 0.00 19.38 FUNCTION_LIST ADVE IF_DATA DIM_X DIRECT 0x818490 /end CHARACTERISTIC
/begin CHARACTERISTIC DLRUMABAND "Unsicherheitsband bei Sprung aus UMA-Bereich" VALUE 0x813D3A KwUw 4.882813 relDK_q0p02441 0.00 4.882813 FUNCTION_LIST ADVE IF_DATA DIM_X DIRECT 0x813D3A /end CHARACTERISTIC
/begin CHARACTERISTIC DLRUMAIINI "Vorladewert I-Anteil bei Sprung aus UMA-Bereich" VALUE 0x813D3C KwSw 12824.85 rel_q0p1957 -6412.524 6412.329 FUNCTION_LIST ADVE IF_DATA DIM_X DIRECT 0x813D3C /end CHARACTERISTIC
/begin CHARACTERISTIC DLSDHK "Dämpfung PT2-Filter Lastschlagdämpfung bei hohem Kupplungsmoment" VALUE 0x81630A KwUw 1.999969 fak_uw_b2 0.00 1.999969 FUNCTION_LIST MDFAW IF_DATA DIM_X DIRECT 0x81630A /end CHARACTERISTIC
/begin CHARACTERISTIC DLUL "Delta-Last für Überladeschutz-Reset" VALUE 0x819345 KwSb 250.0 p_sb_q10 0.00 250.0 FUNCTION_LIST DLDR IF_DATA DIM_X DIRECT 0x819345 /end CHARACTERISTIC
/begin CHARACTERISTIC DLURMIN "Drehzahlabh. Laufunruhe-Referenz-Minimalwert 1" CURVE 0x8103FE GklWSb 463.8 luquant -232.8 231.0 FUNCTION_LIST DMDDLU IF_DATA DIM_X DIRECT 0x8103FE
 /begin AXIS_DESCR COM_AXIS nmot nmot_ub_q40 8 0.00 10200. AXIS_PTS_REF SNM08DMUB /end AXIS_DESCR
/end CHARACTERISTIC
/begin CHARACTERISTIC DLURVS "Drehzahlabh. Laufunruhe-Referenz-Minimalwert für Ventilhubst." CURVE 0x81080C GklWSb 463.8 luquant -232.8 231.0 FUNCTION_LIST DMDDVS IF_DATA DIM_X DIRECT 0x81080C
 /begin AXIS_DESCR COM_AXIS nmot nmot_ub_q40 8 0.00 10200. AXIS_PTS_REF SNM08DMUB /end AXIS_DESCR
/end CHARACTERISTIC
/begin CHARACTERISTIC DMADFK "Maximal adaptierbares Delta-Verlustmoment pro Adaptionsphase Fahrst.+Kompr." VALUE 0x819798 KwUb 24.90 rel_ub_b24p9 0.00 24.90 FUNCTION_LIST MDVERAD IF_DATA DIM_X DIRECT 0x819798 /end CHARACTERISTIC
/begin CHARACTERISTIC DMADFS "Maximal adaptierbares Delta-Verlustmoment pro Adaptionsphase mit Fahrstufe ein" VALUE 0x819799 KwUb 24.90 rel_ub_b24p9 0.00 24.90 FUNCTION_LIST MDVERAD IF_DATA DIM_X DIRECT 0x819799 /end CHARACTERISTIC
/begin CHARACTERISTIC DMADKO "Maximal adaptierbares Delta-Verlustmoment pro Adaptionsphase Kompr.ein" VALUE 0x81979A KwUb 24.90 rel_ub_b24p9 0.00 24.90 FUNCTION_LIST MDVERAD IF_DATA DIM_X DIRECT 0x81979A /end CHARACTERISTIC
/begin CHARACTERISTIC DMADLL "Maximal adaptierbares Delta-Verlustmoment pro Adaptionsphase ohne Last" VALUE 0x81979B KwUb 24.90 rel_ub_b24p9 0.00 24.90 FUNCTION_LIST MDVERAD IF_DATA DIM_X DIRECT 0x81979B /end CHARACTERISTIC
/begin CHARACTERISTIC DMADMNFK "Minimal adaptierbares Delta-Verlustmoment Fahrstufe eingelegt + Kompressor ein" VALUE 0x81979C KwUb 24.90 rel_ub_bn24p9 -24.90 0.00 FUNCTION_LIST MDVERAD IF_DATA DIM_X DIRECT 0x81979C /end CHARACTERISTIC
/begin CHARACTERISTIC DMADMNFS "Minimal adaptierbares Delta-Verlustmoment Fahrstufe eingelegt" VALUE 0x81979D KwUb 24.90 rel_ub_bn24p9 -24.90 0.00 FUNCTION_LIST MDVERAD IF_DATA DIM_X DIRECT 0x81979D /end CHARACTERISTIC
/begin CHARACTERISTIC DMADMNKO "Minimal adaptierbares Delta-Verlustmoment Klimakompressor ein" VALUE 0x81979E KwUb 24.90 rel_ub_bn24p9 -24.90 0.00 FUNCTION_LIST MDVERAD IF_DATA DIM_X DIRECT 0x81979E /end CHARACTERISTIC
/begin CHARACTERISTIC DMADMNLL "Minimal adaptierbares Delta-Verlustmoment ohne Last" VALUE 0x81979F KwUb 24.90 rel_ub_bn24p9 -24.90 0.00 FUNCTION_LIST MDVERAD IF_DATA DIM_X DIRECT 0x81979F /end CHARACTERISTIC
/begin CHARACTERISTIC DMADMXFK "Maximal adaptierbares Delta-Verlustmoment Farstufe + Klimakompressor ein" VALUE 0x8197A0 KwUb 24.90 rel_ub_b24p9 0.00 24.90 FUNCTION_LIST MDVERAD IF_DATA DIM_X DIRECT 0x8197A0 /end CHARACTERISTIC
/begin CHARACTERISTIC DMADMXFS "Maximal adaptierbares Delta-Verlustmoment Farstufe ein" VALUE 0x8197A1 KwUb 24.90 rel_ub_b24p9 0.00 24.90 FUNCTION_LIST MDVERAD IF_DATA DIM_X DIRECT 0x8197A1 /end CHARACTERISTIC
/begin CHARACTERISTIC DMADMXKO "Maximal adaptierbares Delta-Verlustmoment Klimakompressor ein" VALUE 0x8197A2 KwUb 24.90 rel_ub_b24p9 0.00 24.90 FUNCTION_LIST MDVERAD IF_DATA DIM_X DIRECT 0x8197A2 /end CHARACTERISTIC
/begin CHARACTERISTIC DMADMXLL "Maximal adaptierbares Delta-Verlustmoment ohne Last" VALUE 0x8197A3 KwUb 24.90 rel_ub_b24p9 0.00 24.90 FUNCTION_LIST MDVERAD IF_DATA DIM_X DIRECT 0x8197A3 /end CHARACTERISTIC
/begin CHARACTERISTIC DMAUFG "Steigung Faktor Drehmomentangleich für Getriebemoment" VALUE 0x8116AF KwUb 0.9961 fak_ub_b1 0.00 0.9961 FUNCTION_LIST MDAUTG IF_DATA DIM_X DIRECT 0x8116AF /end CHARACTERISTIC
/begin CHARACTERISTIC DMAUFN "Delta-Moment Aufregelung nach Drehmomenteingriff" CURVE 0x81E33C KlAUwSstUwWUw 99.99847 rel_uw_b100 0.00 99.99847 FUNCTION_LIST MDZW IF_DATA DIM_X DIRECT 0x81E33C
 /begin AXIS_DESCR STD_AXIS nmot_w nmot_uw_q0p25 8 0.00 16383.75 DEPOSIT ABSOLUT /end AXIS_DESCR
/end CHARACTERISTIC
/begin CHARACTERISTIC DMDBGV "Deltamoment für Bildung Initialisierungswert mibgv_w" VALUE 0x8162F8 KwSw 199.9969 rel_sw_b100 -100.0000 99.99695 FUNCTION_LIST MDBGV IF_DATA DIM_X DIRECT 0x8162F8 /end CHARACTERISTIC
/begin CHARACTERISTIC DMDKOE "Anfangswert Momentenfilter bei Klimakompressor Einschalten" CURVE 0x81974A KlAUbSstUbWUb 49.73 rel_ub_b49p725 0.00 49.73 FUNCTION_LIST MDVERB IF_DATA DIM_X DIRECT 0x81974A /begin AXIS_DESCR STD_AXIS nmot nmot_ub_q40 6 0.00 10200. DEPOSIT ABSOLUT /end AXIS_DESCR /end CHARACTERISTIC
/begin CHARACTERISTIC DMDNSM "Delta Moment zur Nachstartkompensation" CURVE 0x8197CD KlAUbSstUbWUb 99.61 rel_ub_b99p6 0.00 99.61 FUNCTION_LIST MDVER IF_DATA DIM_X DIRECT 0x8197CD
 /begin AXIS_DESCR STD_AXIS tmot temp_ub_q0p75_o48 8 -48.00 143.3 DEPOSIT ABSOLUT /end AXIS_DESCR
/end CHARACTERISTIC
/begin CHARACTERISTIC DMDPUG "delta Moment Dashpotende" CURVE 0x81DC28 GklWSw 199.9969 rel_sw_b100 -100.0000 99.99695 FUNCTION_LIST MDFAW IF_DATA DIM_X DIRECT 0x81DC28 /begin AXIS_DESCR COM_AXIS gangi dez 8 0.00 255.0 AXIS_PTS_REF SGA08MDUB /end AXIS_DESCR /end CHARACTERISTIC
/begin CHARACTERISTIC DMIFAVSG "Hysterese Schaltschwelle in Abhängigkeit von mifa und gangi" MAP 0x819BA8 KfAxUbAyUbSstxUbSstyUbWUb 99.61 rel_ub_b100 0.00 99.61 FUNCTION_LIST VS IF_DATA DIM_X DIRECT 0x819BA8 /begin AXIS_DESCR STD_AXIS ntolvs nmot_ub_q40 8 0.00 10200. DEPOSIT ABSOLUT /end AXIS_DESCR /begin AXIS_DESCR STD_AXIS gangi dez 8 0.00 255.0 DEPOSIT ABSOLUT /end AXIS_DESCR /end CHARACTERISTIC
/begin CHARACTERISTIC DMIFSAWE "Schwelle bei mimin-Sprung für Rücksetzen von B_fil" VALUE 0x81630C KwUw 99.99695 rel_uw_b100 0.001525879 99.99847 FUNCTION_LIST MDFAW IF_DATA DIM_X DIRECT 0x81630C /end CHARACTERISTIC
/begin CHARACTERISTIC DMIHVS "Korrektur Umschaltschwelle Ventilhub in Abhängigkeit der Höhe" CURVE 0x819BFA KlAUbSstUbWUb 99.61 rel_ub_b100 0.00 99.61 FUNCTION_LIST VS IF_DATA DIM_X DIRECT 0x819BFA /begin AXIS_DESCR STD_AXIS fho fak_ub_b4 8 0.00 3.984 DEPOSIT ABSOLUT /end AXIS_DESCR /end CHARACTERISTIC
/begin CHARACTERISTIC DMLDTEFN "Schwelle Luftmassenstrom unplausibel für Erkennung Fehler in DTEV" VALUE 0x81E2F8 KwSw 2.000000 m_q0p0031 -2.000000 0.00 FUNCTION_LIST DTEV IF_DATA DIM_X DIRECT 0x81E2F8 /end CHARACTERISTIC
/begin CHARACTERISTIC DMLDTEFX "Luftmassenschwelle für Erkennung TEV defekt nicht mehr nötig" VALUE 0x81E2FA KwSw 3.025000 m_q0p0031 0.00 3.025000 FUNCTION_LIST DTEV IF_DATA DIM_X DIRECT 0x81E2FA /end CHARACTERISTIC
/begin CHARACTERISTIC DMLDTEMN "Untere Schwelle für Erkennung Luftmassenstrom unplausibel für Auswertung in DTEV" VALUE 0x81E2FC KwSw 2.000000 m_q0p0031 -2.000000 0.00 FUNCTION_LIST DTEV IF_DATA DIM_X DIRECT 0x81E2FC /end CHARACTERISTIC
/begin CHARACTERISTIC DMLDTEMX "Obere Schwelle für Erkennung Luftmassenstrom unplausibel für Auswertung in DTEV" VALUE 0x81E2FE KwSw 2.000000 m_q0p0031 0.00 2.000000 FUNCTION_LIST DTEV IF_DATA DIM_X DIRECT 0x81E2FE /end CHARACTERISTIC
/begin CHARACTERISTIC DMLLNG "LLR: D-Verstärkung abh. von ngasf für Luftpfad" CURVE 0x8159AC KlASwSstSwWSw 199.9841 rel_q0p00305 -99.99360 99.99055 FUNCTION_LIST LLRRM IF_DATA DIM_X DIRECT 0x8159AC
 /begin AXIS_DESCR STD_AXIS ngasf_w nmotg_sw_q0p39 6 -12800.16 12799.77 DEPOSIT ABSOLUT /end AXIS_DESCR
/end CHARACTERISTIC
/begin CHARACTERISTIC DMLLNGV "LLR: D-Verstärkung abh. von ngasf für Luftpfad" CURVE 0x8159C6 KlASwSstSwWSw 199.9841 rel_q0p00305 -99.99360 99.99055 FUNCTION_LIST LLRRM IF_DATA DIM_X DIRECT 0x8159C6
 /begin AXIS_DESCR STD_AXIS ngasf_w nmotg_sw_q0p39 6 -12800.16 12799.77 DEPOSIT ABSOLUT /end AXIS_DESCR
/end CHARACTERISTIC
/begin CHARACTERISTIC DMLLRLMNN "Untere Begrenzung für dmllrl" CURVE 0x8115DE GklWSb 50.00 rel_sb_q0p39 -50.00 0.00 FUNCTION_LIST LLRRM IF_DATA DIM_X DIRECT 0x8115DE
 /begin AXIS_DESCR COM_AXIS nmot nmot_ub_q40 6 0.00 10200. AXIS_PTS_REF SNM06LLUB /end AXIS_DESCR
/end CHARACTERISTIC
/begin CHARACTERISTIC DMLLRLMXN "Sicherheitskonzept: obere Begrenzung für dmllrl" CURVE 0x8115E4 GklWUb 99.61 rel_ub_b99p6 0.00 99.61 FUNCTION_LIST LLRRM IF_DATA DIM_X DIRECT 0x8115E4
 /begin AXIS_DESCR COM_AXIS nmot nmot_ub_q40 6 0.00 10200. AXIS_PTS_REF SNM06LLUB /end AXIS_DESCR
/end CHARACTERISTIC
/begin CHARACTERISTIC DMLLRMNN "Untere Begrenzung für dmllr_w" CURVE 0x8115EA GklWSb 50.00 rel_sb_q0p39 -50.00 0.00 FUNCTION_LIST LLRRM IF_DATA DIM_X DIRECT 0x8115EA
 /begin AXIS_DESCR COM_AXIS nmot nmot_ub_q40 6 0.00 10200. AXIS_PTS_REF SNM06LLUB /end AXIS_DESCR
/end CHARACTERISTIC
/begin CHARACTERISTIC DMLLRMXN "Sicherheitskonzept: obere Begrenzung für dmllr" CURVE 0x8115F0 GklWUb 99.61 rel_ub_b99p6 0.00 99.61 FUNCTION_LIST LLRRM IF_DATA DIM_X DIRECT 0x8115F0
 /begin AXIS_DESCR COM_AXIS nmot nmot_ub_q40 6 0.00 10200. AXIS_PTS_REF SNM06LLUB /end AXIS_DESCR
/end CHARACTERISTIC
/begin CHARACTERISTIC DMLSDUG "Delta Moment Ende Lastschlagdämpfung" CURVE 0x81DC38 GklWSw 199.9969 rel_sw_b100 -100.0000 99.99695 FUNCTION_LIST MDFAW IF_DATA DIM_X DIRECT 0x81DC38 /begin AXIS_DESCR COM_AXIS gangi dez 8 0.00 255.0 AXIS_PTS_REF SGA08MDUB /end AXIS_DESCR /end CHARACTERISTIC
/begin CHARACTERISTIC DMRESLL "LLR: Abbaugeschwindigkeit der erhöhten Drehmomentreserve" VALUE 0x8114CE KwUb 6.375 rel_ub_bn6p375 -6.375 0.00 FUNCTION_LIST LLRMR IF_DATA DIM_X DIRECT 0x8114CE /end CHARACTERISTIC
/begin CHARACTERISTIC DMRFATE "Hysterese Hochlasterkennung" VALUE 0x8187F6 KwUb 99.61 rel_ub_b99p6 0.00 99.61 FUNCTION_LIST BBTEGA IF_DATA DIM_X DIRECT 0x8187F6 /end CHARACTERISTIC
/begin CHARACTERISTIC DMRFAWE "Schwelle mrfa-Gradient für Deaktivierung PT1-Filter beim Wiedereinsetzen" VALUE 0x81630E KwUw 199.9969 rel_uw_b200 0.00 199.9969 FUNCTION_LIST MDFAW IF_DATA DIM_X DIRECT 0x81630E /end CHARACTERISTIC
/begin CHARACTERISTIC DMRFGRAL "Delta Relatives Moment bei langsamer FGR-Abschaltung" VALUE 0x813EEC KwUw 199.9969 rel_uw_b200 0.00 199.9969 FUNCTION_LIST FGRAUS IF_DATA DIM_X DIRECT 0x813EEC /end CHARACTERISTIC
/begin CHARACTERISTIC DMRKTD "Momentenreserve für Katalysator-Diagnose" VALUE 0x81B8A0 KwUw 99.99847 rel_uw_b100 0.00 99.99847 FUNCTION_LIST DKATLRS IF_DATA DIM_X DIRECT 0x81B8A0 /end CHARACTERISTIC
/begin CHARACTERISTIC DMRLASH "Momentenreserve für Diagnose Lambdasonden-Alterungsüberwachung hinter KAT" VALUE 0x81B8BE KwUw 99.99847 rel_uw_b100 0.00 99.99847 FUNCTION_LIST DLSAHK IF_DATA DIM_X DIRECT 0x81B8BE /end CHARACTERISTIC
/begin CHARACTERISTIC DMRLSH "Momentenreserve für Diagnose Lambdasonden hinter KAT" VALUE 0x81B8DA KwUw 99.99847 rel_uw_b100 0.00 99.99847 FUNCTION_LIST DLSH IF_DATA DIM_X DIRECT 0x81B8DA /end CHARACTERISTIC
/begin CHARACTERISTIC DMRLSV "Momentenreserve für Diagnose Lambdasonde vor Kat" VALUE 0x81B8EC KwUw 99.99847 rel_uw_b100 0.00 99.99847 FUNCTION_LIST DLSU IF_DATA DIM_X DIRECT 0x81B8EC /end CHARACTERISTIC
/begin CHARACTERISTIC DMSDRLTM "Delta-rl-Schwelle in Abhängigkeit von tmot für Sperre Bedingung B_dslmes" CURVE 0x819FFE KlAUbSstUbWUw 1535.977 rel_uw_q0p0234 0.00 1535.977 FUNCTION_LIST DSLSLRS IF_DATA DIM_X DIRECT 0x819FFE
 /begin AXIS_DESCR STD_AXIS tmot temp_ub_q0p75_o48 4 -48.00 143.3 DEPOSIT ABSOLUT /end AXIS_DESCR
/end CHARACTERISTIC
/begin CHARACTERISTIC DMSNTEMN "Minmale normierte Massenstromänderung TEV" VALUE 0x81E300 KwSw 3281.700 m_q0p1 -5.000000 3276.700 FUNCTION_LIST DTEV IF_DATA DIM_X DIRECT 0x81E300 /end CHARACTERISTIC
/begin CHARACTERISTIC DMSNTEMX "Maximale normierte Massenstromänderung TEV" VALUE 0x81E302 KwSw 3274.700 m_q0p1 2.000000 3276.700 FUNCTION_LIST DTEV IF_DATA DIM_X DIRECT 0x81E302 /end CHARACTERISTIC
/begin CHARACTERISTIC DMSTES "Kennlinie maximale Zunahme Massenstrom Tankentlüftung" CURVE 0x81762C KlAUwSstUwWUw 51200.00 m_uw_q3p2 0.00 51200.00 FUNCTION_LIST TEB IF_DATA DIM_X DIRECT 0x81762C
 /begin AXIS_DESCR STD_AXIS mstesoll_w m_uw_b25p6 6 0.00 25.59961 DEPOSIT ABSOLUT /end AXIS_DESCR
/end CHARACTERISTIC
/begin CHARACTERISTIC DMVTEVDO "Schwelle Verlustadaption zur Unterscheidung min, max Fehler in DTEV" VALUE 0x81E304 KwSw 199.9969 rel_sw_b100 -100.0000 99.99695 FUNCTION_LIST DTEV IF_DATA DIM_X DIRECT 0x81E304 /end CHARACTERISTIC
/begin CHARACTERISTIC DMXRDL "Begrenzung bei max. Laufunruhe-Referenzwert-Änderung von dlurs" VALUE 0x810406 KwSb 231.0 luquant 0.00 231.0 FUNCTION_LIST DMDDLU IF_DATA DIM_X DIRECT 0x810406 /end CHARACTERISTIC
/begin CHARACTERISTIC DMXRDLVS "Änderungsbegrenzung Laufunruhe-Referenzwert-Änderung bei Diag. DVS" VALUE 0x810814 KwSb 231.0 luquant 0.00 231.0 FUNCTION_LIST DMDDVS IF_DATA DIM_X DIRECT 0x810814 /end CHARACTERISTIC
/begin CHARACTERISTIC DMXRFL "Begrenzung bei max. Filter-Laufunruhe-Referenzwert-Änderung" VALUE 0x8102B5 KwSb 231.0 luquant 0.00 231.0 FUNCTION_LIST DMDLUA IF_DATA DIM_X DIRECT 0x8102B5 /end CHARACTERISTIC
/begin CHARACTERISTIC DMXRLU "Begrenzung bei max. Laufunruhe-Referenzwert-Änderung" VALUE 0x8105A2 KwSb 231.0 luquant 0.00 231.0 FUNCTION_LIST DMDLU IF_DATA DIM_X DIRECT 0x8105A2 /end CHARACTERISTIC
/begin CHARACTERISTIC DN10BURN "Minimaler Drehzahlanstieg für ""Verbrennnung erfolgt""" VALUE 0x81124C KwUb 2550. nmot_ub_q10 0.00 2550. FUNCTION_LIST ESSTT IF_DATA DIM_X DIRECT 0x81124C /end CHARACTERISTIC
/begin CHARACTERISTIC DNARAU "Drehzahlhysterese AR-Abschaltung" VALUE 0x811693 KwUb 10200. nmot_ub_q40 0.00 10200. FUNCTION_LIST ARMD IF_DATA DIM_X DIRECT 0x811693 /end CHARACTERISTIC
/begin CHARACTERISTIC DNBURN "Minimaler Drehzahlanstieg für erkannte Verbrennung" CURVE 0x811422 KlAUbSstUbWUb 255.0 dez 0.00 255.0 FUNCTION_LIST STADAP IF_DATA DIM_X DIRECT 0x811422 /begin AXIS_DESCR STD_AXIS nmot nmot_ub_q40 12 0.00 10200. DEPOSIT ABSOLUT /end AXIS_DESCR /end CHARACTERISTIC
/begin CHARACTERISTIC DNDLLRO "Maxmimale Drehzahlabweichung (Unterdrehzahl) für Diagnose LLR" VALUE 0x8196DF KwUb 1270. nmot_ub_q10 0.00 1270. FUNCTION_LIST DLLR IF_DATA DIM_X DIRECT 0x8196DF /end CHARACTERISTIC
/begin CHARACTERISTIC DNDLLRU "Maxmimale Drehzahlabweichung (Überdrehzahl) für Diagnose LLR" VALUE 0x8196E0 KwSb 1280. nmot_ub_q10 -1280. 0.00 FUNCTION_LIST DLLR IF_DATA DIM_X DIRECT 0x8196E0 /end CHARACTERISTIC
/begin CHARACTERISTIC DNDTEO "obere Nsoll-Nist-Schwelle für Abbruch Diagnose TEV" VALUE 0x819B39 KwSb 200.0 nmot_ub_q10 0.00 200.0 FUNCTION_LIST DTEV IF_DATA DIM_X DIRECT 0x819B39 /end CHARACTERISTIC
/begin CHARACTERISTIC DNDTEU "lower Nsoll-Nist-Schwelle für Abbruch Diagnose TEV" VALUE 0x819B3A KwSb 200.0 nmot_ub_q10 -200.0 0.00 FUNCTION_LIST DTEV IF_DATA DIM_X DIRECT 0x819B3A /end CHARACTERISTIC
/begin CHARACTERISTIC DNFILO "obere Schwelle für Gradient des Filterausgangs ndfil" VALUE 0x816078 KwSw 8191.750 nmot_sw_q0p25 0.00 8191.750 FUNCTION_LIST ARMD IF_DATA DIM_X DIRECT 0x816078 /end CHARACTERISTIC
/begin CHARACTERISTIC DNKH "Abregelung Leerlaufdrehzahl nach Kat.-Heizung" VALUE 0x819106 KwUb 2550. nmot_ub_q10 0.00 2550. FUNCTION_LIST BBKHZ IF_DATA DIM_X DIRECT 0x819106 /end CHARACTERISTIC
/begin CHARACTERISTIC DNLBZ "Leerlauf-Solldrehzahlanhebung für Batterie-Ladebilanz" CURVE 0x8196E7 KlAUbSstUbWUb 2550. nmot_ub_q10 0.00 2550. FUNCTION_LIST LLRNS IF_DATA DIM_X DIRECT 0x8196E7 /begin AXIS_DESCR STD_AXIS lbz rel_ub_b99p6 6 0.00 99.61 DEPOSIT ABSOLUT /end AXIS_DESCR /end CHARACTERISTIC
/begin CHARACTERISTIC DNLLR "Drehzahlband oberhalb nstat für LLR-Freigabe" VALUE 0x8114CB KwUb 2550. nmot_ub_q10 0.00 2550. FUNCTION_LIST LLRBB IF_DATA DIM_X DIRECT 0x8114CB /end CHARACTERISTIC
/begin CHARACTERISTIC DNLLRES "LLR: Unterdrehzahlschwelle zur Erhöhung der Momentenreserve im LL" VALUE 0x8114CF KwSb 2550. nmotd_sb_q10 -1280. 1270. FUNCTION_LIST LLRMR IF_DATA DIM_X DIRECT 0x8114CF /end CHARACTERISTIC
/begin CHARACTERISTIC DNLLRIST "Überdrehzahlschwelle für Integratorreset" VALUE 0x8115F6 KwSb 2550. nmotd_sb_q10 -1280. 1270. FUNCTION_LIST LLRRM IF_DATA DIM_X DIRECT 0x8115F6 /end CHARACTERISTIC
/begin CHARACTERISTIC DNMAXDZ "Delta-Drehzahl, Abregelung der Drehzahlgrenze bei doppelter Zündausgabe" VALUE 0x8166FC KwUw 16383.75 nmot_uw_q0p25 0.00 16383.75 FUNCTION_LIST NMAXMD IF_DATA DIM_X DIRECT 0x8166FC /end CHARACTERISTIC
/begin CHARACTERISTIC DNMAXH "Überschreitung der Maximaldrehzahl für Einspritzausblendung an allen Zylindern" VALUE 0x8166FE KwUw 2550.000 nmot_uw_q0p25 0.00 2550.000 FUNCTION_LIST NMAXMD IF_DATA DIM_X DIRECT 0x8166FE /end CHARACTERISTIC
/begin CHARACTERISTIC DNMNI "Kleinstmöglicher Wert für dn beim I-Anteil" VALUE 0x8115F7 KwSb 2550. nmotd_sb_q10 -1280. 1270. FUNCTION_LIST LLRRM IF_DATA DIM_X DIRECT 0x8115F7 /end CHARACTERISTIC
/begin CHARACTERISTIC DNMNWS "Drehzahlhysterese für NWS-Umschaltung" CURVE 0x8186A7 KlAUbSstUbWUb 10200. nmot_ub_q40 0.00 10200. FUNCTION_LIST NWS IF_DATA DIM_X DIRECT 0x8186A7 /begin AXIS_DESCR STD_AXIS nmot nmot_ub_q40 2 0.00 10200. DEPOSIT ABSOLUT /end AXIS_DESCR /end CHARACTERISTIC
/begin CHARACTERISTIC DNSAH "Delta n SA high bezogen auf nWE" VALUE 0x8114C1 KwUb 5080. nmot_ub_q40 0.00 5080. FUNCTION_LIST BBSAWE IF_DATA DIM_X DIRECT 0x8114C1 /end CHARACTERISTIC
/begin CHARACTERISTIC DNSAL "Delta n SA low bezogen auf nWE" VALUE 0x8114C2 KwUb 5080. nmot_ub_q40 0.00 5080. FUNCTION_LIST BBSAWE IF_DATA DIM_X DIRECT 0x8114C2 /end CHARACTERISTIC
/begin CHARACTERISTIC DNSLL "Schubabschalte-Hysterese bei WE im Leerlauf" VALUE 0x8114C3 KwUb 10200. nmot_ub_q40 0.00 10200. FUNCTION_LIST BBSAWE IF_DATA DIM_X DIRECT 0x8114C3 /end CHARACTERISTIC
/begin CHARACTERISTIC DNSNFX "Offset zur Bestimmung der oberen Grenze für die Solldrehzahlnachführung" VALUE 0x8115C1 KwUb 2550. nmot_ub_q10 0.00 2550. FUNCTION_LIST LLRNS IF_DATA DIM_X DIRECT 0x8115C1 /end CHARACTERISTIC
/begin CHARACTERISTIC DNTOLVS "Hysterese Drehzahlschwelle für Freigabebit (pol-Ersatz)" VALUE 0x819C0B KwUb 10200. nmot_ub_q40 0.00 10200. FUNCTION_LIST VS IF_DATA DIM_X DIRECT 0x819C0B /end CHARACTERISTIC
/begin CHARACTERISTIC DNVSA "Schubabschaltedrehzahlanhebung bei kleiner Geschwindigkeit" VALUE 0x8114C4 KwUb 10200. nmot_ub_q40 0.00 10200. FUNCTION_LIST BBSAWE IF_DATA DIM_X DIRECT 0x8114C4 /end CHARACTERISTIC
/begin CHARACTERISTIC DNWEK "Delta n für WE bei Klima (AC)" VALUE 0x8114C5 KwUb 10200. nmot_ub_q40 0.00 10200. FUNCTION_LIST BBSAWE IF_DATA DIM_X DIRECT 0x8114C5 /end CHARACTERISTIC
/begin CHARACTERISTIC DNWVLS "Hysteresis Drehzahlschwelle f. Vollastzündw. spät Motorschutz" VALUE 0x819D8D KwUb 10200. nmot_ub_q40 0.00 10200. FUNCTION_LIST ZWBTSK IF_DATA DIM_X DIRECT 0x819D8D /end CHARACTERISTIC
/begin CHARACTERISTIC DPDSVLU "Delta Druckwert für Signalvergleich Ladedruck mit Umgebungsdruck" VALUE 0x81BDC0 KwUw 2559.961 p_uw_q0p039 0.00 2559.961 FUNCTION_LIST GGDSAS IF_DATA DIM_X DIRECT 0x81BDC0 /end CHARACTERISTIC
/begin CHARACTERISTIC DPSLV "minimale Druckdifferenz Sekundärluftventi" VALUE 0x818135 KwUb 1275. p_ub_q5 0.00 1275. FUNCTION_LIST SLS T2DFA T2LID IF_DATA DIM_X DIRECT 0x818135 /end CHARACTERISTIC
/begin CHARACTERISTIC DPUPS "Druckdifferenz für Umschaltung Referenzdruck vor Drosselklappe" VALUE 0x8110A9 KwUb 2550. p_ub_q10 0.00 2550. FUNCTION_LIST FUEDK IF_DATA DIM_X DIRECT 0x8110A9 /end CHARACTERISTIC
/begin CHARACTERISTIC DPUPVDK "Differenzdruck pu-pvdk" CURVE 0x81BDC2 KlAUwSstUwWUw 2559.961 p_uw_q0p039 0.00 2559.961 FUNCTION_LIST GGDSAS IF_DATA DIM_X DIRECT 0x81BDC2 /begin AXIS_DESCR STD_AXIS ml_w m_uw_b6553p5 8 0.00 6553.500 DEPOSIT ABSOLUT /end AXIS_DESCR /end CHARACTERISTIC
/begin CHARACTERISTIC DRISIGH "Diagnoseschwelle Ri-Sonde für Signalunterbrechung hinter KAT" VALUE 0x81B8DC KwUw 131070.0 r_uw_q2 0.00 131070.0 FUNCTION_LIST DLSH IF_DATA DIM_X DIRECT 0x81B8DC /end CHARACTERISTIC
/begin CHARACTERISTIC DRLDYNU "drl-Schwellwert für te-Nachspritzer/Reduktion" VALUE 0x813F9A KwSw 767.9531 rel_sw_q0p0234 0.02343750 767.9766 FUNCTION_LIST BGRLP IF_DATA DIM_X DIRECT 0x813F9A /end CHARACTERISTIC
/begin CHARACTERISTIC DRLKTDP "Schwelle für Laständerung in Kat-Diagnose" VALUE 0x8183B9 KwSb 191.3 rel_sb_q0p75 -96.00 95.25 FUNCTION_LIST DKATLRS IF_DATA DIM_X DIRECT 0x8183B9 /end CHARACTERISTIC
/begin CHARACTERISTIC DRLKTDPT "Schwelle für Laständerung in Kat-Diagnose bei Testeransteuerung" VALUE 0x8183BA KwSb 191.3 rel_sb_q0p75 -96.00 95.25 FUNCTION_LIST DKATLRS IF_DATA DIM_X DIRECT 0x8183BA /end CHARACTERISTIC
/begin CHARACTERISTIC DRLMIN "Min. Füllungsänderung zur Auslösung eines Nachspritzers" VALUE 0x813F9C KwSw 1535.977 rel_sw_q0p0234 -768.0000 767.9766 FUNCTION_LIST BGRLP IF_DATA DIM_X DIRECT 0x813F9C /end CHARACTERISTIC
/begin CHARACTERISTIC DRLMX "Schwelle für Laständerung" VALUE 0x8183FD KwUb 191.3 rel_ub_q0p75 0.00 191.3 FUNCTION_LIST DLSU IF_DATA DIM_X DIRECT 0x8183FD /end CHARACTERISTIC
/begin CHARACTERISTIC DRLNNWSG "Lasthysteresekennfeld für die NWS-Ansteuerung" MAP 0x8186AC KfAxUbAyUbSstxUbSstyUbWUb 191.3 rel_ub_q0p75 0.00 191.3 FUNCTION_LIST NWS IF_DATA DIM_X DIRECT 0x8186AC /begin AXIS_DESCR STD_AXIS nmot nmot_ub_q40 6 0.00 10200. DEPOSIT ABSOLUT /end AXIS_DESCR /begin AXIS_DESCR STD_AXIS gangi dez 8 0.00 255.0 DEPOSIT ABSOLUT /end AXIS_DESCR /end CHARACTERISTIC
/begin CHARACTERISTIC DRLSOLA "Misfire Detection : Schwelle Lastdynamik für Ausblendung" CURVE 0x813856 GklWUw 767.9766 relNWU_q0p0234 0.00 767.9766 FUNCTION_LIST DMDSTP IF_DATA DIM_X DIRECT 0x813856
 /begin AXIS_DESCR COM_AXIS rl rel_ub_q0p75 8 0.00 191.3 AXIS_PTS_REF SRL08DMUB /end AXIS_DESCR
/end CHARACTERISTIC
/begin CHARACTERISTIC DRLSOLMF "Schwelle delta rlsol für Medianfilter" VALUE 0x815238 KwUw 1535.977 rel_uw_q0p0234 0.00 1535.977 FUNCTION_LIST FUEDK IF_DATA DIM_X DIRECT 0x815238 /end CHARACTERISTIC
/begin CHARACTERISTIC DRLSOLST "Misfire Detection : Schwelle Lastdynamik für Ausblendung nach Start" VALUE 0x813866 KwUw 767.9766 relNWU_q0p0234 0.00 767.9766 FUNCTION_LIST DMDSTP IF_DATA DIM_X DIRECT 0x813866 /end CHARACTERISTIC
/begin CHARACTERISTIC DSLGRAD "Gradient für Drucksensor Ladedruck" VALUE 0x813EFE KwUw 1023.984 dgrad_uw_q0p015 0.00 1023.984 FUNCTION_LIST GGDSAS IF_DATA DIM_X DIRECT 0x813EFE /end CHARACTERISTIC
/begin CHARACTERISTIC DSLOFS "Offset Drucksensor Ladedruck" VALUE 0x813F00 KwSw 2559.961 p_sw_q0p039 -1280.000 1279.961 FUNCTION_LIST GGDSAS IF_DATA DIM_X DIRECT 0x813F00 /end CHARACTERISTIC
/begin CHARACTERISTIC DSLVFZMN "vfzg-Schwelle:  Aktivieren Phase 4 durch B_ll-Bedingung" VALUE 0x8180FE KwUb 318.8 vfzg_ub_q1p25 0.00 318.8 FUNCTION_LIST DSLSLRS IF_DATA DIM_X DIRECT 0x8180FE /end CHARACTERISTIC
/begin CHARACTERISTIC DSTEMIN "Minimalwert für Weitertransport in Totzeitglied Gemischtransport" VALUE 0x817646 KwUw 0.9999695 fak_uw_b2 0.00 0.9999695 FUNCTION_LIST TEB IF_DATA DIM_X DIRECT 0x817646 /end CHARACTERISTIC
/begin CHARACTERISTIC DSUGRAD "Gradient für Drucksensor Umgebung" VALUE 0x81BDE4 KwUw 1023.984 dgrad_uw_q0p015 0.00 1023.984 FUNCTION_LIST GGDSAS IF_DATA DIM_X DIRECT 0x81BDE4 /end CHARACTERISTIC
/begin CHARACTERISTIC DSUOFS "Offset Drucksensor Umgebung" VALUE 0x81BDE6 KwSw 2559.961 p_sw_q0p039 -1280.000 1279.961 FUNCTION_LIST GGDSAS IF_DATA DIM_X DIRECT 0x81BDE6 /end CHARACTERISTIC
/begin CHARACTERISTIC DTABUNPL "Schwelle Abstellzeit unplausibel" VALUE 0x81C736 KwUw 65535.00 t1sxs_uw_q1 0.00 65535.00 FUNCTION_LIST BGTABS IF_DATA DIM_X DIRECT 0x81C736 /end CHARACTERISTIC
/begin CHARACTERISTIC DTALF "Hysterese Ansauglufttemperaturschwelle Lüftersteuerung" VALUE 0x8197F0 KwUb 191.3 temp_ub_b191p25 0.00 191.3 FUNCTION_LIST MLS IF_DATA DIM_X DIRECT 0x8197F0 /end CHARACTERISTIC
/begin CHARACTERISTIC DTBTS "Temperaturhysterese für Bauteileschutz" VALUE 0x81C91E KwUw 1279.980 temp_uw_q0p0195 0.00 1279.980 FUNCTION_LIST LAMBTS IF_DATA DIM_X DIRECT 0x81C91E /end CHARACTERISTIC
/begin CHARACTERISTIC DTEPRU "delta-te-Schwelle fuer Nachspritzer-/ti-Reduktion erkannt" VALUE 0x813F9E KwUw 174.7600 tinjection_sy 0.00 174.7600 FUNCTION_LIST BGRLP IF_DATA DIM_X DIRECT 0x813F9E /end CHARACTERISTIC
/begin CHARACTERISTIC DTIABS "Dti-Schwellwert für ersten Nachspritzer" VALUE 0x813DE2 KwUw 174.7600 tinjection_sy 0.00 174.7600 FUNCTION_LIST ACIFI IF_DATA DIM_X DIRECT 0x813DE2 /end CHARACTERISTIC
/begin CHARACTERISTIC DTIREL "Dti-Schwellwert für zweiten Nachspritzer" VALUE 0x810E4F KwUb 99.61 rel_ub_b99p6 0.00 99.61 FUNCTION_LIST ACIFI IF_DATA DIM_X DIRECT 0x810E4F /end CHARACTERISTIC
/begin CHARACTERISTIC DTKATMN "Hysterese Katalysatortemperaturregelschwelle für Kat warmhalten" VALUE 0x819107 KwUb 1275. temp_ub_q5_o50 -50.00 1225. FUNCTION_LIST BBKHZ IF_DATA DIM_X DIRECT 0x819107 /end CHARACTERISTIC
/begin CHARACTERISTIC DTKH "Betrag Differenztemperatur (tans-tmst) für Katheizen" VALUE 0x819108 KwUb 191.3 temp_ub_b191p25 0.00 191.3 FUNCTION_LIST BBKHZ IF_DATA DIM_X DIRECT 0x819108 /end CHARACTERISTIC
/begin CHARACTERISTIC DTLRTML "Bewertungsfaktor Zeitdekrementierung für Erreichen tmot-Einschaltschwelle LR" CURVE 0x819010 KlAUbSstUbWUb 99.61 rel_ub_b99p6 0.00 99.61 FUNCTION_LIST GGTFM IF_DATA DIM_X DIRECT 0x819010 /begin AXIS_DESCR STD_AXIS mll1 m_ub_b1020 7 0.00 1020. DEPOSIT ABSOLUT /end AXIS_DESCR /end CHARACTERISTIC
/begin CHARACTERISTIC DTMABDTMN "Min. Differenz Motortemperatur zwischen Abstellen und Neustart für Diagnose TMOT" VALUE 0x81901F KwUb 191.3 temp_ub_b191p25 0.00 191.3 FUNCTION_LIST GGTFM IF_DATA DIM_X DIRECT 0x81901F /end CHARACTERISTIC
/begin CHARACTERISTIC DTMDMA "Abstand Motortemperaturmodell zur Starttemperatur" VALUE 0x819020 KwUb 191.3 temp_ub_b191p25 0.00 191.3 FUNCTION_LIST GGTFM IF_DATA DIM_X DIRECT 0x819020 /end CHARACTERISTIC
/begin CHARACTERISTIC DTMDNPO "Abstand Motortemperaturmodell zur oberen Unplausibilitätsschwelle" VALUE 0x819021 KwUb 191.3 temp_ub_b191p25 0.00 191.3 FUNCTION_LIST GGTFM IF_DATA DIM_X DIRECT 0x819021 /end CHARACTERISTIC
/begin CHARACTERISTIC DTMDSLA "Temperaturdifferenz zwischen Abstellen und Neustart für Zusatzdiagnose" VALUE 0x8180FF KwUb 191.3 temp_ub_b191p25 0.00 191.3 FUNCTION_LIST DSLSLRS IF_DATA DIM_X DIRECT 0x8180FF /end CHARACTERISTIC
/begin CHARACTERISTIC DTMKOM "Hysteresis Motortemperaturschwelle Ansteuerung Kombi-Warnleuchte" VALUE 0x8197F1 KwUb 191.3 temp_ub_b191p25 0.00 191.3 FUNCTION_LIST MLS IF_DATA DIM_X DIRECT 0x8197F1 /end CHARACTERISTIC
/begin CHARACTERISTIC DTMLF "Hysterese Motortemperaturschwelle Lüftersteuerung" VALUE 0x8197F2 KwUb 191.3 temp_ub_b191p25 0.00 191.3 FUNCTION_LIST MLS IF_DATA DIM_X DIRECT 0x8197F2 /end CHARACTERISTIC
/begin CHARACTERISTIC DTMMSG "Hysterese Motortemperaturschwelle für Motorraumspülgebläse" VALUE 0x8197F3 KwUb 191.3 temp_ub_b191p25 0.00 191.3 FUNCTION_LIST MLS IF_DATA DIM_X DIRECT 0x8197F3 /end CHARACTERISTIC
/begin CHARACTERISTIC DTMR "Hysterese für Einschaltschwelle" VALUE 0x812111 KwUb 191.3 temp_ub_b191p25 0.00 191.3 FUNCTION_LIST LRSEB IF_DATA DIM_X DIRECT 0x812111 /end CHARACTERISTIC
/begin CHARACTERISTIC DTMRMSG "Hysterese Motorraumtemperaturschwelle für Motorraumspülgebläse" VALUE 0x8197F4 KwUb 191.3 temp_ub_b191p25 0.00 191.3 FUNCTION_LIST MLS IF_DATA DIM_X DIRECT 0x8197F4 /end CHARACTERISTIC
/begin CHARACTERISTIC DTMSRT "Delta Motortemp.zu Starttemp. f.Retrigg. Modelle (Blockheater-Erkennung)" VALUE 0x819022 KwUb 191.3 temp_ub_b191p25 0.00 191.3 FUNCTION_LIST GGTFM IF_DATA DIM_X DIRECT 0x819022 /end CHARACTERISTIC
/begin CHARACTERISTIC DTMTMRW "Temperaturdiff.-Schwelle für die Prüfung, ob Zwangseinschaltung LR nötig (CARB)" VALUE 0x8198EB KwSb 191.3 temp_sb_q0p75 -96.00 95.25 FUNCTION_LIST LRSEB IF_DATA DIM_X DIRECT 0x8198EB /end CHARACTERISTIC
/begin CHARACTERISTIC DTMWUC "Delta Motortemperaturschwelle für Erfüllung 'warm up cycle'" VALUE 0x810BF5 KwUb 191.3 temp_ub_b191p25 0.00 191.3 FUNCTION_LIST DWUC IF_DATA DIM_X DIRECT 0x810BF5 /end CHARACTERISTIC
/begin CHARACTERISTIC DTOLTMS "Offset zur Motortemperatur für Bildung minimale Öltemperatur" CURVE 0x81908A KlAUbSstUbWUb 191.3 temp_ub_b191p25 0.00 191.3 FUNCTION_LIST GGTFOL IF_DATA DIM_X DIRECT 0x81908A
 /begin AXIS_DESCR STD_AXIS tmst temp_ub_q0p75_o48 6 -48.00 143.3 DEPOSIT ABSOLUT /end AXIS_DESCR
/end CHARACTERISTIC
/begin CHARACTERISTIC DTUMTA "Offset Ansauglufttemperatur -> Umgebungstemperatur" VALUE 0x818803 KwSb 191.3 temp_sb_q0p75 -96.00 95.25 FUNCTION_LIST BGTABS GGTFUMG IF_DATA DIM_X DIRECT 0x818803 /end CHARACTERISTIC
/begin CHARACTERISTIC DTUMTAT "Offset Ansauglufttemperatur -> Umgebungstemperatur" VALUE 0x8181DE KwUb 191.3 temp_ub_b191p25 0.00 191.3 FUNCTION_LIST ATM IF_DATA DIM_X DIRECT 0x8181DE /end CHARACTERISTIC
/begin CHARACTERISTIC DUBLBZ "Spannungsoffset für Ladebilanzberechnung" VALUE 0x81847F KwUb 19.38 spg_ubatt 0.00 19.38 FUNCTION_LIST BGLBZ IF_DATA DIM_X DIRECT 0x81847F /end CHARACTERISTIC
/begin CHARACTERISTIC DUDKNLPO "Toleranzband für NLP nach oben (inkl. Rü)" VALUE 0x813D84 KwUw 4.998779 spg_q1p221_mV 0.00 4.998779 FUNCTION_LIST BGDVE IF_DATA DIM_X DIRECT 0x813D84 /end CHARACTERISTIC
/begin CHARACTERISTIC DUDKNLPU "Toleranzband für NLP nach unten" VALUE 0x813D86 KwUw 4.998779 spg_q1p221_mV 0.00 4.998779 FUNCTION_LIST BGDVE IF_DATA DIM_X DIRECT 0x813D86 /end CHARACTERISTIC
/begin CHARACTERISTIC DUDKP1HY "Offset für Hysterese bei Umschaltung auf verstärktes Signal von DK-Poti 1" VALUE 0x813DD0 KwUw 80.08377 spg_uw_q0p001222 0.00 80.08377 FUNCTION_LIST GGDVE BGDVE IF_DATA DIM_X DIRECT 0x813DD0 /end CHARACTERISTIC
/begin CHARACTERISTIC DUDKPTMP "Delta eines Rampenschrittes bei der temp. UMA-Adaption" VALUE 0x810D30 KwUb 0.3064 spg_q1p221_mV 0.004883 0.3113 FUNCTION_LIST BGDVE IF_DATA DIM_X DIRECT 0x810D30 /end CHARACTERISTIC
/begin CHARACTERISTIC DUF_T "Zeit fürs Setzen der Zyklusflags der Funktionsüberwachungs-Diagnose" VALUE 0x811FE7 KwUb 25.50 t100msxs_ub_b25p5 0.00 25.50 FUNCTION_LIST DUF IF_DATA DIM_X DIRECT 0x811FE7 /end CHARACTERISTIC
/begin CHARACTERISTIC DUKK "Schwelle für Kurzzeitanteil" VALUE 0x8156D0 KwSw 12287.81 rel_sw_q0p1875 -6144.000 6143.813 FUNCTION_LIST ESUK IF_DATA DIM_X DIRECT 0x8156D0 /end CHARACTERISTIC
/begin CHARACTERISTIC DUPW12 "Zulässige Spannungsabweichung zwischen PWG-Poti 1 und 2" VALUE 0x810E2E KwUb 4.980 spg_ub_b5 0.00 4.980 FUNCTION_LIST GGPED IF_DATA DIM_X DIRECT 0x810E2E /end CHARACTERISTIC
/begin CHARACTERISTIC DUPW12BE "notweniger Spannungsweg von Poti 2 zur Bewegungserkennung" VALUE 0x813DD4 KwUw 4.995117 spg_uw_q0p00488 0.00 4.995117 FUNCTION_LIST GGPED IF_DATA DIM_X DIRECT 0x813DD4 /end CHARACTERISTIC
/begin CHARACTERISTIC DUPW12TG "Zulässige Spannungsabweichung zwischen PWG Poti 1 und  2 im Teilgasbereich" VALUE 0x810E2F KwUb 4.980 spg_ub_b5 0.00 4.980 FUNCTION_LIST GGPED IF_DATA DIM_X DIRECT 0x810E2F /end CHARACTERISTIC
/begin CHARACTERISTIC DUPW12VG "Zulässige Spannungsabweichung zwischen PWG-Poti 1 und 2 im Vollgasbereich" VALUE 0x810E30 KwUb 4.980 spg_ub_b5 0.00 4.980 FUNCTION_LIST GGPED IF_DATA DIM_X DIRECT 0x810E30 /end CHARACTERISTIC
/begin CHARACTERISTIC DUPWGHY "Spannungshysterese bei Entjitterung der PWG-Spannung" VALUE 0x813DD6 KwUw 4.995117 spg_uw_q0p00488 0.00 4.995117 FUNCTION_LIST GGPED IF_DATA DIM_X DIRECT 0x813DD6 /end CHARACTERISTIC
/begin CHARACTERISTIC DUSRIH "Delta Sondenspannung hinter Kat zwischen Neu-und Altwert  für Ri-Messung" VALUE 0x813C18 KwSw 319.9951 spg_sw_q0p00488 -160.0000 159.9951 FUNCTION_LIST GGLSH IF_DATA DIM_X DIRECT 0x813C18 /end CHARACTERISTIC
/begin CHARACTERISTIC DUSSPH "Delta Sondensp. hinter Kat zwischen Neu-und 2 Altwerten für Sonden Sprungmessung" VALUE 0x813C1A KwSw 319.9951 spg_sw_q0p00488 -160.0000 159.9951 FUNCTION_LIST GGLSH IF_DATA DIM_X DIRECT 0x813C1A /end CHARACTERISTIC
/begin CHARACTERISTIC DVAQUGMX "Max. zul. Geschw.differenz bei Aquaplaningerkennung für große Geschw." VALUE 0x813ED2 KwUw 511.9922 vfzg_uw_b512 0.00 511.9922 FUNCTION_LIST BBFGR IF_DATA DIM_X DIRECT 0x813ED2 /end CHARACTERISTIC
/begin CHARACTERISTIC DVAQUKMX "Max. zul. Geschw.differenz bei Aquaplaningerkennung für kleine Geschw." VALUE 0x813ED4 KwUw 511.9922 vfzg_uw_b512 0.00 511.9922 FUNCTION_LIST BBFGR IF_DATA DIM_X DIRECT 0x813ED4 /end CHARACTERISTIC
/begin CHARACTERISTIC DVEEST "Zeit für Heilungsversuch der DV-E-Endstufe" VALUE 0x810D2B KwUb 2.550 t10msxs_ub_b2p55 0.00 2.550 FUNCTION_LIST ADVE IF_DATA DIM_X DIRECT 0x810D2B /end CHARACTERISTIC
/begin CHARACTERISTIC DVFGREO "Delta-Geschw. für obere FGR-Einschaltgeschwindigkeit" VALUE 0x813ED6 KwUw 511.9922 vfzg_uw_b512 0.00 511.9922 FUNCTION_LIST BBFGR IF_DATA DIM_X DIRECT 0x813ED6 /end CHARACTERISTIC
/begin CHARACTERISTIC DVFGREU "Delta-Geschw. für untere FGR-Einschaltgeschwindigkeit" VALUE 0x813ED8 KwUw 511.9922 vfzg_uw_b512 0.00 511.9922 FUNCTION_LIST BBFGR IF_DATA DIM_X DIRECT 0x813ED8 /end CHARACTERISTIC
/begin CHARACTERISTIC DVFZAR "Hysterese fuer Geschwindigkeitsschwelle bei AR" VALUE 0x811694 KwUb 318.8 vfzg_ub_q1p25 0.00 318.8 FUNCTION_LIST ARMD IF_DATA DIM_X DIRECT 0x811694 /end CHARACTERISTIC
/begin CHARACTERISTIC DVFZBEG "Delta-Geschwindigkeit für Änderungsbegrenzung" VALUE 0x813D16 KwUw 511.9922 vfzg_uw_b512 0.00 511.9922 FUNCTION_LIST GGVFZG IF_DATA DIM_X DIRECT 0x813D16 /end CHARACTERISTIC
/begin CHARACTERISTIC DVIVZMX "Max. zul. Abweichung zw. Istgeschw. und Zielgeschw. bei FGR-Konstantfahrt" VALUE 0x813EDA KwUw 511.9922 vfzg_uw_b512 0.00 511.9922 FUNCTION_LIST BBFGR IF_DATA DIM_X DIRECT 0x813EDA /end CHARACTERISTIC
/begin CHARACTERISTIC DVIVZTMX "Maximales Delta zw. Ist- und Zielgeschw. für Tip-Erlaubnis" VALUE 0x8147C4 KwUw 511.9922 vfzg_uw_b512 0.00 511.9922 FUNCTION_LIST FGRMD IF_DATA DIM_X DIRECT 0x8147C4 /end CHARACTERISTIC
/begin CHARACTERISTIC DVLF3 "Hysteresis Fahrzeuggeschwindigkeit für Lüfterstufe 3" VALUE 0x8197F5 KwUb 318.8 vfzg_ub_q1p25 0.00 318.8 FUNCTION_LIST MLS IF_DATA DIM_X DIRECT 0x8197F5 /end CHARACTERISTIC
/begin CHARACTERISTIC DVNG "LLR: D-Verstärkung abh. von ngfil bei stehendem Fahrzeug" CURVE 0x8115F8 GklWUb 0.1245 rel_qn0p000488 -0.1245 0.00 FUNCTION_LIST LLRRM IF_DATA DIM_X DIRECT 0x8115F8
 /begin AXIS_DESCR COM_AXIS ngfil nmotg_sb_q100 6 -12800. 12700. AXIS_PTS_REF SNG06LLSB /end AXIS_DESCR
/end CHARACTERISTIC
/begin CHARACTERISTIC DVNGV "LLR: D-Verstärkung abh. von ngfil bei roolendem Fahrzeug" CURVE 0x8115FE GklWUb 0.1245 rel_qn0p000488 -0.1245 0.00 FUNCTION_LIST LLRRM IF_DATA DIM_X DIRECT 0x8115FE
 /begin AXIS_DESCR COM_AXIS ngfil nmotg_sb_q100 6 -12800. 12700. AXIS_PTS_REF SNG06LLSB /end AXIS_DESCR
/end CHARACTERISTIC
/begin CHARACTERISTIC DVSA "delta Geschwindigkeitsschwelle für SA-Drehzahlanhebung" VALUE 0x8114C6 KwUb 318.8 vfzg_ub_q1p25 0.00 318.8 FUNCTION_LIST BBSAWE IF_DATA DIM_X DIRECT 0x8114C6 /end CHARACTERISTIC
/begin CHARACTERISTIC DVSAVO "Delta Geschwindigkeit für Rücksetzen Schubabschalteverbot vom FGR" VALUE 0x8147C6 KwUw 511.9922 vfzg_uw_b512 0.00 511.9922 FUNCTION_LIST FGRMD IF_DATA DIM_X DIRECT 0x8147C6 /end CHARACTERISTIC
/begin CHARACTERISTIC DVSAVU "Delta Geschwindigkeit für Setzen Schubabschalteverbot vom FGR" VALUE 0x8147C8 KwUw 511.9922 vfzg_uw_b512 0.00 511.9922 FUNCTION_LIST FGRMD IF_DATA DIM_X DIRECT 0x8147C8 /end CHARACTERISTIC
/begin CHARACTERISTIC DVSKNBGA "Delta Geschwindigkeit für Setzwertkorrektur nach Beschleunigen" CURVE 0x81BA02 KlAUwSstUwWUw 511.9922 vfzg_uw_b512 0.00 511.9922 FUNCTION_LIST FGRMD IF_DATA DIM_X DIRECT 0x81BA02 /begin AXIS_DESCR STD_AXIS gangi dez 8 0.00 65535.00 DEPOSIT ABSOLUT /end AXIS_DESCR /end CHARACTERISTIC
/begin CHARACTERISTIC DVSKNVGA "Delta Geschwindigkeit für Setzwertkorrektur nach Verzögern" CURVE 0x81BA24 KlAUwSstUwWUw 511.9922 vfzg_uw_b512 0.00 511.9922 FUNCTION_LIST FGRMD IF_DATA DIM_X DIRECT 0x81BA24 /begin AXIS_DESCR STD_AXIS gangi dez 8 0.00 65535.00 DEPOSIT ABSOLUT /end AXIS_DESCR /end CHARACTERISTIC
/begin CHARACTERISTIC DVTIPUD "Änderung der Zielgeschwindigkeit bei Tip-Up oder Tip-Down" VALUE 0x8147CA KwUw 511.9922 vfzg_uw_b512 0.00 511.9922 FUNCTION_LIST FGRMD IF_DATA DIM_X DIRECT 0x8147CA /end CHARACTERISTIC
/begin CHARACTERISTIC DVZVIMX "Max. zul. Abweichung zw. Zielgeschw. und Istgeschw. bei FGR-Konstantfahrt" VALUE 0x813EDC KwUw 511.9922 vfzg_uw_b512 0.00 511.9922 FUNCTION_LIST BBFGR IF_DATA DIM_X DIRECT 0x813EDC /end CHARACTERISTIC
/begin CHARACTERISTIC DVZVITMX "Maximales Delta zw. Ziel- und Istgeschw. für Tip-Erlaubnis" VALUE 0x8147CC KwUw 511.9922 vfzg_uw_b512 0.00 511.9922 FUNCTION_LIST FGRMD IF_DATA DIM_X DIRECT 0x8147CC /end CHARACTERISTIC
/begin CHARACTERISTIC DVZVIWA "Delta zw. Ziel- und Istgeschw. für Übergang von Konstantfahrt in Wiederaufnahme" VALUE 0x8147CE KwUw 511.9922 vfzg_uw_b512 0.00 511.9922 FUNCTION_LIST FGRMD IF_DATA DIM_X DIRECT 0x8147CE /end CHARACTERISTIC
/begin CHARACTERISTIC DVZVRWA1 "Delta zw. Ziel- und Sollgeschw. für Übergang in WA-Lande-Mode Bereich 1" VALUE 0x8147D0 KwUw 511.9922 vfzg_uw_b512 0.00 511.9922 FUNCTION_LIST FGRMD IF_DATA DIM_X DIRECT 0x8147D0 /end CHARACTERISTIC
/begin CHARACTERISTIC DVZVRWA2 "Delta zw. Ziel- und Sollgeschw. für Übergang in WA-Lande-Mode Bereich 2" VALUE 0x8147D2 KwUw 511.9922 vfzg_uw_b512 0.00 511.9922 FUNCTION_LIST FGRMD IF_DATA DIM_X DIRECT 0x8147D2 /end CHARACTERISTIC
/begin CHARACTERISTIC DVZVRWA3 "Delta zw. Ziel- und Sollgeschw. für Übergang in WA-Lande-Mode Bereich 3" VALUE 0x8147D4 KwUw 511.9922 vfzg_uw_b512 0.00 511.9922 FUNCTION_LIST FGRMD IF_DATA DIM_X DIRECT 0x8147D4 /end CHARACTERISTIC
/begin CHARACTERISTIC DWDK12O "Maximal zulässige Abweichung zwischen den DK-Winkeln aus Poti 1 und 2" VALUE 0x810D48 KwUb 100.0 relDK_ub_b100 0.00 100.0 FUNCTION_LIST GGDVE IF_DATA DIM_X DIRECT 0x810D48 /end CHARACTERISTIC
/begin CHARACTERISTIC DWDK13O "Maximal zulässige Abweichung zwischen DK-Winkel aus Poti 1 und Ersatzwert" VALUE 0x810D49 KwUb 100.0 relDK_ub_b100 0.00 100.0 FUNCTION_LIST GGDVE IF_DATA DIM_X DIRECT 0x810D49 /end CHARACTERISTIC
/begin CHARACTERISTIC DWDK23O "Maximal zulässige Abweichung zwischen DK-Winkel aus Poti 2 und Ersatzwert" VALUE 0x810D4A KwUb 100.0 relDK_ub_b100 0.00 100.0 FUNCTION_LIST GGDVE IF_DATA DIM_X DIRECT 0x810D4A /end CHARACTERISTIC
/begin CHARACTERISTIC DWDKSBAMX "max. Soll-/Ist-DK-Winkel-Abweichung als f(dwdks)" CURVE 0x813D3E KlAUwSstUwWUw 100.0000 relDK_uw_b100 0.00 100.0000 FUNCTION_LIST ADVE IF_DATA DIM_X DIRECT 0x813D3E
 /begin AXIS_DESCR STD_AXIS gwdk_kge relDK_q0p00152 5 0.00 99.99847 DEPOSIT ABSOLUT /end AXIS_DESCR
/end CHARACTERISTIC
/begin CHARACTERISTIC DWDKSIKLS "Schwelle zur Aktivierung des I-Kleinanteils" VALUE 0x813D54 KwSw 1599.976 relDK_q0p02441 -800.0000 799.9756 FUNCTION_LIST ADVE IF_DATA DIM_X DIRECT 0x813D54 /end CHARACTERISTIC
/begin CHARACTERISTIC DWEEMX "maximal zulässige Zunahme Winkel Einspritzende pro Syncro" VALUE 0x811350 KwUb 1530. zw_ub_q6 0.00 1530. FUNCTION_LIST ESVW IF_DATA DIM_X DIRECT 0x811350 /end CHARACTERISTIC
/begin CHARACTERISTIC DWKRMSN "delta Winkel KR Abstand zur gemittelten Spätverstellung" CURVE 0x81928C GklWUb 191.3 zw_ub_qn0p75 -191.3 0.00 FUNCTION_LIST KRRA IF_DATA DIM_X DIRECT 0x81928C
 /begin AXIS_DESCR COM_AXIS nmot nmot_ub_q40 16 0.00 10200. AXIS_PTS_REF SNM16KRUB /end AXIS_DESCR
/end CHARACTERISTIC
/begin CHARACTERISTIC DWNWEMXT "theoretisch maximales delta zwischen Spät- und Frühstellung des Einlaßventil" VALUE 0x8186EC KwUb 127.5 kw_ub_q0p5 0.00 127.5 FUNCTION_LIST NWS IF_DATA DIM_X DIRECT 0x8186EC /end CHARACTERISTIC
/begin CHARACTERISTIC DWPLWUGD "Schwelle Pedalwert-Gradient für Deaktivierung Pedalüberweg über B_lwugd" VALUE 0x816310 KwSw 99.99847 rel_sw_b50 -50.00000 49.99847 FUNCTION_LIST MDFAW IF_DATA DIM_X DIRECT 0x816310 /end CHARACTERISTIC
/begin CHARACTERISTIC DWPMDBGV "Delta Pedalwinkel zum Auslösen der geschw.-abh. Momentenaufbaubegrenzung" VALUE 0x8162FA KwSw 199.9969 rel_sw_b100 -100.0000 99.99695 FUNCTION_LIST MDBGV IF_DATA DIM_X DIRECT 0x8162FA /end CHARACTERISTIC
/begin CHARACTERISTIC DWPMXNB "Maximal zulässige Pedalwerterhöhung pro Rechenschritt nach Bremsbetätigung" VALUE 0x813DD8 KwUw 100.0000 relPED_uw_b100 0.00 100.0000 FUNCTION_LIST GGPED IF_DATA DIM_X DIRECT 0x813DD8 /end CHARACTERISTIC
/begin CHARACTERISTIC DWPMXNOT "Maximal zulässige Pedalwerterhöhung pro Rechenschritt im PWG-Ersatzbetrieb" VALUE 0x813DDA KwUw 100.0000 relPED_uw_b100 0.00 100.0000 FUNCTION_LIST GGPED IF_DATA DIM_X DIRECT 0x813DDA /end CHARACTERISTIC
/begin CHARACTERISTIC DWPR "Delta Prädiktionswinkel ohne Nachspritzer/ti-Reduktion" VALUE 0x8110EC KwSb 1530. kw_q6 -768.0 762.0 FUNCTION_LIST BGRLP IF_DATA DIM_X DIRECT 0x8110EC /end CHARACTERISTIC
/begin CHARACTERISTIC DWPRNSP "Delta Prädiktionswinkel bei Nachspritzerfreigabe" VALUE 0x8110ED KwSb 1530. kw_q6 -768.0 762.0 FUNCTION_LIST BGRLP IF_DATA DIM_X DIRECT 0x8110ED /end CHARACTERISTIC
/begin CHARACTERISTIC DWVLSN "Delta - Zündwinkel Vollast spät Motorschutz" CURVE 0x81E35E KlAUbSstUbWSb 191.3 zw_sb_q0p75 -96.00 95.25 FUNCTION_LIST ZWBTSK IF_DATA DIM_X DIRECT 0x81E35E /begin AXIS_DESCR STD_AXIS nmot nmot_ub_q40 7 0.00 10200. DEPOSIT ABSOLUT /end AXIS_DESCR /end CHARACTERISTIC
/begin CHARACTERISTIC DYADMX "Max. Wert des add. Dynamikvorhalts" VALUE 0x81148C KwUb 24.00 zw_ub_qn0p75 -24.00 0.00 FUNCTION_LIST KRDY IF_DATA DIM_X DIRECT 0x81148C /end CHARACTERISTIC
/begin CHARACTERISTIC DYADS "Add. Spätverstellung pro Zyk. durch lern. Dyn." VALUE 0x81148D KwUb 24.00 zw_ub_qn0p75 -24.00 0.00 FUNCTION_LIST KRDY IF_DATA DIM_X DIRECT 0x81148D /end CHARACTERISTIC
/begin CHARACTERISTIC DYAMNV "Min. Wert des add. Dynamikvorhalts" VALUE 0x81148E KwUb 24.00 zw_ub_qn0p75 -24.00 0.00 FUNCTION_LIST KRDY IF_DATA DIM_X DIRECT 0x81148E /end CHARACTERISTIC
/begin CHARACTERISTIC DYAVF "Abregelkonstante für Dynamikvorhalt" VALUE 0x81148F KwUb 254.0 dez 1.000 255.0 FUNCTION_LIST KRDY IF_DATA DIM_X DIRECT 0x81148F /end CHARACTERISTIC
/begin CHARACTERISTIC DYNLSUFA "Grenzwert für LSU-Dynamik bei Kurztest" VALUE 0x81B8EE KwUw 15.99976 fak_uw_b16 0.00 15.99976 FUNCTION_LIST DLSU IF_DATA DIM_X DIRECT 0x81B8EE /end CHARACTERISTIC
/begin CHARACTERISTIC DYNLSUMX "Grenzwert für LSU-Dynamik" VALUE 0x81B8F0 KwUw 15.99976 fak_uw_b16 0.00 15.99976 FUNCTION_LIST DLSU IF_DATA DIM_X DIRECT 0x81B8F0 /end CHARACTERISTIC
/begin CHARACTERISTIC DYNLSURD "reduzierter Grenzwert für LSU-Dynamik" VALUE 0x81B8F2 KwUw 15.99976 fak_uw_b16 0.00 15.99976 FUNCTION_LIST DLSU IF_DATA DIM_X DIRECT 0x81B8F2 /end CHARACTERISTIC
/begin CHARACTERISTIC DYNLSUTO "obere Grenze für dynlsusa, CARB-Tester, DLSSALRS" VALUE 0x8184BB KwUb 4.980 fak_q0p0195 0.00 4.980 FUNCTION_LIST DLSSA TC5MOD IF_DATA DIM_X DIRECT 0x8184BB /end CHARACTERISTIC
/begin CHARACTERISTIC DYNLSUTU "untere Grenze für dynlsusa, CARB-Tester, DLSSALRS" VALUE 0x8184BC KwUb 4.980 fak_q0p0195 0.00 4.980 FUNCTION_LIST DLSSA TC5MOD IF_DATA DIM_X DIRECT 0x8184BC /end CHARACTERISTIC
/begin CHARACTERISTIC DYNMXNL "Schwellwert für Dynamikbewertung -> hohe Dynamik" VALUE 0x813B7E KwUw 40000.00 t5usxus_q5 0.00 40000.00 FUNCTION_LIST NLDG IF_DATA DIM_X DIRECT 0x813B7E /end CHARACTERISTIC
/begin CHARACTERISTIC DZKBI1MN "kleinstes zulässiges Delta des Kombi-Botschaftszählers" VALUE 0x810234 KwUb 255.0 dez 0.00 255.0 FUNCTION_LIST DCKBI IF_DATA DIM_X DIRECT 0x810234 /end CHARACTERISTIC
/begin CHARACTERISTIC DZKBI1MX "größtes zulässiges Delta des Kombi-Botschaftzählers" VALUE 0x810235 KwUb 255.0 dez 0.00 255.0 FUNCTION_LIST DCKBI IF_DATA DIM_X DIRECT 0x810235 /end CHARACTERISTIC
/begin CHARACTERISTIC DZWAML "Auf/Abregelgeschwindigkeit zwischen den Begrenzungskennfeldern" CURVE 0x81E372 KlAUbSstUbWSb 191.3 zw_sb_q0p75 -96.00 95.25 FUNCTION_LIST ZWMIN IF_DATA DIM_X DIRECT 0x81E372 /begin AXIS_DESCR STD_AXIS ml m_ub_b1020 12 0.00 1020. DEPOSIT ABSOLUT /end AXIS_DESCR /end CHARACTERISTIC
/begin CHARACTERISTIC DZWETA "Deltazündwinkel aus Wirkungsgrad" CURVE 0x812308 FklWSb 191.3 zw_sb_q0p75 -96.00 95.25 FUNCTION_LIST MDZW IF_DATA DIM_X DIRECT 0x812308
 /begin AXIS_DESCR FIX_AXIS etazws rel_ub_b127p5 201 0.00 100.0 FIX_AXIS_PAR 0 0 201 /end AXIS_DESCR
/end CHARACTERISTIC
/begin CHARACTERISTIC DZWOAGR "AGR-ratenabhängiger  Offset des optimalen ZW" CURVE 0x81609E KlAUbSstUbWSb 191.3 zw_sb_q0p75 -96.00 95.25 FUNCTION_LIST MDBAS IF_DATA DIM_X DIRECT 0x81609E /begin AXIS_DESCR STD_AXIS agrr rel_ub_b99p6 10 0.00 99.61 DEPOSIT ABSOLUT /end AXIS_DESCR /end CHARACTERISTIC
/begin CHARACTERISTIC DZWOLA "Lambda-Abhängigkeit des optimalen Zündwinkels bezogen auf Lambda 1" CURVE 0x8160B4 KlAUbSstUbWSb 191.3 zw_sb_q0p75 -96.00 95.25 FUNCTION_LIST MDBAS IF_DATA DIM_X DIRECT 0x8160B4 /begin AXIS_DESCR STD_AXIS lambas fak_ub_b2 10 0.00 1.992 DEPOSIT ABSOLUT /end AXIS_DESCR /end CHARACTERISTIC
/begin CHARACTERISTIC DZWOM "temperaturabhängiger Offset des optimalen ZW" CURVE 0x8160CA KlAUbSstUbWSb 191.3 zw_sb_q0p75 -96.00 95.25 FUNCTION_LIST MDBAS IF_DATA DIM_X DIRECT 0x8160CA
 /begin AXIS_DESCR STD_AXIS tmot temp_ub_q0p75_o48 5 -48.00 143.3 DEPOSIT ABSOLUT /end AXIS_DESCR
/end CHARACTERISTIC
/begin CHARACTERISTIC DZWSPM "Delta spätester Zündwinkel abhängig von Motortemperatur" CURVE 0x819D90 GklWSb 191.3 zw_sb_q0p75 -96.00 95.25 FUNCTION_LIST ZWMIN IF_DATA DIM_X DIRECT 0x819D90
 /begin AXIS_DESCR COM_AXIS tmot temp_ub_q0p75_o48 6 -48.00 143.3 AXIS_PTS_REF STM06__UB /end AXIS_DESCR
/end CHARACTERISTIC
/begin CHARACTERISTIC DZWSTTA "Delta Zündwinkel im Start" CURVE 0x81E38C KlAUbSstUbWSb 191.3 zw_sb_q0p75 -96.00 95.25 FUNCTION_LIST ZWSTT IF_DATA DIM_X DIRECT 0x81E38C
 /begin AXIS_DESCR STD_AXIS tans temp_ub_q0p75_o48 6 -48.00 143.3 DEPOSIT ABSOLUT /end AXIS_DESCR
/end CHARACTERISTIC
/begin CHARACTERISTIC DZZST "Anzahl Zähne bei Zahnunterdrückung im Start" VALUE 0x810C00 KwUb 254.0 dez 0.00 254.0 FUNCTION_LIST GGDPG IF_DATA DIM_X DIRECT 0x810C00 /end CHARACTERISTIC
/begin CHARACTERISTIC DZZST2 "Anzahl der Entprellzähne für zweiten Phasengeber im Start" VALUE 0x810C01 KwUb 254.0 dez 0.00 254.0 FUNCTION_LIST GGDPG IF_DATA DIM_X DIRECT 0x810C01 /end CHARACTERISTIC
/begin CHARACTERISTIC DZZSTNLP "Anzahl der Entprellzähne bei Notlauf-Phasengeber" VALUE 0x810C02 KwUb 254.0 dez 0.00 254.0 FUNCTION_LIST GGDPG IF_DATA DIM_X DIRECT 0x810C02 /end CHARACTERISTIC
/begin CHARACTERISTIC EDLDRP "Schwelle Regelabweichung für Diagnose LDR-Regelabweichung positiv" VALUE 0x819346 KwSb 1270. p_sb_q10 0.00 1270. FUNCTION_LIST DLDR IF_DATA DIM_X DIRECT 0x819346 /end CHARACTERISTIC
/begin CHARACTERISTIC ELDOB "Regelabweichungsschwelle für Start Zeitzähler LDR-Overboost activ" VALUE 0x8193F8 KwSb 1270. p_sb_q10 0.00 1270. FUNCTION_LIST LDOB IF_DATA DIM_X DIRECT 0x8193F8 /end CHARACTERISTIC
/begin CHARACTERISTIC ENASAG "Freigabe SA gangabhaengig" VALUE 0x8114C7 KwUb 255.0 dez 0.00 255.0 FUNCTION_LIST BBSAWE IF_DATA DIM_X DIRECT 0x8114C7 /end CHARACTERISTIC
/begin CHARACTERISTIC ENTDKLL "Entjitterschwelle (Ink) für DK-Sollwert im Leerlauf (B_ll)" VALUE 0x8110AB KwUb 20.00 dez 0.00 20.00 FUNCTION_LIST FUEDKSA IF_DATA DIM_X DIRECT 0x8110AB /end CHARACTERISTIC
/begin CHARACTERISTIC ENTDKNLL "Entjitterschwelle (Ink) für DK-Sollwert außerhalb Leerlauf (!B_ll)" VALUE 0x8110AC KwUb 20.00 dez 0.00 20.00 FUNCTION_LIST FUEDKSA IF_DATA DIM_X DIRECT 0x8110AC /end CHARACTERISTIC
/begin CHARACTERISTIC eskonf "Konfiguration Endstufen" VAL_BLK 0x810F1B KwbUb 255.0 dez 0.00 255.0 NUMBER 12 FUNCTION_LIST DEKON DEKON2 IF_DATA DIM_X DIRECT 0x810F1B /end CHARACTERISTIC
/begin CHARACTERISTIC ETADZW "ZW-Wirkungsgrad in Abhängigkeit von delta ZW" CURVE 0x8116B0 FklWUb 127.5 rel_ub_b127p5 0.00 127.5 FUNCTION_LIST MDBAS LAMBTS MDIST ZWMIN IF_DATA DIM_X DIRECT 0x8116B0
 /begin AXIS_DESCR FIX_AXIS dzw_kge zw_sb_q0p75 128 0.00 95.25 FIX_AXIS_PAR 0 0 128 /end AXIS_DESCR
/end CHARACTERISTIC
/begin CHARACTERISTIC ETALAM "Lambda-Wirkungsgrad" CURVE 0x811730 KlAUbSstUbWUb 127.5 rel_ub_b127p5 0.00 127.5 FUNCTION_LIST MDBAS IF_DATA DIM_X DIRECT 0x811730 /begin AXIS_DESCR STD_AXIS lambas fak_ub_b2 10 0.00 1.992 DEPOSIT ABSOLUT /end AXIS_DESCR /end CHARACTERISTIC
/begin CHARACTERISTIC ETAZWTEN "minimale Zündwinkelwirkungsgrad Schwelle für DTEV" VALUE 0x819B3B KwUb 60.00 rel_ub_b127p5 0.00 60.00 FUNCTION_LIST DTEV IF_DATA DIM_X DIRECT 0x819B3B /end CHARACTERISTIC
/begin CHARACTERISTIC EVTMODMNDK "min. Temperatur bei der Offset nicht zu DK-Kennlinie bei nmot=0 addiert wird" VALUE 0x81C5BC KwSw 49151.25 temp_sw_q0p75 -24576.00 24575.25 FUNCTION_LIST FUEDK IF_DATA DIM_X DIRECT 0x81C5BC /end CHARACTERISTIC
/begin CHARACTERISTIC EVZ_DAT_UC "" VAL_BLK 0x811CBC KwbUb 255.0 dez 0.00 255.0 NUMBER 16 FUNCTION_LIST URCEIN IF_DATA DIM_X DIRECT 0x811CBC /end CHARACTERISTIC
/begin CHARACTERISTIC FABMDWA "Faktor zur Absteuerung des Wandlermoments abhängig von nturb/nsol" CURVE 0x8197A6 KlAUbSstUbWUb 0.9961 fak_ub_b1 0.00 0.9961 FUNCTION_LIST MDWAN IF_DATA DIM_X DIRECT 0x8197A6 /begin AXIS_DESCR STD_AXIS qntns fak_ub_b8 6 0.00 7.969 DEPOSIT ABSOLUT /end AXIS_DESCR /end CHARACTERISTIC
/begin CHARACTERISTIC FABSALU "Abregelfaktor Beschleunigungssignal bei Schlechtwegstrecken-Erkennung" VALUE 0x8121CB KwUb 553.4 accgrd_ub_b555p55 0.00 553.4 FUNCTION_LIST DSWEC IF_DATA DIM_X DIRECT 0x8121CB /end CHARACTERISTIC
/begin CHARACTERISTIC FABSTT "Faktor Abstellzeit für Modelltemparatur" CURVE 0x81CE20 KlAUwSstUwWUw 1.999969 fak_uw_b2 0.00 1.999969 FUNCTION_LIST GGTFM IF_DATA DIM_X DIRECT 0x81CE20
 /begin AXIS_DESCR STD_AXIS tabst_w t1sxs_uw_q1 5 0.00 65535.00 DEPOSIT ABSOLUT /end AXIS_DESCR
/end CHARACTERISTIC
/begin CHARACTERISTIC FAINTEN "Anzahl Intervalle zur Freigabe Ti - Abschaltung" VALUE 0x8181AE KwUb 255.0 dez 0.00 255.0 FUNCTION_LIST DMDMIL IF_DATA DIM_X DIRECT 0x8181AE /end CHARACTERISTIC
/begin CHARACTERISTIC FASKIV1 "Faktor für Verlängerung 1. KAT-Intervall, Aussetzererkennung" VALUE 0x810899 KwUb 4.000 dez 1.000 5.000 FUNCTION_LIST DMDMIL IF_DATA DIM_X DIRECT 0x810899 /end CHARACTERISTIC
/begin CHARACTERISTIC FATMRML "Faktor fuer die Aufteilung Abgas-/Abgas-Rohrwandtemperatur" CURVE 0x8181DF GklWUb 0.9961 fak_ub_b1 0.00 0.9961 FUNCTION_LIST ATM IF_DATA DIM_X DIRECT 0x8181DF
 /begin AXIS_DESCR COM_AXIS ml_w m_uw_b6553p5 7 0.00 6553.500 AXIS_PTS_REF SML07TMUW /end AXIS_DESCR
/end CHARACTERISTIC
/begin CHARACTERISTIC FATMRML2 "Faktor fuer die Aufteilung Abgas-/Abgas-Rohrwandtemperatur Bank2" CURVE 0x8181E6 GklWUb 0.9961 fak_ub_b1 0.00 0.9961 FUNCTION_LIST ATM IF_DATA DIM_X DIRECT 0x8181E6
 /begin AXIS_DESCR COM_AXIS ml_w m_uw_b6553p5 7 0.00 6553.500 AXIS_PTS_REF SML07TMUW /end AXIS_DESCR
/end CHARACTERISTIC
/begin CHARACTERISTIC FAUS "Faktor Abgasuntersuchung Störgröße für Gemischvorsteuerung" VALUE 0x81BFF8 KwUw 1.999969 fak_uw_b2 0.00 1.999969 FUNCTION_LIST ESGRU IF_DATA DIM_X DIRECT 0x81BFF8 /end CHARACTERISTIC
/begin CHARACTERISTIC FBTEB "Faktor Begrenzung Lerngeschwindigkeit für Beladung" CURVE 0x8199EF KlAUbSstUbWUb 0.9961 fak_ub_b1 0.00 0.9961 FUNCTION_LIST TEB IF_DATA DIM_X DIRECT 0x8199EF
 /begin AXIS_DESCR STD_AXIS ftefvab fak_ub_b0p03125 6 0.00 0.03113 DEPOSIT ABSOLUT /end AXIS_DESCR
/end CHARACTERISTIC
/begin CHARACTERISTIC FBTEVA "Faktor ftefva-abhängige Lerngeschwindigkeit der Beladung" CURVE 0x8199FC KlAUbSstUbWUb 0.9961 fak_ub_b1 0.00 0.9961 FUNCTION_LIST TEB IF_DATA DIM_X DIRECT 0x8199FC /begin AXIS_DESCR STD_AXIS ftefva fak_ub_b0p5 6 0.00 0.4980 DEPOSIT ABSOLUT /end AXIS_DESCR /end CHARACTERISTIC
/begin CHARACTERISTIC FDDN "LLR: Gewichtungsfaktor für D-Verstärkung" CURVE 0x811604 GklWUb 0.9961 fak_ub_b1 0.00 0.9961 FUNCTION_LIST LLRRM IF_DATA DIM_X DIRECT 0x811604
 /begin AXIS_DESCR COM_AXIS dns nmotd_sb_q10 6 -1280. 1270. AXIS_PTS_REF SNS06LLSB /end AXIS_DESCR
/end CHARACTERISTIC
/begin CHARACTERISTIC FDFRMIN "Default-Wert untere Schranke dfr_w" VALUE 0x811FF1 KwSb 1.992 fak_sb_b1 -1.000 0.9922 FUNCTION_LIST LRS IF_DATA DIM_X DIRECT 0x811FF1 /end CHARACTERISTIC
/begin CHARACTERISTIC FDNIKOR "Faktor für Korrektur auif I-Anteil über dn" VALUE 0x81160A KwUb 1.992 fak_ub_b2 0.00 1.992 FUNCTION_LIST LLRRM IF_DATA DIM_X DIRECT 0x81160A /end CHARACTERISTIC
/begin CHARACTERISTIC FDVANS "Temperaturfaktor für Drosselventildurchfluß" CURVE 0x8184FA KlAUbSstUbWUb 1.992 fak_ub_b2 0.00 1.992 FUNCTION_LIST BGTMPK IF_DATA DIM_X DIRECT 0x8184FA
 /begin AXIS_DESCR STD_AXIS tans temp_ub_q0p75_o48 8 -48.00 143.3 DEPOSIT ABSOLUT /end AXIS_DESCR
/end CHARACTERISTIC
/begin CHARACTERISTIC FETATEBN "Kennlinie für drehzahlabhängigen Sollwert des Motorwirkungsgrades" CURVE 0x819A09 KlAUbSstUbWUb 0.9961 fak_ub_b1 0.00 0.9961 FUNCTION_LIST TEB IF_DATA DIM_X DIRECT 0x819A09 /begin AXIS_DESCR STD_AXIS nmot nmot_ub_q40 5 0.00 10200. DEPOSIT ABSOLUT /end AXIS_DESCR /end CHARACTERISTIC
/begin CHARACTERISTIC FFLDZ "Folgefunkenladezeit" CURVE 0x817696 KlAUbSstUbWUw 43.69000 tsegment_sy 0.00 43.69000 FUNCTION_LIST ZUESZ IF_DATA DIM_X DIRECT 0x817696 /begin AXIS_DESCR STD_AXIS ub spg_ubatt 8 0.00 19.38 DEPOSIT ABSOLUT /end AXIS_DESCR /end CHARACTERISTIC
/begin CHARACTERISTIC FFNVS "Steigung ZW-Kennfeld-Gewichtung bei Ventihubumschaltung" VALUE 0x81E33A KwUw 0.9999847 fak_uw_b1 0.00 0.9999847 FUNCTION_LIST VS IF_DATA DIM_X DIRECT 0x81E33A /end CHARACTERISTIC
/begin CHARACTERISTIC FFTAAA "Dummy: Tabellenanfang" VAL_BLK 0x81096F KwbUb 255.0 dez 0.00 255.0 NUMBER 3 FUNCTION_LIST DFPM_DFPM IF_DATA DIM_X DIRECT 0x81096F /end CHARACTERISTIC
/begin CHARACTERISTIC FFTAAVE "Freeze Frame Tabelle: Absperrventil Aktivkohlefilter (Endstufe)" VAL_BLK 0x810972 KwbUb 255.0 dez 0.00 255.0 NUMBER 3 FUNCTION_LIST DFPM_DEKON IF_DATA DIM_X DIRECT 0x810972 /end CHARACTERISTIC
/begin CHARACTERISTIC FFTAGRE "Freeze Frame Tabelle: AGR-Ventil Endstufe" VAL_BLK 0x810975 KwbUb 255.0 dez 0.00 255.0 NUMBER 3 FUNCTION_LIST DFPM_DUMMY043 IF_DATA DIM_X DIRECT 0x810975 /end CHARACTERISTIC
/begin CHARACTERISTIC FFTAGRF "Freeze Frame Tabelle: Überwachung AGR-Flow" VAL_BLK 0x810978 KwbUb 255.0 dez 0.00 255.0 NUMBER 3 FUNCTION_LIST DFPM_DUMMY043 IF_DATA DIM_X DIRECT 0x810978 /end CHARACTERISTIC
/begin CHARACTERISTIC FFTBM "Freeze Frame Tabelle: Bezugsmarkengeber" VAL_BLK 0x81097B KwbUb 255.0 dez 0.00 255.0 NUMBER 3 FUNCTION_LIST DFPM_DDG IF_DATA DIM_X DIRECT 0x81097B /end CHARACTERISTIC
/begin CHARACTERISTIC FFTBREMS "Freeze Frame Tabelle: Pedalwertgeber Bremse" VAL_BLK 0x81097E KwbUb 255.0 dez 0.00 255.0 NUMBER 3 FUNCTION_LIST DFPM_GGEGAS IF_DATA DIM_X DIRECT 0x81097E /end CHARACTERISTIC
/begin CHARACTERISTIC FFTBWF "Freeze Frame Tabelle: PWG Bewegung" VAL_BLK 0x810981 KwbUb 255.0 dez 0.00 255.0 NUMBER 3 FUNCTION_LIST DFPM_GGPED IF_DATA DIM_X DIRECT 0x810981 /end CHARACTERISTIC
/begin CHARACTERISTIC FFTCAS "Freeze Frame Tabelle: CAN-Timeout ASC-Botschaft" VAL_BLK 0x810984 KwbUb 255.0 dez 0.00 255.0 NUMBER 3 FUNCTION_LIST DFPM_DCAS IF_DATA DIM_X DIRECT 0x810984 /end CHARACTERISTIC
/begin CHARACTERISTIC FFTCGE "Freeze Frame Tabelle: CAN-Timeout EGS-Botschaft" VAL_BLK 0x810987 KwbUb 255.0 dez 0.00 255.0 NUMBER 3 FUNCTION_LIST DFPM_DCGE IF_DATA DIM_X DIRECT 0x810987 /end CHARACTERISTIC
/begin CHARACTERISTIC FFTCGEGS "Freeze Frame Tabelle: EGS; Steuergerät" VAL_BLK 0x81098A KwbUb 255.0 dez 0.00 255.0 NUMBER 3 FUNCTION_LIST DFPM_DCG IF_DATA DIM_X DIRECT 0x81098A /end CHARACTERISTIC
/begin CHARACTERISTIC FFTCGGGP "Freeze Frame Tabelle: EGS; Gang unplausibel" VAL_BLK 0x81098D KwbUb 255.0 dez 0.00 255.0 NUMBER 3 FUNCTION_LIST DFPM_DCG IF_DATA DIM_X DIRECT 0x81098D /end CHARACTERISTIC
/begin CHARACTERISTIC FFTCGGGV "Freeze Frame Tabelle: EGS; Gangvergleich negativ" VAL_BLK 0x810990 KwbUb 255.0 dez 0.00 255.0 NUMBER 3 FUNCTION_LIST DFPM_DCG IF_DATA DIM_X DIRECT 0x810990 /end CHARACTERISTIC
/begin CHARACTERISTIC FFTCGM1V "Freeze Frame Tabelle: EGS; Magnetventil 1-2/4-5 Schaltung" VAL_BLK 0x810993 KwbUb 255.0 dez 0.00 255.0 NUMBER 3 FUNCTION_LIST DFPM_DCG IF_DATA DIM_X DIRECT 0x810993 /end CHARACTERISTIC
/begin CHARACTERISTIC FFTCGM2V "Freeze Frame Tabelle: EGS; Magnetventil 2-3 Schaltung" VAL_BLK 0x810996 KwbUb 255.0 dez 0.00 255.0 NUMBER 3 FUNCTION_LIST DFPM_DCG IF_DATA DIM_X DIRECT 0x810996 /end CHARACTERISTIC
/begin CHARACTERISTIC FFTCGM3V "Freeze Frame Tabelle: EGS; Magnetventil 3-4 Schaltung" VAL_BLK 0x810999 KwbUb 255.0 dez 0.00 255.0 NUMBER 3 FUNCTION_LIST DFPM_DCG IF_DATA DIM_X DIRECT 0x810999 /end CHARACTERISTIC
/begin CHARACTERISTIC FFTCGMVK "Freeze Frame Tabelle: EGS; Magnetventil Wandlerkupplung" VAL_BLK 0x81099C KwbUb 255.0 dez 0.00 255.0 NUMBER 3 FUNCTION_LIST DFPM_DCG IF_DATA DIM_X DIRECT 0x81099C /end CHARACTERISTIC
/begin CHARACTERISTIC FFTCGRMM "Freeze Frame Tabelle: EGS; Regelmagnetventil Modulierdruck" VAL_BLK 0x81099F KwbUb 255.0 dez 0.00 255.0 NUMBER 3 FUNCTION_LIST DFPM_DCG IF_DATA DIM_X DIRECT 0x81099F /end CHARACTERISTIC
/begin CHARACTERISTIC FFTCGRMS "Freeze Frame Tabelle: EGS; Regelmagnetventil Schaltdruck" VAL_BLK 0x8109A2 KwbUb 255.0 dez 0.00 255.0 NUMBER 3 FUNCTION_LIST DFPM_DCG IF_DATA DIM_X DIRECT 0x8109A2 /end CHARACTERISTIC
/begin CHARACTERISTIC FFTCGUDG "Freeze Frame Tabelle: EGS; Versorgungsspannung Drehzahlsensoren" VAL_BLK 0x8109A5 KwbUb 255.0 dez 0.00 255.0 NUMBER 3 FUNCTION_LIST DFPM_DCG IF_DATA DIM_X DIRECT 0x8109A5 /end CHARACTERISTIC
/begin CHARACTERISTIC FFTCGUMV "Freeze Frame Tabelle: EGS; Versorgungsspannung Magnetventile" VAL_BLK 0x8109A8 KwbUb 255.0 dez 0.00 255.0 NUMBER 3 FUNCTION_LIST DFPM_DCG IF_DATA DIM_X DIRECT 0x8109A8 /end CHARACTERISTIC
/begin CHARACTERISTIC FFTCGVGC "Freeze Frame Tabelle: EGS; Verteilergetr.-Stellung unplaus." VAL_BLK 0x8109AB KwbUb 255.0 dez 0.00 255.0 NUMBER 3 FUNCTION_LIST DFPM_DCG IF_DATA DIM_X DIRECT 0x8109AB /end CHARACTERISTIC
/begin CHARACTERISTIC FFTCGVRC "Freeze Frame Tabelle: EGS; Raddrehzahl hinten unplausibel" VAL_BLK 0x8109AE KwbUb 255.0 dez 0.00 255.0 NUMBER 3 FUNCTION_LIST DFPM_DCG IF_DATA DIM_X DIRECT 0x8109AE /end CHARACTERISTIC
/begin CHARACTERISTIC FFTCGWK "Freeze Frame Tabelle: EGS; Wandlerkupplung" VAL_BLK 0x8109B1 KwbUb 255.0 dez 0.00 255.0 NUMBER 3 FUNCTION_LIST DFPM_DCG IF_DATA DIM_X DIRECT 0x8109B1 /end CHARACTERISTIC
/begin CHARACTERISTIC FFTCKBI "" VAL_BLK 0x8109B4 KwbUb 255.0 dez 0.00 255.0 NUMBER 3 FUNCTION_LIST DFPM_DCKBI IF_DATA DIM_X DIRECT 0x8109B4 /end CHARACTERISTIC
/begin CHARACTERISTIC FFTCMIL "Freeze Frame Tabelle: MIL über CAN" VAL_BLK 0x8109B7 KwbUb 255.0 dez 0.00 255.0 NUMBER 3 FUNCTION_LIST DFPM_DCMIL IF_DATA DIM_X DIRECT 0x8109B7 /end CHARACTERISTIC
/begin CHARACTERISTIC FFTCRA "Freeze Frame Tabelle: EKP aus bei crash" VAL_BLK 0x8109BA KwbUb 255.0 dez 0.00 255.0 NUMBER 3 FUNCTION_LIST DFPM_GGAIRBAG IF_DATA DIM_X DIRECT 0x8109BA /end CHARACTERISTIC
/begin CHARACTERISTIC FFTDK "Freeze Frame Tabelle: DK- Potentiometer" VAL_BLK 0x8109BD KwbUb 255.0 dez 0.00 255.0 NUMBER 3 FUNCTION_LIST DFPM_DDVE IF_DATA DIM_X DIRECT 0x8109BD /end CHARACTERISTIC
/begin CHARACTERISTIC FFTDK1P "Freeze Frame Tabelle: Drosselklappe 1. Poti" VAL_BLK 0x8109C0 KwbUb 255.0 dez 0.00 255.0 NUMBER 3 FUNCTION_LIST DFPM_DDVE IF_DATA DIM_X DIRECT 0x8109C0 /end CHARACTERISTIC
/begin CHARACTERISTIC FFTDK2P "Freeze Frame Tabelle: Drosselklappenpotentiometer 2" VAL_BLK 0x8109C3 KwbUb 255.0 dez 0.00 255.0 NUMBER 3 FUNCTION_LIST DFPM_DDVE IF_DATA DIM_X DIRECT 0x8109C3 /end CHARACTERISTIC
/begin CHARACTERISTIC FFTDPL "Freeze Frame Tabelle: Dauerplus" VAL_BLK 0x8109C6 KwbUb 255.0 dez 0.00 255.0 NUMBER 3 FUNCTION_LIST DFPM_DUMMY043 IF_DATA DIM_X DIRECT 0x8109C6 /end CHARACTERISTIC
/begin CHARACTERISTIC FFTDSL "Freeze Frame Tabelle: Drucksensor Ladedruck" VAL_BLK 0x8109C9 KwbUb 255.0 dez 0.00 255.0 NUMBER 3 FUNCTION_LIST DFPM_GGDSAS IF_DATA DIM_X DIRECT 0x8109C9 /end CHARACTERISTIC
/begin CHARACTERISTIC FFTDSU "Freeze Frame Tabelle: Umgebungsdrucksensor" VAL_BLK 0x8109CC KwbUb 255.0 dez 0.00 255.0 NUMBER 3 FUNCTION_LIST DFPM_GGDSAS IF_DATA DIM_X DIRECT 0x8109CC /end CHARACTERISTIC
/begin CHARACTERISTIC FFTDSVLU "Freeze Frame Tabelle: Drucksensorsignalvergleich (DS-L DS-U)" VAL_BLK 0x8109CF KwbUb 255.0 dez 0.00 255.0 NUMBER 3 FUNCTION_LIST DFPM_GGDSAS IF_DATA DIM_X DIRECT 0x8109CF /end CHARACTERISTIC
/begin CHARACTERISTIC FFTDVEE "Freeze Frame Tabelle: DV-E Endstufe" VAL_BLK 0x8109D2 KwbUb 255.0 dez 0.00 255.0 NUMBER 3 FUNCTION_LIST DFPM_DDVE IF_DATA DIM_X DIRECT 0x8109D2 /end CHARACTERISTIC
/begin CHARACTERISTIC FFTDVEF "Freeze Frame Tabelle: DV-E Fehler bei Federprüfung" VAL_BLK 0x8109D5 KwbUb 255.0 dez 0.00 255.0 NUMBER 3 FUNCTION_LIST DFPM_DDVE IF_DATA DIM_X DIRECT 0x8109D5 /end CHARACTERISTIC
/begin CHARACTERISTIC FFTDVEFO "" VAL_BLK 0x8109D8 KwbUb 255.0 dez 0.00 255.0 NUMBER 3 FUNCTION_LIST DFPM_DDVE IF_DATA DIM_X DIRECT 0x8109D8 /end CHARACTERISTIC
/begin CHARACTERISTIC FFTDVEL "Freeze Frame Tabelle: DV-E Lageabweichung" VAL_BLK 0x8109DB KwbUb 255.0 dez 0.00 255.0 NUMBER 3 FUNCTION_LIST DFPM_DDVE IF_DATA DIM_X DIRECT 0x8109DB /end CHARACTERISTIC
/begin CHARACTERISTIC FFTDVEN "Freeze Frame Tabelle: DV-E Fehler bei Prüfung Notluftposition" VAL_BLK 0x8109DE KwbUb 255.0 dez 0.00 255.0 NUMBER 3 FUNCTION_LIST DFPM_DDVE IF_DATA DIM_X DIRECT 0x8109DE /end CHARACTERISTIC
/begin CHARACTERISTIC FFTDVER "Freeze Frame Tabelle: DV-E Regelbereich" VAL_BLK 0x8109E1 KwbUb 255.0 dez 0.00 255.0 NUMBER 3 FUNCTION_LIST DFPM_DDVE IF_DATA DIM_X DIRECT 0x8109E1 /end CHARACTERISTIC
/begin CHARACTERISTIC FFTDVET "" VAL_BLK 0x8109E4 KwbUb 255.0 dez 0.00 255.0 NUMBER 3 FUNCTION_LIST DFPM_DDVE IF_DATA DIM_X DIRECT 0x8109E4 /end CHARACTERISTIC
/begin CHARACTERISTIC FFTDVEU "Freeze Frame Tabelle: DV-E Fehler beim UMA-Lernen" VAL_BLK 0x8109E7 KwbUb 255.0 dez 0.00 255.0 NUMBER 3 FUNCTION_LIST DFPM_DDVE IF_DATA DIM_X DIRECT 0x8109E7 /end CHARACTERISTIC
/begin CHARACTERISTIC FFTDVEUB "" VAL_BLK 0x8109EA KwbUb 255.0 dez 0.00 255.0 NUMBER 3 FUNCTION_LIST DFPM_DDVE IF_DATA DIM_X DIRECT 0x8109EA /end CHARACTERISTIC
/begin CHARACTERISTIC FFTDVEUW "" VAL_BLK 0x8109ED KwbUb 255.0 dez 0.00 255.0 NUMBER 3 FUNCTION_LIST DFPM_DDVE IF_DATA DIM_X DIRECT 0x8109ED /end CHARACTERISTIC
/begin CHARACTERISTIC FFTDVEV "Freeze Frame Tabelle: DV-E Fehler bei Verstärkerabgleich" VAL_BLK 0x8109F0 KwbUb 255.0 dez 0.00 255.0 NUMBER 3 FUNCTION_LIST DFPM_DDVE IF_DATA DIM_X DIRECT 0x8109F0 /end CHARACTERISTIC
/begin CHARACTERISTIC FFTEGFE "Freeze Frame Tabelle: Lasterfassung" VAL_BLK 0x8109F3 KwbUb 255.0 dez 0.00 255.0 NUMBER 3 FUNCTION_LIST DFPM_EGFE IF_DATA DIM_X DIRECT 0x8109F3 /end CHARACTERISTIC
/begin CHARACTERISTIC FFTEV1 "Freeze Frame Tabelle: EV Endstufe 1" VAL_BLK 0x8109F6 KwbUb 255.0 dez 0.00 255.0 NUMBER 3 FUNCTION_LIST DFPM_DEKON IF_DATA DIM_X DIRECT 0x8109F6 /end CHARACTERISTIC
/begin CHARACTERISTIC FFTEV2 "Freeze Frame Tabelle: EV Endstufe 2" VAL_BLK 0x8109F9 KwbUb 255.0 dez 0.00 255.0 NUMBER 3 FUNCTION_LIST DFPM_DEKON IF_DATA DIM_X DIRECT 0x8109F9 /end CHARACTERISTIC
/begin CHARACTERISTIC FFTEV3 "Freeze Frame Tabelle: EV Endstufe 3" VAL_BLK 0x8109FC KwbUb 255.0 dez 0.00 255.0 NUMBER 3 FUNCTION_LIST DFPM_DEKON IF_DATA DIM_X DIRECT 0x8109FC /end CHARACTERISTIC
/begin CHARACTERISTIC FFTEV4 "Freeze Frame Tabelle: EV Endstufe 4" VAL_BLK 0x8109FF KwbUb 255.0 dez 0.00 255.0 NUMBER 3 FUNCTION_LIST DFPM_DEKON IF_DATA DIM_X DIRECT 0x8109FF /end CHARACTERISTIC
/begin CHARACTERISTIC FFTEV5 "Freeze Frame Tabelle: EV Endstufe 5" VAL_BLK 0x810A02 KwbUb 255.0 dez 0.00 255.0 NUMBER 3 FUNCTION_LIST DFPM_DEKON IF_DATA DIM_X DIRECT 0x810A02 /end CHARACTERISTIC
/begin CHARACTERISTIC FFTEV6 "Freeze frame Tabelle: EV Endstufe 6" VAL_BLK 0x810A05 KwbUb 255.0 dez 0.00 255.0 NUMBER 3 FUNCTION_LIST DFPM_DEKON IF_DATA DIM_X DIRECT 0x810A05 /end CHARACTERISTIC
/begin CHARACTERISTIC FFTFGRL "Freeze Frame Tabelle: FGR-Lampe über CAN" VAL_BLK 0x810A08 KwbUb 255.0 dez 0.00 255.0 NUMBER 3 FUNCTION_LIST DFPM_DCFGRL IF_DATA DIM_X DIRECT 0x810A08 /end CHARACTERISTIC
/begin CHARACTERISTIC FFTFP1P "Freeze Frame Tabelle: Poti 1, Fahrpedal" VAL_BLK 0x810A0B KwbUb 255.0 dez 0.00 255.0 NUMBER 3 FUNCTION_LIST DFPM_GGPED IF_DATA DIM_X DIRECT 0x810A0B /end CHARACTERISTIC
/begin CHARACTERISTIC FFTFP2P "Freeze Frame Tabelle: Poti 2, Fahrpedal" VAL_BLK 0x810A0E KwbUb 255.0 dez 0.00 255.0 NUMBER 3 FUNCTION_LIST DFPM_GGPED IF_DATA DIM_X DIRECT 0x810A0E /end CHARACTERISTIC
/begin CHARACTERISTIC FFTFPP "Freeze Frame Tabelle: Poti Fahrpedal" VAL_BLK 0x810A11 KwbUb 255.0 dez 0.00 255.0 NUMBER 3 FUNCTION_LIST DFPM_GGPED IF_DATA DIM_X DIRECT 0x810A11 /end CHARACTERISTIC
/begin CHARACTERISTIC FFTFRAO "Freeze Frame Tabelle: FRAO Gemischadaption" VAL_BLK 0x810A14 KwbUb 255.0 dez 0.00 255.0 NUMBER 3 FUNCTION_LIST DFPM_DKVS IF_DATA DIM_X DIRECT 0x810A14 /end CHARACTERISTIC
/begin CHARACTERISTIC FFTFRAO2 "Freeze Frame Tabelle: FRAO Gemischadaption Bank 2" VAL_BLK 0x810A17 KwbUb 255.0 dez 0.00 255.0 NUMBER 3 FUNCTION_LIST DFPM_DKVS IF_DATA DIM_X DIRECT 0x810A17 /end CHARACTERISTIC
/begin CHARACTERISTIC FFTFRAU "Freeze Frame Tabelle: FRAU Gemischadaption" VAL_BLK 0x810A1A KwbUb 255.0 dez 0.00 255.0 NUMBER 3 FUNCTION_LIST DFPM_DKVS IF_DATA DIM_X DIRECT 0x810A1A /end CHARACTERISTIC
/begin CHARACTERISTIC FFTFRAU2 "Freeze Frame Tabelle: FRAU Gemischadaption Bank 2" VAL_BLK 0x810A1D KwbUb 255.0 dez 0.00 255.0 NUMBER 3 FUNCTION_LIST DFPM_DKVS IF_DATA DIM_X DIRECT 0x810A1D /end CHARACTERISTIC
/begin CHARACTERISTIC FFTFRST "Freeze Frame Tabelle: LR-Abweichung" VAL_BLK 0x810A20 KwbUb 255.0 dez 0.00 255.0 NUMBER 3 FUNCTION_LIST DFPM_DKVS IF_DATA DIM_X DIRECT 0x810A20 /end CHARACTERISTIC
/begin CHARACTERISTIC FFTFRST2 "Freeze Frame Tabelle: LR-Abweichung Bank 2" VAL_BLK 0x810A23 KwbUb 255.0 dez 0.00 255.0 NUMBER 3 FUNCTION_LIST DFPM_DKVS IF_DATA DIM_X DIRECT 0x810A23 /end CHARACTERISTIC
/begin CHARACTERISTIC FFTHSH "Tabelle Umweltbedingungen Heizung Lambdasonde hinter Kat" VAL_BLK 0x810A26 KwbUb 255.0 dez 0.00 255.0 NUMBER 3 FUNCTION_LIST DFPM_DHLSHK IF_DATA DIM_X DIRECT 0x810A26 /end CHARACTERISTIC
/begin CHARACTERISTIC FFTHSH2 "Tabelle Umweltbedingungen Heizung Lambdasonde hinter Kat Bank2" VAL_BLK 0x810A29 KwbUb 255.0 dez 0.00 255.0 NUMBER 3 FUNCTION_LIST DFPM_DHLSHK IF_DATA DIM_X DIRECT 0x810A29 /end CHARACTERISTIC
/begin CHARACTERISTIC FFTHSHE "Tabelle Umweltbedingungen Endstufe Heizung Lambdasonde hinter Kat" VAL_BLK 0x810A2C KwbUb 255.0 dez 0.00 255.0 NUMBER 3 FUNCTION_LIST DFPM_DEKON IF_DATA DIM_X DIRECT 0x810A2C /end CHARACTERISTIC
/begin CHARACTERISTIC FFTHSHE2 "Freeze Frame Tabelle: Endstufe Heizung Sonde hinter Kat. Bank 2" VAL_BLK 0x810A2F KwbUb 255.0 dez 0.00 255.0 NUMBER 3 FUNCTION_LIST DFPM_DEKON IF_DATA DIM_X DIRECT 0x810A2F /end CHARACTERISTIC
/begin CHARACTERISTIC FFTHSV "Tabelle Umweltbedingungen Heizung Lambdasonde vor Kat" VAL_BLK 0x810A32 KwbUb 255.0 dez 0.00 255.0 NUMBER 3 FUNCTION_LIST DFPM_DHLSU IF_DATA DIM_X DIRECT 0x810A32 /end CHARACTERISTIC
/begin CHARACTERISTIC FFTHSV2 "Tabelle Umweltbedingungen Heizung Lambdasonde vor Kat Bank2" VAL_BLK 0x810A35 KwbUb 255.0 dez 0.00 255.0 NUMBER 3 FUNCTION_LIST DFPM_DHLSU IF_DATA DIM_X DIRECT 0x810A35 /end CHARACTERISTIC
/begin CHARACTERISTIC FFTHSVSA "Tabelle Umweltbedingungen Heizung Lambdasonde vor Kat" VAL_BLK 0x810A38 KwbUb 255.0 dez 0.00 255.0 NUMBER 3 FUNCTION_LIST DFPM_DHLSU IF_DATA DIM_X DIRECT 0x810A38 /end CHARACTERISTIC
/begin CHARACTERISTIC FFTHSVSA2 "Tabelle Umweltbedingungen Heizung Lambdasonde vor Kat Bank2" VAL_BLK 0x810A3B KwbUb 255.0 dez 0.00 255.0 NUMBER 3 FUNCTION_LIST DFPM_DHLSU IF_DATA DIM_X DIRECT 0x810A3B /end CHARACTERISTIC
/begin CHARACTERISTIC FFTKAT "Freeze Frame Tabelle: Katalysator" VAL_BLK 0x810A3E KwbUb 255.0 dez 0.00 255.0 NUMBER 3 FUNCTION_LIST DFPM_DKAT IF_DATA DIM_X DIRECT 0x810A3E /end CHARACTERISTIC
/begin CHARACTERISTIC FFTKAT2 "Freeze Frame Tabelle: Katalysator" VAL_BLK 0x810A41 KwbUb 255.0 dez 0.00 255.0 NUMBER 3 FUNCTION_LIST DFPM_DKAT IF_DATA DIM_X DIRECT 0x810A41 /end CHARACTERISTIC
/begin CHARACTERISTIC FFTKOS "Freeze Frame Tabelle: Klimakompressor Endstufe" VAL_BLK 0x810A44 KwbUb 255.0 dez 0.00 255.0 NUMBER 3 FUNCTION_LIST DFPM_DEKON IF_DATA DIM_X DIRECT 0x810A44 /end CHARACTERISTIC
/begin CHARACTERISTIC FFTKPE "Freeze Frame Tabelle: EKP-Relais Endstufe" VAL_BLK 0x810A47 KwbUb 255.0 dez 0.00 255.0 NUMBER 3 FUNCTION_LIST DFPM_DEKON IF_DATA DIM_X DIRECT 0x810A47 /end CHARACTERISTIC
/begin CHARACTERISTIC FFTKRNT "Freeze frame Tabelle: Klopfregelung Nulltest" VAL_BLK 0x810A4A KwbUb 255.0 dez 0.00 255.0 NUMBER 3 FUNCTION_LIST DFPM_DKRNT IF_DATA DIM_X DIRECT 0x810A4A /end CHARACTERISTIC
/begin CHARACTERISTIC FFTKROF "Freeze Frame Tabelle: Klopfregelung Offset" VAL_BLK 0x810A4D KwbUb 255.0 dez 0.00 255.0 NUMBER 3 FUNCTION_LIST DFPM_DKRNT IF_DATA DIM_X DIRECT 0x810A4D /end CHARACTERISTIC
/begin CHARACTERISTIC FFTKRTP "Freeze Frame Tabelle: Klopfregelung Testimpuls" VAL_BLK 0x810A50 KwbUb 255.0 dez 0.00 255.0 NUMBER 3 FUNCTION_LIST DFPM_DKRTP IF_DATA DIM_X DIRECT 0x810A50 /end CHARACTERISTIC
/begin CHARACTERISTIC FFTKS1 "Freeze Frame Tabelle: Klopfsensor 1" VAL_BLK 0x810A53 KwbUb 255.0 dez 0.00 255.0 NUMBER 3 FUNCTION_LIST DFPM_DKRS IF_DATA DIM_X DIRECT 0x810A53 /end CHARACTERISTIC
/begin CHARACTERISTIC FFTKS2 "Freeze Frame Tabelle: Klopfsensor 2" VAL_BLK 0x810A56 KwbUb 255.0 dez 0.00 255.0 NUMBER 3 FUNCTION_LIST DFPM_DKRS IF_DATA DIM_X DIRECT 0x810A56 /end CHARACTERISTIC
/begin CHARACTERISTIC FFTKS3 "Freeze Frame Tabelle: Klopfsensor 3" VAL_BLK 0x810A59 KwbUb 255.0 dez 0.00 255.0 NUMBER 3 FUNCTION_LIST DFPM_DKRS IF_DATA DIM_X DIRECT 0x810A59 /end CHARACTERISTIC
/begin CHARACTERISTIC FFTKS4 "Freeze Frame Tabelle: Klopfsensor 4" VAL_BLK 0x810A5C KwbUb 255.0 dez 0.00 255.0 NUMBER 3 FUNCTION_LIST DFPM_DKRS IF_DATA DIM_X DIRECT 0x810A5C /end CHARACTERISTIC
/begin CHARACTERISTIC FFTKUPPL "Freeze Frame Tabelle: Pedalwertgeber Kupplung" VAL_BLK 0x810A5F KwbUb 255.0 dez 0.00 255.0 NUMBER 3 FUNCTION_LIST DFPM_DKUPPL IF_DATA DIM_X DIRECT 0x810A5F /end CHARACTERISTIC
/begin CHARACTERISTIC FFTKWAVE "Freeze Frame Tabelle: Kühlwasserabsperrventil Endstufe" VAL_BLK 0x810A62 KwbUb 255.0 dez 0.00 255.0 NUMBER 3 FUNCTION_LIST DFPM_DEKON IF_DATA DIM_X DIRECT 0x810A62 /end CHARACTERISTIC
/begin CHARACTERISTIC FFTLASH "Tabelle Umweltbedingungen Lambdasonde hinter Kat" VAL_BLK 0x810A65 KwbUb 255.0 dez 0.00 255.0 NUMBER 3 FUNCTION_LIST DFPM_DLSAHK IF_DATA DIM_X DIRECT 0x810A65 /end CHARACTERISTIC
/begin CHARACTERISTIC FFTLASH2 "Tabelle Umweltbedingungen Lambdasonde hinter Kat Bank2" VAL_BLK 0x810A68 KwbUb 255.0 dez 0.00 255.0 NUMBER 3 FUNCTION_LIST DFPM_DLSAHK IF_DATA DIM_X DIRECT 0x810A68 /end CHARACTERISTIC
/begin CHARACTERISTIC FFTLDE "Freeze Frame Tabelle: LDR Taktventil Endstufe" VAL_BLK 0x810A6B KwbUb 255.0 dez 0.00 255.0 NUMBER 3 FUNCTION_LIST DFPM_DEKON IF_DATA DIM_X DIRECT 0x810A6B /end CHARACTERISTIC
/begin CHARACTERISTIC FFTLDO "Freeze Frame Tabelle: LDR Überladefehler" VAL_BLK 0x810A6E KwbUb 255.0 dez 0.00 255.0 NUMBER 3 FUNCTION_LIST DFPM_DLDR IF_DATA DIM_X DIRECT 0x810A6E /end CHARACTERISTIC
/begin CHARACTERISTIC FFTLDRA "Freeze Frame Tabelle: LDR Regelabweichungsfehler" VAL_BLK 0x810A71 KwbUb 255.0 dez 0.00 255.0 NUMBER 3 FUNCTION_LIST DFPM_DLDR IF_DATA DIM_X DIRECT 0x810A71 /end CHARACTERISTIC
/begin CHARACTERISTIC FFTLF1E "Freeze Frame Tabelle: Lüfter1 (Endstufe)" VAL_BLK 0x810A74 KwbUb 255.0 dez 0.00 255.0 NUMBER 3 FUNCTION_LIST DFPM_DEKON IF_DATA DIM_X DIRECT 0x810A74 /end CHARACTERISTIC
/begin CHARACTERISTIC FFTLF2E "Freeze Frame Tabelle: Lüfter2 (Endstufe)" VAL_BLK 0x810A77 KwbUb 255.0 dez 0.00 255.0 NUMBER 3 FUNCTION_LIST DFPM_DEKON IF_DATA DIM_X DIRECT 0x810A77 /end CHARACTERISTIC
/begin CHARACTERISTIC FFTLF3E "Freeze Frame Tabelle: Lüfter3 (Endstufe)" VAL_BLK 0x810A7A KwbUb 255.0 dez 0.00 255.0 NUMBER 3 FUNCTION_LIST DFPM_DEKON IF_DATA DIM_X DIRECT 0x810A7A /end CHARACTERISTIC
/begin CHARACTERISTIC FFTLLR "Freeze Frame Tabelle: Leerlaufregelung" VAL_BLK 0x810A7D KwbUb 255.0 dez 0.00 255.0 NUMBER 3 FUNCTION_LIST DFPM_DLLR IF_DATA DIM_X DIRECT 0x810A7D /end CHARACTERISTIC
/begin CHARACTERISTIC FFTLM "Freeze Frame Tabelle: Hauptfüllungssensor" VAL_BLK 0x810A80 KwbUb 255.0 dez 0.00 255.0 NUMBER 3 FUNCTION_LIST DFPM_DHFM IF_DATA DIM_X DIRECT 0x810A80 /end CHARACTERISTIC
/begin CHARACTERISTIC FFTLSH "Tabelle Umweltbedingungen Lambdasonde hinter Kat" VAL_BLK 0x810A83 KwbUb 255.0 dez 0.00 255.0 NUMBER 3 FUNCTION_LIST DFPM_DLSH IF_DATA DIM_X DIRECT 0x810A83 /end CHARACTERISTIC
/begin CHARACTERISTIC FFTLSH2 "Tabelle Umweltbedingungen Lambdasonde hinter Kat Bank 2" VAL_BLK 0x810A86 KwbUb 255.0 dez 0.00 255.0 NUMBER 3 FUNCTION_LIST DFPM_DLSH IF_DATA DIM_X DIRECT 0x810A86 /end CHARACTERISTIC
/begin CHARACTERISTIC FFTLSV "Tabelle Umweltbedingungen: Lambdasonde vor Kat" VAL_BLK 0x810A89 KwbUb 255.0 dez 0.00 255.0 NUMBER 3 FUNCTION_LIST DFPM_DLSU IF_DATA DIM_X DIRECT 0x810A89 /end CHARACTERISTIC
/begin CHARACTERISTIC FFTLSV2 "Tabelle Umweltbedingungen: Lambdasonde vor Kat Bank2" VAL_BLK 0x810A8C KwbUb 255.0 dez 0.00 255.0 NUMBER 3 FUNCTION_LIST DFPM_DLSU IF_DATA DIM_X DIRECT 0x810A8C /end CHARACTERISTIC
/begin CHARACTERISTIC FFTLSVV "Tabelle Umweltbedingungen: Vertauschte Lambdasonden vor Kat" VAL_BLK 0x810A8F KwbUb 255.0 dez 0.00 255.0 NUMBER 3 FUNCTION_LIST DFPM_LSVV IF_DATA DIM_X DIRECT 0x810A8F /end CHARACTERISTIC
/begin CHARACTERISTIC FFTMD "Freeze Frame Tabelle: Aussetzer, Summenfehler (multiple)" VAL_BLK 0x810A92 KwbUb 255.0 dez 0.00 255.0 NUMBER 3 FUNCTION_LIST DFPM_DMDMIL IF_DATA DIM_X DIRECT 0x810A92 /end CHARACTERISTIC
/begin CHARACTERISTIC FFTMD00 "Freeze Frame Tabelle: Aussetzer Zyl. 0" VAL_BLK 0x810A95 KwbUb 255.0 dez 0.00 255.0 NUMBER 3 FUNCTION_LIST DFPM_DMDMIL IF_DATA DIM_X DIRECT 0x810A95 /end CHARACTERISTIC
/begin CHARACTERISTIC FFTMD01 "Freeze Frame Tabelle: Aussetzer Zyl. 1" VAL_BLK 0x810A98 KwbUb 255.0 dez 0.00 255.0 NUMBER 3 FUNCTION_LIST DFPM_DMDMIL IF_DATA DIM_X DIRECT 0x810A98 /end CHARACTERISTIC
/begin CHARACTERISTIC FFTMD02 "Freeze Frame Tabelle: Aussetzer Zylinder 2" VAL_BLK 0x810A9B KwbUb 255.0 dez 0.00 255.0 NUMBER 3 FUNCTION_LIST DFPM_DMDMIL IF_DATA DIM_X DIRECT 0x810A9B /end CHARACTERISTIC
/begin CHARACTERISTIC FFTMD03 "Freeze Frame Tabelle: Aussetzer Zylinder 3" VAL_BLK 0x810A9E KwbUb 255.0 dez 0.00 255.0 NUMBER 3 FUNCTION_LIST DFPM_DMDMIL IF_DATA DIM_X DIRECT 0x810A9E /end CHARACTERISTIC
/begin CHARACTERISTIC FFTMD04 "Freeze Frame Tabelle: Aussetzer Zylinder 4" VAL_BLK 0x810AA1 KwbUb 255.0 dez 0.00 255.0 NUMBER 3 FUNCTION_LIST DFPM_DMDMIL IF_DATA DIM_X DIRECT 0x810AA1 /end CHARACTERISTIC
/begin CHARACTERISTIC FFTMD05 "Freeze Frame Tabelle: Aussetzer Zylinder 5" VAL_BLK 0x810AA4 KwbUb 255.0 dez 0.00 255.0 NUMBER 3 FUNCTION_LIST DFPM_DMDMIL IF_DATA DIM_X DIRECT 0x810AA4 /end CHARACTERISTIC
/begin CHARACTERISTIC FFTMDB "Freeze Frame Tabelle: Momentbegrenzung Sollmoment" VAL_BLK 0x810AA7 KwbUb 255.0 dez 0.00 255.0 NUMBER 3 FUNCTION_LIST DFPM_MDKOG IF_DATA DIM_X DIRECT 0x810AA7 /end CHARACTERISTIC
/begin CHARACTERISTIC FFTMSG "Freeze Frame Tabelle: Motorraumspülgebläse" VAL_BLK 0x810AAA KwbUb 255.0 dez 0.00 255.0 NUMBER 3 FUNCTION_LIST DFPM_MLS IF_DATA DIM_X DIRECT 0x810AAA /end CHARACTERISTIC
/begin CHARACTERISTIC FFTMSGE "Freeze Frame Tabelle: Motorraumspülgebläse (Endstufe)" VAL_BLK 0x810AAD KwbUb 255.0 dez 0.00 255.0 NUMBER 3 FUNCTION_LIST DFPM_DEKON IF_DATA DIM_X DIRECT 0x810AAD /end CHARACTERISTIC
/begin CHARACTERISTIC FFTN "Freeze Frame Tabelle: Drehzahlgeber" VAL_BLK 0x810AB0 KwbUb 255.0 dez 0.00 255.0 NUMBER 3 FUNCTION_LIST DFPM_DDG IF_DATA DIM_X DIRECT 0x810AB0 /end CHARACTERISTIC
/begin CHARACTERISTIC FFTNWKW "Freeze Frame Tabelle: Zuordnung Nockenwelle zu Kurbelwelle" VAL_BLK 0x810AB3 KwbUb 255.0 dez 0.00 255.0 NUMBER 3 FUNCTION_LIST DFPM_DNWKW IF_DATA DIM_X DIRECT 0x810AB3 /end CHARACTERISTIC
/begin CHARACTERISTIC FFTNWKW2 "Freeze Frame Tabelle: Zuordnung Nockenwelle 2 zu Kurbelwelle" VAL_BLK 0x810AB6 KwbUb 255.0 dez 0.00 255.0 NUMBER 3 FUNCTION_LIST DFPM_DNWKW IF_DATA DIM_X DIRECT 0x810AB6 /end CHARACTERISTIC
/begin CHARACTERISTIC FFTNWS "Freeze Frame Tabelle: Nockenwellensteuerung" VAL_BLK 0x810AB9 KwbUb 255.0 dez 0.00 255.0 NUMBER 3 FUNCTION_LIST DFPM_DNWS IF_DATA DIM_X DIRECT 0x810AB9 /end CHARACTERISTIC
/begin CHARACTERISTIC FFTNWS2 "Freeze Frame Tabelle: Nockenwellensteuerung Bank 2" VAL_BLK 0x810ABC KwbUb 255.0 dez 0.00 255.0 NUMBER 3 FUNCTION_LIST DFPM_DNWS IF_DATA DIM_X DIRECT 0x810ABC /end CHARACTERISTIC
/begin CHARACTERISTIC FFTNWSE "Freeze Frame Tabelle: Nockenwellensteuerungsventil Endstufe" VAL_BLK 0x810ABF KwbUb 255.0 dez 0.00 255.0 NUMBER 3 FUNCTION_LIST DFPM_DEKON IF_DATA DIM_X DIRECT 0x810ABF /end CHARACTERISTIC
/begin CHARACTERISTIC FFTNWSE2 "Freeze Frame Tabelle: Nockenwellensteuerung Endstufe 2" VAL_BLK 0x810AC2 KwbUb 255.0 dez 0.00 255.0 NUMBER 3 FUNCTION_LIST DFPM_DEKON IF_DATA DIM_X DIRECT 0x810AC2 /end CHARACTERISTIC
/begin CHARACTERISTIC FFTPH "Freeze Frame Tabelle: Phasensensor" VAL_BLK 0x810AC5 KwbUb 255.0 dez 0.00 255.0 NUMBER 3 FUNCTION_LIST DFPM_DPH IF_DATA DIM_X DIRECT 0x810AC5 /end CHARACTERISTIC
/begin CHARACTERISTIC FFTPH2 "Freeze Frame Tabelle: Phasensensor Bank 2" VAL_BLK 0x810AC8 KwbUb 255.0 dez 0.00 255.0 NUMBER 3 FUNCTION_LIST DFPM_DPH IF_DATA DIM_X DIRECT 0x810AC8 /end CHARACTERISTIC
/begin CHARACTERISTIC FFTRKAT "Freeze Frame Tabelle: RKAT Gemischadaption" VAL_BLK 0x810ACB KwbUb 255.0 dez 0.00 255.0 NUMBER 3 FUNCTION_LIST DFPM_DKVS IF_DATA DIM_X DIRECT 0x810ACB /end CHARACTERISTIC
/begin CHARACTERISTIC FFTRKAT2 "Freeze Frame Tabelle: RKAT Gemischadaption Bank 2" VAL_BLK 0x810ACE KwbUb 255.0 dez 0.00 255.0 NUMBER 3 FUNCTION_LIST DFPM_DKVS IF_DATA DIM_X DIRECT 0x810ACE /end CHARACTERISTIC
/begin CHARACTERISTIC FFTRKAZ "Freeze Frame Tabelle: RKAZ Gemischadaption" VAL_BLK 0x810AD1 KwbUb 255.0 dez 0.00 255.0 NUMBER 3 FUNCTION_LIST DFPM_DKVS IF_DATA DIM_X DIRECT 0x810AD1 /end CHARACTERISTIC
/begin CHARACTERISTIC FFTRKAZ2 "Freeze Frame Tabelle: RKAZ Gemischadaption Bank 2" VAL_BLK 0x810AD4 KwbUb 255.0 dez 0.00 255.0 NUMBER 3 FUNCTION_LIST DFPM_DKVS IF_DATA DIM_X DIRECT 0x810AD4 /end CHARACTERISTIC
/begin CHARACTERISTIC FFTSGEEP "Freeze Frame Tabelle: SG defekt (EEPROM)" VAL_BLK 0x810AD7 KwbUb 255.0 dez 0.00 255.0 NUMBER 3 FUNCTION_LIST DFPM_DSGEEP IF_DATA DIM_X DIRECT 0x810AD7 /end CHARACTERISTIC
/begin CHARACTERISTIC FFTSLPE "Freeze Frame Tabelle: Sekundärluftpumpe Endstufe" VAL_BLK 0x810ADA KwbUb 255.0 dez 0.00 255.0 NUMBER 3 FUNCTION_LIST DFPM_DEKON IF_DATA DIM_X DIRECT 0x810ADA /end CHARACTERISTIC
/begin CHARACTERISTIC FFTSLS "Freeze Frame Tabelle: Sekundärluftsystem" VAL_BLK 0x810ADD KwbUb 255.0 dez 0.00 255.0 NUMBER 3 FUNCTION_LIST DFPM_DSLSLRS IF_DATA DIM_X DIRECT 0x810ADD /end CHARACTERISTIC
/begin CHARACTERISTIC FFTSLS2 "Freeze Frame Tabelle: Sekundärluftsystem, Bank 2" VAL_BLK 0x810AE0 KwbUb 255.0 dez 0.00 255.0 NUMBER 3 FUNCTION_LIST DFPM_DSLSLRS IF_DATA DIM_X DIRECT 0x810AE0 /end CHARACTERISTIC
/begin CHARACTERISTIC FFTSLV "Freeze Frame Tabelle: Dichtheit Sekundärluftventil" VAL_BLK 0x810AE3 KwbUb 255.0 dez 0.00 255.0 NUMBER 3 FUNCTION_LIST DFPM_DSLSLRS IF_DATA DIM_X DIRECT 0x810AE3 /end CHARACTERISTIC
/begin CHARACTERISTIC FFTSLV2 "Freeze Frame Tabelle: Dichtheit Sekundärluftventil, Bank 2" VAL_BLK 0x810AE6 KwbUb 255.0 dez 0.00 255.0 NUMBER 3 FUNCTION_LIST DFPM_DSLSLRS IF_DATA DIM_X DIRECT 0x810AE6 /end CHARACTERISTIC
/begin CHARACTERISTIC FFTSLVE "Freeze Frame Tabelle: Sekundärluftventil Endstufe" VAL_BLK 0x810AE9 KwbUb 255.0 dez 0.00 255.0 NUMBER 3 FUNCTION_LIST DFPM_DEKON IF_DATA DIM_X DIRECT 0x810AE9 /end CHARACTERISTIC
/begin CHARACTERISTIC FFTSWE "Freeze Frame Tabelle: Beschleunigungssensor Schlechtwegeerk." VAL_BLK 0x810AEC KwbUb 255.0 dez 0.00 255.0 NUMBER 3 FUNCTION_LIST DFPM_BGRBS IF_DATA DIM_X DIRECT 0x810AEC /end CHARACTERISTIC
/begin CHARACTERISTIC FFTTA "Freeze Frame Tabelle: Ansauglufttemperatur TANS (/Ladeluft-)" VAL_BLK 0x810AEF KwbUb 255.0 dez 0.00 255.0 NUMBER 3 FUNCTION_LIST DFPM_GGTFA IF_DATA DIM_X DIRECT 0x810AEF /end CHARACTERISTIC
/begin CHARACTERISTIC FFTTES "Freeze Frame Tabelle: Tankentlüftungsventil" VAL_BLK 0x810AF2 KwbUb 255.0 dez 0.00 255.0 NUMBER 3 FUNCTION_LIST DFPM_DTEV IF_DATA DIM_X DIRECT 0x810AF2 /end CHARACTERISTIC
/begin CHARACTERISTIC FFTTEVE "Freeze Frame Tabelle: Tankentlüftungsventil Endstufe" VAL_BLK 0x810AF5 KwbUb 255.0 dez 0.00 255.0 NUMBER 3 FUNCTION_LIST DFPM_DEKON IF_DATA DIM_X DIRECT 0x810AF5 /end CHARACTERISTIC
/begin CHARACTERISTIC FFTTEVE2 "Freeze Frame Tabelle: Tankentlüftungsventil" VAL_BLK 0x810AF8 KwbUb 255.0 dez 0.00 255.0 NUMBER 3 FUNCTION_LIST DFPM_DUMMY043 IF_DATA DIM_X DIRECT 0x810AF8 /end CHARACTERISTIC
/begin CHARACTERISTIC FFTTGET "Freeze Frame Tabelle: Getriebetemperatur TGET" VAL_BLK 0x810AFB KwbUb 255.0 dez 0.00 255.0 NUMBER 3 FUNCTION_LIST DFPM_GGTGET IF_DATA DIM_X DIRECT 0x810AFB /end CHARACTERISTIC
/begin CHARACTERISTIC FFTTHM "Freeze Frame Tabelle: Thermostat-Diagnose THM" VAL_BLK 0x810AFE KwbUb 255.0 dez 0.00 255.0 NUMBER 3 FUNCTION_LIST DFPM_GGTFM IF_DATA DIM_X DIRECT 0x810AFE /end CHARACTERISTIC
/begin CHARACTERISTIC FFTTM "Freeze Frame Tabelle: Motortemperatur TMOT" VAL_BLK 0x810B01 KwbUb 255.0 dez 0.00 255.0 NUMBER 3 FUNCTION_LIST DFPM_GGTFM IF_DATA DIM_X DIRECT 0x810B01 /end CHARACTERISTIC
/begin CHARACTERISTIC FFTTMKI "Freeze Frame Tabelle: Motortemperatur aus Kombiinstrument TMKI" VAL_BLK 0x810B04 KwbUb 255.0 dez 0.00 255.0 NUMBER 3 FUNCTION_LIST DFPM_DUMMY043 IF_DATA DIM_X DIRECT 0x810B04 /end CHARACTERISTIC
/begin CHARACTERISTIC FFTTMR "Freeze Frame Tabelle: MotorraumTtemperatur TMR" VAL_BLK 0x810B07 KwbUb 255.0 dez 0.00 255.0 NUMBER 3 FUNCTION_LIST DFPM_GGTFMR IF_DATA DIM_X DIRECT 0x810B07 /end CHARACTERISTIC
/begin CHARACTERISTIC FFTTOL "Freeze Frame Tabelle: (Motor-) Oeltemperatur TOL" VAL_BLK 0x810B0A KwbUb 255.0 dez 0.00 255.0 NUMBER 3 FUNCTION_LIST DFPM_GGTFOL IF_DATA DIM_X DIRECT 0x810B0A /end CHARACTERISTIC
/begin CHARACTERISTIC FFTTUM "Freeze Frame Tabelle: Umgebungstemperatur TUM" VAL_BLK 0x810B0D KwbUb 255.0 dez 0.00 255.0 NUMBER 3 FUNCTION_LIST DFPM_GGTFUMG IF_DATA DIM_X DIRECT 0x810B0D /end CHARACTERISTIC
/begin CHARACTERISTIC FFTUB "Freeze Frame Tabelle: Batteriespannung UB (Bordnetz)" VAL_BLK 0x810B10 KwbUb 255.0 dez 0.00 255.0 NUMBER 3 FUNCTION_LIST DFPM_GGUB IF_DATA DIM_X DIRECT 0x810B10 /end CHARACTERISTIC
/begin CHARACTERISTIC FFTUFMV "Freeze Frame Tabelle: Funktionsüberwachung: Momentenvergleich" VAL_BLK 0x810B13 KwbUb 255.0 dez 0.00 255.0 NUMBER 3 FUNCTION_LIST DFPM_DUF IF_DATA DIM_X DIRECT 0x810B13 /end CHARACTERISTIC
/begin CHARACTERISTIC FFTUFSKA "Freeze Frame Tabelle: Funktionsüberwachung: Sicherheits-Kraftstoff-Abschaltung" VAL_BLK 0x810B16 KwbUb 255.0 dez 0.00 255.0 NUMBER 3 FUNCTION_LIST DFPM_DUF IF_DATA DIM_X DIRECT 0x810B16 /end CHARACTERISTIC
/begin CHARACTERISTIC FFTURRAM "Freeze Frame Tabelle: Rechnerüberwachung: RAM" VAL_BLK 0x810B19 KwbUb 255.0 dez 0.00 255.0 NUMBER 3 FUNCTION_LIST DFPM_DUR IF_DATA DIM_X DIRECT 0x810B19 /end CHARACTERISTIC
/begin CHARACTERISTIC FFTURROM "Freeze Frame Tabelle: Rechnerüberwachung: ROM" VAL_BLK 0x810B1C KwbUb 255.0 dez 0.00 255.0 NUMBER 3 FUNCTION_LIST DFPM_DUR IF_DATA DIM_X DIRECT 0x810B1C /end CHARACTERISTIC
/begin CHARACTERISTIC FFTURRST "Freeze Frame Tabelle: Rechnerüberwachung: Reset" VAL_BLK 0x810B1F KwbUb 255.0 dez 0.00 255.0 NUMBER 3 FUNCTION_LIST DFPM_DUR IF_DATA DIM_X DIRECT 0x810B1F /end CHARACTERISTIC
/begin CHARACTERISTIC FFTUVSE "Freeze Frame Tabelle:Endstufe Umluftventil Turbo" VAL_BLK 0x810B22 KwbUb 255.0 dez 0.00 255.0 NUMBER 3 FUNCTION_LIST DFPM_DEKON IF_DATA DIM_X DIRECT 0x810B22 /end CHARACTERISTIC
/begin CHARACTERISTIC FFTVFZ "Freeze Frame Tabelle: Geschwindigkeitssignal" VAL_BLK 0x810B25 KwbUb 255.0 dez 0.00 255.0 NUMBER 3 FUNCTION_LIST DFPM_DVFZ IF_DATA DIM_X DIRECT 0x810B25 /end CHARACTERISTIC
/begin CHARACTERISTIC FFTVS01 "" VAL_BLK 0x810B28 KwbUb 255.0 dez 0.00 255.0 NUMBER 3 FUNCTION_LIST DFPM_DVS IF_DATA DIM_X DIRECT 0x810B28 /end CHARACTERISTIC
/begin CHARACTERISTIC FFTVS02 "" VAL_BLK 0x810B2B KwbUb 255.0 dez 0.00 255.0 NUMBER 3 FUNCTION_LIST DFPM_DVS IF_DATA DIM_X DIRECT 0x810B2B /end CHARACTERISTIC
/begin CHARACTERISTIC FFTVS03 "" VAL_BLK 0x810B2E KwbUb 255.0 dez 0.00 255.0 NUMBER 3 FUNCTION_LIST DFPM_DVS IF_DATA DIM_X DIRECT 0x810B2E /end CHARACTERISTIC
/begin CHARACTERISTIC FFTVS04 "" VAL_BLK 0x810B31 KwbUb 255.0 dez 0.00 255.0 NUMBER 3 FUNCTION_LIST DFPM_DVS IF_DATA DIM_X DIRECT 0x810B31 /end CHARACTERISTIC
/begin CHARACTERISTIC FFTVS05 "" VAL_BLK 0x810B34 KwbUb 255.0 dez 0.00 255.0 NUMBER 3 FUNCTION_LIST DFPM_DVS IF_DATA DIM_X DIRECT 0x810B34 /end CHARACTERISTIC
/begin CHARACTERISTIC FFTVS06 "" VAL_BLK 0x810B37 KwbUb 255.0 dez 0.00 255.0 NUMBER 3 FUNCTION_LIST DFPM_DVS IF_DATA DIM_X DIRECT 0x810B37 /end CHARACTERISTIC
/begin CHARACTERISTIC FFTVS1E "Freeze Frame Tabelle: Ventilhub1 (Endstufe)" VAL_BLK 0x810B3A KwbUb 255.0 dez 0.00 255.0 NUMBER 3 FUNCTION_LIST DFPM_DEKON IF_DATA DIM_X DIRECT 0x810B3A /end CHARACTERISTIC
/begin CHARACTERISTIC FFTVS2E "Freeze Frame Tabelle: Ventilhub2 (Endstufe)" VAL_BLK 0x810B3D KwbUb 255.0 dez 0.00 255.0 NUMBER 3 FUNCTION_LIST DFPM_DEKON IF_DATA DIM_X DIRECT 0x810B3D /end CHARACTERISTIC
/begin CHARACTERISTIC FFTVSB1 "" VAL_BLK 0x810B40 KwbUb 255.0 dez 0.00 255.0 NUMBER 3 FUNCTION_LIST DFPM_DVS IF_DATA DIM_X DIRECT 0x810B40 /end CHARACTERISTIC
/begin CHARACTERISTIC FFTVSB2 "" VAL_BLK 0x810B43 KwbUb 255.0 dez 0.00 255.0 NUMBER 3 FUNCTION_LIST DFPM_DVS IF_DATA DIM_X DIRECT 0x810B43 /end CHARACTERISTIC
/begin CHARACTERISTIC FFTVSS "" VAL_BLK 0x810B46 KwbUb 255.0 dez 0.00 255.0 NUMBER 3 FUNCTION_LIST DFPM_DVS IF_DATA DIM_X DIRECT 0x810B46 /end CHARACTERISTIC
/begin CHARACTERISTIC FFTWFS "Freeze Frame Tabelle: Wegfahrsperre" VAL_BLK 0x810B49 KwbUb 255.0 dez 0.00 255.0 NUMBER 3 FUNCTION_LIST DFPM_WFS IF_DATA DIM_X DIRECT 0x810B49 /end CHARACTERISTIC
/begin CHARACTERISTIC FFTZZZ "Dummy: Tabellenende" VAL_BLK 0x810B4C KwbUb 255.0 dez 0.00 255.0 NUMBER 3 FUNCTION_LIST DFPM_DFPM IF_DATA DIM_X DIRECT 0x810B4C /end CHARACTERISTIC
/begin CHARACTERISTIC FHDLLR "Höhenschwelle für Durchführung Diagnose Leerlaufsteller" VALUE 0x8196E1 KwUb 3.984 fak_ub_b4 0.00 3.984 FUNCTION_LIST DLLR IF_DATA DIM_X DIRECT 0x8196E1 /end CHARACTERISTIC
/begin CHARACTERISTIC FHODSL "minimaler Höhenfaktor für DSLS" VALUE 0x81A00C KwUw 3.999939 fak_uw_b4 0.00 3.999939 FUNCTION_LIST DSLSLRS T2DFA T2LID IF_DATA DIM_X DIRECT 0x81A00C /end CHARACTERISTIC
/begin CHARACTERISTIC FHODTEA "untere Höhenschwelle für DTEV aktiv" VALUE 0x81E306 KwUw 0.5999756 fak_uw_b4 0.2000122 0.7999878 FUNCTION_LIST DTEV T2DFA T2LID IF_DATA DIM_X DIRECT 0x81E306 /end CHARACTERISTIC
/begin CHARACTERISTIC FHOE "Ersatzwert für Höhe" VALUE 0x8184DD KwUb 3.984 fak_ub_b4 0.00 3.984 FUNCTION_LIST GGDSAS IF_DATA DIM_X DIRECT 0x8184DD /end CHARACTERISTIC
/begin CHARACTERISTIC FHOKH "minimaler Höhenfaktor für Katheizen" VALUE 0x81CFA2 KwUw 3.999939 fak_uw_b4 0.00 3.999939 FUNCTION_LIST BBKHZ IF_DATA DIM_X DIRECT 0x81CFA2 /end CHARACTERISTIC
/begin CHARACTERISTIC FHSTT "Faktor Heißstart" CURVE 0x81124D KlAUbSstUbWUb 63.75 fak_ub_b64 0.00 63.75 FUNCTION_LIST ESSTT IF_DATA DIM_X DIRECT 0x81124D
 /begin AXIS_DESCR STD_AXIS tans temp_ub_q0p75_o48 6 -48.00 143.3 DEPOSIT ABSOLUT /end AXIS_DESCR
/end CHARACTERISTIC
/begin CHARACTERISTIC FIAMALU "Anhebungsfaktor für Filter Mehrfachaussetzererkennung" VALUE 0x8105A3 KwUb 3.984 fak_ub_b4 0.00 3.984 FUNCTION_LIST DMDLU IF_DATA DIM_X DIRECT 0x8105A3 /end CHARACTERISTIC
/begin CHARACTERISTIC FIBSALU "Filterfaktor Beschleunigungssignal bei Schlechtwegstrecken-Erkennung" VALUE 0x8121CC KwUb 0.9961 fak_ub_b1 0.00 0.9961 FUNCTION_LIST DSWEC IF_DATA DIM_X DIRECT 0x8121CC /end CHARACTERISTIC
/begin CHARACTERISTIC FIMALU "Filterfaktor Mehrfachaussetzererkennung" VALUE 0x8105A4 KwUb 0.9961 fak_ub_b1 0.00 0.9961 FUNCTION_LIST DMDLU IF_DATA DIM_X DIRECT 0x8105A4 /end CHARACTERISTIC
/begin CHARACTERISTIC FIMHU "Faktor Impuls hart" CURVE 0x81135F FklWUb 1.992 fak_ub_b2 0.00 1.992 FUNCTION_LIST ESWE IF_DATA DIM_X DIRECT 0x81135F /begin AXIS_DESCR FIX_AXIS anzwefim dez 16 0.00 15.00 FIX_AXIS_PAR 0 0 16 /end AXIS_DESCR /end CHARACTERISTIC
/begin CHARACTERISTIC FIMWU "Faktor Impuls weich" CURVE 0x81136F FklWUb 1.992 fak_ub_b2 0.00 1.992 FUNCTION_LIST ESWE IF_DATA DIM_X DIRECT 0x81136F /begin AXIS_DESCR FIX_AXIS anzwefim dez 16 0.00 15.00 FIX_AXIS_PAR 0 0 16 /end AXIS_DESCR /end CHARACTERISTIC
/begin CHARACTERISTIC FIRNLIGN "Mindestwert für Winkelfehler nach der ersten Zündung" VALUE 0x810C08 KwUb 255.0 kw_q1 0.00 255.0 FUNCTION_LIST NLDG IF_DATA DIM_X DIRECT 0x810C08 /end CHARACTERISTIC
/begin CHARACTERISTIC FKADPMN "miminaler Kraftstoffanteil über TEV für passive i.O. Prüfung." VALUE 0x819B3C KwSb 0.6953 fak_sb_b1 0.1016 0.7969 FUNCTION_LIST DTEV IF_DATA DIM_X DIRECT 0x819B3C /end CHARACTERISTIC
/begin CHARACTERISTIC FKATEB "Kennlinie Kraftstoffanteil Tankentlüftung abh. von te / TEMIN" CURVE 0x81E268 KlAUbSstUbWUb 0.9961 fak_ub_b1 0.00 0.9961 FUNCTION_LIST TEB IF_DATA DIM_X DIRECT 0x81E268 /begin AXIS_DESCR STD_AXIS qtetemin fak_ub_b4 5 0.00 3.984 DEPOSIT ABSOLUT /end AXIS_DESCR /end CHARACTERISTIC
/begin CHARACTERISTIC FKELDY "Korrekturfaktor für Klopferkennungsschwelle bei Lastdynamik" VALUE 0x811493 KwUb 2.000 fak_ub_b16 0.00 2.000 FUNCTION_LIST KRKE IF_DATA DIM_X DIRECT 0x811493 /end CHARACTERISTIC
/begin CHARACTERISTIC FKELDYA "Korrekturfaktor für Klopferkennungsschwelle bei Lastdynamikadaption" VALUE 0x811490 KwUb 0.6250 fak_ub_b16 0.6250 1.250 FUNCTION_LIST KRDY IF_DATA DIM_X DIRECT 0x811490 /end CHARACTERISTIC
/begin CHARACTERISTIC FKENDY "Korrekturfaktor für Klopferkennungsschwelle bei Drehzahldynamik" VALUE 0x811494 KwUb 2.000 fak_ub_b16 0.00 2.000 FUNCTION_LIST KRKE IF_DATA DIM_X DIRECT 0x811494 /end CHARACTERISTIC
/begin CHARACTERISTIC FKHABMN "Schwelle Abregelfaktor Katheizen" VALUE 0x819109 KwUb 0.9961 fak_ub_b1 0.00 0.9961 FUNCTION_LIST BBKHZ IF_DATA DIM_X DIRECT 0x819109 /end CHARACTERISTIC
/begin CHARACTERISTIC FKHLA "Wichtungsfaktor Lambda-Soll für Katheizen" CURVE 0x81CFA4 KlAUwSstUwWUw 0.9999847 fak_uw_b1 0.00 0.9999847 FUNCTION_LIST BBKHZ IF_DATA DIM_X DIRECT 0x81CFA4
 /begin AXIS_DESCR STD_AXIS imlpr_w fak_uw_b1 8 0.00 0.9999847 DEPOSIT ABSOLUT /end AXIS_DESCR
/end CHARACTERISTIC
/begin CHARACTERISTIC FKHMD "Wichtungsfaktor Drehmomentreserve für Katheizen" CURVE 0x81CFC6 KlAUwSstUwWUw 0.9999847 fak_uw_b1 0.00 0.9999847 FUNCTION_LIST BBKHZ IF_DATA DIM_X DIRECT 0x81CFC6
 /begin AXIS_DESCR STD_AXIS imlpr_w fak_uw_b1 8 0.00 0.9999847 DEPOSIT ABSOLUT /end AXIS_DESCR
/end CHARACTERISTIC
/begin CHARACTERISTIC FKKVS "Korrekturfaktor Kraftstoffversorgungssystem" MAP 0x81C9BC KfAxUbAyUbSstxUbSstyUwWUw 1.999969 fak_uw_b2 0.00 1.999969 FUNCTION_LIST RKTI IF_DATA DIM_X DIRECT 0x81C9BC /begin AXIS_DESCR STD_AXIS nmot nmot_ub_q40 16 0.00 10200. DEPOSIT ABSOLUT /end AXIS_DESCR
 /begin AXIS_DESCR STD_AXIS tevfa_w_kge tinjection_sy 16 0.00 174.7600 DEPOSIT ABSOLUT /end AXIS_DESCR
/end CHARACTERISTIC
/begin CHARACTERISTIC FKKVSNW "Korrekturfaktor Kraftstoffversogungssystem bei geschalteter Nockernwelle" MAP 0x81CBEE KfAxUbAyUbSstxUbSstyUwWUw 1.999969 fak_uw_b2 0.00 1.999969 FUNCTION_LIST RKTI IF_DATA DIM_X DIRECT 0x81CBEE /begin AXIS_DESCR STD_AXIS nmot nmot_ub_q40 16 0.00 10200. DEPOSIT ABSOLUT /end AXIS_DESCR
 /begin AXIS_DESCR STD_AXIS tevfa_w_kge tinjection_sy 16 0.00 174.7600 DEPOSIT ABSOLUT /end AXIS_DESCR
/end CHARACTERISTIC
/begin CHARACTERISTIC FKMSDKMN "min.Korrekturfaktor schneller Massenstromabgleich" VALUE 0x8184CB KwUb 3.984 fak_ub_b4 0.00 3.984 FUNCTION_LIST BGMSZS IF_DATA DIM_X DIRECT 0x8184CB /end CHARACTERISTIC
/begin CHARACTERISTIC FKMSDKMX "max.Korrekturfaktor schneller Massenstromabgleich" VALUE 0x8184CC KwUb 3.984 fak_ub_b4 0.00 3.984 FUNCTION_LIST BGMSZS IF_DATA DIM_X DIRECT 0x8184CC /end CHARACTERISTIC
/begin CHARACTERISTIC FKMSHFM "Faktor Korektur für MIN-Auswahl mit mshfm" VALUE 0x810F5B KwUb 0.9961 fak_ub_b1 0.00 0.9961 FUNCTION_LIST GGHFM IF_DATA DIM_X DIRECT 0x810F5B /end CHARACTERISTIC
/begin CHARACTERISTIC FKPVDKMN "Minimaler Korrekturfaktor langsamer Massenstomabgleich" VALUE 0x8184CD KwUb 3.984 fak_ub_b4 0.00 3.984 FUNCTION_LIST BGMSZS IF_DATA DIM_X DIRECT 0x8184CD /end CHARACTERISTIC
/begin CHARACTERISTIC FKPVDKMX "Maximaler Korrekturfaktor langsamer Massenstomabgleich" VALUE 0x8184CE KwUb 3.984 fak_ub_b4 0.00 3.984 FUNCTION_LIST BGMSZS IF_DATA DIM_X DIRECT 0x8184CE /end CHARACTERISTIC
/begin CHARACTERISTIC FKRXTM "Faktor zur Korrektur von rlmax bei hoher Motortemperatur" CURVE 0x819440 KlAUbSstUbWUb 1.992 fak_ub_b2 0.00 1.992 FUNCTION_LIST LDRLMX IF_DATA DIM_X DIRECT 0x819440
 /begin AXIS_DESCR STD_AXIS tmot temp_ub_q0p75_o48 4 -48.00 143.3 DEPOSIT ABSOLUT /end AXIS_DESCR
/end CHARACTERISTIC
/begin CHARACTERISTIC FKSTT "Faktor Kaltstart" CURVE 0x81125A KlAUbSstUbWUb 63.75 fak_ub_b64 0.00 63.75 FUNCTION_LIST ESSTT IF_DATA DIM_X DIRECT 0x81125A
 /begin AXIS_DESCR STD_AXIS tmst temp_ub_q0p75_o48 12 -48.00 143.3 DEPOSIT ABSOLUT /end AXIS_DESCR
/end CHARACTERISTIC
/begin CHARACTERISTIC FKUKAO "Obergrenze Korrekturfaktor in UK-Adaption" VALUE 0x811337 KwUb 3.984 fak_ub_b4 0.00 3.984 FUNCTION_LIST ESUKAS IF_DATA DIM_X DIRECT 0x811337 /end CHARACTERISTIC
/begin CHARACTERISTIC FKUKAU "Untergrenze Korrekturfaktor in UK-Adaption" VALUE 0x811338 KwUb 3.875 fak_ub_b4 0.1094 3.984 FUNCTION_LIST ESUKAS IF_DATA DIM_X DIRECT 0x811338 /end CHARACTERISTIC
/begin CHARACTERISTIC FKVAUM "Umrechnungsfaktor Einspritzzeit in Kraftstoffverbrauch" VALUE 0x817A52 KwUw 312.5000 tefuel_uw_b312p5 0.00 312.5000 FUNCTION_LIST KVA IF_DATA DIM_X DIRECT 0x817A52 /end CHARACTERISTIC
/begin CHARACTERISTIC FLAMPA "Druck-Korrekturfaktor für Lambda" CURVE 0x813C30 KlAUwSstUwWUw 1.999969 fak_uw_b2 0.00 1.999969 FUNCTION_LIST GGLSU IF_DATA DIM_X DIRECT 0x813C30
 /begin AXIS_DESCR STD_AXIS palsu_w p_uw_q0p039 10 0.00 2559.961 DEPOSIT ABSOLUT /end AXIS_DESCR
/end CHARACTERISTIC
/begin CHARACTERISTIC FLAMPA2 "Druck-Korrekturfaktor für Lambda 2" CURVE 0x813C5A KlAUwSstUwWUw 1.999969 fak_uw_b2 0.00 1.999969 FUNCTION_LIST GGLSU IF_DATA DIM_X DIRECT 0x813C5A
 /begin AXIS_DESCR STD_AXIS palsu2_w p_uw_q0p039 10 0.00 2559.961 DEPOSIT ABSOLUT /end AXIS_DESCR
/end CHARACTERISTIC
/begin CHARACTERISTIC FLAMSBA "Faktor Lambdasoll bei Beschleunigungsanreicherung" VALUE 0x813FDA KwUw 15.99976 fak_uw_b16 0.00 15.99976 FUNCTION_LIST ESUKAS IF_DATA DIM_X DIRECT 0x813FDA /end CHARACTERISTIC
/begin CHARACTERISTIC FLAMSVA "Faktor Lambdasoll bei Verzögerungsabmagerung" VALUE 0x813FDC KwUw 15.99976 fak_uw_b16 0.00 15.99976 FUNCTION_LIST ESUKAS IF_DATA DIM_X DIRECT 0x813FDC /end CHARACTERISTIC
/begin CHARACTERISTIC FLFO "Filterfaktor Lernfilter der fuel-on/-off Adaption" VALUE 0x813848 KwSw 1.999969 fak_uw_b2 -1.000000 0.9999695 FUNCTION_LIST DMDFON IF_DATA DIM_X DIRECT 0x813848 /end CHARACTERISTIC
/begin CHARACTERISTIC FLMLKAMA "Faktor zur Bewertung Schwellwert integr. Fettfl. f. Abbruch Kat-Ausr. Pre/Main" VALUE 0x811FE9 KwUb 7.969 fak_ub_b8 0.00 7.969 FUNCTION_LIST LRSKA IF_DATA DIM_X DIRECT 0x811FE9 /end CHARACTERISTIC
/begin CHARACTERISTIC FLMLKAMA2 "Fakt. zur Bewert. Schwellw. integr. Fettfl. f. Abbruch Kat-Ausr. Pre/Main, Bank2" VALUE 0x811FEA KwUb 7.969 fak_ub_b8 0.00 7.969 FUNCTION_LIST LRSKA IF_DATA DIM_X DIRECT 0x811FEA /end CHARACTERISTIC
/begin CHARACTERISTIC FLRAG "Verstärkung Lastregler bei AT" CURVE 0x815F96 FklWUb 15.94 fak_ub_b16 0.00 15.94 FUNCTION_LIST ARMD IF_DATA DIM_X DIRECT 0x815F96 /begin AXIS_DESCR FIX_AXIS gangi dez 6 1.000 6.000 FIX_AXIS_PAR 1 0 6 /end AXIS_DESCR /end CHARACTERISTIC
/begin CHARACTERISTIC FLRAWG "Verstärkung Lastregler bei AT, WK geschlossen" CURVE 0x815F9C FklWUb 15.94 fak_ub_b16 0.00 15.94 FUNCTION_LIST ARMD IF_DATA DIM_X DIRECT 0x815F9C /begin AXIS_DESCR FIX_AXIS gangi dez 6 1.000 6.000 FIX_AXIS_PAR 1 0 6 /end AXIS_DESCR /end CHARACTERISTIC
/begin CHARACTERISTIC FLRHG "Verstärkung Lastregler" CURVE 0x815FA2 FklWUb 15.94 fak_ub_b16 0.00 15.94 FUNCTION_LIST ARMD IF_DATA DIM_X DIRECT 0x815FA2 /begin AXIS_DESCR FIX_AXIS gangi dez 6 1.000 6.000 FIX_AXIS_PAR 1 0 6 /end AXIS_DESCR /end CHARACTERISTIC
/begin CHARACTERISTIC FLRSG2K "Korrekturfaktor für Reglerparameter G2 bei temperaturabhängiger Reglereinstellug" VALUE 0x8198DC KwUb 1.992 fak_ub_b2 0.00 1.992 FUNCTION_LIST LRS IF_DATA DIM_X DIRECT 0x8198DC /end CHARACTERISTIC
/begin CHARACTERISTIC FLSUIP "Faktor für Umrechnung Spannung in Pumpstrom" VALUE 0x813C84 KwUw 204.7969 leit_q3p125Em6 0.00 204.7969 FUNCTION_LIST GGLSU IF_DATA DIM_X DIRECT 0x813C84 /end CHARACTERISTIC
/begin CHARACTERISTIC FLTEFUEL "Faktor Anteil TEV Strom, der direkt ins Saugrohr strömt" CURVE 0x8199E5 KlAUbSstUbWUb 0.9961 fak_ub_b1 0.00 0.9961 FUNCTION_LIST BGTEV IF_DATA DIM_X DIRECT 0x8199E5 /begin AXIS_DESCR STD_AXIS qltefil fak_ub_b1 4 0.00 0.9961 DEPOSIT ABSOLUT /end AXIS_DESCR /end CHARACTERISTIC
/begin CHARACTERISTIC FLUTN "Filterfaktor Laufunruhe-Filter" CURVE 0x8102B6 GklWUb 0.9961 fak_ub_b1 0.00 0.9961 FUNCTION_LIST DMDLUA IF_DATA DIM_X DIRECT 0x8102B6
 /begin AXIS_DESCR COM_AXIS nmot nmot_ub_q40 8 0.00 10200. AXIS_PTS_REF SNM08DMUB /end AXIS_DESCR
/end CHARACTERISTIC
/begin CHARACTERISTIC FLUV1 "Schalter der Modifikation 1 der Laufunruhe-Berechnung" VALUE 0x8105A5 KwUb 255.0 dez 0.00 255.0 FUNCTION_LIST DMDLU IF_DATA DIM_X DIRECT 0x8105A5 /end CHARACTERISTIC
/begin CHARACTERISTIC FLUV2 "Schalter der Modifikation 2 der Laufunruhe-Berechnung" VALUE 0x8105A6 KwUb 255.0 dez 0.00 255.0 FUNCTION_LIST DMDLU IF_DATA DIM_X DIRECT 0x8105A6 /end CHARACTERISTIC
/begin CHARACTERISTIC FMDKHFH "Höhenkorrektur Drehmomentenreserve für Katheizen" CURVE 0x81CFEE KlAUwSstUwWUw 1.999969 fak_uw_b2 0.00 1.999969 FUNCTION_LIST KHMD IF_DATA DIM_X DIRECT 0x81CFEE /begin AXIS_DESCR STD_AXIS fho_w fak_uw_b4 4 0.00 3.999939 DEPOSIT ABSOLUT /end AXIS_DESCR /end CHARACTERISTIC
/begin CHARACTERISTIC FMDKHTMST "tmst-Korrektur Drehmomentenresrve für Katheizen" CURVE 0x81913E KlAUbSstUbWUb 1.992 fak_ub_b2 0.00 1.992 FUNCTION_LIST KHMD IF_DATA DIM_X DIRECT 0x81913E
 /begin AXIS_DESCR STD_AXIS tmst temp_ub_q0p75_o48 8 -48.00 143.3 DEPOSIT ABSOLUT /end AXIS_DESCR
/end CHARACTERISTIC
/begin CHARACTERISTIC FMDWAT "Faktor zur Berechnung des Wandlermoments abh. von der Öltemperatur des Wandlers" CURVE 0x8197B3 GklWUb 0.000119850000 fak_ub_q4p7Em7 0.00 0.000119850000 FUNCTION_LIST MDWAN IF_DATA DIM_X DIRECT 0x8197B3
 /begin AXIS_DESCR COM_AXIS twan_kge temp_ub_q1_o50 6 -50.00 205.0 AXIS_PTS_REF STW06MDUB /end AXIS_DESCR
/end CHARACTERISTIC
/begin CHARACTERISTIC FMFKR "Mittenfrequenz für Bandpaßfilter Klopfregelung" VALUE 0x81916E KwUb 16.00 fmfkr_dez 0.00 16.00 FUNCTION_LIST GGKS IF_DATA DIM_X DIRECT 0x81916E /end CHARACTERISTIC
/begin CHARACTERISTIC FMIKNS "Integratorsteigung Aufregelung mikscan_w auf MDIMX" VALUE 0x813738 KwUw 0.9999847 fak_uw_b1 0.00 0.9999847 FUNCTION_LIST MDEX IF_DATA DIM_X DIRECT 0x813738 /end CHARACTERISTIC
/begin CHARACTERISTIC FMIVL "Faktor Korrektur maximales Moment bei VL" VALUE 0x819809 KwUb 1.992 fak_ub_b2 0.00 1.992 FUNCTION_LIST MDMAX IF_DATA DIM_X DIRECT 0x819809 /end CHARACTERISTIC
/begin CHARACTERISTIC FMRFAZTE "Gewichtung der Drehzahl um jetzige Leistung zu berechnen" CURVE 0x8187F7 KlAUbSstUbWUb 3.984 fak_ub_b4 0.00 3.984 FUNCTION_LIST BBTEGA IF_DATA DIM_X DIRECT 0x8187F7 /begin AXIS_DESCR STD_AXIS nmot nmot_ub_q40 4 0.00 10200. DEPOSIT ABSOLUT /end AXIS_DESCR /end CHARACTERISTIC
/begin CHARACTERISTIC FMSL "Faktor Korrektur Sekundärluftmasse" VALUE 0x818136 KwUb 1.992 fak_ub_b2 0.00 1.992 FUNCTION_LIST SLS IF_DATA DIM_X DIRECT 0x818136 /end CHARACTERISTIC
/begin CHARACTERISTIC FMSL2 "Faktor Korrektur Sekundärluftmasse, Bank 2" VALUE 0x818137 KwUb 1.992 fak_ub_b2 0.00 1.992 FUNCTION_LIST SLS IF_DATA DIM_X DIRECT 0x818137 /end CHARACTERISTIC
/begin CHARACTERISTIC FMSLAMN "minimaler Adaptionsfaktor Sekundärluftmasse" VALUE 0x818100 KwUb 1.992 fak_ub_b2 0.00 1.992 FUNCTION_LIST DSLSLRS IF_DATA DIM_X DIRECT 0x818100 /end CHARACTERISTIC
/begin CHARACTERISTIC FMSLAMX "maximaler Adaptionsfaktor Sekundärluftmasse" VALUE 0x818101 KwUb 1.992 fak_ub_b2 0.00 1.992 FUNCTION_LIST DSLSLRS IF_DATA DIM_X DIRECT 0x818101 /end CHARACTERISTIC
/begin CHARACTERISTIC FMSLOFF "Schwelle Ausräumen der Sekundärluft beendet" VALUE 0x818138 KwUb 0.9961 fak_ub_b1 0.00 0.9961 FUNCTION_LIST SLS IF_DATA DIM_X DIRECT 0x818138 /end CHARACTERISTIC
/begin CHARACTERISTIC FMSML "Abgasgegendruckkorrektur der Sekundärluftmasse" CURVE 0x818139 KlAUbSstUbWUb 1.992 fak_ub_b2 0.00 1.992 FUNCTION_LIST SLS IF_DATA DIM_X DIRECT 0x818139 /begin AXIS_DESCR STD_AXIS ml m_ub_b1020 8 0.00 1020. DEPOSIT ABSOLUT /end AXIS_DESCR /end CHARACTERISTIC
/begin CHARACTERISTIC FMSRHOL "Dichtekorrektur der Sekundärluftmasse" CURVE 0x81A048 KlAUwSstUwWUw 1.999969 fak_uw_b2 0.00 1.999969 FUNCTION_LIST SLS IF_DATA DIM_X DIRECT 0x81A048 /begin AXIS_DESCR STD_AXIS frhol_w fak_uw_b2 4 0.00 1.999969 DEPOSIT ABSOLUT /end AXIS_DESCR /end CHARACTERISTIC
/begin CHARACTERISTIC FMSTMOT "tmot- Korrektur der Sekundärluftmasse" CURVE 0x81814A KlAUbSstUbWUb 1.992 fak_ub_b2 0.00 1.992 FUNCTION_LIST SLS IF_DATA DIM_X DIRECT 0x81814A
 /begin AXIS_DESCR STD_AXIS tmot temp_ub_q0p75_o48 8 -48.00 143.3 DEPOSIT ABSOLUT /end AXIS_DESCR
/end CHARACTERISTIC
/begin CHARACTERISTIC FNLMI0 "Bewertungsfaktor von tsegph(k) für gleitenden Mittelwert" VALUE 0x810C09 KwUb 7.969 fak_ub_b8 0.00 7.969 FUNCTION_LIST NLDG IF_DATA DIM_X DIRECT 0x810C09 /end CHARACTERISTIC
/begin CHARACTERISTIC FNLMI1 "Bewertungsfaktor von tsegph(k-1) für gleitenden Mittelwert" VALUE 0x810C0A KwUb 7.969 fak_ub_b8 0.00 7.969 FUNCTION_LIST NLDG IF_DATA DIM_X DIRECT 0x810C0A /end CHARACTERISTIC
/begin CHARACTERISTIC FNLMI2 "Bewertungsfaktor von tsegph(k-2) für gleitenden Mittelwert" VALUE 0x810C0B KwUb 7.969 fak_ub_b8 0.00 7.969 FUNCTION_LIST NLDG IF_DATA DIM_X DIRECT 0x810C0B /end CHARACTERISTIC
/begin CHARACTERISTIC FNRAD "Faktor zwischen Raddrehzahl und Geschwindigkeit f(Radumfang)" VALUE 0x811671 KwUb 15.94 fak_ub_b16 0.00 15.94 FUNCTION_LIST MDWAN IF_DATA DIM_X DIRECT 0x811671 /end CHARACTERISTIC
/begin CHARACTERISTIC FNSA "Nachstartanhebung" CURVE 0x818938 GklWUb 1.992 fak_ub_b2 0.00 1.992 FUNCTION_LIST ESNST IF_DATA DIM_X DIRECT 0x818938
 /begin AXIS_DESCR COM_AXIS tans temp_ub_q0p75_o48 6 -48.00 143.3 AXIS_PTS_REF STA06ESUB /end AXIS_DESCR
/end CHARACTERISTIC
/begin CHARACTERISTIC FNSHO "Wichtung Nachstartanhebung" CURVE 0x81893E KlAUbSstUbWUb 1.992 fak_ub_b2 0.00 1.992 FUNCTION_LIST ESNST IF_DATA DIM_X DIRECT 0x81893E /begin AXIS_DESCR STD_AXIS fho fak_ub_b4 4 0.00 3.984 DEPOSIT ABSOLUT /end AXIS_DESCR /end CHARACTERISTIC
/begin CHARACTERISTIC FNSNF "Faktor für Solldrehzahlnachführung" VALUE 0x8115C2 KwUb 0.9961 rel_ub_b1p0 0.00 0.9961 FUNCTION_LIST LLRNS IF_DATA DIM_X DIRECT 0x8115C2 /end CHARACTERISTIC
/begin CHARACTERISTIC FNSSM "Nachstartanhebung" CURVE 0x818947 GklWUb 1.992 fak_ub_b2 0.00 1.992 FUNCTION_LIST ESNST IF_DATA DIM_X DIRECT 0x818947
 /begin AXIS_DESCR COM_AXIS tmst temp_ub_q0p75_o48 12 -48.00 143.3 AXIS_PTS_REF STS12ESUB /end AXIS_DESCR
/end CHARACTERISTIC
/begin CHARACTERISTIC FNSSTM "Faktor zur Wichtung der Solldrehzahl im Start" CURVE 0x8196F4 KlAUbSstUbWUb 1.992 fak_ub_b2 0.00 1.992 FUNCTION_LIST LLRNS IF_DATA DIM_X DIRECT 0x8196F4
 /begin AXIS_DESCR STD_AXIS tmot temp_ub_q0p75_o48 6 -48.00 143.3 DEPOSIT ABSOLUT /end AXIS_DESCR
/end CHARACTERISTIC
/begin CHARACTERISTIC FNSTABNV "Faktor zur Drehzahlstabilisierung durch Drehmoment" CURVE 0x815A7A KlAUwSstUwWUw 7.999878 fak_uw_b8 0.00 7.999878 FUNCTION_LIST MDNSTAB IF_DATA DIM_X DIRECT 0x815A7A /begin AXIS_DESCR STD_AXIS nver_w fak_uw_b8 6 0.00 7.999878 DEPOSIT ABSOLUT /end AXIS_DESCR /end CHARACTERISTIC
/begin CHARACTERISTIC FNWSTM "Gemischkorrektur Tmot-Abhängig" CURVE 0x813FA6 KlAUbSstUbWUb 3.984 fak_ub_b4 0.00 3.984 FUNCTION_LIST ESNWS IF_DATA DIM_X DIRECT 0x813FA6
 /begin AXIS_DESCR STD_AXIS tmot temp_ub_q0p75_o48 8 -48.00 143.3 DEPOSIT ABSOLUT /end AXIS_DESCR
/end CHARACTERISTIC
/begin CHARACTERISTIC FPRAT "Ansauglufttemperaturschwelle für DV-E-Federprüfung" VALUE 0x810D31 KwUb 191.3 temp_ub_q0p75_o48 -48.00 143.3 FUNCTION_LIST BGDVE T2DVE IF_DATA DIM_X DIRECT 0x810D31 /end CHARACTERISTIC
/begin CHARACTERISTIC FPRMT "Motortemperaturschwelle für DV-E-Federprüfung" VALUE 0x810D32 KwUb 191.3 temp_ub_q0p75_o48 -48.00 143.3 FUNCTION_LIST BGDVE T2DVE IF_DATA DIM_X DIRECT 0x810D32 /end CHARACTERISTIC
/begin CHARACTERISTIC FPRNMAX "Motordrehzahlschwelle für DV-E-Federprüfung" VALUE 0x810D33 KwUb 2550. nmot_ub_q10 0.00 2550. FUNCTION_LIST BGDVE T2DVE IF_DATA DIM_X DIRECT 0x810D33 /end CHARACTERISTIC
/begin CHARACTERISTIC FPRTIM1_T "DV-E-Federprüfung, Wartezeit in Prüfschritt 1" VALUE 0x810D34 KwUb 2.540 t10msxs_ub_b2p55 0.01000 2.550 FUNCTION_LIST BGDVE IF_DATA DIM_X DIRECT 0x810D34 /end CHARACTERISTIC
/begin CHARACTERISTIC FPRTIM2_T "DV-E-Federprüfung, Wartezeit in Prüfschritt 2" VALUE 0x810D35 KwUb 2.540 t10msxs_ub_b2p55 0.01000 2.550 FUNCTION_LIST BGDVE IF_DATA DIM_X DIRECT 0x810D35 /end CHARACTERISTIC
/begin CHARACTERISTIC FPRTIM3_T "DV-E-Federprüfung: Wartezeit in Prüfschritt 5" VALUE 0x810D36 KwUb 2.540 t10msxs_ub_b2p55 0.01000 2.550 FUNCTION_LIST BGDVE IF_DATA DIM_X DIRECT 0x810D36 /end CHARACTERISTIC
/begin CHARACTERISTIC FPRTIM4_T "DV-E-Federprüfung: Wartezeit in Prüfschritt 6" VALUE 0x810D37 KwUb 2.540 t10msxs_ub_b2p55 0.01000 2.550 FUNCTION_LIST BGDVE IF_DATA DIM_X DIRECT 0x810D37 /end CHARACTERISTIC
/begin CHARACTERISTIC FPVMXN2 "Faktor maximales Druckverhältnis mit Nebenlastsignal" CURVE 0x81C000 KlAUwSstUwWUw 1.999969 fak_uw_b2 0.00 1.999969 FUNCTION_LIST BGSRM IF_DATA DIM_X DIRECT 0x81C000
 /begin AXIS_DESCR STD_AXIS nmot_w nmot_uw_q0p25 6 0.00 16383.75 DEPOSIT ABSOLUT /end AXIS_DESCR
/end CHARACTERISTIC
/begin CHARACTERISTIC FPVMXP "Faktor maximales Druckverhältnis fuer Lastpraediktion" VALUE 0x813FA0 KwUw 1.999969 fak_uw_b2 0.00 1.999969 FUNCTION_LIST BGRLP IF_DATA DIM_X DIRECT 0x813FA0 /end CHARACTERISTIC
/begin CHARACTERISTIC FPWDKAPP "Drosselklappenkennlinie abh. von Fahrpedal nur f. Applik." CURVE 0x81523A KlAUwSstUwWUw 99.99847 rel_uw_b100 0.00 99.99847 FUNCTION_LIST FUEDK IF_DATA DIM_X DIRECT 0x81523A
 /begin AXIS_DESCR STD_AXIS wped_w relPED_uw_b100 16 0.00 100.0000 DEPOSIT ABSOLUT /end AXIS_DESCR
/end CHARACTERISTIC
/begin CHARACTERISTIC FQTEDL "Kennlinie Faktor für exponentielle Absteuerung Spülrate" CURVE 0x819A14 KlAUbSstUbWUb 1.992 fak_ub_b2 0.00 1.992 FUNCTION_LIST TEB IF_DATA DIM_X DIRECT 0x819A14 /begin AXIS_DESCR STD_AXIS dmlftef fak_ub_b0p5 5 0.00 0.4980 DEPOSIT ABSOLUT /end AXIS_DESCR /end CHARACTERISTIC
/begin CHARACTERISTIC FQTEFR "Kennlinie stetige Grenzwertregelung (fr)" CURVE 0x81E274 KlAUbSstUbWSb 15.88 fak_sb_b16 0.00 15.88 FUNCTION_LIST TEB IF_DATA DIM_X DIRECT 0x81E274 /begin AXIS_DESCR STD_AXIS frmxa fak_ub_b2 8 0.00 1.992 DEPOSIT ABSOLUT /end AXIS_DESCR /end CHARACTERISTIC
/begin CHARACTERISTIC FQTEPT "Kennlinie Tankunterdruckbegrenzung (pte)" CURVE 0x81E286 KlAUbSstSbWSb 15.88 fak_sb_b16 0.00 15.88 FUNCTION_LIST TEB IF_DATA DIM_X DIRECT 0x81E286 /begin AXIS_DESCR STD_AXIS pte p_sb_q0p25 6 -32.00 31.75 DEPOSIT ABSOLUT /end AXIS_DESCR /end CHARACTERISTIC
/begin CHARACTERISTIC FQTEVA "Progression bei Spülratenaufsteuerung" CURVE 0x819A1F KlAUbSstUbWUb 15.94 fak_ub_b16 0.00 15.94 FUNCTION_LIST TEB IF_DATA DIM_X DIRECT 0x819A1F /begin AXIS_DESCR STD_AXIS ftefva fak_ub_b0p5 6 0.00 0.4980 DEPOSIT ABSOLUT /end AXIS_DESCR /end CHARACTERISTIC
/begin CHARACTERISTIC FRAE "Delta-fra-Schwelle für Erkennung der eingeschwungenen Grundadaption" VALUE 0x81C790 KwUw 1.999969 fak_uw_b2 0.00 1.999969 FUNCTION_LIST DKVS IF_DATA DIM_X DIRECT 0x81C790 /end CHARACTERISTIC
/begin CHARACTERISTIC FRAODN "untere Diagnoseschwelle des Korrekturfaktors frao" VALUE 0x81C792 KwUw 1.999969 fak_uw_b2 0.00 1.999969 FUNCTION_LIST DKVS IF_DATA DIM_X DIRECT 0x81C792 /end CHARACTERISTIC
/begin CHARACTERISTIC FRAODX "obere Diagnoseschwelle des Korrekturfaktors frao" VALUE 0x81C794 KwUw 1.999969 fak_uw_b2 0.00 1.999969 FUNCTION_LIST DKVS IF_DATA DIM_X DIRECT 0x81C794 /end CHARACTERISTIC
/begin CHARACTERISTIC FRAOMN "untere Begrenzung des Korrekturfaktors frao" VALUE 0x818F97 KwUb 1.992 fak_ub_b2 0.00 1.992 FUNCTION_LIST LRA IF_DATA DIM_X DIRECT 0x818F97 /end CHARACTERISTIC
/begin CHARACTERISTIC FRAOMX "obere Begrenzung des Korrekturfaktors frao" VALUE 0x818F98 KwUb 1.992 fak_ub_b2 0.00 1.992 FUNCTION_LIST LRA IF_DATA DIM_X DIRECT 0x818F98 /end CHARACTERISTIC
/begin CHARACTERISTIC FRAORN "untere reduzierte Schwelle des Korrekturfaktors frao" VALUE 0x818F99 KwUb 1.992 fak_ub_b2 0.00 1.992 FUNCTION_LIST LRA IF_DATA DIM_X DIRECT 0x818F99 /end CHARACTERISTIC
/begin CHARACTERISTIC FRAORX "obere reduzierte Schwelle des Korrekturfaktors frao" VALUE 0x818F9A KwUb 1.992 fak_ub_b2 0.00 1.992 FUNCTION_LIST LRA IF_DATA DIM_X DIRECT 0x818F9A /end CHARACTERISTIC
/begin CHARACTERISTIC FRAUDN "untere Diagnoseschwelle des Korrekturfaktors frau" VALUE 0x81C796 KwUw 1.999969 fak_uw_b2 0.00 1.999969 FUNCTION_LIST DKVS IF_DATA DIM_X DIRECT 0x81C796 /end CHARACTERISTIC
/begin CHARACTERISTIC FRAUDX "obere Diagnoseschwelle des Korrekturfaktors frau" VALUE 0x81C798 KwUw 1.999969 fak_uw_b2 0.00 1.999969 FUNCTION_LIST DKVS IF_DATA DIM_X DIRECT 0x81C798 /end CHARACTERISTIC
/begin CHARACTERISTIC FRAUMN "untere Begrenzung des Korrekturfaktors frau" VALUE 0x818F9B KwUb 1.992 fak_ub_b2 0.00 1.992 FUNCTION_LIST LRA IF_DATA DIM_X DIRECT 0x818F9B /end CHARACTERISTIC
/begin CHARACTERISTIC FRAUMX "obere Begrenzung des Korrekturfaktors frau" VALUE 0x818F9C KwUb 1.992 fak_ub_b2 0.00 1.992 FUNCTION_LIST LRA IF_DATA DIM_X DIRECT 0x818F9C /end CHARACTERISTIC
/begin CHARACTERISTIC FRAURN "untere reduzierte Schwelle des Korrekturfaktors frau" VALUE 0x818F9D KwUb 1.992 fak_ub_b2 0.00 1.992 FUNCTION_LIST LRA IF_DATA DIM_X DIRECT 0x818F9D /end CHARACTERISTIC
/begin CHARACTERISTIC FRAURX "obere reduzierte Schwelle des Korrekturfaktors frau" VALUE 0x818F9E KwUb 1.992 fak_ub_b2 0.00 1.992 FUNCTION_LIST LRA IF_DATA DIM_X DIRECT 0x818F9E /end CHARACTERISTIC
/begin CHARACTERISTIC FRDO "obere Diagnoseschwelle für Lambdaregler" VALUE 0x81E1F6 KwUw 1.999969 fak_uw_b2 0.00 1.999969 FUNCTION_LIST DLSUV IF_DATA DIM_X DIRECT 0x81E1F6 /end CHARACTERISTIC
/begin CHARACTERISTIC FRDU "untere Diagnoseschwelle für Lambdaregler" VALUE 0x81E1F8 KwUw 1.999969 fak_uw_b2 0.00 1.999969 FUNCTION_LIST DLSUV IF_DATA DIM_X DIRECT 0x81E1F8 /end CHARACTERISTIC
/begin CHARACTERISTIC FRHB "fr-Schwelle für mögliches Rücksetzten Flip-Flop ""Hohe Beladung""" VALUE 0x819A2C KwUb 1.992 fak_ub_b2 0.00 1.992 FUNCTION_LIST TEB IF_DATA DIM_X DIRECT 0x819A2C /end CHARACTERISTIC
/begin CHARACTERISTIC FRINH1 "Multiplikativer Faktor für RIN Sollwert hinter Kat" CURVE 0x81835F KlAUbSstUbWUb 63.75 fak_ub_b64 0.00 63.75 FUNCTION_LIST DHLSHK IF_DATA DIM_X DIRECT 0x81835F
 /begin AXIS_DESCR STD_AXIS tkatmf temp_ub_q5_o50 5 -50.00 1225. DEPOSIT ABSOLUT /end AXIS_DESCR
/end CHARACTERISTIC
/begin CHARACTERISTIC FRINH2 "Multiplikativer Faktor für RIN Sollwert hinter Kat" CURVE 0x81836A KlAUbSstUbWUb 63.75 fak_ub_b64 0.00 63.75 FUNCTION_LIST DHLSHK IF_DATA DIM_X DIRECT 0x81836A
 /begin AXIS_DESCR STD_AXIS tkatmf2 temp_ub_q5_o50 5 -50.00 1225. DEPOSIT ABSOLUT /end AXIS_DESCR
/end CHARACTERISTIC
/begin CHARACTERISTIC FRINOF "Faktor für Bewertung alter Ri-Wert ohne Filter" VALUE 0x810C6F KwUb 15.94 fak_ub_b16 0.00 15.94 FUNCTION_LIST GGLSH IF_DATA DIM_X DIRECT 0x810C6F /end CHARACTERISTIC
/begin CHARACTERISTIC FRKAP "Faktor relative Kraftstoffmasse für Applikation" VALUE 0x818815 KwUb 1.992 fak_ub_b2 0.00 1.992 FUNCTION_LIST ESGRU IF_DATA DIM_X DIRECT 0x818815 /end CHARACTERISTIC
/begin CHARACTERISTIC FRLFSDP "Einspritzkorrektur bei RLFS" CURVE 0x81BFC8 KlAUwSstSwWUw 1.999969 fak_uw_b2 0.00 1.999969 FUNCTION_LIST AES IF_DATA DIM_X DIRECT 0x81BFC8
 /begin AXIS_DESCR STD_AXIS dpus_w p_sw_q0p078 11 -2560.000 2559.922 DEPOSIT ABSOLUT /end AXIS_DESCR
/end CHARACTERISTIC
/begin CHARACTERISTIC FRLMNHO "Korrekturfaktor rlmin über Höhe" CURVE 0x8110AF KlAUbSstUbWUb 1.992 fak_ub_b2 0.00 1.992 FUNCTION_LIST MDFUE IF_DATA DIM_X DIRECT 0x8110AF /begin AXIS_DESCR STD_AXIS fho fak_ub_b4 5 0.00 3.984 DEPOSIT ABSOLUT /end AXIS_DESCR /end CHARACTERISTIC
/begin CHARACTERISTIC FRMAX "obere Regelbereichsgrenze" VALUE 0x8169D8 KwUw 1.999969 fak_uw_b2 0.00 1.999969 FUNCTION_LIST LRS IF_DATA DIM_X DIRECT 0x8169D8 /end CHARACTERISTIC
/begin CHARACTERISTIC FRMDPMO "obere frm Schwelle für passive Einschaltbedingungen Diagnose TEV" VALUE 0x81E308 KwUw 0.1499939 fak_uw_b2 1.000000 1.149994 FUNCTION_LIST DTEV IF_DATA DIM_X DIRECT 0x81E308 /end CHARACTERISTIC
/begin CHARACTERISTIC FRMDPMU "untere frm Schwelle für passive Einschaltbedingungen Diagnose TEV" VALUE 0x81E30A KwUw 0.1499939 fak_uw_b2 0.8500061 1.000000 FUNCTION_LIST DTEV IF_DATA DIM_X DIRECT 0x81E30A /end CHARACTERISTIC
/begin CHARACTERISTIC FRMDTEVO "obere frm Schwelle für passive i.O. Prüfung Diagnose TEV" VALUE 0x81E30C KwUw 0.1499939 fak_uw_b2 1.000000 1.149994 FUNCTION_LIST DTEV IF_DATA DIM_X DIRECT 0x81E30C /end CHARACTERISTIC
/begin CHARACTERISTIC FRMDTEVU "untere frm Schwelle für passive i.O. Prüfung Diagnose TEV" VALUE 0x81E30E KwUw 0.1499939 fak_uw_b2 0.8500061 1.000000 FUNCTION_LIST DTEV IF_DATA DIM_X DIRECT 0x81E30E /end CHARACTERISTIC
/begin CHARACTERISTIC FRMIN "untere Regelbereichsgrenze" VALUE 0x8169DA KwUw 1.999969 fak_uw_b2 0.00 1.999969 FUNCTION_LIST LRS IF_DATA DIM_X DIRECT 0x8169DA /end CHARACTERISTIC
/begin CHARACTERISTIC FRMINKH "Magerbegrenzung Lambdaregelung bei KH mit SL" VALUE 0x8169DC KwUw 1.999969 fak_uw_b2 0.00 1.999969 FUNCTION_LIST LRS IF_DATA DIM_X DIRECT 0x8169DC /end CHARACTERISTIC
/begin CHARACTERISTIC FRMLASHO "obere Schwelle für Mittelwert des Lambdareglerfaktors" VALUE 0x81B8C0 KwUw 1.999969 fak_uw_b2 0.00 1.999969 FUNCTION_LIST DLSAHK IF_DATA DIM_X DIRECT 0x81B8C0 /end CHARACTERISTIC
/begin CHARACTERISTIC FRMLASHU "untere Schwelle für Mittelwert des Lambdareglerfaktors" VALUE 0x81B8C2 KwUw 1.999969 fak_uw_b2 0.00 1.999969 FUNCTION_LIST DLSAHK IF_DATA DIM_X DIRECT 0x81B8C2 /end CHARACTERISTIC
/begin CHARACTERISTIC FRMOG "Oberer Grenzwert FRM und FRM2" VALUE 0x817688 KwUw 1.999969 fak_uw_b2 0.00 1.999969 FUNCTION_LIST DVS IF_DATA DIM_X DIRECT 0x817688 /end CHARACTERISTIC
/begin CHARACTERISTIC FRMSTDN "untere Diagnoseschwelle (short test)" VALUE 0x81880A KwUb 1.992 fak_ub_b2 0.00 1.992 FUNCTION_LIST DKVS IF_DATA DIM_X DIRECT 0x81880A /end CHARACTERISTIC
/begin CHARACTERISTIC FRMSTDX "obere Diagnoseschwelle (short test)" VALUE 0x81880B KwUb 1.992 fak_ub_b2 0.00 1.992 FUNCTION_LIST DKVS IF_DATA DIM_X DIRECT 0x81880B /end CHARACTERISTIC
/begin CHARACTERISTIC FRMUG "Unterer Grenzwert FRM und FRM2" VALUE 0x81768A KwUw 1.999969 fak_uw_b2 0.00 1.999969 FUNCTION_LIST DVS IF_DATA DIM_X DIRECT 0x81768A /end CHARACTERISTIC
/begin CHARACTERISTIC FRNO "Obere Drehzahlschwelle für die Lambdareglerabfrage." VALUE 0x8122F5 KwUb 10200. nmot_ub_q40 0.00 10200. FUNCTION_LIST DVS IF_DATA DIM_X DIRECT 0x8122F5 /end CHARACTERISTIC
/begin CHARACTERISTIC FRNU "Untere Drehzahlschwelle für die Lambdareglerabfrage." VALUE 0x8122F6 KwUb 10200. nmot_ub_q40 0.00 10200. FUNCTION_LIST DVS IF_DATA DIM_X DIRECT 0x8122F6 /end CHARACTERISTIC
/begin CHARACTERISTIC FRRLO "Obere Lastgrenze für Lambdareglerabfrage" VALUE 0x8122F7 KwUb 191.3 rel_ub_q0p75 0.00 191.3 FUNCTION_LIST DVS IF_DATA DIM_X DIRECT 0x8122F7 /end CHARACTERISTIC
/begin CHARACTERISTIC FRRLU "Untere Lastgrenze für Lambdareglerabfrage" VALUE 0x8122F8 KwUb 191.3 rel_ub_q0p75 0.00 191.3 FUNCTION_LIST DVS IF_DATA DIM_X DIRECT 0x8122F8 /end CHARACTERISTIC
/begin CHARACTERISTIC FS1FO "Filterfaktor Segmentzeit-Filter 1 der fuel-on/-off Adaption" VALUE 0x81384A KwUw 0.9999695 fak_uw_b2 0.00 0.9999695 FUNCTION_LIST DMDFON IF_DATA DIM_X DIRECT 0x81384A /end CHARACTERISTIC
/begin CHARACTERISTIC FS2FO "Filterfaktor Segmentzeit-Filter 2 der fuel-on/-off Adaption" VALUE 0x81384C KwUw 0.9999695 fak_uw_b2 0.00 0.9999695 FUNCTION_LIST DMDFON IF_DATA DIM_X DIRECT 0x81384C /end CHARACTERISTIC
/begin CHARACTERISTIC FSRFTEF "Faktor Steilheit Spülratenregelung in der Nähe des gewünschten Krafstoffanteils" VALUE 0x8121D7 KwUb 59.75 fak_ub_b64 4.000 63.75 FUNCTION_LIST TEB IF_DATA DIM_X DIRECT 0x8121D7 /end CHARACTERISTIC
/begin CHARACTERISTIC FSTHO "Wichtung Startfaktor" CURVE 0x818983 KlAUbSstUbWUb 1.992 fak_ub_b2 0.00 1.992 FUNCTION_LIST ESSTT IF_DATA DIM_X DIRECT 0x818983 /begin AXIS_DESCR STD_AXIS fho fak_ub_b4 4 0.00 3.984 DEPOSIT ABSOLUT /end AXIS_DESCR /end CHARACTERISTIC
/begin CHARACTERISTIC FSWALUV "Erkennungsschwelle Schlechtwegstrecke abhängig von Fz.geschwindigkeit" CURVE 0x8121CD KlAUbSstUbWUb 55.34 acc_ub_b55p55 0.00 55.34 FUNCTION_LIST DSWEC IF_DATA DIM_X DIRECT 0x8121CD /begin AXIS_DESCR STD_AXIS vfzg vfzg_ub_q1p25 4 0.00 318.8 DEPOSIT ABSOLUT /end AXIS_DESCR /end CHARACTERISTIC
/begin CHARACTERISTIC FSZTM "Faktor Schließzeitkorrektur tmot-abhängig" CURVE 0x8123D4 KlAUbSstUbWUb 1.992 fak_ub_b2 0.00 1.992 FUNCTION_LIST ZUESZ IF_DATA DIM_X DIRECT 0x8123D4
 /begin AXIS_DESCR STD_AXIS tmot temp_ub_q0p75_o48 8 -48.00 143.3 DEPOSIT ABSOLUT /end AXIS_DESCR
/end CHARACTERISTIC
/begin CHARACTERISTIC FTEADAB "Schwelle Beladung für Abbruch TE-Phase" VALUE 0x819A2D KwSb 127.5 fak_sb_b64 -64.00 63.50 FUNCTION_LIST TEB IF_DATA DIM_X DIRECT 0x819A2D /end CHARACTERISTIC
/begin CHARACTERISTIC FTEADDPO "obere Beladungsschwelle für passive i.O. Prüfung" VALUE 0x81E310 KwSw 30.00000 fak_sw_b64 20.00000 50.00000 FUNCTION_LIST DTEV IF_DATA DIM_X DIRECT 0x81E310 /end CHARACTERISTIC
/begin CHARACTERISTIC FTEADDPU "untere Beladungsschwelle für passive i.O. Prüfung" VALUE 0x81E312 KwSw 8.000000 fak_sw_b64 2.000000 10.00000 FUNCTION_LIST DTEV IF_DATA DIM_X DIRECT 0x81E312 /end CHARACTERISTIC
/begin CHARACTERISTIC FTEADMX "Maximalwert der Beladung des AKF's" VALUE 0x819A2E KwSb 127.5 fak_sb_b64 -64.00 63.50 FUNCTION_LIST TEB IF_DATA DIM_X DIRECT 0x819A2E /end CHARACTERISTIC
/begin CHARACTERISTIC FTEADSZ "Schwelle Beladung für TEV sofort schließen aus DTEV" VALUE 0x81E314 KwSw 15.00000 fak_sw_b64 0.00 15.00000 FUNCTION_LIST DTEV IF_DATA DIM_X DIRECT 0x81E314 /end CHARACTERISTIC
/begin CHARACTERISTIC FTEADZU "Schwelle Beladung für Unterbrechung TE-Phase für Diagnose Funktionen" VALUE 0x81C704 KwSw 127.9980 fak_sw_b64 -64.00000 63.99805 FUNCTION_LIST BBTEGA IF_DATA DIM_X DIRECT 0x81C704 /end CHARACTERISTIC
/begin CHARACTERISTIC FTEDS "Schwelle Beladung für Umschaltung auf Dauertankentlüftung" VALUE 0x81C706 KwSw 127.9980 fak_sw_b64 -64.00000 63.99805 FUNCTION_LIST BBTEGA IF_DATA DIM_X DIRECT 0x81C706 /end CHARACTERISTIC
/begin CHARACTERISTIC FTEFHB "Schwelle für Spülrate Tankentlüftung für Erkennung hohe Beladung" VALUE 0x819A2F KwUb 0.4980 fak_ub_b0p5 0.00 0.4980 FUNCTION_LIST TEB IF_DATA DIM_X DIRECT 0x819A2F /end CHARACTERISTIC
/begin CHARACTERISTIC FTEHB "Schwelle für Faktor Tankentlüftung für Erkennung hohe Beladung" VALUE 0x819A30 KwSb 127.5 fak_sb_b64 -64.00 63.50 FUNCTION_LIST TEB IF_DATA DIM_X DIRECT 0x819A30 /end CHARACTERISTIC
/begin CHARACTERISTIC FTEINIX "Kennlinie Max. Spülrate abhängig vom Integral Massenstrom TE nach TE Stop" CURVE 0x819A31 KlAUbSstUbWUb 0.1992 fak_ub_b0p5 0.00 0.1992 FUNCTION_LIST TEB IF_DATA DIM_X DIRECT 0x819A31
 /begin AXIS_DESCR STD_AXIS imsteini m_ub_q0p0444 5 0.00 11.32 DEPOSIT ABSOLUT /end AXIS_DESCR
/end CHARACTERISTIC
/begin CHARACTERISTIC FTLDIA "Faktor für Entprellzeit Adaptionsfreigabe" VALUE 0x8195C6 KwUb 1.992 fak_ub_b2 0.00 1.992 FUNCTION_LIST LDRPID IF_DATA DIM_X DIRECT 0x8195C6 /end CHARACTERISTIC
/begin CHARACTERISTIC FTLDIAP "Faktor für Entprellzeit schnelle positive Nachführung" VALUE 0x8195C7 KwUb 1.992 fak_ub_b2 0.00 1.992 FUNCTION_LIST LDRPID IF_DATA DIM_X DIRECT 0x8195C7 /end CHARACTERISTIC
/begin CHARACTERISTIC FTMLAKH "tmot-Korrektur der Lambda-Bewertung bei Katheizen" CURVE 0x81910A KlAUbSstUbWUb 0.9961 fak_ub_b1 0.00 0.9961 FUNCTION_LIST BBKHZ IF_DATA DIM_X DIRECT 0x81910A
 /begin AXIS_DESCR STD_AXIS tmot temp_ub_q0p75_o48 4 -48.00 143.3 DEPOSIT ABSOLUT /end AXIS_DESCR
/end CHARACTERISTIC
/begin CHARACTERISTIC FTVVSV "Faktor Schaltzeitverkürzung bei starkem Drehmomentanstieg" CURVE 0x819C0C KlAUbSstUbWUb 0.9961 fak_ub_b1 0.00 0.9961 FUNCTION_LIST VS IF_DATA DIM_X DIRECT 0x819C0C /begin AXIS_DESCR STD_AXIS dmtvvs rel_ub_q0p75 8 0.00 191.3 DEPOSIT ABSOLUT /end AXIS_DESCR /end CHARACTERISTIC
/begin CHARACTERISTIC FUBAOF "Offenzeit für Funkenbandzündung" VALUE 0x8176B0 KwUw 43.68333 tsegment_sy 0.006666667 43.69000 FUNCTION_LIST ZUESZ IF_DATA DIM_X DIRECT 0x8176B0 /end CHARACTERISTIC
/begin CHARACTERISTIC FUEPMLD "Faktor für gleitender Übergang Druckmittelwert(Referenzdruck) beim Turbo" CURVE 0x81C5BE KlAUwSstSwWUw 0.9999847 fak_uw_b1 0.00 0.9999847 FUNCTION_LIST FUEDK IF_DATA DIM_X DIRECT 0x81C5BE
 /begin AXIS_DESCR STD_AXIS lditv_w tv_sw_q0p005 4 -163.8400 163.8350 DEPOSIT ABSOLUT /end AXIS_DESCR
/end CHARACTERISTIC
/begin CHARACTERISTIC FUKABAKI "Init.-Wert adaptiver ÜK-Korrekturfaktor BA für kalten Motor" VALUE 0x811339 KwUb 3.984 fak_ub_b4 0.00 3.984 FUNCTION_LIST ESUKAS IF_DATA DIM_X DIRECT 0x811339 /end CHARACTERISTIC
/begin CHARACTERISTIC FUKABAKO "Obergrenze adaptiver ÜK-Korrekturfaktor BA bei kaltem Motor" VALUE 0x81133A KwUb 3.984 fak_ub_b4 0.00 3.984 FUNCTION_LIST ESUKAS IF_DATA DIM_X DIRECT 0x81133A /end CHARACTERISTIC
/begin CHARACTERISTIC FUKABAKU "Untergrenze adaptiver ÜK-Korrekturfaktor BA bei kaltem Motor" VALUE 0x81133B KwUb 3.875 fak_ub_b4 0.1094 3.984 FUNCTION_LIST ESUKAS IF_DATA DIM_X DIRECT 0x81133B /end CHARACTERISTIC
/begin CHARACTERISTIC FUKABAWI "Init.-Wert adaptiver ÜK-Korrekturfaktor BA für warmen Motor" VALUE 0x81133C KwUb 3.984 fak_ub_b4 0.00 3.984 FUNCTION_LIST ESUKAS IF_DATA DIM_X DIRECT 0x81133C /end CHARACTERISTIC
/begin CHARACTERISTIC FUKABAWO "Obergrenze adaptiver ÜK-Korrekturfaktor BA bei warmem Motor" VALUE 0x81133D KwUb 3.984 fak_ub_b4 0.00 3.984 FUNCTION_LIST ESUKAS IF_DATA DIM_X DIRECT 0x81133D /end CHARACTERISTIC
/begin CHARACTERISTIC FUKABAWU "Untergrenze adaptiver ÜK-Korrekturfaktor BA bei warmem Motor" VALUE 0x81133E KwUb 3.875 fak_ub_b4 0.1094 3.984 FUNCTION_LIST ESUKAS IF_DATA DIM_X DIRECT 0x81133E /end CHARACTERISTIC
/begin CHARACTERISTIC FUKAVAKI "Init.-Wert adaptiver ÜK-Korrekturfaktor VA für kalten Motor" VALUE 0x81133F KwUb 3.984 fak_ub_b4 0.00 3.984 FUNCTION_LIST ESUKAS IF_DATA DIM_X DIRECT 0x81133F /end CHARACTERISTIC
/begin CHARACTERISTIC FUKAVAKO "Obergrenze adaptiver ÜK-Korrekturfaktor VA bei kaltem Motor" VALUE 0x811340 KwUb 3.984 fak_ub_b4 0.00 3.984 FUNCTION_LIST ESUKAS IF_DATA DIM_X DIRECT 0x811340 /end CHARACTERISTIC
/begin AXIS_PTS SDZ08DMUB "SST-Verteilung in DMD, 8 Drehzahl-SST" 0x81029A nmot SstAUbSstUb 10200. nmot_ub_q40 8 0.00 10200. FUNCTION_LIST DMDFON DEPOSIT ABSOLUT IF_DATA DIM_X DIRECT 0x81029A /end AXIS_PTS
/begin AXIS_PTS SDZ08DMUB2 "SST-Verteilung in DMD, 8 Drehzahl-SST" 0x8102A3 nmot SstAUbSstUb 10200. nmot_ub_q40 8 0.00 10200. FUNCTION_LIST DMDFON DEPOSIT ABSOLUT IF_DATA DIM_X DIRECT 0x8102A3 /end AXIS_PTS
/begin AXIS_PTS SGA08MDUB "Stützstellenverteilung Ist Gang 8 Sst." 0x810058 gangi SstAUbSstUb 255.0 dez 8 0.00 255.0 FUNCTION_LIST SSTBER87 DMDSTP MDFAW NMAXMD DEPOSIT ABSOLUT IF_DATA DIM_X DIRECT 0x810058 /end AXIS_PTS
/begin AXIS_PTS SML07TMUW "Stützstellenverteilung, Luftmasse, 7 Stützstellen" 0x819F9A ml_w SstAUwSstUw 6553.500 m_uw_b6553p5 7 0.00 6553.500 FUNCTION_LIST SSTBER87 ATM DEPOSIT ABSOLUT IF_DATA DIM_X DIRECT 0x819F9A /end AXIS_PTS
/begin AXIS_PTS SNG06LLSB "Stützstellenverteilung Drehzahlgradient, 6 Sst." 0x810073 ngfil SstAUbSstSb 25500. nmotg_sb_q100 6 -12800. 12700. FUNCTION_LIST SSTBER87 LLRRM DEPOSIT ABSOLUT IF_DATA DIM_X DIRECT 0x810073 /end AXIS_PTS
/begin AXIS_PTS SNM06LLUB "Sützstellenverteilung für Motordrehzahl" 0x810080 nmot SstAUbSstUb 10200. nmot_ub_q40 6 0.00 10200. FUNCTION_LIST SSTBER87 LLRRM DEPOSIT ABSOLUT IF_DATA DIM_X DIRECT 0x810080 /end AXIS_PTS
/begin AXIS_PTS SNM08DMUB "SST-Verteilung in DMD, 8 Drehzahl-SST" 0x810097 nmot SstAUbSstUb 10200. nmot_ub_q40 8 0.00 10200. FUNCTION_LIST SSTBER87 DMDDLU DMDDVS DMDLU DMDLUA DMDMIL DMDSTP DEPOSIT ABSOLUT IF_DATA DIM_X DIRECT 0x810097 /end AXIS_PTS
/begin AXIS_PTS SNM16KRUB "Stützstellenverteilung Drehzahl, 16 Sst." 0x81806C nmot SstAUbSstUb 10200. nmot_ub_q40 16 0.00 10200. FUNCTION_LIST SSTBER87 DKRS GGKS KRDY KRKE KRRA DEPOSIT ABSOLUT IF_DATA DIM_X DIRECT 0x81806C /end AXIS_PTS
/begin AXIS_PTS SNS06LLSB "Stützstellenvert., Solldrehzahlabw., 06 Sst., LL-Regel." 0x8115D0 dns SstAUbSstSb 2550. nmotd_sb_q10 6 -1280. 1270. FUNCTION_LIST LLRNS LLRRM DEPOSIT ABSOLUT IF_DATA DIM_X DIRECT 0x8115D0 /end AXIS_PTS
/begin AXIS_PTS SRL08DMUB "SST-Verteilung in DMD, 8 Last-SST" 0x81016C rl SstAUbSstUb 191.3 rel_ub_q0p75 8 0.00 191.3 FUNCTION_LIST SSTBER87 DMDDLU DMDLU DMDLUA DMDSTP DEPOSIT ABSOLUT IF_DATA DIM_X DIRECT 0x81016C /end AXIS_PTS
/begin AXIS_PTS STA06ESUB "SST-Verteilung für die Ansauglufttemperatur" 0x8180AF tans SstAUbSstUb 191.3 temp_ub_q0p75_o48 6 -48.00 143.3 FUNCTION_LIST SSTBER87 ESNST DEPOSIT ABSOLUT IF_DATA DIM_X DIRECT 0x8180AF /end AXIS_PTS
/begin AXIS_PTS STM06__UB "Stützstellenverteilung Motortemperatur, 6 Sst." 0x8180C8 tmot SstAUbSstUb 191.3 temp_ub_q0p75_o48 6 -48.00 143.3 FUNCTION_LIST SSTBER87 MDVER ZWMIN DEPOSIT ABSOLUT IF_DATA DIM_X DIRECT 0x8180C8 /end AXIS_PTS
/begin AXIS_PTS STS12ESUB "SST-Verteilung für Motorstarttemperatur" 0x8101D9 tmst SstAUbSstUb 191.3 temp_ub_q0p75_o48 12 -48.00 143.3 FUNCTION_LIST SSTBER87 ESNST ESWL DEPOSIT ABSOLUT IF_DATA DIM_X DIRECT 0x8101D9 /end AXIS_PTS
/begin AXIS_PTS STW06MDUB "6 twan-Stützstellen für ?" 0x8197B9 twan_kge SstAUbSstUb 255.0 temp_ub_q1_o50 6 -50.00 205.0 FUNCTION_LIST MDWAN DEPOSIT ABSOLUT IF_DATA DIM_X DIRECT 0x8197B9 /end AXIS_PTS
/begin COMPU_METHOD accgrd_ub_b555p55 "" RAT_FUNC "%6.2" "m/(s^3)" COEFFS 0 1 0 0 0 2.17 /end COMPU_METHOD
/begin COMPU_METHOD acc_ub_b55p55 "" RAT_FUNC "%6.3" "m/(s^2)" COEFFS 0 1 0 0 0 0.217 /end COMPU_METHOD
/begin COMPU_METHOD DEZ "1 : 1 Umrechnug (dez/hex)" RAT_FUNC "%6.2" "" COEFFS 0 1 0 0 0 1 /end COMPU_METHOD
/begin COMPU_METHOD dez "1 : 1 Umrechnug (dez/hex)" RAT_FUNC "%6.2" "" COEFFS 0 1 0 0 0 1 /end COMPU_METHOD
/begin COMPU_METHOD dgrad_uw_q0p015 "" RAT_FUNC "%6.4" "hPa/V" COEFFS 0 65536 0 0 0 1024 /end COMPU_METHOD
/begin COMPU_METHOD dtsegn_b11p25divZyl "" RAT_FUNC "%6.4" "grad/KW" COEFFS 0 68.2667 0 0 0 1 /end COMPU_METHOD
/begin COMPU_METHOD fak_q0p0195 "" RAT_FUNC "%6.4" "-" COEFFS 0 256 0 0 0 5 /end COMPU_METHOD
/begin COMPU_METHOD fak_sb_b1 "" RAT_FUNC "%6.4" "-" COEFFS 0 256 0 0 0 2 /end COMPU_METHOD
/begin COMPU_METHOD fak_sb_b16 "" RAT_FUNC "%6.3" "-" COEFFS 0 256 0 0 0 32 /end COMPU_METHOD
/begin COMPU_METHOD fak_sb_b64 "" RAT_FUNC "%6.3" "-" COEFFS 0 256 0 0 0 128 /end COMPU_METHOD
/begin COMPU_METHOD fak_sw_b1 "" RAT_FUNC "%7.6" "-" COEFFS 0 65536 0 0 0 2 /end COMPU_METHOD
/begin COMPU_METHOD fak_sw_b64 "" RAT_FUNC "%6.4" "-" COEFFS 0 65536 0 0 0 128 /end COMPU_METHOD
/begin COMPU_METHOD fak_ub_b0p03125 "" RAT_FUNC "%6.5" "-" COEFFS 0 256 0 0 0 0.03125 /end COMPU_METHOD
/begin COMPU_METHOD fak_ub_b0p1_o0p05 "" RAT_FUNC "%8.7" "-" COEFFS 0 256 12.8 0 0 0.1 /end COMPU_METHOD
/begin COMPU_METHOD fak_ub_b0p5 "" RAT_FUNC "%6.4" "-" COEFFS 0 256 0 0 0 0.5 /end COMPU_METHOD
/begin COMPU_METHOD fak_ub_b1 "" RAT_FUNC "%6.4" "-" COEFFS 0 256 0 0 0 1 /end COMPU_METHOD
/begin COMPU_METHOD fak_ub_b16 "" RAT_FUNC "%6.4" "-" COEFFS 0 256 0 0 0 16 /end COMPU_METHOD
/begin COMPU_METHOD fak_ub_b2 "" RAT_FUNC "%6.4" "-" COEFFS 0 256 0 0 0 2 /end COMPU_METHOD
/begin COMPU_METHOD fak_ub_b4 "" RAT_FUNC "%6.4" "-" COEFFS 0 256 0 0 0 4 /end COMPU_METHOD
/begin COMPU_METHOD fak_ub_b64 "" RAT_FUNC "%6.3" "-" COEFFS 0 256 0 0 0 64 /end COMPU_METHOD
/begin COMPU_METHOD fak_ub_b8 "" RAT_FUNC "%6.4" "-" COEFFS 0 256 0 0 0 8 /end COMPU_METHOD
/begin COMPU_METHOD fak_ub_q4p7Em7 "" RAT_FUNC "%11.10" "-" COEFFS 0 1 0 0 0 4.7e-007 /end COMPU_METHOD
/begin COMPU_METHOD fak_uw_b1 "" RAT_FUNC "%7.6" "-" COEFFS 0 65536 0 0 0 1 /end COMPU_METHOD
/begin COMPU_METHOD fak_uw_b16 "" RAT_FUNC "%6.5" "-" COEFFS 0 65536 0 0 0 16 /end COMPU_METHOD
/begin COMPU_METHOD fak_uw_b2 "" RAT_FUNC "%7.6" "-" COEFFS 0 65536 0 0 0 2 /end COMPU_METHOD
/begin COMPU_METHOD fak_uw_b4 "" RAT_FUNC "%7.6" "-" COEFFS 0 65536 0 0 0 4 /end COMPU_METHOD
/begin COMPU_METHOD fak_uw_b8 "" RAT_FUNC "%6.5" "-" COEFFS 0 65536 0 0 0 8 /end COMPU_METHOD
/begin COMPU_METHOD fmfkr_dez "" RAT_FUNC "%6.2" "kHz" COEFFS 0 1 0 0 0 1 /end COMPU_METHOD
/begin COMPU_METHOD KennText "" RAT_FUNC "%6.2" "" COEFFS 0 1 0 0 0 1 /end COMPU_METHOD
/begin COMPU_METHOD kw_q1 "" RAT_FUNC "%6.2" "°KW" COEFFS 0 1 0 0 0 1 /end COMPU_METHOD
/begin COMPU_METHOD kw_q6 "" RAT_FUNC "%6.2" "°KW" COEFFS 0 1 0 0 0 6 /end COMPU_METHOD
/begin COMPU_METHOD kw_ub_q0p5 "" RAT_FUNC "%6.3" "°KW" COEFFS 0 256 0 0 0 128 /end COMPU_METHOD
/begin COMPU_METHOD leit_q3p125Em6 "" RAT_FUNC "%6.4" "mS [mSiemens]" COEFFS 0 65536 0 0 0 204.8 /end COMPU_METHOD
/begin COMPU_METHOD luquant "Umrechnung Laufunruhe in DMD" RAT_FUNC "%6.2" "(Umdr./sec)^2" COEFFS 0 0.549756 0 0 0 1 /end COMPU_METHOD
/begin COMPU_METHOD m_q0p0031 "" RAT_FUNC "%6.4" "kg/h" COEFFS 0 320 0 0 0 1 /end COMPU_METHOD
/begin COMPU_METHOD m_q0p1 "" RAT_FUNC "%6.3" "kg/h" COEFFS 0 10 0 0 0 1 /end COMPU_METHOD
/begin COMPU_METHOD m_ub_b1020 "" RAT_FUNC "%6.2" "kg/h" COEFFS 0 1 0 0 0 4 /end COMPU_METHOD
/begin COMPU_METHOD m_ub_q0p0444 "" RAT_FUNC "%6.4" "g" COEFFS 0 1 0 0 0 0.0444 /end COMPU_METHOD
/begin COMPU_METHOD m_uw_b25p6 "" RAT_FUNC "%6.5" "kg/h" COEFFS 0 65536 0 0 0 25.6 /end COMPU_METHOD
/begin COMPU_METHOD m_uw_b6553p5 "" RAT_FUNC "%6.3" "kg/h" COEFFS 0 1 0 0 0 0.1 /end COMPU_METHOD
/begin COMPU_METHOD m_uw_q3p2 "" RAT_FUNC "%6.2" "kg/h" COEFFS 0 1 0 0 0 3.2 /end COMPU_METHOD
/begin COMPU_METHOD nmotd_sb_q10 "" RAT_FUNC "%6.1" "U/min" COEFFS 0 1 0 0 0 10 /end COMPU_METHOD
/begin COMPU_METHOD nmotg_sb_q100 "" RAT_FUNC "%6.0" "U/min/s" COEFFS 0 1 0 0 0 100 /end COMPU_METHOD
/begin COMPU_METHOD nmotg_sw_q0p39 "" RAT_FUNC "%6.3" "U/min/s" COEFFS 0 1 0 0 0 0.39063 /end COMPU_METHOD
/begin COMPU_METHOD nmot_sw_q0p25 "" RAT_FUNC "%6.3" "U/min" COEFFS 0 1 0 0 0 0.25 /end COMPU_METHOD
/begin COMPU_METHOD nmot_ub_q10 "" RAT_FUNC "%6.1" "U/min" COEFFS 0 1 0 0 0 10 /end COMPU_METHOD
/begin COMPU_METHOD nmot_ub_q40 "" RAT_FUNC "%6.1" "Upm" COEFFS 0 1 0 0 0 40 /end COMPU_METHOD
/begin COMPU_METHOD nmot_uw_q0p25 "" RAT_FUNC "%6.3" "U/min" COEFFS 0 1 0 0 0 0.25 /end COMPU_METHOD
/begin COMPU_METHOD p_sb_q0p25 "" RAT_FUNC "%6.3" "hPa" COEFFS 0 1 0 0 0 0.25 /end COMPU_METHOD
/begin COMPU_METHOD p_sb_q10 "" RAT_FUNC "%6.1" "hPa" COEFFS 0 1 0 0 0 10 /end COMPU_METHOD
/begin COMPU_METHOD p_sw_q0p039 "" RAT_FUNC "%6.4" "hPa" COEFFS 0 256 0 0 0 10 /end COMPU_METHOD
/begin COMPU_METHOD p_sw_q0p078 "" RAT_FUNC "%6.4" "hPa" COEFFS 0 65536 0 0 0 5120 /end COMPU_METHOD
/begin COMPU_METHOD p_ub_q10 "" RAT_FUNC "%6.1" "hPa" COEFFS 0 1 0 0 0 10 /end COMPU_METHOD
/begin COMPU_METHOD p_ub_q5 "" RAT_FUNC "%6.2" "hPa" COEFFS 0 1 0 0 0 5 /end COMPU_METHOD
/begin COMPU_METHOD p_uw_q0p039 "" RAT_FUNC "%6.4" "hPa" COEFFS 0 256 0 0 0 10 /end COMPU_METHOD
/begin COMPU_METHOD relDK_q0p00152 "" RAT_FUNC "%6.4" "%DK" COEFFS 0 65536 0 0 0 100 /end COMPU_METHOD
/begin COMPU_METHOD relDK_q0p02441 "" RAT_FUNC "%6.4" "% DK" COEFFS 0 65536 0 0 0 1600 /end COMPU_METHOD
/begin COMPU_METHOD relDK_q0p0625 "" RAT_FUNC "%6.4" "%PWM/%DK" COEFFS 0 16 0 0 0 1 /end COMPU_METHOD
/begin COMPU_METHOD relDK_q1 "" RAT_FUNC "%6.2" "%PWM/%DK" COEFFS 0 1 0 0 0 1 /end COMPU_METHOD
/begin COMPU_METHOD relDK_q4 "" RAT_FUNC "%6.2" "%PWM/%DK" COEFFS 0 1 0 0 0 4 /end COMPU_METHOD
/begin COMPU_METHOD relDK_ub_b100 "" RAT_FUNC "%6.3" "% DK" COEFFS 0 255 0 0 0 100 /end COMPU_METHOD
/begin COMPU_METHOD relDK_uw_b100 "" RAT_FUNC "%6.4" "% DK" COEFFS 0 65535 0 0 0 100 /end COMPU_METHOD
/begin COMPU_METHOD relNWU_q0p0234 "" RAT_FUNC "%6.4" "%/NWU" COEFFS 0 32 0 0 0 0.75 /end COMPU_METHOD
/begin COMPU_METHOD relPED_uw_b100 "" RAT_FUNC "%6.4" "% PED" COEFFS 0 65535 0 0 0 100 /end COMPU_METHOD
/begin COMPU_METHOD rel_q0p00305 "" RAT_FUNC "%6.4" "%/(U/min)" COEFFS 0 256 0 0 0 0.7812 /end COMPU_METHOD
/begin COMPU_METHOD rel_q0p1957 "" RAT_FUNC "%6.3" "%" COEFFS 0 511 0 0 0 100 /end COMPU_METHOD
/begin COMPU_METHOD rel_qn0p000488 "" RAT_FUNC "%8.7" "(%*s)/(U/min)" COEFFS 0 -256 0 0 0 0.125 /end COMPU_METHOD
/begin COMPU_METHOD rel_sb_q0p39 "" RAT_FUNC "%6.3" "%" COEFFS 0 1 0 0 0 0.3906 /end COMPU_METHOD
/begin COMPU_METHOD rel_sb_q0p75 "" RAT_FUNC "%6.3" "%" COEFFS 0 1 0 0 0 0.75 /end COMPU_METHOD
/begin COMPU_METHOD rel_sw_b100 "" RAT_FUNC "%6.4" "%" COEFFS 0 32768 0 0 0 100 /end COMPU_METHOD
/begin COMPU_METHOD rel_sw_b50 "" RAT_FUNC "%6.4" "%" COEFFS 0 65536 0 0 0 100 /end COMPU_METHOD
/begin COMPU_METHOD rel_sw_q0p0234 "" RAT_FUNC "%6.4" "%/seg" COEFFS 0 32 0 0 0 0.75 /end COMPU_METHOD
/begin COMPU_METHOD rel_sw_q0p1875 "" RAT_FUNC "%6.3" "%" COEFFS 0 65536 0 0 0 12288 /end COMPU_METHOD
/begin COMPU_METHOD rel_ub_b100 "" RAT_FUNC "%6.3" "%" COEFFS 0 256 0 0 0 100 /end COMPU_METHOD
/begin COMPU_METHOD rel_ub_b127p5 "" RAT_FUNC "%6.3" "%" COEFFS 0 2 0 0 0 1 /end COMPU_METHOD
/begin COMPU_METHOD rel_ub_b1p0 "" RAT_FUNC "%6.4" "%" COEFFS 0 256 0 0 0 1 /end COMPU_METHOD
/begin COMPU_METHOD rel_ub_b24p9 "" RAT_FUNC "%6.3" "%" COEFFS 0 255 0 0 0 24.9 /end COMPU_METHOD
/begin COMPU_METHOD rel_ub_b49p725 "" RAT_FUNC "%6.3" "%" COEFFS 0 255 0 0 0 49.725 /end COMPU_METHOD
/begin COMPU_METHOD rel_ub_b99p6 "" RAT_FUNC "%6.3" "%" COEFFS 0 256 0 0 0 100 /end COMPU_METHOD
/begin COMPU_METHOD rel_ub_bn24p9 "" RAT_FUNC "%6.5" "%" COEFFS 0 -255 0 0 0 24.9 /end COMPU_METHOD
/begin COMPU_METHOD rel_ub_bn6p375 "" RAT_FUNC "%6.5" "%" COEFFS 0 -255 0 0 0 6.375 /end COMPU_METHOD
/begin COMPU_METHOD rel_ub_q0p3906 "" RAT_FUNC "%6.3" "%" COEFFS 0 256 0 0 0 100 /end COMPU_METHOD
/begin COMPU_METHOD rel_ub_q0p75 "" RAT_FUNC "%6.3" "%" COEFFS 0 1 0 0 0 0.75 /end COMPU_METHOD
/begin COMPU_METHOD rel_uw_b100 "" RAT_FUNC "%6.4" "%" COEFFS 0 65536 0 0 0 100 /end COMPU_METHOD
/begin COMPU_METHOD rel_uw_b200 "" RAT_FUNC "%6.4" "%" COEFFS 0 65536 0 0 0 200 /end COMPU_METHOD
/begin COMPU_METHOD rel_uw_b40 "" RAT_FUNC "%6.5" "%" COEFFS 0 65536 0 0 0 40 /end COMPU_METHOD
/begin COMPU_METHOD rel_uw_q0p0234 "" RAT_FUNC "%6.4" "%" COEFFS 0 32 0 0 0 0.75 /end COMPU_METHOD
/begin COMPU_METHOD r_uw_q2 "" RAT_FUNC "%6.2" "Ohm" COEFFS 0 1 0 0 0 2 /end COMPU_METHOD
/begin COMPU_METHOD spg_q1p221_mV "" RAT_FUNC "%6.4" "V" COEFFS 0 65536 0 0 0 80 /end COMPU_METHOD
/begin COMPU_METHOD spg_sw_q0p00488 "" RAT_FUNC "%6.4" "V" COEFFS 0 1024 0 0 0 5 /end COMPU_METHOD
/begin COMPU_METHOD spg_ubatt "" RAT_FUNC "%6.4" "V" COEFFS 0 1 0 0 0 0.076 /end COMPU_METHOD
/begin COMPU_METHOD spg_ub_b5 "" RAT_FUNC "%6.4" "V" COEFFS 0 256 0 0 0 5 /end COMPU_METHOD
/begin COMPU_METHOD spg_uw_q0p001222 "" RAT_FUNC "%6.4" "V" COEFFS 0 1 0 0 0 0.001222 /end COMPU_METHOD
/begin COMPU_METHOD spg_uw_q0p00488 "" RAT_FUNC "%6.4" "V" COEFFS 0 1024 0 0 0 5 /end COMPU_METHOD
/begin COMPU_METHOD t100msxs_ub_b25p5 "" RAT_FUNC "%6.3" "s" COEFFS 0 1 0 0 0 0.1 /end COMPU_METHOD
/begin COMPU_METHOD t10msxs_ub_b2p55 "" RAT_FUNC "%6.4" "s" COEFFS 0 1 0 0 0 0.01 /end COMPU_METHOD
/begin COMPU_METHOD t10msxs_uw_b655p35 "" RAT_FUNC "%6.4" "s" COEFFS 0 1 0 0 0 0.01 /end COMPU_METHOD
/begin COMPU_METHOD t1sxs_uw_q1 "" RAT_FUNC "%6.2" "s" COEFFS 0 1 0 0 0 1 /end COMPU_METHOD
/begin COMPU_METHOD t20msxs_ub_b5p1 "" RAT_FUNC "%6.4" "s" COEFFS 0 1 0 0 0 0.02 /end COMPU_METHOD
/begin COMPU_METHOD t5usxus_q5 "" RAT_FUNC "%6.2" "us" COEFFS 0 1 0 0 0 5 /end COMPU_METHOD
/begin COMPU_METHOD tefuel_uw_b312p5 "" RAT_FUNC "%6.4" "ul/ms" COEFFS 0 65535 0 0 0 312.5 /end COMPU_METHOD
/begin COMPU_METHOD temp_sb_q0p75 "" RAT_FUNC "%6.3" "Grad C" COEFFS 0 1 0 0 0 0.75 /end COMPU_METHOD
/begin COMPU_METHOD temp_sw_q0p75 "" RAT_FUNC "%6.3" "Grad C" COEFFS 0 4 0 0 0 3 /end COMPU_METHOD
/begin COMPU_METHOD temp_ub_b191p25 "" RAT_FUNC "%6.3" "Grad C" COEFFS 0 1 0 0 0 0.75 /end COMPU_METHOD
/begin COMPU_METHOD temp_ub_q0p75_o48 "" RAT_FUNC "%6.2" "Grad C" COEFFS 0 1 48 0 0 0.75 /end COMPU_METHOD
/begin COMPU_METHOD temp_ub_q1_o50 "" RAT_FUNC "%6.2" "Grad C" COEFFS 0 1 50 0 0 1 /end COMPU_METHOD
/begin COMPU_METHOD temp_ub_q5_o50 "" RAT_FUNC "%6.2" "Grad C" COEFFS 0 1 50 0 0 5 /end COMPU_METHOD
/begin COMPU_METHOD temp_uw_q0p0195 "" RAT_FUNC "%6.4" "Grad C" COEFFS 0 256 0 0 0 5 /end COMPU_METHOD
/begin COMPU_METHOD tinjection_sy "" RAT_FUNC "%6.4" "ms" COEFFS 0 375 0 0 0 1 /end COMPU_METHOD
/begin COMPU_METHOD tknockcon_sy "" RAT_FUNC "%8.7" "s" COEFFS 0 375000 0 0 0 1 /end COMPU_METHOD
/begin COMPU_METHOD tknockintgrad_sy "" RAT_FUNC "%6.3" "V/s" COEFFS 0 8.94855 0 0 0 1 /end COMPU_METHOD
/begin COMPU_METHOD tsegment_sy "" RAT_FUNC "%6.5" "ms" COEFFS 0 1500 0 0 0 1 /end COMPU_METHOD
/begin COMPU_METHOD tv_sw_q0p005 "" RAT_FUNC "%6.4" "%" COEFFS 0 1 0 0 0 0.005 /end COMPU_METHOD
/begin COMPU_METHOD vfzg_ub_q1p25 "" RAT_FUNC "%6.2" "km/h" COEFFS 0 1 0 0 0 1.25 /end COMPU_METHOD
/begin COMPU_METHOD vfzg_uw_b512 "" RAT_FUNC "%6.4" "km/h" COEFFS 0 65536 0 0 0 512 /end COMPU_METHOD
/begin COMPU_METHOD zw_sb_q0p75 "" RAT_FUNC "%6.3" "grad KW" COEFFS 0 255 0 0 0 191.25 /end COMPU_METHOD
/begin COMPU_METHOD zw_ub_q6 "" RAT_FUNC "%6.2" "Grad KW" COEFFS 0 255 0 0 0 1530 /end COMPU_METHOD
/begin COMPU_METHOD zw_ub_qn0p75 "" RAT_FUNC "%6.4" "grad KW" COEFFS 0 1 0 0 0 -0.75 /end COMPU_METHOD
/begin RECORD_LAYOUT FklWSb FNC_VALUES 1 SBYTE COLUMN_DIR DIRECT /end RECORD_LAYOUT
/begin RECORD_LAYOUT FklWUb FNC_VALUES 1 UBYTE COLUMN_DIR DIRECT /end RECORD_LAYOUT
/begin RECORD_LAYOUT GklWSb FNC_VALUES 1 SBYTE COLUMN_DIR DIRECT /end RECORD_LAYOUT
/begin RECORD_LAYOUT GklWSw FNC_VALUES 1 SWORD COLUMN_DIR DIRECT /end RECORD_LAYOUT
/begin RECORD_LAYOUT GklWUb FNC_VALUES 1 UBYTE COLUMN_DIR DIRECT /end RECORD_LAYOUT
/begin RECORD_LAYOUT GklWUw FNC_VALUES 1 UWORD COLUMN_DIR DIRECT /end RECORD_LAYOUT
/begin RECORD_LAYOUT KfAxUbAyUbSstxUbSstyUbWUb NO_AXIS_PTS_X 1 UBYTE NO_AXIS_PTS_Y 2 UBYTE AXIS_PTS_X 3 UBYTE INDEX_INCR DIRECT AXIS_PTS_Y 4 UBYTE INDEX_INCR DIRECT FNC_VALUES 5 UBYTE COLUMN_DIR DIRECT /end RECORD_LAYOUT
/begin RECORD_LAYOUT KfAxUbAyUbSstxUbSstyUwWUw NO_AXIS_PTS_X 1 UBYTE NO_AXIS_PTS_Y 2 UBYTE AXIS_PTS_X 3 UBYTE INDEX_INCR DIRECT AXIS_PTS_Y 4 UWORD INDEX_INCR DIRECT FNC_VALUES 5 UWORD COLUMN_DIR DIRECT /end RECORD_LAYOUT
/begin RECORD_LAYOUT KlASwSstSwWSw NO_AXIS_PTS_X 1 SWORD AXIS_PTS_X 2 SWORD INDEX_INCR DIRECT FNC_VALUES 3 SWORD COLUMN_DIR DIRECT /end RECORD_LAYOUT
/begin RECORD_LAYOUT KlAUbSstSbWSb NO_AXIS_PTS_X 1 UBYTE AXIS_PTS_X 2 SBYTE INDEX_INCR DIRECT FNC_VALUES 3 SBYTE COLUMN_DIR DIRECT /end RECORD_LAYOUT
/begin RECORD_LAYOUT KlAUbSstUbWSb NO_AXIS_PTS_X 1 UBYTE AXIS_PTS_X 2 UBYTE INDEX_INCR DIRECT FNC_VALUES 3 SBYTE COLUMN_DIR DIRECT /end RECORD_LAYOUT
/begin RECORD_LAYOUT KlAUbSstUbWUb NO_AXIS_PTS_X 1 UBYTE AXIS_PTS_X 2 UBYTE INDEX_INCR DIRECT FNC_VALUES 3 UBYTE COLUMN_DIR DIRECT /end RECORD_LAYOUT
/begin RECORD_LAYOUT KlAUbSstUbWUw NO_AXIS_PTS_X 1 UBYTE AXIS_PTS_X 2 UBYTE INDEX_INCR DIRECT FNC_VALUES 3 UWORD COLUMN_DIR DIRECT /end RECORD_LAYOUT
/begin RECORD_LAYOUT KlAUwSstSwWUw NO_AXIS_PTS_X 1 UWORD AXIS_PTS_X 2 SWORD INDEX_INCR DIRECT FNC_VALUES 3 UWORD COLUMN_DIR DIRECT /end RECORD_LAYOUT
/begin RECORD_LAYOUT KlAUwSstUwWUw NO_AXIS_PTS_X 1 UWORD AXIS_PTS_X 2 UWORD INDEX_INCR DIRECT FNC_VALUES 3 UWORD COLUMN_DIR DIRECT /end RECORD_LAYOUT
/begin RECORD_LAYOUT KwbUb FNC_VALUES 1 UBYTE COLUMN_DIR DIRECT /end RECORD_LAYOUT
/begin RECORD_LAYOUT KwSb FNC_VALUES 1 SBYTE COLUMN_DIR DIRECT /end RECORD_LAYOUT
/begin RECORD_LAYOUT KwSw FNC_VALUES 1 SWORD COLUMN_DIR DIRECT /end RECORD_LAYOUT
/begin RECORD_LAYOUT KwUb FNC_VALUES 1 UBYTE COLUMN_DIR DIRECT /end RECORD_LAYOUT
/begin RECORD_LAYOUT KwUw FNC_VALUES 1 UWORD COLUMN_DIR DIRECT /end RECORD_LAYOUT
/begin RECORD_LAYOUT SstAUbSstSb NO_AXIS_PTS_X 1 UBYTE AXIS_PTS_X 2 SBYTE INDEX_INCR DIRECT /end RECORD_LAYOUT
/begin RECORD_LAYOUT SstAUbSstUb NO_AXIS_PTS_X 1 UBYTE AXIS_PTS_X 2 UBYTE INDEX_INCR DIRECT /end RECORD_LAYOUT
/begin RECORD_LAYOUT SstAUwSstUw NO_AXIS_PTS_X 1 UWORD AXIS_PTS_X 2 UWORD INDEX_INCR DIRECT /end RECORD_LAYOUT
/end MODULE
/end PROJECT
