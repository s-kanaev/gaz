/*** Created by DAM2ASAP Version 2.18E, 2nd February 2001 ***/
ASAP2_VERSION 1 3
/begin PROJECT _ " [ME.ME3.1C.09.4111.DAMOS25]  DAMPAR_04"
/begin HEADER "Lancia Thesis 5-Zyl. 2,4 MT" PROJECT_NO 411.1 VERSION "P2FJGD66" /end HEADER
/begin MODULE DIM " "
/begin MOD_PAR "PGM-Stand vom: 10-JUL-2002 16:15" VERSION "P2FJGD66 10-JUL-02 Mit Korr. Checkyte 200ms nach Kl15 ein senden" ADDR_EPK 0xFFFF EPK "" CUSTOMER_NO "09" USER "Dupré" PHONE_NO "1385" ECU "ME3.1" CPU_TYPE "S80166"
 /begin CALIBRATION_METHOD "DSERAP" 1 /begin CALIBRATION_HANDLE 0x8000 0x5BFE /end CALIBRATION_HANDLE /end CALIBRATION_METHOD
 /begin MEMORY_LAYOUT PRG_CODE 0x0 0x8000 -1 -1 -1 -1 -1 /begin IF_DATA ASAP1B_ETK DP_BLOB 0x0 0x8000 /end IF_DATA /begin IF_DATA ASAP1B_MCMESS DP_BLOB 0x0 0x8000 /end IF_DATA /end MEMORY_LAYOUT
 /begin MEMORY_LAYOUT PRG_CODE 0x10000 0x70000 -1 -1 -1 -1 -1 /begin IF_DATA ASAP1B_ETK DP_BLOB 0x10000 0x70000 /end IF_DATA /begin IF_DATA ASAP1B_MCMESS DP_BLOB 0x10000 0x70000 /end IF_DATA /end MEMORY_LAYOUT
 /begin MEMORY_LAYOUT PRG_DATA 0x8000 0x8000 -1 -1 -1 -1 -1 /begin IF_DATA ASAP1B_ETK DP_BLOB 0x8000 0x8000 /end IF_DATA /begin IF_DATA ASAP1B_MCMESS DP_BLOB 0x8000 0x8000 /end IF_DATA /end MEMORY_LAYOUT
/end MOD_PAR
/begin MOD_COMMON " " S_REC_LAYOUT DAMOS DEPOSIT ABSOLUTE BYTE_ORDER MSB_LAST /end MOD_COMMON
/begin IF_DATA ASAP1B_ETK
 /begin SOURCE "Synchro" 103 1 QP_BLOB 1 16 0x8000 0xB0180 0xB0000 1 0 0 /end SOURCE
 /begin SOURCE "10ms" 4 1 QP_BLOB 2 24 0x8032 0xB0198 0xB0204 10 0 0 /end SOURCE
 /begin SOURCE "100ms" 5 1 QP_BLOB 3 32 0x8074 0xB01B8 0xB0206 100 0 0 /end SOURCE
 /begin TP_BLOB 0xB0200 1 39 12 2 0xDF90 0x4 0xB01F8 0x4 0 0 ETK_CFG 0xF 0xF0 0xFF 0x2 0xFF 0xFE 0xFF 0x1 EXRAM 0xB0000 0xB7FFF -1 -1 -1 -1 -1 /end TP_BLOB
/end IF_DATA
/begin IF_DATA ASAP1B_MCMESS
 /begin SOURCE "HandShake" 103 1 QP_BLOB HANDSHAKE 0 /end SOURCE
 /begin SOURCE "Block Zuendsynchr" 103 1 QP_BLOB ANGLE 0 /end SOURCE
 /begin SOURCE "Zeitsynchr." 103 1 QP_BLOB TIME 0 /end SOURCE
 /begin TP_BLOB 0x0101 KOMKEN 7 MCTGT 0x10 MCINI KW2000 CYLCNAME xx NOOFCYL 5 CYLSEQU "" XRAMOF 0 /begin CHECKSUM_PARAM 0x8001 CHECKSUM_CALCULATION WORKING_PAGE /end CHECKSUM_PARAM /begin DEFINED_PAGES 1 "Referencepage" FLASH NO_FLASH_BACK /end DEFINED_PAGES /begin DEFINED_PAGES 2 "Workingpage" RAM RAM_INIT_BY_TOOL /end DEFINED_PAGES BYTE_ORDER MSB_LAST THREE_BYTE_ADDRESSES /end TP_BLOB
/end IF_DATA
/begin COMPU_METHOD BSCHL_S5L "Darstellung -6.25 bis 6.249 " RAT_FUNC "%5.3" "g" COEFFS 0 5242.000000 3.276800e+04 0 0.000000 1.000000 /end COMPU_METHOD
/begin COMPU_METHOD B_DEZ "log Zustand" TAB_VERB "%7.5" "" COMPU_TAB_REF B_DEZ /end COMPU_METHOD
/begin COMPU_METHOD B_TRUE "True" TAB_VERB "%7.5" "" COMPU_TAB_REF B_TRUE /end COMPU_METHOD
/begin COMPU_METHOD CLU_TMP "Ansaugluft-Temperatur" TAB_INTP "%7.3" "grd C" COMPU_TAB_REF CLU_TMP /end COMPU_METHOD
/begin COMPU_METHOD CMO_TMP "Motor-Temperatur (invers)" TAB_INTP "%7.3" "Grad C" COMPU_TAB_REF CMO_TMP /end COMPU_METHOD
/begin COMPU_METHOD DEZ "  Dezimalzahl in Hexzahl" RAT_FUNC "%3.0" "" COEFFS 0 1.000000 0.000000 0 0.000000 1.000000 /end COMPU_METHOD
/begin COMPU_METHOD DEZ7 "  Dezimalzahl in Hexzahl von 0-7" RAT_FUNC "%4.2" "" COEFFS 0 1.000000 0.000000 0 0.000000 1.000000 /end COMPU_METHOD
/begin COMPU_METHOD DEZL "  Dezimalzahl in 16-Bit-Hexzahl" RAT_FUNC "%5.0" "" COEFFS 0 1.000000 0.000000 0 0.000000 1.000000 /end COMPU_METHOD
/begin COMPU_METHOD FAK_UB_B2 " 8-Bit-Hexwerte " RAT_FUNC "%9.7" "  " COEFFS 0 256.000000 0.000000 0 0.000000 2.000000 /end COMPU_METHOD
/begin COMPU_METHOD FKT0001 "  Quantisierung mit 0.01 " RAT_FUNC "%7.5" "" COEFFS 0 1.000000 0.000000 0 0.000000 1.000000e-02 /end COMPU_METHOD
/begin COMPU_METHOD FKT128 "  Umsetzung des Intervalles [0;<2]" RAT_FUNC "%6.4" "" COEFFS 0 128.000000 0.000000 0 0.000000 1.000000 /end COMPU_METHOD
/begin COMPU_METHOD FKT128_S " Umsetzung des Intervalles [-1;1] fuer signed byte" RAT_FUNC "%8.6" "" COEFFS 0 127.000000 0.000000 0 0.000000 1.000000 /end COMPU_METHOD
/begin COMPU_METHOD FKT256 "  Umsetzung des Intervalles [0;<1]" RAT_FUNC "%6.4" "" COEFFS 0 256.000000 0.000000 0 0.000000 1.000000 /end COMPU_METHOD
/begin COMPU_METHOD FKT32 "  Umsetzung des Intervalles [0;<8]" RAT_FUNC "%6.4" "" COEFFS 0 32.000000 0.000000 0 0.000000 1.000000 /end COMPU_METHOD
/begin COMPU_METHOD FKT32768 "  Umsetzung des Intervalles [0;<2]" RAT_FUNC "%9.7" "" COEFFS 0 3.276800e+04 0.000000 0 0.000000 1.000000 /end COMPU_METHOD
/begin COMPU_METHOD FKT4096L "  Umsetzung des Intervalles [0-16]" RAT_FUNC "%6.3" "" COEFFS 0 4096.000000 0.000000 0 0.000000 1.000000 /end COMPU_METHOD
/begin COMPU_METHOD FKT51 "  Umsetzung des Intervalles [0;< 4.980]" RAT_FUNC "%7.5" "" COEFFS 0 51.200000 0.000000 0 0.000000 1.000000 /end COMPU_METHOD
/begin COMPU_METHOD FPC50L "  Korrekturfaktor fuer Aenderung um 50 [%] , 16 Bit" RAT_FUNC "%8.6" "" COEFFS 0 6.553600e+04 -3.276800e+04 0 0.000000 1.000000 /end COMPU_METHOD
/begin COMPU_METHOD FREQ_512SL "16-Bit Darstellung -512 ... 512 1/s " RAT_FUNC "%9.5" "1/s" COEFFS 0 6.553600e+04 0.000000 0 0.000000 1024.000000 /end COMPU_METHOD
/begin COMPU_METHOD KM_L "  Kilometerstand 16-Bit, 1km/Ink" RAT_FUNC "%5.0" "km" COEFFS 0 1.000000 0.000000 0 0.000000 1.000000 /end COMPU_METHOD
/begin COMPU_METHOD LUQ_S8 "  Laufunruhe (vorzeichenbehaftet)" RAT_FUNC "%7.4" "(Umdr./sec)^2" COEFFS 0 1.000000 0.000000 0 0.000000 7.366900e-01 /end COMPU_METHOD
/begin COMPU_METHOD MLQ002 "  Luftmasse mit 0.0200[kg] quantisiert" RAT_FUNC "%5.3" "kg" COEFFS 0 1.000000 0.000000 0 0.000000 2.000000e-02 /end COMPU_METHOD
/begin COMPU_METHOD MLQ010L "  Luftmassen-Durchsatz, 16 Bit mit 0.1000[kg/h] quantisiert" RAT_FUNC "%7.2" "kg/h" COEFFS 0 1.000000 0.000000 0 0.000000 1.000000e-01 /end COMPU_METHOD
/begin COMPU_METHOD MLQ360L "  Luftmassen-Durchsatz mit Faktor  360.0[g] " RAT_FUNC "%7.3" "g" COEFFS 0 360.000000 0.000000 0 0.000000 1.000000 /end COMPU_METHOD
/begin COMPU_METHOD MLSMQ "MLE mit  4.000 Kg/h quantisiert" RAT_FUNC "%7.2" "kg/h" COEFFS 0 1.000000 0.000000 0 0.000000 4.000000 /end COMPU_METHOD
/begin COMPU_METHOD MMQ "Motor-Momentquantisierung " RAT_FUNC "%5.1" "Nm" COEFFS 0 1.000000 0.000000 0 0.000000 2.000000 /end COMPU_METHOD
/begin COMPU_METHOD M_UB_B1020 " Massenfluß in 8-Bit-Hexwerten " RAT_FUNC "%4.0" " kg/h " COEFFS 0 1.000000 0.000000 0 0.000000 4.000000 /end COMPU_METHOD
/begin COMPU_METHOD NGRDQ50S "  Drehzahlgradient mit 50 Upm/sec quantisiert (signed)" RAT_FUNC "%6.1" "Upm/sec" COEFFS 0 1.000000 6400.000000 0 0.000000 50.000000 /end COMPU_METHOD
/begin COMPU_METHOD NQ025PN "  Drehzahlquantisierung 0.25[Upm]" RAT_FUNC "%4.0" "Upm" COEFFS 0 4.000000 0.000000 0 0.000000 1.000000 /end COMPU_METHOD
/begin COMPU_METHOD NQ1_W "  Drehzahlquantisierung  1.000[Upm]" RAT_FUNC "%4.0" "Upm" COEFFS 0 1.000000 0.000000 0 0.000000 1.000000 /end COMPU_METHOD
/begin COMPU_METHOD NQ25 "  Drehzahlquantisierung  25.00[Upm]" RAT_FUNC "%4.0" "Upm" COEFFS 0 1.000000 0.000000 0 0.000000 25.000000 /end COMPU_METHOD
/begin COMPU_METHOD NQ40 "  Drehzahlquantisierung  40.00[Upm]" RAT_FUNC "%5.0" "Upm" COEFFS 0 1.000000 0.000000 0 0.000000 40.000000 /end COMPU_METHOD
/begin COMPU_METHOD PCENT "  Prozent" RAT_FUNC "%5.2" "%" COEFFS 0 256.000000 0.000000 0 0.000000 100.000000 /end COMPU_METHOD
/begin COMPU_METHOD PER0327 "percent" RAT_FUNC "%7.3" "%" COEFFS 0 327.670000 0.000000 0 0.000000 1.000000 /end COMPU_METHOD
/begin COMPU_METHOD PER0327LS "Prozentumrechnung mit  327.7[%/ms] signed-word quantisiert" RAT_FUNC "%7.3" "%/10ms" COEFFS 0 327.670000 0.000000 0 0.000000 1.000000 /end COMPU_METHOD
/begin COMPU_METHOD PER0327PN "percent -100 - +100" RAT_FUNC "%7.3" "%" COEFFS 0 327.670000 0.000000 0 0.000000 1.000000 /end COMPU_METHOD
/begin COMPU_METHOD PER255 "percent" RAT_FUNC "%7.3" "%" COEFFS 0 255.000000 0.000000 0 0.000000 100.000000 /end COMPU_METHOD
/begin COMPU_METHOD PER25T10MS "Prozentumrechnung mit  5.120[%/ms] als signed" RAT_FUNC "%7.4" "%/10ms" COEFFS 0 5.119840 0.000000 0 0.000000 1.000000 /end COMPU_METHOD
/begin COMPU_METHOD PER_DKA "percent" RAT_FUNC "%7.3" "%" COEFFS 0 215.000000 0.000000 0 0.000000 100.000000 /end COMPU_METHOD
/begin COMPU_METHOD R_UB_Q64 " Widerstand in 8-Bit-Hexwerten " RAT_FUNC "%5.0" " Ohm " COEFFS 0 1.000000 0.000000 0 0.000000 64.000000 /end COMPU_METHOD
/begin COMPU_METHOD R_UW_Q2 " Widerstand in 16-Bit-Hexwerten " RAT_FUNC "%6.0" " Ohm " COEFFS 0 1.000000 0.000000 0 0.000000 2.000000 /end COMPU_METHOD
/begin COMPU_METHOD SENSORB "8 BIT Sensorsignal" RAT_FUNC "%7.5" "V" COEFFS 0 256.000000 0.000000 0 0.000000 5.000000 /end COMPU_METHOD
/begin COMPU_METHOD SENSORW "16 BIT Sensorsignal" RAT_FUNC "%7.5" "V" COEFFS 0 6.553600e+04 0.000000 0 0.000000 5.000000 /end COMPU_METHOD
/begin COMPU_METHOD SPGG_Q0P52 "8Bit Umsetzung des Intervalles 0..132,6 mV/ms" RAT_FUNC "%5.1" "mV/ms" COEFFS 0 1.000000 0.000000 0 0.000000 5.200000e-01 /end COMPU_METHOD
/begin COMPU_METHOD SPG_UB_B5 " Spannung in 8-Bit-Hexwerten " RAT_FUNC "%9.7" " V " COEFFS 0 256.000000 0.000000 0 0.000000 5.000000 /end COMPU_METHOD
/begin COMPU_METHOD TEQL "  Quantisierung von te, 16 Bit mit  0.267E-2[ms]" RAT_FUNC "%7.3" "ms" COEFFS 0 1.000000 0.000000 0 0.000000 2.666700e-03 /end COMPU_METHOD
/begin COMPU_METHOD TEQ_32 "  Quantisierung von tlw 8 Bit mit 0.0853[ms]" RAT_FUNC "%7.4" "ms" COEFFS 0 1.000000 0.000000 0 0.000000 8.533300e-02 /end COMPU_METHOD
/begin COMPU_METHOD TEQ_CPL "  Quantisierung von te, 16 Bitmit  0.267E-2[ms]" RAT_FUNC "%9.6" "ms" COEFFS 0 1.000000 0.000000 0 0.000000 2.666666e-03 /end COMPU_METHOD
/begin COMPU_METHOD TQ100 "  Zeitquantisierung mit 100[ms]" RAT_FUNC "%4.1" "sec" COEFFS 0 10.000000 0.000000 0 0.000000 1.000000 /end COMPU_METHOD
/begin COMPU_METHOD TQ100L "  Zeitquantisierung mit 100[ms]" RAT_FUNC "%7.2" "sec" COEFFS 0 10.000000 0.000000 0 0.000000 1.000000 /end COMPU_METHOD
/begin COMPU_METHOD TQ10L "  Zeitquantisierung mit 10[ms]" RAT_FUNC "%6.2" "sec" COEFFS 0 100.000000 0.000000 0 0.000000 1.000000 /end COMPU_METHOD
/begin COMPU_METHOD TQ10MSSL "  Zeitquantisierung mit 10[ms] 16Bit-signed" RAT_FUNC "%7.3" "sec" COEFFS 0 100.000000 0.000000 0 0.000000 1.000000 /end COMPU_METHOD
/begin COMPU_METHOD TQ40 "  Zeitquantisierung mit 40[ms]" RAT_FUNC "%5.2" "sec" COEFFS 0 25.000000 0.000000 0 0.000000 1.000000 /end COMPU_METHOD
/begin COMPU_METHOD TQ50L "  Zeitquantisierung mit 50[ms]" RAT_FUNC "%9.4" "sec" COEFFS 0 20.000000 0.000000 0 0.000000 1.000000 /end COMPU_METHOD
/begin COMPU_METHOD TQT1L "  Zeitquantisierung mit [2.666 us]" RAT_FUNC "%6.2" "ms" COEFFS 0 1.000000 0.000000 0 0.000000 2.666700e-03 /end COMPU_METHOD
/begin COMPU_METHOD U0V_1V25 "8Bit Umsetzung des Spannungsintervalles 0..1,245V" RAT_FUNC "%5.3" "V" COEFFS 0 256.000000 0.000000 0 0.000000 1.250000 /end COMPU_METHOD
/begin COMPU_METHOD U0V_1V33 "8Bit Umsetzung des Spannungsintervalles 0..1,33V" RAT_FUNC "%5.3" "V" COEFFS 0 255.000000 0.000000 0 0.000000 1.330000 /end COMPU_METHOD
/begin COMPU_METHOD U0V_1V33L "16-Bit Umsetzung des Spannungsintervalles 0..1,33V" RAT_FUNC "%7.5" "V" COEFFS 0 65535.000000 0.000000 0 0.000000 1.330000 /end COMPU_METHOD
/begin COMPU_METHOD U5V "  Batteriespannung mit 5V quantisiert" RAT_FUNC "%5.3" "V" COEFFS 0 255.000000 0.000000 0 0.000000 5.000000 /end COMPU_METHOD
/begin COMPU_METHOD UBQ "  Batteriespannung mit 0.0942[V] quantisiert" RAT_FUNC "%5.2" "V" COEFFS 0 1.000000 0.000000 0 0.000000 9.421700e-02 /end COMPU_METHOD
/begin COMPU_METHOD UDCLR "  Umrechnung Spannung mit 0.0196 quantisiert" RAT_FUNC "%7.5" "V" COEFFS 0 1.000000 0.000000 0 0.000000 1.960000e-02 /end COMPU_METHOD
/begin COMPU_METHOD UDKL "Drosselklappenwinkel" RAT_FUNC "%7.4" "grad DK" COEFFS 0 3.276800e+04 0.000000 0 0.000000 80.916000 /end COMPU_METHOD
/begin COMPU_METHOD UDWDK "Drosselklappenwinkeländerung" RAT_FUNC "%7.4" "grad DK/20ms" COEFFS 0 256.000000 0.000000 0 0.000000 80.916000 /end COMPU_METHOD
/begin COMPU_METHOD UEBV_L "vn-Quotient, d.h. Geschwindigkeit bei 1000 U/min" RAT_FUNC "%8.4" "1 (km/h) / (1/min)" COEFFS 0 2.621440e+05 0.000000 0 0.000000 1000.000000 /end COMPU_METHOD
/begin COMPU_METHOD UFUELL "Umrechnung fuer Fuellungsgrad" RAT_FUNC "%7.3" "%" COEFFS 0 255.000000 0.000000 0 0.000000 191.250000 /end COMPU_METHOD
/begin COMPU_METHOD ULSQ "  Lambdasonden-Spannung ohne Offset" RAT_FUNC "%7.5" "V" COEFFS 0 51.000000 0.000000 0 0.000000 1.000000 /end COMPU_METHOD
/begin COMPU_METHOD ULSQL "  Lambdasonden-Spannung ohne Offset" RAT_FUNC "%7.5" "V" COEFFS 0 13107.000000 0.000000 0 0.000000 1.000000 /end COMPU_METHOD
/begin COMPU_METHOD UTABG "Abgastemperatur" RAT_FUNC "%7.3" "grad C" COEFFS 0 1.000000 48.000000 0 0.000000 4.000000 /end COMPU_METHOD
/begin COMPU_METHOD UTMP_40 "  lineare Temperatur + Offset" RAT_FUNC "%6.2" "grd C" COEFFS 0 1.000000 40.000000 0 0.000000 1.000000 /end COMPU_METHOD
/begin COMPU_METHOD UWDK "Drosselklappenwinkel" RAT_FUNC "%7.4" "grad DK" COEFFS 0 256.000000 0.000000 0 0.000000 80.916000 /end COMPU_METHOD
/begin COMPU_METHOD VFZG_Q1P0 " Geschwindigkeit in 8-Bit-Hexwerten " RAT_FUNC "%3.0" " km/h " COEFFS 0 1.000000 0.000000 0 0.000000 1.000000 /end COMPU_METHOD
/begin COMPU_METHOD VQV "  Fahrgeschwindigkeit mit Faktor  0.833 [km/h]" RAT_FUNC "%5.1" "km/h" COEFFS 0 8.333300e-01 0.000000 0 0.000000 1.000000 /end COMPU_METHOD
/begin COMPU_METHOD VQV16L "  Geschwindigkeitsumrechnung mit Faktor  16.00 [km/h]" RAT_FUNC "%6.1" "km/h" COEFFS 0 16.000000 0.000000 0 0.000000 1.000000 /end COMPU_METHOD
/begin COMPU_METHOD ZWKOOF "  Zuendwinkelkorrektur mit Offset mit  0.750[grad KW] quantisiert" RAT_FUNC "%5.2" "grad KW" COEFFS 0 1.000000 96.000000 0 0.000000 7.500000e-01 /end COMPU_METHOD
/begin COMPU_METHOD ZWQ "  Zuendwinkel ohne Offset mit  0.750[grad KW] quantisiert" RAT_FUNC "%6.2" "grad KW" COEFFS 0 1.000000 0.000000 0 0.000000 7.500000e-01 /end COMPU_METHOD
/begin COMPU_TAB CLU_TMP "" TAB_INTP 41 3 -50.000000 4 -45.000000 5 -40.000000 7 -35.000000 10 -30.000000 13 -25.000000 16 -20.000000 21 -15.000000 26 -10.000000 32 -5.000000 38 0.000000 46 5.000000 55 10.000000 64 15.000000 74 20.000000 84 25.000000 95 30.000000 106 35.000000 117 40.000000 128 45.000000 139 50.000000 149 55.000000 158 60.000000 167 65.000000 175 70.000000 183 75.000000 190 80.000000 196 85.000000 202 90.000000 207 95.000000 212 100.000000 216 105.000000 220 110.000000 223 115.000000 226 120.000000 229 125.000000 231 130.000000 233 135.000000 235 140.000000 237 145.000000 239 150.000000 /end COMPU_TAB
/begin COMPU_TAB CMO_TMP "" TAB_INTP 21 0 -41.000000 5 -40.000000 9 -30.000000 15 -20.150000 24 -10.120000 36 -0.140000 53 9.940000 73 19.980000 84 24.980000 95 30.020000 118 39.970000 141 49.980000 162 60.000000 180 70.080000 195 80.030000 207 90.000000 217 99.960000 225 109.910000 231 120.250000 236 129.640000 255 140.000000 /end COMPU_TAB
/begin COMPU_VTAB B_DEZ "" TAB_VERB 2 0 "0" 1 "1" /end COMPU_VTAB
/begin COMPU_VTAB B_TRUE "" TAB_VERB 2 0 "----" 1 "TRUE" /end COMPU_VTAB
/begin MEASUREMENT DZWSPAET " " UBYTE ZWQ 0 0 0.000000 191.250000 ECU_ADDRESS 0x67F BIT_MASK 0xFF /end MEASUREMENT
/begin MEASUREMENT FDKHA "Hoehenabhg. DK-Adaptionsfaktor" UBYTE FKT128 0 0 0.000000 1.992190 ECU_ADDRESS 0x2002 BIT_MASK 0xFF /end MEASUREMENT
/begin MEASUREMENT GANG "Gänge vom Getriebe mit Speicherung bei getretener Kupplung " UBYTE DEZ7 0 0 0.000000 7.000000 ECU_ADDRESS 0x4AB BIT_MASK 0xFF /end MEASUREMENT
/begin MEASUREMENT GANG_I "Gänge vom Getriebe" UBYTE DEZ7 0 0 0.000000 7.000000 ECU_ADDRESS 0x4F3 BIT_MASK 0xFF /end MEASUREMENT
/begin MEASUREMENT MLSM "MLE" UBYTE MLSMQ 0 0 0.000000 1024.000000 ECU_ADDRESS 0xF72C BIT_MASK 0xFF /end MEASUREMENT
/begin MEASUREMENT NGRTN "Drehzahlgradient mit 50upm/s segmentsynchron erfasst" UBYTE NGRDQ50S 0 0 -6400.000000 6350.000000 ECU_ADDRESS 0xF953 BIT_MASK 0xFF /end MEASUREMENT
/begin MEASUREMENT NIST "Drehzahl " UBYTE NQ25 0 0 0.000000 6400.000000 ECU_ADDRESS 0xF72B BIT_MASK 0xFF /end MEASUREMENT
/begin MEASUREMENT NMOT "Motordrehzahl " UBYTE NQ40 0 0 0.000000 10200.000000 ECU_ADDRESS 0xF74B BIT_MASK 0xFF /end MEASUREMENT
/begin MEASUREMENT SWPT "Pedal- u. Tempomatsollwert " UBYTE PER255 0 0 0.000000 100.000000 ECU_ADDRESS 0xF73B BIT_MASK 0xFF /end MEASUREMENT
/begin MEASUREMENT SWRES "" UBYTE PER255 0 0 0.000000 100.000000 ECU_ADDRESS 0xF73F BIT_MASK 0xFF /end MEASUREMENT
/begin MEASUREMENT TABGM "" UBYTE UTABG 0 0 -48.000000 972.000000 ECU_ADDRESS 0x673 BIT_MASK 0xFF /end MEASUREMENT
/begin MEASUREMENT TABGMFH "" UBYTE UTABG 0 0 -48.000000 972.000000 ECU_ADDRESS 0x6A3 BIT_MASK 0xFF /end MEASUREMENT
/begin MEASUREMENT TANS "Ansauglufttemperatur" UBYTE CLU_TMP 0 0 -50.000000 150.000000 ECU_ADDRESS 0xF70E BIT_MASK 0xFF /end MEASUREMENT
/begin MEASUREMENT TKATM "" UBYTE UTABG 0 0 -48.000000 972.000000 ECU_ADDRESS 0x675 BIT_MASK 0xFF /end MEASUREMENT
/begin MEASUREMENT TKATMFH "" UBYTE UTABG 0 0 -48.000000 972.000000 ECU_ADDRESS 0x6A1 BIT_MASK 0xFF /end MEASUREMENT
/begin MEASUREMENT TL8 "Last " UBYTE UFUELL 0 0 0.000000 191.250000 ECU_ADDRESS 0xF72D BIT_MASK 0xFF /end MEASUREMENT
/begin MEASUREMENT TL8Z "Last " UBYTE UFUELL 0 0 0.000000 191.250000 ECU_ADDRESS 0xF964 BIT_MASK 0xFF /end MEASUREMENT
/begin MEASUREMENT TMDMM "Motortemperaturmodell" UBYTE UTMP_40 0 0 -40.000000 216.000000 ECU_ADDRESS 0xA02 BIT_MASK 0xFF /end MEASUREMENT
/begin MEASUREMENT TMOT "Motor-Temperatur " UBYTE CMO_TMP 0 0 -41.000000 140.000000 ECU_ADDRESS 0xF70D BIT_MASK 0xFF /end MEASUREMENT
/begin MEASUREMENT TMST "Motor-Temperatur beim Start " UBYTE CMO_TMP 0 0 -41.000000 140.000000 ECU_ADDRESS 0x258 BIT_MASK 0xFF /end MEASUREMENT
/begin MEASUREMENT UBATT "Batteriespannung " UBYTE UBQ 0 0 0.000000 24.119600 ECU_ADDRESS 0xF70C BIT_MASK 0xFF /end MEASUREMENT
/begin MEASUREMENT VFZG "Geschwindigkeitssignal ueber Impulse" UBYTE VQV 0 0 0.000000 306.000000 ECU_ADDRESS 0x27E BIT_MASK 0xFF /end MEASUREMENT
/begin MEASUREMENT V_CAN "V_CAN " UBYTE VQV 0 0 0.000000 306.000000 ECU_ADDRESS 0x27E BIT_MASK 0xFF /end MEASUREMENT
/begin MEASUREMENT WDKBL "Winkel" UBYTE UWDK 0 0 0.000000 80.599900 ECU_ADDRESS 0xF72F BIT_MASK 0xFF /end MEASUREMENT
/begin MEASUREMENT AHKAT1 "Mittelwert der Amplitude Sondensignal hK, korr. mit KB Bank1" UBYTE FKT256 0 0 0.000000 0.996090 ECU_ADDRESS 0xB218A BIT_MASK 0xFF /end MEASUREMENT
/begin MEASUREMENT AHKAT2 "Mittelwert der Amplitude Sondensignal hK, korr. mit KB Bank2" UBYTE FKT256 0 0 0.000000 0.996090 ECU_ADDRESS 0xB218B BIT_MASK 0xFF /end MEASUREMENT
/begin MEASUREMENT AHKATN1 "Ampl. Sondensp. hinter Kat normiert Bank1" UBYTE FKT256 0 0 0.000000 0.996090 ECU_ADDRESS 0xB0876 BIT_MASK 0xFF /end MEASUREMENT
/begin MEASUREMENT AKATBN1 "Amplitude des Katalysatorbelastungssignas Bank1" UBYTE FKT256 0 0 0.000000 0.996090 ECU_ADDRESS 0xB087A BIT_MASK 0xFF /end MEASUREMENT
/begin MEASUREMENT AKATBN2 "Amplitude des Katalysatorbelastungssignals Bank2" UBYTE FKT256 0 0 0.000000 0.996090 ECU_ADDRESS 0xB087B BIT_MASK 0xFF /end MEASUREMENT
/begin MEASUREMENT AKATBNK1 "Amplitude des Kat-Belastungssignals nach KF-Multiplikation Bank1" UBYTE FKT256 0 0 0.000000 0.996090 ECU_ADDRESS 0xB087C BIT_MASK 0xFF /end MEASUREMENT
/begin MEASUREMENT AKATBNK2 "Amplitude des Kat-Belastungssignals nach KF-Multiplikation Bank2" UBYTE FKT256 0 0 0.000000 0.996090 ECU_ADDRESS 0xB087D BIT_MASK 0xFF /end MEASUREMENT
/begin MEASUREMENT ANZNMAX " Anzahl der Fahrten in Drehzahlbegrenzung" UBYTE DEZ 0 0 0.000000 256.000000 ECU_ADDRESS 0xB2B18 BIT_MASK 0xFF /end MEASUREMENT
/begin MEASUREMENT APEDKT " Zaehler Anzahl der Pruefungen mit Fehlerergebnis bei Katdiagn." UBYTE DEZ 0 0 0.000000 256.000000 ECU_ADDRESS 0xB088A BIT_MASK 0xFF /end MEASUREMENT
/begin MEASUREMENT ATVFETT " atv-Verschiebung nach fett" UBYTE TQ40 0 0 0.000000 10.200000 ECU_ADDRESS 0xB214A BIT_MASK 0xFF /end MEASUREMENT
/begin MEASUREMENT ATVH1 "LR-Integrator hinter Kat, Bank1 high" SWORD TQ10MSSL 0 0 -327.680000 327.670000 ECU_ADDRESS 0xB2006 BIT_MASK 0xFFFF /end MEASUREMENT
/begin MEASUREMENT ATVH2 "LR-Integrator hinter Kat, Bank2 high" SWORD TQ10MSSL 0 0 -327.680000 327.670000 ECU_ADDRESS 0xB200A BIT_MASK 0xFFFF /end MEASUREMENT
/begin MEASUREMENT ATVMAGER " atv-Verschiebung nach mager" UBYTE TQ40 0 0 0.000000 10.200000 ECU_ADDRESS 0xB214B BIT_MASK 0xFF /end MEASUREMENT
/begin MEASUREMENT AVKATF1 "Amplitudenverhaeltnis gefiltert laafh1/laafv1" UBYTE FKT256 0 0 0.000000 0.996090 ECU_ADDRESS 0xB218C BIT_MASK 0xFF /end MEASUREMENT
/begin MEASUREMENT AVKATF2 "Amplitudenverhaeltnis gefiltert laafh2/laafv2" UBYTE FKT256 0 0 0.000000 0.996090 ECU_ADDRESS 0xB218D BIT_MASK 0xFF /end MEASUREMENT
/begin MEASUREMENT BBDCY "Byte fuer Bedingung B_dcy als Triggerevent in DCLA" UBYTE DEZ 0 0 0.000000 256.000000 ECU_ADDRESS 0xB0F9D BIT_MASK 0xFF /end MEASUREMENT
/begin MEASUREMENT BS " Signal Beschleunigungssensor" UWORD BSCHL_S5L 0 0 -6.251050 6.250860 ECU_ADDRESS 0xF978 BIT_MASK 0xFFFF /end MEASUREMENT
/begin MEASUREMENT CTRERF1 "Zaehler fuer Anzahl erkannter Fehler im System seit powerfail" UBYTE DEZ 0 0 0.000000 256.000000 ECU_ADDRESS 0xB1007 BIT_MASK 0xFF /end MEASUREMENT
/begin MEASUREMENT CTRRDY1 "Zaehler fuer Anzahl gepruefter Fehlerpfade im System seit powerfail" UBYTE DEZ 0 0 0.000000 256.000000 ECU_ADDRESS 0xB100A BIT_MASK 0xFF /end MEASUREMENT
/begin MEASUREMENT CTRSFP "Zaehler fuer Anzahl Fehlerpfade im System" UBYTE DEZ 0 0 0.000000 256.000000 ECU_ADDRESS 0xB1009 BIT_MASK 0xFF /end MEASUREMENT
/begin MEASUREMENT CTRZYF0 "Zaehler fuer Anzahl ungepruefter Fehlerpfade im System seit Start" UBYTE DEZ 0 0 0.000000 256.000000 ECU_ADDRESS 0xB100B BIT_MASK 0xFF /end MEASUREMENT
/begin MEASUREMENT CTRZYF1 "Zaehler fuer Anzahl gepruefter Fehlerpfade im System seit Start" UBYTE DEZ 0 0 0.000000 256.000000 ECU_ADDRESS 0xB100C BIT_MASK 0xFF /end MEASUREMENT
/begin MEASUREMENT C_NMAX " Zeitdauer in Drehzahlbegrenzung [100ms/Inc]" UWORD TQ100L 0 0 0.000000 6553.500000 ECU_ADDRESS 0xB2B16 BIT_MASK 0xFFFF /end MEASUREMENT
/begin MEASUREMENT C_NOMACC "Zeit Botschaftsunterbrechung ACC" UWORD TQ10L 0 0 0.000000 655.350000 ECU_ADDRESS 0xB0BE4 BIT_MASK 0xFFFF /end MEASUREMENT
/begin MEASUREMENT C_NOMASR "Zeit Botschaftsunterbrechung ASR" UWORD TQ10L 0 0 0.000000 655.350000 ECU_ADDRESS 0xB0BE0 BIT_MASK 0xFFFF /end MEASUREMENT
/begin MEASUREMENT C_NOMBC "Zeit Botschaftsunterbrechung NBC" UWORD TQ10L 0 0 0.000000 655.350000 ECU_ADDRESS 0xB0BDE BIT_MASK 0xFFFF /end MEASUREMENT
/begin MEASUREMENT C_NOMEGS "Zeit Botschaftsunterbrechung EGS" UWORD TQ10L 0 0 0.000000 655.350000 ECU_ADDRESS 0xB0BE2 BIT_MASK 0xFFFF /end MEASUREMENT
/begin MEASUREMENT C_NOMHACC " Heilungszaehler ACC CAN Fehler" UWORD TQ10L 0 0 0.000000 655.350000 ECU_ADDRESS 0xB0C10 BIT_MASK 0xFFFF /end MEASUREMENT
/begin MEASUREMENT C_NOMHASR " Heilungszaehler ASR CAN Fehler" UWORD TQ10L 0 0 0.000000 655.350000 ECU_ADDRESS 0xB0C08 BIT_MASK 0xFFFF /end MEASUREMENT
/begin MEASUREMENT C_NOMHBC " Heilungszaehler BC CAN Fehler" UWORD TQ10L 0 0 0.000000 655.350000 ECU_ADDRESS 0xB0C04 BIT_MASK 0xFFFF /end MEASUREMENT
/begin MEASUREMENT C_NOMHEGS " Heilungszaehler EGS CAN Fehler" UWORD TQ10L 0 0 0.000000 655.350000 ECU_ADDRESS 0xB0C0C BIT_MASK 0xFFFF /end MEASUREMENT
/begin MEASUREMENT C_NOMHNBA " Heilungszaehler NBA CAN Fehler" UWORD TQ10L 0 0 0.000000 655.350000 ECU_ADDRESS 0xB0C14 BIT_MASK 0xFFFF /end MEASUREMENT
/begin MEASUREMENT C_NOMNBA "Zeit Botschaftsunterbrechung NBA" UWORD TQ10L 0 0 0.000000 655.350000 ECU_ADDRESS 0xB0BE6 BIT_MASK 0xFFFF /end MEASUREMENT
/begin MEASUREMENT DCLR "DC-Lagereglerausgang" UBYTE UDCLR 0 0 0.000000 4.998000 ECU_ADDRESS 0xB0259 BIT_MASK 0xFF /end MEASUREMENT
/begin MEASUREMENT DCYCNT "Driving cycle - counter" UWORD DEZL 0 0 0.000000 65535.000000 ECU_ADDRESS 0xB25B8 BIT_MASK 0xFFFF /end MEASUREMENT
/begin MEASUREMENT DFH "gefilterte Geschwindigkeit hinten links" UWORD VQV16L 0 0 0.000000 4095.940000 ECU_ADDRESS 0xB027C BIT_MASK 0xFFFF /end MEASUREMENT
/begin MEASUREMENT DFV "gefilterte Geschwindigkeit vorne links" UWORD VQV16L 0 0 0.000000 4095.940000 ECU_ADDRESS 0xB027A BIT_MASK 0xFFFF /end MEASUREMENT
/begin MEASUREMENT DKATAKT1_W "DKATAW1: Integrator1 Output Bank1" UWORD TQ50L 0 0 0.000000 3276.750000 ECU_ADDRESS 0xB08A2 BIT_MASK 0xFFFF /end MEASUREMENT
/begin MEASUREMENT DKATAKT2_W "DKATAW2: Integrator2 Output Bank2" UWORD TQ50L 0 0 0.000000 3276.750000 ECU_ADDRESS 0xB08A4 BIT_MASK 0xFFFF /end MEASUREMENT
/begin MEASUREMENT DKUAN "unterer Anschlag, auch waehrend Lernvorgang aktiv" UWORD DEZL 0 0 0.000000 65535.000000 ECU_ADDRESS 0xB065E BIT_MASK 0xFFFF /end MEASUREMENT
/begin MEASUREMENT DKUANSP "Speicher fuer unteren elektr. Anschlag" UWORD DEZL 0 0 0.000000 65535.000000 ECU_ADDRESS 0xB2E48 BIT_MASK 0xFFFF /end MEASUREMENT
/begin MEASUREMENT DKVRES "Resultierende DK-Vorgabe mit LL-Vorgabe" UWORD PER0327 0 0 0.000000 100.000000 ECU_ADDRESS 0xB0B9C BIT_MASK 0xFFFF /end MEASUREMENT
/begin MEASUREMENT DKVRES8 "Resultierende DK-Vorgabe mit LL-Vorgabe (Byte)" UBYTE PER255 0 0 0.000000 100.000000 ECU_ADDRESS 0xB0B9B BIT_MASK 0xFF /end MEASUREMENT
/begin MEASUREMENT DKVRESTC "normierte DK-Vorgabe fuer EGS-Eingriff" UBYTE PER255 0 0 0.000000 100.000000 ECU_ADDRESS 0xB059E BIT_MASK 0xFF /end MEASUREMENT
/begin MEASUREMENT DKV_R "Drosselklappenvorgabe rechte Zylinderbank" UWORD UDKL 0 0 0.000000 10.112000 ECU_ADDRESS 0xB0652 BIT_MASK 0xFFFF /end MEASUREMENT
/begin MEASUREMENT DLURS " Differenzbildung Referenzwert" SBYTE LUQ_S8 0 0 -94.296300 93.559600 ECU_ADDRESS 0xB07AD BIT_MASK 0xFF /end MEASUREMENT
/begin MEASUREMENT DLUTS1 "dluts(zyl)" SBYTE LUQ_S8 0 0 -94.296300 93.559600 ECU_ADDRESS 0xB079B BIT_MASK 0xFF /end MEASUREMENT
/begin MEASUREMENT DLUTS2 "dluts(zyl)" SBYTE LUQ_S8 0 0 -94.296300 93.559600 ECU_ADDRESS 0xB079C BIT_MASK 0xFF /end MEASUREMENT
/begin MEASUREMENT DLUTS3 "dluts(zyl)" SBYTE LUQ_S8 0 0 -94.296300 93.559600 ECU_ADDRESS 0xB079D BIT_MASK 0xFF /end MEASUREMENT
/begin MEASUREMENT DLUTS4 "dluts(zyl)" SBYTE LUQ_S8 0 0 -94.296300 93.559600 ECU_ADDRESS 0xB079E BIT_MASK 0xFF /end MEASUREMENT
/begin MEASUREMENT DLUTS5 "dluts(zyl)" SBYTE LUQ_S8 0 0 -94.296300 93.559600 ECU_ADDRESS 0xB079F BIT_MASK 0xFF /end MEASUREMENT
/begin MEASUREMENT DLUTS6 "dluts(zyl)" SBYTE LUQ_S8 0 0 -94.296300 93.559600 ECU_ADDRESS 0xB07A0 BIT_MASK 0xFF /end MEASUREMENT
/begin MEASUREMENT DLUTS7 "dluts(zyl)" SBYTE LUQ_S8 0 0 -94.296300 93.559600 ECU_ADDRESS 0xB07A1 BIT_MASK 0xFF /end MEASUREMENT
/begin MEASUREMENT DLUTS8 "dluts(zyl)" SBYTE LUQ_S8 0 0 -94.296300 93.559600 ECU_ADDRESS 0xB07A2 BIT_MASK 0xFF /end MEASUREMENT
/begin MEASUREMENT DLUT_AP "Ausgabe von DLUTS aus Trommel" SBYTE LUQ_S8 0 0 -94.296300 93.559600 ECU_ADDRESS 0xF9A6 BIT_MASK 0xFF /end MEASUREMENT
/begin MEASUREMENT DNAB "Offset auf NWE zur Berechnung v. NAB" UBYTE NQ25 0 0 0.000000 6400.000000 ECU_ADDRESS 0xB049B BIT_MASK 0xFF /end MEASUREMENT
/begin MEASUREMENT DRBL " Diagnose Bremsschalter" UBYTE DEZ 0 0 0.000000 256.000000 ECU_ADDRESS 0xB21D0 BIT_MASK 0xFF /end MEASUREMENT
/begin MEASUREMENT DRDTV1 " Diagnosebits fuer LR-Adaption ti-additiv, Bank1" UBYTE DEZ 0 0 0.000000 256.000000 ECU_ADDRESS 0xB21D4 BIT_MASK 0xFF /end MEASUREMENT
/begin MEASUREMENT DRDVE " Diagnose-Bits DK-Steller" UBYTE DEZ 0 0 0.000000 256.000000 ECU_ADDRESS 0xB21A4 BIT_MASK 0xFF /end MEASUREMENT
/begin MEASUREMENT DRFRA1 " Diagnosebits fuer LR-Adaption multiplikativ, Bank1" UBYTE DEZ 0 0 0.000000 256.000000 ECU_ADDRESS 0xB21D3 BIT_MASK 0xFF /end MEASUREMENT
/begin MEASUREMENT DRHSHE " Endstufen-Diagnosebits Sondenheizer hinter Kat Bank1" UBYTE DEZ 0 0 0.000000 256.000000 ECU_ADDRESS 0xB21CD BIT_MASK 0xFF /end MEASUREMENT
/begin MEASUREMENT DRHSVE " Endstufen-Diagnosebits Sondenheizer v. Kat" UBYTE DEZ 0 0 0.000000 256.000000 ECU_ADDRESS 0xB21CC BIT_MASK 0xFF /end MEASUREMENT
/begin MEASUREMENT DRIPDK " Diagnose-Bits Istwertpoti" UBYTE DEZ 0 0 0.000000 256.000000 ECU_ADDRESS 0xB21A5 BIT_MASK 0xFF /end MEASUREMENT
/begin MEASUREMENT DRRSKA " Diagnose reversible Sicherheitskraftstoffabschalten" UBYTE DEZ 0 0 0.000000 256.000000 ECU_ADDRESS 0xB21A8 BIT_MASK 0xFF /end MEASUREMENT
/begin MEASUREMENT DRSKAUM " Diagnose Sicherheitskraftstoffab. von Ueberwachungsfkt." UBYTE DEZ 0 0 0.000000 256.000000 ECU_ADDRESS 0xB21A9 BIT_MASK 0xFF /end MEASUREMENT
/begin MEASUREMENT DRSWE " Diagnose Schlechtwegerkennung" UBYTE DEZ 0 0 0.000000 256.000000 ECU_ADDRESS 0xB21D5 BIT_MASK 0xFF /end MEASUREMENT
/begin MEASUREMENT DRTRA1 " Diagnosebits fuer LR-Adaption QL-additiv, Bank1" UBYTE DEZ 0 0 0.000000 256.000000 ECU_ADDRESS 0xB21D2 BIT_MASK 0xFF /end MEASUREMENT
/begin MEASUREMENT DTLW " Delta des Lastersatzwertes" UBYTE TEQ_32 0 0 0.000000 21.760000 ECU_ADDRESS 0xB0CB0 BIT_MASK 0xFF /end MEASUREMENT
/begin MEASUREMENT DTV_B1 "'fmt:530' LRA-Integrator Bank1 addit. Korr.-Faktor f. EV-Fehler" SWORD TEQ_CPL 0 0 -87.381300 87.378700 ECU_ADDRESS 0xB202A BIT_MASK 0xFFFF /end MEASUREMENT
/begin MEASUREMENT DTV_B2 "'fmt:530' LRA-Integrator Bank2 addit. Korr.-Faktor f. EV-Fehler" SWORD TEQ_CPL 0 0 -87.381300 87.378700 ECU_ADDRESS 0xB202E BIT_MASK 0xFFFF /end MEASUREMENT
/begin MEASUREMENT DWDKBL "Drosselklappenwinkelaenderung" SBYTE UDWDK 0 0 -40.458000 40.141900 ECU_ADDRESS 0xF730 BIT_MASK 0xFF /end MEASUREMENT
/begin MEASUREMENT DWKRS "Klopf-Sicherheitsspaetverstellung" UBYTE ZWQ 0 0 0.000000 191.250000 ECU_ADDRESS 0xB0468 BIT_MASK 0xFF /end MEASUREMENT
/begin MEASUREMENT EGASPFAD "Pfadidentifier aus EGAS" UBYTE DEZ 0 0 0.000000 256.000000 ECU_ADDRESS 0xB0FB3 BIT_MASK 0xFF /end MEASUREMENT
/begin MEASUREMENT EPCLSTATE "" UBYTE DEZ 0 0 0.000000 256.000000 ECU_ADDRESS 0xB225C BIT_MASK 0xFF /end MEASUREMENT
/begin MEASUREMENT EVSUP1 "Funktionskennungsbyte fuer Ausgabe SAE J1979 Mode2" UBYTE DEZ 0 0 0.000000 256.000000 ECU_ADDRESS 0xB0F9F BIT_MASK 0xFF /end MEASUREMENT
/begin MEASUREMENT FALRDKT "Anforderung Modifikation der LR-Amplitude" UBYTE FKT32 0 0 0.000000 7.968750 ECU_ADDRESS 0xB0887 BIT_MASK 0xFF /end MEASUREMENT
/begin MEASUREMENT FCMEND "Anzahl Eintraege im Fehlerspeicher" UBYTE DEZ 0 0 0.000000 256.000000 ECU_ADDRESS 0xB225E BIT_MASK 0xFF /end MEASUREMENT
/begin MEASUREMENT FDMD_AP "Ausgabe von FLG2 aus Trommel" UBYTE DEZ 0 0 0.000000 256.000000 ECU_ADDRESS 0xF9A7 BIT_MASK 0xFF /end MEASUREMENT
/begin MEASUREMENT FLGLRS " CARB FREEZE FRAME Byte, Bank 1, fuer LR" UBYTE DEZ 0 0 0.000000 256.000000 ECU_ADDRESS 0xB03AD BIT_MASK 0xFF /end MEASUREMENT
/begin MEASUREMENT FLGLRS2 " CARB FREEZE FRAME Byte, Bank 2, fuer LR" UBYTE DEZ 0 0 0.000000 256.000000 ECU_ADDRESS 0xB03AE BIT_MASK 0xFF /end MEASUREMENT
/begin MEASUREMENT FLGTIAB " Statusflag ti-Abschaltung bei kat.-sch. Aussetzern" UBYTE DEZ 0 0 0.000000 256.000000 ECU_ADDRESS 0xB0A2B BIT_MASK 0xFF /end MEASUREMENT
/begin MEASUREMENT FLG_AP " Ausgabe von FLG aus Trommel" UBYTE DEZ 0 0 0.000000 256.000000 ECU_ADDRESS 0xF9A0 BIT_MASK 0xFF /end MEASUREMENT
/begin MEASUREMENT FR2_U "Lambda-Regler-Ausgang" UBYTE FAK_UB_B2 0 0 0.000000 1.992190 ECU_ADDRESS 0xB0FB2 BIT_MASK 0xFF /end MEASUREMENT
/begin MEASUREMENT FRA2_U "multiplikative Gemischkorrektur der Gemischadaption (Byte)" UBYTE FAK_UB_B2 0 0 0.000000 1.992190 ECU_ADDRESS 0xB0FB0 BIT_MASK 0xFF /end MEASUREMENT
/begin MEASUREMENT FRAU_B1 "LRA-Integrator.high Bank1 multipl. Korr.-Faktor" UWORD FPC50L 0 0 0.500000 1.499980 ECU_ADDRESS 0xB200E BIT_MASK 0xFFFF /end MEASUREMENT
/begin MEASUREMENT FRAU_B2 "LRA-Integrator.high Bank2 multipl. Korr.-Faktor" UWORD FPC50L 0 0 0.500000 1.499980 ECU_ADDRESS 0xB2012 BIT_MASK 0xFFFF /end MEASUREMENT
/begin MEASUREMENT FRAZS1 "LRA-Integrator Bank 1 Zwischenwert" UWORD FPC50L 0 0 0.500000 1.499980 ECU_ADDRESS 0xB0946 BIT_MASK 0xFFFF /end MEASUREMENT
/begin MEASUREMENT FRAZS2 "LRA-Integrator Bank 2 Zwischenwert" UWORD FPC50L 0 0 0.500000 1.499980 ECU_ADDRESS 0xB0948 BIT_MASK 0xFFFF /end MEASUREMENT
/begin MEASUREMENT FRA_B1 "LRA-Integrator.low Bank1 multipl. Korr.-Faktor =f(FRAU,FRAO)" UWORD FPC50L 0 0 0.500000 1.499980 ECU_ADDRESS 0xB201C BIT_MASK 0xFFFF /end MEASUREMENT
/begin MEASUREMENT FRA_B2 "LRA-Integrator.low Bank2 multipl. Korr.-Faktor" UWORD FPC50L 0 0 0.500000 1.499980 ECU_ADDRESS 0xB201E BIT_MASK 0xFFFF /end MEASUREMENT
/begin MEASUREMENT FRA_U "multiplikative Gemischkorrektur der Gemischadaption (Byte)" UBYTE FAK_UB_B2 0 0 0.000000 1.992190 ECU_ADDRESS 0xB0FAF BIT_MASK 0xFF /end MEASUREMENT
/begin MEASUREMENT FRMTRIP1_W " Mittelwert des Lambdaregelfaktors fuer Kurztrip Schwingungspruefung hinter Kat" UWORD FKT32768 0 0 0.000000 2.000000 ECU_ADDRESS 0xB0926 BIT_MASK 0xFFFF /end MEASUREMENT
/begin MEASUREMENT FRM_B1 "gefiltertes FR f. Adaption, Bank1" UWORD FPC50L 0 0 0.500000 1.499980 ECU_ADDRESS 0xB03A0 BIT_MASK 0xFFFF /end MEASUREMENT
/begin MEASUREMENT FRM_B2 "gefiltertes FR f. Adaption, Bank2" UWORD FPC50L 0 0 0.500000 1.499980 ECU_ADDRESS 0xB03A4 BIT_MASK 0xFFFF /end MEASUREMENT
/begin MEASUREMENT FR_B1 " Lambda-Korrekturfaktor Bank1" UWORD FPC50L 0 0 0.500000 1.499980 ECU_ADDRESS 0xF722 BIT_MASK 0xFFFF /end MEASUREMENT
/begin MEASUREMENT FR_B2 " Lambda-Korrekturfaktor Bank2" UWORD FPC50L 0 0 0.500000 1.499980 ECU_ADDRESS 0xF724 BIT_MASK 0xFFFF /end MEASUREMENT
/begin MEASUREMENT FR_U "Lambda-Regler-Ausgang (Byte)" UBYTE FAK_UB_B2 0 0 0.000000 1.992190 ECU_ADDRESS 0xB0FB1 BIT_MASK 0xFF /end MEASUREMENT
/begin MEASUREMENT IMLATM "Integral Luftmasse" UBYTE MLQ002 0 0 0.000000 5.100000 ECU_ADDRESS 0xB067A BIT_MASK 0xFF /end MEASUREMENT
/begin MEASUREMENT IP1S "Istwertpoti 1" UBYTE PER255 0 0 0.000000 100.000000 ECU_ADDRESS 0xB0255 BIT_MASK 0xFF /end MEASUREMENT
/begin MEASUREMENT IP1SN "DK-Istwert vom Poti 1 umgerechnet auf steigende Gerade o. u. Anschlag" UBYTE PER_DKA 0 0 0.000000 100.000000 ECU_ADDRESS 0xB06FA BIT_MASK 0xFF /end MEASUREMENT
/begin MEASUREMENT IP1SUAN "IP1S-Wert am unteren DK-Anschlag" UBYTE PER255 0 0 0.000000 100.000000 ECU_ADDRESS 0xB0668 BIT_MASK 0xFF /end MEASUREMENT
/begin MEASUREMENT IP2S "Istwertpoti 2" UBYTE PER255 0 0 0.000000 100.000000 ECU_ADDRESS 0xB0256 BIT_MASK 0xFF /end MEASUREMENT
/begin MEASUREMENT IP2SN "DK-Istwert vom Poti 2 umgerechnet auf steigende Gerade o. u. Anschlag" UBYTE PER_DKA 0 0 0.000000 100.000000 ECU_ADDRESS 0xB06FB BIT_MASK 0xFF /end MEASUREMENT
/begin MEASUREMENT IP2SUAN "IP2S-Wert am unteren DK-Anschlag" UBYTE PER255 0 0 0.000000 100.000000 ECU_ADDRESS 0xB0669 BIT_MASK 0xFF /end MEASUREMENT
/begin MEASUREMENT IPSN_FR " momentaner DK-Istwert vom FR" UBYTE PER_DKA 0 0 0.000000 100.000000 ECU_ADDRESS 0xB06FC BIT_MASK 0xFF /end MEASUREMENT
/begin MEASUREMENT KAKBMT " Multiplikationsfaktor fuer Kat-Belastungssignal" UBYTE FKT128 0 0 0.000000 1.992190 ECU_ADDRESS 0xB087E BIT_MASK 0xFF /end MEASUREMENT
/begin MEASUREMENT KATBF1 "Signal1 nach Speicher normiert Bank1" UBYTE U0V_1V33 0 0 0.000000 1.330000 ECU_ADDRESS 0xB0878 BIT_MASK 0xFF /end MEASUREMENT
/begin MEASUREMENT KATBFI1_W "AKATB1: Belastungssignal nach Filter Bank1" SWORD FREQ_512SL 0 0 -512.000000 511.984000 ECU_ADDRESS 0xB08A6 BIT_MASK 0xFFFF /end MEASUREMENT
/begin MEASUREMENT KATBFS1 "Signal nach Speicher (Kat- Modell) Bank1" SBYTE FKT128_S 0 0 -1.000000 1.000000 ECU_ADDRESS 0xB0883 BIT_MASK 0xFF /end MEASUREMENT
/begin MEASUREMENT KFRTV_R " signed LR-TV-Zeit aus KFRTV" SWORD TQ10MSSL 0 0 -327.680000 327.670000 ECU_ADDRESS 0xB0392 BIT_MASK 0xFFFF /end MEASUREMENT
/begin MEASUREMENT KMSTMIL_W " 'Kilometerstand' in [1km/Inc]" UWORD KM_L 0 0 0.000000 65535.000000 ECU_ADDRESS 0xB2B14 BIT_MASK 0xFFFF /end MEASUREMENT
/begin MEASUREMENT KRNT "Klopfintegral Nulltest" UWORD SENSORW 0 0 0.000000 4.999920 ECU_ADDRESS 0xB0460 BIT_MASK 0xFFFF /end MEASUREMENT
/begin MEASUREMENT KTI1INT "Klopfintegral Testimpuls Eingang 1" UWORD SENSORW 0 0 0.000000 4.999920 ECU_ADDRESS 0xB045C BIT_MASK 0xFFFF /end MEASUREMENT
/begin MEASUREMENT KTI2INT "Klopfintegral Testimpuls Eingang 2" UWORD SENSORW 0 0 0.000000 4.999920 ECU_ADDRESS 0xB045E BIT_MASK 0xFFFF /end MEASUREMENT
/begin MEASUREMENT KVSFNS " Mode6 Ablagewert" UWORD DEZL 0 0 0.000000 65535.000000 ECU_ADDRESS 0xB203C BIT_MASK 0xFFFF /end MEASUREMENT
/begin MEASUREMENT KVSFNS2 " Mode6 Ablagewert" UWORD DEZL 0 0 0.000000 65535.000000 ECU_ADDRESS 0xB204C BIT_MASK 0xFFFF /end MEASUREMENT
/begin MEASUREMENT KVSFNW " Mode6 Ablagewert" UWORD DEZL 0 0 0.000000 65535.000000 ECU_ADDRESS 0xB203A BIT_MASK 0xFFFF /end MEASUREMENT
/begin MEASUREMENT KVSFNW2 " Mode6 Ablagewert" UWORD DEZL 0 0 0.000000 65535.000000 ECU_ADDRESS 0xB204A BIT_MASK 0xFFFF /end MEASUREMENT
/begin MEASUREMENT KVSFXS " Mode6 Ablagewert" UWORD DEZL 0 0 0.000000 65535.000000 ECU_ADDRESS 0xB2038 BIT_MASK 0xFFFF /end MEASUREMENT
/begin MEASUREMENT KVSFXS2 " Mode6 Ablagewert" UWORD DEZL 0 0 0.000000 65535.000000 ECU_ADDRESS 0xB2048 BIT_MASK 0xFFFF /end MEASUREMENT
/begin MEASUREMENT KVSFXW " Mode6 Ablagewert" UWORD DEZL 0 0 0.000000 65535.000000 ECU_ADDRESS 0xB2036 BIT_MASK 0xFFFF /end MEASUREMENT
/begin MEASUREMENT KVSFXW2 " Mode6 Ablagewert" UWORD DEZL 0 0 0.000000 65535.000000 ECU_ADDRESS 0xB2046 BIT_MASK 0xFFFF /end MEASUREMENT
/begin MEASUREMENT KVSTNS " Mode6 Ablagewert" UWORD DEZL 0 0 0.000000 65535.000000 ECU_ADDRESS 0xB2044 BIT_MASK 0xFFFF /end MEASUREMENT
/begin MEASUREMENT KVSTNS2 " Mode6 Ablagewert" UWORD DEZL 0 0 0.000000 65535.000000 ECU_ADDRESS 0xB2054 BIT_MASK 0xFFFF /end MEASUREMENT
/begin MEASUREMENT KVSTNW " Mode6 Ablagewert" UWORD DEZL 0 0 0.000000 65535.000000 ECU_ADDRESS 0xB2042 BIT_MASK 0xFFFF /end MEASUREMENT
/begin MEASUREMENT KVSTNW2 " Mode6 Ablagewert" UWORD DEZL 0 0 0.000000 65535.000000 ECU_ADDRESS 0xB2052 BIT_MASK 0xFFFF /end MEASUREMENT
/begin MEASUREMENT KVSTXS " Mode6 Ablagewert" UWORD DEZL 0 0 0.000000 65535.000000 ECU_ADDRESS 0xB2040 BIT_MASK 0xFFFF /end MEASUREMENT
/begin MEASUREMENT KVSTXS2 " Mode6 Ablagewert" UWORD DEZL 0 0 0.000000 65535.000000 ECU_ADDRESS 0xB2050 BIT_MASK 0xFFFF /end MEASUREMENT
/begin MEASUREMENT KVSTXW " Mode6 Ablagewert" UWORD DEZL 0 0 0.000000 65535.000000 ECU_ADDRESS 0xB203E BIT_MASK 0xFFFF /end MEASUREMENT
/begin MEASUREMENT KVSTXW2 " Mode6 Ablagewert" UWORD DEZL 0 0 0.000000 65535.000000 ECU_ADDRESS 0xB204E BIT_MASK 0xFFFF /end MEASUREMENT
/begin MEASUREMENT LAGE_F_C "Fehlerzaehler bei DK-Lagefehler" UBYTE TQ100 0 0 0.000000 25.500000 ECU_ADDRESS 0xB06AA BIT_MASK 0xFF /end MEASUREMENT
/begin MEASUREMENT LAMFRM1_W " Lambdaabweichung aus Mittelwert des Lambdaregelfaktors" UWORD FKT4096L 0 0 0.000000 16.000000 ECU_ADDRESS 0xB0928 BIT_MASK 0xFFFF /end MEASUREMENT
/begin MEASUREMENT LAMLASH1_W " Lambdasoll fuer Test Schwingungspruefung hinter Kat" UWORD FKT4096L 0 0 0.000000 16.000000 ECU_ADDRESS 0xB092A BIT_MASK 0xFFFF /end MEASUREMENT
/begin MEASUREMENT LAMSONS1_W " Lambdasoll bezogen auf Einbauort Lambda-Sensor aus %LAMKO" UWORD FKT4096L 0 0 0.000000 16.000000 ECU_ADDRESS 0xB092C BIT_MASK 0xFFFF /end MEASUREMENT
/begin MEASUREMENT LRNSTEP_C " Zaehler fuer Lernsteps" UBYTE DEZ 0 0 0.000000 256.000000 ECU_ADDRESS 0xB0667 BIT_MASK 0xFF /end MEASUREMENT
/begin MEASUREMENT LRNWERT "Lernwert" UWORD DEZL 0 0 0.000000 65535.000000 ECU_ADDRESS 0xB0662 BIT_MASK 0xFFFF /end MEASUREMENT
/begin MEASUREMENT LUT "aktueller LUT-Wert" SBYTE LUQ_S8 0 0 -94.296300 93.559600 ECU_ADDRESS 0xF9B1 BIT_MASK 0xFF /end MEASUREMENT
/begin MEASUREMENT MFEOFS "Klopfintegrator-Wert nach Test-MF aus KRTI" UWORD SENSORW 0 0 0.000000 4.999920 ECU_ADDRESS 0xB0458 BIT_MASK 0xFFFF /end MEASUREMENT
/begin MEASUREMENT MI_DUF " Istmoment beim Ansprechen des Momentenvergleichs in der Funktionsueberwachung" UBYTE MMQ 0 0 0.000000 512.000000 ECU_ADDRESS 0xE02A BIT_MASK 0xFF /end MEASUREMENT
/begin MEASUREMENT MI_UM " Istmoment" UBYTE MMQ 0 0 0.000000 512.000000 ECU_ADDRESS 0xE02A BIT_MASK 0xFF /end MEASUREMENT
/begin MEASUREMENT ML "Luftmassenfluss" UBYTE M_UB_B1020 0 0 0.000000 1020.000000 ECU_ADDRESS 0xF72C BIT_MASK 0xFF /end MEASUREMENT
/begin MEASUREMENT MLDYN_W " Luftmassenintegral im Schubbetrieb" UWORD MLQ360L 0 0 0.000000 182.042000 ECU_ADDRESS 0xB092E BIT_MASK 0xFFFF /end MEASUREMENT
/begin MEASUREMENT MLSMS "16-Bit Luftmasse ungefiltert" UWORD MLQ010L 0 0 0.000000 6553.500000 ECU_ADDRESS 0xF954 BIT_MASK 0xFFFF /end MEASUREMENT
/begin MEASUREMENT MLSMW "16-Bit Luftmasse gefiltert" UWORD MLQ010L 0 0 0.000000 6553.500000 ECU_ADDRESS 0xF956 BIT_MASK 0xFFFF /end MEASUREMENT
/begin MEASUREMENT MPFAD "Pfadidentifier aus Momentenbildung" UBYTE DEZ 0 0 0.000000 256.000000 ECU_ADDRESS 0xB0FB4 BIT_MASK 0xFF /end MEASUREMENT
/begin MEASUREMENT NAB "Abschaltedrehzahl" UBYTE NQ25 0 0 0.000000 6400.000000 ECU_ADDRESS 0xB049A BIT_MASK 0xFF /end MEASUREMENT
/begin MEASUREMENT NFI "TP-Filterausgang Vorkommastelle" UBYTE NQ25 0 0 0.000000 6400.000000 ECU_ADDRESS 0xB04A9 BIT_MASK 0xFF /end MEASUREMENT
/begin MEASUREMENT NIST_1U "Drehzahl" UWORD NQ1_W 0 0 0.000000 8000.000000 ECU_ADDRESS 0xF94A BIT_MASK 0xFFFF /end MEASUREMENT
/begin MEASUREMENT NWE "Wiedereinsetzdrehzahl" UBYTE NQ25 0 0 0.000000 6400.000000 ECU_ADDRESS 0xB049C BIT_MASK 0xFF /end MEASUREMENT
/begin MEASUREMENT N_RDIF " Regelabweichung 0.25U/min" SWORD NQ025PN 0 0 -8192.000000 8191.750000 ECU_ADDRESS 0xB0C76 BIT_MASK 0xFFFF /end MEASUREMENT
/begin MEASUREMENT OBGR "Obergrenze" UWORD UDKL 0 0 0.000000 10.112000 ECU_ADDRESS 0xB0510 BIT_MASK 0xFFFF /end MEASUREMENT
/begin MEASUREMENT PEDGR "Pedalwertgradient" SWORD PER0327LS 0 0 -100.003000 100.000000 ECU_ADDRESS 0xB04C2 BIT_MASK 0xFFFF /end MEASUREMENT
/begin MEASUREMENT PEDGR8 "Pedalwertgradient 8bit" SBYTE PER25T10MS 0 0 -25.000800 24.805400 ECU_ADDRESS 0xB04CC BIT_MASK 0xFF /end MEASUREMENT
/begin MEASUREMENT PHLSNH "normierte Heizleistung der Lambdasonde hinter Kat" UBYTE FKT0001 0 0 0.000000 2.560000 ECU_ADDRESS 0xB0695 BIT_MASK 0xFF /end MEASUREMENT
/begin MEASUREMENT PHLSNHFH " high_byte gefilterte Heizleistung hinter Kat Bank 1" UBYTE FKT0001 0 0 0.000000 2.560000 ECU_ADDRESS 0xB06A9 BIT_MASK 0xFF /end MEASUREMENT
/begin MEASUREMENT PHLSNV "normierte Heizleistung der Lambdasonde vor Kat" UBYTE FKT0001 0 0 0.000000 2.560000 ECU_ADDRESS 0xB0694 BIT_MASK 0xFF /end MEASUREMENT
/begin MEASUREMENT PHLSNVFH " high_byte gefilterte Heizleistung vor Kat Bank 1" UBYTE FKT0001 0 0 0.000000 2.560000 ECU_ADDRESS 0xB06A7 BIT_MASK 0xFF /end MEASUREMENT
/begin MEASUREMENT PU "Umgebungsdruck" UBYTE DEZ 0 0 0.000000 256.000000 ECU_ADDRESS 0xB0FBB BIT_MASK 0xFF /end MEASUREMENT
/begin MEASUREMENT QUOT " Quotient aus Fahrzeuggeschw. und Drehzahl" UWORD UEBV_L 0 0 0.000000 249.996000 ECU_ADDRESS 0xB17A6 BIT_MASK 0xFFFF /end MEASUREMENT
/begin MEASUREMENT READY "readiness-Byte fuer Ausgabe SAE J1979 Mode2" UBYTE DEZ 0 0 0.000000 256.000000 ECU_ADDRESS 0xB2253 BIT_MASK 0xFF /end MEASUREMENT
/begin MEASUREMENT RINH2_U "Istwert (Byte) Innenwiderstand Ri-Nernstzelle der Lambdasonde hinter KAT Bank2" UBYTE R_UB_Q64 0 0 0.000000 16320.000000 ECU_ADDRESS 0xB0FA8 BIT_MASK 0xFF /end MEASUREMENT
/begin MEASUREMENT RINH2_W "Innenwiderstand Ri Nerst hinter Kat Bank 2" UWORD R_UW_Q2 0 0 0.000000 131070.000000 ECU_ADDRESS 0xB0FFE BIT_MASK 0xFFFF /end MEASUREMENT
/begin MEASUREMENT RINH_U "Istwert (Byte) Innenwiderstand Ri-Nernstzelle der Lambdasonde hinter KAT" UBYTE R_UB_Q64 0 0 0.000000 16320.000000 ECU_ADDRESS 0xB0FA7 BIT_MASK 0xFF /end MEASUREMENT
/begin MEASUREMENT RINH_W "Innenwiderstand Ri Nerst hinter Kat Bank 1" UWORD R_UW_Q2 0 0 0.000000 131070.000000 ECU_ADDRESS 0xB0FFA BIT_MASK 0xFFFF /end MEASUREMENT
/begin MEASUREMENT RINV2_U "Istwert (Byte) Innenwiderstand Ri-Nernstzelle der Lambdasonde vor KAT Bank2" UBYTE R_UB_Q64 0 0 0.000000 16320.000000 ECU_ADDRESS 0xB0FA6 BIT_MASK 0xFF /end MEASUREMENT
/begin MEASUREMENT RINV2_W "Innenwiderstand Ri Nerst vor Kat Bank 2" UWORD R_UW_Q2 0 0 0.000000 131070.000000 ECU_ADDRESS 0xB0FF6 BIT_MASK 0xFFFF /end MEASUREMENT
/begin MEASUREMENT RINV_U "Istwert (Byte) Innenwiderstand Ri-Nernstzelle der Lambdasonde vor KAT" UBYTE R_UB_Q64 0 0 0.000000 16320.000000 ECU_ADDRESS 0xB0FA5 BIT_MASK 0xFF /end MEASUREMENT
/begin MEASUREMENT RINV_W "Innenwiderstand Ri Nerst vor Kat Bank 1" UWORD R_UW_Q2 0 0 0.000000 131070.000000 ECU_ADDRESS 0xB0FF2 BIT_MASK 0xFFFF /end MEASUREMENT
/begin MEASUREMENT RKRN "Absolute(normierte) KR-Referenz" UBYTE SENSORB 0 0 0.000000 4.980470 ECU_ADDRESS 0xB041A BIT_MASK 0xFF /end MEASUREMENT
/begin MEASUREMENT RL "relative Luftfuellung" UBYTE UFUELL 0 0 0.000000 191.250000 ECU_ADDRESS 0xF72D BIT_MASK 0xFF /end MEASUREMENT
/begin MEASUREMENT RML "relative Luftmasse (calc. load value) nach SAE J1979" UBYTE PER255 0 0 0.000000 100.000000 ECU_ADDRESS 0xB0FBC BIT_MASK 0xFF /end MEASUREMENT
/begin MEASUREMENT RSTPFAD "Pfadidentifier aus Reset" UBYTE DEZ 0 0 0.000000 256.000000 ECU_ADDRESS 0xB0FB5 BIT_MASK 0xFF /end MEASUREMENT
/begin MEASUREMENT SFPLASH1 "Status Fehlerpfad: Diagnose Lambdasonde-Alterung hinter Kat" UWORD DEZL 0 0 0.000000 65535.000000 ECU_ADDRESS 0xB258E BIT_MASK 0xFFFF /end MEASUREMENT
/begin MEASUREMENT SFPLATP1 "Status Fehlerpfad: Diagnose Lambdasonde-Alterung TP" UWORD DEZL 0 0 0.000000 65535.000000 ECU_ADDRESS 0xB258A BIT_MASK 0xFFFF /end MEASUREMENT
/begin MEASUREMENT SFPLATV1 "Status Fehlerpfad: Diagnose Lambdasonde-Alterung TV" UWORD DEZL 0 0 0.000000 65535.000000 ECU_ADDRESS 0xB258C BIT_MASK 0xFFFF /end MEASUREMENT
/begin MEASUREMENT SFPPAC "Diagnose Klimadrucksensor" UWORD DEZL 0 0 0.000000 65535.000000 ECU_ADDRESS 0xB25B4 BIT_MASK 0xFFFF /end MEASUREMENT
/begin MEASUREMENT SKAPFAD " SKA-Pfad als Umweltbedingung fuer Funktionsueberwachungs-Diagnoseeintrag" UBYTE DEZ 0 0 0.000000 256.000000 ECU_ADDRESS 0xB21A9 BIT_MASK 0xFF /end MEASUREMENT
/begin MEASUREMENT SP1S "Sollw.-Poti-Schleifer 1 (10 Bit rechtsbuendig)" UWORD DEZL 0 0 0.000000 65535.000000 ECU_ADDRESS 0xB024A BIT_MASK 0xFFFF /end MEASUREMENT
/begin MEASUREMENT SP2S "Sollw.-Poti-Schleifer 2 (10 Bit rechtsbuendig)" UWORD DEZL 0 0 0.000000 65535.000000 ECU_ADDRESS 0xB024C BIT_MASK 0xFFFF /end MEASUREMENT
/begin MEASUREMENT STAT_MD_E "Status Momenteneingriff" UBYTE DEZ 0 0 0.000000 256.000000 ECU_ADDRESS 0xB05EB BIT_MASK 0xFF /end MEASUREMENT
/begin MEASUREMENT STGMW "Stellgroessen-Momentanwert" UWORD UDKL 0 0 0.000000 10.112000 ECU_ADDRESS 0xB0506 BIT_MASK 0xFFFF /end MEASUREMENT
/begin MEASUREMENT SW_ADMB "Sollwert Anfahrdrehmoment-Begrenzung" UWORD PER0327 0 0 0.000000 100.000000 ECU_ADDRESS 0xB0642 BIT_MASK 0xFFFF /end MEASUREMENT
/begin MEASUREMENT SW_ASR "Sollwert ASR" UWORD PER0327 0 0 0.000000 100.000000 ECU_ADDRESS 0xB0648 BIT_MASK 0xFFFF /end MEASUREMENT
/begin MEASUREMENT SW_BVF "Sollwert Beschleunigte Vorbeifahrt" UWORD PER0327 0 0 0.000000 100.000000 ECU_ADDRESS 0xB065A BIT_MASK 0xFFFF /end MEASUREMENT
/begin MEASUREMENT SW_LLR "Leerlauf-Sollwert" UWORD UDKL 0 0 0.000000 10.112000 ECU_ADDRESS 0xB0508 BIT_MASK 0xFFFF /end MEASUREMENT
/begin MEASUREMENT SW_LWB "Sollwert Lastwertbegrenzung" UWORD PER0327 0 0 0.000000 100.000000 ECU_ADDRESS 0xB0644 BIT_MASK 0xFFFF /end MEASUREMENT
/begin MEASUREMENT SW_MAX "NO COMMENT" UWORD PER0327 0 0 0.000000 100.000000 ECU_ADDRESS 0xB0640 BIT_MASK 0xFFFF /end MEASUREMENT
/begin MEASUREMENT SW_MAXN " Speicherwert NMOT max" UWORD PER0327 0 0 0.000000 100.000000 ECU_ADDRESS 0xF988 BIT_MASK 0xFFFF /end MEASUREMENT
/begin MEASUREMENT SW_MAX_N "max. Sollwert als Funktion der Motordrehzahl" UWORD PER0327 0 0 0.000000 100.000000 ECU_ADDRESS 0xB063C BIT_MASK 0xFFFF /end MEASUREMENT
/begin MEASUREMENT SW_MIN "NO COMMENT" UWORD PER0327 0 0 0.000000 100.000000 ECU_ADDRESS 0xB064C BIT_MASK 0xFFFF /end MEASUREMENT
/begin MEASUREMENT SW_MSR "Sollwert MSR" UWORD PER0327 0 0 0.000000 100.000000 ECU_ADDRESS 0xB064A BIT_MASK 0xFFFF /end MEASUREMENT
/begin MEASUREMENT SW_NACHL "Sollwert nach Pedalkenlinie drehzahlbegrenzt" UWORD PER0327 0 0 0.000000 100.000000 ECU_ADDRESS 0xB063E BIT_MASK 0xFFFF /end MEASUREMENT
/begin MEASUREMENT SW_NMAX " Sollwert NMAX" UWORD PER0327 0 0 0.000000 100.000000 ECU_ADDRESS 0xB0C74 BIT_MASK 0xFFFF /end MEASUREMENT
/begin MEASUREMENT SW_NMAXI " Sollwert I-Anteil NMAX" SWORD PER0327PN 0 0 -100.003000 100.000000 ECU_ADDRESS 0xB0C78 BIT_MASK 0xFFFF /end MEASUREMENT
/begin MEASUREMENT SW_NMAXP " Sollwert P-Anteil NMAX" SWORD PER0327PN 0 0 -100.003000 100.000000 ECU_ADDRESS 0xB0C7A BIT_MASK 0xFFFF /end MEASUREMENT
/begin MEASUREMENT SW_PED "normierter Pedal-Sollwert (15 Bit rechtsbuendig)" UWORD PER0327 0 0 0.000000 100.000000 ECU_ADDRESS 0xB04C0 BIT_MASK 0xFFFF /end MEASUREMENT
/begin MEASUREMENT SW_PEDBW "bewerteter Pedal-Sollwert (15 Bit rechtsbuendig)" UWORD PER0327 0 0 0.000000 100.000000 ECU_ADDRESS 0xB02C8 BIT_MASK 0xFFFF /end MEASUREMENT
/begin MEASUREMENT SW_PEDKL "Sollwert nach Pedalkennkinie (15 Bit rechtsbuendig)" UWORD PER0327 0 0 0.000000 100.000000 ECU_ADDRESS 0xB0554 BIT_MASK 0xFFFF /end MEASUREMENT
/begin MEASUREMENT SW_PT " Sollwertmaximum aus Fahrerwunsch und FGR/ACC" UWORD PER0327 0 0 0.000000 100.000000 ECU_ADDRESS 0xB0658 BIT_MASK 0xFFFF /end MEASUREMENT
/begin MEASUREMENT SW_RES "Resultierender Sollwert" UWORD PER0327 0 0 0.000000 100.000000 ECU_ADDRESS 0xB064E BIT_MASK 0xFFFF /end MEASUREMENT
/begin MEASUREMENT SW_TEMP "Tempomat-Sollwert (15 Bit rechtsbuendig)" UWORD PER0327 0 0 0.000000 100.000000 ECU_ADDRESS 0xB04CE BIT_MASK 0xFFFF /end MEASUREMENT
/begin MEASUREMENT SW_VMAX "Sollwert Vmax-Begrenzung" UWORD PER0327 0 0 0.000000 100.000000 ECU_ADDRESS 0xB0646 BIT_MASK 0xFFFF /end MEASUREMENT
/begin MEASUREMENT TABGM2 "Abgastemperatur vor Kat aus Modell Bank2" UBYTE UTABG 0 0 -48.000000 972.000000 ECU_ADDRESS 0xB0FC1 BIT_MASK 0xFF /end MEASUREMENT
/begin MEASUREMENT TANKFST " Fuel Level Quant.: 1% /Inc" UBYTE DEZ 0 0 0.000000 256.000000 ECU_ADDRESS 0xB0C18 BIT_MASK 0xFF /end MEASUREMENT
/begin MEASUREMENT TANSLIN "Linearisierte Lufttemp." UBYTE UTMP_40 0 0 -40.000000 216.000000 ECU_ADDRESS 0xB0297 BIT_MASK 0xFF /end MEASUREMENT
/begin MEASUREMENT TATMSTA "Abgastemperatur vor Kat aus Modell stationaer" UBYTE UTABG 0 0 -48.000000 972.000000 ECU_ADDRESS 0xB067E BIT_MASK 0xFF /end MEASUREMENT
/begin MEASUREMENT TFRN1_W " Zeit FR negativ" UWORD TQ10L 0 0 0.000000 655.350000 ECU_ADDRESS 0xB0364 BIT_MASK 0xFFFF /end MEASUREMENT
/begin MEASUREMENT TFRN2_W " Zeit FR negativ" UWORD TQ10L 0 0 0.000000 655.350000 ECU_ADDRESS 0xB036C BIT_MASK 0xFFFF /end MEASUREMENT
/begin MEASUREMENT TFRP1_W " Zeit FR positiv" UWORD TQ10L 0 0 0.000000 655.350000 ECU_ADDRESS 0xB0366 BIT_MASK 0xFFFF /end MEASUREMENT
/begin MEASUREMENT TFRP2_W " Zeit FR positiv" UWORD TQ10L 0 0 0.000000 655.350000 ECU_ADDRESS 0xB036E BIT_MASK 0xFFFF /end MEASUREMENT
/begin MEASUREMENT TFST "Tankfuellstand" UBYTE DEZ 0 0 0.000000 256.000000 ECU_ADDRESS 0xB0FC3 BIT_MASK 0xFF /end MEASUREMENT
/begin MEASUREMENT TKATM2 "Katalysatortemperatur aus Modell, Bank 2" UBYTE UTABG 0 0 -48.000000 972.000000 ECU_ADDRESS 0xB0FC2 BIT_MASK 0xFF /end MEASUREMENT
/begin MEASUREMENT TL8M "Normierte Last (Quant.=0.5%) fuer Adressierung ZW-Kennfeld" UBYTE UFUELL 0 0 0.000000 191.250000 ECU_ADDRESS 0xF968 BIT_MASK 0xFF /end MEASUREMENT
/begin MEASUREMENT TLR "TL_roh vor Filter phys: TEQL/2 [ms/kwu]" UWORD TEQL 0 0 0.000000 174.760000 ECU_ADDRESS 0xF958 BIT_MASK 0xFFFF /end MEASUREMENT
/begin MEASUREMENT TLS_ADMB "TL-Sollwert fuer Anfahrdrehmoment-Begrenzung" UBYTE UFUELL 0 0 0.000000 191.250000 ECU_ADDRESS 0xB0624 BIT_MASK 0xFF /end MEASUREMENT
/begin MEASUREMENT TLW "Nebenlastsignal Q=32*2.666us" UBYTE TEQ_32 0 0 0.000000 21.760000 ECU_ADDRESS 0xF72E BIT_MASK 0xFF /end MEASUREMENT
/begin MEASUREMENT TLZ "TLZ (=LAST) gefiltert" UWORD TEQL 0 0 0.000000 174.760000 ECU_ADDRESS 0xF962 BIT_MASK 0xFFFF /end MEASUREMENT
/begin MEASUREMENT TMEW "Motortemperatur-Ersatzwert aus Modell" UBYTE CMO_TMP 0 0 -41.000000 140.000000 ECU_ADDRESS 0xB0A01 BIT_MASK 0xFF /end MEASUREMENT
/begin MEASUREMENT TMOTLIN "Linearisierte Motortemp." UBYTE UTMP_40 0 0 -40.000000 216.000000 ECU_ADDRESS 0xB0296 BIT_MASK 0xFF /end MEASUREMENT
/begin MEASUREMENT TMOT_U "Motor-Temperatur mit def. Quantisierung fuer FSP-Umwelten" UBYTE UTMP_40 0 0 -40.000000 216.000000 ECU_ADDRESS 0xB0FAA BIT_MASK 0xFF /end MEASUREMENT
/begin MEASUREMENT TNBM " Zahnperioden" UWORD TQT1L 0 0 0.000000 174.760000 ECU_ADDRESS 0xB1092 BIT_MASK 0xFFFF /end MEASUREMENT
/begin MEASUREMENT TNST "Nachstart-Counter (Start mit B_STEND: 0->1, Begr. auf FFFFH)" UWORD TQ100L 0 0 0.000000 6553.500000 ECU_ADDRESS 0xB0278 BIT_MASK 0xFFFF /end MEASUREMENT
/begin MEASUREMENT TPLRVK1_W " Periodendauer Sonde vor Kat" UWORD TQ10L 0 0 0.000000 655.350000 ECU_ADDRESS 0xB0918 BIT_MASK 0xFFFF /end MEASUREMENT
/begin MEASUREMENT TPOTV1_W " Zwischenergebnis tfrn_w + tfrp_w" UWORD TQ10L 0 0 0.000000 655.350000 ECU_ADDRESS 0xB0916 BIT_MASK 0xFFFF /end MEASUREMENT
/begin MEASUREMENT TPSVKMF2_U "gefilterter Periodendauerwert des Sondensignals vor Kat, Bank2 (Byte)" UBYTE TQ40 0 0 0.000000 10.200000 ECU_ADDRESS 0xB0FA4 BIT_MASK 0xFF /end MEASUREMENT
/begin MEASUREMENT TPSVKMF2_W "gefilterter Periodendauerwert des Sondensignals vor Kat, Bank2 (Word)" UWORD TQ10L 0 0 0.000000 655.350000 ECU_ADDRESS 0xB0920 BIT_MASK 0xFFFF /end MEASUREMENT
/begin MEASUREMENT TPSVKMF_U "gefilterter Periodendauerwert des Sondensignals vor Kat. (Byte)" UBYTE TQ40 0 0 0.000000 10.200000 ECU_ADDRESS 0xB0FA3 BIT_MASK 0xFF /end MEASUREMENT
/begin MEASUREMENT TPSVKMF_W "gefilterter Periodendauerwert des Sondensignals vor Kat. (Word)" UWORD TQ10L 0 0 0.000000 655.350000 ECU_ADDRESS 0xB091E BIT_MASK 0xFFFF /end MEASUREMENT
/begin MEASUREMENT TPSVKOF1_W " Periodendauer Sonde vor Kat, mit Korrektur" UWORD TQ10L 0 0 0.000000 655.350000 ECU_ADDRESS 0xB091A BIT_MASK 0xFFFF /end MEASUREMENT
/begin MEASUREMENT TPSVLSSA " Periodendauer (So.Signal v.K.) fuer DLSSA" UBYTE TQ40 0 0 0.000000 10.200000 ECU_ADDRESS 0xB214C BIT_MASK 0xFF /end MEASUREMENT
/begin MEASUREMENT TRAZS2 "TRA-Integrator Bank 2 Zwischenwert" SWORD TEQ_CPL 0 0 -87.381300 87.378700 ECU_ADDRESS 0xB094C BIT_MASK 0xFFFF /end MEASUREMENT
/begin MEASUREMENT TRA_B1 "'fmt:530' LRA-Integrator Bank1 addit. Korr.-Faktor" SWORD TEQ_CPL 0 0 -87.381300 87.378700 ECU_ADDRESS 0xB2022 BIT_MASK 0xFFFF /end MEASUREMENT
/begin MEASUREMENT TRA_B2 "'fmt:530' LRA-Integrator Bank2 addit. Korr.-Faktor" SWORD TEQ_CPL 0 0 -87.381300 87.378700 ECU_ADDRESS 0xB2026 BIT_MASK 0xFFFF /end MEASUREMENT
/begin MEASUREMENT TSCHUB "Anzahl TFDKHA-Raster im Schub (bei B_SA,B_SZ=1)" UBYTE DEZ 0 0 0.000000 256.000000 ECU_ADDRESS 0xB06DA BIT_MASK 0xFF /end MEASUREMENT
/begin MEASUREMENT TUMG "Umgebungstemperatur" UBYTE DEZ 0 0 0.000000 256.000000 ECU_ADDRESS 0xB0FB6 BIT_MASK 0xFF /end MEASUREMENT
/begin MEASUREMENT TUSPNF " gef. Zeit zw. pos u. neg usvk-Flanke, DLSSA" UBYTE TQ40 0 0 0.000000 10.200000 ECU_ADDRESS 0xB214D BIT_MASK 0xFF /end MEASUREMENT
/begin MEASUREMENT TVEGR " Ausgabetastverhaeltnis" UBYTE PCENT 0 0 0.000000 99.609400 ECU_ADDRESS 0xB0CB1 BIT_MASK 0xFF /end MEASUREMENT
/begin MEASUREMENT TVLRHI1 " tv I-Anteil, Bank1" SWORD TQ10MSSL 0 0 -327.680000 327.670000 ECU_ADDRESS 0xB03B2 BIT_MASK 0xFFFF /end MEASUREMENT
/begin MEASUREMENT TVLRHI2 " tv I-Anteil, Bank2" SWORD TQ10MSSL 0 0 -327.680000 327.670000 ECU_ADDRESS 0xB03B4 BIT_MASK 0xFFFF /end MEASUREMENT
/begin MEASUREMENT TWDLSSA_W " Mindestpruefzeit DLSSA-Extremwertbest." UWORD TQ50L 0 0 0.000000 3276.750000 ECU_ADDRESS 0xB0A58 BIT_MASK 0xFFFF /end MEASUREMENT
/begin MEASUREMENT TWDLSSH_W " Mindestpruefzeit DLSSA-Extremwertbest. h.K." UWORD TQ50L 0 0 0.000000 3276.750000 ECU_ADDRESS 0xB0A5A BIT_MASK 0xFFFF /end MEASUREMENT
/begin MEASUREMENT UB "Batteriespannung" UBYTE UBQ 0 0 0.000000 24.119600 ECU_ADDRESS 0xF70C BIT_MASK 0xFF /end MEASUREMENT
/begin MEASUREMENT UBABW " Ubatt Schwelle fuer Anlasser ausgespurrt" UBYTE UBQ 0 0 0.000000 24.119600 ECU_ADDRESS 0xB1096 BIT_MASK 0xFF /end MEASUREMENT
/begin MEASUREMENT UBGR "Untergrenze (LFR4)" UWORD UDKL 0 0 0.000000 10.112000 ECU_ADDRESS 0xB050A BIT_MASK 0xFFFF /end MEASUREMENT
/begin MEASUREMENT UDKP1_U "Spannung Drosselklappen-Poti 1 (Byte)" UBYTE SPG_UB_B5 0 0 0.000000 4.980470 ECU_ADDRESS 0xB0FAB BIT_MASK 0xFF /end MEASUREMENT
/begin MEASUREMENT UDKP2_U "Spannung Drosselklappen-Poti 2 (Byte)" UBYTE SPG_UB_B5 0 0 0.000000 4.980470 ECU_ADDRESS 0xB0FAC BIT_MASK 0xFF /end MEASUREMENT
/begin MEASUREMENT UDSAC_W " Klimadrucksensorspannung" UBYTE U5V 0 0 0.000000 5.000000 ECU_ADDRESS 0xB1834 BIT_MASK 0xFF /end MEASUREMENT
/begin MEASUREMENT UEBVER "Uebersetzungsverhaeltnis (Gang)" UBYTE FKT51 0 0 0.000000 4.980470 ECU_ADDRESS 0xB0C5B BIT_MASK 0xFF /end MEASUREMENT
/begin MEASUREMENT UHSH "Spannung an Heizerendstufe HK" UBYTE ULSQ 0 0 0.000000 5.000000 ECU_ADDRESS 0xB0FB9 BIT_MASK 0xFF /end MEASUREMENT
/begin MEASUREMENT UHSH2 "Spannung an Heizerendstufe 2 HK" UBYTE ULSQ 0 0 0.000000 5.000000 ECU_ADDRESS 0xB0FBA BIT_MASK 0xFF /end MEASUREMENT
/begin MEASUREMENT UHSV "Spannung an Heizerendstufe VK" UBYTE DEZ 0 0 0.000000 256.000000 ECU_ADDRESS 0xB0FB7 BIT_MASK 0xFF /end MEASUREMENT
/begin MEASUREMENT UHSV2 "Spannung an Heizerendstufe 2 VK" UBYTE DEZ 0 0 0.000000 256.000000 ECU_ADDRESS 0xB0FB8 BIT_MASK 0xFF /end MEASUREMENT
/begin MEASUREMENT UPWG1_U "Spannung PWG-Poti 1 (Byte)" UBYTE SPG_UB_B5 0 0 0.000000 4.980470 ECU_ADDRESS 0xB0FAD BIT_MASK 0xFF /end MEASUREMENT
/begin MEASUREMENT UPWG2D_U "Verdoppelte PWG-Poti-2-Spannung (Byte)" UBYTE SPG_UB_B5 0 0 0.000000 4.980470 ECU_ADDRESS 0xB0FA9 BIT_MASK 0xFF /end MEASUREMENT
/begin MEASUREMENT UPWG2_U "Spannung PWG-Poti 2 (Byte)" UBYTE SPG_UB_B5 0 0 0.000000 4.980470 ECU_ADDRESS 0xB0FAE BIT_MASK 0xFF /end MEASUREMENT
/begin MEASUREMENT USHFMXSTG1 " gefilterte maximale Steigung der Sondenspannung hinter Kat" UBYTE SPGG_Q0P52 0 0 0.000000 132.600000 ECU_ADDRESS 0xB0941 BIT_MASK 0xFF /end MEASUREMENT
/begin MEASUREMENT USHK "Hinterkat-Lambdasonde 1" UBYTE ULSQ 0 0 0.000000 5.000000 ECU_ADDRESS 0xB0245 BIT_MASK 0xFF /end MEASUREMENT
/begin MEASUREMENT USHK1 "Hinterkat-Lambdasonde 1" UBYTE ULSQ 0 0 0.000000 5.000000 ECU_ADDRESS 0xB0245 BIT_MASK 0xFF /end MEASUREMENT
/begin MEASUREMENT USHK1W "Hinterkat-Lambdasonde1" UWORD ULSQL 0 0 0.000000 5.000000 ECU_ADDRESS 0xB0244 BIT_MASK 0xFFFF /end MEASUREMENT
/begin MEASUREMENT USHK2 "Hinterkat-Lambdasonde 2" UBYTE ULSQ 0 0 0.000000 5.000000 ECU_ADDRESS 0xB0247 BIT_MASK 0xFF /end MEASUREMENT
/begin MEASUREMENT USHK2W "Hinterkat-Lambdasonde2" UWORD ULSQL 0 0 0.000000 5.000000 ECU_ADDRESS 0xB0246 BIT_MASK 0xFFFF /end MEASUREMENT
/begin MEASUREMENT USHKB1 " Spannung Lambdasonde hinter Kat, Bank1" UBYTE U0V_1V25 0 0 0.000000 1.245120 ECU_ADDRESS 0xB03C1 BIT_MASK 0xFF /end MEASUREMENT
/begin MEASUREMENT USHKJ " Spng. LS h.K. ohne Offset, DLSSA" UBYTE U0V_1V33 0 0 0.000000 1.330000 ECU_ADDRESS 0xB0A50 BIT_MASK 0xFF /end MEASUREMENT
/begin MEASUREMENT USHKJF_W " gef. Spng. LS h.K. ohne Offset, DLSSA" UWORD U0V_1V33L 0 0 0.000000 1.330000 ECU_ADDRESS 0xB0A5C BIT_MASK 0xFFFF /end MEASUREMENT
/begin MEASUREMENT USHKMXSTG1 " Maximale Steigung der Sondenspannung hinter Kat" UBYTE SPGG_Q0P52 0 0 0.000000 132.600000 ECU_ADDRESS 0xB0942 BIT_MASK 0xFF /end MEASUREMENT
/begin MEASUREMENT USHKSTEIG1 " Steigung der Sondenspannung hinter Kat" UBYTE SPGG_Q0P52 0 0 0.000000 132.600000 ECU_ADDRESS 0xB0943 BIT_MASK 0xFF /end MEASUREMENT
/begin MEASUREMENT USMNSAA " min. erkannte So.sp. v.K. (alt) DLSSA" UBYTE U0V_1V33 0 0 0.000000 1.330000 ECU_ADDRESS 0xB0A51 BIT_MASK 0xFF /end MEASUREMENT
/begin MEASUREMENT USMNSAN " min. erkannte So.sp. v.K. (neu) DLSSA" UBYTE U0V_1V33 0 0 0.000000 1.330000 ECU_ADDRESS 0xB214E BIT_MASK 0xFF /end MEASUREMENT
/begin MEASUREMENT USMNSHA " min. erkannte So.sp. h.K. (alt) DLSSA" UBYTE U0V_1V33 0 0 0.000000 1.330000 ECU_ADDRESS 0xB0A52 BIT_MASK 0xFF /end MEASUREMENT
/begin MEASUREMENT USMNSHN " min. erkannte So.sp. h.K. (neu) DLSSA" UBYTE U0V_1V33 0 0 0.000000 1.330000 ECU_ADDRESS 0xB2150 BIT_MASK 0xFF /end MEASUREMENT
/begin MEASUREMENT USMXSAA " max. erkannte So.sp. v.K. (alt) DLSSA" UBYTE U0V_1V33 0 0 0.000000 1.330000 ECU_ADDRESS 0xB0A53 BIT_MASK 0xFF /end MEASUREMENT
/begin MEASUREMENT USMXSAN " max. erkannte So.sp. v.K. (neu) DLSSA" UBYTE U0V_1V33 0 0 0.000000 1.330000 ECU_ADDRESS 0xB214F BIT_MASK 0xFF /end MEASUREMENT
/begin MEASUREMENT USMXSHN " max. erkannte So.sp. h.K. (neu) DLSSA" UBYTE U0V_1V33 0 0 0.000000 1.330000 ECU_ADDRESS 0xB2151 BIT_MASK 0xFF /end MEASUREMENT
/begin MEASUREMENT USRHK " aktuelle Regelschwelle Lambdasignal hinter Kat" UBYTE U0V_1V25 0 0 0.000000 1.245120 ECU_ADDRESS 0xB03C3 BIT_MASK 0xFF /end MEASUREMENT
/begin MEASUREMENT USRJ " Regelschwelle der LR ohne Offset DLSSA" UBYTE U0V_1V33 0 0 0.000000 1.330000 ECU_ADDRESS 0xB0A55 BIT_MASK 0xFF /end MEASUREMENT
/begin MEASUREMENT USVK "Vorkat-Lambdasonde 1" UBYTE ULSQ 0 0 0.000000 5.000000 ECU_ADDRESS 0xB0241 BIT_MASK 0xFF /end MEASUREMENT
/begin MEASUREMENT USVK1 "Vorkat-Lambdasonde 1" UBYTE ULSQ 0 0 0.000000 5.000000 ECU_ADDRESS 0xB0241 BIT_MASK 0xFF /end MEASUREMENT
/begin MEASUREMENT USVK1W "Vorkat-Lambdasonde1" UWORD ULSQL 0 0 0.000000 5.000000 ECU_ADDRESS 0xB0240 BIT_MASK 0xFFFF /end MEASUREMENT
/begin MEASUREMENT USVK2 "Vorkat-Lambdasonde 2" UBYTE ULSQ 0 0 0.000000 5.000000 ECU_ADDRESS 0xB0243 BIT_MASK 0xFF /end MEASUREMENT
/begin MEASUREMENT USVK2W "Vorkat-Lambdasonde2" UWORD ULSQL 0 0 0.000000 5.000000 ECU_ADDRESS 0xB0242 BIT_MASK 0xFFFF /end MEASUREMENT
/begin MEASUREMENT USVKJ " Spng. LS v.K. ohne Offset, DLSSA" UBYTE U0V_1V33 0 0 0.000000 1.330000 ECU_ADDRESS 0xB0A56 BIT_MASK 0xFF /end MEASUREMENT
/begin MEASUREMENT USVKJF_W " gef. Spng. LS v.K. ohne Offset, DLSSA" UWORD U0V_1V33L 0 0 0.000000 1.330000 ECU_ADDRESS 0xB0A5E BIT_MASK 0xFFFF /end MEASUREMENT
/begin MEASUREMENT VFZG_U "Fahrzeuggeschwindigkeit, mit def. Quantisierung fuer Tester" UBYTE VFZG_Q1P0 0 0 0.000000 255.000000 ECU_ADDRESS 0xB0FA2 BIT_MASK 0xFF /end MEASUREMENT
/begin MEASUREMENT VFZG_W "gefilterte Geschwindigkeit" UWORD VQV16L 0 0 0.000000 4095.940000 ECU_ADDRESS 0xB027A BIT_MASK 0xFFFF /end MEASUREMENT
/begin MEASUREMENT WAR "Zuendwinkel aus Antiruckelfunktion" UBYTE ZWKOOF 0 0 -96.000000 96.000000 ECU_ADDRESS 0xF734 BIT_MASK 0xFF /end MEASUREMENT
/begin MEASUREMENT WARDY "Spaetwinkel aus dynamischer Antiruckelfkt." UBYTE ZWQ 0 0 0.000000 191.250000 ECU_ADDRESS 0xF735 BIT_MASK 0xFF /end MEASUREMENT
/begin MEASUREMENT WDKBA "Winkel Drosselklappe bezogen auf DK-Anschlag" UBYTE UWDK 0 0 0.000000 80.599900 ECU_ADDRESS 0xF72F BIT_MASK 0xFF /end MEASUREMENT
/begin MEASUREMENT WDKS "Sollwert DK-Winkel, bezogen auf unteren Anschlag" UBYTE PER255 0 0 0.000000 100.000000 ECU_ADDRESS 0xB0B9B BIT_MASK 0xFF /end MEASUREMENT
/begin MEASUREMENT WPED "Normierter Fahrpedalwinkel" UBYTE PER255 0 0 0.000000 100.000000 ECU_ADDRESS 0xF73B BIT_MASK 0xFF /end MEASUREMENT
/begin MEASUREMENT ZLASH1_W " Timer fuer Sondenspannung hinter Kat ober/unterhalb des Sollwertes" UWORD TQ100L 0 0 0.000000 6553.500000 ECU_ADDRESS 0xB0934 BIT_MASK 0xFFFF /end MEASUREMENT
/begin MEASUREMENT ZLSATP1 " aktueller Periodenzaehler fuer Ready-Flag der Periodendauerueberwachung" UBYTE DEZ 0 0 0.000000 256.000000 ECU_ADDRESS 0xB090E BIT_MASK 0xFF /end MEASUREMENT
/begin MEASUREMENT ZWDYNSH1 " Zaehler fuer Anzahl der Dynamikmessungen fuer Sonde hinter Kat" UBYTE DEZ 0 0 0.000000 256.000000 ECU_ADDRESS 0xB0944 BIT_MASK 0xFF /end MEASUREMENT
/begin MEASUREMENT ZWGEFLR2 " Ereigniszaehler bei Gemischfehler (Bank 2)" UBYTE DEZ 0 0 0.000000 256.000000 ECU_ADDRESS 0xB2149 BIT_MASK 0xFF /end MEASUREMENT
/begin MEASUREMENT ZWLWS "additiver dynamischer Antiruckelzuendwinkel" UBYTE ZWQ 0 0 0.000000 191.250000 ECU_ADDRESS 0xB04AC BIT_MASK 0xFF /end MEASUREMENT
/begin MEASUREMENT BZSYNC " 1 = bis Bezugsmarke gefunden ist" UWORD B_TRUE 0 0 0.000000 1.000000 ECU_ADDRESS 0xFD10 BIT_MASK 0x2 /end MEASUREMENT
/begin MEASUREMENT B_ABGSTG1 " ml ist innerhalb der Schwellen" UWORD B_TRUE 0 0 0.000000 1.000000 ECU_ADDRESS 0xFD3C BIT_MASK 0x1 /end MEASUREMENT
/begin MEASUREMENT B_ABW " Abwuergen erkannt" UWORD B_TRUE 0 0 0.000000 1.000000 ECU_ADDRESS 0xFDD8 BIT_MASK 0x8 /end MEASUREMENT
/begin MEASUREMENT B_ACCAKT " ACC-Eingriff freigegeben" UWORD B_TRUE 0 0 0.000000 1.000000 ECU_ADDRESS 0xFD70 BIT_MASK 0x80 /end MEASUREMENT
/begin MEASUREMENT B_ACSDH1 " 1 = bank1" UWORD B_TRUE 0 0 0.000000 1.000000 ECU_ADDRESS 0xB086A BIT_MASK 0x10 /end MEASUREMENT
/begin MEASUREMENT B_ACSDH2 " 1 = bank1" UWORD B_TRUE 0 0 0.000000 1.000000 ECU_ADDRESS 0xB086C BIT_MASK 0x10 /end MEASUREMENT
/begin MEASUREMENT B_ADAPFG "1 = Adaptions-Freigabe" UWORD B_TRUE 0 0 0.000000 1.000000 ECU_ADDRESS 0xFD1E BIT_MASK 0x8 /end MEASUREMENT
/begin MEASUREMENT B_ADCSD " 1 = Pruefung Adernschluss und CSD" UWORD B_TRUE 0 0 0.000000 1.000000 ECU_ADDRESS 0xB084E BIT_MASK 0x1000 /end MEASUREMENT
/begin MEASUREMENT B_ADCSD2 " Ausloesung Drive-Recorder Messung " UWORD B_TRUE 0 0 0.000000 1.000000 ECU_ADDRESS 0xB0850 BIT_MASK 0x1000 /end MEASUREMENT
/begin MEASUREMENT B_ADDE " 1 = Adernschluss oder defekte Sonde mit begrenztem Spannungshub" UWORD B_TRUE 0 0 0.000000 1.000000 ECU_ADDRESS 0xB084E BIT_MASK 0x800 /end MEASUREMENT
/begin MEASUREMENT B_ADDE2 " Ausloesung Drive-Recorder Messung " UWORD B_TRUE 0 0 0.000000 1.000000 ECU_ADDRESS 0xB0850 BIT_MASK 0x800 /end MEASUREMENT
/begin MEASUREMENT B_ADMBAKT " Anfahrdrehmoment-Begrenzung aktiv" UWORD B_TRUE 0 0 0.000000 1.000000 ECU_ADDRESS 0xFD9A BIT_MASK 0x800 /end MEASUREMENT
/begin MEASUREMENT B_ADSH1 " 1 = DLSH-B_plaus-Spiegel aus Dauer-Ram Banc1" UWORD B_TRUE 0 0 0.000000 1.000000 ECU_ADDRESS 0xFDF6 BIT_MASK 0x10 /end MEASUREMENT
/begin MEASUREMENT B_ADSH2 " 1 = DLSH-B_plaus-Spiegel aus Dauer-Ram Banc2" UWORD B_TRUE 0 0 0.000000 1.000000 ECU_ADDRESS 0xFDF6 BIT_MASK 0x20 /end MEASUREMENT
/begin MEASUREMENT B_ADSVB "Verbot Betriebsbereitschaft wegen Adernschluss" UBYTE B_TRUE 0 0 0.000000 1.000000 ECU_ADDRESS 0xB2146 BIT_MASK 0x4 /end MEASUREMENT
/begin MEASUREMENT B_AGRRDY " Bedingung AGR geprueft fuer 'ready-Byte'" UBYTE B_TRUE 0 0 0.000000 1.000000 ECU_ADDRESS 0xB2253 BIT_MASK 0x80 /end MEASUREMENT
/begin MEASUREMENT B_AR " 1 = Zuendwinkeleingriff AR aktiv" UWORD B_TRUE 0 0 0.000000 1.000000 ECU_ADDRESS 0xFD12 BIT_MASK 0x4000 /end MEASUREMENT
/begin MEASUREMENT B_ASR " 1 = ASR aktiv" UWORD B_TRUE 0 0 0.000000 1.000000 ECU_ADDRESS 0xFD04 BIT_MASK 0x400 /end MEASUREMENT
/begin MEASUREMENT B_ASRAKT "1 = Motorsollmoment-Reduktion (ASR aktiv)" UWORD B_TRUE 0 0 0.000000 1.000000 ECU_ADDRESS 0xFD26 BIT_MASK 0x4 /end MEASUREMENT
/begin MEASUREMENT B_ATMTPA " Taupunkt ueberschritten vor Kat" UWORD B_TRUE 0 0 0.000000 1.000000 ECU_ADDRESS 0xFD50 BIT_MASK 0x10 /end MEASUREMENT
/begin MEASUREMENT B_ATMTPF " Bedingung Taupunkt vor Kat ueberschritten (last trip)" UWORD B_TRUE 0 0 0.000000 1.000000 ECU_ADDRESS 0xFDFA BIT_MASK 0x4 /end MEASUREMENT
/begin MEASUREMENT B_ATMTPK "Bedingung Taupunkt ueberschritten hinter Kat" UWORD B_TRUE 0 0 0.000000 1.000000 ECU_ADDRESS 0xFDFA BIT_MASK 0x1 /end MEASUREMENT
/begin MEASUREMENT B_ATMTPL " Bedingung Taupunktendezeit abgelaufen (last trip)" UWORD B_TRUE 0 0 0.000000 1.000000 ECU_ADDRESS 0xFDFA BIT_MASK 0x8 /end MEASUREMENT
/begin MEASUREMENT B_BFSP1 " '1' = , Stoppbedingung aus Sauerstoffbeladung Katmodell" UWORD B_TRUE 0 0 0.000000 1.000000 ECU_ADDRESS 0xFD46 BIT_MASK 0x4 /end MEASUREMENT
/begin MEASUREMENT B_BFSP11 " '1' = , Stoppbedingung aus Sauerstoffbeladung Katmodell" UWORD B_TRUE 0 0 0.000000 1.000000 ECU_ADDRESS 0xFD46 BIT_MASK 0x8 /end MEASUREMENT
/begin MEASUREMENT B_BOFDTV1 " 1 = Bedingung im Bereich dtv ohne Fehler Bank1" UWORD B_TRUE 0 0 0.000000 1.000000 ECU_ADDRESS 0xFD7C BIT_MASK 0x800 /end MEASUREMENT
/begin MEASUREMENT B_BOFDTV2 " 1 = Bedingung im Bereich dtv ohne Fehler Bank2" UWORD B_TRUE 0 0 0.000000 1.000000 ECU_ADDRESS 0xFD7C BIT_MASK 0x1000 /end MEASUREMENT
/begin MEASUREMENT B_BOFFRA1 " 1 = Bedingung im Bereich fra ohne Fehler Bank1" UWORD B_TRUE 0 0 0.000000 1.000000 ECU_ADDRESS 0xFD7C BIT_MASK 0x80 /end MEASUREMENT
/begin MEASUREMENT B_BOFFRA2 " 1 = Bedingung im Bereich fra ohne Fehler Bank2" UWORD B_TRUE 0 0 0.000000 1.000000 ECU_ADDRESS 0xFD7C BIT_MASK 0x100 /end MEASUREMENT
/begin MEASUREMENT B_BOFTRA1 " 1 = Bedingung im Bereich tra ohne Fehler Bank1" UWORD B_TRUE 0 0 0.000000 1.000000 ECU_ADDRESS 0xFD7C BIT_MASK 0x200 /end MEASUREMENT
/begin MEASUREMENT B_BOFTRA2 " 1 = Bedingung im Bereich tra ohne Fehler Bank2" UWORD B_TRUE 0 0 0.000000 1.000000 ECU_ADDRESS 0xFD7C BIT_MASK 0x400 /end MEASUREMENT
/begin MEASUREMENT B_BREMSE " 1 = Bremse betaetigt" UWORD B_TRUE 0 0 0.000000 1.000000 ECU_ADDRESS 0xFD0A BIT_MASK 0x80 /end MEASUREMENT
/begin MEASUREMENT B_BVF " beschleunigte Vorbeifahrt" UWORD DEZ 0 0 0.000000 256.000000 ECU_ADDRESS 0xFDAA BIT_MASK 0x20 /end MEASUREMENT
/begin MEASUREMENT B_CDAGR " Funktion ueber Codewort CDAGR freigegeben" UWORD B_TRUE 0 0 0.000000 1.000000 ECU_ADDRESS 0xB1000 BIT_MASK 0x8000 /end MEASUREMENT
/begin MEASUREMENT B_CDHSV " Funktion ueber Codewort CDHSV freigegeben" UWORD B_TRUE 0 0 0.000000 1.000000 ECU_ADDRESS 0xB1000 BIT_MASK 0x40 /end MEASUREMENT
/begin MEASUREMENT B_CDLASH " Funktion ueber Codewort CDLASH freigegeben" UWORD B_TRUE 0 0 0.000000 1.000000 ECU_ADDRESS 0xFD3C BIT_MASK 0x2 /end MEASUREMENT
/begin MEASUREMENT B_CDLATP " '1'= Bit0 Codewort CDWLSA, Funktionsfreigabe" UWORD B_TRUE 0 0 0.000000 1.000000 ECU_ADDRESS 0xFD36 BIT_MASK 0x2 /end MEASUREMENT
/begin MEASUREMENT B_CDLATV " '1'= Bit0 Codewort CDWLSA, Funktionsfreigabe" UWORD B_TRUE 0 0 0.000000 1.000000 ECU_ADDRESS 0xFD36 BIT_MASK 0x1 /end MEASUREMENT
/begin MEASUREMENT B_CDLDP " Funktion ueber Codewort CDLDP freigegeben" UWORD B_TRUE 0 0 0.000000 1.000000 ECU_ADDRESS 0xB1000 BIT_MASK 0x4000 /end MEASUREMENT
/begin MEASUREMENT B_CDLSV " Funktion ueber Codewort CDLSV freigegeben" UWORD B_TRUE 0 0 0.000000 1.000000 ECU_ADDRESS 0xB1000 BIT_MASK 0x8 /end MEASUREMENT
/begin MEASUREMENT B_CDSLS " Funktion ueber Codewort CDSLS freigegeben" UWORD B_TRUE 0 0 0.000000 1.000000 ECU_ADDRESS 0xB1002 BIT_MASK 0x1 /end MEASUREMENT
/begin MEASUREMENT B_CDTES " Funktion ueber Codewort CDTES freigegeben" UWORD B_TRUE 0 0 0.000000 1.000000 ECU_ADDRESS 0xB1000 BIT_MASK 0x2000 /end MEASUREMENT
/begin MEASUREMENT B_DCY " Bedingung 'driving cycle' erkannt" UBYTE B_TRUE 0 0 0.000000 1.000000 ECU_ADDRESS 0xB0F9D BIT_MASK 0x1 /end MEASUREMENT
/begin MEASUREMENT B_DDYLASH1 " Sonde hinter Kat dynamisch langsam 'dynamisch'" UWORD B_TRUE 0 0 0.000000 1.000000 ECU_ADDRESS 0xFD3C BIT_MASK 0x4 /end MEASUREMENT
/begin MEASUREMENT B_DESEE " 1= allg. Pruefbedingungen erfuellt" UWORD B_TRUE 0 0 0.000000 1.000000 ECU_ADDRESS 0xFD8E BIT_MASK 0x1000 /end MEASUREMENT
/begin MEASUREMENT B_DKATEND1 " '1' = Dkat- Aktiv- Zeit ist abgelaufen, Bank1" UWORD B_TRUE 0 0 0.000000 1.000000 ECU_ADDRESS 0xFD46 BIT_MASK 0x10 /end MEASUREMENT
/begin MEASUREMENT B_DKINI " '1' = Bedingung fuer Dkat- Funktion init. Bank1" UWORD B_TRUE 0 0 0.000000 1.000000 ECU_ADDRESS 0xFD46 BIT_MASK 0x400 /end MEASUREMENT
/begin MEASUREMENT B_DKLPI " '1' = interne Umschaltung Lambdaparam. gefordert" UWORD B_TRUE 0 0 0.000000 1.000000 ECU_ADDRESS 0xFD46 BIT_MASK 0x800 /end MEASUREMENT
/begin MEASUREMENT B_DKNOT_FR " DK-Notfahren" UWORD B_TRUE 0 0 0.000000 1.000000 ECU_ADDRESS 0xFD6A BIT_MASK 0x100 /end MEASUREMENT
/begin MEASUREMENT B_DKTEN " '1' = DKAT fuer diesen Trip nicht mehr aktiv" UWORD B_TRUE 0 0 0.000000 1.000000 ECU_ADDRESS 0xFD48 BIT_MASK 0x80 /end MEASUREMENT
/begin MEASUREMENT B_DKTLP " '1' = Umschaltung LR_Parameter angefordert" UWORD B_TRUE 0 0 0.000000 1.000000 ECU_ADDRESS 0xFD46 BIT_MASK 0x1000 /end MEASUREMENT
/begin MEASUREMENT B_DKTNR " '1' = n/rl-Bereich verlassen" UWORD B_TRUE 0 0 0.000000 1.000000 ECU_ADDRESS 0xFD46 BIT_MASK 0x2000 /end MEASUREMENT
/begin MEASUREMENT B_DKTSB1 " '1' = bankspezifische Stopbedingung, Bank1" UWORD B_TRUE 0 0 0.000000 1.000000 ECU_ADDRESS 0xFD46 BIT_MASK 0x40 /end MEASUREMENT
/begin MEASUREMENT B_DKTSP1 " '1' = physikalische Stopbedingung, Bank1" UWORD B_TRUE 0 0 0.000000 1.000000 ECU_ADDRESS 0xFD46 BIT_MASK 0x80 /end MEASUREMENT
/begin MEASUREMENT B_DKTST1 " '0' = DKAT- Funktion ist gestoppt Bank1" UWORD B_TRUE 0 0 0.000000 1.000000 ECU_ADDRESS 0xFD46 BIT_MASK 0x20 /end MEASUREMENT
/begin MEASUREMENT B_DKTT " '1' = DKAT aktiv-Zeit abgelaufen" UWORD B_TRUE 0 0 0.000000 1.000000 ECU_ADDRESS 0xFD46 BIT_MASK 0x100 /end MEASUREMENT
/begin MEASUREMENT B_DKTTK " '1' = Katdiagnose temperaturbedingt gesperrt" UWORD B_TRUE 0 0 0.000000 1.000000 ECU_ADDRESS 0xFD46 BIT_MASK 0x200 /end MEASUREMENT
/begin MEASUREMENT B_DLASH1 " Akt. Diagnose: Lambda-Sondenalt. hinter Kat." UWORD B_TRUE 0 0 0.000000 1.000000 ECU_ADDRESS 0xFD3C BIT_MASK 0x8 /end MEASUREMENT
/begin MEASUREMENT B_DLATP1 " '1'= Diagnose Lambdasondenalterung TP aktiv" UWORD B_TRUE 0 0 0.000000 1.000000 ECU_ADDRESS 0xFD34 BIT_MASK 0x10 /end MEASUREMENT
/begin MEASUREMENT B_DLATV1 " '1'= Diagnose Lambdasondenalterung TV aktiv" UWORD B_TRUE 0 0 0.000000 1.000000 ECU_ADDRESS 0xFD34 BIT_MASK 0x20 /end MEASUREMENT
/begin MEASUREMENT B_DLSHSP1 " 1 = bank 1" UWORD B_TRUE 0 0 0.000000 1.000000 ECU_ADDRESS 0xB086A BIT_MASK 0x40 /end MEASUREMENT
/begin MEASUREMENT B_DLSHSP2 " 1 = bank 1" UWORD B_TRUE 0 0 0.000000 1.000000 ECU_ADDRESS 0xB086C BIT_MASK 0x40 /end MEASUREMENT
/begin MEASUREMENT B_DLSVSP " 1 = Sondendiagnose vor Kat sperren" UWORD B_TRUE 0 0 0.000000 1.000000 ECU_ADDRESS 0xB084E BIT_MASK 0x40 /end MEASUREMENT
/begin MEASUREMENT B_DMDHI_AP " 1 = DMD -High Resolution" UBYTE B_TRUE 0 0 0.000000 1.000000 ECU_ADDRESS 0xF9A7 BIT_MASK 0x80 /end MEASUREMENT
/begin MEASUREMENT B_DSHEN1 " 1 =" UWORD B_TRUE 0 0 0.000000 1.000000 ECU_ADDRESS 0xB086A BIT_MASK 0x8 /end MEASUREMENT
/begin MEASUREMENT B_DSHEN2 " 1 =" UWORD B_TRUE 0 0 0.000000 1.000000 ECU_ADDRESS 0xB086C BIT_MASK 0x8 /end MEASUREMENT
/begin MEASUREMENT B_DSHK1 " Diagnosefkt. in %DLSH und %DHLS mit iO_Meldung hinter Kat beendet" UWORD B_TRUE 0 0 0.000000 1.000000 ECU_ADDRESS 0xFD3C BIT_MASK 0x10 /end MEASUREMENT
/begin MEASUREMENT B_DSLS " '1'= SLS-Diagnose aktiv" UWORD B_TRUE 0 0 0.000000 1.000000 ECU_ADDRESS 0xFD5A BIT_MASK 0x4 /end MEASUREMENT
/begin MEASUREMENT B_DSVEN " 1 = Freigabe Sondendiagnose" UWORD B_TRUE 0 0 0.000000 1.000000 ECU_ADDRESS 0xB084E BIT_MASK 0x8 /end MEASUREMENT
/begin MEASUREMENT B_DSVEN2 " Ausloesung Drive-Recorder Messung " UWORD B_TRUE 0 0 0.000000 1.000000 ECU_ADDRESS 0xB0850 BIT_MASK 0x8 /end MEASUREMENT
/begin MEASUREMENT B_DUSHSCH1 " Schw. f. Sonde hinter Kat im Schub nicht unterschrit. 'dynamisch'" UWORD B_TRUE 0 0 0.000000 1.000000 ECU_ADDRESS 0xFD3C BIT_MASK 0x20 /end MEASUREMENT
/begin MEASUREMENT B_DYLASH1 " Sonde hinter Kat dynamisch langsam 'statisch'" UWORD B_TRUE 0 0 0.000000 1.000000 ECU_ADDRESS 0xFD3C BIT_MASK 0x40 /end MEASUREMENT
/begin MEASUREMENT B_EDKVS1 " 1 = Bed. Adaptionsfehlerschwellen an Bank 1 aktuell ueberschritten" UWORD B_TRUE 0 0 0.000000 1.000000 ECU_ADDRESS 0xFD44 BIT_MASK 0x100 /end MEASUREMENT
/begin MEASUREMENT B_EDKVS2 " 1 = Bed. Adaptionsfehlerschwellen an Bank 2 aktuell ueberschritten" UWORD B_TRUE 0 0 0.000000 1.000000 ECU_ADDRESS 0xFD44 BIT_MASK 0x200 /end MEASUREMENT
/begin MEASUREMENT B_ENFMST1 " enable fuer Filter" UWORD B_TRUE 0 0 0.000000 1.000000 ECU_ADDRESS 0xFD3C BIT_MASK 0x80 /end MEASUREMENT
/begin MEASUREMENT B_ENLASH1 " Test fuer Schwingungspruefung abgeschlossen, Freigabe Zyklusbit" UWORD B_TRUE 0 0 0.000000 1.000000 ECU_ADDRESS 0xFD3C BIT_MASK 0x100 /end MEASUREMENT
/begin MEASUREMENT B_ENTEST1 " Ausloesung Drive-Recorder Messung " UWORD B_TRUE 0 0 0.000000 1.000000 ECU_ADDRESS 0xFD3C BIT_MASK 0x200 /end MEASUREMENT
/begin MEASUREMENT B_EPCL " Bedingung fuer Ansteuerung EGAS-Fehlerlampe" UWORD B_TRUE 0 0 0.000000 1.000000 ECU_ADDRESS 0xFDD6 BIT_MASK 0x1 /end MEASUREMENT
/begin MEASUREMENT B_ERDKT1 " '1' = Fehlererkennung fuer Bank1" UWORD B_TRUE 0 0 0.000000 1.000000 ECU_ADDRESS 0xFD46 BIT_MASK 0x8000 /end MEASUREMENT
/begin MEASUREMENT B_ESDIA " 1= Endstufenpruefung aktiv" UWORD B_TRUE 0 0 0.000000 1.000000 ECU_ADDRESS 0xFD8E BIT_MASK 0x2000 /end MEASUREMENT
/begin MEASUREMENT B_EVLOC " Status alle lokalen Einspritzventile werden angesteuert" UWORD B_TRUE 0 0 0.000000 1.000000 ECU_ADDRESS 0xFD42 BIT_MASK 0x8000 /end MEASUREMENT
/begin MEASUREMENT B_FA " '1'= Funktionanforderung allgemein" UWORD B_TRUE 0 0 0.000000 1.000000 ECU_ADDRESS 0xFD36 BIT_MASK 0x10 /end MEASUREMENT
/begin MEASUREMENT B_FAKAT " '1' = Funktionsanforderung Katalysatorueberwachung" UWORD B_TRUE 0 0 0.000000 1.000000 ECU_ADDRESS 0xFD48 BIT_MASK 0x1 /end MEASUREMENT
/begin MEASUREMENT B_FASH1 " Funktionsanforderung Schwingungspruefung" UWORD B_TRUE 0 0 0.000000 1.000000 ECU_ADDRESS 0xFD3C BIT_MASK 0x800 /end MEASUREMENT
/begin MEASUREMENT B_FATP1 " '1'= Funktionanforderung TP-Ueberwachung" UWORD B_TRUE 0 0 0.000000 1.000000 ECU_ADDRESS 0xFD36 BIT_MASK 0x20 /end MEASUREMENT
/begin MEASUREMENT B_FATV1 " '1'= Funktionanforderung TV-Ueberwachung" UWORD B_TRUE 0 0 0.000000 1.000000 ECU_ADDRESS 0xFD36 BIT_MASK 0x40 /end MEASUREMENT
/begin MEASUREMENT B_FDYFGR " Absch. ACC,FGR bei ASR,MSR,VDC" UWORD B_TRUE 0 0 0.000000 1.000000 ECU_ADDRESS 0xFDB4 BIT_MASK 0x2000 /end MEASUREMENT
/begin MEASUREMENT B_FGR " 1 = Fahrgesch.regelung aktiv" UWORD B_TRUE 0 0 0.000000 1.000000 ECU_ADDRESS 0xFD0A BIT_MASK 0x1 /end MEASUREMENT
/begin MEASUREMENT B_FMS1 " Fett-Mager-Sprung Vorkat-Sonde1" UWORD B_TRUE 0 0 0.000000 1.000000 ECU_ADDRESS 0xFD2E BIT_MASK 0x1 /end MEASUREMENT
/begin MEASUREMENT B_FMS2 " Fett-Mager-Sprung Vorkat-Sonde2" UWORD B_TRUE 0 0 0.000000 1.000000 ECU_ADDRESS 0xFD2E BIT_MASK 0x8 /end MEASUREMENT
/begin MEASUREMENT B_FPRAKT "> Federpruefung aktiviert" UWORD B_TRUE 0 0 0.000000 1.000000 ECU_ADDRESS 0xFD4E BIT_MASK 0x2000 /end MEASUREMENT
/begin MEASUREMENT B_FPRFG "> Federpruefungs-Freigabe" UWORD B_TRUE 0 0 0.000000 1.000000 ECU_ADDRESS 0xFD4E BIT_MASK 0x800 /end MEASUREMENT
/begin MEASUREMENT B_FPRRDY "> Federpruefungs-Ende" UWORD B_TRUE 0 0 0.000000 1.000000 ECU_ADDRESS 0xFD4E BIT_MASK 0x4000 /end MEASUREMENT
/begin MEASUREMENT B_FPRVB "> Federpruefungs-Verbot" UWORD B_TRUE 0 0 0.000000 1.000000 ECU_ADDRESS 0xFD4E BIT_MASK 0x1000 /end MEASUREMENT
/begin MEASUREMENT B_FRAU1 " Ausloesung Drive-Recorder Messung " UBYTE B_TRUE 0 0 0.000000 1.000000 ECU_ADDRESS 0xB2034 BIT_MASK 0x1 /end MEASUREMENT
/begin MEASUREMENT B_FRAU2 " Ausloesung Drive-Recorder Messung " UBYTE B_TRUE 0 0 0.000000 1.000000 ECU_ADDRESS 0xB2034 BIT_MASK 0x2 /end MEASUREMENT
/begin MEASUREMENT B_FRMLASH1 " Mittelwert des Lambdaregelfaktors innerhalb der Schwellen" UWORD B_TRUE 0 0 0.000000 1.000000 ECU_ADDRESS 0xFD3C BIT_MASK 0x1000 /end MEASUREMENT
/begin MEASUREMENT B_GAE1 "> 1 = Grundadaption Bank 1 eingeschwungen" UWORD B_TRUE 0 0 0.000000 1.000000 ECU_ADDRESS 0xFD44 BIT_MASK 0x400 /end MEASUREMENT
/begin MEASUREMENT B_GAE2 "> 1 = Grundadaption Bank 2 eingeschwungen" UWORD B_TRUE 0 0 0.000000 1.000000 ECU_ADDRESS 0xFD44 BIT_MASK 0x800 /end MEASUREMENT
/begin MEASUREMENT B_GAEFRA1 "> 1 = fra-Adaption Bank 1 eingeschwungen" UWORD B_TRUE 0 0 0.000000 1.000000 ECU_ADDRESS 0xFD44 BIT_MASK 0x1000 /end MEASUREMENT
/begin MEASUREMENT B_GAEFRA2 "> 1 = fra-Adaption Bank 2 eingeschwungen" UWORD B_TRUE 0 0 0.000000 1.000000 ECU_ADDRESS 0xFD44 BIT_MASK 0x2000 /end MEASUREMENT
/begin MEASUREMENT B_GASP "> 1 = Gemischadaption gesperrt" UWORD B_TRUE 0 0 0.000000 1.000000 ECU_ADDRESS 0xFD0E BIT_MASK 0x2 /end MEASUREMENT
/begin MEASUREMENT B_GV "1 = Automat Variante" UWORD B_TRUE 0 0 0.000000 1.000000 ECU_ADDRESS 0xFD02 BIT_MASK 0x400 /end MEASUREMENT
/begin MEASUREMENT B_HA " 1 = Bedingung Hoehenadaption" UWORD B_DEZ 0 0 0.000000 1.000000 ECU_ADDRESS 0xFD28 BIT_MASK 0x200 /end MEASUREMENT
/begin MEASUREMENT B_HAS " 1 = Bedingung schnelle Hoehenaption" UWORD B_DEZ 0 0 0.000000 1.000000 ECU_ADDRESS 0xFD28 BIT_MASK 0x400 /end MEASUREMENT
/begin MEASUREMENT B_HG "1 = Handschalter Variante" UWORD B_TRUE 0 0 0.000000 1.000000 ECU_ADDRESS 0xFD0E BIT_MASK 0x10 /end MEASUREMENT
/begin MEASUREMENT B_HR " 1 = Hauptrelais ein" UWORD B_TRUE 0 0 0.000000 1.000000 ECU_ADDRESS 0xFD02 BIT_MASK 0x200 /end MEASUREMENT
/begin MEASUREMENT B_HSHE " Sondenheizung hinten ein/aus" UWORD B_TRUE 0 0 0.000000 1.000000 ECU_ADDRESS 0xFD02 BIT_MASK 0x4 /end MEASUREMENT
/begin MEASUREMENT B_HSRDY " Bedingung Sondenheizung geprueft fuer 'ready-Byte'" UBYTE B_TRUE 0 0 0.000000 1.000000 ECU_ADDRESS 0xB2253 BIT_MASK 0x40 /end MEASUREMENT
/begin MEASUREMENT B_HSVE " Sondenheizung vorn ein/aus" UWORD B_TRUE 0 0 0.000000 1.000000 ECU_ADDRESS 0xFD02 BIT_MASK 0x2 /end MEASUREMENT
/begin MEASUREMENT B_INIT " 1 = Init. noch nicht abgeschlossen" UWORD B_TRUE 0 0 0.000000 1.000000 ECU_ADDRESS 0xFD04 BIT_MASK 0x1 /end MEASUREMENT
/begin MEASUREMENT B_IP2SEL_F " '1'= IP2-Umschaltung vom FR" UWORD B_TRUE 0 0 0.000000 1.000000 ECU_ADDRESS 0xFD5E BIT_MASK 0x1000 /end MEASUREMENT
/begin MEASUREMENT B_IP3OK_FR " '1'= IP3-Ok vom FR" UWORD B_TRUE 0 0 0.000000 1.000000 ECU_ADDRESS 0xFD5E BIT_MASK 0x4000 /end MEASUREMENT
/begin MEASUREMENT B_IPSOK_FR " '1'= IPS-Pruefung Ok" UWORD B_TRUE 0 0 0.000000 1.000000 ECU_ADDRESS 0xFD5E BIT_MASK 0x8000 /end MEASUREMENT
/begin MEASUREMENT B_I_SKA_FR "irrev. Sicherheitskraftstoffabschaltung vom FR" UWORD B_TRUE 0 0 0.000000 1.000000 ECU_ADDRESS 0xFD6A BIT_MASK 0x10 /end MEASUREMENT
/begin MEASUREMENT B_I_SKA_UM "irrev. Sicherheitskraftstoffabschaltung vom UM" UWORD B_TRUE 0 0 0.000000 1.000000 ECU_ADDRESS 0xFD6A BIT_MASK 0x20 /end MEASUREMENT
/begin MEASUREMENT B_KATFZ " Bedingung Kat in Fahrzeug eingebaut" UWORD B_TRUE 0 0 0.000000 1.000000 ECU_ADDRESS 0xFDD6 BIT_MASK 0x200 /end MEASUREMENT
/begin MEASUREMENT B_KATH " Bedingung Kat Heizung in Fahrzeug eingebaut" UWORD B_TRUE 0 0 0.000000 1.000000 ECU_ADDRESS 0xFDD6 BIT_MASK 0x100 /end MEASUREMENT
/begin MEASUREMENT B_KATRDY " Bedingung Katalysatoren geprueft fuer 'ready-Byte'" UBYTE B_TRUE 0 0 0.000000 1.000000 ECU_ADDRESS 0xB2253 BIT_MASK 0x1 /end MEASUREMENT
/begin MEASUREMENT B_KH " 1 = Katheizen aktiv" UWORD B_TRUE 0 0 0.000000 1.000000 ECU_ADDRESS 0xFD08 BIT_MASK 0x2 /end MEASUREMENT
/begin MEASUREMENT B_KL15 " 1 = Zuendung ein" UWORD B_TRUE 0 0 0.000000 1.000000 ECU_ADDRESS 0xFD02 BIT_MASK 0x20 /end MEASUREMENT
/begin MEASUREMENT B_KLOFVB "1=Klimaoffset Verbot" UWORD B_TRUE 0 0 0.000000 1.000000 ECU_ADDRESS 0xFD1E BIT_MASK 0x200 /end MEASUREMENT
/begin MEASUREMENT B_KMMIL " MIL-Ansteuerung mit Relevanz zu Kilometererfassung" UBYTE B_TRUE 0 0 0.000000 1.000000 ECU_ADDRESS 0xB0FA1 BIT_MASK 0x20 /end MEASUREMENT
/begin MEASUREMENT B_KOE " Request Kompressor Endstufe ein" UWORD B_TRUE 0 0 0.000000 1.000000 ECU_ADDRESS 0xFD66 BIT_MASK 0x200 /end MEASUREMENT
/begin MEASUREMENT B_KOS " 1 = Bedingung Klimakompressor ein" UWORD B_TRUE 0 0 0.000000 1.000000 ECU_ADDRESS 0xFD0A BIT_MASK 0x200 /end MEASUREMENT
/begin MEASUREMENT B_KR " KR 'ein'" UWORD B_TRUE 0 0 0.000000 1.000000 ECU_ADDRESS 0xFD06 BIT_MASK 0x800 /end MEASUREMENT
/begin MEASUREMENT B_KS "Klopfsicherheitsverst. aktiv" UWORD B_TRUE 0 0 0.000000 1.000000 ECU_ADDRESS 0xFD60 BIT_MASK 0x8 /end MEASUREMENT
/begin MEASUREMENT B_KUP " 1 = Kupplungsschalter betaetigt (Handschalter)" UWORD B_TRUE 0 0 0.000000 1.000000 ECU_ADDRESS 0xFD1E BIT_MASK 0x800 /end MEASUREMENT
/begin MEASUREMENT B_KUPSTAT " 1 = Kupplungsschalter betaetigt (Handschalter)" UWORD B_TRUE 0 0 0.000000 1.000000 ECU_ADDRESS 0xFD1E BIT_MASK 0x800 /end MEASUREMENT
/begin MEASUREMENT B_LAMEND1 " Ende der Lambdaverstellung in %LAMKO" UWORD B_TRUE 0 0 0.000000 1.000000 ECU_ADDRESS 0xFD3C BIT_MASK 0x2000 /end MEASUREMENT
/begin MEASUREMENT B_LAMLASH1 " Abmagern in %LAMKO" UWORD B_TRUE 0 0 0.000000 1.000000 ECU_ADDRESS 0xFD3C BIT_MASK 0x4000 /end MEASUREMENT
/begin MEASUREMENT B_LAMPE "1=Ansteuerung der Armaturenbrettlampen" UWORD B_TRUE 0 0 0.000000 1.000000 ECU_ADDRESS 0xFD68 BIT_MASK 0x400 /end MEASUREMENT
/begin MEASUREMENT B_LAMVERG1 " Vergleich Lambdasoll in %DLSAHK mit %LAMKO uebereinstimmend" UWORD B_TRUE 0 0 0.000000 1.000000 ECU_ADDRESS 0xFD3C BIT_MASK 0x8000 /end MEASUREMENT
/begin MEASUREMENT B_LL " 1 = Leerlauf" UWORD B_TRUE 0 0 0.000000 1.000000 ECU_ADDRESS 0xFD06 BIT_MASK 0x1 /end MEASUREMENT
/begin MEASUREMENT B_LL_DIS "> LL disable von Antischubruckelfunktin im FGR" UWORD B_TRUE 0 0 0.000000 1.000000 ECU_ADDRESS 0xFD4E BIT_MASK 0x200 /end MEASUREMENT
/begin MEASUREMENT B_LR1 " 1 = Lambdaregelung v.KAT B1 aktiv" UWORD B_TRUE 0 0 0.000000 1.000000 ECU_ADDRESS 0xFD06 BIT_MASK 0x4000 /end MEASUREMENT
/begin MEASUREMENT B_LR2 " 1 = Lambdaregelung v.KAT B2 aktiv" UWORD B_TRUE 0 0 0.000000 1.000000 ECU_ADDRESS 0xFD06 BIT_MASK 0x8000 /end MEASUREMENT
/begin MEASUREMENT B_LRA1 "> 1 = LRA enable Bank1" UWORD B_TRUE 0 0 0.000000 1.000000 ECU_ADDRESS 0xFD44 BIT_MASK 0x1 /end MEASUREMENT
/begin MEASUREMENT B_LRA2 "> 1 = LRA enable Bank2" UWORD B_TRUE 0 0 0.000000 1.000000 ECU_ADDRESS 0xFD44 BIT_MASK 0x2 /end MEASUREMENT
/begin MEASUREMENT B_LRHK1 "1 = Lambdaregelung h.KAT B1 aktiv" UWORD B_TRUE 0 0 0.000000 1.000000 ECU_ADDRESS 0xFD30 BIT_MASK 0x10 /end MEASUREMENT
/begin MEASUREMENT B_LRHK2 "1 = Lambdaregelung h.KAT B2 aktiv" UWORD B_TRUE 0 0 0.000000 1.000000 ECU_ADDRESS 0xFD30 BIT_MASK 0x20 /end MEASUREMENT
/begin MEASUREMENT B_LRNAKT " 1 = Lernen aktiv" UWORD B_TRUE 0 0 0.000000 1.000000 ECU_ADDRESS 0xFD20 BIT_MASK 0x4000 /end MEASUREMENT
/begin MEASUREMENT B_LRNERF " 1 = Lern-Erfolg" UWORD B_TRUE 0 0 0.000000 1.000000 ECU_ADDRESS 0xFD08 BIT_MASK 0x20 /end MEASUREMENT
/begin MEASUREMENT B_LRNFG " 1 = Lern-Freigabe" UWORD B_TRUE 0 0 0.000000 1.000000 ECU_ADDRESS 0xFD20 BIT_MASK 0x2000 /end MEASUREMENT
/begin MEASUREMENT B_LRNRDY " 1 = Lern-Ende" UWORD B_TRUE 0 0 0.000000 1.000000 ECU_ADDRESS 0xFD20 BIT_MASK 0x1000 /end MEASUREMENT
/begin MEASUREMENT B_LRNREQ " 1 = Abgleich-Anforderung" UBYTE B_TRUE 0 0 0.000000 1.000000 ECU_ADDRESS 0xB2E46 BIT_MASK 0x1 /end MEASUREMENT
/begin MEASUREMENT B_LRNVB " 1 = Lern-Verbot" UWORD B_TRUE 0 0 0.000000 1.000000 ECU_ADDRESS 0xFD20 BIT_MASK 0x8000 /end MEASUREMENT
/begin MEASUREMENT B_LRNWS " 1 = Lernwert-UANL abgespeichert" UWORD B_TRUE 0 0 0.000000 1.000000 ECU_ADDRESS 0xFD20 BIT_MASK 0x400 /end MEASUREMENT
/begin MEASUREMENT B_LRSYNC " '1' = Bedingung fr_b1-/fr_b2-Synchronisierung aktiv" UWORD B_TRUE 0 0 0.000000 1.000000 ECU_ADDRESS 0xFD48 BIT_MASK 0x2 /end MEASUREMENT
/begin MEASUREMENT B_LSADS "Bedingung Sonde hat Adernschluss" UBYTE B_TRUE 0 0 0.000000 1.000000 ECU_ADDRESS 0xB2146 BIT_MASK 0x8 /end MEASUREMENT
/begin MEASUREMENT B_LSAHKSP1 " allgemeine Stopbedingung fuer die %DLSAHK" UWORD B_TRUE 0 0 0.000000 1.000000 ECU_ADDRESS 0xFD3E BIT_MASK 0x1 /end MEASUREMENT
/begin MEASUREMENT B_LSASTP1 " '1'= allgemeine Stopbedingung fuer DLSA" UWORD B_TRUE 0 0 0.000000 1.000000 ECU_ADDRESS 0xFD36 BIT_MASK 0x8 /end MEASUREMENT
/begin MEASUREMENT B_LSFET "Nebenschluss nach UBATT" UBYTE B_TRUE 0 0 0.000000 1.000000 ECU_ADDRESS 0xB2146 BIT_MASK 0x1 /end MEASUREMENT
/begin MEASUREMENT B_LSHUB "Bedingung Sonde begrenzter Spannungshub" UBYTE B_TRUE 0 0 0.000000 1.000000 ECU_ADDRESS 0xB2146 BIT_MASK 0x2 /end MEASUREMENT
/begin MEASUREMENT B_LSRDY " Bedingung Lambda-Sonden geprueft fuer 'ready-Byte'" UBYTE B_TRUE 0 0 0.000000 1.000000 ECU_ADDRESS 0xB2253 BIT_MASK 0x20 /end MEASUREMENT
/begin MEASUREMENT B_LSVKLT " 1 = Lambdasonde vor Kat kalt" UWORD B_TRUE 0 0 0.000000 1.000000 ECU_ADDRESS 0xB084E BIT_MASK 0x4000 /end MEASUREMENT
/begin MEASUREMENT B_LSVKLT2 " Ausloesung Drive-Recorder Messung " UWORD B_TRUE 0 0 0.000000 1.000000 ECU_ADDRESS 0xB0850 BIT_MASK 0x4000 /end MEASUREMENT
/begin MEASUREMENT B_LSVN "Bedingung Nebenschluss bei kalter Sonde vor Kat" UBYTE B_TRUE 0 0 0.000000 1.000000 ECU_ADDRESS 0xB2146 BIT_MASK 0x10 /end MEASUREMENT
/begin MEASUREMENT B_LUSTOP " 1= Aussetzererkennung nicht aktiv" UWORD B_TRUE 0 0 0.000000 1.000000 ECU_ADDRESS 0xFDBE BIT_MASK 0x80 /end MEASUREMENT
/begin MEASUREMENT B_MAXLASH1 " Maximalwert fuer Schwingungspruefung hinter Kat erkannt" UWORD B_TRUE 0 0 0.000000 1.000000 ECU_ADDRESS 0xFD3E BIT_MASK 0x2 /end MEASUREMENT
/begin MEASUREMENT B_MDARV " kritische Aussetzerrate vorhanden f. andere Fkt." UWORD B_TRUE 0 0 0.000000 1.000000 ECU_ADDRESS 0xFD84 BIT_MASK 0x400 /end MEASUREMENT
/begin MEASUREMENT B_MIL " MIL-Ansteuerung" UWORD B_TRUE 0 0 0.000000 1.000000 ECU_ADDRESS 0xFDD6 BIT_MASK 0x2 /end MEASUREMENT
/begin MEASUREMENT B_MINLASH1 " Minimalwert fuer Schwingungspruefung hinter Kat erkannt" UWORD B_TRUE 0 0 0.000000 1.000000 ECU_ADDRESS 0xFD3E BIT_MASK 0x4 /end MEASUREMENT
/begin MEASUREMENT B_MLDYN " erforderliche Luftmasse im Schubbetrieb fuer Dynamikmessung erreicht" UWORD B_TRUE 0 0 0.000000 1.000000 ECU_ADDRESS 0xFD3E BIT_MASK 0x8 /end MEASUREMENT
/begin MEASUREMENT B_MLUSTEST " ml ist innerhalb der Schwellen" UWORD B_TRUE 0 0 0.000000 1.000000 ECU_ADDRESS 0xFD3E BIT_MASK 0x10 /end MEASUREMENT
/begin MEASUREMENT B_MS100 " 1 = 100ms-Synchronisierten HG-Programmdurchlauf" UWORD B_TRUE 0 0 0.000000 1.000000 ECU_ADDRESS 0xFD0C BIT_MASK 0x80 /end MEASUREMENT
/begin MEASUREMENT B_MSRAKT "1 = Motorsollmoment-Erhoehung (MSR aktiv)" UWORD B_TRUE 0 0 0.000000 1.000000 ECU_ADDRESS 0xFD26 BIT_MASK 0x2 /end MEASUREMENT
/begin MEASUREMENT B_NCAUPAKT " NCA Drehmomentanhebung aktiv" UWORD B_TRUE 0 0 0.000000 1.000000 ECU_ADDRESS 0xFDB8 BIT_MASK 0x8 /end MEASUREMENT
/begin MEASUREMENT B_NMAX " 1 = Maximaldrehzahl ueberschritten" UWORD B_TRUE 0 0 0.000000 1.000000 ECU_ADDRESS 0xFD04 BIT_MASK 0x200 /end MEASUREMENT
/begin MEASUREMENT B_NMAXE " 1= Drehzahlbegrenzung EGAS" UWORD B_TRUE 0 0 0.000000 1.000000 ECU_ADDRESS 0xFDAA BIT_MASK 0x80 /end MEASUREMENT
/begin MEASUREMENT B_NMIN " 1 = Minimaldrehzahl unterschritten" UWORD B_TRUE 0 0 0.000000 1.000000 ECU_ADDRESS 0xFD04 BIT_MASK 0x100 /end MEASUREMENT
/begin MEASUREMENT B_NMOT " Bedingung Motordrehzahl: n > NMIN" UWORD B_TRUE 0 0 0.000000 1.000000 ECU_ADDRESS 0xFDD6 BIT_MASK 0x10 /end MEASUREMENT
/begin MEASUREMENT B_NOFLR " Ausloesung Drive-Recorder Messung " UWORD B_TRUE 0 0 0.000000 1.000000 ECU_ADDRESS 0xFD92 BIT_MASK 0x4 /end MEASUREMENT
/begin MEASUREMENT B_NOMACC " Botschaftsunterbrechung CAN NAC" UWORD B_TRUE 0 0 0.000000 1.000000 ECU_ADDRESS 0xFD86 BIT_MASK 0x400 /end MEASUREMENT
/begin MEASUREMENT B_NOMASR " Botschaftsunterbrechung CAN NFR" UWORD B_TRUE 0 0 0.000000 1.000000 ECU_ADDRESS 0xFD86 BIT_MASK 0x100 /end MEASUREMENT
/begin MEASUREMENT B_NOMBC " Botschaftsunterbrechung CAN NBC" UWORD B_TRUE 0 0 0.000000 1.000000 ECU_ADDRESS 0xFD86 BIT_MASK 0x80 /end MEASUREMENT
/begin MEASUREMENT B_NOMEGS " Botschaftsunterbrechung CAN NCA/NCR" UWORD B_TRUE 0 0 0.000000 1.000000 ECU_ADDRESS 0xFD86 BIT_MASK 0x200 /end MEASUREMENT
/begin MEASUREMENT B_NOMNBA " Botschaftsunterbrechung CAN NBA" UWORD B_TRUE 0 0 0.000000 1.000000 ECU_ADDRESS 0xFD86 BIT_MASK 0x800 /end MEASUREMENT
/begin MEASUREMENT B_NOMSR_FR " MSR-Verbot" UWORD B_TRUE 0 0 0.000000 1.000000 ECU_ADDRESS 0xFD26 BIT_MASK 0x40 /end MEASUREMENT
/begin MEASUREMENT B_NOMSR_UM " MSR-Momentenvorgabe in FU nicht uebern." UWORD B_TRUE 0 0 0.000000 1.000000 ECU_ADDRESS 0xFD24 BIT_MASK 0x2000 /end MEASUREMENT
/begin MEASUREMENT B_NOSGS_FR " SGS-Verbot" UWORD B_TRUE 0 0 0.000000 1.000000 ECU_ADDRESS 0xFDC6 BIT_MASK 0x1000 /end MEASUREMENT
/begin MEASUREMENT B_NOSGS_UM " SGS-Momentenvorgabe in FU nicht uebern." UWORD B_TRUE 0 0 0.000000 1.000000 ECU_ADDRESS 0xFDC6 BIT_MASK 0x800 /end MEASUREMENT
/begin MEASUREMENT B_NOTL " 1 = Notluftfahren" UWORD B_TRUE 0 0 0.000000 1.000000 ECU_ADDRESS 0xFD04 BIT_MASK 0x800 /end MEASUREMENT
/begin MEASUREMENT B_NOTLU_FR "Notluftfahren vom FR" UWORD B_TRUE 0 0 0.000000 1.000000 ECU_ADDRESS 0xFD6A BIT_MASK 0x4 /end MEASUREMENT
/begin MEASUREMENT B_NUMES10 " CAN-Nachrichtenunterbrechung Geschwindigkeitssignal" UWORD B_TRUE 0 0 0.000000 1.000000 ECU_ADDRESS 0xFD60 BIT_MASK 0x2000 /end MEASUREMENT
/begin MEASUREMENT B_NWS " 1 = Kennfeldumschaltung bei NWS ein" UWORD B_TRUE 0 0 0.000000 1.000000 ECU_ADDRESS 0xFD06 BIT_MASK 0x200 /end MEASUREMENT
/begin MEASUREMENT B_OFFABW " ti- und Zuendverbot durch Rueckdrehen" UWORD B_TRUE 0 0 0.000000 1.000000 ECU_ADDRESS 0xFDD8 BIT_MASK 0x10 /end MEASUREMENT
/begin MEASUREMENT B_PHEA " 1 = Abschaltung der EV's aufgrund Falschsynchronisation" UWORD B_TRUE 0 0 0.000000 1.000000 ECU_ADDRESS 0xFD64 BIT_MASK 0x8000 /end MEASUREMENT
/begin MEASUREMENT B_PNCAN " 1 = Bedingung fuer Fahrstufe P oder N direkt von CAN" UWORD B_TRUE 0 0 0.000000 1.000000 ECU_ADDRESS 0xFD08 BIT_MASK 0x800 /end MEASUREMENT
/begin MEASUREMENT B_PR " 1 = EKP-Relais geschlossen" UWORD B_TRUE 0 0 0.000000 1.000000 ECU_ADDRESS 0xFD02 BIT_MASK 0x10 /end MEASUREMENT
/begin MEASUREMENT B_PWF " 1 = Urstart bzw. Powerfail erkannt" UWORD B_TRUE 0 0 0.000000 1.000000 ECU_ADDRESS 0xFD04 BIT_MASK 0x4000 /end MEASUREMENT
/begin MEASUREMENT B_REDMX " Schubabschalten waehrend Schaltphase" UWORD B_TRUE 0 0 0.000000 1.000000 ECU_ADDRESS 0xFD08 BIT_MASK 0x8000 /end MEASUREMENT
/begin MEASUREMENT B_REDSA " Anforderung SA durch Schaltvorgang vom Selespeed" UWORD B_TRUE 0 0 0.000000 1.000000 ECU_ADDRESS 0xFD7C BIT_MASK 0x1 /end MEASUREMENT
/begin MEASUREMENT B_REFMAX " 1 = Sondensp. im plausiblen Bereich zwischen USREF und USMAX" UWORD B_TRUE 0 0 0.000000 1.000000 ECU_ADDRESS 0xB084E BIT_MASK 0x2000 /end MEASUREMENT
/begin MEASUREMENT B_RINH " Bed. Innenwiderstand Ri-Messung der Nernstsonde aktiv hinter Kat" UWORD B_TRUE 0 0 0.000000 1.000000 ECU_ADDRESS 0xFD52 BIT_MASK 0x80 /end MEASUREMENT
/begin MEASUREMENT B_RINH2 " Bed. Innenwiderstand Ri-Messung der Nernstsonde aktiv hinter Kat Bank2" UWORD B_TRUE 0 0 0.000000 1.000000 ECU_ADDRESS 0xFD52 BIT_MASK 0x100 /end MEASUREMENT
/begin MEASUREMENT B_RINV " Bed. Innenwiderstand Ri-Messung der Nernstsonde aktiv vor Kat" UWORD B_TRUE 0 0 0.000000 1.000000 ECU_ADDRESS 0xFD52 BIT_MASK 0x20 /end MEASUREMENT
/begin MEASUREMENT B_RINV2 " Bed. Innenwiderstand Ri-Messung der Nernstsonde aktiv vor Kat Bank2" UWORD B_TRUE 0 0 0.000000 1.000000 ECU_ADDRESS 0xFD52 BIT_MASK 0x40 /end MEASUREMENT
/begin MEASUREMENT B_RISIGH1 " 1 = bank 1" UWORD B_TRUE 0 0 0.000000 1.000000 ECU_ADDRESS 0xB086A BIT_MASK 0x400 /end MEASUREMENT
/begin MEASUREMENT B_RISIGH2 " 1 = bank 1" UWORD B_TRUE 0 0 0.000000 1.000000 ECU_ADDRESS 0xB086C BIT_MASK 0x400 /end MEASUREMENT
/begin MEASUREMENT B_RISIGV " 1 = Signalunterbrechung Sondenmasse mit Ri-Diagnose" UWORD B_TRUE 0 0 0.000000 1.000000 ECU_ADDRESS 0xB084E BIT_MASK 0x400 /end MEASUREMENT
/begin MEASUREMENT B_RISIGV2 " Ausloesung Drive-Recorder Messung " UWORD B_TRUE 0 0 0.000000 1.000000 ECU_ADDRESS 0xB0850 BIT_MASK 0x400 /end MEASUREMENT
/begin MEASUREMENT B_R_SKA_FR "rev. Sicherheitskraftstoffabschaltung vom FR" UWORD B_TRUE 0 0 0.000000 1.000000 ECU_ADDRESS 0xFD6A BIT_MASK 0x40 /end MEASUREMENT
/begin MEASUREMENT B_SA " Schubabschaltung" UWORD B_TRUE 0 0 0.000000 1.000000 ECU_ADDRESS 0xFD08 BIT_MASK 0x8 /end MEASUREMENT
/begin MEASUREMENT B_SAANF " Anforderung Schubabschalten" UWORD B_TRUE 0 0 0.000000 1.000000 ECU_ADDRESS 0xFD08 BIT_MASK 0x4000 /end MEASUREMENT
/begin MEASUREMENT B_SAREQ " Anforderung Schubabschaltung" UWORD B_TRUE 0 0 0.000000 1.000000 ECU_ADDRESS 0xFD08 BIT_MASK 0x1 /end MEASUREMENT
/begin MEASUREMENT B_SBBHK1 " 1 = Betriebsbereitschaft L-Sonde h.KAT B1" UWORD B_TRUE 0 0 0.000000 1.000000 ECU_ADDRESS 0xFD30 BIT_MASK 0x1 /end MEASUREMENT
/begin MEASUREMENT B_SBBHK2 " 1 = Betriebsbereitschaft L-Sonde h.KAT B2" UWORD B_TRUE 0 0 0.000000 1.000000 ECU_ADDRESS 0xFD30 BIT_MASK 0x2 /end MEASUREMENT
/begin MEASUREMENT B_SBBVK1 "1 = Betriebsbereitschaft L-Sonde v.KAT B1" UWORD B_TRUE 0 0 0.000000 1.000000 ECU_ADDRESS 0xFD2C BIT_MASK 0x1 /end MEASUREMENT
/begin MEASUREMENT B_SELESP " Bedingung Selespeedvariante" UWORD B_TRUE 0 0 0.000000 1.000000 ECU_ADDRESS 0xFD14 BIT_MASK 0x4 /end MEASUREMENT
/begin MEASUREMENT B_SKA " 1 = Sicherheitskraftstoffabsch." UWORD B_TRUE 0 0 0.000000 1.000000 ECU_ADDRESS 0xFD08 BIT_MASK 0x10 /end MEASUREMENT
/begin MEASUREMENT B_SLS " Sekundaerluftsteuerung" UWORD B_TRUE 0 0 0.000000 1.000000 ECU_ADDRESS 0xFD06 BIT_MASK 0x100 /end MEASUREMENT
/begin MEASUREMENT B_SLSRDY " Bedingung SLS geprueft fuer 'ready-Byte'" UBYTE B_TRUE 0 0 0.000000 1.000000 ECU_ADDRESS 0xB2253 BIT_MASK 0x8 /end MEASUREMENT
/begin MEASUREMENT B_SP1 " FLC-Trigger der Aussetzererkennung" UBYTE B_TRUE 0 0 0.000000 1.000000 ECU_ADDRESS 0xB0FBF BIT_MASK 0x1 /end MEASUREMENT
/begin MEASUREMENT B_SP2 " HLC-Trigger der Aussetzererkennung" UBYTE B_TRUE 0 0 0.000000 1.000000 ECU_ADDRESS 0xB0FC0 BIT_MASK 0x1 /end MEASUREMENT
/begin MEASUREMENT B_SP3 " Spezial-Bereichs-Trigger der Diagnose Kraftstoffversorgungssystem" UBYTE B_TRUE 0 0 0.000000 1.000000 ECU_ADDRESS 0xB2257 BIT_MASK 0x1 /end MEASUREMENT
/begin MEASUREMENT B_START " 1 = Start aktiv" UWORD B_TRUE 0 0 0.000000 1.000000 ECU_ADDRESS 0xFD04 BIT_MASK 0x2 /end MEASUREMENT
/begin MEASUREMENT B_STEIGM1 " Steigung des Sondensignals messen" UWORD B_TRUE 0 0 0.000000 1.000000 ECU_ADDRESS 0xFD3E BIT_MASK 0x80 /end MEASUREMENT
/begin MEASUREMENT B_STEND " 1 = Startende erkannt" UWORD B_TRUE 0 0 0.000000 1.000000 ECU_ADDRESS 0xFD04 BIT_MASK 0x4 /end MEASUREMENT
/begin MEASUREMENT B_STZ " 1 = Pruefzeit nach Startende abgelaufen DEMS (DDVE, DPWG)" UWORD B_TRUE 0 0 0.000000 1.000000 ECU_ADDRESS 0xFD68 BIT_MASK 0x10 /end MEASUREMENT
/begin MEASUREMENT B_SWMAXN " Ausloesung Drive-Recorder Messung " UWORD B_TRUE 0 0 0.000000 1.000000 ECU_ADDRESS 0xFD92 BIT_MASK 0x4000 /end MEASUREMENT
/begin MEASUREMENT B_SYSERR " Bedingung fuer mind. 1 Fehler (E_abc) im System erkannt" UBYTE B_TRUE 0 0 0.000000 1.000000 ECU_ADDRESS 0xB1008 BIT_MASK 0x2 /end MEASUREMENT
/begin MEASUREMENT B_SZ " B_SA oder B_LL & vfzg>VHA bei ACC" UWORD B_TRUE 0 0 0.000000 1.000000 ECU_ADDRESS 0xFD28 BIT_MASK 0x100 /end MEASUREMENT
/begin MEASUREMENT B_TAL " Tank leer" UWORD B_TRUE 0 0 0.000000 1.000000 ECU_ADDRESS 0xFD7E BIT_MASK 0x800 /end MEASUREMENT
/begin MEASUREMENT B_TE " Tankentlueftung aktiv" UWORD B_TRUE 0 0 0.000000 1.000000 ECU_ADDRESS 0xFD06 BIT_MASK 0x2000 /end MEASUREMENT
/begin MEASUREMENT B_TEHB " hohe Beladung" UWORD B_TRUE 0 0 0.000000 1.000000 ECU_ADDRESS 0xFD50 BIT_MASK 0x800 /end MEASUREMENT
/begin MEASUREMENT B_TEMPFE " Tempomat Fuellungseingriff" UWORD B_TRUE 0 0 0.000000 1.000000 ECU_ADDRESS 0xFD4E BIT_MASK 0x40 /end MEASUREMENT
/begin MEASUREMENT B_TESLASH1 " Test ausfuehren fuer Ueberpruefung Sonde hinter Kat" UWORD B_TRUE 0 0 0.000000 1.000000 ECU_ADDRESS 0xFD3E BIT_MASK 0x100 /end MEASUREMENT
/begin MEASUREMENT B_TESRDY " Bedingung TES geprueft fuer 'ready-Byte'" UBYTE B_TRUE 0 0 0.000000 1.000000 ECU_ADDRESS 0xB2253 BIT_MASK 0x4 /end MEASUREMENT
/begin MEASUREMENT B_TIM " Zeit-Trigger fuer Fehlerpfadmanagement" UBYTE B_TRUE 0 0 0.000000 1.000000 ECU_ADDRESS 0xB0F9C BIT_MASK 0x1 /end MEASUREMENT
/begin MEASUREMENT B_TLFU "Bedingung TL_Filter Umschaltung (neg./pos. Lastaenderung)" UWORD B_TRUE 0 0 0.000000 1.000000 ECU_ADDRESS 0xFD68 BIT_MASK 0x20 /end MEASUREMENT
/begin MEASUREMENT B_TLROK "1 = TL-Regelung OK" UWORD B_TRUE 0 0 0.000000 1.000000 ECU_ADDRESS 0xFD1E BIT_MASK 0x4 /end MEASUREMENT
/begin MEASUREMENT B_TPKLAST " Taupunkt ueberschritten hinter Kat (letzte Fahrt)" UWORD B_TRUE 0 0 0.000000 1.000000 ECU_ADDRESS 0xFD50 BIT_MASK 0x20 /end MEASUREMENT
/begin MEASUREMENT B_TPKV " Verlaengerte Taupunktendezeit" UWORD B_TRUE 0 0 0.000000 1.000000 ECU_ADDRESS 0xFD50 BIT_MASK 0x40 /end MEASUREMENT
/begin MEASUREMENT B_TRA1 "> 1 = TRA enable Bank1" UWORD B_TRUE 0 0 0.000000 1.000000 ECU_ADDRESS 0xFD44 BIT_MASK 0x10 /end MEASUREMENT
/begin MEASUREMENT B_TRA2 "> 1 = TRA enable Bank2" UWORD B_TRUE 0 0 0.000000 1.000000 ECU_ADDRESS 0xFD44 BIT_MASK 0x20 /end MEASUREMENT
/begin MEASUREMENT B_TRFASH1 " Kurztrip einleiten fuer Schwingungspruefung Sonde hinter Kat" UWORD B_TRUE 0 0 0.000000 1.000000 ECU_ADDRESS 0xFD3E BIT_MASK 0x200 /end MEASUREMENT
/begin MEASUREMENT B_TRIP " Flag fuer erfuellten 'trip'" UBYTE B_TRUE 0 0 0.000000 1.000000 ECU_ADDRESS 0xB1008 BIT_MASK 0x1 /end MEASUREMENT
/begin MEASUREMENT B_TRSA " 1 = Kabelbruch" UWORD B_TRUE 0 0 0.000000 1.000000 ECU_ADDRESS 0xB084E BIT_MASK 0x4 /end MEASUREMENT
/begin MEASUREMENT B_TRSA2 " Ausloesung Drive-Recorder Messung " UWORD B_TRUE 0 0 0.000000 1.000000 ECU_ADDRESS 0xB0850 BIT_MASK 0x4 /end MEASUREMENT
/begin MEASUREMENT B_TRSAH1 " 1 =" UWORD B_TRUE 0 0 0.000000 1.000000 ECU_ADDRESS 0xB086A BIT_MASK 0x4 /end MEASUREMENT
/begin MEASUREMENT B_TRSAH2 " 1 =" UWORD B_TRUE 0 0 0.000000 1.000000 ECU_ADDRESS 0xB086C BIT_MASK 0x4 /end MEASUREMENT
/begin MEASUREMENT B_TTBMH2 " Theoretische Sondenbetriebsbereitschaft mit Heizung vK" UWORD B_TRUE 0 0 0.000000 1.000000 ECU_ADDRESS 0xFD38 BIT_MASK 0x20 /end MEASUREMENT
/begin MEASUREMENT B_TTBMHH " theoretische Sondenbereitschaft hinter Kat mit Heizung" UWORD B_TRUE 0 0 0.000000 1.000000 ECU_ADDRESS 0xFD30 BIT_MASK 0x4000 /end MEASUREMENT
/begin MEASUREMENT B_TTBMHH2 " ohne Worte" UWORD B_TRUE 0 0 0.000000 1.000000 ECU_ADDRESS 0xFD54 BIT_MASK 0x400 /end MEASUREMENT
/begin MEASUREMENT B_TUSPN " Uebernahme der Halbperiode (Zeit zwischen pos/neg Flanke)" UBYTE B_TRUE 0 0 0.000000 1.000000 ECU_ADDRESS 0xB0A4D BIT_MASK 0x2 /end MEASUREMENT
/begin MEASUREMENT B_TUSPN2 " Uebernahme der Halbperiode (Zeit zwischen pos/neg Flanke)" UBYTE B_TRUE 0 0 0.000000 1.000000 ECU_ADDRESS 0xB0A4D BIT_MASK 0x4 /end MEASUREMENT
/begin MEASUREMENT B_TUSRE " Resultat fuer gefilterte Halbperiode Sonde vor Kat" UBYTE B_TRUE 0 0 0.000000 1.000000 ECU_ADDRESS 0xB0A4D BIT_MASK 0x8 /end MEASUREMENT
/begin MEASUREMENT B_TUSRE2 " Resultat fuer gefilterte Halbperiode Sonde vor Kat" UBYTE B_TRUE 0 0 0.000000 1.000000 ECU_ADDRESS 0xB0A4D BIT_MASK 0x10 /end MEASUREMENT
/begin MEASUREMENT B_UB_OK "1 = Batteriespannung ok" UWORD B_TRUE 0 0 0.000000 1.000000 ECU_ADDRESS 0xFD0E BIT_MASK 0x2000 /end MEASUREMENT
/begin MEASUREMENT B_UEINH1 " Vorbereitung zum Einschalten der Sondenbereitschaft hinter Kat" UWORD B_TRUE 0 0 0.000000 1.000000 ECU_ADDRESS 0xFD30 BIT_MASK 0x8000 /end MEASUREMENT
/begin MEASUREMENT B_UEINV "Vorbereitung zur Einschaltung der LS-Bereitschaft" UBYTE B_TRUE 0 0 0.000000 1.000000 ECU_ADDRESS 0xB2146 BIT_MASK 0x80 /end MEASUREMENT
/begin MEASUREMENT B_URSTA " 1 = Urstart bzw. Powerfail erkannt" UWORD B_TRUE 0 0 0.000000 1.000000 ECU_ADDRESS 0xFD04 BIT_MASK 0x4000 /end MEASUREMENT
/begin MEASUREMENT B_USHKF1 " Sondenspannung hinter Kat FETT (Sollwert ueberschritten)" UWORD B_TRUE 0 0 0.000000 1.000000 ECU_ADDRESS 0xFD3E BIT_MASK 0x400 /end MEASUREMENT
/begin MEASUREMENT B_USHKM1 " Sondenspannung hinter Kat MAGER (Sollwert unterschritten)" UWORD B_TRUE 0 0 0.000000 1.000000 ECU_ADDRESS 0xFD3E BIT_MASK 0x800 /end MEASUREMENT
/begin MEASUREMENT B_USHSCH1 " Schw. fuer Sonde hinter Kat im Schub nicht ueberschrit. 'dynam.'" UWORD B_TRUE 0 0 0.000000 1.000000 ECU_ADDRESS 0xFD3E BIT_MASK 0x1000 /end MEASUREMENT
/begin MEASUREMENT B_VADGE " 1 = Verdacht auf Adernschluss oder Gemischfehler" UWORD B_TRUE 0 0 0.000000 1.000000 ECU_ADDRESS 0xB084E BIT_MASK 0x200 /end MEASUREMENT
/begin MEASUREMENT B_VADGE2 " Ausloesung Drive-Recorder Messung " UWORD B_TRUE 0 0 0.000000 1.000000 ECU_ADDRESS 0xB0850 BIT_MASK 0x200 /end MEASUREMENT
/begin MEASUREMENT B_VARA " 1 = Geschwindigkeitsb. fuer AR-Funktion erfuellt" UWORD B_TRUE 0 0 0.000000 1.000000 ECU_ADDRESS 0xFD12 BIT_MASK 0x2000 /end MEASUREMENT
/begin MEASUREMENT B_VGEFLR "Bedingung Verdacht auf Gemischfehler" UBYTE B_TRUE 0 0 0.000000 1.000000 ECU_ADDRESS 0xB2146 BIT_MASK 0x40 /end MEASUREMENT
/begin MEASUREMENT B_VL "1 = Vollast" UWORD B_TRUE 0 0 0.000000 1.000000 ECU_ADDRESS 0xFD06 BIT_MASK 0x2 /end MEASUREMENT
/begin MEASUREMENT B_VNULL " Fahrzeug steht" UWORD B_TRUE 0 0 0.000000 1.000000 ECU_ADDRESS 0xFD10 BIT_MASK 0x400 /end MEASUREMENT
/begin MEASUREMENT B_WAL " 1=TMOT-Warnlampe ein" UWORD B_TRUE 0 0 0.000000 1.000000 ECU_ADDRESS 0xFD68 BIT_MASK 0x1000 /end MEASUREMENT
/begin MEASUREMENT B_WALALT " Merker von b_wal im Nachlauf" UBYTE B_TRUE 0 0 0.000000 1.000000 ECU_ADDRESS 0xB25BA BIT_MASK 0x1 /end MEASUREMENT
/begin MEASUREMENT B_WE " 1 = Wiedereinsetzen aktiv" UWORD B_TRUE 0 0 0.000000 1.000000 ECU_ADDRESS 0xFD0C BIT_MASK 0x8 /end MEASUREMENT
/begin MEASUREMENT B_WEH "1 = Hartes Wiedereinsetzen" UWORD B_TRUE 0 0 0.000000 1.000000 ECU_ADDRESS 0xFD0C BIT_MASK 0x10 /end MEASUREMENT
/begin MEASUREMENT B_WFSFREI " WFS gibt Zuendung und Einspritzung frei" UWORD B_TRUE 0 0 0.000000 1.000000 ECU_ADDRESS 0xFDD4 BIT_MASK 0x1 /end MEASUREMENT
/begin MEASUREMENT B_WNL " 1 = Notlaufdrosselklappenwinkel aktiv" UWORD B_TRUE 0 0 0.000000 1.000000 ECU_ADDRESS 0xFD0C BIT_MASK 0x8000 /end MEASUREMENT
/begin MEASUREMENT B_WUC " Bedingung 'warm up cycle' erkannt" UBYTE B_TRUE 0 0 0.000000 1.000000 ECU_ADDRESS 0xB0F9E BIT_MASK 0x1 /end MEASUREMENT
/begin MEASUREMENT B_ZWARDY " dyn. Antiruckeleingriff aktiv" UWORD B_TRUE 0 0 0.000000 1.000000 ECU_ADDRESS 0xFD66 BIT_MASK 0x400 /end MEASUREMENT
/begin MEASUREMENT EI_DKLAGE " = 1 : DK-Lage-Fehler" UWORD B_TRUE 0 0 0.000000 1.000000 ECU_ADDRESS 0xFDA6 BIT_MASK 0x100 /end MEASUREMENT
/begin MEASUREMENT EI_FPR_FR " = 1 : Fehler bei der DK-Rueckstellfederpruefung" UWORD B_TRUE 0 0 0.000000 1.000000 ECU_ADDRESS 0xFDA6 BIT_MASK 0x800 /end MEASUREMENT
/begin MEASUREMENT EI_SGSC_UM " Keine Uebernahme des SGS-Momentes" UWORD B_TRUE 0 0 0.000000 1.000000 ECU_ADDRESS 0xFDF0 BIT_MASK 0x1000 /end MEASUREMENT
/begin MEASUREMENT EI_UAN_FR " = 1 : unterer DK-Anschlag fehlerhaft" UWORD B_TRUE 0 0 0.000000 1.000000 ECU_ADDRESS 0xFDA6 BIT_MASK 0x2 /end MEASUREMENT
/begin MEASUREMENT E_BL " 1 = Fehler Bremslichtschalter" UBYTE B_TRUE 0 0 0.000000 1.000000 ECU_ADDRESS 0xFDEC BIT_MASK 0x20 /end MEASUREMENT
/begin MEASUREMENT E_BREMSE "> 1 = Fehler Schalter Bremse" UWORD B_TRUE 0 0 0.000000 1.000000 ECU_ADDRESS 0xFD5A BIT_MASK 0x1000 /end MEASUREMENT
/begin MEASUREMENT E_CACC " CAN-Fehler: ACC Kommunikation" UBYTE B_TRUE 0 0 0.000000 1.000000 ECU_ADDRESS 0xFDED BIT_MASK 0x10 /end MEASUREMENT
/begin MEASUREMENT E_CAN " CAN-Fehler Bus" UBYTE B_TRUE 0 0 0.000000 1.000000 ECU_ADDRESS 0xFDEA BIT_MASK 0x2 /end MEASUREMENT
/begin MEASUREMENT E_CASR " CAN-Fehler: ASR Kommunikation" UBYTE B_TRUE 0 0 0.000000 1.000000 ECU_ADDRESS 0xFDED BIT_MASK 0x8 /end MEASUREMENT
/begin MEASUREMENT E_CBC " CAN-Fehler: Nachrichtenfehler Body-Computer" UBYTE B_TRUE 0 0 0.000000 1.000000 ECU_ADDRESS 0xFDEA BIT_MASK 0x4 /end MEASUREMENT
/begin MEASUREMENT E_CEGS " CAN-Fehler: EGS Kommunikation" UBYTE B_TRUE 0 0 0.000000 1.000000 ECU_ADDRESS 0xFDEA BIT_MASK 0x8 /end MEASUREMENT
/begin MEASUREMENT E_CNBA " CAN-Fehler: NBA Kommunikation" UBYTE B_TRUE 0 0 0.000000 1.000000 ECU_ADDRESS 0xFDED BIT_MASK 0x20 /end MEASUREMENT
/begin MEASUREMENT E_DG " 1 = Fehler Drehzahlgeber" UBYTE B_TRUE 0 0 0.000000 1.000000 ECU_ADDRESS 0xFDE6 BIT_MASK 0x20 /end MEASUREMENT
/begin MEASUREMENT E_DK " 1 = Fehler Drosselklappengeber" UBYTE B_TRUE 0 0 0.000000 1.000000 ECU_ADDRESS 0xFDE7 BIT_MASK 0x2 /end MEASUREMENT
/begin MEASUREMENT E_DTV1 " 1 = Fehler LR-Adaption ti-additiv, Bank1" UBYTE B_TRUE 0 0 0.000000 1.000000 ECU_ADDRESS 0xFDED BIT_MASK 0x2 /end MEASUREMENT
/begin MEASUREMENT E_DVE " 1 = Fehler Drosselklappensteller" UBYTE B_TRUE 0 0 0.000000 1.000000 ECU_ADDRESS 0xFDE7 BIT_MASK 0x2 /end MEASUREMENT
/begin MEASUREMENT E_EV " 1 = Fehler Einspritzventile" UWORD B_TRUE 0 0 0.000000 1.000000 ECU_ADDRESS 0xFD66 BIT_MASK 0x20 /end MEASUREMENT
/begin MEASUREMENT E_EV1 " 1 = Fehler Einspritzventil 1" UBYTE B_TRUE 0 0 0.000000 1.000000 ECU_ADDRESS 0xFDE8 BIT_MASK 0x40 /end MEASUREMENT
/begin MEASUREMENT E_EV2 " 1 = Fehler Einspritzventil 2" UBYTE B_TRUE 0 0 0.000000 1.000000 ECU_ADDRESS 0xFDE8 BIT_MASK 0x80 /end MEASUREMENT
/begin MEASUREMENT E_EV3 " 1 = Fehler Einspritzventil 3" UBYTE B_TRUE 0 0 0.000000 1.000000 ECU_ADDRESS 0xFDE9 BIT_MASK 0x1 /end MEASUREMENT
/begin MEASUREMENT E_EV4 " 1 = Fehler Einspritzventil 4" UBYTE B_TRUE 0 0 0.000000 1.000000 ECU_ADDRESS 0xFDE9 BIT_MASK 0x2 /end MEASUREMENT
/begin MEASUREMENT E_EV5 " 1 = Fehler Einspritzventil 5" UBYTE B_TRUE 0 0 0.000000 1.000000 ECU_ADDRESS 0xFDE9 BIT_MASK 0x4 /end MEASUREMENT
/begin MEASUREMENT E_FRA1 " 1 = Fehler LR-Adaption multiplikativ, Bank1" UBYTE B_TRUE 0 0 0.000000 1.000000 ECU_ADDRESS 0xFDED BIT_MASK 0x1 /end MEASUREMENT
/begin MEASUREMENT E_HFM " 1 = HFM-Error" UBYTE B_TRUE 0 0 0.000000 1.000000 ECU_ADDRESS 0xFDE6 BIT_MASK 0x2 /end MEASUREMENT
/begin MEASUREMENT E_HSH " Fehler Heizung Lambda-Sonde hinter Kat Bank1" UBYTE B_TRUE 0 0 0.000000 1.000000 ECU_ADDRESS 0xFDEC BIT_MASK 0x1 /end MEASUREMENT
/begin MEASUREMENT E_HSHE " Endstufen-Fehler Heizung Lambda-Sonde hinter Kat Bank1" UBYTE B_TRUE 0 0 0.000000 1.000000 ECU_ADDRESS 0xFDEC BIT_MASK 0x4 /end MEASUREMENT
/begin MEASUREMENT E_HSV " Fehler Heizung Lambda-Sonde vor Kat Bank1" UBYTE B_TRUE 0 0 0.000000 1.000000 ECU_ADDRESS 0xFDEB BIT_MASK 0x80 /end MEASUREMENT
/begin MEASUREMENT E_HSVE " 1 = Endstufen-Fehler Lambda-Sondenheizung v. KAT Bank1" UBYTE B_TRUE 0 0 0.000000 1.000000 ECU_ADDRESS 0xFDEC BIT_MASK 0x2 /end MEASUREMENT
/begin MEASUREMENT E_KAT1 " 1 = Fehler Katalysatorkonvertierung, Bank1" UBYTE B_TRUE 0 0 0.000000 1.000000 ECU_ADDRESS 0xFDEC BIT_MASK 0x40 /end MEASUREMENT
/begin MEASUREMENT E_KRHW " KR-Hardware-Sammelfehler B2_BI" UBYTE B_TRUE 0 0 0.000000 1.000000 ECU_ADDRESS 0xFDE8 BIT_MASK 0x1 /end MEASUREMENT
/begin MEASUREMENT E_KS1 " Sensor1-Abfall" UBYTE B_TRUE 0 0 0.000000 1.000000 ECU_ADDRESS 0xFDE8 BIT_MASK 0x2 /end MEASUREMENT
/begin MEASUREMENT E_KS2 " Sensor2-Abfall" UBYTE B_TRUE 0 0 0.000000 1.000000 ECU_ADDRESS 0xFDE8 BIT_MASK 0x4 /end MEASUREMENT
/begin MEASUREMENT E_LASH1 " 1 = Fehler Lambda-Sondenalterung h. KAT Bank1" UBYTE B_TRUE 0 0 0.000000 1.000000 ECU_ADDRESS 0xFDEB BIT_MASK 0x40 /end MEASUREMENT
/begin MEASUREMENT E_LATP1 " 1 = Fehler Lambda-Sondenalterung TP Bank1" UBYTE B_TRUE 0 0 0.000000 1.000000 ECU_ADDRESS 0xFDEB BIT_MASK 0x10 /end MEASUREMENT
/begin MEASUREMENT E_LATV1 " 1 = Fehler Lambda-Sondenalterung TV Bank1" UBYTE B_TRUE 0 0 0.000000 1.000000 ECU_ADDRESS 0xFDEB BIT_MASK 0x20 /end MEASUREMENT
/begin MEASUREMENT E_LM " 1 = Lasterfassungsfehler" UBYTE B_TRUE 0 0 0.000000 1.000000 ECU_ADDRESS 0xFDE6 BIT_MASK 0x2 /end MEASUREMENT
/begin MEASUREMENT E_LSH1 " Diagnose Lambda-Sonde 1 hinter Kat Bank1" UBYTE B_TRUE 0 0 0.000000 1.000000 ECU_ADDRESS 0xFDEB BIT_MASK 0x8 /end MEASUREMENT
/begin MEASUREMENT E_LSV1 " Fehler Lambda-Sonde vor Kat Bank 1" UBYTE B_TRUE 0 0 0.000000 1.000000 ECU_ADDRESS 0xFDEB BIT_MASK 0x4 /end MEASUREMENT
/begin MEASUREMENT E_PAC " Fehler: Klimadrucksensor" UBYTE B_TRUE 0 0 0.000000 1.000000 ECU_ADDRESS 0xFDEE BIT_MASK 0x2 /end MEASUREMENT
/begin MEASUREMENT E_PH " Phasenfehler" UBYTE B_TRUE 0 0 0.000000 1.000000 ECU_ADDRESS 0xFDE6 BIT_MASK 0x40 /end MEASUREMENT
/begin MEASUREMENT E_RSKA " 1 = Fehler reversibele SKA" UBYTE B_TRUE 0 0 0.000000 1.000000 ECU_ADDRESS 0xFDE7 BIT_MASK 0x20 /end MEASUREMENT
/begin MEASUREMENT E_SWE " 1 = Fehler Schlechtwegerkennung" UBYTE B_TRUE 0 0 0.000000 1.000000 ECU_ADDRESS 0xFDED BIT_MASK 0x4 /end MEASUREMENT
/begin MEASUREMENT E_TA " 1 = Fehler Ansauglufttemperaturfuehler" UBYTE B_TRUE 0 0 0.000000 1.000000 ECU_ADDRESS 0xFDE6 BIT_MASK 0x8 /end MEASUREMENT
/begin MEASUREMENT E_TEVE " 1 = Fehler TEV-Endstufe" UBYTE B_TRUE 0 0 0.000000 1.000000 ECU_ADDRESS 0xFDE9 BIT_MASK 0x8 /end MEASUREMENT
/begin MEASUREMENT E_TLTLW "> 1 = Fehler in Hoehenadaption" UWORD B_TRUE 0 0 0.000000 1.000000 ECU_ADDRESS 0xFD5A BIT_MASK 0x2000 /end MEASUREMENT
/begin MEASUREMENT E_TM " 1 = Fehler Kuehlmitteltemperaturfuehler" UBYTE B_TRUE 0 0 0.000000 1.000000 ECU_ADDRESS 0xFDE6 BIT_MASK 0x4 /end MEASUREMENT
/begin MEASUREMENT E_TRA1 " 1 = Fehler LR-Adaption QL-additiv, Bank1" UBYTE B_TRUE 0 0 0.000000 1.000000 ECU_ADDRESS 0xFDEC BIT_MASK 0x80 /end MEASUREMENT
/begin MEASUREMENT E_UB " 1 = Ubatt fehlerhaft" UBYTE B_TRUE 0 0 0.000000 1.000000 ECU_ADDRESS 0xFDE6 BIT_MASK 0x80 /end MEASUREMENT
/begin MEASUREMENT E_VFZ " 1 = V-Signal fehlerhaft" UBYTE B_TRUE 0 0 0.000000 1.000000 ECU_ADDRESS 0xFDE6 BIT_MASK 0x10 /end MEASUREMENT
/begin MEASUREMENT E_VSIG_UP " 1 = V-Signal unplausibel" UBYTE B_TRUE 0 0 0.000000 1.000000 ECU_ADDRESS 0xFDE6 BIT_MASK 0x10 /end MEASUREMENT
/begin MEASUREMENT E_V_CAN " 1= Fehler Geschwindigkeit" UWORD B_TRUE 0 0 0.000000 1.000000 ECU_ADDRESS 0xFD6E BIT_MASK 0x800 /end MEASUREMENT
/begin MEASUREMENT NWHG " Phasensensorsignal am CPU-Pin" UWORD B_TRUE 0 0 0.000000 1.000000 ECU_ADDRESS 0xFD2A BIT_MASK 0x4000 /end MEASUREMENT
/begin MEASUREMENT S_DLSV1 " '1'= %DLSV Bank1 gesperrt" UWORD B_TRUE 0 0 0.000000 1.000000 ECU_ADDRESS 0xFDAC BIT_MASK 0x80 /end MEASUREMENT
/begin MEASUREMENT S_KO " 1 = Klimakompressoranforderung aktiv" UWORD B_TRUE 0 0 0.000000 1.000000 ECU_ADDRESS 0xFD04 BIT_MASK 0x20 /end MEASUREMENT
/begin MEASUREMENT S_KUP " 1 = Kupplungsschalter betaetigt (Handschalter)" UWORD B_TRUE 0 0 0.000000 1.000000 ECU_ADDRESS 0xFD02 BIT_MASK 0x40 /end MEASUREMENT
/begin MEASUREMENT S_LSV1 " '1'= Z_lsv1 ignorieren" UWORD B_TRUE 0 0 0.000000 1.000000 ECU_ADDRESS 0xFDAE BIT_MASK 0x400 /end MEASUREMENT
/begin MEASUREMENT S_SCHALT " 1 = EGS schaltet (CAN)" UWORD B_TRUE 0 0 0.000000 1.000000 ECU_ADDRESS 0xFD0A BIT_MASK 0x400 /end MEASUREMENT
/begin MEASUREMENT VC_FGR " 1 = Variante mit Tempomat" UWORD B_TRUE 0 0 0.000000 1.000000 ECU_ADDRESS 0xFDF4 BIT_MASK 0x4 /end MEASUREMENT
/begin FUNCTION _AGR "67.0.0"
 /begin REF_CHARACTERISTIC TPBAGR TAGRAEB KFAGR FBAGR FAGRM DTPAGKF DTPAGAB DTLAGR DTAAGKF DTAAGAB /end REF_CHARACTERISTIC
 /begin LOC_MEASUREMENT TVEGR TMOT TL8 NMOT DTLW B_SA B_LL /end LOC_MEASUREMENT
/end FUNCTION
/begin FUNCTION _AR "62.120.0"
 /begin REF_CHARACTERISTIC ZNFIG_MT ZNFIG_AT WDKARDYN VMINAR TWLWS TLFI TKLWS PEDARDYN PEDARDMX NDFI NAA KFZWLW KFWARNDG KFTDARNG KFARTLN FARDYM DZUE8 DZUE7 DWAPDN DWANDN DINK8 DINK7 /end REF_CHARACTERISTIC
 /begin LOC_MEASUREMENT ZWLWS NFI B_ZWARDY B_AR WARDY WAR WDKBL VFZG TL8 S_SCHALT PEDGR8 PEDGR NMOT NIST NGRTN GANG E_DK B_VARA B_START B_SELESP B_NCAUPAKT B_MSRAKT B_LL B_KS B_HG B_GV /end LOC_MEASUREMENT
/end FUNCTION
/begin FUNCTION _ATM "31.20.0"
 /begin REF_CHARACTERISTIC ZATMVFZ ZATMKML ZATMAML TMATMTP TMATMKV TATMTP TATMSA KLIMLKATW KLIMLKAT KLIMLAW KLIMLAB KFATMZW KFATMMLV KFATMMLN IMLFLL IMLATMU FATMRWZ ATMTANS /end REF_CHARACTERISTIC
 /begin LOC_MEASUREMENT TATMSTA B_TPKV B_TPKLAST TKATM TABGM IMLATM B_ATMTPL B_ATMTPK B_ATMTPF B_ATMTPA VFZG TMST TANSLIN TANS MLSM DZWSPAET B_STEND B_SA B_KL15 B_INIT /end LOC_MEASUREMENT
/end FUNCTION
/begin FUNCTION _ATWAL "2.50.0" /begin REF_CHARACTERISTIC TVTMWAL TMWALE TMWALA T_LAMPE /end REF_CHARACTERISTIC /begin LOC_MEASUREMENT B_WALALT B_WAL B_LAMPE B_STEND /end LOC_MEASUREMENT /end FUNCTION
/begin FUNCTION _BBABW "6.10.0" /begin REF_CHARACTERISTIC UBDABW TWABW TABWM /end REF_CHARACTERISTIC
 /begin LOC_MEASUREMENT UBABW TNBM B_OFFABW B_ABW UB E_UB BZSYNC B_START B_KL15 B_INIT /end LOC_MEASUREMENT
/end FUNCTION
/begin FUNCTION _BBGANG "9.40.0"
 /begin REF_CHARACTERISTIC VNQUOT6U VNQUOT6O VNQUOT5U VNQUOT5O VNQUOT4U VNQUOT4O VNQUOT3U VNQUOT3O VNQUOT2U VNQUOT2O VNQUOT1U VNQUOT1O NGANGMIN /end REF_CHARACTERISTIC
 /begin LOC_MEASUREMENT QUOT GANG_I GANG VFZG_W NIST_1U E_VFZ B_VNULL B_SELESP B_KUPSTAT B_GV /end LOC_MEASUREMENT
/end FUNCTION
/begin FUNCTION _BBHR "3.10.0" /begin REF_CHARACTERISTIC TPKL15 THROM /end REF_CHARACTERISTIC /begin LOC_MEASUREMENT B_KL15 B_HR B_NMIN /end LOC_MEASUREMENT /end FUNCTION
/begin FUNCTION _BBNMAX "21.100.0"
 /begin REF_CHARACTERISTIC VNMAXRF VNMAXDF VNMAXAT TNMAXKE TNMAXK TNMAXAT SWU_NMAX SWG_NMAX NMAXWF NMAXRE NMAXR NMAXKE NMAXK NMAXE_C NMAXDV NMAXDE NMAXD NMAXAT NGRADFIL K_PCALC K_ISET K_ICALC IN_FAK I_NDIFMX /end REF_CHARACTERISTIC
 /begin LOC_MEASUREMENT SW_NMAXP SW_NMAXI N_RDIF SW_NMAX B_NMAXE B_NMAX TMOT SW_RES NIST_1U E_VSIG_UP E_CAN /end LOC_MEASUREMENT
/end FUNCTION
/begin FUNCTION _BBNMIN "1.10.0" /begin REF_CHARACTERISTIC NMIN /end REF_CHARACTERISTIC /begin LOC_MEASUREMENT B_NMIN /end LOC_MEASUREMENT /end FUNCTION
/begin FUNCTION _BBPR "4.10.0" /begin REF_CHARACTERISTIC TPR10V /end REF_CHARACTERISTIC /begin LOC_MEASUREMENT B_PR B_NMIN B_KL15 /end LOC_MEASUREMENT /end FUNCTION
/begin FUNCTION _BBSAWE "14.170.0"
 /begin REF_CHARACTERISTIC UWEW UWEH TVSAKUPN T_SA_M TNSSA TLSN SAS_BLL REDSAEG REDSAAG PEDGRWE NGWE KFTVSAN KFTVSAAC KFNWE1 KFNWE DTSA DTLWE DNWEK DNSAL DNSAH /end REF_CHARACTERISTIC
 /begin LOC_MEASUREMENT NWE NAB DNAB B_SAREQ B_SAANF B_WEH B_WE B_SA B_REDSA B_REDMX TNST TMOT TL8 S_SCHALT S_KUP S_KO PEDGR NIST GANG_I B_TLROK B_SELESP B_NOTL B_MSRAKT B_LL B_KUP B_KOE B_KH B_GV B_ASR /end LOC_MEASUREMENT
/end FUNCTION
/begin FUNCTION _BBSTART "1.10.0" /begin REF_CHARACTERISTIC NSTNM NNST /end REF_CHARACTERISTIC /begin LOC_MEASUREMENT TNST B_START B_NMIN /end LOC_MEASUREMENT /end FUNCTION
/begin FUNCTION _BGBS "6.20.0" /begin REF_CHARACTERISTIC VASRM TMVDBS DRMX CWABSSW /end REF_CHARACTERISTIC /begin LOC_MEASUREMENT E_SWE DRSWE BS DFH B_NUMES10 B_INIT /end LOC_MEASUREMENT /end FUNCTION
/begin FUNCTION _BGBSZ "3.20.0" /begin REF_CHARACTERISTIC VC_BC NMAXU /end REF_CHARACTERISTIC /begin LOC_MEASUREMENT KMSTMIL_W C_NMAX ANZNMAX VFZG_U B_NMAX B_MIL B_KMMIL /end LOC_MEASUREMENT /end FUNCTION
/begin FUNCTION _BGFHA "1.40.0"
 /begin REF_CHARACTERISTIC ZDKHAS ZDKHA WKWAUN WKWAN VHA TVHA TSHAS THAS TFDKHA FWMREDACC FDKHE FDKHAU FDKHAO FDDKHAU FDDKHAO DFDKHA /end REF_CHARACTERISTIC
 /begin LOC_MEASUREMENT TSCHUB B_SZ B_HAS B_HA FDKHA B_WNL WDKBL VFZG TLW E_VFZ E_V_CAN E_TLTLW E_CASR E_CAN B_SA B_LL B_DKNOT_FR /end LOC_MEASUREMENT
/end FUNCTION
/begin FUNCTION _BGRML "2.10.0" /begin REF_CHARACTERISTIC MLMAX /end REF_CHARACTERISTIC /begin LOC_MEASUREMENT RML MLSMW FDKHA /end LOC_MEASUREMENT /end FUNCTION
/begin FUNCTION _BGTL "130.80.0"
 /begin REF_CHARACTERISTIC TL_NOK TLMXNNW TLMXN KHFM KFZTLZ KFZTLN KFZTLMN KFZTLM KFZTL KFTLSTA KFPUNNW KFPUN DTLFU /end REF_CHARACTERISTIC
 /begin LOC_MEASUREMENT WDKBL TL8 TLW TLR NIST MLSM E_HFM B_TLFU B_START B_NWS TL8Z TL8M TLZ TMOT FDKHA /end LOC_MEASUREMENT
/end FUNCTION
/begin FUNCTION _BGTLW "44.20.0" /begin REF_CHARACTERISTIC KFTLW FANS /end REF_CHARACTERISTIC /begin LOC_MEASUREMENT TLW WDKBL NMOT FDKHA /end LOC_MEASUREMENT /end FUNCTION
/begin FUNCTION _BGWDK "6.30.0" /begin REF_CHARACTERISTIC WDKVLN WDKDE IPSNHUB /end REF_CHARACTERISTIC /begin LOC_MEASUREMENT WDKBL DWDKBL B_VL IP2SN IP1SN E_DK /end LOC_MEASUREMENT /end FUNCTION
/begin FUNCTION _BKAS "4.20.0"
 /begin LOC_MEASUREMENT B_SKA B_EVLOC FLGTIAB B_WFSFREI B_UB_OK B_SA B_R_SKA_FR B_PHEA B_NMAX B_I_SKA_UM B_I_SKA_FR /end LOC_MEASUREMENT
/end FUNCTION
/begin FUNCTION _CAN "97.150.0"
 /begin REF_CHARACTERISTIC WGEXT_T V_ES VC_GETR VC_BC VC_ACC TV_DKVP TV_DKV T_MGRD T_MDACCGR T_EGSNP2 T_EGSNP1 T_EGSNPH T_ACMVER T_ACC_AUS T_ACC SWMSRRMP SWEGSRMP SWASRRMP SWACCRMP REDS_T REDA_T NREDMSR NREDMIN NORED MDUPNCAKL MDREDMN MDNORM MDNOKHA MDMSRKL MDMAXRECN MDEGTU_T MDEGTD_T MDEGTC_T MDEGS_T MDANS MD_AC KFZSWEGS KFZSWACC KFTLWTC KFREDV KFNGRD KFMNOKTC KFMNHMAX KFMNDKP KFMNDKMSR KFMNDKASR KFMNDKACC KFMNDK KFMDSN KFMDOFAC KFMDNOKN KFMDMSRGR KFMDMAXDKN KFMDHN KFMDGR KFMDASRLGR KFMDACCGR KFFMDDZW KFDZWFMDI KFDZWFMD FWMRED1 FWMREDNCA FWMREDASR FWMRED DZUE9 DMEGSOFF DMDEGS DKVOFFTC DINK9 CWHBRK CANSTAND CANSPEC /end REF_CHARACTERISTIC
 /begin LOC_MEASUREMENT STAT_MD_E B_NOSGS_FR B_NOMSR_FR B_FDYFGR B_ACCAKT WPED WDKBA TMOT TANKFST NMOT FCMEND EI_SGSC_UM B_WAL B_TEMPFE B_SYSERR B_PNCAN B_NOSGS_UM B_NOMSR_UM B_KOS B_KOE B_KL15 B_I_SKA_UM B_FGR B_BREMSE /end LOC_MEASUREMENT
/end FUNCTION
/begin FUNCTION _D2CTR "2.20.0" /begin REF_CHARACTERISTIC DFPSLBIT /end REF_CHARACTERISTIC /begin LOC_MEASUREMENT CTRZYF1 CTRZYF0 CTRSFP CTRRDY1 CTRERF1 B_TRIP B_SYSERR /end LOC_MEASUREMENT /end FUNCTION
/begin FUNCTION _DBL "3.0.0" /begin LOC_MEASUREMENT E_BL DRBL VC_FGR E_BREMSE B_BREMSE /end LOC_MEASUREMENT /end FUNCTION
/begin FUNCTION _DCAN "12.40.0"
 /begin REF_CHARACTERISTIC UB_NBAE UB_NBAA UB_EGSE UB_EGSA UB_CANE UB_CANA UB_BCE UB_BCA UB_ASRE UB_ASRA UB_ACCE UB_ACCA T2CANOFF TP_NBA TP_EGS TP_BC TP_ASR TP_ACC TNOMNBA T_NOMNBA T_NOMHNBA T_NOMHEGS T_NOMHBC T_NOMHASR T_NOMHACC TNOMEGS T_NOMEGS TNOMBC T_NOMBC TNOMASR T_NOMASR TNOMACC T_NOMACC TFAULNBA TFAULEGS TFAULBC TFAULASR TFAULACC TCANOFF TCANMUTE NFAULNBA NFAULEGS NFAULBC NFAULASR NFAULACC NCANOFF CWDCAN /end REF_CHARACTERISTIC
 /begin LOC_MEASUREMENT E_CNBA E_CEGS E_CBC E_CASR E_CACC C_NOMNBA C_NOMHNBA C_NOMHEGS C_NOMHBC C_NOMHASR C_NOMHACC C_NOMEGS C_NOMBC C_NOMASR C_NOMACC B_NOMNBA B_NOMEGS B_NOMBC B_NOMASR B_NOMACC B_KL15 B_INIT /end LOC_MEASUREMENT
/end FUNCTION
/begin FUNCTION _DCLA "9.10.0" /begin LOC_MEASUREMENT B_WUC B_TIM B_TAL B_SP3 B_SP2 B_SP1 B_DCY /end LOC_MEASUREMENT /end FUNCTION
/begin FUNCTION _DDCY "15.10.0" /begin REF_CHARACTERISTIC TWBDCY /end REF_CHARACTERISTIC /begin LOC_MEASUREMENT DCYCNT B_DCY BBDCY B_STEND /end LOC_MEASUREMENT /end FUNCTION
/begin FUNCTION _DDG "5.20.0" /begin LOC_MEASUREMENT E_DG B_NOFLR NWHG NIST_1U BZSYNC /end LOC_MEASUREMENT /end FUNCTION
/begin FUNCTION _DDSAC "1.10.0" /begin REF_CHARACTERISTIC UADPACMX UADPACMN TDDFAC CWDDSAC /end REF_CHARACTERISTIC /begin LOC_MEASUREMENT SFPPAC E_PAC UDSAC_W B_STEND B_KL15 /end LOC_MEASUREMENT /end FUNCTION
/begin FUNCTION _DDVE "4.21.0" /begin REF_CHARACTERISTIC N_DKIST /end REF_CHARACTERISTIC
 /begin LOC_MEASUREMENT E_RSKA E_DVE E_DK DRRSKA DRIPDK DRDVE B_STZ NIST B_STEND B_R_SKA_FR B_NOTLU_FR B_LRNWS B_I_SKA_FR B_IPSOK_FR B_DKNOT_FR /end LOC_MEASUREMENT
/end FUNCTION
/begin FUNCTION _DECJ "14.0.0" /begin LOC_MEASUREMENT B_ESDIA B_DESEE UB NMOT /end LOC_MEASUREMENT /end FUNCTION
/begin FUNCTION _DEKPE "11.10.0" /begin LOC_MEASUREMENT B_DESEE /end LOC_MEASUREMENT /end FUNCTION
/begin FUNCTION _DEPCL "2.10.0" /begin REF_CHARACTERISTIC TEPCLI TEPCL /end REF_CHARACTERISTIC /begin LOC_MEASUREMENT B_EPCL EPCLSTATE B_NMOT /end LOC_MEASUREMENT /end FUNCTION
/begin FUNCTION _DEVE "2.0.0" /begin LOC_MEASUREMENT B_NOFLR E_EV5 E_EV4 E_EV3 E_EV2 E_EV1 E_EV B_STEND B_DESEE /end LOC_MEASUREMENT /end FUNCTION
/begin FUNCTION _DFCM "1.10.0" /end FUNCTION
/begin FUNCTION _DFFT "1.40.0"
 /begin LOC_MEASUREMENT WPED WDKS WDKBA VFZG_U USVK2 USVK USHK2 USHK UPWG2_U UPWG2D_U UPWG1_U UHSV2 UHSV UHSH2 UHSH UDKP2_U UDKP1_U UB TUMG TPSVKMF2_U TPSVKMF_U TMOT_U TMOT TMEW TKATM2 TKATM TFST TANS TABGM2 TABGM SKAPFAD RSTPFAD RML RL RINV2_U RINV_U RINH2_U RINH_U PU NMOT MPFAD ML MI_DUF FR2_U FR_U FRA2_U FRA_U FLGLRS2 FLGLRS EGASPFAD /end LOC_MEASUREMENT
/end FUNCTION
/begin FUNCTION _DFFTCNV "5.10.0"
 /begin LOC_MEASUREMENT WPED WDKS WDKBA VFZG_U UPWG2_U UPWG2D_U UPWG1_U UDKP2_U UDKP1_U UB TPSVKMF2_U TPSVKMF_U TMOT_U TMEW SKAPFAD RL RINV2_U RINH2_U RINH_U ML MI_DUF FR2_U FR_U FRA2_U FRA_U WDKBL VFZG_W UBATT TPSVKMF2_W TPSVKMF_W TMOTLIN TMDMM TL8 SWPT SP2S SP1S RINV2_W RINV_W RINH2_W RINH_W MLSM MI_UM IP2S IP1S FR_B2 FR_B1 FRA_B2 FRA_B1 DRSKAUM DKVRES8 /end LOC_MEASUREMENT
/end FUNCTION
/begin FUNCTION _DFFTK "1.10.0" /begin LOC_MEASUREMENT TMOT NMOT /end LOC_MEASUREMENT /end FUNCTION
/begin FUNCTION _DFPM "3.12.0" /begin LOC_MEASUREMENT B_WUC B_DCY /end LOC_MEASUREMENT /end FUNCTION
/begin FUNCTION _DFRZ "20.20.0" /end FUNCTION
/begin FUNCTION _DHFM "6.50.0" /begin REF_CHARACTERISTIC TDMLST TDMLNF TDMLMX TDMLMN NDMLST NDLMMN MLDMXN MLDMNW /end REF_CHARACTERISTIC /begin LOC_MEASUREMENT B_NOFLR E_LM NIST MLSMS ML /end LOC_MEASUREMENT /end FUNCTION
/begin FUNCTION _DHLS "60.20.0"
 /begin REF_CHARACTERISTIC ZKPRIV ZKPRIH ZKARIV ZKARIH UBDLSMX UBDLS TVRIF TADHMXV TADHMXH TADHMN KLFRINV KLFRINH KFRINV KFRINH /end REF_CHARACTERISTIC
 /begin LOC_MEASUREMENT TKATMFH TABGMFH PHLSNVFH PHLSNHFH E_HSV E_HSH B_NOFLR UBATT TKATM TABGM RINV2_W RINV_W RINH2_W RINH_W PHLSNV PHLSNH E_HSVE E_HSHE B_STEND B_RINV2 B_RINV B_RINH2 B_RINH B_INIT B_ATMTPK B_ATMTPA /end LOC_MEASUREMENT
/end FUNCTION
/begin FUNCTION _DHLSE "1.50.0" /begin LOC_MEASUREMENT E_HSVE E_HSHE DRHSVE DRHSHE B_INIT B_DESEE /end LOC_MEASUREMENT /end FUNCTION
/begin FUNCTION _DIMC "23.11.0" /begin REF_CHARACTERISTIC SRYTES SRYSLS SRYLS SRYKAT SRYHS SRYAGR CDAGR /end REF_CHARACTERISTIC
 /begin LOC_MEASUREMENT READY EVSUP1 B_TESRDY B_SLSRDY B_LSRDY B_KATRDY B_HSRDY B_AGRRDY B_PWF B_KATH B_KATFZ B_CDTES B_CDSLS B_CDLSV B_CDLDP B_CDHSV B_CDAGR /end LOC_MEASUREMENT
/end FUNCTION
/begin FUNCTION _DKADMB "1.2.0"
 /begin REF_CHARACTERISTIC NISTV08 IV_ADMB DFH_ADMB ADMBV_VH ADMBVKL ADMBR_VH ADMB_RP ADMBRKL /end REF_CHARACTERISTIC
 /begin LOC_MEASUREMENT TLS_ADMB B_ADMBAKT SW_ADMB UEBVER TL8 SW_NACHL NIST DFH B_HG /end LOC_MEASUREMENT
/end FUNCTION
/begin FUNCTION _DKAT "64.50.0"
 /begin REF_CHARACTERISTIC ZKTDRL ZDKTBF ZDKTBD ZDKATAF ZDKATAD TWKTDLP TWDKATST TMNKATT TMINKAT TMAXKAT TDKATATT TDKATAKT RLDKTUT RLDKTSU RLDKTSO RLDKTOT NKTDX NDKTSUT NDKTSU NDKTSOT NDKTSO KFKABMT KATBSH KATBSG KATBFXM KATBFSX KATBFNP KATBFNM KATBFN KATBFMNT KATBFMN KATBFML FALRKTT FALRKTD DRLKTDPT DRLKTDP DKATCW CDKAT AVKATFS APEKTDX AHKTTSW AHKTMXT AHKTISW AHKATSB AHKATS AHKATMX AHKATMN ADKATNF /end REF_CHARACTERISTIC
 /begin LOC_MEASUREMENT MLSMW KATBF1 KATBFS1 KATBFI1_W KAKBMT FALRDKT DKATAKT2_W DKATAKT1_W B_ERDKT1 B_DKTTK B_DKTT B_DKTST1 B_DKTSP1 B_DKTSB1 B_DKTNR B_DKTLP B_DKTEN B_DKLPI B_DKINI B_DKATEND1 B_BFSP11 APEDKT AKATBN2 AKATBN1 AKATBNK2 AKATBNK1 AHKAT2 AHKAT1 AHKATN1 B_LRSYNC B_BFSP1 AVKATF2 AVKATF1 USHK2W USHK1W TL8 TKATM NIST MLSM FR_B2 FR_B1 E_LM E_KAT1 B_PWF B_INIT B_FAKAT B_FA /end LOC_MEASUREMENT
/end FUNCTION
/begin FUNCTION _DKBVF "1.0.0"
 /begin REF_CHARACTERISTIC GBVU GBVO GBVAR GBTVST GBTMOT GBTDKR GBPEDGR GBNU GBNO GBDKRUE GBDKD2 GBDKD1 /end REF_CHARACTERISTIC
 /begin LOC_MEASUREMENT B_BVF SW_BVF PEDGR B_HG /end LOC_MEASUREMENT
/end FUNCTION
/begin FUNCTION _DKFP "3.0.0" /begin REF_CHARACTERISTIC N_FPR FPR_MT FPR_AT /end REF_CHARACTERISTIC
 /begin LOC_MEASUREMENT B_IP2SEL_F B_FPRVB B_FPRRDY B_FPRFG EI_FPR_FR DKUAN B_NOTLU_FR B_FPRAKT TMOT TANS NIST IP1S DKUANSP DFV DFH /end LOC_MEASUREMENT
/end FUNCTION
/begin FUNCTION _DKLR "1.2.0" /begin LOC_MEASUREMENT B_R_SKA_FR DCLR /end LOC_MEASUREMENT /end FUNCTION
/begin FUNCTION _DKLUAN "2.20.0"
 /begin REF_CHARACTERISTIC UAN_U_MT UAN_U_AT UANPIDMIN UAN_O_MT UANOFF UAN_O_AT SWUANL IP1SIVL IP1SILL IPSNHUB DNUANMIN DNUANMAX DKPWMVL DKPWMLL DKDNHUB /end REF_CHARACTERISTIC
 /begin LOC_MEASUREMENT LRNSTEP_C LRNWERT IP2SUAN IP1SUAN EI_UAN_FR DKUANSP DKUAN B_LRNWS B_LRNVB B_LRNRDY B_LRNFG B_LRNERF B_LRNAKT V_CAN UBATT TMOT SW_PED NIST IP2S IP1S DFV DFH B_URSTA B_LRNREQ B_I_SKA_UM B_I_SKA_FR /end LOC_MEASUREMENT
/end FUNCTION
/begin FUNCTION _DKLWB "1.1.0" /begin REF_CHARACTERISTIC N_LWB LWB_RP LWB_KL IV_LWB /end REF_CHARACTERISTIC /begin LOC_MEASUREMENT SW_LWB TL8 NIST_1U /end LOC_MEASUREMENT /end FUNCTION
/begin FUNCTION _DKRM "5.0.0" /begin REF_CHARACTERISTIC UDKRTP UDKRNT UDKRGOFS TMKR KRFHT DKRISNT /end REF_CHARACTERISTIC /begin LOC_MEASUREMENT KTI2INT KTI1INT MFEOFS KRNT E_KRHW B_STEND B_NOFLR TMOT /end LOC_MEASUREMENT /end FUNCTION
/begin FUNCTION _DKRS "22.20.0" /begin REF_CHARACTERISTIC UDKSNU UDKSNO TMKR TDKS NDKS /end REF_CHARACTERISTIC
 /begin LOC_MEASUREMENT RKRN NIST B_NOFLR B_KS B_KR E_KS2 E_KS1 TMOT E_PH E_KRHW DWKRS B_INIT /end LOC_MEASUREMENT
/end FUNCTION
/begin FUNCTION _DKSI "4.10.0" /begin REF_CHARACTERISTIC SWSTAT LAGE_F_T KL_ABW IPSNNOT GR_ABW DKDNHUB /end REF_CHARACTERISTIC
 /begin LOC_MEASUREMENT EI_DKLAGE B_R_SKA_FR B_NOTLU_FR LAGE_F_C IPSN_FR DKV_R B_UB_OK B_NOTL B_MS100 B_LRNRDY B_I_SKA_FR /end LOC_MEASUREMENT
/end FUNCTION
/begin FUNCTION _DKVS "9.10.0"
 /begin REF_CHARACTERISTIC TTRAZ TTRA TRARX TRARN TRAE TRADX TRADN TFRAZ TFRA FRARX FRARN FRAE FRADX FRADN DTVDX DTVDN /end REF_CHARACTERISTIC
 /begin LOC_MEASUREMENT TRAZS2 FRAZS2 FRAZS1 B_BOFTRA2 B_BOFTRA1 B_BOFFRA2 B_BOFFRA1 B_BOFDTV2 B_BOFDTV1 KVSTXW2 KVSTXW KVSTXS2 KVSTXS KVSTNW2 KVSTNW KVSTNS2 KVSTNS KVSFXW2 KVSFXW KVSFXS2 KVSFXS KVSFNW2 KVSFNW KVSFNS2 KVSFNS E_TRA1 E_FRA1 E_DTV1 DRTRA1 DRFRA1 DRDTV1 B_GAE2 B_GAE1 B_GAEFRA2 B_GAEFRA1 B_EDKVS2 B_EDKVS1 TRA_B2 TRA_B1 FRAU_B2 FRAU_B1 DTV_B2 DTV_B1 B_TRA2 B_TRA1 B_LRA2 B_LRA1 B_INIT B_FRAU2 B_FRAU1 /end LOC_MEASUREMENT
/end FUNCTION
/begin FUNCTION _DK_SWK "4.330.0"
 /begin REF_CHARACTERISTIC VC_ACC TEMPFELL SW_N_0 SWMAXN N_SW_MAX NMOT_LO NMOT_HI FWMRED DKMAXKL /end REF_CHARACTERISTIC
 /begin LOC_MEASUREMENT SW_PEDBW SW_NACHL SW_MIN SW_MAXN SW_MAX B_SWMAXN SWRES SW_RES SWPT SW_PT DKVRES8 DKVRESTC DKVRES DKV_R B_TEMPFE B_LL B_IP3OK_FR SW_VMAX SW_TEMP SW_PEDKL SW_PED SW_NMAX SW_MSR SW_MAX_N SW_LLR SW_BVF SW_ASR S_SCHALT NMOT NIST E_HFM B_SELESP B_MSRAKT B_LL_DIS B_KS B_DKNOT_FR B_ASRAKT B_ACCAKT /end LOC_MEASUREMENT
/end FUNCTION
/begin FUNCTION _DLFR "2.20.0" /begin REF_CHARACTERISTIC N_UG_OF N_OG_OF LLR_UG_T LLR_OG_T LLP_T DK_UG_OF BGRPR_MT /end REF_CHARACTERISTIC
 /begin LOC_MEASUREMENT UBGR TMOT STGMW OBGR NIST B_UB_OK B_NOTLU_FR B_KLOFVB B_I_SKA_UM B_I_SKA_FR B_ADAPFG /end LOC_MEASUREMENT
/end FUNCTION
/begin FUNCTION _DLSA "50.30.0"
 /begin REF_CHARACTERISTIC ZFTSVK TWDDTV TVLRHMX TVLRHMN TSVKU TSVKO TSVKKU TSVKKTU TSVKKTO TSVKKO TSTEAA TLTPVKU TLTPVKO TLTPKTU TLTPKTO TKTPVK TDLRPER NTPVKU NTPVKO NTPKTU NTPKTO KFTPKOR CWDLSA ANZTP ANZDPVK /end REF_CHARACTERISTIC
 /begin LOC_MEASUREMENT ZLSATP1 TPSVKOF1_W TPOTV1_W TPLRVK1_W B_LSASTP1 B_CDLATV B_CDLATP TPSVKMF2_W SFPLATV1 SFPLATP1 E_LATV1 E_LATP1 B_DLATV1 B_DLATP1 TVLRHI2 TVLRHI1 TL8 TFRP2_W TFRP1_W TFRN2_W TFRN1_W TABGM NMOT KFRTV_R E_UB E_TM E_TEVE E_TA E_PH E_LM E_KAT1 E_HSV E_HSH B_URSTA B_TEHB B_TE B_MDARV B_LR2 B_LR1 B_LRHK2 B_LRHK1 B_INIT B_GASP B_FATV1 B_FATP1 B_FA B_EDKVS2 B_EDKVS1 ATVH2 ATVH1 /end LOC_MEASUREMENT
/end FUNCTION
/begin FUNCTION _DLSAHK "7.10.0"
 /begin REF_CHARACTERISTIC USSCHUB USHSTSOLL USHSTGMX USHRICH USHLEAN TUSSA TUSLASH TUSHSMIN TUSENLASH TUSCHUB TTLASH TSALASH TRIPFASH TLLASH TFRMB TABGSTG SMLDYN MLUSTEST MLUSSTG MLOSTEST MLLASH KMXSTG FRMLASHU FRMLASHO FFTLASH1 DMRLASH DLAMLASHM DLAMLASHF CWDLSAHK CLALASH1 CDTLASH1 CDLASH CDCLASH1 ANZDYNSH /end REF_CHARACTERISTIC
 /begin LOC_MEASUREMENT ZWDYNSH1 ZLASH1_W USHKSTEIG1 USHKMXSTG1 USHFMXSTG1 MLDYN_W LAMSONS1_W LAMFRM1_W FRMTRIP1_W FRM_B2 FRM_B1 B_USHSCH1 B_USHKM1 B_USHKF1 B_TRFASH1 B_TESLASH1 B_STEIGM1 B_MLUSTEST B_MLDYN B_MINLASH1 B_MAXLASH1 B_LSAHKSP1 B_LAMVERG1 B_LAMLASH1 B_LAMEND1 B_FRMLASH1 B_ENTEST1 B_ENLASH1 B_ENFMST1 B_DYLASH1 B_DUSHSCH1 B_DSHK1 B_DLASH1 B_DDYLASH1 B_ABGSTG1 SFPLASH1 LAMLASH1_W E_LASH1 USRHK USHKB1 MLSMW E_UB E_TEVE E_PH E_LSH1 E_HSH B_URSTA B_TEHB B_SBBHK2 B_SBBHK1 B_MDARV B_LRHK2 B_LRHK1 B_INIT B_GAE2 B_GAE1 B_FASH1 B_EVLOC B_EDKVS2 B_EDKVS1 B_CDLASH /end LOC_MEASUREMENT
/end FUNCTION
/begin FUNCTION _DLSH "27.10.0"
 /begin REF_CHARACTERISTIC USREMH USREFH USMIN USMAX UBDLS TUSMAX TUSKS TUSEINH TUSDUH TTBMH TRSE TRSAH TASIG TABGMCSD RISIGRESH DRISIGH CDLSH ABGMSIGH /end REF_CHARACTERISTIC
 /begin LOC_MEASUREMENT B_UEINH1 B_TRSAH2 B_TRSAH1 B_RISIGH2 B_RISIGH1 B_DSHEN2 B_DSHEN1 B_DLSHSP2 B_DLSHSP1 B_ADSH2 B_ADSH1 B_ACSDH2 B_ACSDH1 E_LSH1 B_TTBMHH2 B_TTBMHH B_SBBHK2 B_SBBHK1 USHK2W USHK1W UBATT TKATM TABGM RINH_W E_TEVE B_URSTA B_SLS B_NMIN B_LRHK2 B_LRHK1 B_KL15 B_INIT B_HSHE B_DSLS B_ATMTPK /end LOC_MEASUREMENT
/end FUNCTION
/begin FUNCTION _DLSSA "16.10.0"
 /begin REF_CHARACTERISTIC USRHKSHJ USR USMXSHMX USMXSHMN USMXSAMX USMXSAMN USMNSHMX USMNSHMN USMNSAMX USMNSAMN USIVMINV USIVMINH USIVMAXV USIVMAXH TWDLSSA TUSPNMX TUSPNMN TPSVKMX TPSVKMN SAFK2 SAFK1 ATVMAGU ATVMAGO ATVFETTU ATVFETTO /end REF_CHARACTERISTIC
 /begin LOC_MEASUREMENT USVKJF_W USMXSAA USMNSHA USMNSAA USHKJF_W TWDLSSH_W TWDLSSA_W B_TUSRE2 B_TUSRE B_TUSPN2 B_TUSPN USVKJ USRJ USMXSHN USMXSAN USMNSHN USMNSAN USHKJ TUSPNF TPSVLSSA ATVMAGER ATVFETT USVK2 USVK1 USHK2 USHK1 TPSVKMF2_W TPSVKMF_W TFRN2_W TFRN1_W B_LRHK2 B_LRHK1 B_FMS2 B_FMS1 B_DLATP1 ATVH2 /end LOC_MEASUREMENT
/end FUNCTION
/begin FUNCTION _DLSV "33.10.0"
 /begin REF_CHARACTERISTIC USREM USREF USMIN USMHK USMAX USFHK USDBU USDBO UBDLS TUSMAX TUSKS TUSFETT TUSEINV TUSDUC TUSDU TTBMH TRSE TRSA TNSTDN TMSVA TMSV TMNEB TASIG TABGMCSD RISIGRESV DRISIGV CDLSH ANZGEM ABGMSIGV /end REF_CHARACTERISTIC
 /begin LOC_MEASUREMENT ZWGEFLR2 B_VGEFLR B_VADGE2 B_VADGE B_UEINV B_TRSA2 B_TRSA B_RISIGV2 B_RISIGV B_REFMAX B_LSVN B_LSVKLT2 B_LSVKLT B_LSHUB B_LSFET B_LSADS B_DSVEN2 B_DSVEN B_DLSVSP B_ADSVB B_ADDE2 B_ADDE B_ADCSD2 B_ADCSD S_LSV1 E_LSV1 B_TTBMH2 B_SBBVK1 USVK2W USVK1W USHK2W USHK1W UBATT TMOT TABGM S_DLSV1 RINV_W E_TM E_TEVE B_URSTA B_START B_SLS B_LR2 B_LR1 B_KL15 B_INIT B_HSVE B_DSLS B_ATMTPA /end LOC_MEASUREMENT
/end FUNCTION
/begin FUNCTION _DMDDLU "11.11.0" /begin REF_CHARACTERISTIC KFDLUR DMXRDL DLURMIN /end REF_CHARACTERISTIC
 /begin LOC_MEASUREMENT DLUT_AP DLUTS8 DLUTS7 DLUTS6 DLUTS5 DLUTS4 DLUTS3 DLUTS2 DLUTS1 DLURS TL8 NIST LUT FLG_AP FDMD_AP B_LUSTOP B_DMDHI_AP /end LOC_MEASUREMENT
/end FUNCTION
/end MODULE
/end PROJECT
