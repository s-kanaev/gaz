ASAP2_VERSION 1 3
/begin PROJECT _ " [ME.ME3.1C.09.4111.DAMOS25]  DAMPAR_04"
/begin HEADER "Lancia Thesis 5-Zyl. 2,4 MT" PROJECT_NO 411.1 VERSION "P2FJGD66" /end HEADER
/begin MODULE DIM " "
/begin MOD_COMMON " " S_REC_LAYOUT DAMOS DEPOSIT ABSOLUTE BYTE_ORDER MSB_LAST /end MOD_COMMON
/begin RECORD_LAYOUT DAMOS_SST97 SRC_ADDR_X 1 UWORD NO_AXIS_PTS_X 2 UBYTE AXIS_PTS_X 3 UBYTE INDEX_INCR DIRECT /end RECORD_LAYOUT
/begin AXIS_PTS MLV08 "Luftmassenstuetzstellen mit 8 Stuetzstellen" 0x8DC6 MLSP DAMOS_SST97 0 MLSMQ 8 0.000000 1024.000000 /end AXIS_PTS
/begin AXIS_PTS NISTV16 "Drehzahlstützstellenverteilung" 0x8D68 NIST DAMOS_SST97 0 NQ25 16 0.000000 6400.000000 /end AXIS_PTS
/begin AXIS_PTS SPSNV08_UM "SST fuer eins-FU" 0x8F12 SPSN_UM DAMOS_SST97 0 DEZ 8 0.000000 256.000000 /end AXIS_PTS
/begin AXIS_PTS SSTZYLNR "SST Zylindernummer" 0x8F0A IR0 DAMOS_SST97 0 DEZ 5 0.000000 256.000000 /end AXIS_PTS
/begin AXIS_PTS TANSV04 "Stuetzstellenverteilung Lufttemperatur" 0x8D9C TANS DAMOS_SST97 0 CLU_TMP 4 -50.000000 150.000000 /end AXIS_PTS
/begin AXIS_PTS TL8V16 "Laststuetzstellen" 0x8D20 TL8 DAMOS_SST97 0 UFUELL 16 0.000000 191.250000 /end AXIS_PTS
/begin AXIS_PTS UBV04 "Batteriespannungsstuetzstellen" 0x8DD2 UBATT DAMOS_SST97 0 UBQ 4 0.000000 24.119630 EXTENDED_LIMITS 0.000000 24.119600 /end AXIS_PTS
/begin COMPU_METHOD ATVG38L "  Adaptiver tv-Gradient hinter KAT" RAT_FUNC "%7.3" "ms/s" COEFFS 0 38.000000 0.000000 0 0.000000 6.000000e-02 /end COMPU_METHOD
/begin COMPU_METHOD B_DEZ "log Zustand" TAB_VERB "%7.5" "" COMPU_TAB_REF B_DEZ /end COMPU_METHOD
/begin COMPU_METHOD B_TRUE "True" TAB_VERB "%7.5" "" COMPU_TAB_REF B_TRUE /end COMPU_METHOD
/begin COMPU_METHOD CLU_TMP "Ansaugluft-Temperatur" TAB_INTP "%7.3" "grd C" COMPU_TAB_REF CLU_TMP /end COMPU_METHOD
/begin COMPU_METHOD DEZ "  Dezimalzahl in Hexzahl" RAT_FUNC "%3.0" "" COEFFS 0 1.000000 0.000000 0 0.000000 1.000000 /end COMPU_METHOD
/begin COMPU_METHOD DEZBG "  Dezimalzahl in Hexzahl" RAT_FUNC "%3.0" "" COEFFS 0 1.000000 0.000000 0 0.000000 1.000000 /end COMPU_METHOD
/begin COMPU_METHOD DEZL "  Dezimalzahl in 16-Bit-Hexzahl" RAT_FUNC "%5.0" "" COEFFS 0 1.000000 0.000000 0 0.000000 1.000000 /end COMPU_METHOD
/begin COMPU_METHOD FKT2048 "  Umsetzung des Intervalles [0;<0.128]" RAT_FUNC "%6.4" "" COEFFS 0 2048.000000 0.000000 0 0.000000 1.000000 /end COMPU_METHOD
/begin COMPU_METHOD K10Q " FAKTOR  (10ms)256/PHYS" RAT_FUNC "%5.3" "sec" COEFFS 0 0.000000 2.560000 0 1.000000 0.000000 /end COMPU_METHOD
/begin COMPU_METHOD K409Q " FAKTOR     409.6    /PHYS" RAT_FUNC "%5.1" "sec" COEFFS 0 0.000000 409.600000 0 1.000000 0.000000 /end COMPU_METHOD
/begin COMPU_METHOD MLSMQ "MLE mit  4.000 Kg/h quantisiert" RAT_FUNC "%7.2" "kg/h" COEFFS 0 1.000000 0.000000 0 0.000000 4.000000 /end COMPU_METHOD
/begin COMPU_METHOD NQ25 "  Drehzahlquantisierung  25.00[Upm]" RAT_FUNC "%4.0" "Upm" COEFFS 0 1.000000 0.000000 0 0.000000 25.000000 /end COMPU_METHOD
/begin COMPU_METHOD PCENTLS "Prozentquantisierung [-100%...<100%]" RAT_FUNC "%7.3" "%" COEFFS 0 1.000000 0.000000 0 0.000000 3.051800e-03 /end COMPU_METHOD
/begin COMPU_METHOD PER255 "percent" RAT_FUNC "%7.3" "%" COEFFS 0 255.000000 0.000000 0 0.000000 100.000000 /end COMPU_METHOD
/begin COMPU_METHOD PHI1_40 "  Filterzeitkonstante fuer Tiefpass mit einer Zeitbasis von  40.00[ms]" TAB_INTP "%7.1" "ms" COMPU_TAB_REF PHI1_40 /end COMPU_METHOD
/begin COMPU_METHOD PHI1_SY "  Zuendungsabhaengige Filterkonstante mit  0.391 %/Zuendung. quantisiert" RAT_FUNC "%7.4" "% pro Zuendung" COEFFS 0 1.000000 0.000000 0 0.000000 3.906300e-01 /end COMPU_METHOD
/begin COMPU_METHOD PSAUGDS "Ladedruckabweichung (8 Bit)" RAT_FUNC "%7.2" "hPa" COEFFS 0 1.000000 0.000000 0 0.000000 10.240000 /end COMPU_METHOD
/begin COMPU_METHOD SENSORB "8 BIT Sensorsignal" RAT_FUNC "%7.5" "V" COEFFS 0 256.000000 0.000000 0 0.000000 5.000000 /end COMPU_METHOD
/begin COMPU_METHOD TC_STS "TorqueConverter Status" TAB_VERB "%7.5" "" COMPU_TAB_REF TC_STS /end COMPU_METHOD
/begin COMPU_METHOD TEQL "  Quantisierung von te, 16 Bit mit  0.267E-2[ms]" RAT_FUNC "%7.3" "ms" COEFFS 0 1.000000 0.000000 0 0.000000 2.666700e-03 /end COMPU_METHOD
/begin COMPU_METHOD TEQ_12L "  Quantisierung von te, 16 Bit mit 0.0320[ms] quantisiert" RAT_FUNC "%7.2" "ms" COEFFS 0 1.000000 0.000000 0 0.000000 3.200000e-02 /end COMPU_METHOD
/begin COMPU_METHOD TQ10 "  Zeitquantisierung mit 10[ms]" RAT_FUNC "%4.2" "sec" COEFFS 0 100.000000 0.000000 0 0.000000 1.000000 /end COMPU_METHOD
/begin COMPU_METHOD TQ100 "  Zeitquantisierung mit 100[ms]" RAT_FUNC "%4.1" "sec" COEFFS 0 10.000000 0.000000 0 0.000000 1.000000 /end COMPU_METHOD
/begin COMPU_METHOD TQ1000L "  Zeitquantisierung mit 1000[ms]" RAT_FUNC "%5.0" "sec" COEFFS 0 1.000000 0.000000 0 0.000000 1.000000 /end COMPU_METHOD
/begin COMPU_METHOD TQ100L "  Zeitquantisierung mit 100[ms]" RAT_FUNC "%7.2" "sec" COEFFS 0 10.000000 0.000000 0 0.000000 1.000000 /end COMPU_METHOD
/begin COMPU_METHOD TQ10L "  Zeitquantisierung mit 10[ms]" RAT_FUNC "%6.2" "sec" COEFFS 0 100.000000 0.000000 0 0.000000 1.000000 /end COMPU_METHOD
/begin COMPU_METHOD TQ10MSS "  Zeitquantisierung mit 10[ms] signed" RAT_FUNC "%5.3" "sec" COEFFS 0 100.000000 0.000000 0 0.000000 1.000000 /end COMPU_METHOD
/begin COMPU_METHOD TQ10MSSL "  Zeitquantisierung mit 10[ms] 16Bit-signed" RAT_FUNC "%7.3" "sec" COEFFS 0 100.000000 0.000000 0 0.000000 1.000000 /end COMPU_METHOD
/begin COMPU_METHOD TQ1L "  Zeitquantisierung mit 1[ms]" RAT_FUNC "%6.3" "sec" COEFFS 0 1000.000000 0.000000 0 0.000000 1.000000 /end COMPU_METHOD
/begin COMPU_METHOD TQ20 "  Zeitquantisierung mit 20[ms]" RAT_FUNC "%5.3" "sec" COEFFS 0 50.000000 0.000000 0 0.000000 1.000000 /end COMPU_METHOD
/begin COMPU_METHOD TQ50 "  Zeitquantisierung mit 50[ms]" RAT_FUNC "%6.3" "sec" COEFFS 0 20.000000 0.000000 0 0.000000 1.000000 /end COMPU_METHOD
/begin COMPU_METHOD TQ80 "  Zeitquantisierung mit 80[ms]" RAT_FUNC "%4.1" "sec" COEFFS 0 12.500000 0.000000 0 0.000000 1.000000 /end COMPU_METHOD
/begin COMPU_METHOD TSEGQL "  Quant. der Segmentzeit mit  0.889[us] " RAT_FUNC "%7.1" "us" COEFFS 0 1.000000 0.000000 0 0.000000 8.888900e-01 /end COMPU_METHOD
/begin COMPU_METHOD U0V_1V33 "8Bit Umsetzung des Spannungsintervalles 0..1,33V" RAT_FUNC "%5.3" "V" COEFFS 0 255.000000 0.000000 0 0.000000 1.330000 /end COMPU_METHOD
/begin COMPU_METHOD UBQ "  Batteriespannung mit 0.0942[V] quantisiert" RAT_FUNC "%5.2" "V" COEFFS 0 1.000000 0.000000 0 0.000000 9.421700e-02 /end COMPU_METHOD
/begin COMPU_METHOD UDKL "Drosselklappenwinkel" RAT_FUNC "%7.4" "grad DK" COEFFS 0 3.276800e+04 0.000000 0 0.000000 80.916000 /end COMPU_METHOD
/begin COMPU_METHOD UFUELL "Umrechnung fuer Fuellungsgrad" RAT_FUNC "%7.3" "%" COEFFS 0 255.000000 0.000000 0 0.000000 191.250000 /end COMPU_METHOD
/begin COMPU_METHOD ULSQL "  Lambdasonden-Spannung ohne Offset" RAT_FUNC "%7.5" "V" COEFFS 0 13107.000000 0.000000 0 0.000000 1.000000 /end COMPU_METHOD
/begin COMPU_METHOD UWDK "Drosselklappenwinkel" RAT_FUNC "%7.4" "grad DK" COEFFS 0 256.000000 0.000000 0 0.000000 80.916000 /end COMPU_METHOD
/begin COMPU_METHOD VQV16L "  Geschwindigkeitsumrechnung mit Faktor  16.00 [km/h]" RAT_FUNC "%6.1" "km/h" COEFFS 0 16.000000 0.000000 0 0.000000 1.000000 /end COMPU_METHOD
/begin COMPU_METHOD WQ720 "  Kurbelwellenwinkel-Quantisierung mit  2.813 [grad KW] quantisiert" RAT_FUNC "%5.1" "grad KW" COEFFS 0 1.000000 0.000000 0 0.000000 2.812500 /end COMPU_METHOD
/begin COMPU_METHOD ZWNEG "  Zuendwinkelverstellung nach frueh mit -0.750[grad KW] quantisiert" RAT_FUNC "%5.2" "grad KW" COEFFS 0 1.000000 0.000000 0 0.000000 -7.500000e-01 /end COMPU_METHOD
/begin COMPU_METHOD ZWNEGBG "  Zuendwinkelverstellung nach frueh mit -0.750[grad KW] quantisiert" RAT_FUNC "%5.2" "grad KW" COEFFS 0 1.000000 0.000000 0 0.000000 -7.500000e-01 /end COMPU_METHOD
/begin COMPU_METHOD ZWOF "  Zuendwinkel mit Offset" RAT_FUNC "%6.3" "grad KW" COEFFS 0 1.000000 78.000000 0 0.000000 7.500000e-01 /end COMPU_METHOD
/begin COMPU_METHOD ZWQ "  Zuendwinkel ohne Offset mit  0.750[grad KW] quantisiert" RAT_FUNC "%6.2" "grad KW" COEFFS 0 1.000000 0.000000 0 0.000000 7.500000e-01 /end COMPU_METHOD
/begin COMPU_TAB CLU_TMP "" TAB_INTP 41 3 -50.000000 4 -45.000000 5 -40.000000 7 -35.000000 10 -30.000000 13 -25.000000 16 -20.000000 21 -15.000000 26 -10.000000 32 -5.000000 38 0.000000 46 5.000000 55 10.000000 64 15.000000 74 20.000000 84 25.000000 95 30.000000 106 35.000000 117 40.000000 128 45.000000 139 50.000000 149 55.000000 158 60.000000 167 65.000000 175 70.000000 183 75.000000 190 80.000000 196 85.000000 202 90.000000 207 95.000000 212 100.000000 216 105.000000 220 110.000000 223 115.000000 226 120.000000 229 125.000000 231 130.000000 233 135.000000 235 140.000000 237 145.000000 239 150.000000 /end COMPU_TAB
/begin COMPU_TAB PHI1_40 "" TAB_INTP 35 0 40000.000000 1 10220.000000 2 5116.000000 3 3393.200200 4 2539.600100 5 2027.600000 6 1686.400000 7 1442.400000 8 1259.600000 9 1117.600000 10 1003.600000 11 910.800050 12 832.799990 13 767.200010 14 711.200010 15 662.399960 16 619.599980 20 491.600010 25 389.199980 30 320.800020 35 272.000000 40 235.200010 50 184.000000 60 149.600010 70 125.200000 80 106.800000 100 80.800003 120 63.200001 140 50.520000 162 40.000000 180 32.920002 200 26.320000 220 20.360001 240 14.400001 255 7.212000 /end COMPU_TAB
/begin COMPU_VTAB B_DEZ "" TAB_VERB 2 0 "0" 1 "1" /end COMPU_VTAB
/begin COMPU_VTAB B_TRUE "" TAB_VERB 2 0 "----" 1 "TRUE" /end COMPU_VTAB
/begin COMPU_VTAB TC_STS "" TAB_VERB 4 0 "not applied" 1 "slipping" 2 "applied" 3 "engaging" /end COMPU_VTAB
/begin MEASUREMENT TS_ASE "Ausgabe von berechnetem TS (ohne Verzoegerung)" UWORD TSEGQL 0 0 0.000000 58253.300000 ECU_ADDRESS 0xF99C BIT_MASK 0xFFFF /end MEASUREMENT
/begin MEASUREMENT TTBMHHC ">Zeit f. theor. So.-Betr.-Bereitschaft mit Hzg" UWORD TQ100L 0 0 0.000000 6553.500000 ECU_ADDRESS 0xB085E BIT_MASK 0xFFFF /end MEASUREMENT
/begin MEASUREMENT TTBMHHC1 "" UWORD TQ100L 0 0 0.000000 6553.500000 ECU_ADDRESS 0xB085E BIT_MASK 0xFFFF /end MEASUREMENT
/begin MEASUREMENT TTBMHHC2 "" UWORD TQ100L 0 0 0.000000 6553.500000 ECU_ADDRESS 0xB0860 BIT_MASK 0xFFFF /end MEASUREMENT
/begin MEASUREMENT TTBMHVC1 " Zeitzaehler Sonden-Taupunkt überschritten (Bank1)" UWORD TQ100L 0 0 0.000000 6553.500000 ECU_ADDRESS 0xB0834 BIT_MASK 0xFFFF /end MEASUREMENT
/begin MEASUREMENT TTBMHVC2 " Zeitzaehler Sonden-Taupunkt überschritten (Bank2)" UWORD TQ100L 0 0 0.000000 6553.500000 ECU_ADDRESS 0xB0836 BIT_MASK 0xFFFF /end MEASUREMENT
/begin MEASUREMENT TTEBEGR "Zaehler fuer Spuelratenbegrenzung" UWORD TQ100L 0 0 0.000000 6553.500000 ECU_ADDRESS 0xB070C BIT_MASK 0xFFFF /end MEASUREMENT
/begin MEASUREMENT TTESTART "Startsperrzaehler" UWORD TQ100L 0 0 0.000000 6553.500000 ECU_ADDRESS 0xB0722 BIT_MASK 0xFFFF /end MEASUREMENT
/begin MEASUREMENT TTHSRIH2_W " Zaehler fuer THSRIH Bank 2" UWORD DEZL 0 0 0.000000 65535.000000 ECU_ADDRESS 0xB107C BIT_MASK 0xFFFF /end MEASUREMENT
/begin MEASUREMENT TTHSRIH_W " Zaehler fuer THSRIH Bank 1" UBYTE DEZL 0 0 0.000000 65535.000000 ECU_ADDRESS 0xB107A BIT_MASK 0xFF /end MEASUREMENT
/begin MEASUREMENT TTHSRIV2_W " Zaehler fuer THSRIV Bank 2" UWORD DEZL 0 0 0.000000 65535.000000 ECU_ADDRESS 0xB1078 BIT_MASK 0xFFFF /end MEASUREMENT
/begin MEASUREMENT TTHSRIV_W " Zaehler fuer THSRIV Bank 1" UWORD DEZL 0 0 0.000000 65535.000000 ECU_ADDRESS 0xB1076 BIT_MASK 0xFFFF /end MEASUREMENT
/begin MEASUREMENT TTNOV " TN-Timer durchlaufender OV-Zaehler" UBYTE DEZ 0 0 0.000000 256.000000 ECU_ADDRESS 0xF950 BIT_MASK 0xFF /end MEASUREMENT
/begin MEASUREMENT TTOLRSKA "Zaehler fuer Toleranzzeit Speicher. rev SKA" UBYTE TQ10 0 0 0.000000 2.550000 ECU_ADDRESS 0xB0D1C BIT_MASK 0xFF /end MEASUREMENT
/begin MEASUREMENT TTOLRSKO "Zaehler fuer Heilzeit Speicher. rev SKA" UBYTE TQ10 0 0 0.000000 2.550000 ECU_ADDRESS 0xB0D1D BIT_MASK 0xFF /end MEASUREMENT
/begin MEASUREMENT TTRAZ_T1 "Timer fuer Verweilzeit in tra Bank 1" UWORD TQ100L 0 0 0.000000 6553.500000 ECU_ADDRESS 0xB0952 BIT_MASK 0xFFFF /end MEASUREMENT
/begin MEASUREMENT TTRAZ_T2 "Timer fuer Verweilzeit in tra Bank 2" UWORD TQ100L 0 0 0.000000 6553.500000 ECU_ADDRESS 0xB0954 BIT_MASK 0xFFFF /end MEASUREMENT
/begin MEASUREMENT TTRIIMPH " Zaehler fuer TRIIMPH" UWORD DEZL 0 0 0.000000 65535.000000 ECU_ADDRESS 0xB1074 BIT_MASK 0xFFFF /end MEASUREMENT
/begin MEASUREMENT TTRIIMPV " Zaehler fuer TRIIMPV" UWORD DEZL 0 0 0.000000 65535.000000 ECU_ADDRESS 0xB1072 BIT_MASK 0xFFFF /end MEASUREMENT
/begin MEASUREMENT TTUSBELH " Zaehler fuer TUSBELH Bank 1" UBYTE DEZ 0 0 0.000000 256.000000 ECU_ADDRESS 0xB1080 BIT_MASK 0xFF /end MEASUREMENT
/begin MEASUREMENT TTUSBELH2 " Zaehler fuer TUSBELH Bank 2" UBYTE DEZ 0 0 0.000000 256.000000 ECU_ADDRESS 0xB1081 BIT_MASK 0xFF /end MEASUREMENT
/begin MEASUREMENT TTUSBELV " Zaehler fuer TUSBELV Bank 1" UBYTE DEZ 0 0 0.000000 256.000000 ECU_ADDRESS 0xB107E BIT_MASK 0xFF /end MEASUREMENT
/begin MEASUREMENT TTUSBELV2 " Zaehler fuer TUSBELV Bank 2" UBYTE DEZ 0 0 0.000000 256.000000 ECU_ADDRESS 0xB107F BIT_MASK 0xFF /end MEASUREMENT
/begin MEASUREMENT TUSDBC1 " Zeitzaehler begrenzter Spannungshub (Bank1)" UWORD TQ100L 0 0 0.000000 6553.500000 ECU_ADDRESS 0xB0830 BIT_MASK 0xFFFF /end MEASUREMENT
/begin MEASUREMENT TUSDBC2 " Zeitzaehler begrenzter Spannungshub (Bank2)" UWORD TQ100L 0 0 0.000000 6553.500000 ECU_ADDRESS 0xB0832 BIT_MASK 0xFFFF /end MEASUREMENT
/begin MEASUREMENT TUSDUC1 " Zeitentprellung Adernschluß oder Gemischfehler(Bank 1)" UWORD TQ100L 0 0 0.000000 6553.500000 ECU_ADDRESS 0xB082C BIT_MASK 0xFFFF /end MEASUREMENT
/begin MEASUREMENT TUSDUC2 " Zeitentprellung Adernschluß oder Gemischfehler(Bank 2)" UWORD TQ100L 0 0 0.000000 6553.500000 ECU_ADDRESS 0xB082E BIT_MASK 0xFFFF /end MEASUREMENT
/begin MEASUREMENT TUSDUFHC1 " Zeitzaehler Erkennung Adernschluss (Bank 1)" UWORD TQ100L 0 0 0.000000 6553.500000 ECU_ADDRESS 0xB083E BIT_MASK 0xFFFF /end MEASUREMENT
/begin MEASUREMENT TUSDUFHC2 " Zeitzaehler Erkennung Adernschluss (Bank 2)" UWORD TQ100L 0 0 0.000000 6553.500000 ECU_ADDRESS 0xB0840 BIT_MASK 0xFFFF /end MEASUREMENT
/begin MEASUREMENT TUSDUHC " " UWORD TQ100L 0 0 0.000000 6553.500000 ECU_ADDRESS 0xB085A BIT_MASK 0xFFFF /end MEASUREMENT
/begin MEASUREMENT TUSDUHC1 "" UWORD TQ100L 0 0 0.000000 6553.500000 ECU_ADDRESS 0xB085A BIT_MASK 0xFFFF /end MEASUREMENT
/begin MEASUREMENT TUSDUHC2 "" UWORD TQ100L 0 0 0.000000 6553.500000 ECU_ADDRESS 0xB085C BIT_MASK 0xFFFF /end MEASUREMENT
/begin MEASUREMENT TUSEINHC ">" UBYTE TQ100 0 0 0.000000 25.500000 ECU_ADDRESS 0xB0864 BIT_MASK 0xFF /end MEASUREMENT
/begin MEASUREMENT TUSEINVC1 " Verzoegerung fuer Einschalten Sondenbetriebsbereitschaft vor Kat" UBYTE TQ100 0 0 0.000000 25.500000 ECU_ADDRESS 0xB0848 BIT_MASK 0xFF /end MEASUREMENT
/begin MEASUREMENT TUSEINVC2 " Verzoegerung fuer Einschalten Sondenbetriebsbereitschaft vor Kat" UBYTE TQ100 0 0 0.000000 25.500000 ECU_ADDRESS 0xB0849 BIT_MASK 0xFF /end MEASUREMENT
/begin MEASUREMENT TUSFETTC1 "Verz. fuer Erkennung niederohmiger Nebenschluss nach Ubatt vor Kat" UWORD TQ100L 0 0 0.000000 6553.500000 ECU_ADDRESS 0xB084A BIT_MASK 0xFFFF /end MEASUREMENT
/begin MEASUREMENT TUSFETTC2 "Verz. fuer Erkennung niederohmiger Nebenschluss nach Ubatt vor Kat" UWORD TQ100L 0 0 0.000000 6553.500000 ECU_ADDRESS 0xB084C BIT_MASK 0xFFFF /end MEASUREMENT
/begin MEASUREMENT TUSMXHC ">" UBYTE TQ100 0 0 0.000000 25.500000 ECU_ADDRESS 0xB0862 BIT_MASK 0xFF /end MEASUREMENT
/begin MEASUREMENT TUSMXVC1 " Entprellzeit KS-Ubatt Fehler (Bank 1)" UBYTE TQ100 0 0 0.000000 25.500000 ECU_ADDRESS 0xB083A BIT_MASK 0xFF /end MEASUREMENT
/begin MEASUREMENT TUSMXVC2 " Entprellzeit KS-Ubatt Fehler (Bank 2)" UBYTE TQ100 0 0 0.000000 25.500000 ECU_ADDRESS 0xB083B BIT_MASK 0xFF /end MEASUREMENT
/begin MEASUREMENT TUSNC1 " US > usref OR US < usrem tusks-entprellt (Bank 1)" UBYTE TQ100 0 0 0.000000 25.500000 ECU_ADDRESS 0xB083C BIT_MASK 0xFF /end MEASUREMENT
/begin MEASUREMENT TUSNC2 " US > usref OR US < usrem tusks-entprellt (Bank 2)" UBYTE TQ100 0 0 0.000000 25.500000 ECU_ADDRESS 0xB083D BIT_MASK 0xFF /end MEASUREMENT
/begin MEASUREMENT TUSRHKC ">" UBYTE TQ100 0 0 0.000000 25.500000 ECU_ADDRESS 0xB0868 BIT_MASK 0xFF /end MEASUREMENT
/begin MEASUREMENT TVEIN " V-Stoerimpulsunterdrueckzeit" UWORD TQ10L 0 0 0.000000 655.350000 ECU_ADDRESS 0xB0616 BIT_MASK 0xFFFF /end MEASUREMENT
/begin MEASUREMENT TVESZWNC "Zaehler Verzugszeit f. Einspr. Kor. bei ZW-Verst." UBYTE TQ80 0 0 0.000000 20.400000 ECU_ADDRESS 0xB06BD BIT_MASK 0xFF /end MEASUREMENT
/begin MEASUREMENT TVFSTA_CNT " Zaehler Verzoegerungszeit Ausgabe Tankzustand" UWORD TQ10L 0 0 0.000000 655.350000 ECU_ADDRESS 0xF990 BIT_MASK 0xFFFF /end MEASUREMENT
/begin MEASUREMENT TVHA_C "Verzoegerungszeit fuer Hoehenadaption" UBYTE TQ20 0 0 0.000000 5.100000 ECU_ADDRESS 0xB06DD BIT_MASK 0xFF /end MEASUREMENT
/begin MEASUREMENT TVKUPPLOFF " Zeitentprellung S_KUP 1->0" UBYTE TQ10 0 0 0.000000 2.550000 ECU_ADDRESS 0xB17AC BIT_MASK 0xFF /end MEASUREMENT
/begin MEASUREMENT TVKUPPLON " Zeitentprellung S_KUP 0->1" UBYTE TQ10 0 0 0.000000 2.550000 ECU_ADDRESS 0xB17AB BIT_MASK 0xFF /end MEASUREMENT
/begin MEASUREMENT TVLR1 "LR-TV-Summe Bank1" SBYTE TQ10MSS 0 0 -1.280000 1.270000 ECU_ADDRESS 0xB032C BIT_MASK 0xFF /end MEASUREMENT
/begin MEASUREMENT TVLR2 "LR-TV-Summe Bank2" SBYTE TQ10MSS 0 0 -1.280000 1.270000 ECU_ADDRESS 0xB032D BIT_MASK 0xFF /end MEASUREMENT
/begin MEASUREMENT TVLRAC1 "B_lra-Verz.-Zaehler nach B_lr 'ein' Banc1" UBYTE TQ100 0 0 0.000000 25.500000 ECU_ADDRESS 0xB03AA BIT_MASK 0xFF /end MEASUREMENT
/begin MEASUREMENT TVLRAC2 "B_lra-Verz.-Zaehler nach B_lr 'ein' Banc2" UBYTE TQ100 0 0 0.000000 25.500000 ECU_ADDRESS 0xB03AB BIT_MASK 0xFF /end MEASUREMENT
/begin MEASUREMENT TVLRDIFF " Differenz der Tastverhaeltnisse, Reglerdifferenz" SWORD PCENTLS 0 0 -100.000000 99.996900 ECU_ADDRESS 0xB035C BIT_MASK 0xFFFF /end MEASUREMENT
/begin MEASUREMENT TVLRH "signed LR-TV-Zeit hKat Array" SWORD TQ10MSSL 0 0 -327.680000 327.670000 ECU_ADDRESS 0xB038E BIT_MASK 0xFFFF /end MEASUREMENT
/begin MEASUREMENT TVMASTER " Tastverhaeltnis Fettzeit zur Gesamtperiodendauer Master-Bank" SWORD PCENTLS 0 0 -100.000000 99.996900 ECU_ADDRESS 0xB034A BIT_MASK 0xFFFF /end MEASUREMENT
/begin MEASUREMENT TVSAS "SA-Zeitverzoegerung" UBYTE TQ20 0 0 0.000000 5.100000 ECU_ADDRESS 0xB0498 BIT_MASK 0xFF /end MEASUREMENT
/begin MEASUREMENT TVSLAVE " Tastverhaeltnis Fettzeit zur Gesamtperiodendauer Slave-Bank" SWORD PCENTLS 0 0 -100.000000 99.996900 ECU_ADDRESS 0xB035A BIT_MASK 0xFFFF /end MEASUREMENT
/begin MEASUREMENT TVUB_R "Spannungskorrektur auf TI fuer EVs" UWORD TEQL 0 0 0.000000 174.760000 ECU_ADDRESS 0xF7E4 BIT_MASK 0xFFFF /end MEASUREMENT
/begin MEASUREMENT TV_DKVC " Umschaltverzoegerung KFMNDKP -> KFMNDK" UBYTE TQ10 0 0 0.000000 2.550000 ECU_ADDRESS 0xB05AA BIT_MASK 0xFF /end MEASUREMENT
/begin MEASUREMENT TV_DKVPC " Umschaltverzoegerung KFMNDK -> KFMNDKP" UBYTE TQ10 0 0 0.000000 2.550000 ECU_ADDRESS 0xB05AB BIT_MASK 0xFF /end MEASUREMENT
/begin MEASUREMENT TWDK1_C " Zaehler Delay Time Bank1" UBYTE TQ50 0 0 0.000000 12.750000 ECU_ADDRESS 0xB0888 BIT_MASK 0xFF /end MEASUREMENT
/begin MEASUREMENT TWDK2_C " Zaehler Delay Time Bank2" UBYTE TQ50 0 0 0.000000 12.750000 ECU_ADDRESS 0xB0889 BIT_MASK 0xFF /end MEASUREMENT
/begin MEASUREMENT TWLLRUB_C " Verzoegerungszaehler Ladebilanzregelung LLRUB" UWORD TQ100L 0 0 0.000000 6553.500000 ECU_ADDRESS 0xB0F98 BIT_MASK 0xFFFF /end MEASUREMENT
/begin MEASUREMENT TWNSTA_CNT " Zaehler Wartezeit nach Motorstart" UWORD TQ10L 0 0 0.000000 655.350000 ECU_ADDRESS 0xF98A BIT_MASK 0xFFFF /end MEASUREMENT
/begin MEASUREMENT TWNTA_CNT1 " Zaehler Wartezeit bis nicht Tank leer gueltig ist" UWORD TQ10L 0 0 0.000000 655.350000 ECU_ADDRESS 0xF98C BIT_MASK 0xFFFF /end MEASUREMENT
/begin MEASUREMENT TWNTA_CNT2 " Zaehler Wartezeit bis nicht Tank leer gueltig ist" UWORD TQ10L 0 0 0.000000 655.350000 ECU_ADDRESS 0xF98E BIT_MASK 0xFFFF /end MEASUREMENT
/begin MEASUREMENT TWRBTEMN_C " Zähler für Wartezeit Rücksetzung B_temin" UWORD TQ100 0 0 0.000000 25.500000 ECU_ADDRESS 0xB03EC BIT_MASK 0xFFFF /end MEASUREMENT
/begin MEASUREMENT TWSBTEMN_C " Zähler für Wartezeit Setzung B_temin" UWORD TQ100 0 0 0.000000 25.500000 ECU_ADDRESS 0xB03EE BIT_MASK 0xFFFF /end MEASUREMENT
/begin MEASUREMENT TWVDBS_CNT " 100ms Timer Dswec 4.0" UWORD TQ10L 0 0 0.000000 655.350000 ECU_ADDRESS 0xF97E BIT_MASK 0xFFFF /end MEASUREMENT
/begin MEASUREMENT TZL1_HILF " Hilfszaehler fuer TZLSATV1_W" UBYTE DEZ 0 0 0.000000 256.000000 ECU_ADDRESS 0xB0912 BIT_MASK 0xFF /end MEASUREMENT
/begin MEASUREMENT TZLSATV1_W " aktueller Zeitzaehlerstand fuer Ready-Flag der ATV-Ueberwachung" UWORD TQ1000L 0 0 0.000000 65535.000000 ECU_ADDRESS 0xB091C BIT_MASK 0xFFFF /end MEASUREMENT
/begin MEASUREMENT TZRA_T1 "Timer f. Erkennungszeit eingeschwungene GA f. fra u. tra an Bank 1" UWORD TQ100L 0 0 0.000000 6553.500000 ECU_ADDRESS 0xB0956 BIT_MASK 0xFFFF /end MEASUREMENT
/begin MEASUREMENT TZRA_T2 "Timer f. Erkennungszeit eingeschwungene GA f. fra u. tra an Bank 2" UWORD TQ100L 0 0 0.000000 6553.500000 ECU_ADDRESS 0xB0958 BIT_MASK 0xFFFF /end MEASUREMENT
/begin MEASUREMENT T_DIAMFB " Zeitzaehler Diag. Mil-f.b." UWORD TQ10L 0 0 0.000000 655.350000 ECU_ADDRESS 0xB17A8 BIT_MASK 0xFFFF /end MEASUREMENT
/begin MEASUREMENT T_EN_DLSSA " Zaehler fuer DLSSA enable" UBYTE DEZ 0 0 0.000000 256.000000 ECU_ADDRESS 0xB0A4F BIT_MASK 0xFF /end MEASUREMENT
/begin MEASUREMENT T_TDARNG " Zeitabregelung von KFTDARNG" UWORD TQ10L 0 0 0.000000 655.350000 ECU_ADDRESS 0xB04A6 BIT_MASK 0xFFFF /end MEASUREMENT
/begin MEASUREMENT T_TDEPOEL_ " Entprellzeit Fehler setzen Oelschalter" UWORD TQ10L 0 0 0.000000 655.350000 ECU_ADDRESS 0xB0000 BIT_MASK 0xFFFF /end MEASUREMENT
/begin MEASUREMENT T_TDKUPPL " Startabregelzeit fuer DVKUP" UBYTE TQ10 0 0 0.000000 2.550000 ECU_ADDRESS 0xB1823 BIT_MASK 0xFF /end MEASUREMENT
/begin MEASUREMENT T_TFRMB1 " Timer Verzoegerungszeit fuer Erkennung Mittelwert des Lambdareglers innerhalb S" UBYTE TQ100 0 0 0.000000 25.500000 ECU_ADDRESS 0xB0938 BIT_MASK 0xFF /end MEASUREMENT
/begin MEASUREMENT T_TLLASH1 " Timer fuer Verweildauer der Sonde hinter Kat unter-/oberhalb des Sollwertes" UBYTE TQ100 0 0 0.000000 25.500000 ECU_ADDRESS 0xB0939 BIT_MASK 0xFF /end MEASUREMENT
/begin MEASUREMENT T_TRIPFAS1 " Timer Mindestzeitdauer fuer aktive Lambdaregelung vor Kat" UBYTE TQ100 0 0 0.000000 25.500000 ECU_ADDRESS 0xB093A BIT_MASK 0xFF /end MEASUREMENT
/begin MEASUREMENT T_TSALASH " Timer Zeit nach Schub fuer Ueberpruefung Sonde hinter Kat" UBYTE TQ100 0 0 0.000000 25.500000 ECU_ADDRESS 0xB093B BIT_MASK 0xFF /end MEASUREMENT
/begin MEASUREMENT T_TUSCH_R1 " Timer Verzoegerungszeit fuer Stoerspitzen bei Schubpruefung Sonde hinter Kat" UBYTE TQ100 0 0 0.000000 25.500000 ECU_ADDRESS 0xB093D BIT_MASK 0xFF /end MEASUREMENT
/begin MEASUREMENT T_TUSCH_S1 " Timer Verzoegerungszeit fuer Stoerspitzen bei Schubpruefung Sonde hinter Kat" UBYTE TQ100 0 0 0.000000 25.500000 ECU_ADDRESS 0xB093C BIT_MASK 0xFF /end MEASUREMENT
/begin MEASUREMENT T_TUSENLA1 " Timer bis Sonden Fett/Mager Erkennung erlaubt" UWORD TQ100L 0 0 0.000000 6553.500000 ECU_ADDRESS 0xB0930 BIT_MASK 0xFFFF /end MEASUREMENT
/begin MEASUREMENT T_TUSHSMN1 " Timer Mindestdauer fuer Steigungsmessung fuer enable Filter" UBYTE TQ100 0 0 0.000000 25.500000 ECU_ADDRESS 0xB093E BIT_MASK 0xFF /end MEASUREMENT
/begin MEASUREMENT T_TUSLASH1 " Testzeit fuer Dauer Anfettung/Abmagerung hinter Kat" UWORD TQ100L 0 0 0.000000 6553.500000 ECU_ADDRESS 0xB0932 BIT_MASK 0xFFFF /end MEASUREMENT
/begin MEASUREMENT T_TUSSA_F1 " Timer Verzoegerungszeit nach Ueberschreiten der Regelschwelle hinter Kat" UBYTE TQ100 0 0 0.000000 25.500000 ECU_ADDRESS 0xB093F BIT_MASK 0xFF /end MEASUREMENT
/begin MEASUREMENT T_TUSSA_M1 " Timer Verzoegerungszeit nach Unterschreiten der Regelschwelle hinter Kat" UBYTE TQ100 0 0 0.000000 25.500000 ECU_ADDRESS 0xB0940 BIT_MASK 0xFF /end MEASUREMENT
/begin MEASUREMENT T_WAG "Zaehler fuer AGR-Zuendwinkeleingriff" UBYTE TQ10 0 0 0.000000 2.550000 ECU_ADDRESS 0xB06D5 BIT_MASK 0xFF /end MEASUREMENT
/begin MEASUREMENT T__1MS " frei durchlaufender 1-ms-Zaehler" UWORD TQ1L 0 0 0.000000 65.535000 ECU_ADDRESS 0xF750 BIT_MASK 0xFFFF /end MEASUREMENT
/begin MEASUREMENT UBGR_TMP " temporaere Untergrenze" UWORD UDKL 0 0 0.000000 10.112000 ECU_ADDRESS 0xB050C BIT_MASK 0xFFFF /end MEASUREMENT
/begin MEASUREMENT UDKSNO_ "IP-Ergebnis Obere RKRN-Schwelle fuer KRS" UBYTE SENSORB 0 0 0.000000 4.980470 ECU_ADDRESS 0xB0449 BIT_MASK 0xFF /end MEASUREMENT
/begin MEASUREMENT UDKSNU_ "IP-Ergebnis Untere RKRN-Schwelle fuer KRS" UBYTE SENSORB 0 0 0.000000 4.980470 ECU_ADDRESS 0xB0448 BIT_MASK 0xFF /end MEASUREMENT
/begin MEASUREMENT UMA2_RES " Ist-Zaehler Verknuepfung nach abarb. aller Module des Befehlstest" UWORD DEZL 0 0 0.000000 65535.000000 ECU_ADDRESS 0xB0B94 BIT_MASK 0xFFFF /end MEASUREMENT
/begin MEASUREMENT UMA_RES " Ist-Zaehler Verknuepfung nach abarb. alle Ueberw.module" UWORD DEZL 0 0 0.000000 65535.000000 ECU_ADDRESS 0xB0B92 BIT_MASK 0xFFFF /end MEASUREMENT
/begin MEASUREMENT UMF_PTR " Zwischenspeicher der empf. Frage von ASIC (LOW-Byte um_ptr)" UBYTE DEZL 0 0 0.000000 65535.000000 ECU_ADDRESS 0xB0B90 BIT_MASK 0xFF /end MEASUREMENT
/begin MEASUREMENT UM_BITS1 "" UWORD DEZL 0 0 0.000000 65535.000000 ECU_ADDRESS 0xFDF0 BIT_MASK 0xFFFF /end MEASUREMENT
/begin MEASUREMENT UM_BITS2 "" UWORD DEZL 0 0 0.000000 65535.000000 ECU_ADDRESS 0xFDF2 BIT_MASK 0xFFFF /end MEASUREMENT
/begin MEASUREMENT UM_ERROR " Fehlerword UM" UWORD DEZL 0 0 0.000000 65535.000000 ECU_ADDRESS 0x0 BIT_MASK 0xFFFF /end MEASUREMENT
/begin MEASUREMENT UM_PTR " Zwischenspeicher der empf. Frage vom ASIC" UWORD DEZL 0 0 0.000000 65535.000000 ECU_ADDRESS 0xB0B90 BIT_MASK 0xFFFF /end MEASUREMENT
/begin MEASUREMENT UPVG_UM " Potiversorgung" UBYTE PER255 0 0 0.000000 100.000000 ECU_ADDRESS 0xE002 BIT_MASK 0xFF /end MEASUREMENT
/begin MEASUREMENT UPVG_UR " Potiversorgung" UBYTE PER255 0 0 0.000000 100.000000 ECU_ADDRESS 0xB17B3 BIT_MASK 0xFF /end MEASUREMENT
/begin MEASUREMENT USHK1N " Spannung Lambdasonde hinter Kat1, normiert fuer Dkat" UBYTE U0V_1V33 0 0 0.000000 1.330000 ECU_ADDRESS 0xB0881 BIT_MASK 0xFF /end MEASUREMENT
/begin MEASUREMENT USHK2N " Spannung Lambdasonde hinter Kat2, normiert fuer Dkat" UBYTE U0V_1V33 0 0 0.000000 1.330000 ECU_ADDRESS 0xB0882 BIT_MASK 0xFF /end MEASUREMENT
/begin MEASUREMENT USHKF1AU16 "AHKATS1: neuer/alter Wert" UWORD DEZL 0 0 0.000000 65535.000000 ECU_ADDRESS 0xB0000 BIT_MASK 0xFFFF /end MEASUREMENT
/begin MEASUREMENT USHKF1_S16 "AHKATS1: Ergebnis nach Subtraktion" UWORD DEZL 0 0 0.000000 65535.000000 ECU_ADDRESS 0xB08D2 BIT_MASK 0xFFFF /end MEASUREMENT
/begin MEASUREMENT USHKF1_U8 "AHKATS1: Wert nach Transfer Filter 1 Bank1" UBYTE DEZ 0 0 0.000000 256.000000 ECU_ADDRESS 0xB0890 BIT_MASK 0xFF /end MEASUREMENT
/begin MEASUREMENT USHKF2AU16 "AHKATS2: neuer/alter Wert" UWORD DEZL 0 0 0.000000 65535.000000 ECU_ADDRESS 0xB0000 BIT_MASK 0xFFFF /end MEASUREMENT
/begin MEASUREMENT USHKF2_S16 "AHKATS2: Ergebnis nach Subtraktion" UWORD DEZL 0 0 0.000000 65535.000000 ECU_ADDRESS 0xB08D4 BIT_MASK 0xFFFF /end MEASUREMENT
/begin MEASUREMENT USHKF2_U8 "AHKATS2: Wert nach Transfer Filter 1 Bank2" UBYTE DEZ 0 0 0.000000 256.000000 ECU_ADDRESS 0xB0891 BIT_MASK 0xFF /end MEASUREMENT
/begin MEASUREMENT USHKFF1A16 "AHKATS1: neuer/alter Wert" UWORD DEZL 0 0 0.000000 65535.000000 ECU_ADDRESS 0xB0000 BIT_MASK 0xFFFF /end MEASUREMENT
/begin MEASUREMENT USHKFF2A16 "AHKATS2: neuer/alter Wert" UWORD DEZL 0 0 0.000000 65535.000000 ECU_ADDRESS 0xB0000 BIT_MASK 0xFFFF /end MEASUREMENT
/begin MEASUREMENT USHKFFM116 "AHKATS1: Wert nach Transfer Filter 2 Bank1" UWORD DEZL 0 0 0.000000 65535.000000 ECU_ADDRESS 0xB0000 BIT_MASK 0xFFFF /end MEASUREMENT
/begin MEASUREMENT USHKFFM216 "AHKATS2: Wert nach Transfer Filter 2 Bank2" UWORD DEZL 0 0 0.000000 65535.000000 ECU_ADDRESS 0xB0000 BIT_MASK 0xFFFF /end MEASUREMENT
/begin MEASUREMENT USHKFS1_U8 "AHKATS1: Wert nach Subtraktion Bank1" UBYTE DEZ 0 0 0.000000 256.000000 ECU_ADDRESS 0xB088C BIT_MASK 0xFF /end MEASUREMENT
/begin MEASUREMENT USHKFS2_U8 "AHKATS2: Wert nach Subtraktion Bank2" UBYTE DEZ 0 0 0.000000 256.000000 ECU_ADDRESS 0xB088D BIT_MASK 0xFF /end MEASUREMENT
/begin MEASUREMENT USMXSHA " max. erkannte So.sp. h.K. (alt) DLSSA" UBYTE U0V_1V33 0 0 0.000000 1.330000 ECU_ADDRESS 0xB0A54 BIT_MASK 0xFF /end MEASUREMENT
/begin MEASUREMENT USRHK_W "Hinterkatsonden-Schwelle aus KF" UWORD ULSQL 0 0 0.000000 5.000000 ECU_ADDRESS 0xB037E BIT_MASK 0xFFFF /end MEASUREMENT
/begin MEASUREMENT USVKMAW "Spannung Vorkat-Master-Lambdasonde" UWORD ULSQL 0 0 0.000000 5.000000 ECU_ADDRESS 0xB0338 BIT_MASK 0xFFFF /end MEASUREMENT
/begin MEASUREMENT USVKSLW "Spannung Vorkat-Slave-Lambdasonde" UWORD ULSQL 0 0 0.000000 5.000000 ECU_ADDRESS 0xB033A BIT_MASK 0xFFFF /end MEASUREMENT
/begin MEASUREMENT UWSKAUM " Umweltbdg. 6 fuer Fehler DRSKAUM" UBYTE DEZ 0 0 0.000000 256.000000 ECU_ADDRESS 0xB0D1E BIT_MASK 0xFF /end MEASUREMENT
/begin MEASUREMENT V1 "Referenzgeschw. von ASR ueber CAN" UWORD VQV16L 0 0 0.000000 4095.940000 ECU_ADDRESS 0xB060C BIT_MASK 0xFFFF /end MEASUREMENT
/begin MEASUREMENT VCFGR_C " Entprellzeit vc_fgr-Erfassung" UBYTE TQ10 0 0 0.000000 2.550000 ECU_ADDRESS 0xB04F1 BIT_MASK 0xFF /end MEASUREMENT
/begin MEASUREMENT VC_ACC_UC " DA Variantencodierung ACC" UBYTE DEZ 0 0 0.000000 256.000000 ECU_ADDRESS 0xE0C7 BIT_MASK 0xFF /end MEASUREMENT
/begin MEASUREMENT VERBOFF "Verbraucher-Offset (LFR5)" UWORD UDKL 0 0 0.000000 10.112000 ECU_ADDRESS 0xB0538 BIT_MASK 0xFFFF /end MEASUREMENT
/begin MEASUREMENT VERB_UG "Verbraucher-Untergrenzen-Anteil (LFR5)" UWORD UDKL 0 0 0.000000 10.112000 ECU_ADDRESS 0xB053A BIT_MASK 0xFFFF /end MEASUREMENT
/begin MEASUREMENT VFZG_UC " Geschwindigkeit fuer BT" UWORD VQV16L 0 0 0.000000 4095.940000 ECU_ADDRESS 0xE0B6 BIT_MASK 0xFFFF /end MEASUREMENT
/begin MEASUREMENT VFZ_CAN " Geschwindigkeit ueber CAN" UWORD VQV16L 0 0 0.000000 4095.940000 ECU_ADDRESS 0xB0C1C BIT_MASK 0xFFFF /end MEASUREMENT
/begin MEASUREMENT VKR0 "KR-Verstaerkung Zyl. 1 (SW)" UBYTE DEZ 0 0 0.000000 256.000000 ECU_ADDRESS 0xB0422 BIT_MASK 0xFF /end MEASUREMENT
/begin MEASUREMENT VKR1 "KR-Verstaerkung Zyl. 2 (SW)" UBYTE DEZ 0 0 0.000000 256.000000 ECU_ADDRESS 0xB0423 BIT_MASK 0xFF /end MEASUREMENT
/begin MEASUREMENT VKR2 "KR-Verstaerkung Zyl. 3 (SW)" UBYTE DEZ 0 0 0.000000 256.000000 ECU_ADDRESS 0xB0424 BIT_MASK 0xFF /end MEASUREMENT
/begin MEASUREMENT VKR3 "KR-Verstaerkung Zyl. 4 (SW)" UBYTE DEZ 0 0 0.000000 256.000000 ECU_ADDRESS 0xB0425 BIT_MASK 0xFF /end MEASUREMENT
/begin MEASUREMENT VKR4 "KR-Verstaerkung Zyl. 5 (SW)" UBYTE DEZ 0 0 0.000000 256.000000 ECU_ADDRESS 0xB0426 BIT_MASK 0xFF /end MEASUREMENT
/begin MEASUREMENT VKR5 "KR-Verstaerkung Zyl. 6 (SW)" UBYTE DEZ 0 0 0.000000 256.000000 ECU_ADDRESS 0xB0427 BIT_MASK 0xFF /end MEASUREMENT
/begin MEASUREMENT VKR6 "KR-Verstaerkung Zyl. 7 (SW)" UBYTE DEZ 0 0 0.000000 256.000000 ECU_ADDRESS 0xB0428 BIT_MASK 0xFF /end MEASUREMENT
/begin MEASUREMENT VKR7 "KR-Verstaerkung Zyl. 8 (SW)" UBYTE DEZ 0 0 0.000000 256.000000 ECU_ADDRESS 0xB0429 BIT_MASK 0xFF /end MEASUREMENT
/begin MEASUREMENT VRAD_LH " Radgeschwindigkeit links hinten" UWORD VQV16L 0 0 0.000000 4095.940000 ECU_ADDRESS 0xB0C4C BIT_MASK 0xFFFF /end MEASUREMENT
/begin MEASUREMENT VRAD_LV " Radgeschwindigkeit links vorne" UWORD VQV16L 0 0 0.000000 4095.940000 ECU_ADDRESS 0xB0C48 BIT_MASK 0xFFFF /end MEASUREMENT
/begin MEASUREMENT VRAD_RH " Radgeschwindigkeit rechts hinten" UWORD VQV16L 0 0 0.000000 4095.940000 ECU_ADDRESS 0xB0C4A BIT_MASK 0xFFFF /end MEASUREMENT
/begin MEASUREMENT VRAD_RV " Radgeschwindigkeit rechts vorne" UWORD VQV16L 0 0 0.000000 4095.940000 ECU_ADDRESS 0xB0C46 BIT_MASK 0xFFFF /end MEASUREMENT
/begin MEASUREMENT VSEXRAMCHK " Ablage Programmstandskennung fuer uETK" UWORD DEZL 0 0 0.000000 65535.000000 ECU_ADDRESS 0xB01F8 BIT_MASK 0xFFFF /end MEASUREMENT
/begin MEASUREMENT VSLDS " LDR-Sollwertverstellung" SBYTE PSAUGDS 0 0 -1310.720000 1300.480000 ECU_ADDRESS 0xB0C65 BIT_MASK 0xFF /end MEASUREMENT
/begin MEASUREMENT VW_VS "Verstellwert fuer Vorlagerungswinkel" UBYTE DEZBG 0 0 0.000000 255.000000 ECU_ADDRESS 0xB0280 BIT_MASK 0xFF /end MEASUREMENT
/begin MEASUREMENT VZL_UR " Byte fuer DA b_vzl_um" UBYTE DEZ 0 0 0.000000 256.000000 ECU_ADDRESS 0xB17F0 BIT_MASK 0xFF /end MEASUREMENT
/begin MEASUREMENT V_IST "NO COMMENT" UWORD VQV16L 0 0 0.000000 4095.940000 ECU_ADDRESS 0xB027A BIT_MASK 0xFFFF /end MEASUREMENT
/begin MEASUREMENT V_SOLL_1 " FGR Sollgeschwindigkeit korrigiert" UWORD VQV16L 0 0 0.000000 4095.940000 ECU_ADDRESS 0xB04E0 BIT_MASK 0xFFFF /end MEASUREMENT
/begin MEASUREMENT W1 "Allgemeine Bits" UWORD DEZL 0 0 0.000000 65535.000000 ECU_ADDRESS 0xFD0C BIT_MASK 0xFFFF /end MEASUREMENT
/begin MEASUREMENT W10 "Bedingungen LR 2" UWORD DEZL 0 0 0.000000 65535.000000 ECU_ADDRESS 0xFD44 BIT_MASK 0xFFFF /end MEASUREMENT
/begin MEASUREMENT W10A "Kat-Diagnose" UWORD DEZL 0 0 0.000000 65535.000000 ECU_ADDRESS 0xFD46 BIT_MASK 0xFFFF /end MEASUREMENT
/begin MEASUREMENT W10B "Kat-Diagnose" UWORD DEZL 0 0 0.000000 65535.000000 ECU_ADDRESS 0xFD48 BIT_MASK 0xFFFF /end MEASUREMENT
/begin MEASUREMENT W10C "Kat-Diagnose" UWORD DEZL 0 0 0.000000 65535.000000 ECU_ADDRESS 0xFD4A BIT_MASK 0xFFFF /end MEASUREMENT
/begin MEASUREMENT W134 " Zwischenspeicherbits fuer diverse Programmroutinen" UWORD DEZL 0 0 0.000000 65535.000000 ECU_ADDRESS 0xFDC4 BIT_MASK 0xFFFF /end MEASUREMENT
/begin MEASUREMENT W135 "Zwischenspeicherbits fuer diverse Programmroutinen" UWORD DEZL 0 0 0.000000 65535.000000 ECU_ADDRESS 0xFDC6 BIT_MASK 0xFFFF /end MEASUREMENT
/begin MEASUREMENT W14 "" UWORD DEZL 0 0 0.000000 65535.000000 ECU_ADDRESS 0xFD4E BIT_MASK 0xFFFF /end MEASUREMENT
/begin MEASUREMENT W141 " Bitwort Wegfahrsperre" UWORD DEZL 0 0 0.000000 65535.000000 ECU_ADDRESS 0xFDD4 BIT_MASK 0xFFFF /end MEASUREMENT
/begin MEASUREMENT W143 " Bitwort" UWORD DEZL 0 0 0.000000 65535.000000 ECU_ADDRESS 0xFDD8 BIT_MASK 0xFFFF /end MEASUREMENT
/begin MEASUREMENT W144 " Bitwort" UWORD DEZL 0 0 0.000000 65535.000000 ECU_ADDRESS 0xFDDA BIT_MASK 0xFFFF /end MEASUREMENT
/begin MEASUREMENT W145 " Bitwort" UWORD DEZL 0 0 0.000000 65535.000000 ECU_ADDRESS 0xFDDC BIT_MASK 0xFFFF /end MEASUREMENT
/begin MEASUREMENT W14A "" UWORD DEZL 0 0 0.000000 65535.000000 ECU_ADDRESS 0x0 BIT_MASK 0xFFFF /end MEASUREMENT
/begin MEASUREMENT W15 "Bedingungen Sondenheizung Abgasmodell" UWORD DEZL 0 0 0.000000 65535.000000 ECU_ADDRESS 0xFD50 BIT_MASK 0xFFFF /end MEASUREMENT
/begin MEASUREMENT W150 " Dauerlaufmessung Bitword 1" UWORD DEZL 0 0 0.000000 65535.000000 ECU_ADDRESS 0xFA3E BIT_MASK 0xFFFF /end MEASUREMENT
/begin MEASUREMENT W151 " Dauerlaufmessung Bitword 2" UWORD DEZL 0 0 0.000000 65535.000000 ECU_ADDRESS 0xFA40 BIT_MASK 0xFFFF /end MEASUREMENT
/begin MEASUREMENT W15A "" UWORD DEZL 0 0 0.000000 65535.000000 ECU_ADDRESS 0xFD52 BIT_MASK 0xFFFF /end MEASUREMENT
/begin MEASUREMENT W15A1 "" UWORD DEZL 0 0 0.000000 65535.000000 ECU_ADDRESS 0xFD54 BIT_MASK 0xFFFF /end MEASUREMENT
/begin MEASUREMENT W15B "" UWORD DEZL 0 0 0.000000 65535.000000 ECU_ADDRESS 0xFD56 BIT_MASK 0xFFFF /end MEASUREMENT
/begin MEASUREMENT W15C "" UWORD DEZL 0 0 0.000000 65535.000000 ECU_ADDRESS 0xFD58 BIT_MASK 0xFFFF /end MEASUREMENT
/begin MEASUREMENT W16 "Anforderung Fehlerreaktion" UWORD DEZL 0 0 0.000000 65535.000000 ECU_ADDRESS 0xFD5A BIT_MASK 0xFFFF /end MEASUREMENT
/begin MEASUREMENT W16A "Diagnose-/Zyklus-/OBDII-Bits" UWORD DEZL 0 0 0.000000 65535.000000 ECU_ADDRESS 0x0 BIT_MASK 0xFFFF /end MEASUREMENT
/begin MEASUREMENT W17 "Fehler-EMS, PWG" UWORD DEZL 0 0 0.000000 65535.000000 ECU_ADDRESS 0xFD5E BIT_MASK 0xFFFF /end MEASUREMENT
/begin MEASUREMENT W18 "Klopfregelung Bits" UWORD DEZL 0 0 0.000000 65535.000000 ECU_ADDRESS 0xFD60 BIT_MASK 0xFFFF /end MEASUREMENT
/begin MEASUREMENT W19 "" UWORD DEZL 0 0 0.000000 65535.000000 ECU_ADDRESS 0xFD64 BIT_MASK 0xFFFF /end MEASUREMENT
/begin MEASUREMENT W2 "Allgemeine Bits" UWORD DEZL 0 0 0.000000 65535.000000 ECU_ADDRESS 0xFD0E BIT_MASK 0xFFFF /end MEASUREMENT
/begin MEASUREMENT W20 "" UWORD DEZL 0 0 0.000000 65535.000000 ECU_ADDRESS 0xFD66 BIT_MASK 0xFFFF /end MEASUREMENT
/begin MEASUREMENT W21 "" UWORD DEZL 0 0 0.000000 65535.000000 ECU_ADDRESS 0xFD68 BIT_MASK 0xFFFF /end MEASUREMENT
/begin MEASUREMENT W22 "Anforderung Fehlerreaktion EMS" UWORD DEZL 0 0 0.000000 65535.000000 ECU_ADDRESS 0xFD6A BIT_MASK 0xFFFF /end MEASUREMENT
/begin MEASUREMENT W23 " Bits für Tempomat" UWORD DEZL 0 0 0.000000 65535.000000 ECU_ADDRESS 0xFD6C BIT_MASK 0xFFFF /end MEASUREMENT
/begin MEASUREMENT W24 "Bits fuer CAN" UWORD DEZL 0 0 0.000000 65535.000000 ECU_ADDRESS 0xFD6E BIT_MASK 0xFFFF /end MEASUREMENT
/begin MEASUREMENT W24A "Bits fuer ACC" UWORD DEZL 0 0 0.000000 65535.000000 ECU_ADDRESS 0xFD70 BIT_MASK 0xFFFF /end MEASUREMENT
/begin MEASUREMENT W24B "Bits fuer ACC" UWORD DEZL 0 0 0.000000 65535.000000 ECU_ADDRESS 0xFD72 BIT_MASK 0xFFFF /end MEASUREMENT
/begin MEASUREMENT W25 "Bitbuffer" UWORD DEZL 0 0 0.000000 65535.000000 ECU_ADDRESS 0xFD74 BIT_MASK 0xFFFF /end MEASUREMENT
/begin MEASUREMENT W26 "Bitbuffer" UWORD DEZL 0 0 0.000000 65535.000000 ECU_ADDRESS 0xFD76 BIT_MASK 0xFFFF /end MEASUREMENT
/begin MEASUREMENT W27 "" UWORD DEZL 0 0 0.000000 65535.000000 ECU_ADDRESS 0xFD78 BIT_MASK 0xFFFF /end MEASUREMENT
/begin MEASUREMENT W27A "" UWORD DEZL 0 0 0.000000 65535.000000 ECU_ADDRESS 0xFD7A BIT_MASK 0xFFFF /end MEASUREMENT
/begin MEASUREMENT W28 "" UWORD DEZL 0 0 0.000000 65535.000000 ECU_ADDRESS 0xFD7C BIT_MASK 0xFFFF /end MEASUREMENT
/begin MEASUREMENT W28A "" UWORD DEZL 0 0 0.000000 65535.000000 ECU_ADDRESS 0xFD7E BIT_MASK 0xFFFF /end MEASUREMENT
/begin MEASUREMENT W29 "" UWORD DEZL 0 0 0.000000 65535.000000 ECU_ADDRESS 0xFD80 BIT_MASK 0xFFFF /end MEASUREMENT
/begin MEASUREMENT W3 "Synchronisation und Geschw. Bits" UWORD DEZL 0 0 0.000000 65535.000000 ECU_ADDRESS 0xFD10 BIT_MASK 0xFFFF /end MEASUREMENT
/begin MEASUREMENT W30 "" UWORD DEZL 0 0 0.000000 65535.000000 ECU_ADDRESS 0xFD82 BIT_MASK 0xFFFF /end MEASUREMENT
/begin MEASUREMENT W31 "" UWORD DEZL 0 0 0.000000 65535.000000 ECU_ADDRESS 0xFD84 BIT_MASK 0xFFFF /end MEASUREMENT
/begin MEASUREMENT W32 "" UWORD DEZL 0 0 0.000000 65535.000000 ECU_ADDRESS 0xFD86 BIT_MASK 0xFFFF /end MEASUREMENT
/begin MEASUREMENT W32A "" UWORD DEZL 0 0 0.000000 65535.000000 ECU_ADDRESS 0xFD88 BIT_MASK 0xFFFF /end MEASUREMENT
/begin MEASUREMENT W32B "" UWORD DEZL 0 0 0.000000 65535.000000 ECU_ADDRESS 0xFD8A BIT_MASK 0xFFFF /end MEASUREMENT
/begin MEASUREMENT W33 "" UWORD DEZL 0 0 0.000000 65535.000000 ECU_ADDRESS 0xFD8C BIT_MASK 0xFFFF /end MEASUREMENT
/begin MEASUREMENT W33A "" UWORD DEZL 0 0 0.000000 65535.000000 ECU_ADDRESS 0xFD8E BIT_MASK 0xFFFF /end MEASUREMENT
/begin MEASUREMENT W34 "" UWORD DEZL 0 0 0.000000 65535.000000 ECU_ADDRESS 0xFD90 BIT_MASK 0xFFFF /end MEASUREMENT
/begin MEASUREMENT W34A "" UWORD DEZL 0 0 0.000000 65535.000000 ECU_ADDRESS 0xFD92 BIT_MASK 0xFFFF /end MEASUREMENT
/begin MEASUREMENT W34B "" UWORD DEZL 0 0 0.000000 65535.000000 ECU_ADDRESS 0xFD94 BIT_MASK 0xFFFF /end MEASUREMENT
/begin MEASUREMENT W35 " Bits fuer digitalen Lageregler" UWORD DEZL 0 0 0.000000 65535.000000 ECU_ADDRESS 0xFD96 BIT_MASK 0xFFFF /end MEASUREMENT
/begin MEASUREMENT W36 "" UWORD DEZL 0 0 0.000000 65535.000000 ECU_ADDRESS 0xFD98 BIT_MASK 0xFFFF /end MEASUREMENT
/begin MEASUREMENT W37 "" UWORD DEZL 0 0 0.000000 65535.000000 ECU_ADDRESS 0xFD9A BIT_MASK 0xFFFF /end MEASUREMENT
/begin MEASUREMENT W38 "Bitbuffer" UWORD DEZL 0 0 0.000000 65535.000000 ECU_ADDRESS 0xFD9C BIT_MASK 0xFFFF /end MEASUREMENT
/begin MEASUREMENT W39 "Bitbuffer" UWORD DEZL 0 0 0.000000 65535.000000 ECU_ADDRESS 0xFD9E BIT_MASK 0xFFFF /end MEASUREMENT
/begin MEASUREMENT W4 " allg Bits" UWORD DEZL 0 0 0.000000 65535.000000 ECU_ADDRESS 0xFD12 BIT_MASK 0xFFFF /end MEASUREMENT
/begin MEASUREMENT W40 "Bitbuffer" UWORD DEZL 0 0 0.000000 65535.000000 ECU_ADDRESS 0xFDA0 BIT_MASK 0xFFFF /end MEASUREMENT
/begin MEASUREMENT W41 "" UWORD DEZL 0 0 0.000000 65535.000000 ECU_ADDRESS 0xFDA2 BIT_MASK 0xFFFF /end MEASUREMENT
/begin MEASUREMENT W42 "" UWORD DEZL 0 0 0.000000 65535.000000 ECU_ADDRESS 0xFDA4 BIT_MASK 0xFFFF /end MEASUREMENT
/begin MEASUREMENT W43 "" UWORD DEZL 0 0 0.000000 65535.000000 ECU_ADDRESS 0xFDA6 BIT_MASK 0xFFFF /end MEASUREMENT
/begin MEASUREMENT W44 "" UWORD DEZL 0 0 0.000000 65535.000000 ECU_ADDRESS 0xFDA8 BIT_MASK 0xFFFF /end MEASUREMENT
/begin MEASUREMENT W45 " Bitwort allgemeine Bits" UWORD DEZL 0 0 0.000000 65535.000000 ECU_ADDRESS 0xFDAA BIT_MASK 0xFFFF /end MEASUREMENT
/begin MEASUREMENT W48 " Bitwort allgemeine Bits" UWORD DEZL 0 0 0.000000 65535.000000 ECU_ADDRESS 0xFDB0 BIT_MASK 0xFFFF /end MEASUREMENT
/begin MEASUREMENT W49 " Bitwort allgemeine Bits" UWORD DEZL 0 0 0.000000 65535.000000 ECU_ADDRESS 0xFDB2 BIT_MASK 0xFFFF /end MEASUREMENT
/begin MEASUREMENT W4A " allg Bits" UWORD DEZL 0 0 0.000000 65535.000000 ECU_ADDRESS 0xFD14 BIT_MASK 0xFFFF /end MEASUREMENT
/begin MEASUREMENT W5 " CIFI-Einspritzung" UWORD DEZL 0 0 0.000000 65535.000000 ECU_ADDRESS 0xFD16 BIT_MASK 0xFFFF /end MEASUREMENT
/begin MEASUREMENT W50 "Bits fuer CAN" UWORD DEZL 0 0 0.000000 65535.000000 ECU_ADDRESS 0xFDB4 BIT_MASK 0xFFFF /end MEASUREMENT
/begin MEASUREMENT W50A "Bits fuer CAN" UWORD DEZL 0 0 0.000000 65535.000000 ECU_ADDRESS 0xFDB6 BIT_MASK 0xFFFF /end MEASUREMENT
/begin MEASUREMENT W50B "Bits fuer CAN" UWORD DEZL 0 0 0.000000 65535.000000 ECU_ADDRESS 0xFDB8 BIT_MASK 0xFFFF /end MEASUREMENT
/begin MEASUREMENT W51 "Bits fuer DASE" UWORD DEZL 0 0 0.000000 65535.000000 ECU_ADDRESS 0xFDBA BIT_MASK 0xFFFF /end MEASUREMENT
/begin MEASUREMENT W53 "" UWORD DEZL 0 0 0.000000 65535.000000 ECU_ADDRESS 0xFDBE BIT_MASK 0xFFFF /end MEASUREMENT
/begin MEASUREMENT W54 "" UWORD DEZL 0 0 0.000000 65535.000000 ECU_ADDRESS 0xFDC0 BIT_MASK 0xFFFF /end MEASUREMENT
/begin MEASUREMENT W6 " CIFI-Einspritzung" UWORD DEZL 0 0 0.000000 65535.000000 ECU_ADDRESS 0xFD18 BIT_MASK 0xFFFF /end MEASUREMENT
/begin MEASUREMENT W7 " Flagword 7" UWORD DEZL 0 0 0.000000 65535.000000 ECU_ADDRESS 0xFD28 BIT_MASK 0xFFFF /end MEASUREMENT
/begin MEASUREMENT W7A " UKSEFI Status-Byte" UWORD DEZ 0 0 0.000000 256.000000 ECU_ADDRESS 0xFD2A BIT_MASK 0xFFFF /end MEASUREMENT
/begin MEASUREMENT W8 "Bedingungen Vorkat-LR" UWORD DEZL 0 0 0.000000 65535.000000 ECU_ADDRESS 0xFD2C BIT_MASK 0xFFFF /end MEASUREMENT
/begin MEASUREMENT W9 "" UWORD DEZL 0 0 0.000000 65535.000000 ECU_ADDRESS 0xFD2E BIT_MASK 0xFFFF /end MEASUREMENT
/begin MEASUREMENT W9A " Zustand LRHK" UWORD DEZL 0 0 0.000000 65535.000000 ECU_ADDRESS 0xFD30 BIT_MASK 0xFFFF /end MEASUREMENT
/begin MEASUREMENT W9B " Bits für Katausrauemen" UWORD DEZL 0 0 0.000000 65535.000000 ECU_ADDRESS 0xFD32 BIT_MASK 0xFFFF /end MEASUREMENT
/begin MEASUREMENT W9C " Bits für Lambda-Diagnosen" UWORD DEZL 0 0 0.000000 65535.000000 ECU_ADDRESS 0xFD34 BIT_MASK 0xFFFF /end MEASUREMENT
/begin MEASUREMENT W9D " Bits für Lambda-Diagnosen" UWORD DEZL 0 0 0.000000 65535.000000 ECU_ADDRESS 0xFD36 BIT_MASK 0xFFFF /end MEASUREMENT
/begin MEASUREMENT W9E " Bits für Lambda-Diagnosen" UWORD DEZL 0 0 0.000000 65535.000000 ECU_ADDRESS 0xFD38 BIT_MASK 0xFFFF /end MEASUREMENT
/begin MEASUREMENT W9F " Bits für Lambda-Diagnosen (DLSAHK)" UWORD DEZL 0 0 0.000000 65535.000000 ECU_ADDRESS 0xFD3A BIT_MASK 0xFFFF /end MEASUREMENT
/begin MEASUREMENT W9G " Bits für Lambda-Diagnosen (DLSAHK)" UWORD DEZL 0 0 0.000000 65535.000000 ECU_ADDRESS 0xFD3C BIT_MASK 0xFFFF /end MEASUREMENT
/begin MEASUREMENT W9H " Bits für Lambda-Diagnosen (DLSAHK)" UWORD DEZL 0 0 0.000000 65535.000000 ECU_ADDRESS 0xFD3E BIT_MASK 0xFFFF /end MEASUREMENT
/begin MEASUREMENT W9I " Bits für Lambda-Diagnosen (DLSAHK)" UWORD DEZL 0 0 0.000000 65535.000000 ECU_ADDRESS 0xFD40 BIT_MASK 0xFFFF /end MEASUREMENT
/begin MEASUREMENT W9J " Bits für Lambda-Diagnosen (DLSAHK)" UWORD DEZL 0 0 0.000000 65535.000000 ECU_ADDRESS 0xFD42 BIT_MASK 0xFFFF /end MEASUREMENT
/begin MEASUREMENT WADD1 "Positive Korrekturen auf Grundzuendwinkel" UBYTE ZWQ 0 0 0.000000 191.250000 ECU_ADDRESS 0xF779 BIT_MASK 0xFF /end MEASUREMENT
/begin MEASUREMENT WADD2 "Positive Korrekturen auf ZWB-Winkel" UBYTE ZWQ 0 0 0.000000 191.250000 ECU_ADDRESS 0xF77A BIT_MASK 0xFF /end MEASUREMENT
/begin MEASUREMENT WAL_UR " Byte fuer DA b_wal_um" UBYTE DEZ 0 0 0.000000 256.000000 ECU_ADDRESS 0xB17F1 BIT_MASK 0xFF /end MEASUREMENT
/begin MEASUREMENT WAND_STS " WandlerStatus" UBYTE TC_STS 0 0 0.000000 3.000000 ECU_ADDRESS 0xB05F8 BIT_MASK 0xFF /end MEASUREMENT
/begin MEASUREMENT WASRCALC "Zuendwinkel aus ASR-Eingriff unbegrenzt" UBYTE ZWQ 0 0 0.000000 191.250000 ECU_ADDRESS 0xB0573 BIT_MASK 0xFF /end MEASUREMENT
/begin MEASUREMENT WDG1PLZ "> Programmlaufzeit von Freigabe Watchdog bis 1. Refresh [2.6us]" UWORD TEQL 0 0 0.000000 174.760000 ECU_ADDRESS 0xF766 BIT_MASK 0xFFFF /end MEASUREMENT
/begin MEASUREMENT WDG2PLZ "> Programmlaufzeit Romcheck bis Aufruf MAIN-Prog. [2.6us]" UWORD TEQL 0 0 0.000000 174.760000 ECU_ADDRESS 0xF76A BIT_MASK 0xFFFF /end MEASUREMENT
/begin MEASUREMENT WDKBL_ALT "Alter Drosselklappenwinkel" UBYTE UWDK 0 0 0.000000 80.599900 ECU_ADDRESS 0xB0622 BIT_MASK 0xFF /end MEASUREMENT
/begin MEASUREMENT WDKBL_URAL " 20ms-alter Drosselklappenwinkel" UBYTE UWDK 0 0 0.000000 80.599900 ECU_ADDRESS 0xB0000 BIT_MASK 0xFF /end MEASUREMENT
/begin MEASUREMENT WEER "Vorlagerungswinkel fuer CIFI" UBYTE WQ720 0 0 0.000000 720.000000 ECU_ADDRESS 0xB027F BIT_MASK 0xFF /end MEASUREMENT
/begin MEASUREMENT WFS_STATUS " Status SG freigegeben wenn true (37)" UBYTE DEZ 0 0 0.000000 256.000000 ECU_ADDRESS 0xB2240 BIT_MASK 0xFF /end MEASUREMENT
/begin MEASUREMENT WFS_STSG "WFS Statusinformation" UBYTE DEZ 0 0 0.000000 256.000000 ECU_ADDRESS 0xFA16 BIT_MASK 0xFF /end MEASUREMENT
/begin MEASUREMENT WFS_ZUST " WFS-Zustand" UBYTE DEZ 0 0 0.000000 256.000000 ECU_ADDRESS 0xB0CF0 BIT_MASK 0xFF /end MEASUREMENT
/begin MEASUREMENT WF_ALT "Alter Wandfilm" UWORD TEQ_12L 0 0 0.000000 2097.120000 ECU_ADDRESS 0xF8EC BIT_MASK 0xFFFF /end MEASUREMENT
/begin MEASUREMENT WGEXTCALC " externer Zuendwinkel-Eingriff unbegrenzt" UBYTE ZWQ 0 0 0.000000 191.250000 ECU_ADDRESS 0xB055F BIT_MASK 0xFF /end MEASUREMENT
/begin MEASUREMENT WGSCALC " ZW von EGS-Eingriff vor Aenderungsbegr." UBYTE ZWQ 0 0 0.000000 191.250000 ECU_ADDRESS 0xB05AF BIT_MASK 0xFF /end MEASUREMENT
/begin MEASUREMENT WKFZW2 " Basiszuendwinkel für Momentenberechnungen" UBYTE ZWOF 0 0 -78.000000 24.000000 ECU_ADDRESS 0xF77E BIT_MASK 0xFF /end MEASUREMENT
/begin MEASUREMENT WKR6 "Zuendwinkel aus Klopfregelung Zyl. 7" UBYTE ZWQ 0 0 0.000000 191.250000 ECU_ADDRESS 0xB0438 BIT_MASK 0xFF /end MEASUREMENT
/begin MEASUREMENT WKR7 "Zuendwinkel aus Klopfregelung Zyl. 8" UBYTE ZWQ 0 0 0.000000 191.250000 ECU_ADDRESS 0xB0439 BIT_MASK 0xFF /end MEASUREMENT
/begin MEASUREMENT WKRDMNN_ "IP-Ergebnis max. Abweichung (negativ) von mittlerer KR-Regeltiefe" UBYTE ZWQ 0 0 0.000000 191.250000 ECU_ADDRESS 0xB044A BIT_MASK 0xFF /end MEASUREMENT
/begin MEASUREMENT WKRDMXN_ "IP-Ergebnis max. Abweichung (positiv) von mittlerer KR-Regeltiefe" UBYTE ZWQ 0 0 0.000000 191.250000 ECU_ADDRESS 0xB044B BIT_MASK 0xFF /end MEASUREMENT
/begin MEASUREMENT WKRDYA1 " Adaptiver Zuendwinkel-Dynamikvorhalt n>KRAN1" UBYTE ZWQ 0 0 0.000000 191.250000 ECU_ADDRESS 0xB215A BIT_MASK 0xFF /end MEASUREMENT
/begin MEASUREMENT WKRDYA2 " Adaptiver Zuendwinkel-Dynamikvorhalt n>KRAN2" UBYTE ZWQ 0 0 0.000000 191.250000 ECU_ADDRESS 0xB215B BIT_MASK 0xFF /end MEASUREMENT
/begin MEASUREMENT WKRDYA3 " Adaptiver Zuendwinkel-Dynamikvorhalt n>KRAN3" UBYTE ZWQ 0 0 0.000000 191.250000 ECU_ADDRESS 0xB215C BIT_MASK 0xFF /end MEASUREMENT
/begin MEASUREMENT WKRDYA4 " Adaptiver Zuendwinkel-Dynamikvorhalt n>KRAN4" UBYTE ZWQ 0 0 0.000000 191.250000 ECU_ADDRESS 0xB215D BIT_MASK 0xFF /end MEASUREMENT
/begin MEASUREMENT WKRDY_KOR " Zuendwinkel-Dynamikvorhalt mit Tip-In" UBYTE ZWQ 0 0 0.000000 191.250000 ECU_ADDRESS 0xB06EC BIT_MASK 0xFF /end MEASUREMENT
/begin MEASUREMENT WKRMO "unselektiertes wkr" UBYTE ZWQ 0 0 0.000000 191.250000 ECU_ADDRESS 0xB0454 BIT_MASK 0xFF /end MEASUREMENT
/begin MEASUREMENT WKR_FUER " Klopfzuendwinkel des gefuehrten Zylinders" UBYTE ZWQ 0 0 0.000000 191.250000 ECU_ADDRESS 0xB0418 BIT_MASK 0xFF /end MEASUREMENT
/begin MEASUREMENT WKR_MAX " Maxiamlwert ZW aus KR" UBYTE ZWQ 0 0 0.000000 191.250000 ECU_ADDRESS 0xB06BE BIT_MASK 0xFF /end MEASUREMENT
/begin MEASUREMENT WKR_MW " Mittelwert ZW aus KR" UBYTE ZWQ 0 0 0.000000 191.250000 ECU_ADDRESS 0xB06BF BIT_MASK 0xFF /end MEASUREMENT
/begin MEASUREMENT WL_BLK_CTR " Zeitzaehler fuer Pegeldauer bei 'Blinken'" UBYTE TQ10 0 0 0.000000 2.550000 ECU_ADDRESS 0xB0C88 BIT_MASK 0xFF /end MEASUREMENT
/begin MEASUREMENT WL_DIA_CTR " Zeitzaehler fuer Diagnoseablauf" UWORD TQ10L 0 0 0.000000 655.350000 ECU_ADDRESS 0xB0C86 BIT_MASK 0xFFFF /end MEASUREMENT
/begin MEASUREMENT WOKR "Ausgabezuendwinkel ohne KR-Anteile" UBYTE ZWOF 0 0 -78.000000 24.000000 ECU_ADDRESS 0xF780 BIT_MASK 0xFF /end MEASUREMENT
/begin MEASUREMENT WOUTA "Zuendwinkel Zuendung A (Doppelzuendung)" UBYTE ZWOF 0 0 -78.000000 24.000000 ECU_ADDRESS 0xF78D BIT_MASK 0xFF /end MEASUREMENT
/begin MEASUREMENT WOUTB "Zuendwinkel Zuendung B (Doppelzuendung)" UBYTE ZWOF 0 0 -78.000000 24.000000 ECU_ADDRESS 0xF78E BIT_MASK 0xFF /end MEASUREMENT
/begin MEASUREMENT WOUTCPL "Komplement Zuendwinkel fuer Ebene 2" UBYTE DEZ 0 0 0.000000 256.000000 ECU_ADDRESS 0xF790 BIT_MASK 0xFF /end MEASUREMENT
/begin MEASUREMENT WOUT_UC "auszugebender Zuendwinkel fuer BT" UBYTE ZWOF 0 0 -78.000000 24.000000 ECU_ADDRESS 0xE085 BIT_MASK 0xFF /end MEASUREMENT
/begin MEASUREMENT WOUT_UM " auszugebender Zuendwinkel" UBYTE ZWOF 0 0 -78.000000 24.000000 ECU_ADDRESS 0xE005 BIT_MASK 0xFF /end MEASUREMENT
/begin MEASUREMENT WOUT_UR " auszugebender Zuendwinkel" UBYTE ZWOF 0 0 -78.000000 24.000000 ECU_ADDRESS 0xB17B7 BIT_MASK 0xFF /end MEASUREMENT
/begin MEASUREMENT WPHG "Phasenkorrektur" UBYTE ZWNEG 0 0 -72.000000 0.000000 ECU_ADDRESS 0xF782 BIT_MASK 0xFF /end MEASUREMENT
/begin MEASUREMENT WST "Startzuendwinkel" UBYTE ZWOF 0 0 -78.000000 24.000000 ECU_ADDRESS 0xF73A BIT_MASK 0xFF /end MEASUREMENT
/begin MEASUREMENT WSUB1 "Negative Korrekturen auf Grundzuendwinkel" UBYTE ZWNEG 0 0 -72.000000 0.000000 ECU_ADDRESS 0xF77B BIT_MASK 0xFF /end MEASUREMENT
/begin MEASUREMENT WSUB2 "Negative Korrekturen auf ZWB-Winkel" UBYTE ZWNEG 0 0 -72.000000 0.000000 ECU_ADDRESS 0xF77C BIT_MASK 0xFF /end MEASUREMENT
/begin MEASUREMENT WVS6 "ZW-Verstellung Zuendung 6" UBYTE ZWNEGBG 0 0 -25.500000 0.000000 ECU_ADDRESS 0xF747 BIT_MASK 0xFF /end MEASUREMENT
/begin MEASUREMENT WVS7 "ZW-Verstellung Zuendung 7" UBYTE ZWNEGBG 0 0 -25.500000 0.000000 ECU_ADDRESS 0xF748 BIT_MASK 0xFF /end MEASUREMENT
/begin MEASUREMENT W_ASRL "Zuendwinkel aus ASR-Eingriff (langsam)" UBYTE ZWQ 0 0 0.000000 191.250000 ECU_ADDRESS 0xB056C BIT_MASK 0xFF /end MEASUREMENT
/begin MEASUREMENT W_ASRS "Zuendwinkel aus ASR-Eingriff (schnell)" UBYTE ZWQ 0 0 0.000000 191.250000 ECU_ADDRESS 0xB056D BIT_MASK 0xFF /end MEASUREMENT
/begin MEASUREMENT W_DK "Drosselklappenwinkel ohne den gelernten Teil" UBYTE UWDK 0 0 0.000000 80.599900 ECU_ADDRESS 0xB05A6 BIT_MASK 0xFF /end MEASUREMENT
/begin MEASUREMENT W_KWP01 "state od switches 3" UWORD DEZL 0 0 0.000000 65535.000000 ECU_ADDRESS 0xB0268 BIT_MASK 0xFFFF /end MEASUREMENT
/begin MEASUREMENT W_KWP02 "state od switches 1" UWORD DEZL 0 0 0.000000 65535.000000 ECU_ADDRESS 0xB0264 BIT_MASK 0xFFFF /end MEASUREMENT
/begin MEASUREMENT W_KWP03 "state of lambda probes 1" UWORD DEZL 0 0 0.000000 65535.000000 ECU_ADDRESS 0xB026A BIT_MASK 0xFFFF /end MEASUREMENT
/begin MEASUREMENT W_KWP04 "state od switches 2" UWORD DEZL 0 0 0.000000 65535.000000 ECU_ADDRESS 0xB0266 BIT_MASK 0xFFFF /end MEASUREMENT
/begin MEASUREMENT W_KWP05 "state of lambda probes 2" UWORD DEZL 0 0 0.000000 65535.000000 ECU_ADDRESS 0xB026C BIT_MASK 0xFFFF /end MEASUREMENT
/begin MEASUREMENT W_KWP06 "state of lambda probes 3" UWORD DEZL 0 0 0.000000 65535.000000 ECU_ADDRESS 0xB026E BIT_MASK 0xFFFF /end MEASUREMENT
/begin MEASUREMENT W_KWP07 "state of CAN diagnosis" UWORD DEZL 0 0 0.000000 65535.000000 ECU_ADDRESS 0xB0270 BIT_MASK 0xFFFF /end MEASUREMENT
/begin MEASUREMENT W_KWP08 "Cruise control status" UWORD DEZL 0 0 0.000000 65535.000000 ECU_ADDRESS 0xB0262 BIT_MASK 0xFFFF /end MEASUREMENT
/begin MEASUREMENT W_MSRCALC "Zuendwinkel aus MSR-Eingriff unbegrenzt" UBYTE ZWQ 0 0 0.000000 191.250000 ECU_ADDRESS 0xB056A BIT_MASK 0xFF /end MEASUREMENT
/begin MEASUREMENT W_TEST1 " Testbyte 1 fuer VS100/PCAM" UWORD DEZL 0 0 0.000000 65535.000000 ECU_ADDRESS 0xB02CE BIT_MASK 0xFFFF /end MEASUREMENT
/begin MEASUREMENT W_TEST2 " Testbyte 2 fuer VS100/PCAM" UWORD DEZL 0 0 0.000000 65535.000000 ECU_ADDRESS 0xB02D0 BIT_MASK 0xFFFF /end MEASUREMENT
/begin MEASUREMENT W_TEST3 " Testbyte 3 fuer VS100/PCAM" UWORD DEZL 0 0 0.000000 65535.000000 ECU_ADDRESS 0xB02D2 BIT_MASK 0xFFFF /end MEASUREMENT
/begin MEASUREMENT W_TEST4 " Testbyte 4 fuer VS100/PCAM" UWORD DEZL 0 0 0.000000 65535.000000 ECU_ADDRESS 0xB02D4 BIT_MASK 0xFFFF /end MEASUREMENT
/begin MEASUREMENT W_TEST5 " Testbyte 5 fuer VS100/PCAM" UWORD DEZL 0 0 0.000000 65535.000000 ECU_ADDRESS 0xB02D6 BIT_MASK 0xFFFF /end MEASUREMENT
/begin MEASUREMENT W_TEST6 " Testbyte 6 fuer VS100/PCAM" UWORD DEZL 0 0 0.000000 65535.000000 ECU_ADDRESS 0xB02D8 BIT_MASK 0xFFFF /end MEASUREMENT
/begin MEASUREMENT W_TEST7 " Testbyte 7 fuer VS100/PCAM" UWORD DEZL 0 0 0.000000 65535.000000 ECU_ADDRESS 0xB02DA BIT_MASK 0xFFFF /end MEASUREMENT
/begin MEASUREMENT W_TEST8 " Testbyte 8 fuer VS100/PCAM" UWORD DEZL 0 0 0.000000 65535.000000 ECU_ADDRESS 0xB02DC BIT_MASK 0xFFFF /end MEASUREMENT
/begin MEASUREMENT X0000 "Word mit Inhalt 0000h" UBYTE DEZ 0 0 0.000000 256.000000 ECU_ADDRESS 0xB1BD2 BIT_MASK 0xFF /end MEASUREMENT
/begin MEASUREMENT XDUMMY "Word beinhaltet TFR bei HW-Trap" UBYTE DEZBG 0 0 0.000000 255.000000 ECU_ADDRESS 0xB1BD0 BIT_MASK 0xFF /end MEASUREMENT
/begin MEASUREMENT XNLP " Notlaufpunkt (Q = 0.025Grad/inc)" UWORD DEZL 0 0 0.000000 65535.000000 ECU_ADDRESS 0xB207A BIT_MASK 0xFFFF /end MEASUREMENT
/begin MEASUREMENT XSD0 " Interne Rechengroesse" UBYTE DEZ 0 0 0.000000 256.000000 ECU_ADDRESS 0xB07D8 BIT_MASK 0xFF /end MEASUREMENT
/begin MEASUREMENT XSD1 " Interne Rechengroesse" UBYTE DEZ 0 0 0.000000 256.000000 ECU_ADDRESS 0xB07D9 BIT_MASK 0xFF /end MEASUREMENT
/begin MEASUREMENT XSD1W " Interne Rechengroesse" UWORD DEZL 0 0 0.000000 65535.000000 ECU_ADDRESS 0xB07D2 BIT_MASK 0xFFFF /end MEASUREMENT
/begin MEASUREMENT XSD2 " Interne Rechengroesse" UBYTE DEZ 0 0 0.000000 256.000000 ECU_ADDRESS 0xB07DA BIT_MASK 0xFF /end MEASUREMENT
/begin MEASUREMENT XSD2W " Interne Rechengroesse" UWORD DEZL 0 0 0.000000 65535.000000 ECU_ADDRESS 0xB07D4 BIT_MASK 0xFFFF /end MEASUREMENT
/begin MEASUREMENT XSD3 " Interne Rechengroesse" UBYTE DEZ 0 0 0.000000 256.000000 ECU_ADDRESS 0xB07DB BIT_MASK 0xFF /end MEASUREMENT
/begin MEASUREMENT XSD3W " Interne Rechengroesse" UWORD DEZL 0 0 0.000000 65535.000000 ECU_ADDRESS 0xB07D6 BIT_MASK 0xFFFF /end MEASUREMENT
/begin MEASUREMENT XSD4 " Interne Rechengroesse" UBYTE DEZ 0 0 0.000000 256.000000 ECU_ADDRESS 0xB07DC BIT_MASK 0xFF /end MEASUREMENT
/begin MEASUREMENT XSD5 " Interne Rechengroesse" UBYTE DEZ 0 0 0.000000 256.000000 ECU_ADDRESS 0xB07DD BIT_MASK 0xFF /end MEASUREMENT
/begin MEASUREMENT XSD6 " Interne Rechengroesse" UBYTE DEZ 0 0 0.000000 256.000000 ECU_ADDRESS 0xB07DE BIT_MASK 0xFF /end MEASUREMENT
/begin MEASUREMENT XSD7 " Interne Rechengroesse" UBYTE DEZ 0 0 0.000000 256.000000 ECU_ADDRESS 0xB07DF BIT_MASK 0xFF /end MEASUREMENT
/begin MEASUREMENT XSET " Soll-Wert (Q = 0.025Grad/inc)" UWORD DEZL 0 0 0.000000 65535.000000 ECU_ADDRESS 0xF9C2 BIT_MASK 0xFFFF /end MEASUREMENT
/begin MEASUREMENT ZALT_UM " Zahnzaehlerwert des vorh. Berechnungszeitpunktes im 40ms-Raster" UWORD DEZL 0 0 0.000000 65535.000000 ECU_ADDRESS 0xE058 BIT_MASK 0xFFFF /end MEASUREMENT
/begin MEASUREMENT ZALT_UR " DA Differenz der Berechnungszeitpunkte in Timersteps" UWORD DEZL 0 0 0.000000 65535.000000 ECU_ADDRESS 0xB17FA BIT_MASK 0xFFFF /end MEASUREMENT
/begin MEASUREMENT ZBALM_R " Wert aus ZBALM" UBYTE FKT2048 0 0 0.000000 0.124510 ECU_ADDRESS 0xF8F2 BIT_MASK 0xFF /end MEASUREMENT
/begin MEASUREMENT ZCAP_UM " Zahnzaehlerwert des akt. Berechnungszeitpunktes im 40ms-Raster" UWORD DEZL 0 0 0.000000 65535.000000 ECU_ADDRESS 0xE056 BIT_MASK 0xFFFF /end MEASUREMENT
/begin MEASUREMENT ZDIF_UM " Differenz der Berechnungszeitpunkte in Timersteps" UWORD DEZL 0 0 0.000000 65535.000000 ECU_ADDRESS 0xE05A BIT_MASK 0xFFFF /end MEASUREMENT
/begin MEASUREMENT ZG_SOLL " Istgang, waehrend des Schaltens Zielgang" UBYTE DEZ 0 0 0.000000 256.000000 ECU_ADDRESS 0xB057C BIT_MASK 0xFF /end MEASUREMENT
/begin MEASUREMENT ZKVEK " Zuendkreisvektor ( 0..(ZYLANZ/2)-1 )" UBYTE DEZ 0 0 0.000000 256.000000 ECU_ADDRESS 0xF778 BIT_MASK 0xFF /end MEASUREMENT
/begin MEASUREMENT ZLASOHML_B " Zeitkonstante fuer PT1-Filter des Pseudo-Lambda hinter Kat" UBYTE PHI1_40 0 0 7.212000 40000.000000 ECU_ADDRESS 0xB03CB BIT_MASK 0xFF /end MEASUREMENT
/begin MEASUREMENT ZLRHML_R " Steigung f. ATV aus KL 'ZLRHML'" UWORD ATVG38L 0 0 0.000000 103.476000 ECU_ADDRESS 0xB039C BIT_MASK 0xFFFF /end MEASUREMENT
/begin MEASUREMENT ZNDY " Zuendungszaehler fuer Drehzahldynamik" UBYTE DEZ 0 0 0.000000 256.000000 ECU_ADDRESS 0xB06E7 BIT_MASK 0xFF /end MEASUREMENT
/begin MEASUREMENT ZNS "Zeitkonstante TP1-Glied" UBYTE K409Q 0 0 1.606270 409.600000 ECU_ADDRESS 0xB0494 BIT_MASK 0xFF /end MEASUREMENT
/begin MEASUREMENT ZRIBERH "Ri-Berechnungszaehler nach Start hinter Kat Bank 1" UBYTE DEZ 0 0 0.000000 256.000000 ECU_ADDRESS 0xB108C BIT_MASK 0xFF /end MEASUREMENT
/begin MEASUREMENT ZRIBERH2 "Ri-Berechnungszaehler nach Start hinter Kat Bank" UBYTE DEZ 0 0 0.000000 256.000000 ECU_ADDRESS 0xB108D BIT_MASK 0xFF /end MEASUREMENT
/begin MEASUREMENT ZRINH2_W "Zeitzaehler Bereitstellung aktuelle Bedingungen b_rinh2" UWORD TQ100L 0 0 0.000000 6553.500000 ECU_ADDRESS 0xB1088 BIT_MASK 0xFFFF /end MEASUREMENT
/begin MEASUREMENT ZRINH_W "Zeitzaehler Bereitstellung aktuelle Bedingungen b_rin" UWORD TQ100L 0 0 0.000000 6553.500000 ECU_ADDRESS 0xB1086 BIT_MASK 0xFFFF /end MEASUREMENT
/begin MEASUREMENT ZRPLZ "> 10ms-Programmlaufzeitzaehler [2.6us]" UWORD TEQL 0 0 0.000000 174.760000 ECU_ADDRESS 0xF75E BIT_MASK 0xFFFF /end MEASUREMENT
/begin MEASUREMENT ZSWACC " Zeitkonstante fuer SW_ACC Filter" UBYTE K10Q 0 0 0.010039 2.560000 ECU_ADDRESS 0xB05D1 BIT_MASK 0xFF /end MEASUREMENT
/begin MEASUREMENT ZSWEGS " Zeitkonstante fuer SW_EGS Filter" UBYTE K10Q 0 0 0.010039 2.560000 ECU_ADDRESS 0xB05AD BIT_MASK 0xFF /end MEASUREMENT
/begin MEASUREMENT ZSYNC_UM " Variable fuer Kennung Zylinder-Neusynchronisation" UBYTE DEZ 0 0 0.000000 256.000000 ECU_ADDRESS 0xE00B BIT_MASK 0xFF /end MEASUREMENT
/begin MEASUREMENT ZTLF "TL/TLW-Filterkonstante" UBYTE PHI1_SY 0 0 0.000000 99.609400 ECU_ADDRESS 0xB06CD BIT_MASK 0xFF /end MEASUREMENT
/begin MEASUREMENT ZTLM "TLM-Filterkonstante" UBYTE PHI1_SY 0 0 0.000000 99.609400 ECU_ADDRESS 0xF969 BIT_MASK 0xFF /end MEASUREMENT
/begin MEASUREMENT ZTLMN "TLM-Filterkonstante (b_tlfu = 1)" UBYTE PHI1_SY 0 0 0.000000 99.609400 ECU_ADDRESS 0xF96A BIT_MASK 0xFF /end MEASUREMENT
/begin MEASUREMENT ZTLZ "TLZ-Filterkonstante" UBYTE PHI1_SY 0 0 0.000000 99.609400 ECU_ADDRESS 0xF965 BIT_MASK 0xFF /end MEASUREMENT
/begin MEASUREMENT ZVALM_R " Wert aus ZVALM" UBYTE FKT2048 0 0 0.000000 0.124510 ECU_ADDRESS 0xF8F1 BIT_MASK 0xFF /end MEASUREMENT
/begin MEASUREMENT ZWC_C_UM "Fehlerzaehler Zuendwinkelueberw." UBYTE DEZ 0 0 0.000000 256.000000 ECU_ADDRESS 0xE041 BIT_MASK 0xFF /end MEASUREMENT
/begin MEASUREMENT ZWC_C_UR " DA Fehlerzaehler Zuendwinkelueberwachung" UBYTE DEZ 0 0 0.000000 256.000000 ECU_ADDRESS 0xB17E3 BIT_MASK 0xFF /end MEASUREMENT
/begin MEASUREMENT ZWDAR "zeitgeregelter additiver Antiruckelzuendwinkel-Eingriff" UBYTE ZWQ 0 0 0.000000 191.250000 ECU_ADDRESS 0xB04AD BIT_MASK 0xFF /end MEASUREMENT
/begin MEASUREMENT ZWGEFLR1 " Ereigniszaehler bei Gemischfehler (Bank 1)" UBYTE DEZ 0 0 0.000000 256.000000 ECU_ADDRESS 0xB2148 BIT_MASK 0xFF /end MEASUREMENT
/begin MEASUREMENT ZWOPT_UC " theor. opt. Zuendwinkel fuer BT" UBYTE ZWOF 0 0 -78.000000 24.000000 ECU_ADDRESS 0xE09E BIT_MASK 0xFF /end MEASUREMENT
/begin MEASUREMENT ZWOPT_UM " theor. opt. Zuendwinkel" UBYTE ZWOF 0 0 -78.000000 24.000000 ECU_ADDRESS 0xE028 BIT_MASK 0xFF /end MEASUREMENT
/begin MEASUREMENT ZWPVK1 " Warteperiodenzaehler der Periodendauerueberwachung" UBYTE DEZ 0 0 0.000000 256.000000 ECU_ADDRESS 0xB090F BIT_MASK 0xFF /end MEASUREMENT
/begin MEASUREMENT ZYLFUER " Inhalt von LZFUER[zylvek]" UBYTE DEZ 0 0 0.000000 256.000000 ECU_ADDRESS 0xFD62 BIT_MASK 0xFF /end MEASUREMENT
/begin MEASUREMENT ZZWST " Anzahl Zuendungen fuer Startzuendwinkel ueber Startende hinaus" UBYTE DEZ 0 0 0.000000 256.000000 ECU_ADDRESS 0xF78F BIT_MASK 0xFF /end MEASUREMENT
/begin MEASUREMENT ALT_NEG " Rechengroesse" UWORD B_TRUE 0 0 0.000000 1.000000 ECU_ADDRESS 0xFDBA BIT_MASK 0x20 /end MEASUREMENT
/begin MEASUREMENT ASRF_VD " ValidData ASR fast" UWORD B_TRUE 0 0 0.000000 1.000000 ECU_ADDRESS 0xFDB4 BIT_MASK 0x400 /end MEASUREMENT
/begin MEASUREMENT ASRS_VD " ValidData ASR slow" UWORD B_TRUE 0 0 0.000000 1.000000 ECU_ADDRESS 0xFDB4 BIT_MASK 0x200 /end MEASUREMENT
/begin MEASUREMENT A_SCHALT "alter Wert von s_schalt" UWORD B_TRUE 0 0 0.000000 1.000000 ECU_ADDRESS 0xFD8A BIT_MASK 0x1 /end MEASUREMENT
/begin MEASUREMENT BANKCOD0 " 1 = Zylinder 0 ist an Bank 1" UWORD B_TRUE 0 0 0.000000 1.000000 ECU_ADDRESS 0xFD1A BIT_MASK 0x100 /end MEASUREMENT
/begin MEASUREMENT BANKCOD1 " 1 = Zylinder 1 ist an Bank 1" UWORD B_TRUE 0 0 0.000000 1.000000 ECU_ADDRESS 0xFD1A BIT_MASK 0x200 /end MEASUREMENT
/begin MEASUREMENT BANKCOD2 " 1 = Zylinder 2 ist an Bank 1" UWORD B_TRUE 0 0 0.000000 1.000000 ECU_ADDRESS 0xFD1A BIT_MASK 0x400 /end MEASUREMENT
/begin MEASUREMENT BANKCOD3 " 1 = Zylinder 3 ist an Bank 1" UWORD B_TRUE 0 0 0.000000 1.000000 ECU_ADDRESS 0xFD1A BIT_MASK 0x800 /end MEASUREMENT
/begin MEASUREMENT BANKCOD4 " 1 = Zylinder 4 ist an Bank 1" UWORD B_TRUE 0 0 0.000000 1.000000 ECU_ADDRESS 0xFD1A BIT_MASK 0x1000 /end MEASUREMENT
/begin MEASUREMENT BANKCOD5 " 1 = Zylinder 5 ist an Bank 1" UWORD B_TRUE 0 0 0.000000 1.000000 ECU_ADDRESS 0xFD1A BIT_MASK 0x2000 /end MEASUREMENT
/begin MEASUREMENT BANKCOD6 " 1 = Zylinder 6 ist an Bank 1" UWORD B_TRUE 0 0 0.000000 1.000000 ECU_ADDRESS 0xFD1A BIT_MASK 0x4000 /end MEASUREMENT
/begin MEASUREMENT BANKCOD7 " 1 = Zylinder 7 ist an Bank 1" UWORD B_TRUE 0 0 0.000000 1.000000 ECU_ADDRESS 0xFD1A BIT_MASK 0x8000 /end MEASUREMENT
/begin MEASUREMENT B_4ZYL " 1 = Anfahren im 2. Gang" UWORD B_TRUE 0 0 0.000000 1.000000 ECU_ADDRESS 0xFD0E BIT_MASK 0x8000 /end MEASUREMENT
/begin MEASUREMENT B_500KWABG " Intervall f. abgasrel. Aussetzer erreicht" UWORD B_TRUE 0 0 0.000000 1.000000 ECU_ADDRESS 0xFD84 BIT_MASK 0x1000 /end MEASUREMENT
/begin MEASUREMENT B_500KWSP " Intervall f. abgasrel. Aussetzer erreicht" UWORD B_TRUE 0 0 0.000000 1.000000 ECU_ADDRESS 0xFD82 BIT_MASK 0x4000 /end MEASUREMENT
/begin MEASUREMENT B_5ZYL " 1 = 5 Zylinder Motor" UWORD B_TRUE 0 0 0.000000 1.000000 ECU_ADDRESS 0xFD0E BIT_MASK 0x20 /end MEASUREMENT
/begin MEASUREMENT B_6ZYL " 6 Zylinder Motor" UWORD B_TRUE 0 0 0.000000 1.000000 ECU_ADDRESS 0xFD10 BIT_MASK 0x2000 /end MEASUREMENT
/begin MEASUREMENT B_A0 " >1= SW0_OUT" UWORD B_TRUE 0 0 0.000000 1.000000 ECU_ADDRESS 0xFDA0 BIT_MASK 0x100 /end MEASUREMENT
/begin MEASUREMENT B_A1 " >1= SW1_OUT" UWORD B_TRUE 0 0 0.000000 1.000000 ECU_ADDRESS 0xFDA0 BIT_MASK 0x200 /end MEASUREMENT
/begin MEASUREMENT B_A2 " >1= SW2_OUT" UWORD B_TRUE 0 0 0.000000 1.000000 ECU_ADDRESS 0xFDA0 BIT_MASK 0x400 /end MEASUREMENT
/begin MEASUREMENT B_A3 " >1= SW3_OUT" UWORD B_TRUE 0 0 0.000000 1.000000 ECU_ADDRESS 0xFDA0 BIT_MASK 0x800 /end MEASUREMENT
/begin MEASUREMENT B_A4 " >1=" UWORD B_TRUE 0 0 0.000000 1.000000 ECU_ADDRESS 0xFDA0 BIT_MASK 0x1000 /end MEASUREMENT
/begin MEASUREMENT B_A5 " >1=" UWORD B_TRUE 0 0 0.000000 1.000000 ECU_ADDRESS 0xFDA0 BIT_MASK 0x2000 /end MEASUREMENT
/begin MEASUREMENT B_ABS " 1 = ABs aktiv" UWORD B_TRUE 0 0 0.000000 1.000000 ECU_ADDRESS 0xFDB4 BIT_MASK 0x4 /end MEASUREMENT
/begin MEASUREMENT B_ABSFELA " 1 = ABS-Fehlerlampe" UWORD B_TRUE 0 0 0.000000 1.000000 ECU_ADDRESS 0xFDB4 BIT_MASK 0x20 /end MEASUREMENT
/begin MEASUREMENT B_ACCAKT1 " ACC-Freigabe aus Botschaftsueberwachung" UWORD B_TRUE 0 0 0.000000 1.000000 ECU_ADDRESS 0xFD70 BIT_MASK 0x10 /end MEASUREMENT
/begin MEASUREMENT B_ACCAKT2 " ACC-Freigabe aus Fahreranforderung" UWORD B_TRUE 0 0 0.000000 1.000000 ECU_ADDRESS 0xFD70 BIT_MASK 0x20 /end MEASUREMENT
/begin MEASUREMENT B_ACCAKT3 " ACC-Freigabe aus ACC-Reaktion" UWORD B_TRUE 0 0 0.000000 1.000000 ECU_ADDRESS 0xFD70 BIT_MASK 0x40 /end MEASUREMENT
/begin MEASUREMENT B_ACCNP1 "> ACC nichtplausibel Verzoegerung" UWORD B_TRUE 0 0 0.000000 1.000000 ECU_ADDRESS 0xFD78 BIT_MASK 0x8000 /end MEASUREMENT
/begin MEASUREMENT B_ACCRMP "1 = Abregelrampe fuer ACC laeuft" UWORD B_TRUE 0 0 0.000000 1.000000 ECU_ADDRESS 0xFD72 BIT_MASK 0x20 /end MEASUREMENT
/begin MEASUREMENT B_ACCUB "Hilfsbit fuer Spannungsschwelle ACC" UWORD B_TRUE 0 0 0.000000 1.000000 ECU_ADDRESS 0xFD88 BIT_MASK 0x80 /end MEASUREMENT
/begin MEASUREMENT B_ACC_AB_F " ACC reversibel aus durch Fuktionsrechner" UWORD B_TRUE 0 0 0.000000 1.000000 ECU_ADDRESS 0xFD6E BIT_MASK 0x2000 /end MEASUREMENT
/begin MEASUREMENT B_ACC_BRK " Status ACC: 'only DC regulation'" UWORD B_TRUE 0 0 0.000000 1.000000 ECU_ADDRESS 0xFD70 BIT_MASK 0x200 /end MEASUREMENT
/begin MEASUREMENT B_ACC_DC "ACC bremst aktiv" UWORD B_TRUE 0 0 0.000000 1.000000 ECU_ADDRESS 0xFD72 BIT_MASK 0x2000 /end MEASUREMENT
/begin MEASUREMENT B_ACC_FAIL " Status ACC: 'failure detected'" UWORD B_TRUE 0 0 0.000000 1.000000 ECU_ADDRESS 0xFD70 BIT_MASK 0x8 /end MEASUREMENT
/begin MEASUREMENT B_ACC_NOCO " ECU erkennt Kommunikationsfehler ACC" UWORD B_TRUE 0 0 0.000000 1.000000 ECU_ADDRESS 0xFD88 BIT_MASK 0x100 /end MEASUREMENT
/begin MEASUREMENT B_ACC_NORE " ECU erkennt ACC-Fehler (irreversibel)" UWORD B_TRUE 0 0 0.000000 1.000000 ECU_ADDRESS 0xFD6E BIT_MASK 0x1000 /end MEASUREMENT
/begin MEASUREMENT B_ACC_NP " ACC-Anforderung nicht plausibel" UWORD B_TRUE 0 0 0.000000 1.000000 ECU_ADDRESS 0xFD70 BIT_MASK 0x1 /end MEASUREMENT
/begin MEASUREMENT B_ACC_OFF " Status ACC: 'off'" UWORD B_TRUE 0 0 0.000000 1.000000 ECU_ADDRESS 0xFD70 BIT_MASK 0x2 /end MEASUREMENT
/begin MEASUREMENT B_ACC_REG " Status ACC: 'EC/DC regulation'" UWORD B_TRUE 0 0 0.000000 1.000000 ECU_ADDRESS 0xFD70 BIT_MASK 0x400 /end MEASUREMENT
/begin MEASUREMENT B_ACC_STBY " Status ACC: 'standby'" UWORD B_TRUE 0 0 0.000000 1.000000 ECU_ADDRESS 0xFD70 BIT_MASK 0x4 /end MEASUREMENT
/begin MEASUREMENT B_ACC_TC "ACC fordert aktiv Drehmoment" UWORD B_TRUE 0 0 0.000000 1.000000 ECU_ADDRESS 0xFD72 BIT_MASK 0x1000 /end MEASUREMENT
/begin MEASUREMENT B_ACMVER " ACC-Momentenvergleich" UWORD B_TRUE 0 0 0.000000 1.000000 ECU_ADDRESS 0xFDAA BIT_MASK 0x4000 /end MEASUREMENT
/begin MEASUREMENT B_ADCASIC "AD-Werte vom ASIC koennen ausgewertet werden." UWORD B_TRUE 0 0 0.000000 1.000000 ECU_ADDRESS 0xFD68 BIT_MASK 0x80 /end MEASUREMENT
/begin MEASUREMENT B_ADNMAX " Drehzahlbegrenzung aktiv fuer Betr.datenerfassung" UWORD B_TRUE 0 0 0.000000 1.000000 ECU_ADDRESS 0xFD7A BIT_MASK 0x4 /end MEASUREMENT
/begin MEASUREMENT B_ADUNPLAU " ADC-Steuerung abgebrochen -> keine Aufbereitung der Rohsignale" UWORD B_TRUE 0 0 0.000000 1.000000 ECU_ADDRESS 0xFD64 BIT_MASK 0x20 /end MEASUREMENT
/begin MEASUREMENT B_AFG ">1= Aussetzerfenster gespeichert (DMDMIL)" UWORD B_TRUE 0 0 0.000000 1.000000 ECU_ADDRESS 0xFD82 BIT_MASK 0x8000 /end MEASUREMENT
/begin MEASUREMENT B_AHKAT " Zwischenbit Bank1" UWORD B_TRUE 0 0 0.000000 1.000000 ECU_ADDRESS 0xFD46 BIT_MASK 0x1 /end MEASUREMENT
/begin MEASUREMENT B_AHZK " Zwischenbit Bank1" UWORD B_TRUE 0 0 0.000000 1.000000 ECU_ADDRESS 0xFD46 BIT_MASK 0x2 /end MEASUREMENT
/begin MEASUREMENT B_ALLRAD " Allradfahrzeug" UWORD B_TRUE 0 0 0.000000 1.000000 ECU_ADDRESS 0xFD14 BIT_MASK 0x2 /end MEASUREMENT
/begin MEASUREMENT B_ANALU_AP " Ausblendphase" UBYTE B_TRUE 0 0 0.000000 1.000000 ECU_ADDRESS 0xF9A7 BIT_MASK 0x4 /end MEASUREMENT
/begin MEASUREMENT B_ANFSTAT " 1 = Anfahr-Zustand" UWORD B_TRUE 0 0 0.000000 1.000000 ECU_ADDRESS 0xFD20 BIT_MASK 0x20 /end MEASUREMENT
/begin MEASUREMENT B_AP_AKTIV " 1 = DATEN kommen aus AP_RAM" UWORD B_TRUE 0 0 0.000000 1.000000 ECU_ADDRESS 0xFD2A BIT_MASK 0x8000 /end MEASUREMENT
/begin MEASUREMENT B_ARGETR " Handschalter oder Automat im Tip-Modus fuer AR" UWORD B_TRUE 0 0 0.000000 1.000000 ECU_ADDRESS 0xFD8A BIT_MASK 0x200 /end MEASUREMENT
/begin MEASUREMENT B_ASICOK " ASIC Init. erfolgreich abgeschlossen, 10ms Raster-Bed. freigeben" UWORD B_TRUE 0 0 0.000000 1.000000 ECU_ADDRESS 0xFD64 BIT_MASK 0x2 /end MEASUREMENT
/begin MEASUREMENT B_ASRFAIL " 1 = ASR/FDR/ABS Fehler" UWORD B_TRUE 0 0 0.000000 1.000000 ECU_ADDRESS 0xFDB4 BIT_MASK 0x8 /end MEASUREMENT
/begin MEASUREMENT B_ASRFELA " 1 = ASR-Fehlerlampe" UWORD B_TRUE 0 0 0.000000 1.000000 ECU_ADDRESS 0xFDB4 BIT_MASK 0x10 /end MEASUREMENT
/begin MEASUREMENT B_ASRRMP "1 = Abregelrampe fuer ASR laeuft" UWORD B_TRUE 0 0 0.000000 1.000000 ECU_ADDRESS 0xFD26 BIT_MASK 0x10 /end MEASUREMENT
/begin MEASUREMENT B_ASRUB "Hilfsbit fuer Spannungsschwelle ASR" UWORD B_TRUE 0 0 0.000000 1.000000 ECU_ADDRESS 0xFD88 BIT_MASK 0x20 /end MEASUREMENT
/begin MEASUREMENT B_ASR_EV "1 = EV-Ausblendung aktiv" UWORD B_TRUE 0 0 0.000000 1.000000 ECU_ADDRESS 0xFD24 BIT_MASK 0x100 /end MEASUREMENT
/begin MEASUREMENT B_AUSL " Stoergroessenaufschaltung aktiv" UWORD B_TRUE 0 0 0.000000 1.000000 ECU_ADDRESS 0xFD58 BIT_MASK 0x40 /end MEASUREMENT
/begin MEASUREMENT B_AUS_ACC " 'Tempomat Aus' entprellt fuer ACC" UWORD B_TRUE 0 0 0.000000 1.000000 ECU_ADDRESS 0xFD70 BIT_MASK 0x4000 /end MEASUREMENT
/begin MEASUREMENT B_AUS_ACC_ " alte Bitinfo 'Tempomat Aus' entprellt fuer ACC" UWORD B_TRUE 0 0 0.000000 1.000000 ECU_ADDRESS 0xFD72 BIT_MASK 0x8 /end MEASUREMENT
/begin MEASUREMENT B_AUS_ALT " alte Bitinfo 'Tempomat Aus'" UWORD B_TRUE 0 0 0.000000 1.000000 ECU_ADDRESS 0xFD72 BIT_MASK 0x4 /end MEASUREMENT
/begin MEASUREMENT B_AUTO " Umschalt. Pedalkennfeld auf Automatikbetrieb" UWORD B_TRUE 0 0 0.000000 1.000000 ECU_ADDRESS 0xFD58 BIT_MASK 0x80 /end MEASUREMENT
/begin MEASUREMENT B_AWBZSY " Zwischensp. Flankenwechsel BZSYNC" UWORD B_TRUE 0 0 0.000000 1.000000 ECU_ADDRESS 0xFDD8 BIT_MASK 0x2 /end MEASUREMENT
/begin MEASUREMENT B_AWLCK " Zwischensp. b_luecke" UWORD B_TRUE 0 0 0.000000 1.000000 ECU_ADDRESS 0xFDD8 BIT_MASK 0x1 /end MEASUREMENT
/begin MEASUREMENT B_AWLCK2 " Zwischensp. b_luecke2" UWORD B_TRUE 0 0 0.000000 1.000000 ECU_ADDRESS 0xFDD8 BIT_MASK 0x20 /end MEASUREMENT
/begin MEASUREMENT B_BACKDOOR " 1 = Hintertüre zur WFS-Umgehung ist offen." UWORD B_TRUE 0 0 0.000000 1.000000 ECU_ADDRESS 0xFD0C BIT_MASK 0x800 /end MEASUREMENT
/begin MEASUREMENT B_BAKT "1 = Betrieb ist aktiv" UWORD B_TRUE 0 0 0.000000 1.000000 ECU_ADDRESS 0xFD1C BIT_MASK 0x4 /end MEASUREMENT
/begin MEASUREMENT B_BCUB "Hilfsbit fuer Spannungsschwelle BC" UWORD B_TRUE 0 0 0.000000 1.000000 ECU_ADDRESS 0xFD88 BIT_MASK 0x2 /end MEASUREMENT
/begin MEASUREMENT B_BD_DRZ " Drehzahlfenster ist erreicht" UBYTE B_TRUE 0 0 0.000000 1.000000 ECU_ADDRESS 0xB207E BIT_MASK 0x40 /end MEASUREMENT
/begin MEASUREMENT B_BD_DRZJA " Drehzahlbedingung erfüllt" UBYTE B_TRUE 0 0 0.000000 1.000000 ECU_ADDRESS 0xB207E BIT_MASK 0x80 /end MEASUREMENT
/begin MEASUREMENT B_BD_VL " Backdoor: lokale Volllastbedingung" UBYTE B_TRUE 0 0 0.000000 1.000000 ECU_ADDRESS 0xB207E BIT_MASK 0x8 /end MEASUREMENT
/begin MEASUREMENT B_BD_VLJA " Volllastbedingung erfüllt" UBYTE B_TRUE 0 0 0.000000 1.000000 ECU_ADDRESS 0xB207E BIT_MASK 0x10 /end MEASUREMENT
/begin MEASUREMENT B_BD_VL_AL " B_vl beim letzten Programmlauf" UBYTE B_TRUE 0 0 0.000000 1.000000 ECU_ADDRESS 0xB207E BIT_MASK 0x20 /end MEASUREMENT
/begin MEASUREMENT B_BEDIENH_ " Bitinfo: Bedienhebel mind. 1mal gelesen" UWORD B_TRUE 0 0 0.000000 1.000000 ECU_ADDRESS 0xFD72 BIT_MASK 0x10 /end MEASUREMENT
/begin MEASUREMENT B_BESCHL " 1= Korrektur nach Beschleunigung" UWORD B_TRUE 0 0 0.000000 1.000000 ECU_ADDRESS 0xFD6C BIT_MASK 0x40 /end MEASUREMENT
/begin MEASUREMENT B_BETRNLF " '1'= Betriebsdaten sind im Nachlauf abgespeichert worden" UWORD B_TRUE 0 0 0.000000 1.000000 ECU_ADDRESS 0xFD68 BIT_MASK 0x2000 /end MEASUREMENT
/begin MEASUREMENT B_BZ1NOTOG "> BZ-Bit 1 bei Toggle-Ausfall" UWORD B_TRUE 0 0 0.000000 1.000000 ECU_ADDRESS 0xFD4E BIT_MASK 0x100 /end MEASUREMENT
/begin MEASUREMENT B_CACCVAL " Botschaft von ACC empfangen" UWORD B_TRUE 0 0 0.000000 1.000000 ECU_ADDRESS 0xFD88 BIT_MASK 0x40 /end MEASUREMENT
/begin MEASUREMENT B_CANBOFF " CAN-Controller Busoff Status" UWORD B_TRUE 0 0 0.000000 1.000000 ECU_ADDRESS 0xFD6E BIT_MASK 0x4 /end MEASUREMENT
/begin MEASUREMENT B_CANDATAV " CAN-Daten verfuegbar" UWORD B_TRUE 0 0 0.000000 1.000000 ECU_ADDRESS 0xFD6E BIT_MASK 0x1 /end MEASUREMENT
/begin MEASUREMENT B_CANEWRN " CAN-Controller Error Warning Status" UWORD B_TRUE 0 0 0.000000 1.000000 ECU_ADDRESS 0xFD6E BIT_MASK 0x2 /end MEASUREMENT
/begin MEASUREMENT B_CANFAIL " CAN Busoff, Mute, Fehler ueberlauf." UWORD B_TRUE 0 0 0.000000 1.000000 ECU_ADDRESS 0xFD86 BIT_MASK 0x2000 /end MEASUREMENT
/begin MEASUREMENT B_CANOFF " CAN Busoff" UWORD B_TRUE 0 0 0.000000 1.000000 ECU_ADDRESS 0xFD86 BIT_MASK 0x20 /end MEASUREMENT
/begin MEASUREMENT B_CASRVAL " Botschaft von ASR empfangen" UWORD B_TRUE 0 0 0.000000 1.000000 ECU_ADDRESS 0xFD88 BIT_MASK 0x10 /end MEASUREMENT
/begin MEASUREMENT B_CBCVAL " Botschaft von BC empfangen" UWORD B_TRUE 0 0 0.000000 1.000000 ECU_ADDRESS 0xFD88 BIT_MASK 0x1 /end MEASUREMENT
/begin MEASUREMENT B_CCSW_ON " 1= CruiseControlSwitch_On" UWORD B_TRUE 0 0 0.000000 1.000000 ECU_ADDRESS 0xFD6E BIT_MASK 0x4000 /end MEASUREMENT
/begin MEASUREMENT B_CDKVS " Funktion ueber Codewort ??? freigegeben" UWORD B_TRUE 0 0 0.000000 1.000000 ECU_ADDRESS 0xB1000 BIT_MASK 0x800 /end MEASUREMENT
/begin MEASUREMENT B_CEGSVAL " Botschaft von EGS empfangen" UWORD B_TRUE 0 0 0.000000 1.000000 ECU_ADDRESS 0xFD88 BIT_MASK 0x4 /end MEASUREMENT
/begin MEASUREMENT B_CHKRCYSE " Checkyte fuer Diagnose W-Ltg. ist gesendet" UWORD B_TRUE 0 0 0.000000 1.000000 ECU_ADDRESS 0xFDD4 BIT_MASK 0x400 /end MEASUREMENT
/begin MEASUREMENT B_CHKUMP " '1'=Prüfung, ob Umprg. erfolgt ist, abgeschlossen" UWORD B_TRUE 0 0 0.000000 1.000000 ECU_ADDRESS 0xFD08 BIT_MASK 0x100 /end MEASUREMENT
/begin MEASUREMENT B_CNBAVAL " Botschaft von NBA empfangen" UWORD B_TRUE 0 0 0.000000 1.000000 ECU_ADDRESS 0xFD88 BIT_MASK 0x200 /end MEASUREMENT
/begin MEASUREMENT B_CRANK " Anlassvorgang" UWORD B_TRUE 0 0 0.000000 1.000000 ECU_ADDRESS 0xFD0C BIT_MASK 0x2 /end MEASUREMENT
/begin MEASUREMENT B_CURRFSTS " Bedingung ob aktueller Fehler mit Z-Flag anliegt" UWORD B_TRUE 0 0 0.000000 1.000000 ECU_ADDRESS 0xFDD6 BIT_MASK 0x2000 /end MEASUREMENT
/begin MEASUREMENT B_CWKOS " Klimaanlage ist verbaut" UWORD B_TRUE 0 0 0.000000 1.000000 ECU_ADDRESS 0xFDF8 BIT_MASK 0x400 /end MEASUREMENT
/begin MEASUREMENT B_C_MS100 " AnsiC 100ms Zeitraster aktiv" UWORD B_TRUE 0 0 0.000000 1.000000 ECU_ADDRESS 0xFDB0 BIT_MASK 0x2 /end MEASUREMENT
/begin MEASUREMENT B_C_MS200 " AnsiC 200ms Zeitraster aktiv" UWORD B_TRUE 0 0 0.000000 1.000000 ECU_ADDRESS 0xFDB0 BIT_MASK 0x4 /end MEASUREMENT
/begin MEASUREMENT B_C_MS50 " AnsiC 50ms Zeitraster aktiv" UWORD B_TRUE 0 0 0.000000 1.000000 ECU_ADDRESS 0xFDB0 BIT_MASK 0x1 /end MEASUREMENT
/begin MEASUREMENT B_C_S1 " AnsiC 1s Zeitraster aktiv" UWORD B_TRUE 0 0 0.000000 1.000000 ECU_ADDRESS 0xFDB0 BIT_MASK 0x8 /end MEASUREMENT
/begin MEASUREMENT B_C_S2 " AnsiC 2s Zeitraster aktiv" UWORD B_TRUE 0 0 0.000000 1.000000 ECU_ADDRESS 0xFDB0 BIT_MASK 0x10 /end MEASUREMENT
/begin MEASUREMENT B_DCDISREQ " 1 = Endstufenabschalt-Anforderung" UWORD B_TRUE 0 0 0.000000 1.000000 ECU_ADDRESS 0xFD4E BIT_MASK 0x8000 /end MEASUREMENT
/begin MEASUREMENT B_DCDIS_FF " Abschaltung bei gesetztem Fehlerflag DC-Endstufe anfordern" UWORD B_TRUE 0 0 0.000000 1.000000 ECU_ADDRESS 0xFD66 BIT_MASK 0x8000 /end MEASUREMENT
/begin MEASUREMENT B_DDFRPLAU " Trigger Ruecksetzen Plausfehler DDF" UWORD B_TRUE 0 0 0.000000 1.000000 ECU_ADDRESS 0xFD32 BIT_MASK 0x2000 /end MEASUREMENT
/begin MEASUREMENT B_DDFSPLAU " Trigger Setzen Plausfehler DDF" UWORD B_TRUE 0 0 0.000000 1.000000 ECU_ADDRESS 0xFD32 BIT_MASK 0x1000 /end MEASUREMENT
/begin MEASUREMENT B_DFPMSTOR " DFPM ins Spiegelram copiert" UWORD B_TRUE 0 0 0.000000 1.000000 ECU_ADDRESS 0xFDD6 BIT_MASK 0x8000 /end MEASUREMENT
/begin MEASUREMENT B_DIS_NCA " NCA Drehmomentanhebung Active" UWORD B_TRUE 0 0 0.000000 1.000000 ECU_ADDRESS 0xFDB8 BIT_MASK 0x40 /end MEASUREMENT
/begin MEASUREMENT B_DKLP2ALT " Funktionsbit: alter Wert abspeichern" UWORD B_TRUE 0 0 0.000000 1.000000 ECU_ADDRESS 0xB089C BIT_MASK 0x2 /end MEASUREMENT
/begin MEASUREMENT B_DKLP2_FL " Funktionsbit: Flanke b_dklpi2" UWORD B_TRUE 0 0 0.000000 1.000000 ECU_ADDRESS 0xB089C BIT_MASK 0x1 /end MEASUREMENT
/begin MEASUREMENT B_DKLP2_HL " Funktionsbit: high-low-Flanke erkannt" UWORD B_TRUE 0 0 0.000000 1.000000 ECU_ADDRESS 0xB089C BIT_MASK 0x4 /end MEASUREMENT
/begin MEASUREMENT B_DKLP2_LH " Funktionsbit: low_high-Flanke erkannt" UWORD B_TRUE 0 0 0.000000 1.000000 ECU_ADDRESS 0xB089C BIT_MASK 0x8 /end MEASUREMENT
/begin MEASUREMENT B_DKLPALT " Funktionsbit: alter Wert abspeichern" UWORD B_TRUE 0 0 0.000000 1.000000 ECU_ADDRESS 0xB089A BIT_MASK 0x40 /end MEASUREMENT
/begin MEASUREMENT B_DKLP_FL " Funktionsbit: Flanke b_dklpi" UWORD B_TRUE 0 0 0.000000 1.000000 ECU_ADDRESS 0xB089A BIT_MASK 0x20 /end MEASUREMENT
/begin MEASUREMENT B_DKLP_HL " Funktionsbit: high-low-Flanke erkannt" UWORD B_TRUE 0 0 0.000000 1.000000 ECU_ADDRESS 0xB089A BIT_MASK 0x80 /end MEASUREMENT
/begin MEASUREMENT B_DKLP_LH " Funktionsbit: low_high-Flanke erkannt" UWORD B_TRUE 0 0 0.000000 1.000000 ECU_ADDRESS 0xB089A BIT_MASK 0x100 /end MEASUREMENT
/begin MEASUREMENT B_DKNOT_IN " DK-Poti - Notfahren (Info)" UWORD B_TRUE 0 0 0.000000 1.000000 ECU_ADDRESS 0xFD66 BIT_MASK 0x4 /end MEASUREMENT
/begin MEASUREMENT B_DLAFF1 " Anz. TP-Messungen erreicht seit B_dlatp1" UWORD B_TRUE 0 0 0.000000 1.000000 ECU_ADDRESS 0xFD38 BIT_MASK 0x1 /end MEASUREMENT
/begin MEASUREMENT B_DLARTP1 " '1'= Diagnose Lambdasondenalterung, Hilfsbit" UWORD B_TRUE 0 0 0.000000 1.000000 ECU_ADDRESS 0xFD34 BIT_MASK 0x8 /end MEASUREMENT
/begin MEASUREMENT B_DLFRFG "1 = LFR-Diagnose-Freigabe" UWORD B_TRUE 0 0 0.000000 1.000000 ECU_ADDRESS 0xFD1E BIT_MASK 0x400 /end MEASUREMENT
/begin MEASUREMENT B_DLSVSP2 " Ausloesung Drive-Recorder Messung " UWORD B_TRUE 0 0 0.000000 1.000000 ECU_ADDRESS 0xB0850 BIT_MASK 0x40 /end MEASUREMENT
/begin MEASUREMENT B_DLUERKV " vormerken: B_DLUERKV" UWORD B_TRUE 0 0 0.000000 1.000000 ECU_ADDRESS 0xFDBA BIT_MASK 0x8 /end MEASUREMENT
/begin MEASUREMENT B_DLUERK_A " Aussetzer aus DMDDLU" UBYTE B_TRUE 0 0 0.000000 1.000000 ECU_ADDRESS 0xF9A7 BIT_MASK 0x1 /end MEASUREMENT
/begin MEASUREMENT B_DLUREQ " anfordern: B_DLUREQ" UWORD B_TRUE 0 0 0.000000 1.000000 ECU_ADDRESS 0xFDBE BIT_MASK 0x10 /end MEASUREMENT
/begin MEASUREMENT B_DMD2 "> 1 = von oben kommend" UWORD B_TRUE 0 0 0.000000 1.000000 ECU_ADDRESS 0xFDBC BIT_MASK 0x80 /end MEASUREMENT
/begin MEASUREMENT B_DMDCHA " 1 = DMD hat gewechselt" UWORD B_TRUE 0 0 0.000000 1.000000 ECU_ADDRESS 0xFDBC BIT_MASK 0x8 /end MEASUREMENT
/begin MEASUREMENT B_DMDHI_AL " alte Info: B_DMDHI" UWORD B_TRUE 0 0 0.000000 1.000000 ECU_ADDRESS 0xFDBC BIT_MASK 0x20 /end MEASUREMENT
/begin MEASUREMENT B_DMDHI_BG " Hintergrundinfo" UWORD B_TRUE 0 0 0.000000 1.000000 ECU_ADDRESS 0xFDBC BIT_MASK 0x100 /end MEASUREMENT
/begin MEASUREMENT B_DMDNLF " Nachlauf f. Aussetzererk. beendet" UWORD B_TRUE 0 0 0.000000 1.000000 ECU_ADDRESS 0xFD84 BIT_MASK 0x800 /end MEASUREMENT
/begin MEASUREMENT B_DNWNS " 1 = Drehzahlschwelle fuer Nachstartkorr. schon mal ueberschritten" UWORD B_TRUE 0 0 0.000000 1.000000 ECU_ADDRESS 0xFD12 BIT_MASK 0x800 /end MEASUREMENT
/begin MEASUREMENT B_DRAMG " 1 = OBP-Dauerram geprueft fuer Powerfailpruef." UWORD B_TRUE 0 0 0.000000 1.000000 ECU_ADDRESS 0xFD06 BIT_MASK 0x20 /end MEASUREMENT
/begin MEASUREMENT B_DRREC " Ausloesung Drive-Recorder Messung " UBYTE B_TRUE 0 0 0.000000 1.000000 ECU_ADDRESS 0xFDE0 BIT_MASK 0x1 /end MEASUREMENT
/begin MEASUREMENT B_DRVOFF " Umschalt. Pedalkennfeld auf Anfahren" UWORD B_TRUE 0 0 0.000000 1.000000 ECU_ADDRESS 0xFD58 BIT_MASK 0x100 /end MEASUREMENT
/begin MEASUREMENT B_DRV_BR " Fahrer bremst (hat Angst vor ACC)" UWORD B_TRUE 0 0 0.000000 1.000000 ECU_ADDRESS 0xFD6E BIT_MASK 0x8000 /end MEASUREMENT
/begin MEASUREMENT B_DRV_BRVD " ValidData Fahrer bremst" UWORD B_TRUE 0 0 0.000000 1.000000 ECU_ADDRESS 0xFDB4 BIT_MASK 0x1000 /end MEASUREMENT
/begin MEASUREMENT B_DSW " '1'= Diagnose Beschleunigungssensor aktiv" UWORD B_TRUE 0 0 0.000000 1.000000 ECU_ADDRESS 0xFD5A BIT_MASK 0x800 /end MEASUREMENT
/begin MEASUREMENT B_DTDO_T " Temp. Bit fuer DTDO" UWORD B_TRUE 0 0 0.000000 1.000000 ECU_ADDRESS 0xFD7A BIT_MASK 0x10 /end MEASUREMENT
/begin MEASUREMENT B_EBDFELA " 1 = EBD-Fehlerlampe" UWORD B_TRUE 0 0 0.000000 1.000000 ECU_ADDRESS 0xFDB4 BIT_MASK 0x40 /end MEASUREMENT
/begin MEASUREMENT B_EEDEFEKT " 1 = EEPROM defekt (Lesen in Init. hat nicht funktioniert)" UWORD B_TRUE 0 0 0.000000 1.000000 ECU_ADDRESS 0xFD86 BIT_MASK 0x8 /end MEASUREMENT
/begin MEASUREMENT B_EEFERTIG " 1 = EEPROM ist fertig beschrieben, Nachlauf kann beendet werden" UWORD B_TRUE 0 0 0.000000 1.000000 ECU_ADDRESS 0xFD86 BIT_MASK 0x2 /end MEASUREMENT
/begin MEASUREMENT B_EELESEN " 1 = EEPROM wird noch ausgelesen" UWORD B_TRUE 0 0 0.000000 1.000000 ECU_ADDRESS 0xFD86 BIT_MASK 0x1 /end MEASUREMENT
/begin MEASUREMENT B_EESANF "1= Schreibanforderung ins EEPROM während Fahrprogramm" UWORD B_TRUE 0 0 0.000000 1.000000 ECU_ADDRESS 0xFDF8 BIT_MASK 0x2 /end MEASUREMENT
/begin MEASUREMENT B_EESA_KOD "1= Schreibanforderung Kodierung (EEP)" UWORD B_TRUE 0 0 0.000000 1.000000 ECU_ADDRESS 0xFDF8 BIT_MASK 0x8 /end MEASUREMENT
/begin MEASUREMENT B_EESA_PRO "1= Schreibanforderung Programmierbytes (EEP)" UWORD B_TRUE 0 0 0.000000 1.000000 ECU_ADDRESS 0xFDF8 BIT_MASK 0x4 /end MEASUREMENT
/begin MEASUREMENT B_EESA_WFS " WFS-RAMs ins EEPROM abspeichern im Nachlauf" UWORD B_TRUE 0 0 0.000000 1.000000 ECU_ADDRESS 0xFDD4 BIT_MASK 0x200 /end MEASUREMENT
/begin MEASUREMENT B_EGSNP " Fehler Plausibilitaetspruefung Drehmoment" UWORD B_TRUE 0 0 0.000000 1.000000 ECU_ADDRESS 0xFD8A BIT_MASK 0x2 /end MEASUREMENT
/begin MEASUREMENT B_EGSRMP " NCA Absteuerung der Anhebung aktiv" UWORD B_TRUE 0 0 0.000000 1.000000 ECU_ADDRESS 0xFDB8 BIT_MASK 0x2 /end MEASUREMENT
/begin MEASUREMENT B_EGSUB "Hilfsbit fuer Spannungsschwelle EGS" UWORD B_TRUE 0 0 0.000000 1.000000 ECU_ADDRESS 0xFD88 BIT_MASK 0x8 /end MEASUREMENT
/begin MEASUREMENT B_EGS_ANF " EGS-Eingriff wirksam" UWORD B_TRUE 0 0 0.000000 1.000000 ECU_ADDRESS 0xFD9E BIT_MASK 0x400 /end MEASUREMENT
/begin MEASUREMENT B_EGS_NOCO " Fehler in Komm. mit EGS" UWORD B_TRUE 0 0 0.000000 1.000000 ECU_ADDRESS 0xFDB8 BIT_MASK 0x1 /end MEASUREMENT
/begin MEASUREMENT B_EHSH1 " Sondenheizung 1 hinten Fehler" UWORD B_TRUE 0 0 0.000000 1.000000 ECU_ADDRESS 0xFD56 BIT_MASK 0x200 /end MEASUREMENT
/begin MEASUREMENT B_EHSV1 " Sondenheizung 1 vorn Fehler" UWORD B_TRUE 0 0 0.000000 1.000000 ECU_ADDRESS 0xFD56 BIT_MASK 0x80 /end MEASUREMENT
/begin MEASUREMENT B_EKATS " '1' = Summenfehler fuer MODE6 Bank1" UWORD B_TRUE 0 0 0.000000 1.000000 ECU_ADDRESS 0xFD46 BIT_MASK 0x4000 /end MEASUREMENT
/begin MEASUREMENT B_EKPEP " 1= Endstufe-Ansteuerung EKP erfolgt" UWORD B_TRUE 0 0 0.000000 1.000000 ECU_ADDRESS 0xFD90 BIT_MASK 0x8 /end MEASUREMENT
/begin MEASUREMENT B_EML " 1 = EML-HARDWARE (AP_RAM) ist eingeba" UWORD B_TRUE 0 0 0.000000 1.000000 ECU_ADDRESS 0xFD28 BIT_MASK 0x8000 /end MEASUREMENT
/begin MEASUREMENT B_EMPF_PO_ " 1 = Empfangsportzustand aus letztem 1ms-Raster" UWORD B_TRUE 0 0 0.000000 1.000000 ECU_ADDRESS 0xFD80 BIT_MASK 0x4000 /end MEASUREMENT
/begin MEASUREMENT B_EMS_DI " 1=" UWORD B_TRUE 0 0 0.000000 1.000000 ECU_ADDRESS 0xFD96 BIT_MASK 0x1 /end MEASUREMENT
/begin MEASUREMENT B_ENCIFI " 1 = Einspritzung freigegeben" UWORD B_TRUE 0 0 0.000000 1.000000 ECU_ADDRESS 0xFD0C BIT_MASK 0x4 /end MEASUREMENT
/begin MEASUREMENT B_ERSZ " Funktionsbit: b_szkat & b_erdkt" UWORD B_TRUE 0 0 0.000000 1.000000 ECU_ADDRESS 0xB089C BIT_MASK 0x200 /end MEASUREMENT
/begin MEASUREMENT B_ERSZALT " Funktionsbit: alter Wert von b_szkat & b_erdkt" UWORD B_TRUE 0 0 0.000000 1.000000 ECU_ADDRESS 0xB089C BIT_MASK 0x400 /end MEASUREMENT
/begin MEASUREMENT B_ERSZLH " Funktionsbit: low_high-Flanke von b_szkat & b_erdkt erkannt" UWORD B_TRUE 0 0 0.000000 1.000000 ECU_ADDRESS 0xB089C BIT_MASK 0x800 /end MEASUREMENT
/begin MEASUREMENT B_ESB " 1 = Anforderung Zuendungsabschalten von EGS" UWORD B_TRUE 0 0 0.000000 1.000000 ECU_ADDRESS 0xFDA0 BIT_MASK 0x80 /end MEASUREMENT
/begin MEASUREMENT B_ESFAAV " 1= Endstufenpruefg. AAV aktiv" UWORD B_TRUE 0 0 0.000000 1.000000 ECU_ADDRESS 0xFD8C BIT_MASK 0x200 /end MEASUREMENT
/begin MEASUREMENT B_ESFAGR " 1= Endstufenpruefg. AGR aktiv" UWORD B_TRUE 0 0 0.000000 1.000000 ECU_ADDRESS 0xFD8C BIT_MASK 0x1000 /end MEASUREMENT
/begin MEASUREMENT B_ESFEKP " 1= Endstufenpruefg. EKP aktiv" UWORD B_TRUE 0 0 0.000000 1.000000 ECU_ADDRESS 0xFD8C BIT_MASK 0x8 /end MEASUREMENT
/begin MEASUREMENT B_ESFFELA " 1= Endstufenpruefg. FELA aktiv" UWORD B_TRUE 0 0 0.000000 1.000000 ECU_ADDRESS 0xFD8C BIT_MASK 0x1 /end MEASUREMENT
/begin MEASUREMENT B_ESFFGRE " 1= Endstufenpruefg. FGR Lampe aktiv" UWORD B_TRUE 0 0 0.000000 1.000000 ECU_ADDRESS 0xFD8C BIT_MASK 0x4000 /end MEASUREMENT
/begin MEASUREMENT B_ESFKOS " 1= Endstufenpruefg. KOS aktiv" UWORD B_TRUE 0 0 0.000000 1.000000 ECU_ADDRESS 0xFD8C BIT_MASK 0x2 /end MEASUREMENT
/begin MEASUREMENT B_ESFLDR " 1= Endstufenpruefg. LDR aktiv" UWORD B_TRUE 0 0 0.000000 1.000000 ECU_ADDRESS 0xFD8C BIT_MASK 0x2000 /end MEASUREMENT
/begin MEASUREMENT B_ESFLSHHK " 1= Endstufenpruefg. LSHHK aktiv" UWORD B_TRUE 0 0 0.000000 1.000000 ECU_ADDRESS 0xFD8C BIT_MASK 0x10 /end MEASUREMENT
/begin MEASUREMENT B_ESFLSHVK " 1= Endstufenpruefg. LSHVK aktiv" UWORD B_TRUE 0 0 0.000000 1.000000 ECU_ADDRESS 0xFD8C BIT_MASK 0x20 /end MEASUREMENT
/begin MEASUREMENT B_ESFLUES1 " 1= Endstufenpruefg. LUES1 aktiv" UWORD B_TRUE 0 0 0.000000 1.000000 ECU_ADDRESS 0xFD8C BIT_MASK 0x80 /end MEASUREMENT
/begin MEASUREMENT B_ESFLUES2 " 1= Endstufenpruefg. LUES2 aktiv" UWORD B_TRUE 0 0 0.000000 1.000000 ECU_ADDRESS 0xFD8C BIT_MASK 0x100 /end MEASUREMENT
/begin MEASUREMENT B_ESFNWS " 1= Endstufenpruefg. NWS aktiv" UWORD B_TRUE 0 0 0.000000 1.000000 ECU_ADDRESS 0xFD8C BIT_MASK 0x800 /end MEASUREMENT
/begin MEASUREMENT B_ESFSU " 1= Endstufenpruefg. SU aktiv" UWORD B_TRUE 0 0 0.000000 1.000000 ECU_ADDRESS 0xFD8C BIT_MASK 0x400 /end MEASUREMENT
/begin MEASUREMENT B_ESFTEV " 1= Endstufenpruefg. TEV aktiv" UWORD B_TRUE 0 0 0.000000 1.000000 ECU_ADDRESS 0xFD8C BIT_MASK 0x4 /end MEASUREMENT
/begin MEASUREMENT B_ESFWAL " 1= Endstufenpruefg. WAL aktiv" UWORD B_TRUE 0 0 0.000000 1.000000 ECU_ADDRESS 0xFD8C BIT_MASK 0x40 /end MEASUREMENT
/begin MEASUREMENT B_EVEP0 " 1= Endstufe-Ansteuerung EV1 erfolgt" UWORD B_TRUE 0 0 0.000000 1.000000 ECU_ADDRESS 0xFD94 BIT_MASK 0x1 /end MEASUREMENT
/begin MEASUREMENT B_EVEP1 " 1= Endstufe-Ansteuerung EV2 erfolgt" UWORD B_TRUE 0 0 0.000000 1.000000 ECU_ADDRESS 0xFD94 BIT_MASK 0x2 /end MEASUREMENT
/begin MEASUREMENT B_EVEP2 " 1= Endstufe-Ansteuerung EV3 erfolgt" UWORD B_TRUE 0 0 0.000000 1.000000 ECU_ADDRESS 0xFD94 BIT_MASK 0x4 /end MEASUREMENT
/begin MEASUREMENT B_EVEP3 " 1= Endstufe-Ansteuerung EV4 erfolgt" UWORD B_TRUE 0 0 0.000000 1.000000 ECU_ADDRESS 0xFD94 BIT_MASK 0x8 /end MEASUREMENT
/begin MEASUREMENT B_EVEP4 " 1= Endstufe-Ansteuerung EV5 erfolgt" UWORD B_TRUE 0 0 0.000000 1.000000 ECU_ADDRESS 0xFD94 BIT_MASK 0x10 /end MEASUREMENT
/begin MEASUREMENT B_FATP1ALT "'1' = Funktionanforderung TP-Ueberwachung (i-1)" UWORD B_TRUE 0 0 0.000000 1.000000 ECU_ADDRESS 0xFD34 BIT_MASK 0x8000 /end MEASUREMENT
/begin MEASUREMENT B_FBREMS " 1 = Fehler Schalter Bremse" UWORD B_TRUE 0 0 0.000000 1.000000 ECU_ADDRESS 0xFD0A BIT_MASK 0x100 /end MEASUREMENT
/begin MEASUREMENT B_FCMCLR " Anforderung Task FCMCLR" UWORD B_TRUE 0 0 0.000000 1.000000 ECU_ADDRESS 0xFDD6 BIT_MASK 0x8 /end MEASUREMENT
/begin MEASUREMENT B_FELAEP " 1= Endstufe-Ansteuerung FELA erfolgt" UWORD B_TRUE 0 0 0.000000 1.000000 ECU_ADDRESS 0xFD90 BIT_MASK 0x1 /end MEASUREMENT
/begin MEASUREMENT B_FGREEP " 1= Endstufe-Ansteuerung FGR-Lampe erfolgt" UWORD B_TRUE 0 0 0.000000 1.000000 ECU_ADDRESS 0xFD90 BIT_MASK 0x4000 /end MEASUREMENT
/begin MEASUREMENT B_FIFO_WOR "1 = Es wird gerade ein EEPROM-Anforderung in den Fifo eingetragen" UWORD B_TRUE 0 0 0.000000 1.000000 ECU_ADDRESS 0xFD86 BIT_MASK 0x4 /end MEASUREMENT
/begin MEASUREMENT B_FIRSTASR " 0->1 Uebergang von B_ASR_EV" UWORD B_TRUE 0 0 0.000000 1.000000 ECU_ADDRESS 0xFD24 BIT_MASK 0x200 /end MEASUREMENT
/begin MEASUREMENT B_FLKKUP " Flankenwechsel an B_KUP" UWORD B_TRUE 0 0 0.000000 1.000000 ECU_ADDRESS 0xFD7A BIT_MASK 0x200 /end MEASUREMENT
/begin MEASUREMENT B_FLKSBSVW " Flankenwechsel an SB oder SV oder WA" UWORD B_TRUE 0 0 0.000000 1.000000 ECU_ADDRESS 0xFD7A BIT_MASK 0x100 /end MEASUREMENT
/begin MEASUREMENT B_FMS " Fett-Mager-Sprung Vorkat-Sonde1" UWORD B_TRUE 0 0 0.000000 1.000000 ECU_ADDRESS 0xFD2E BIT_MASK 0x1 /end MEASUREMENT
/begin MEASUREMENT B_FMSMA " Fett-Mager-Sprung an Master-Bank erkannt" UWORD B_TRUE 0 0 0.000000 1.000000 ECU_ADDRESS 0xFD2E BIT_MASK 0x80 /end MEASUREMENT
/begin MEASUREMENT B_FOFBER " 1 = FOF-Bereich" UWORD B_TRUE 0 0 0.000000 1.000000 ECU_ADDRESS 0xFDBA BIT_MASK 0x800 /end MEASUREMENT
/begin MEASUREMENT B_FOF_AP " FUEL-OFF aktiv" UBYTE B_TRUE 0 0 0.000000 1.000000 ECU_ADDRESS 0xF9A0 BIT_MASK 0x40 /end MEASUREMENT
/begin MEASUREMENT B_FOG " Bedingung Adaption Bereich gesperrt" UBYTE B_TRUE 0 0 0.000000 1.000000 ECU_ADDRESS 0xB25BC BIT_MASK 0x10 /end MEASUREMENT
/begin MEASUREMENT B_FONBER " 1 = FON-Bereich" UWORD B_TRUE 0 0 0.000000 1.000000 ECU_ADDRESS 0xFDBC BIT_MASK 0x2000 /end MEASUREMENT
/begin MEASUREMENT B_FONOR " Bedingung Adaption Bereich ganz normal" UBYTE B_TRUE 0 0 0.000000 1.000000 ECU_ADDRESS 0xB25BC BIT_MASK 0x1 /end MEASUREMENT
/begin MEASUREMENT B_FON_AP " FUEL-ON aktiv" UBYTE B_TRUE 0 0 0.000000 1.000000 ECU_ADDRESS 0xF9A0 BIT_MASK 0x1 /end MEASUREMENT
/begin MEASUREMENT B_FORDO_AP " dominanter Bereich Ready" UBYTE B_TRUE 0 0 0.000000 1.000000 ECU_ADDRESS 0xF9A7 BIT_MASK 0x20 /end MEASUREMENT
/begin MEASUREMENT B_FORNNN " Bedingung fuel-on Adaption im akt. n-Bereichen eingeschwungen" UWORD B_TRUE 0 0 0.000000 1.000000 ECU_ADDRESS 0xFDBC BIT_MASK 0x2 /end MEASUREMENT
/begin MEASUREMENT B_FORN_AP " n-Bereich Bereich Ready" UBYTE B_TRUE 0 0 0.000000 1.000000 ECU_ADDRESS 0xF9A7 BIT_MASK 0x40 /end MEASUREMENT
/begin MEASUREMENT B_FORXX " Bedingung fuel-on Adaption im akt. n/tl-Bereich eingeschwungen" UWORD B_TRUE 0 0 0.000000 1.000000 ECU_ADDRESS 0xFDBC BIT_MASK 0x4 /end MEASUREMENT
/begin MEASUREMENT B_FOR_AP " Bereich Ready" UBYTE B_TRUE 0 0 0.000000 1.000000 ECU_ADDRESS 0xF9A7 BIT_MASK 0x10 /end MEASUREMENT
/begin MEASUREMENT B_FRMAX1 " 1 = Lambdaregler B1 am oberen Anschlag" UWORD B_TRUE 0 0 0.000000 1.000000 ECU_ADDRESS 0xFD2C BIT_MASK 0x40 /end MEASUREMENT
/begin MEASUREMENT B_FRMAX2 " 1 = Lambdaregler B2 am oberen Anschlag" UWORD B_TRUE 0 0 0.000000 1.000000 ECU_ADDRESS 0xFD2C BIT_MASK 0x80 /end MEASUREMENT
/begin MEASUREMENT B_FRMIN1 " 1 = Lambdaregler B1 am unteren Anschlag" UWORD B_TRUE 0 0 0.000000 1.000000 ECU_ADDRESS 0xFD2C BIT_MASK 0x10 /end MEASUREMENT
/begin MEASUREMENT B_FRMIN2 " 1 = Lambdaregler B2 am unteren Anschlag" UWORD B_TRUE 0 0 0.000000 1.000000 ECU_ADDRESS 0xFD2C BIT_MASK 0x20 /end MEASUREMENT
/begin MEASUREMENT B_FR_RED " Freigabe Reduzierstufen aus ext.Eingriff" UWORD B_TRUE 0 0 0.000000 1.000000 ECU_ADDRESS 0xFDB2 BIT_MASK 0x1000 /end MEASUREMENT
/begin MEASUREMENT B_FW_NUL " Zuendwinkelveraenderung durch MSR ist freigegeben" UWORD B_TRUE 0 0 0.000000 1.000000 ECU_ADDRESS 0xFDB8 BIT_MASK 0x100 /end MEASUREMENT
/begin MEASUREMENT B_GANGHALT " '1'= Gang halten an EGS (SA_B)" UWORD B_TRUE 0 0 0.000000 1.000000 ECU_ADDRESS 0xFD0A BIT_MASK 0x8000 /end MEASUREMENT
/begin MEASUREMENT B_GASE "> 1 = Gemischadaption eingeschwungen" UWORD B_TRUE 0 0 0.000000 1.000000 ECU_ADDRESS 0xFD0E BIT_MASK 0x8 /end MEASUREMENT
/begin MEASUREMENT B_GGTFM_HL " Ausloesung Drive-Recorder Messung " UWORD B_TRUE 0 0 0.000000 1.000000 ECU_ADDRESS 0xFD92 BIT_MASK 0x20 /end MEASUREMENT
/begin MEASUREMENT B_GPA " GasPedalActive" UWORD B_TRUE 0 0 0.000000 1.000000 ECU_ADDRESS 0xFD6E BIT_MASK 0x40 /end MEASUREMENT
/begin MEASUREMENT B_GROUPESP " Gruppeneinspritzung aktiv" UWORD B_TRUE 0 0 0.000000 1.000000 ECU_ADDRESS 0xFDD8 BIT_MASK 0x80 /end MEASUREMENT
/begin MEASUREMENT B_HBRK " 1 = Handbremse gezogen (Info ueber Body-Computer)" UWORD B_TRUE 0 0 0.000000 1.000000 ECU_ADDRESS 0xFD7C BIT_MASK 0x2000 /end MEASUREMENT
/begin MEASUREMENT B_HELP11 " b_teslash(i-1)" UWORD B_TRUE 0 0 0.000000 1.000000 ECU_ADDRESS 0xFD3A BIT_MASK 0x1 /end MEASUREMENT
/begin MEASUREMENT B_HELP12 " b_teslash2(i-1)" UWORD B_TRUE 0 0 0.000000 1.000000 ECU_ADDRESS 0xFD3A BIT_MASK 0x4 /end MEASUREMENT
/begin MEASUREMENT B_HELP3 " fuer Freigabe Schwingungspruefung" UWORD B_TRUE 0 0 0.000000 1.000000 ECU_ADDRESS 0xFD3A BIT_MASK 0x8 /end MEASUREMENT
/begin MEASUREMENT B_HELP41 " b_enfmst1(i-1)" UWORD B_TRUE 0 0 0.000000 1.000000 ECU_ADDRESS 0xFD3A BIT_MASK 0x40 /end MEASUREMENT
/begin MEASUREMENT B_HELP42 " b_enfmst1(i-1)" UWORD B_TRUE 0 0 0.000000 1.000000 ECU_ADDRESS 0xFD3A BIT_MASK 0x80 /end MEASUREMENT
/begin MEASUREMENT B_HELP51 " b_steigm1(i-1)" UWORD B_TRUE 0 0 0.000000 1.000000 ECU_ADDRESS 0xFD3A BIT_MASK 0x10 /end MEASUREMENT
/begin MEASUREMENT B_HELP52 " b_steigm2(i-1)" UWORD B_TRUE 0 0 0.000000 1.000000 ECU_ADDRESS 0xFD3A BIT_MASK 0x20 /end MEASUREMENT
/begin MEASUREMENT B_HELP61 " pos. Flanke von" UWORD B_TRUE 0 0 0.000000 1.000000 ECU_ADDRESS 0xFD3A BIT_MASK 0x2000 /end MEASUREMENT
/begin MEASUREMENT B_HELP62 " TRIPFASH && b_dshk && b_fash" UWORD B_TRUE 0 0 0.000000 1.000000 ECU_ADDRESS 0xFD3A BIT_MASK 0x4000 /end MEASUREMENT
/begin MEASUREMENT B_HSOKH1 " Sondenheizung 1 hinten OK" UWORD B_TRUE 0 0 0.000000 1.000000 ECU_ADDRESS 0xFD56 BIT_MASK 0x20 /end MEASUREMENT
/begin MEASUREMENT B_HSOKV1 " Sondenheizung 1 vorn OK" UWORD B_TRUE 0 0 0.000000 1.000000 ECU_ADDRESS 0xFD56 BIT_MASK 0x8 /end MEASUREMENT
/begin MEASUREMENT B_INJEN "> Injection-Anforderung erlaubt" UWORD B_TRUE 0 0 0.000000 1.000000 ECU_ADDRESS 0xFD64 BIT_MASK 0x10 /end MEASUREMENT
/begin MEASUREMENT B_IP_GESEN " 1 = DK-Anschlaege wurden SR mitgeteilt" UWORD B_TRUE 0 0 0.000000 1.000000 ECU_ADDRESS 0xFD64 BIT_MASK 0x800 /end MEASUREMENT
/begin MEASUREMENT B_I_SKA_IN " irrev. Sicherheitskraftstoffabschaltung (Info)" UWORD B_TRUE 0 0 0.000000 1.000000 ECU_ADDRESS 0xFD66 BIT_MASK 0x10 /end MEASUREMENT
/begin MEASUREMENT B_I_SKA_UC " irrev. Fehlerbit BT" UWORD B_TRUE 0 0 0.000000 1.000000 ECU_ADDRESS 0xFDF0 BIT_MASK 0x200 /end MEASUREMENT
/begin MEASUREMENT B_KATHRDY " Ausloesung Drive-Recorder Messung " UBYTE B_TRUE 0 0 0.000000 1.000000 ECU_ADDRESS 0xB2253 BIT_MASK 0x2 /end MEASUREMENT
/begin MEASUREMENT B_KKRDY " Ausloesung Drive-Recorder Messung " UBYTE B_TRUE 0 0 0.000000 1.000000 ECU_ADDRESS 0xB2253 BIT_MASK 0x10 /end MEASUREMENT
/begin MEASUREMENT B_KLCHA "1 = Klimawechsel" UWORD B_TRUE 0 0 0.000000 1.000000 ECU_ADDRESS 0xFD1C BIT_MASK 0x800 /end MEASUREMENT
/begin MEASUREMENT B_KLME2 "> Klopfmeldung 2. Bedingung" UWORD B_TRUE 0 0 0.000000 1.000000 ECU_ADDRESS 0xFD60 BIT_MASK 0x40 /end MEASUREMENT
/begin MEASUREMENT B_KLMEAN "> Mindestens ein wkr > 0" UWORD B_TRUE 0 0 0.000000 1.000000 ECU_ADDRESS 0xFD60 BIT_MASK 0x80 /end MEASUREMENT
/begin MEASUREMENT B_KOE_ALT "1 = Klima-Zustand" UWORD B_TRUE 0 0 0.000000 1.000000 ECU_ADDRESS 0xFD1C BIT_MASK 0x400 /end MEASUREMENT
/begin MEASUREMENT B_KOSEP " 1= Endstufe-Ansteuerung KOS erfolgt" UWORD B_TRUE 0 0 0.000000 1.000000 ECU_ADDRESS 0xFD90 BIT_MASK 0x2 /end MEASUREMENT
/begin MEASUREMENT B_KOSTEMP " Temp. Abschaltschwelle fuer Klimaanlage" UWORD B_TRUE 0 0 0.000000 1.000000 ECU_ADDRESS 0xFDDC BIT_MASK 0x4 /end MEASUREMENT
/begin MEASUREMENT B_KOS_SR1 " 1 = Flip-Flop in KOS gesetzt" UWORD B_TRUE 0 0 0.000000 1.000000 ECU_ADDRESS 0xFD04 BIT_MASK 0x80 /end MEASUREMENT
/begin MEASUREMENT B_KR1_0 "> B_kr 1-0 Flankenerk" UWORD B_TRUE 0 0 0.000000 1.000000 ECU_ADDRESS 0xFD60 BIT_MASK 0x4 /end MEASUREMENT
/begin MEASUREMENT B_KRABW "> KRA - Bereichswechsel erkannt" UWORD B_TRUE 0 0 0.000000 1.000000 ECU_ADDRESS 0xFD60 BIT_MASK 0x200 /end MEASUREMENT
/begin MEASUREMENT B_KRHI "> Hilfsbit f. B_kr Flankenerk." UWORD B_TRUE 0 0 0.000000 1.000000 ECU_ADDRESS 0xFD60 BIT_MASK 0x2 /end MEASUREMENT
/begin MEASUREMENT B_KRHWENA " 1 = DKRHW enable" UWORD B_TRUE 0 0 0.000000 1.000000 ECU_ADDRESS 0xFD0E BIT_MASK 0x1000 /end MEASUREMENT
/begin MEASUREMENT B_KRLDYAMK " 1 = Dynamische KR aktiv" UWORD B_TRUE 0 0 0.000000 1.000000 ECU_ADDRESS 0xFD98 BIT_MASK 0x4 /end MEASUREMENT
/begin MEASUREMENT B_KRLDY_M " Merker von B_KRLDY fuer Zeitabregelung DYVT" UWORD B_TRUE 0 0 0.000000 1.000000 ECU_ADDRESS 0xFD98 BIT_MASK 0x80 /end MEASUREMENT
/begin MEASUREMENT B_KRNDY_M " 1 = Merker von B_KRNDY wegen Lastdynamikvorrang" UWORD B_TRUE 0 0 0.000000 1.000000 ECU_ADDRESS 0xFD98 BIT_MASK 0x40 /end MEASUREMENT
/begin MEASUREMENT B_KRTEON " 1 = HW-Test des KR-IC aktiv" UWORD B_TRUE 0 0 0.000000 1.000000 ECU_ADDRESS 0xFD0E BIT_MASK 0x400 /end MEASUREMENT
/begin MEASUREMENT B_KRTEST " 1 = T_krtest-MF enable" UWORD B_TRUE 0 0 0.000000 1.000000 ECU_ADDRESS 0xFD0E BIT_MASK 0x800 /end MEASUREMENT
/begin MEASUREMENT B_KUEBE " Wandlerkupplung schliessend" UWORD B_TRUE 0 0 0.000000 1.000000 ECU_ADDRESS 0xFDBE BIT_MASK 0x4000 /end MEASUREMENT
/begin MEASUREMENT B_KUEBG " Wandlerkupplung geschlossen" UWORD B_TRUE 0 0 0.000000 1.000000 ECU_ADDRESS 0xFDBE BIT_MASK 0x200 /end MEASUREMENT
/begin MEASUREMENT B_KUEBO " Wandlerkupplung offen" UWORD B_TRUE 0 0 0.000000 1.000000 ECU_ADDRESS 0xFDBE BIT_MASK 0x100 /end MEASUREMENT
/begin MEASUREMENT B_KUEBS " Wandlerkupplung schleifend" UWORD B_TRUE 0 0 0.000000 1.000000 ECU_ADDRESS 0xFDBE BIT_MASK 0x400 /end MEASUREMENT
/begin MEASUREMENT B_KUPCHSP " B_KUPCHA 0->1 fuer 500ms" UWORD B_TRUE 0 0 0.000000 1.000000 ECU_ADDRESS 0xFD20 BIT_MASK 0x100 /end MEASUREMENT
/begin MEASUREMENT B_KUPDMD " Merker fuer B_KUPSTAT fuer DMD-Stopbdg." UWORD B_TRUE 0 0 0.000000 1.000000 ECU_ADDRESS 0xFDC0 BIT_MASK 0x4000 /end MEASUREMENT
/begin MEASUREMENT B_KUPWDMD " Kupplungswechsel fuer DMD-Stopbdg. erkannt" UWORD B_TRUE 0 0 0.000000 1.000000 ECU_ADDRESS 0xFDC0 BIT_MASK 0x8000 /end MEASUREMENT
/begin MEASUREMENT B_KUP_FGR " alter Wert v. B_KUP fuer Flankenwechsel in FGR" UWORD B_TRUE 0 0 0.000000 1.000000 ECU_ADDRESS 0xFD7A BIT_MASK 0x400 /end MEASUREMENT
/begin MEASUREMENT B_KUP_TVSA " 1 = Umschaltung auf TVSAKUPN erfolgt" UWORD B_TRUE 0 0 0.000000 1.000000 ECU_ADDRESS 0xFDAA BIT_MASK 0x100 /end MEASUREMENT
/begin MEASUREMENT B_KWPINI_R " '1'= Initialisierung für KWP2000 kann nun erfoolgen" UWORD B_TRUE 0 0 0.000000 1.000000 ECU_ADDRESS 0xFD6A BIT_MASK 0x8000 /end MEASUREMENT
/begin MEASUREMENT B_K_LINE " Zwischenspeicher fuer K-Ltg. aktiv" UWORD B_TRUE 0 0 0.000000 1.000000 ECU_ADDRESS 0xFDD4 BIT_MASK 0x800 /end MEASUREMENT
/begin MEASUREMENT B_LDR50MS " > 1= 50ms-Raster" UWORD B_TRUE 0 0 0.000000 1.000000 ECU_ADDRESS 0xFDA2 BIT_MASK 0x1 /end MEASUREMENT
/begin MEASUREMENT B_LDREP " 1= Endstufe-Ansteuerung LDR erfolgt" UWORD B_TRUE 0 0 0.000000 1.000000 ECU_ADDRESS 0xFD90 BIT_MASK 0x2000 /end MEASUREMENT
/begin MEASUREMENT B_LHI " 1 = Eingriff Lenkhilfe" UWORD B_TRUE 0 0 0.000000 1.000000 ECU_ADDRESS 0xFD9E BIT_MASK 0x40 /end MEASUREMENT
/begin MEASUREMENT B_LHIALT " 1 = Eingriff Lenkhilfe (alter Wert)" UWORD B_TRUE 0 0 0.000000 1.000000 ECU_ADDRESS 0xFD9E BIT_MASK 0x80 /end MEASUREMENT
/begin MEASUREMENT B_LHICH " 1 = Zustandswechsel LHI Eingriff" UWORD B_TRUE 0 0 0.000000 1.000000 ECU_ADDRESS 0xFD9E BIT_MASK 0x100 /end MEASUREMENT
/begin MEASUREMENT B_LLCHA "1 = Lastwechsel" UWORD B_TRUE 0 0 0.000000 1.000000 ECU_ADDRESS 0xFD1C BIT_MASK 0x4000 /end MEASUREMENT
/begin MEASUREMENT B_LLKUP " 1 = Zuendwinkeleingriff bei Leerlauf mit getretender Kupplung" UWORD B_TRUE 0 0 0.000000 1.000000 ECU_ADDRESS 0xFD14 BIT_MASK 0x1 /end MEASUREMENT
/begin MEASUREMENT B_LLLAST " 1 = Leerlauf zum Zeitp.j-1" UWORD B_TRUE 0 0 0.000000 1.000000 ECU_ADDRESS 0xFD0C BIT_MASK 0x4000 /end MEASUREMENT
/begin MEASUREMENT B_LL_ARMK " B_ll merken fuer 1->0 Uebergang" UWORD B_TRUE 0 0 0.000000 1.000000 ECU_ADDRESS 0xFD66 BIT_MASK 0x800 /end MEASUREMENT
/begin MEASUREMENT B_LL_DLY " Verzoegertes B_LL bei Uebergang von TL -> LL" UWORD B_TRUE 0 0 0.000000 1.000000 ECU_ADDRESS 0xFD2A BIT_MASK 0x1 /end MEASUREMENT
/begin MEASUREMENT B_LRHKP1 "1 = LRHK-P-Anteil B1 aktiv" UWORD B_TRUE 0 0 0.000000 1.000000 ECU_ADDRESS 0xFD30 BIT_MASK 0x4 /end MEASUREMENT
/begin MEASUREMENT B_LRHKP2 "1 = LRHK-P-Anteil B2 aktiv" UWORD B_TRUE 0 0 0.000000 1.000000 ECU_ADDRESS 0xFD30 BIT_MASK 0x8 /end MEASUREMENT
/begin MEASUREMENT B_LRKAA "> 1 = Katausraeumfkt. aktiv Automatausgang" UWORD B_TRUE 0 0 0.000000 1.000000 ECU_ADDRESS 0xFD32 BIT_MASK 0x1 /end MEASUREMENT
/begin MEASUREMENT B_LRKAALT "> 1 = Hilfsbit zur TP-Initialisierung Bank1" UWORD B_TRUE 0 0 0.000000 1.000000 ECU_ADDRESS 0xFD30 BIT_MASK 0x40 /end MEASUREMENT
/begin MEASUREMENT B_LRMA " LR-Regelung an Master-Bank vor Kat aktiv" UWORD B_TRUE 0 0 0.000000 1.000000 ECU_ADDRESS 0xFD2E BIT_MASK 0x2000 /end MEASUREMENT
/begin MEASUREMENT B_LRNSAV " 1 = Lernwert-UANL erfolgreich im EEPROM abgespeichert" UWORD B_TRUE 0 0 0.000000 1.000000 ECU_ADDRESS 0xFD20 BIT_MASK 0x800 /end MEASUREMENT
/begin MEASUREMENT B_LRNSAV_B " 1 = Lernwerte im EEPROM abgespeichert" UBYTE B_TRUE 0 0 0.000000 1.000000 ECU_ADDRESS 0xB2E46 BIT_MASK 0x2 /end MEASUREMENT
/begin MEASUREMENT B_LRNWS_B " 1 = Lernwert-Speicherung des unteren Anschlags" UBYTE B_TRUE 0 0 0.000000 1.000000 ECU_ADDRESS 0xB2E46 BIT_MASK 0x4 /end MEASUREMENT
/begin MEASUREMENT B_LRSP " Sprung Vorkat-Sonde1" UWORD B_TRUE 0 0 0.000000 1.000000 ECU_ADDRESS 0xFD2E BIT_MASK 0x4 /end MEASUREMENT
/begin MEASUREMENT B_LRSYALT " Funktionsbit: alter Wert abspeichern" UWORD B_TRUE 0 0 0.000000 1.000000 ECU_ADDRESS 0xB089A BIT_MASK 0x4 /end MEASUREMENT
/begin MEASUREMENT B_LRSYIA " Merker fuer b_lrsyni 10ms-alt" UWORD B_TRUE 0 0 0.000000 1.000000 ECU_ADDRESS 0xFD2E BIT_MASK 0x1000 /end MEASUREMENT
/begin MEASUREMENT B_LRSY_FL " Funktionsbit: Flanke b_lrsync" UWORD B_TRUE 0 0 0.000000 1.000000 ECU_ADDRESS 0xB089A BIT_MASK 0x2 /end MEASUREMENT
/begin MEASUREMENT B_LRSY_HL " Funktionsbit: high-low-Flanke erkannt" UWORD B_TRUE 0 0 0.000000 1.000000 ECU_ADDRESS 0xB089A BIT_MASK 0x8 /end MEASUREMENT
/begin MEASUREMENT B_LRSY_LH " Funktionsbit: low_high-Flanke erkannt" UWORD B_TRUE 0 0 0.000000 1.000000 ECU_ADDRESS 0xB089A BIT_MASK 0x10 /end MEASUREMENT
/begin MEASUREMENT B_LSAFKN "> 1 = LS1 ausserhalb Fenster, kein Nebenschl" UWORD B_TRUE 0 0 0.000000 1.000000 ECU_ADDRESS 0xFDF6 BIT_MASK 0x4 /end MEASUREMENT
/begin MEASUREMENT B_LSAFKN1 "> 1 = LS1 ausserhalb Fenster, kein Nebenschl" UWORD B_TRUE 0 0 0.000000 1.000000 ECU_ADDRESS 0xFDF6 BIT_MASK 0x4 /end MEASUREMENT
/begin MEASUREMENT B_LSASTP_I " Hilfsvariable" UWORD B_TRUE 0 0 0.000000 1.000000 ECU_ADDRESS 0xFD36 BIT_MASK 0x4 /end MEASUREMENT
/begin MEASUREMENT B_LSDGETR " Handschalter oder Automat im Tip-Modus fuer FVDPLSD" UWORD B_TRUE 0 0 0.000000 1.000000 ECU_ADDRESS 0xFD8A BIT_MASK 0x400 /end MEASUREMENT
/begin MEASUREMENT B_LSHHKEP " 1= Endstufe-Ansteuerung LSHHK erfolgt" UWORD B_TRUE 0 0 0.000000 1.000000 ECU_ADDRESS 0xFD90 BIT_MASK 0x10 /end MEASUREMENT
/begin MEASUREMENT B_LSHVKEP " 1= Endstufe-Ansteuerung LSHVK erfolgt" UWORD B_TRUE 0 0 0.000000 1.000000 ECU_ADDRESS 0xFD90 BIT_MASK 0x20 /end MEASUREMENT
/begin MEASUREMENT B_LSPVS1 " 1 = LAS-Potentialversatz Bank 1" UWORD B_TRUE 0 0 0.000000 1.000000 ECU_ADDRESS 0xFDF6 BIT_MASK 0x40 /end MEASUREMENT
/begin MEASUREMENT B_LSVFB " 1 = (b_ttbmh | ~b_lsvn)" UWORD B_TRUE 0 0 0.000000 1.000000 ECU_ADDRESS 0xB084E BIT_MASK 0x80 /end MEASUREMENT
/begin MEASUREMENT B_LSVFB2 " Ausloesung Drive-Recorder Messung " UWORD B_TRUE 0 0 0.000000 1.000000 ECU_ADDRESS 0xB0850 BIT_MASK 0x80 /end MEASUREMENT
/begin MEASUREMENT B_LSVKLTN " 1 = temp. Pos. f. B-lsvklt-Neuber, u. Flankenerk." UWORD B_TRUE 0 0 0.000000 1.000000 ECU_ADDRESS 0xB084E BIT_MASK 0x100 /end MEASUREMENT
/begin MEASUREMENT B_LSVKLTN2 " Ausloesung Drive-Recorder Messung " UWORD B_TRUE 0 0 0.000000 1.000000 ECU_ADDRESS 0xB0850 BIT_MASK 0x100 /end MEASUREMENT
/begin MEASUREMENT B_LUAERKV " vormerken: B_LUAERKV" UWORD B_TRUE 0 0 0.000000 1.000000 ECU_ADDRESS 0xFDBA BIT_MASK 0x4 /end MEASUREMENT
/begin MEASUREMENT B_LUAERK_A " Aussetzer aus DMDLUA" UBYTE B_TRUE 0 0 0.000000 1.000000 ECU_ADDRESS 0xF9A7 BIT_MASK 0x2 /end MEASUREMENT
/begin MEASUREMENT B_LUAREQ " anfordern: B_LUAREQ" UWORD B_TRUE 0 0 0.000000 1.000000 ECU_ADDRESS 0xFDBE BIT_MASK 0x8 /end MEASUREMENT
/begin MEASUREMENT B_LUECKDAS " Fuer DASE verzoegertes B_LUECKE" UWORD B_TRUE 0 0 0.000000 1.000000 ECU_ADDRESS 0xFDBE BIT_MASK 0x2 /end MEASUREMENT
/begin MEASUREMENT B_LUECKE " 1 = in diesem Segment tritt die Zahnluecke auf" UWORD B_TRUE 0 0 0.000000 1.000000 ECU_ADDRESS 0xFD0C BIT_MASK 0x100 /end MEASUREMENT
/begin MEASUREMENT B_LUECKE2 " Luecke ohne Phase" UWORD B_TRUE 0 0 0.000000 1.000000 ECU_ADDRESS 0xFD10 BIT_MASK 0x8000 /end MEASUREMENT
/begin MEASUREMENT B_LUECKE_N " 1 = Synchro-Raster nach der Luecke" UWORD B_TRUE 0 0 0.000000 1.000000 ECU_ADDRESS 0xFD2A BIT_MASK 0x800 /end MEASUREMENT
/begin MEASUREMENT B_LUEFTER_ " Nachlauf darf aus Lueftersicht beendet werden." UWORD B_TRUE 0 0 0.000000 1.000000 ECU_ADDRESS 0xFD92 BIT_MASK 0x80 /end MEASUREMENT
/begin MEASUREMENT B_LUERKV " vormerken: B_LUERKV" UWORD B_TRUE 0 0 0.000000 1.000000 ECU_ADDRESS 0xFDBA BIT_MASK 0x10 /end MEASUREMENT
/begin MEASUREMENT B_LUERK_AP " Aussetzer erkannt" UBYTE B_TRUE 0 0 0.000000 1.000000 ECU_ADDRESS 0xF9A0 BIT_MASK 0x4 /end MEASUREMENT
/begin MEASUREMENT B_LUES1EP " 1= Endstufe-Ansteuerung LUES1 erfolgt" UWORD B_TRUE 0 0 0.000000 1.000000 ECU_ADDRESS 0xFD90 BIT_MASK 0x80 /end MEASUREMENT
/begin MEASUREMENT B_LUES2EP " 1= Endstufe-Ansteuerung LUES2 erfolgt" UWORD B_TRUE 0 0 0.000000 1.000000 ECU_ADDRESS 0xFD90 BIT_MASK 0x100 /end MEASUREMENT
/begin MEASUREMENT B_LUREQ " anfordern: B_LUREQ" UWORD B_TRUE 0 0 0.000000 1.000000 ECU_ADDRESS 0xFDBE BIT_MASK 0x20 /end MEASUREMENT
/begin MEASUREMENT B_LUTINI " 1 = DASE noch in INIT wegen zu wenig Segmentzeiten" UWORD B_TRUE 0 0 0.000000 1.000000 ECU_ADDRESS 0xFDBE BIT_MASK 0x1 /end MEASUREMENT
/begin MEASUREMENT B_MAIN1 " Zwischenbit 1 nur in MAIN-Sektion verwenden" UWORD B_TRUE 0 0 0.000000 1.000000 ECU_ADDRESS 0xFDC6 BIT_MASK 0x1 /end MEASUREMENT
/begin MEASUREMENT B_MAIN2 " Zwischenbit 2 nur in MAIN-Sektion verwenden" UWORD B_TRUE 0 0 0.000000 1.000000 ECU_ADDRESS 0xFDC6 BIT_MASK 0x2 /end MEASUREMENT
/begin MEASUREMENT B_MAIN3 " Zwischenbit 3 nur in MAIN-Sektion verwenden" UWORD B_TRUE 0 0 0.000000 1.000000 ECU_ADDRESS 0xFDC6 BIT_MASK 0x4 /end MEASUREMENT
/begin MEASUREMENT B_MAIN4 " Zwischenbit 4 nur in MAIN-Sektion verwenden" UWORD B_TRUE 0 0 0.000000 1.000000 ECU_ADDRESS 0xFDC6 BIT_MASK 0x8 /end MEASUREMENT
/begin MEASUREMENT B_MAIN5 " Zwischenbit 5 nur in MAIN-Sektion verwenden" UWORD B_TRUE 0 0 0.000000 1.000000 ECU_ADDRESS 0xFDC6 BIT_MASK 0x10 /end MEASUREMENT
/begin MEASUREMENT B_MAIN6 " Zwischenbit 6 nur in MAIN-Sektion verwenden" UWORD B_TRUE 0 0 0.000000 1.000000 ECU_ADDRESS 0xFDC6 BIT_MASK 0x20 /end MEASUREMENT
/begin MEASUREMENT B_MAIN7 " Zwischenbit 7 nur in MAIN-Sektion verwenden" UWORD B_TRUE 0 0 0.000000 1.000000 ECU_ADDRESS 0xFDC6 BIT_MASK 0x40 /end MEASUREMENT
/begin MEASUREMENT B_MAIN8 " Zwischenbit 8 nur in MAIN-Sektion verwenden" UWORD B_TRUE 0 0 0.000000 1.000000 ECU_ADDRESS 0xFDC6 BIT_MASK 0x80 /end MEASUREMENT
/begin MEASUREMENT B_MAS " Motronic alive Signal fuer Selespeed (alternierend)" UWORD B_TRUE 0 0 0.000000 1.000000 ECU_ADDRESS 0xFD60 BIT_MASK 0x1000 /end MEASUREMENT
/begin MEASUREMENT B_MAXAT "Getriebeschutz: Einspritzausblendung aktiv" UWORD B_TRUE 0 0 0.000000 1.000000 ECU_ADDRESS 0xFDB2 BIT_MASK 0x1 /end MEASUREMENT
/begin MEASUREMENT B_MAXATV " Getriebeschutz (CAN-Fehler): Einspritzausblendung aktiv" UWORD B_TRUE 0 0 0.000000 1.000000 ECU_ADDRESS 0xFDB2 BIT_MASK 0x2 /end MEASUREMENT
/begin MEASUREMENT B_MAXF " 1 = b_mxlsv vor b_dsven vKat" UWORD B_TRUE 0 0 0.000000 1.000000 ECU_ADDRESS 0xB084E BIT_MASK 0x2 /end MEASUREMENT
/begin MEASUREMENT B_MAXF2 " Benennung siehe Bank1" UWORD B_TRUE 0 0 0.000000 1.000000 ECU_ADDRESS 0xB0850 BIT_MASK 0x2 /end MEASUREMENT
/begin MEASUREMENT B_MAXFH1 " 1 = b_mxlsh vor b_dshen hKat" UWORD B_TRUE 0 0 0.000000 1.000000 ECU_ADDRESS 0xB086A BIT_MASK 0x2 /end MEASUREMENT
/begin MEASUREMENT B_MAXFH2 " 1 = b_mxlsh vor b_dshen hKat" UWORD B_TRUE 0 0 0.000000 1.000000 ECU_ADDRESS 0xB086C BIT_MASK 0x2 /end MEASUREMENT
/begin MEASUREMENT B_MCMESS_V " '1'= Einstieg ins McMess über KWP2000 noch nicht erfolgt" UWORD B_TRUE 0 0 0.000000 1.000000 ECU_ADDRESS 0xFD6A BIT_MASK 0x4000 /end MEASUREMENT
/begin MEASUREMENT B_MDCLRE " MD-Fehler in Init. loeschen (DMDMIL)" UWORD B_TRUE 0 0 0.000000 1.000000 ECU_ADDRESS 0xFDF6 BIT_MASK 0x1000 /end MEASUREMENT
/begin MEASUREMENT B_MDERK_AP " Allgemeiner Aussetzer erkannt" UBYTE B_TRUE 0 0 0.000000 1.000000 ECU_ADDRESS 0xF9A0 BIT_MASK 0x8 /end MEASUREMENT
/begin MEASUREMENT B_MDERR " 1 = DASE ausgeblendet wg. Fehlern anderer Funktionen" UWORD B_TRUE 0 0 0.000000 1.000000 ECU_ADDRESS 0xFDBC BIT_MASK 0x1000 /end MEASUREMENT
/begin MEASUREMENT B_MDSOV_AP " Segmentzeit-Overflow" UBYTE B_TRUE 0 0 0.000000 1.000000 ECU_ADDRESS 0xF9A0 BIT_MASK 0x20 /end MEASUREMENT
/begin MEASUREMENT B_MDSTIM_A " Stimulisignal" UBYTE B_TRUE 0 0 0.000000 1.000000 ECU_ADDRESS 0xF9A0 BIT_MASK 0x2 /end MEASUREMENT
/begin MEASUREMENT B_MDSTOP_A " LU-Berechnung gesperrt" UBYTE B_TRUE 0 0 0.000000 1.000000 ECU_ADDRESS 0xF9A0 BIT_MASK 0x80 /end MEASUREMENT
/begin MEASUREMENT B_MDUP_NCA " NCA Drehmomentanhebung Active" UWORD B_TRUE 0 0 0.000000 1.000000 ECU_ADDRESS 0xFDB6 BIT_MASK 0x4 /end MEASUREMENT
/begin MEASUREMENT B_MDZYL1_A " Zylinder 1 Kennung" UBYTE B_TRUE 0 0 0.000000 1.000000 ECU_ADDRESS 0xF9A0 BIT_MASK 0x10 /end MEASUREMENT
/begin MEASUREMENT B_MESSTOUT " 1 = Kein McMess Timeout" UWORD B_TRUE 0 0 0.000000 1.000000 ECU_ADDRESS 0xFD28 BIT_MASK 0x10 /end MEASUREMENT
/begin MEASUREMENT B_MESS_SYN " 1 = Synchromessen aktiv" UWORD B_TRUE 0 0 0.000000 1.000000 ECU_ADDRESS 0xFD28 BIT_MASK 0x1000 /end MEASUREMENT
/begin MEASUREMENT B_MFBLMP " 1 = Restzeitausgabe Messfensteranf. fuer Segm m Luecke (akt Phase)" UWORD B_TRUE 0 0 0.000000 1.000000 ECU_ADDRESS 0xFD14 BIT_MASK 0x20 /end MEASUREMENT
/begin MEASUREMENT B_MFBLOP " 1 = Restzeitausg Messfensteranf f Seg m Luecke (ina Ph)" UWORD B_TRUE 0 0 0.000000 1.000000 ECU_ADDRESS 0xFD24 BIT_MASK 0x400 /end MEASUREMENT
/begin MEASUREMENT B_MFDLMP " 1 = Restzeitausgabe Messfensterende fuer Segm m Luecke (akt Phase)" UWORD B_TRUE 0 0 0.000000 1.000000 ECU_ADDRESS 0xFD14 BIT_MASK 0x40 /end MEASUREMENT
/begin MEASUREMENT B_MFDLOP " 1 = Restzeitausg Messfensterend f Seg m Luecke (ina Ph)" UWORD B_TRUE 0 0 0.000000 1.000000 ECU_ADDRESS 0xFD24 BIT_MASK 0x800 /end MEASUREMENT
/begin MEASUREMENT B_MFDSP " Zwischenspeicherwert fuer B_MFD" UWORD B_TRUE 0 0 0.000000 1.000000 ECU_ADDRESS 0xFD24 BIT_MASK 0x1000 /end MEASUREMENT
/begin MEASUREMENT B_MFS " Mager-Fett-Sprung Vorkat-Sonde1" UWORD B_TRUE 0 0 0.000000 1.000000 ECU_ADDRESS 0xFD2E BIT_MASK 0x2 /end MEASUREMENT
/begin MEASUREMENT B_MFSMA " Mager-Fett-Sprung an Master-Bank erkannt" UWORD B_TRUE 0 0 0.000000 1.000000 ECU_ADDRESS 0xFD2E BIT_MASK 0x40 /end MEASUREMENT
/begin MEASUREMENT B_MLSNLF " Ausloesung Drive-Recorder Messung " UWORD B_TRUE 0 0 0.000000 1.000000 ECU_ADDRESS 0xFD92 BIT_MASK 0x100 /end MEASUREMENT
/begin MEASUREMENT B_MS50 " Funktionsbit: 50 ms Zaehler" UWORD B_TRUE 0 0 0.000000 1.000000 ECU_ADDRESS 0xB089A BIT_MASK 0x1 /end MEASUREMENT
/begin MEASUREMENT B_MSR " 1 = MSr Drehmomentanforderung" UWORD B_TRUE 0 0 0.000000 1.000000 ECU_ADDRESS 0xFDB4 BIT_MASK 0x2 /end MEASUREMENT
/begin MEASUREMENT B_MSRAKTAL " Ausloesung Drive-Recorder Messung " UWORD B_TRUE 0 0 0.000000 1.000000 ECU_ADDRESS 0xFD92 BIT_MASK 0x1000 /end MEASUREMENT
/begin MEASUREMENT B_MSRRMP "1 = Abregelrampe fuer MSR laeuft" UWORD B_TRUE 0 0 0.000000 1.000000 ECU_ADDRESS 0xFD26 BIT_MASK 0x8 /end MEASUREMENT
/begin MEASUREMENT B_MSR_ZW " Zuendwinkelveraenderung durch MSR ist freigegeben" UWORD B_TRUE 0 0 0.000000 1.000000 ECU_ADDRESS 0xFDB8 BIT_MASK 0x80 /end MEASUREMENT
/begin MEASUREMENT B_MSZE1 " Zwischenbit 1 nur in MSZE-Sektion verwenden" UWORD B_TRUE 0 0 0.000000 1.000000 ECU_ADDRESS 0xFDC4 BIT_MASK 0x100 /end MEASUREMENT
/begin MEASUREMENT B_MSZE2 " Zwischenbit 2 nur in MSZE-Sektion verwenden" UWORD B_TRUE 0 0 0.000000 1.000000 ECU_ADDRESS 0xFDC4 BIT_MASK 0x200 /end MEASUREMENT
/begin MEASUREMENT B_MSZE3 " Zwischenbit 3 nur in MSZE-Sektion verwenden" UWORD B_TRUE 0 0 0.000000 1.000000 ECU_ADDRESS 0xFDC4 BIT_MASK 0x400 /end MEASUREMENT
/begin MEASUREMENT B_MSZE4 " Zwischenbit 4 nur in MSZE-Sektion verwenden" UWORD B_TRUE 0 0 0.000000 1.000000 ECU_ADDRESS 0xFDC4 BIT_MASK 0x800 /end MEASUREMENT
/begin MEASUREMENT B_MSZE5 " Zwischenbit 5 nur in MSZE-Sektion verwenden" UWORD B_TRUE 0 0 0.000000 1.000000 ECU_ADDRESS 0xFDC4 BIT_MASK 0x1000 /end MEASUREMENT
/begin MEASUREMENT B_MSZE6 " Zwischenbit 6 nur in MSZE-Sektion verwenden" UWORD B_TRUE 0 0 0.000000 1.000000 ECU_ADDRESS 0xFDC4 BIT_MASK 0x2000 /end MEASUREMENT
/begin MEASUREMENT B_MSZE7 " Zwischenbit 7 nur in MSZE-Sektion verwenden" UWORD B_TRUE 0 0 0.000000 1.000000 ECU_ADDRESS 0xFDC4 BIT_MASK 0x4000 /end MEASUREMENT
/begin MEASUREMENT B_MSZE8 " Zwischenbit 8 nur in MSZE-Sektion verwenden" UWORD B_TRUE 0 0 0.000000 1.000000 ECU_ADDRESS 0xFDC4 BIT_MASK 0x8000 /end MEASUREMENT
/begin MEASUREMENT B_MUTE " CAN Mute" UWORD B_TRUE 0 0 0.000000 1.000000 ECU_ADDRESS 0xFD86 BIT_MASK 0x40 /end MEASUREMENT
/begin MEASUREMENT B_NBAUB "Hilfsbit fuer Spannungsschwelle NBA" UWORD B_TRUE 0 0 0.000000 1.000000 ECU_ADDRESS 0xFD88 BIT_MASK 0x400 /end MEASUREMENT
/begin MEASUREMENT B_NCADNAKT " NCA Drehmomentreduzierung aktiv" UWORD B_TRUE 0 0 0.000000 1.000000 ECU_ADDRESS 0xFDB8 BIT_MASK 0x4 /end MEASUREMENT
/begin MEASUREMENT B_NDDF "> 1 = n-Schwelle NDDFA einmalig ueberschritten" UWORD B_TRUE 0 0 0.000000 1.000000 ECU_ADDRESS 0xFD32 BIT_MASK 0x800 /end MEASUREMENT
/begin MEASUREMENT B_NESCH1 " Ausloesung Drive-Recorder Messung " UWORD B_TRUE 0 0 0.000000 1.000000 ECU_ADDRESS 0xFD3E BIT_MASK 0x20 /end MEASUREMENT
/begin MEASUREMENT B_NFB " 1 = Notluftbetrieb" UWORD B_TRUE 0 0 0.000000 1.000000 ECU_ADDRESS 0xFD04 BIT_MASK 0x800 /end MEASUREMENT
/begin MEASUREMENT B_NKH " 1 = einmalig N ueberschritten fuer Kat-Heizen" UWORD B_TRUE 0 0 0.000000 1.000000 ECU_ADDRESS 0xFD12 BIT_MASK 0x200 /end MEASUREMENT
/begin MEASUREMENT B_NL " 1 = Nachlauf enable" UWORD B_TRUE 0 0 0.000000 1.000000 ECU_ADDRESS 0xFD02 BIT_MASK 0x200 /end MEASUREMENT
/begin MEASUREMENT B_NM1200 "> Drehzahl > NMOT_HI (Achtung Hysterese!!!)" UWORD B_TRUE 0 0 0.000000 1.000000 ECU_ADDRESS 0xFD4E BIT_MASK 0x20 /end MEASUREMENT
/begin MEASUREMENT B_NMIN0ERK " 1 = seit dem letzten Wechsel B_hr = 0->1" UWORD B_TRUE 0 0 0.000000 1.000000 ECU_ADDRESS 0xFD0C BIT_MASK 0x1 /end MEASUREMENT
/begin MEASUREMENT B_NMXSGS " Drehzahlbegrenzung auf Anf. Selespeedgetriebe" UWORD B_TRUE 0 0 0.000000 1.000000 ECU_ADDRESS 0xFDB2 BIT_MASK 0x2000 /end MEASUREMENT
/begin MEASUREMENT B_NOACC_BT " Fuer Erkennung SGS-Verbot in der Ebene 1" UWORD B_TRUE 0 0 0.000000 1.000000 ECU_ADDRESS 0xFDF2 BIT_MASK 0x200 /end MEASUREMENT
/begin MEASUREMENT B_NOACC_UC " Fuer Erkennung SGS in UF nicht uebernommen" UWORD B_TRUE 0 0 0.000000 1.000000 ECU_ADDRESS 0xFDF2 BIT_MASK 0x100 /end MEASUREMENT
/begin MEASUREMENT B_NOBLSDAT "> Bremsinformations-Ausfall" UWORD B_TRUE 0 0 0.000000 1.000000 ECU_ADDRESS 0xFD4E BIT_MASK 0x10 /end MEASUREMENT
/begin MEASUREMENT B_NODRHZ " 1= Motor steht (0= Motor laeuft oder keine Aussage moeglich)" UWORD DEZ 0 0 0.000000 256.000000 ECU_ADDRESS 0xFDAA BIT_MASK 0x40 /end MEASUREMENT
/begin MEASUREMENT B_NOKUP_FR " Kupplung-Verbot" UWORD B_TRUE 0 0 0.000000 1.000000 ECU_ADDRESS 0xFDC6 BIT_MASK 0x2000 /end MEASUREMENT
/begin MEASUREMENT B_NOLASH1 " Ausloesung Drive-Recorder Messung " UWORD B_TRUE 0 0 0.000000 1.000000 ECU_ADDRESS 0xFD3E BIT_MASK 0x40 /end MEASUREMENT
/begin MEASUREMENT B_NOMNBAUC " Botschaftsunterbrechung CAN NBA in BT" UWORD B_TRUE 0 0 0.000000 1.000000 ECU_ADDRESS 0xFDF2 BIT_MASK 0x800 /end MEASUREMENT
/begin MEASUREMENT B_NOMSRTOG "> Toggle-Ausfall" UWORD B_TRUE 0 0 0.000000 1.000000 ECU_ADDRESS 0xFD4E BIT_MASK 0x80 /end MEASUREMENT
/begin MEASUREMENT B_NOMSR_BT " Fuer Erkennung MSR-Verbot in der Ebene 1" UWORD B_TRUE 0 0 0.000000 1.000000 ECU_ADDRESS 0xFDF2 BIT_MASK 0x4 /end MEASUREMENT
/begin MEASUREMENT B_NOMSR_UC " Fuer Erkennung MSR in UF nicht uebernommen" UWORD B_TRUE 0 0 0.000000 1.000000 ECU_ADDRESS 0xFDF2 BIT_MASK 0x2 /end MEASUREMENT
/begin MEASUREMENT B_NOSGS_BT " Fuer Erkennung SGS-Verbot in der Ebene 1" UWORD B_TRUE 0 0 0.000000 1.000000 ECU_ADDRESS 0xFDF2 BIT_MASK 0x20 /end MEASUREMENT
/begin MEASUREMENT B_NOSGS_UC " Fuer Erkennung SGS in UF nicht uebernommen" UWORD B_TRUE 0 0 0.000000 1.000000 ECU_ADDRESS 0xFDF2 BIT_MASK 0x10 /end MEASUREMENT
/begin MEASUREMENT B_NOTLU_IN " Notluft - Fahren (Info)" UWORD B_TRUE 0 0 0.000000 1.000000 ECU_ADDRESS 0xFD66 BIT_MASK 0x8 /end MEASUREMENT
/begin MEASUREMENT B_NOVCAN "1 = keine CAN-Geschwindigkeit" UWORD B_TRUE 0 0 0.000000 1.000000 ECU_ADDRESS 0xFD1E BIT_MASK 0x2000 /end MEASUREMENT
/begin MEASUREMENT B_NOWGEXT " keine Zuendwinkelverstellung" UWORD B_TRUE 0 0 0.000000 1.000000 ECU_ADDRESS 0xFDB8 BIT_MASK 0x200 /end MEASUREMENT
/begin MEASUREMENT B_NO_AC_FR "1 = interner Fehlerzustand(ACC)" UWORD B_TRUE 0 0 0.000000 1.000000 ECU_ADDRESS 0xFD76 BIT_MASK 0x8 /end MEASUREMENT
/begin MEASUREMENT B_NPHSH1 " Sondenheizung 1 hinten unplaus" UWORD B_TRUE 0 0 0.000000 1.000000 ECU_ADDRESS 0xFD56 BIT_MASK 0x2000 /end MEASUREMENT
/begin MEASUREMENT B_NPHSV1 " Sondenheizung 1 vorn unplaus" UWORD B_TRUE 0 0 0.000000 1.000000 ECU_ADDRESS 0xFD56 BIT_MASK 0x800 /end MEASUREMENT
/begin MEASUREMENT B_NS " 1 = Nachstart aktiv, d.h. Fns>1.0" UWORD B_TRUE 0 0 0.000000 1.000000 ECU_ADDRESS 0xFD08 BIT_MASK 0x4 /end MEASUREMENT
/begin MEASUREMENT B_NSOBGRON " 1 = Nachstartobergrenze Ein" UWORD B_TRUE 0 0 0.000000 1.000000 ECU_ADDRESS 0xFD1C BIT_MASK 0x8 /end MEASUREMENT
/begin MEASUREMENT B_NUACC_UC " Fuer Erkennung SGS NU in der BT" UWORD B_TRUE 0 0 0.000000 1.000000 ECU_ADDRESS 0xFDF2 BIT_MASK 0x400 /end MEASUREMENT
/begin MEASUREMENT B_NUMES1 " 1= ME Links ueber CAN (EAM CAN)" UWORD B_TRUE 0 0 0.000000 1.000000 ECU_ADDRESS 0xFD6E BIT_MASK 0x10 /end MEASUREMENT
/begin MEASUREMENT B_NUSGS_UC " Fuer Erkennung SGS NU in der BT" UWORD B_TRUE 0 0 0.000000 1.000000 ECU_ADDRESS 0xFDF2 BIT_MASK 0x40 /end MEASUREMENT
/begin MEASUREMENT B_NW " 1 = Nockenwellensteller ein" UWORD B_TRUE 0 0 0.000000 1.000000 ECU_ADDRESS 0xFD06 BIT_MASK 0x400 /end MEASUREMENT
/begin MEASUREMENT B_NWCNT " Toggelt bei jeder KW-Umdrehnung" UWORD B_TRUE 0 0 0.000000 1.000000 ECU_ADDRESS 0xFD0C BIT_MASK 0x200 /end MEASUREMENT
/begin MEASUREMENT B_NWSEP " 1= Endstufe-Ansteuerung NWS erfolgt" UWORD B_TRUE 0 0 0.000000 1.000000 ECU_ADDRESS 0xFD90 BIT_MASK 0x800 /end MEASUREMENT
/begin MEASUREMENT B_OILPR " 1= Oeldruck niedrig" UWORD B_TRUE 0 0 0.000000 1.000000 ECU_ADDRESS 0xFD6E BIT_MASK 0x20 /end MEASUREMENT
/begin MEASUREMENT B_OVERR " ACC-Override durch Fahrer" UWORD B_TRUE 0 0 0.000000 1.000000 ECU_ADDRESS 0xFD4E BIT_MASK 0x8 /end MEASUREMENT
/begin MEASUREMENT B_PERBEG " 1 = PWM-Ausgabeperiode beginnt" UWORD B_TRUE 0 0 0.000000 1.000000 ECU_ADDRESS 0xFD7E BIT_MASK 0x1 /end MEASUREMENT
/begin MEASUREMENT B_PHALT " Phasensensor Zustand ein Abtastzeitpunkt vorher" UWORD B_TRUE 0 0 0.000000 1.000000 ECU_ADDRESS 0xFD6A BIT_MASK 0x80 /end MEASUREMENT
/begin MEASUREMENT B_PHCHA "1 = Phasenwechsel" UWORD B_TRUE 0 0 0.000000 1.000000 ECU_ADDRESS 0xFD1C BIT_MASK 0x8000 /end MEASUREMENT
/begin MEASUREMENT B_PHOK " Phasenwechsel erkannt" UWORD B_TRUE 0 0 0.000000 1.000000 ECU_ADDRESS 0xFD6A BIT_MASK 0x400 /end MEASUREMENT
/begin MEASUREMENT B_PHSYNC " Phasensync. erfolgt, Einspritzung trotz Phasenfehler" UWORD B_TRUE 0 0 0.000000 1.000000 ECU_ADDRESS 0xFD6A BIT_MASK 0x200 /end MEASUREMENT
/begin MEASUREMENT B_PLOKNN " Bedingung fuel-on Adaption im akt. n-Bereichen plausibel" UWORD B_TRUE 0 0 0.000000 1.000000 ECU_ADDRESS 0xFDBA BIT_MASK 0x4000 /end MEASUREMENT
/begin MEASUREMENT B_PNZ " 1= Lern-Erfolg" UWORD B_TRUE 0 0 0.000000 1.000000 ECU_ADDRESS 0xFD08 BIT_MASK 0x40 /end MEASUREMENT
/begin MEASUREMENT B_PN_RED " Redundantes B_PN aus Signal GANG_I" UWORD B_TRUE 0 0 0.000000 1.000000 ECU_ADDRESS 0xFDB8 BIT_MASK 0x20 /end MEASUREMENT
/begin MEASUREMENT B_PRVB " 1 = EKP-Vorlauf-Bereitschaft" UWORD B_TRUE 0 0 0.000000 1.000000 ECU_ADDRESS 0xFDF6 BIT_MASK 0x100 /end MEASUREMENT
/begin MEASUREMENT B_PS " Phasensensor Zustand bei tr-Marke" UWORD B_TRUE 0 0 0.000000 1.000000 ECU_ADDRESS 0xFD28 BIT_MASK 0x2000 /end MEASUREMENT
/begin MEASUREMENT B_PSADR " 1 = Pseudo-Adresse gueltig" UWORD B_TRUE 0 0 0.000000 1.000000 ECU_ADDRESS 0xFD28 BIT_MASK 0x4 /end MEASUREMENT
/begin MEASUREMENT B_PVSH1 " 1 = LAS-Potentialversatz HKAT Bank 1" UWORD B_TRUE 0 0 0.000000 1.000000 ECU_ADDRESS 0xFDF8 BIT_MASK 0x100 /end MEASUREMENT
/begin MEASUREMENT B_PVSH2 " 1 = LAS-Potentialversatz HKAT Bank 2" UWORD B_TRUE 0 0 0.000000 1.000000 ECU_ADDRESS 0xFDF8 BIT_MASK 0x200 /end MEASUREMENT
/begin MEASUREMENT B_PWGNOT_F " PWG-Notfahren" UWORD B_TRUE 0 0 0.000000 1.000000 ECU_ADDRESS 0xFD6A BIT_MASK 0x1 /end MEASUREMENT
/begin MEASUREMENT B_PWGNOT_I " PWG - Notfahren (Info)" UWORD B_TRUE 0 0 0.000000 1.000000 ECU_ADDRESS 0xFD66 BIT_MASK 0x1 /end MEASUREMENT
/begin MEASUREMENT B_PWGNOT_U "PWG-Notfahren" UWORD B_TRUE 0 0 0.000000 1.000000 ECU_ADDRESS 0xFD6A BIT_MASK 0x2 /end MEASUREMENT
/begin MEASUREMENT B_PWMSYNCH "> Lageregler PWM ist synchronisiert (%1%)" UWORD B_TRUE 0 0 0.000000 1.000000 ECU_ADDRESS 0xFD1E BIT_MASK 0x80 /end MEASUREMENT
/begin MEASUREMENT B_REDA_T " Reduzierstufe aktiv" UWORD B_TRUE 0 0 0.000000 1.000000 ECU_ADDRESS 0xFDB8 BIT_MASK 0x800 /end MEASUREMENT
/begin MEASUREMENT B_REDSAOLD " Anforderung SA durch Schaltvorgang vom Selespeed (alt)" UWORD B_TRUE 0 0 0.000000 1.000000 ECU_ADDRESS 0xFD7C BIT_MASK 0x2 /end MEASUREMENT
/begin MEASUREMENT B_RED_AKT " Reduzierstufe aktiv" UWORD B_TRUE 0 0 0.000000 1.000000 ECU_ADDRESS 0xFDB8 BIT_MASK 0x400 /end MEASUREMENT
/begin MEASUREMENT B_REFMAX2 " Ausloesung Drive-Recorder Messung " UWORD B_TRUE 0 0 0.000000 1.000000 ECU_ADDRESS 0xB0850 BIT_MASK 0x2000 /end MEASUREMENT
/begin MEASUREMENT B_REGLER_D " 1= Reglerausgang deaktivieren" UWORD B_TRUE 0 0 0.000000 1.000000 ECU_ADDRESS 0xFD6C BIT_MASK 0x4 /end MEASUREMENT
/begin MEASUREMENT B_RFRG " 1 = Aufsteuerrampe freigegeben" UWORD B_TRUE 0 0 0.000000 1.000000 ECU_ADDRESS 0xFD7E BIT_MASK 0x2 /end MEASUREMENT
/begin MEASUREMENT B_RGANG " Umschalt. Pedalkennfeld auf Rueckwaertsgang" UWORD B_TRUE 0 0 0.000000 1.000000 ECU_ADDRESS 0xFD58 BIT_MASK 0x200 /end MEASUREMENT
/begin MEASUREMENT B_RIAKH " Bed. fuer Strompumpen aktualisiert hinter Kat Bank 1" UBYTE B_TRUE 0 0 0.000000 1.000000 ECU_ADDRESS 0xB1014 BIT_MASK 0x1 /end MEASUREMENT
/begin MEASUREMENT B_RIAKH2 " Bed. fuer Strompumpen aktualisiert hinter Kat Bank 2" UBYTE B_TRUE 0 0 0.000000 1.000000 ECU_ADDRESS 0xB1015 BIT_MASK 0x1 /end MEASUREMENT
/begin MEASUREMENT B_RIIBH " Bed. Sondenspannung im zul. Band fuer Strompumpen hinter Kat Bank 1" UBYTE B_TRUE 0 0 0.000000 1.000000 ECU_ADDRESS 0xB1014 BIT_MASK 0x4 /end MEASUREMENT
/begin MEASUREMENT B_RIIBH2 " Bed. Sondenspannung im zul. Band fuer Strompumpen hinter Kat Bank 2" UBYTE B_TRUE 0 0 0.000000 1.000000 ECU_ADDRESS 0xB1015 BIT_MASK 0x4 /end MEASUREMENT
/begin MEASUREMENT B_RISPH " Bed. Spannungsdifferenz vor/nach Pumpen oberhalb Schwelle hinter Kat B 1" UBYTE B_TRUE 0 0 0.000000 1.000000 ECU_ADDRESS 0xB1014 BIT_MASK 0x10 /end MEASUREMENT
/begin MEASUREMENT B_RISPH2 " Bed. Spannungsdifferenz vor/nach Pumpen oberhalb Schwelle hinter Kat B 2" UBYTE B_TRUE 0 0 0.000000 1.000000 ECU_ADDRESS 0xB1015 BIT_MASK 0x10 /end MEASUREMENT
/begin MEASUREMENT B_RISPV " Bed. Spannungsdifferenz vor/nach Pumpen oberhalb Schwelle vor Kat B 1" UBYTE B_TRUE 0 0 0.000000 1.000000 ECU_ADDRESS 0xB1012 BIT_MASK 0x10 /end MEASUREMENT
/begin MEASUREMENT B_RISPV2 " Bed. Spannungsdifferenz vor/nach Pumpen oberhalb Schwelle vor Kat B 2" UBYTE B_TRUE 0 0 0.000000 1.000000 ECU_ADDRESS 0xB1013 BIT_MASK 0x10 /end MEASUREMENT
/begin MEASUREMENT B_ROMRDY "ROM-Pruefung im Nachlauf ist fertig" UBYTE B_TRUE 0 0 0.000000 1.000000 ECU_ADDRESS 0xB223C BIT_MASK 0x8 /end MEASUREMENT
/begin MEASUREMENT B_RWH " 1= Heckscheibenheizung ein" UWORD B_TRUE 0 0 0.000000 1.000000 ECU_ADDRESS 0xFD6E BIT_MASK 0x80 /end MEASUREMENT
/begin MEASUREMENT B_SAC " 1 = Schubabschalten andere Bank aktiv (nur fuer 12-Zyl ueber CAN)" UWORD B_TRUE 0 0 0.000000 1.000000 ECU_ADDRESS 0xFD7C BIT_MASK 0x4000 /end MEASUREMENT
/begin MEASUREMENT B_SA_ALT " alter Zustand von B_SA" UWORD B_TRUE 0 0 0.000000 1.000000 ECU_ADDRESS 0xFD08 BIT_MASK 0x200 /end MEASUREMENT
/begin MEASUREMENT B_SA_OLD " steigende Flanke von b_sa" UWORD B_TRUE 0 0 0.000000 1.000000 ECU_ADDRESS 0xFD3A BIT_MASK 0x100 /end MEASUREMENT
/begin MEASUREMENT B_SBBVK "1 = Betriebsbereitschaft L-Sonde v.KAT B1" UWORD B_TRUE 0 0 0.000000 1.000000 ECU_ADDRESS 0xFD2C BIT_MASK 0x1 /end MEASUREMENT
/begin MEASUREMENT B_SB_ACC " 'Setzen Beschleunigen' entprellt fuer ACC" UWORD B_TRUE 0 0 0.000000 1.000000 ECU_ADDRESS 0xFD70 BIT_MASK 0x800 /end MEASUREMENT
/begin MEASUREMENT B_SB_ALT " alte Bitinfo 'Setzen Beschleunigen'" UWORD B_TRUE 0 0 0.000000 1.000000 ECU_ADDRESS 0xFD70 BIT_MASK 0x8000 /end MEASUREMENT
/begin MEASUREMENT B_SB_FGR " Schalter S_SB merken in FGR" UWORD B_TRUE 0 0 0.000000 1.000000 ECU_ADDRESS 0xFD9E BIT_MASK 0x800 /end MEASUREMENT
/begin MEASUREMENT B_SCHALTNP " s_schalt laenger als MDEGS_T aktiv" UWORD B_TRUE 0 0 0.000000 1.000000 ECU_ADDRESS 0xFDB8 BIT_MASK 0x10 /end MEASUREMENT
/begin MEASUREMENT B_SECURITY " Ueberwachungungsfunktion laeuft" UWORD B_TRUE 0 0 0.000000 1.000000 ECU_ADDRESS 0xFD64 BIT_MASK 0x4000 /end MEASUREMENT
/begin MEASUREMENT B_SELSAS " 1 = Selektives SAS" UWORD B_TRUE 0 0 0.000000 1.000000 ECU_ADDRESS 0xFD0E BIT_MASK 0x1 /end MEASUREMENT
/begin MEASUREMENT B_SERAP " 1 = neuer Name fuer DAMOS B_AP_AKTIV" UWORD B_TRUE 0 0 0.000000 1.000000 ECU_ADDRESS 0xFD2A BIT_MASK 0x8000 /end MEASUREMENT
/begin MEASUREMENT B_SI_FGR " Schalterzustand gemerkt fuer Wechselerkennung" UWORD B_TRUE 0 0 0.000000 1.000000 ECU_ADDRESS 0xFD9E BIT_MASK 0x4000 /end MEASUREMENT
/begin MEASUREMENT B_SKSA " Zuendkreis A zuerst schliessen" UWORD B_TRUE 0 0 0.000000 1.000000 ECU_ADDRESS 0xFDA0 BIT_MASK 0x10 /end MEASUREMENT
/begin MEASUREMENT B_SKSB " Zuendkreis B zuerst schliessen (Konsistenz zwischen Interrupts !)" UWORD B_TRUE 0 0 0.000000 1.000000 ECU_ADDRESS 0xFDA0 BIT_MASK 0x20 /end MEASUREMENT
/begin MEASUREMENT B_SP1STAT " '1'= SP1S-Stationaerzustand" UWORD B_TRUE 0 0 0.000000 1.000000 ECU_ADDRESS 0xFD5E BIT_MASK 0x40 /end MEASUREMENT
/begin MEASUREMENT B_SP2STAT " '1'= SP2S-Stationaerzustand" UWORD B_TRUE 0 0 0.000000 1.000000 ECU_ADDRESS 0xFD5E BIT_MASK 0x80 /end MEASUREMENT
/begin MEASUREMENT B_SPRUAB1 "1 = Spr. abw. gesperrt bis sgnlam1 auf plus wechselt" UWORD B_TRUE 0 0 0.000000 1.000000 ECU_ADDRESS 0xFD2C BIT_MASK 0x2000 /end MEASUREMENT
/begin MEASUREMENT B_SPRUAB2 "1 = Spr. abw. gesperrt bis sgnlam2 auf plus wechselt" UWORD B_TRUE 0 0 0.000000 1.000000 ECU_ADDRESS 0xFD2C BIT_MASK 0x4000 /end MEASUREMENT
/begin MEASUREMENT B_SPRUAUF1 "1 = Spr. aufw. gesperrt bis sgnlam1 auf minus wechselt" UWORD B_TRUE 0 0 0.000000 1.000000 ECU_ADDRESS 0xFD2C BIT_MASK 0x800 /end MEASUREMENT
/begin MEASUREMENT B_SPRUAUF2 "1 = Spr. aufw. gesperrt bis sgnlam2 auf minus wechselt" UWORD B_TRUE 0 0 0.000000 1.000000 ECU_ADDRESS 0xFD2C BIT_MASK 0x1000 /end MEASUREMENT
/begin MEASUREMENT B_SPSKS " SKS A/B Wechsel gesperrt, da bereits erfolgt" UWORD B_TRUE 0 0 0.000000 1.000000 ECU_ADDRESS 0xFDA0 BIT_MASK 0x8 /end MEASUREMENT
/begin MEASUREMENT B_SPUELINT "> Spuelratenintegratorabsteuerung" UWORD B_TRUE 0 0 0.000000 1.000000 ECU_ADDRESS 0xFD50 BIT_MASK 0x400 /end MEASUREMENT
/begin MEASUREMENT B_STEP1ABG " Intervall 1 f. abgasrel. Aussetzererk." UWORD B_TRUE 0 0 0.000000 1.000000 ECU_ADDRESS 0xFD84 BIT_MASK 0x10 /end MEASUREMENT
/begin MEASUREMENT B_STEP1KAT " Intervall 1 f. katschaedigende Aussetzererk." UWORD B_TRUE 0 0 0.000000 1.000000 ECU_ADDRESS 0xFD84 BIT_MASK 0x20 /end MEASUREMENT
/begin MEASUREMENT B_STGKAKT " 1 = Stellgroessenklammerung aktiv" UWORD B_TRUE 0 0 0.000000 1.000000 ECU_ADDRESS 0xFD20 BIT_MASK 0x40 /end MEASUREMENT
/begin MEASUREMENT B_STGLD_ON " Bedingung Stellglied-Diagnose aktiv" UWORD B_TRUE 0 0 0.000000 1.000000 ECU_ADDRESS 0xFD6A BIT_MASK 0x1000 /end MEASUREMENT
/begin MEASUREMENT B_STGLD_TN " Bedingung TN-Ausgabe im 1ms-Raster aktiv" UWORD B_TRUE 0 0 0.000000 1.000000 ECU_ADDRESS 0xFD6A BIT_MASK 0x2000 /end MEASUREMENT
/begin MEASUREMENT B_STNDL "Bed. Beginn SG-Nachlauf oder Startende (1->0)" UWORD B_TRUE 0 0 0.000000 1.000000 ECU_ADDRESS 0xFD52 BIT_MASK 0x400 /end MEASUREMENT
/begin MEASUREMENT B_ST_ALT "Merker fuer B_STEND (Main-Durchlauf zuvor)" UWORD B_TRUE 0 0 0.000000 1.000000 ECU_ADDRESS 0xFD52 BIT_MASK 0x200 /end MEASUREMENT
/begin MEASUREMENT B_ST_MESS " 1 = Start Synchromessen" UWORD B_TRUE 0 0 0.000000 1.000000 ECU_ADDRESS 0xFD28 BIT_MASK 0x800 /end MEASUREMENT
/begin MEASUREMENT B_ST_OK " b_trfash1/2 && b_mlustest" UWORD B_TRUE 0 0 0.000000 1.000000 ECU_ADDRESS 0xFD3A BIT_MASK 0x8000 /end MEASUREMENT
/begin MEASUREMENT B_SUEP " 1= Endstufe-Ansteuerung SU erfolgt" UWORD B_TRUE 0 0 0.000000 1.000000 ECU_ADDRESS 0xFD90 BIT_MASK 0x400 /end MEASUREMENT
/begin MEASUREMENT B_SV_ACC " 'Setzen Verzoegern' entprellt fuer ACC" UWORD B_TRUE 0 0 0.000000 1.000000 ECU_ADDRESS 0xFD70 BIT_MASK 0x1000 /end MEASUREMENT
/begin MEASUREMENT B_SV_ALT " alte Bitinfo 'Setzen Verzoegern'" UWORD B_TRUE 0 0 0.000000 1.000000 ECU_ADDRESS 0xFD72 BIT_MASK 0x1 /end MEASUREMENT
/begin MEASUREMENT B_SV_FGR " Schalter S_SV merken in FGR" UWORD B_TRUE 0 0 0.000000 1.000000 ECU_ADDRESS 0xFD9E BIT_MASK 0x1000 /end MEASUREMENT
/begin MEASUREMENT B_SW0 " 1 = Nicht ueberlappender Zuendungen" UWORD B_TRUE 0 0 0.000000 1.000000 ECU_ADDRESS 0xFD14 BIT_MASK 0x200 /end MEASUREMENT
/begin MEASUREMENT B_SW1 " 1 = einfach ueberlappende Zuendungen" UWORD B_TRUE 0 0 0.000000 1.000000 ECU_ADDRESS 0xFD14 BIT_MASK 0x400 /end MEASUREMENT
/begin MEASUREMENT B_SYNC1 " Zwischenbit 1 nur in SYNC-Sektion verwenden" UWORD B_TRUE 0 0 0.000000 1.000000 ECU_ADDRESS 0xFDC4 BIT_MASK 0x1 /end MEASUREMENT
/begin MEASUREMENT B_SYNC2 " Zwischenbit 2 nur in SYNC-Sektion verwenden" UWORD B_TRUE 0 0 0.000000 1.000000 ECU_ADDRESS 0xFDC4 BIT_MASK 0x2 /end MEASUREMENT
/begin MEASUREMENT B_SYNC3 " Zwischenbit 3 nur in SYNC-Sektion verwenden" UWORD B_TRUE 0 0 0.000000 1.000000 ECU_ADDRESS 0xFDC4 BIT_MASK 0x4 /end MEASUREMENT
/begin MEASUREMENT B_SYNC4 " Zwischenbit 4 nur in SYNC-Sektion verwenden" UWORD B_TRUE 0 0 0.000000 1.000000 ECU_ADDRESS 0xFDC4 BIT_MASK 0x8 /end MEASUREMENT
/begin MEASUREMENT B_SYNC5 " Zwischenbit 5 nur in SYNC-Sektion verwenden" UWORD B_TRUE 0 0 0.000000 1.000000 ECU_ADDRESS 0xFDC4 BIT_MASK 0x10 /end MEASUREMENT
/begin MEASUREMENT B_SYNC6 " Zwischenbit 6 nur in SYNC-Sektion verwenden" UWORD B_TRUE 0 0 0.000000 1.000000 ECU_ADDRESS 0xFDC4 BIT_MASK 0x20 /end MEASUREMENT
/begin MEASUREMENT B_SYNC7 " Zwischenbit 7 nur in SYNC-Sektion verwenden" UWORD B_TRUE 0 0 0.000000 1.000000 ECU_ADDRESS 0xFDC4 BIT_MASK 0x40 /end MEASUREMENT
/begin MEASUREMENT B_SYNC8 " Zwischenbit 8 nur in SYNC-Sektion verwenden" UWORD B_TRUE 0 0 0.000000 1.000000 ECU_ADDRESS 0xFDC4 BIT_MASK 0x80 /end MEASUREMENT
/begin MEASUREMENT B_SYNCCAN " 1 = Anderes 12-Zyl. SG hat Zahnluecke (ueber CAN) erkannt." UWORD B_TRUE 0 0 0.000000 1.000000 ECU_ADDRESS 0xFD10 BIT_MASK 0x100 /end MEASUREMENT
/begin MEASUREMENT B_SYNCMOT " 1 = Steuergeraet hat Zahnluecke erkannt." UWORD B_TRUE 0 0 0.000000 1.000000 ECU_ADDRESS 0xFD10 BIT_MASK 0x80 /end MEASUREMENT
/begin MEASUREMENT B_SZKAT " '1' = Zykluszeit und Fehler in Bank1 abgelaufen" UWORD B_TRUE 0 0 0.000000 1.000000 ECU_ADDRESS 0xFD48 BIT_MASK 0x4 /end MEASUREMENT
/begin MEASUREMENT B_SZKAT2LH " Funktionsbit: low_high-Flanke erkannt" UWORD B_TRUE 0 0 0.000000 1.000000 ECU_ADDRESS 0xB089C BIT_MASK 0x80 /end MEASUREMENT
/begin MEASUREMENT B_SZKATLH " Funktionsbit: low_high-Flanke erkannt" UWORD B_TRUE 0 0 0.000000 1.000000 ECU_ADDRESS 0xB089A BIT_MASK 0x1000 /end MEASUREMENT
/begin MEASUREMENT B_SZKT2ALT " Funktionsbit: alter Wert abspeichern (Bank2)" UWORD B_TRUE 0 0 0.000000 1.000000 ECU_ADDRESS 0xB089C BIT_MASK 0x100 /end MEASUREMENT
/begin MEASUREMENT B_SZKTALT " Funktionsbit: alter Wert abspeichern" UWORD B_TRUE 0 0 0.000000 1.000000 ECU_ADDRESS 0xB089A BIT_MASK 0x2000 /end MEASUREMENT
/begin MEASUREMENT B_T2RXOK " Botschaftsempfang waehrend <t2>" UWORD B_TRUE 0 0 0.000000 1.000000 ECU_ADDRESS 0xFD6E BIT_MASK 0x8 /end MEASUREMENT
/begin MEASUREMENT B_TAL_DRAM ">Index 0: '1' = Tank leer" UBYTE B_TRUE 0 0 0.000000 1.000000 ECU_ADDRESS 0xB2195 BIT_MASK 0x1 /end MEASUREMENT
/begin MEASUREMENT B_TANSAKTU "Tans kann ausgewertet werden." UWORD B_TRUE 0 0 0.000000 1.000000 ECU_ADDRESS 0xFD68 BIT_MASK 0x8000 /end MEASUREMENT
/begin MEASUREMENT B_TDO " Tankdeckel als offen erkannt" UWORD B_TRUE 0 0 0.000000 1.000000 ECU_ADDRESS 0xFD7A BIT_MASK 0x8 /end MEASUREMENT
/begin MEASUREMENT B_TEMPFE_U "Tempomat freigegeben BT" UWORD B_TRUE 0 0 0.000000 1.000000 ECU_ADDRESS 0xFDF0 BIT_MASK 0x4000 /end MEASUREMENT
/begin MEASUREMENT B_TFAUNPL " '1'= Ansauglufttemp. ist unplausibel" UWORD B_TRUE 0 0 0.000000 1.000000 ECU_ADDRESS 0xFD6C BIT_MASK 0x8000 /end MEASUREMENT
/begin MEASUREMENT B_TFMUNPL " '1'= Motortemp. ist unplausibel" UWORD B_TRUE 0 0 0.000000 1.000000 ECU_ADDRESS 0xFD6C BIT_MASK 0x4000 /end MEASUREMENT
/begin MEASUREMENT B_TIMFAST " 1 = Timer laeuft schnell" UWORD B_TRUE 0 0 0.000000 1.000000 ECU_ADDRESS 0xFD0C BIT_MASK 0x2000 /end MEASUREMENT
/begin MEASUREMENT B_TIP " Freischaltung Tiptronic an Automat" UWORD B_TRUE 0 0 0.000000 1.000000 ECU_ADDRESS 0xFD88 BIT_MASK 0x2000 /end MEASUREMENT
/begin MEASUREMENT B_TIP_DOWN " 1= Tip-down gesperrt" UWORD B_TRUE 0 0 0.000000 1.000000 ECU_ADDRESS 0xFD6C BIT_MASK 0x400 /end MEASUREMENT
/begin MEASUREMENT B_TIP_UPDI " 1= Tip-up gesperrt" UWORD B_TRUE 0 0 0.000000 1.000000 ECU_ADDRESS 0xFD6C BIT_MASK 0x200 /end MEASUREMENT
/begin MEASUREMENT B_TMEINA " alter Wert v. b_tm_ein" UWORD B_TRUE 0 0 0.000000 1.000000 ECU_ADDRESS 0xFD7A BIT_MASK 0x80 /end MEASUREMENT
/begin MEASUREMENT B_TMOT "1=Motortemperatur kritisch" UWORD B_TRUE 0 0 0.000000 1.000000 ECU_ADDRESS 0xFD68 BIT_MASK 0x800 /end MEASUREMENT
/begin MEASUREMENT B_TMOTAKTU "Tmot kann ausgewertet werden." UWORD B_TRUE 0 0 0.000000 1.000000 ECU_ADDRESS 0xFD68 BIT_MASK 0x40 /end MEASUREMENT
/begin MEASUREMENT B_TMRMP_UM " 1= Tempomat-Abschaltung ueber Rampe (SR)" UWORD B_TRUE 0 0 0.000000 1.000000 ECU_ADDRESS 0xFD6C BIT_MASK 0x2000 /end MEASUREMENT
/begin MEASUREMENT B_TM_FR "1= Temp. EIN plaus. mit LG" UWORD B_TRUE 0 0 0.000000 1.000000 ECU_ADDRESS 0xFD6C BIT_MASK 0x1000 /end MEASUREMENT
/begin MEASUREMENT B_TNA " 1->0 bei tr-Marke, 0->1 bei SHK (entspricht tn-Signal)" UWORD B_TRUE 0 0 0.000000 1.000000 ECU_ADDRESS 0xFD10 BIT_MASK 0x800 /end MEASUREMENT
/begin MEASUREMENT B_TNALU_AP " Testphase" UBYTE B_TRUE 0 0 0.000000 1.000000 ECU_ADDRESS 0xF9A7 BIT_MASK 0x8 /end MEASUREMENT
/begin MEASUREMENT B_TNBM " Zahnzeit ueberschreitet Rueckdrehschwelle" UWORD B_TRUE 0 0 0.000000 1.000000 ECU_ADDRESS 0xFDD8 BIT_MASK 0x4 /end MEASUREMENT
/begin MEASUREMENT B_TOUT " 1 = McMess Timeout" UWORD B_TRUE 0 0 0.000000 1.000000 ECU_ADDRESS 0xFD28 BIT_MASK 0x20 /end MEASUREMENT
/begin MEASUREMENT B_TRVERZ " Bei Synchronisation Luecke ohne Phase erkannt (nur fuer 5Zyl.)" UWORD B_TRUE 0 0 0.000000 1.000000 ECU_ADDRESS 0xFD10 BIT_MASK 0x4000 /end MEASUREMENT
/begin MEASUREMENT B_TSAM " Ausloesung Drive-Recorder Messung " UWORD B_TRUE 0 0 0.000000 1.000000 ECU_ADDRESS 0xFD92 BIT_MASK 0x800 /end MEASUREMENT
/begin MEASUREMENT B_TSAM2 " Ausloesung Drive-Recorder Messung " UWORD B_TRUE 0 0 0.000000 1.000000 ECU_ADDRESS 0xFD92 BIT_MASK 0x2000 /end MEASUREMENT
/begin MEASUREMENT B_TSTEAA " '1'=" UWORD B_TRUE 0 0 0.000000 1.000000 ECU_ADDRESS 0xFD36 BIT_MASK 0x100 /end MEASUREMENT
/begin MEASUREMENT B_TSTREC " erfolgreiche Recovery-Prozedur Ueber Tester" UWORD B_TRUE 0 0 0.000000 1.000000 ECU_ADDRESS 0xFDD4 BIT_MASK 0x40 /end MEASUREMENT
/begin MEASUREMENT B_TSTRECBL " Ausloesung Drive-Recorder Messung " UWORD B_TRUE 0 0 0.000000 1.000000 ECU_ADDRESS 0xFDD4 BIT_MASK 0x80 /end MEASUREMENT
/begin MEASUREMENT B_TTBMH1 " Theoretische Sondenbetriebsbereitschaft mit Heizung vK" UWORD B_TRUE 0 0 0.000000 1.000000 ECU_ADDRESS 0xFD38 BIT_MASK 0x10 /end MEASUREMENT
/begin MEASUREMENT B_TTEGAINI "1= erste Gemischadaptionsphase aktiv" UWORD B_TRUE 0 0 0.000000 1.000000 ECU_ADDRESS 0xFD7A BIT_MASK 0x1000 /end MEASUREMENT
/begin MEASUREMENT B_TTEINI "1= erste Tankentlueftungsphase aktiv" UWORD B_TRUE 0 0 0.000000 1.000000 ECU_ADDRESS 0xFD7A BIT_MASK 0x2000 /end MEASUREMENT
/begin MEASUREMENT B_TUSCH_R1 " Bit fuer Timer t_tusch_r1" UWORD B_TRUE 0 0 0.000000 1.000000 ECU_ADDRESS 0xFD3A BIT_MASK 0x400 /end MEASUREMENT
/begin MEASUREMENT B_TUSCH_R2 " Bit fuer Timer t_tusch_r2" UWORD B_TRUE 0 0 0.000000 1.000000 ECU_ADDRESS 0xFD3A BIT_MASK 0x1000 /end MEASUREMENT
/begin MEASUREMENT B_TUSCH_S1 " Bit fuer Timer t_tusch_s1" UWORD B_TRUE 0 0 0.000000 1.000000 ECU_ADDRESS 0xFD3A BIT_MASK 0x200 /end MEASUREMENT
/begin MEASUREMENT B_TUSCH_S2 " Bit fuer Timer t_tusch_s2" UWORD B_TRUE 0 0 0.000000 1.000000 ECU_ADDRESS 0xFD3A BIT_MASK 0x800 /end MEASUREMENT
/begin MEASUREMENT B_TUSEINH1 " 1 = bank 1" UWORD B_TRUE 0 0 0.000000 1.000000 ECU_ADDRESS 0xB086A BIT_MASK 0x20 /end MEASUREMENT
/begin MEASUREMENT B_TUSEINH2 " 1 = bank 1" UWORD B_TRUE 0 0 0.000000 1.000000 ECU_ADDRESS 0xB086C BIT_MASK 0x20 /end MEASUREMENT
/begin MEASUREMENT B_TUSEINV " 1 = Verzoegerung Einschalten Betriebsbereitschaft abgelaufen" UWORD B_TRUE 0 0 0.000000 1.000000 ECU_ADDRESS 0xB084E BIT_MASK 0x20 /end MEASUREMENT
/begin MEASUREMENT B_TUSEINV2 " Ausloesung Drive-Recorder Messung " UWORD B_TRUE 0 0 0.000000 1.000000 ECU_ADDRESS 0xB0850 BIT_MASK 0x20 /end MEASUREMENT
/begin MEASUREMENT B_TZLSATV1 " '1'= Zaehler tzlsatv Delta-TV-Diagnose abgelaufen" UWORD B_TRUE 0 0 0.000000 1.000000 ECU_ADDRESS 0xFD36 BIT_MASK 0x80 /end MEASUREMENT
/begin MEASUREMENT B_UBTH_OK " UBatt und Hinterkattemperatur OK" UWORD B_TRUE 0 0 0.000000 1.000000 ECU_ADDRESS 0xFD56 BIT_MASK 0x4 /end MEASUREMENT
/begin MEASUREMENT B_UBTV_OK " UBatt und Vorkattemperatur OK" UWORD B_TRUE 0 0 0.000000 1.000000 ECU_ADDRESS 0xFD56 BIT_MASK 0x2 /end MEASUREMENT
/begin MEASUREMENT B_UB__OK " UBatt im Bereich" UWORD B_TRUE 0 0 0.000000 1.000000 ECU_ADDRESS 0xFD56 BIT_MASK 0x1 /end MEASUREMENT
/begin MEASUREMENT B_UKGALT " alter Wert von B_UKG" UWORD B_TRUE 0 0 0.000000 1.000000 ECU_ADDRESS 0xFD28 BIT_MASK 0x2 /end MEASUREMENT
/begin MEASUREMENT B_USBEH " Bed. fuer Zeitzaehler zur Ausblendung der Sondenbelastung hinter Kat B 1" UBYTE B_TRUE 0 0 0.000000 1.000000 ECU_ADDRESS 0xB1014 BIT_MASK 0x20 /end MEASUREMENT
/begin MEASUREMENT B_USBEH2 " Bed. fuer Zeitzaehler zur Ausblendung der Sondenbelastung hinter Kat B 2" UBYTE B_TRUE 0 0 0.000000 1.000000 ECU_ADDRESS 0xB1015 BIT_MASK 0x20 /end MEASUREMENT
/begin MEASUREMENT B_UUS_BUSY " GGLS: ADC-Wert im 1ms-Raster noch nicht umgeladen" UWORD B_TRUE 0 0 0.000000 1.000000 ECU_ADDRESS 0xFD54 BIT_MASK 0x800 /end MEASUREMENT
/begin MEASUREMENT B_UUS_FIRS " GGLS: ADC-Wert im ersten 1ms-Raster umladen" UWORD B_TRUE 0 0 0.000000 1.000000 ECU_ADDRESS 0xFD54 BIT_MASK 0x1000 /end MEASUREMENT
/begin MEASUREMENT B_UUS_PLAU " GGLS: ADC-Wert plausibel" UWORD B_TRUE 0 0 0.000000 1.000000 ECU_ADDRESS 0xFD54 BIT_MASK 0x2000 /end MEASUREMENT
/begin MEASUREMENT B_UUS_READ " GGLS: ADC-Wert im 1ms-Raster umgeladen" UWORD B_TRUE 0 0 0.000000 1.000000 ECU_ADDRESS 0xFD54 BIT_MASK 0x4000 /end MEASUREMENT
/begin MEASUREMENT B_UUS_SETT " TGGLS: SSCR-Interrupt soll Timer umspeichern" UWORD B_TRUE 0 0 0.000000 1.000000 ECU_ADDRESS 0xFD54 BIT_MASK 0x8000 /end MEASUREMENT
/begin MEASUREMENT B_VCHA "1 = Geschwindigkeitswechsel" UWORD B_TRUE 0 0 0.000000 1.000000 ECU_ADDRESS 0xFD1C BIT_MASK 0x200 /end MEASUREMENT
/begin MEASUREMENT B_VDC " 1 = VDC-active" UWORD B_TRUE 0 0 0.000000 1.000000 ECU_ADDRESS 0xFDB4 BIT_MASK 0x80 /end MEASUREMENT
/begin MEASUREMENT B_VDCFELA " 1 = VDC-Fehlerlampe" UWORD B_TRUE 0 0 0.000000 1.000000 ECU_ADDRESS 0xFDB4 BIT_MASK 0x100 /end MEASUREMENT
/begin MEASUREMENT B_VERSTELL "> 1 = Verstellung wurde durchgefuehrt" UWORD B_TRUE 0 0 0.000000 1.000000 ECU_ADDRESS 0xFD64 BIT_MASK 0x400 /end MEASUREMENT
/begin MEASUREMENT B_VERZOE " 1= Korrektur nach Verzoegerung" UWORD B_TRUE 0 0 0.000000 1.000000 ECU_ADDRESS 0xFD6C BIT_MASK 0x80 /end MEASUREMENT
/begin MEASUREMENT B_VGE " Vorwaertsgang eingelegt" UWORD B_TRUE 0 0 0.000000 1.000000 ECU_ADDRESS 0xFD72 BIT_MASK 0x8000 /end MEASUREMENT
/begin MEASUREMENT B_VOR10 " Bedingung vor Kat im 10-ms-Raster" UWORD B_TRUE 0 0 0.000000 1.000000 ECU_ADDRESS 0xFD54 BIT_MASK 0x40 /end MEASUREMENT
/begin MEASUREMENT B_VOR100 " Bedingung vor Kat im 100-ms-Raster" UWORD B_TRUE 0 0 0.000000 1.000000 ECU_ADDRESS 0xFD54 BIT_MASK 0x80 /end MEASUREMENT
/begin MEASUREMENT B_VST " 1 = Verstellwert gueltig" UWORD B_TRUE 0 0 0.000000 1.000000 ECU_ADDRESS 0xFD28 BIT_MASK 0x8 /end MEASUREMENT
/begin MEASUREMENT B_WAG " 1 = AGR-Zuendwinkeleingriff aktiv" UWORD B_TRUE 0 0 0.000000 1.000000 ECU_ADDRESS 0xFD14 BIT_MASK 0x80 /end MEASUREMENT
/begin MEASUREMENT B_WALEP " 1= Endstufe-Ansteuerung WAL erfolgt" UWORD B_TRUE 0 0 0.000000 1.000000 ECU_ADDRESS 0xFD90 BIT_MASK 0x40 /end MEASUREMENT
/begin MEASUREMENT B_WA_ACC " 'Wiederaufnahme' entprellt fuer ACC" UWORD B_TRUE 0 0 0.000000 1.000000 ECU_ADDRESS 0xFD70 BIT_MASK 0x2000 /end MEASUREMENT
/begin MEASUREMENT B_WA_ALT " alte Bitinfo 'Wiederaufnahme'" UWORD B_TRUE 0 0 0.000000 1.000000 ECU_ADDRESS 0xFD72 BIT_MASK 0x2 /end MEASUREMENT
/begin MEASUREMENT B_WA_FGR " Schalter S_WA merken in FGR" UWORD B_TRUE 0 0 0.000000 1.000000 ECU_ADDRESS 0xFD9E BIT_MASK 0x2000 /end MEASUREMENT
/begin MEASUREMENT B_WBER " 1 = Berechneter Zuendwinkel aktiv (kein GS o. ASR)" UWORD B_TRUE 0 0 0.000000 1.000000 ECU_ADDRESS 0xFD12 BIT_MASK 0x2 /end MEASUREMENT
/begin MEASUREMENT B_WDTR " Kopie von WDTR: Letzter RechnerReset vom Watchdog !" UWORD B_TRUE 0 0 0.000000 1.000000 ECU_ADDRESS 0xFDDC BIT_MASK 0x8 /end MEASUREMENT
/begin MEASUREMENT B_WETRIG " 1 = Triggerbit 'Wiedereinsetzen' f. Zuendung" UWORD B_TRUE 0 0 0.000000 1.000000 ECU_ADDRESS 0xFD0C BIT_MASK 0x20 /end MEASUREMENT
/begin MEASUREMENT B_WE_ALT " alter Zustand von B_WE" UWORD B_TRUE 0 0 0.000000 1.000000 ECU_ADDRESS 0xFD08 BIT_MASK 0x400 /end MEASUREMENT
/begin MEASUREMENT B_WFSGASRC " erfolgreiche Recovery-Prozedur ueber Gaspedal" UWORD B_TRUE 0 0 0.000000 1.000000 ECU_ADDRESS 0xFDD4 BIT_MASK 0x20 /end MEASUREMENT
/begin MEASUREMENT B_WFSPROTA " WFS-Protokoll aktiv auf der seriellen Schnittstelle" UWORD B_TRUE 0 0 0.000000 1.000000 ECU_ADDRESS 0xFDD4 BIT_MASK 0x100 /end MEASUREMENT
/begin MEASUREMENT B_WKE " Wandlerkupplung schliessend" UWORD B_TRUE 0 0 0.000000 1.000000 ECU_ADDRESS 0xFDBE BIT_MASK 0x2000 /end MEASUREMENT
/begin MEASUREMENT B_WL_DIA " 1= Diagnosefunktion aktiv" UWORD B_TRUE 0 0 0.000000 1.000000 ECU_ADDRESS 0xFD68 BIT_MASK 0x8 /end MEASUREMENT
/begin MEASUREMENT B_WL_VAR " 1= Blinken wegen fehlender Variante" UWORD B_TRUE 0 0 0.000000 1.000000 ECU_ADDRESS 0xFD68 BIT_MASK 0x4 /end MEASUREMENT
/begin MEASUREMENT B_WNS " 1 = Wiederholnachstart" UWORD B_TRUE 0 0 0.000000 1.000000 ECU_ADDRESS 0xFD04 BIT_MASK 0x10 /end MEASUREMENT
/begin MEASUREMENT B_XACTHIGH " 1=" UWORD B_TRUE 0 0 0.000000 1.000000 ECU_ADDRESS 0xFD96 BIT_MASK 0x8 /end MEASUREMENT
/begin MEASUREMENT B_XACTLOW " 1=" UWORD B_TRUE 0 0 0.000000 1.000000 ECU_ADDRESS 0xFD96 BIT_MASK 0x10 /end MEASUREMENT
/begin MEASUREMENT B_XIGFR " 1=" UWORD B_TRUE 0 0 0.000000 1.000000 ECU_ADDRESS 0xFD96 BIT_MASK 0x2 /end MEASUREMENT
/begin MEASUREMENT B_XINOT " 1=" UWORD B_TRUE 0 0 0.000000 1.000000 ECU_ADDRESS 0xFD96 BIT_MASK 0x4 /end MEASUREMENT
/begin MEASUREMENT B_XIRAMPA " 1=" UWORD B_TRUE 0 0 0.000000 1.000000 ECU_ADDRESS 0xFD96 BIT_MASK 0x20 /end MEASUREMENT
/begin MEASUREMENT B_XIRAMPZ " 1=" UWORD B_TRUE 0 0 0.000000 1.000000 ECU_ADDRESS 0xFD96 BIT_MASK 0x40 /end MEASUREMENT
/begin MEASUREMENT B_Z1 " 1 = Zuendbereich 1" UWORD B_TRUE 0 0 0.000000 1.000000 ECU_ADDRESS 0xFD12 BIT_MASK 0x4 /end MEASUREMENT
/begin MEASUREMENT B_ZESYNC " 1 = Zuendung auf Einspritzung synchronisiert" UWORD B_TRUE 0 0 0.000000 1.000000 ECU_ADDRESS 0xFD12 BIT_MASK 0x1 /end MEASUREMENT
/begin MEASUREMENT B_ZKAON " Zuendkreis A aktiv" UWORD B_TRUE 0 0 0.000000 1.000000 ECU_ADDRESS 0xFDA0 BIT_MASK 0x1 /end MEASUREMENT
/begin MEASUREMENT B_ZKAT1ALT " Funktionsbit: alter Wert abspeichern (Bank1)" UWORD B_TRUE 0 0 0.000000 1.000000 ECU_ADDRESS 0xB089A BIT_MASK 0x800 /end MEASUREMENT
/begin MEASUREMENT B_ZKAT2ALT " Funktionsbit: alter Wert abspeichern (Bank2)" UWORD B_TRUE 0 0 0.000000 1.000000 ECU_ADDRESS 0xB089C BIT_MASK 0x40 /end MEASUREMENT
/begin MEASUREMENT B_ZKATB " '1' = bankspezifische Zykluszeit Bank1" UWORD B_TRUE 0 0 0.000000 1.000000 ECU_ADDRESS 0xFD48 BIT_MASK 0x8 /end MEASUREMENT
/begin MEASUREMENT B_ZKATBN " Zwischenbit Bank1" UWORD B_TRUE 0 0 0.000000 1.000000 ECU_ADDRESS 0xFD48 BIT_MASK 0x10 /end MEASUREMENT
/begin MEASUREMENT B_ZKATF1 " Funktionsbit: Flanke erkannt (Bank1)" UWORD B_TRUE 0 0 0.000000 1.000000 ECU_ADDRESS 0xB089A BIT_MASK 0x400 /end MEASUREMENT
/begin MEASUREMENT B_ZKATF2 " Funktionsbit: Flanke erkannt (Bank2)" UWORD B_TRUE 0 0 0.000000 1.000000 ECU_ADDRESS 0xB089C BIT_MASK 0x20 /end MEASUREMENT
/begin MEASUREMENT B_ZKATLH1 " Funktionsbit: Flanke von aktiv low nach aktiv high erkannt (Bank1)" UWORD B_TRUE 0 0 0.000000 1.000000 ECU_ADDRESS 0xB089A BIT_MASK 0x200 /end MEASUREMENT
/begin MEASUREMENT B_ZKATLH2 " Funktionsbit: Flanke von aktiv low nach aktiv high erkannt (Bank2)" UWORD B_TRUE 0 0 0.000000 1.000000 ECU_ADDRESS 0xB089C BIT_MASK 0x10 /end MEASUREMENT
/begin MEASUREMENT B_ZKATS " '1' = Zykluszeit fuer 1. Bank abgelaufen" UWORD B_TRUE 0 0 0.000000 1.000000 ECU_ADDRESS 0xFD48 BIT_MASK 0x20 /end MEASUREMENT
/begin MEASUREMENT B_ZKATZ " '1' = Bedingung fuer Summenfehler fuer MODE6 Bank1" UWORD B_TRUE 0 0 0.000000 1.000000 ECU_ADDRESS 0xFD48 BIT_MASK 0x40 /end MEASUREMENT
/begin MEASUREMENT B_ZKBON " Zuendkreis B aktiv" UWORD B_TRUE 0 0 0.000000 1.000000 ECU_ADDRESS 0xFDA0 BIT_MASK 0x2 /end MEASUREMENT
/begin MEASUREMENT B_ZKSA " Zuendkreis A zuerst zuenden" UWORD B_TRUE 0 0 0.000000 1.000000 ECU_ADDRESS 0xFDA0 BIT_MASK 0x4 /end MEASUREMENT
/begin MEASUREMENT B_ZLSATP1 " '1'= wenn zlsatp > ANZDPVK" UWORD B_TRUE 0 0 0.000000 1.000000 ECU_ADDRESS 0xFD36 BIT_MASK 0x200 /end MEASUREMENT
/begin MEASUREMENT B_ZPHNOK " 1 = Fehlerzaehler abgelaufen" UWORD B_TRUE 0 0 0.000000 1.000000 ECU_ADDRESS 0xFD2A BIT_MASK 0x1000 /end MEASUREMENT
/begin MEASUREMENT B_ZUENOFF "Zuendung ausgeschaltet (Schliessverbot)" UWORD B_TRUE 0 0 0.000000 1.000000 ECU_ADDRESS 0xFDD8 BIT_MASK 0x40 /end MEASUREMENT
/begin MEASUREMENT B_ZWB0 " ZWB-Bereich 0 (Sonderfall)" UWORD B_TRUE 0 0 0.000000 1.000000 ECU_ADDRESS 0xFD12 BIT_MASK 0x8 /end MEASUREMENT
/begin MEASUREMENT B_ZWB1 " ZWB-Bereich 1" UWORD B_TRUE 0 0 0.000000 1.000000 ECU_ADDRESS 0xFD12 BIT_MASK 0x10 /end MEASUREMENT
/begin MEASUREMENT B_ZWB2 " ZWB-Bereich 2" UWORD B_TRUE 0 0 0.000000 1.000000 ECU_ADDRESS 0xFD12 BIT_MASK 0x20 /end MEASUREMENT
/begin MEASUREMENT B_ZWB3 " ZWB-Bereich 3" UWORD B_TRUE 0 0 0.000000 1.000000 ECU_ADDRESS 0xFD12 BIT_MASK 0x40 /end MEASUREMENT
/begin MEASUREMENT B_ZWB4 " ZWB-Bereich 4" UWORD B_TRUE 0 0 0.000000 1.000000 ECU_ADDRESS 0xFD12 BIT_MASK 0x80 /end MEASUREMENT
/begin MEASUREMENT B_ZWB5 " ZWB-Bereich 5" UWORD B_TRUE 0 0 0.000000 1.000000 ECU_ADDRESS 0xFD12 BIT_MASK 0x100 /end MEASUREMENT
/begin MEASUREMENT B_ZWLWS " Zeitregelung von zwdar aktiv" UWORD B_TRUE 0 0 0.000000 1.000000 ECU_ADDRESS 0xFD66 BIT_MASK 0x1000 /end MEASUREMENT
/begin MEASUREMENT B_ZWNLFAUS "Zuendung ausgeschaltet im Nachlauf" UWORD B_TRUE 0 0 0.000000 1.000000 ECU_ADDRESS 0xFDDA BIT_MASK 0x200 /end MEASUREMENT
/begin MEASUREMENT B_ZWS0 " Anforderung Zwangschluss im Betrieb ohne Ueberlappung" UWORD B_TRUE 0 0 0.000000 1.000000 ECU_ADDRESS 0xFDA0 BIT_MASK 0x40 /end MEASUREMENT
/begin MEASUREMENT B_ZYLGEFUE " Zylinder wird vom Leitzylinder gefuehrt" UWORD DEZ 0 0 0.000000 256.000000 ECU_ADDRESS 0xFD60 BIT_MASK 0x800 /end MEASUREMENT
/begin MEASUREMENT B_ZYLGF1 " Zylinder wird v. Leitzylinder in LZFUER1 gef." UWORD B_TRUE 0 0 0.000000 1.000000 ECU_ADDRESS 0xFD60 BIT_MASK 0x10 /end MEASUREMENT
/begin MEASUREMENT DCFF " DC-Endstufenfehlerflag: 1= Endstufe gesperrt (Fehlerfall)" UWORD B_TRUE 0 0 0.000000 1.000000 ECU_ADDRESS 0xFD68 BIT_MASK 0x4000 /end MEASUREMENT
/begin MEASUREMENT DLSSA_MS50 " Funktionsbit: 50 ms Zaehler" UBYTE B_TRUE 0 0 0.000000 1.000000 ECU_ADDRESS 0xB0A4D BIT_MASK 0x1 /end MEASUREMENT
/begin MEASUREMENT DLSV12_B1 " 1 = 'US > usref OR US < usrem tusks-entprellt bank 1" UWORD B_TRUE 0 0 0.000000 1.000000 ECU_ADDRESS 0xB0852 BIT_MASK 0x1000 /end MEASUREMENT
/begin MEASUREMENT DLSV12_B2 " 1 = 'US > usref OR US < usrem tusks-entprellt bank 2" UWORD B_TRUE 0 0 0.000000 1.000000 ECU_ADDRESS 0xB0854 BIT_MASK 0x1000 /end MEASUREMENT
/begin MEASUREMENT DLSV14_B1 " 1 = 'Monoflop TNSTDN fuer b_lsvklt bank 1" UWORD B_TRUE 0 0 0.000000 1.000000 ECU_ADDRESS 0xB0852 BIT_MASK 0x4000 /end MEASUREMENT
/begin MEASUREMENT DLSV14_B2 " 1 = 'Monoflop TNSTDN fuer b_lsvklt bank 2" UWORD B_TRUE 0 0 0.000000 1.000000 ECU_ADDRESS 0xB0854 BIT_MASK 0x4000 /end MEASUREMENT
/begin MEASUREMENT DLSV15_B1 " 1 = 'US > usmax 'tusks-entprellt bank 1" UWORD B_TRUE 0 0 0.000000 1.000000 ECU_ADDRESS 0xB0852 BIT_MASK 0x8000 /end MEASUREMENT
/begin MEASUREMENT DLSV15_B2 " 1 = 'US > usmax 'tusks-entprellt bank 2" UWORD B_TRUE 0 0 0.000000 1.000000 ECU_ADDRESS 0xB0854 BIT_MASK 0x8000 /end MEASUREMENT
/begin MEASUREMENT DLSV1_B1 " 1 = 'ushk1 >= usfhk bank 1" UWORD B_TRUE 0 0 0.000000 1.000000 ECU_ADDRESS 0xB0852 BIT_MASK 0x2 /end MEASUREMENT
/begin MEASUREMENT DLSV1_B2 " 1 = 'ushk2 > usfhk2 bank 2" UWORD B_TRUE 0 0 0.000000 1.000000 ECU_ADDRESS 0xB0854 BIT_MASK 0x2 /end MEASUREMENT
/begin MEASUREMENT DLSV2_B1 " 1 = 'US im Band usdbu...usdbo' bank 1" UWORD B_TRUE 0 0 0.000000 1.000000 ECU_ADDRESS 0xB0852 BIT_MASK 0x4 /end MEASUREMENT
/begin MEASUREMENT DLSV2_B2 " 1 = 'US im Band usdbu...usdbo' bank 2" UWORD B_TRUE 0 0 0.000000 1.000000 ECU_ADDRESS 0xB0854 BIT_MASK 0x4 /end MEASUREMENT
/begin MEASUREMENT DLSV3_B1 " 1 = 'US < usmin' bank 1" UWORD B_TRUE 0 0 0.000000 1.000000 ECU_ADDRESS 0xB0852 BIT_MASK 0x8 /end MEASUREMENT
/begin MEASUREMENT DLSV3_B2 " 1 = 'US < usmin' bank 2" UWORD B_TRUE 0 0 0.000000 1.000000 ECU_ADDRESS 0xB0854 BIT_MASK 0x8 /end MEASUREMENT
/begin MEASUREMENT DLSV6_B1 " 1 = 'b_adde OR b_vadge' bank 1" UWORD B_TRUE 0 0 0.000000 1.000000 ECU_ADDRESS 0xB0852 BIT_MASK 0x40 /end MEASUREMENT
/begin MEASUREMENT DLSV6_B2 " 1 = 'b_adde OR b_vadge' bank 1" UWORD B_TRUE 0 0 0.000000 1.000000 ECU_ADDRESS 0xB0854 BIT_MASK 0x40 /end MEASUREMENT
/begin MEASUREMENT DLSV7_B1 " 1 = 'US im Band usref...usmax' bank 1" UWORD B_TRUE 0 0 0.000000 1.000000 ECU_ADDRESS 0xB0852 BIT_MASK 0x80 /end MEASUREMENT
/begin MEASUREMENT DLSV7_B2 " 1 = 'US im Band usref...usmax' bank 2" UWORD B_TRUE 0 0 0.000000 1.000000 ECU_ADDRESS 0xB0854 BIT_MASK 0x80 /end MEASUREMENT
/begin MEASUREMENT DLSV8_B1 " 1 = 'US <= usrem' bank 1" UWORD B_TRUE 0 0 0.000000 1.000000 ECU_ADDRESS 0xB0852 BIT_MASK 0x100 /end MEASUREMENT
/begin MEASUREMENT DLSV8_B2 " 1 = 'US >= usrem' bank 2" UWORD B_TRUE 0 0 0.000000 1.000000 ECU_ADDRESS 0xB0854 BIT_MASK 0x100 /end MEASUREMENT
/begin MEASUREMENT DLSV9_B1 " 1 = dlsv9 = ( dlsv7 || ( dlsv8 && !dlsv6) )" UWORD B_TRUE 0 0 0.000000 1.000000 ECU_ADDRESS 0xB0852 BIT_MASK 0x200 /end MEASUREMENT
/begin MEASUREMENT DLSV9_B2 "dlsv9 = ( dlsv7 || ( dlsv8 && !dlsv6) )" UWORD B_TRUE 0 0 0.000000 1.000000 ECU_ADDRESS 0xB0854 BIT_MASK 0x200 /end MEASUREMENT
/begin MEASUREMENT DNSHIFT " EGS-Eingriff wirksam" UWORD B_TRUE 0 0 0.000000 1.000000 ECU_ADDRESS 0xFD9E BIT_MASK 0x8000 /end MEASUREMENT
/begin MEASUREMENT EB_BUNABH " Funktionsbit: bankunabhaengige Bedingungen" UWORD B_TRUE 0 0 0.000000 1.000000 ECU_ADDRESS 0xB089A BIT_MASK 0x4000 /end MEASUREMENT
/begin MEASUREMENT EGS_ANFA "> Anfahren v. Getriebe (alter Wert)" UWORD B_TRUE 0 0 0.000000 1.000000 ECU_ADDRESS 0xFD64 BIT_MASK 0x2000 /end MEASUREMENT
/begin MEASUREMENT EGS_AUTA "> Automatik-Modus (alter Wert)" UWORD B_TRUE 0 0 0.000000 1.000000 ECU_ADDRESS 0xFD66 BIT_MASK 0x2000 /end MEASUREMENT
/begin MEASUREMENT EGS_ES " Selespeed EngineStopSignal" UWORD B_TRUE 0 0 0.000000 1.000000 ECU_ADDRESS 0xFD60 BIT_MASK 0x4000 /end MEASUREMENT
/begin MEASUREMENT EGS_HPA " Hydraulik Pumpe von EGS aktiv" UWORD B_TRUE 0 0 0.000000 1.000000 ECU_ADDRESS 0xFD60 BIT_MASK 0x8000 /end MEASUREMENT
/begin MEASUREMENT EGS_LIMP " Selespeed LimpHomeStatus" UWORD B_TRUE 0 0 0.000000 1.000000 ECU_ADDRESS 0xFDB4 BIT_MASK 0x1 /end MEASUREMENT
/begin MEASUREMENT EGS_MDCS " Konstantphase Momentanforderung" UWORD B_TRUE 0 0 0.000000 1.000000 ECU_ADDRESS 0xFD14 BIT_MASK 0x8000 /end MEASUREMENT
/begin MEASUREMENT EGS_MDDA " alter Wert von egs_mddn" UWORD B_TRUE 0 0 0.000000 1.000000 ECU_ADDRESS 0xFD14 BIT_MASK 0x10 /end MEASUREMENT
/begin MEASUREMENT EGS_MDDN " Momentenreduktionsphase" UWORD B_TRUE 0 0 0.000000 1.000000 ECU_ADDRESS 0xFD14 BIT_MASK 0x2000 /end MEASUREMENT
/begin MEASUREMENT EGS_MDDNA " alter Wert von egs_mdda" UWORD B_TRUE 0 0 0.000000 1.000000 ECU_ADDRESS 0xFDAA BIT_MASK 0x4 /end MEASUREMENT
/begin MEASUREMENT EGS_MDOK " Hilfsbit fuer s_schalt Ueberwachung" UWORD B_TRUE 0 0 0.000000 1.000000 ECU_ADDRESS 0xFDAA BIT_MASK 0x400 /end MEASUREMENT
/begin MEASUREMENT EGS_MDUP " Momentenerhoehungsphase" UWORD B_TRUE 0 0 0.000000 1.000000 ECU_ADDRESS 0xFD14 BIT_MASK 0x4000 /end MEASUREMENT
/begin MEASUREMENT EGS_TC " 1 = Anforderung Schalteingriff" UWORD B_TRUE 0 0 0.000000 1.000000 ECU_ADDRESS 0xFDAA BIT_MASK 0x200 /end MEASUREMENT
/begin MEASUREMENT EI_ABGL_FR " = 1 : Abgleich fehlerhaft" UWORD B_TRUE 0 0 0.000000 1.000000 ECU_ADDRESS 0xFDA6 BIT_MASK 0x1 /end MEASUREMENT
/begin MEASUREMENT EI_ACCC_UC " Fehler-Bit SGS BT" UWORD B_TRUE 0 0 0.000000 1.000000 ECU_ADDRESS 0xFDF2 BIT_MASK 0x80 /end MEASUREMENT
/begin MEASUREMENT EI_AMSR_FR " = 1 : ASR/MSR-Botschaft unplausibel" UWORD B_TRUE 0 0 0.000000 1.000000 ECU_ADDRESS 0xFDA8 BIT_MASK 0x8 /end MEASUREMENT
/begin MEASUREMENT EI_BLD_FR " = 1 : Bremsinfo-Uebertragungs-Fehler" UWORD B_TRUE 0 0 0.000000 1.000000 ECU_ADDRESS 0xFDA8 BIT_MASK 0x10 /end MEASUREMENT
/begin MEASUREMENT EI_DCFF " = 1 : HW-Schutz hat vor uC-Abschaltung angesprochen" UWORD B_TRUE 0 0 0.000000 1.000000 ECU_ADDRESS 0xFDA6 BIT_MASK 0x400 /end MEASUREMENT
/begin MEASUREMENT EI_DCLR " = 1 : Stellgroesse DCLR in der Begrenzung" UWORD B_TRUE 0 0 0.000000 1.000000 ECU_ADDRESS 0xFDA6 BIT_MASK 0x200 /end MEASUREMENT
/begin MEASUREMENT EI_EGS_FR " = 1 : EGS-Botschaftszaehler-Fehler erkannt" UWORD B_TRUE 0 0 0.000000 1.000000 ECU_ADDRESS 0xFDA8 BIT_MASK 0x4 /end MEASUREMENT
/begin MEASUREMENT EI_KUPC_UM " Fehler-Bit Kupplungsueberwachung" UWORD B_TRUE 0 0 0.000000 1.000000 ECU_ADDRESS 0xFDF0 BIT_MASK 0x1000 /end MEASUREMENT
/begin MEASUREMENT EI_MSRC_UC " Fehler-Bit MSR BT" UWORD B_TRUE 0 0 0.000000 1.000000 ECU_ADDRESS 0xFDF2 BIT_MASK 0x1 /end MEASUREMENT
/begin MEASUREMENT EI_MVER_UC " Fehler-Bit Momentenvergleich BT" UWORD B_TRUE 0 0 0.000000 1.000000 ECU_ADDRESS 0xFDF0 BIT_MASK 0x400 /end MEASUREMENT
/begin MEASUREMENT EI_REAC_UC " Fehler-Bit aus F-Reac-UEW BT" UWORD B_TRUE 0 0 0.000000 1.000000 ECU_ADDRESS 0xFDF0 BIT_MASK 0x800 /end MEASUREMENT
/begin MEASUREMENT EI_SGSC_UC " Fehler-Bit SGS BT" UWORD B_TRUE 0 0 0.000000 1.000000 ECU_ADDRESS 0xFDF2 BIT_MASK 0x8 /end MEASUREMENT
/begin MEASUREMENT EMS_LL "> Leerlaufbedingungen erfuellt" UWORD B_TRUE 0 0 0.000000 1.000000 ECU_ADDRESS 0xFD06 BIT_MASK 0x1 /end MEASUREMENT
/begin MEASUREMENT ER_EGS_FR " EGS-Fehlermerker" UWORD B_TRUE 0 0 0.000000 1.000000 ECU_ADDRESS 0xFD9A BIT_MASK 0x2000 /end MEASUREMENT
/begin MEASUREMENT ER_LLR_OB " Leerlaufregler an der Obergrenze" UWORD B_TRUE 0 0 0.000000 1.000000 ECU_ADDRESS 0xFD9A BIT_MASK 0x8000 /end MEASUREMENT
/begin MEASUREMENT ER_LLR_UB " Leerlaufregler an der Untergrenze" UWORD B_TRUE 0 0 0.000000 1.000000 ECU_ADDRESS 0xFD9A BIT_MASK 0x4000 /end MEASUREMENT
/begin MEASUREMENT E_ACMVER " Fehler: irreversible ACC abschalten" UBYTE B_TRUE 0 0 0.000000 1.000000 ECU_ADDRESS 0xFDEE BIT_MASK 0x1 /end MEASUREMENT
/begin MEASUREMENT E_BC1 " CAN-Fehler: Nachrichtenfehler Body-Computer" UBYTE B_TRUE 0 0 0.000000 1.000000 ECU_ADDRESS 0xFDEA BIT_MASK 0x4 /end MEASUREMENT
/begin MEASUREMENT E_BC2 " CAN-Fehler: Nachrichtenfehler Body-Computer" UBYTE B_TRUE 0 0 0.000000 1.000000 ECU_ADDRESS 0xFDEA BIT_MASK 0x4 /end MEASUREMENT
/begin MEASUREMENT E_BREMSACC "1 = Speicher Bremsfehler ACC" UWORD B_TRUE 0 0 0.000000 1.000000 ECU_ADDRESS 0xFD72 BIT_MASK 0x80 /end MEASUREMENT
/begin MEASUREMENT E_BREMSE_F " Fehler Schalter Bremse mind. 1x erkannt." UWORD B_TRUE 0 0 0.000000 1.000000 ECU_ADDRESS 0xFD70 BIT_MASK 0x100 /end MEASUREMENT
/begin MEASUREMENT E_DKG " 1 = Fehler Drosselklappengeber" UBYTE B_TRUE 0 0 0.000000 1.000000 ECU_ADDRESS 0xFDE7 BIT_MASK 0x2 /end MEASUREMENT
/begin MEASUREMENT E_DUMMY " stehen lassen Dummy fuer Index 0" UBYTE B_TRUE 0 0 0.000000 1.000000 ECU_ADDRESS 0xFDE6 BIT_MASK 0x1 /end MEASUREMENT
/begin MEASUREMENT E_EKPE " 1 = Endstufenfehler EKP" UBYTE B_TRUE 0 0 0.000000 1.000000 ECU_ADDRESS 0xFDE9 BIT_MASK 0x40 /end MEASUREMENT
/begin MEASUREMENT E_FELA " Endstufenfehler Fehlerlampe" UBYTE B_TRUE 0 0 0.000000 1.000000 ECU_ADDRESS 0xFDE9 BIT_MASK 0x20 /end MEASUREMENT
/begin MEASUREMENT E_FGRE " Endstufen Fehler: FGR-Lampe" UBYTE B_TRUE 0 0 0.000000 1.000000 ECU_ADDRESS 0xFDEC BIT_MASK 0x10 /end MEASUREMENT
/begin MEASUREMENT E_FUEL_L " FuelLevelFailSts" UWORD B_TRUE 0 0 0.000000 1.000000 ECU_ADDRESS 0xFD6E BIT_MASK 0x100 /end MEASUREMENT
/begin MEASUREMENT E_HSVE1 " 1 = Endstufen-Fehler Lambda-Sondenheizung v. KAT Bank1" UBYTE B_TRUE 0 0 0.000000 1.000000 ECU_ADDRESS 0xFDEC BIT_MASK 0x2 /end MEASUREMENT
/begin MEASUREMENT E_IPDK " 1 = Fehler Istwertpoti" UBYTE B_TRUE 0 0 0.000000 1.000000 ECU_ADDRESS 0xFDE7 BIT_MASK 0x4 /end MEASUREMENT
/begin MEASUREMENT E_KOSE " Endstufenfehler Klimakompressor" UBYTE B_TRUE 0 0 0.000000 1.000000 ECU_ADDRESS 0xFDE9 BIT_MASK 0x10 /end MEASUREMENT
/begin MEASUREMENT E_LHI " Fehler Servolenkung" UWORD B_TRUE 0 0 0.000000 1.000000 ECU_ADDRESS 0xFD9E BIT_MASK 0x20 /end MEASUREMENT
/begin MEASUREMENT E_LL " Leerlauf-Fehler aus LFR-Diagnose" UBYTE B_TRUE 0 0 0.000000 1.000000 ECU_ADDRESS 0xFDE7 BIT_MASK 0x80 /end MEASUREMENT
/begin MEASUREMENT E_LUE1 "Fehler Endstufe Luefter 1 (Achtung: hier nicht endg. Pos.!!)" UWORD B_TRUE 0 0 0.000000 1.000000 ECU_ADDRESS 0xFD9C BIT_MASK 0x1000 /end MEASUREMENT
/begin MEASUREMENT E_LUES2 " Endstufen Fehler: Luefter Stufe 2" UBYTE B_TRUE 0 0 0.000000 1.000000 ECU_ADDRESS 0xFDE8 BIT_MASK 0x20 /end MEASUREMENT
/begin MEASUREMENT E_MD1 " Aussetzererkennung, abgasrelevant, (ASE Soft-Zyl.1)" UBYTE B_TRUE 0 0 0.000000 1.000000 ECU_ADDRESS 0xFDEA BIT_MASK 0x20 /end MEASUREMENT
/begin MEASUREMENT E_MD2 " Aussetzererkennung, abgasrelevant, (ASE Soft-Zyl.2)" UBYTE B_TRUE 0 0 0.000000 1.000000 ECU_ADDRESS 0xFDEA BIT_MASK 0x40 /end MEASUREMENT
/begin MEASUREMENT E_MD3 " Aussetzererkennung, abgasrelevant, (ASE Soft-Zyl.3)" UBYTE B_TRUE 0 0 0.000000 1.000000 ECU_ADDRESS 0xFDEA BIT_MASK 0x80 /end MEASUREMENT
/begin MEASUREMENT E_MD4 " Aussetzererkennung, abgasrelevant, (ASE Soft-Zyl.4)" UBYTE B_TRUE 0 0 0.000000 1.000000 ECU_ADDRESS 0xFDEB BIT_MASK 0x1 /end MEASUREMENT
/begin MEASUREMENT E_MD5 " Aussetzererkennung, abgasrelevant, (ASE Soft-Zyl.5)" UBYTE B_TRUE 0 0 0.000000 1.000000 ECU_ADDRESS 0xFDEB BIT_MASK 0x2 /end MEASUREMENT
/begin MEASUREMENT E_MILFB " Fehler: Mil fremdbestimmt / Mil-f.b. Leitung" UBYTE B_TRUE 0 0 0.000000 1.000000 ECU_ADDRESS 0xFDED BIT_MASK 0x40 /end MEASUREMENT
/begin MEASUREMENT E_PMOEL " Fehler Oeldruckschalter" UBYTE B_TRUE 0 0 0.000000 1.000000 ECU_ADDRESS 0xFDE7 BIT_MASK 0x1 /end MEASUREMENT
/begin MEASUREMENT E_SKAUM " 1 = Fehler SKA von Ueberwachungsfkt." UBYTE B_TRUE 0 0 0.000000 1.000000 ECU_ADDRESS 0xFDE7 BIT_MASK 0x40 /end MEASUREMENT
/begin MEASUREMENT E_UBAT " 1 = Ubatt fehlerhaft" UBYTE B_TRUE 0 0 0.000000 1.000000 ECU_ADDRESS 0xFDE6 BIT_MASK 0x80 /end MEASUREMENT
/begin MEASUREMENT E_WFS " Wegfahrsperren Fehler" UBYTE B_TRUE 0 0 0.000000 1.000000 ECU_ADDRESS 0xFDE8 BIT_MASK 0x8 /end MEASUREMENT
/begin MEASUREMENT FDBKASR " Feedback ASR-Eingriff" UWORD B_TRUE 0 0 0.000000 1.000000 ECU_ADDRESS 0xFD26 BIT_MASK 0x1 /end MEASUREMENT
/begin MEASUREMENT FF_L2_OUT " Ausgang FF_QLUE2" UWORD B_TRUE 0 0 0.000000 1.000000 ECU_ADDRESS 0xFD9C BIT_MASK 0x40 /end MEASUREMENT
/begin MEASUREMENT F_UK1_PRE " 1 = Interpolation von KLWF findet statt." UWORD B_TRUE 0 0 0.000000 1.000000 ECU_ADDRESS 0xFD2A BIT_MASK 0x4 /end MEASUREMENT
/begin MEASUREMENT F_UK2_PRE " 1 = 10-ms-synch. UK wird bei keinem DK-Fehler im naech Durchl ber." UWORD B_TRUE 0 0 0.000000 1.000000 ECU_ADDRESS 0xFD2A BIT_MASK 0x8 /end MEASUREMENT
/begin MEASUREMENT F_UKNS " 1 = UKSEFI anhand Zeit nach Startende erlaubt" UWORD B_DEZ 0 0 0.000000 1.000000 ECU_ADDRESS 0xFD2A BIT_MASK 0x40 /end MEASUREMENT
/begin MEASUREMENT F_UKW " 1 = 10ms-synchr. UK wird ausgegeben und wirkt aufs ti" UWORD B_DEZ 0 0 0.000000 1.000000 ECU_ADDRESS 0xFD2A BIT_MASK 0x10 /end MEASUREMENT
/begin MEASUREMENT F_UKWLL " langer Leerlauf" UWORD B_TRUE 0 0 0.000000 1.000000 ECU_ADDRESS 0xFD2A BIT_MASK 0x400 /end MEASUREMENT
/begin MEASUREMENT F_VAKTUELL " aktueller Messwert fuer Geschwindigkeit liegt vor" UWORD B_TRUE 0 0 0.000000 1.000000 ECU_ADDRESS 0xFDD4 BIT_MASK 0x10 /end MEASUREMENT
/begin MEASUREMENT HFMKENA " HFM-Startkorr. 'enable'" UWORD B_TRUE 0 0 0.000000 1.000000 ECU_ADDRESS 0xFD64 BIT_MASK 0x80 /end MEASUREMENT
/begin MEASUREMENT HR_AUS " WFS gibt Abschalten des Halterelais frei" UWORD B_TRUE 0 0 0.000000 1.000000 ECU_ADDRESS 0xFDD4 BIT_MASK 0x2 /end MEASUREMENT
/begin MEASUREMENT LFS_HB0 " Hilfsbit 0 fuer Lueftersteuerung" UWORD B_TRUE 0 0 0.000000 1.000000 ECU_ADDRESS 0xFD9C BIT_MASK 0x80 /end MEASUREMENT
/begin MEASUREMENT LFS_HB1 " Hilfsbit 1 fuer Lueftersteuerung" UWORD B_TRUE 0 0 0.000000 1.000000 ECU_ADDRESS 0xFD9C BIT_MASK 0x100 /end MEASUREMENT
/begin MEASUREMENT LUT_NEG " Rechengroesse" UWORD B_TRUE 0 0 0.000000 1.000000 ECU_ADDRESS 0xFDBA BIT_MASK 0x2 /end MEASUREMENT
/begin MEASUREMENT MDDNNCA_VD " ValidData Drehmomentreduktion" UWORD B_TRUE 0 0 0.000000 1.000000 ECU_ADDRESS 0xFDB6 BIT_MASK 0x10 /end MEASUREMENT
/begin MEASUREMENT MDMXNCA_VD " ValidData Drehmomentbegrenzung" UWORD B_TRUE 0 0 0.000000 1.000000 ECU_ADDRESS 0xFDB6 BIT_MASK 0x20 /end MEASUREMENT
/begin MEASUREMENT MDUPNCA_VD " ValidData Drehmomentanhebung" UWORD B_TRUE 0 0 0.000000 1.000000 ECU_ADDRESS 0xFDB6 BIT_MASK 0x8 /end MEASUREMENT
/begin MEASUREMENT MI_REQ " GetriebeAnforderung: MIL einschalten" UWORD B_TRUE 0 0 0.000000 1.000000 ECU_ADDRESS 0xFDB6 BIT_MASK 0x1 /end MEASUREMENT
/begin MEASUREMENT MSR_VD " ValidData MSR" UWORD B_TRUE 0 0 0.000000 1.000000 ECU_ADDRESS 0xFDB4 BIT_MASK 0x800 /end MEASUREMENT
/begin MEASUREMENT NEU_NEG " Rechengroesse" UWORD B_TRUE 0 0 0.000000 1.000000 ECU_ADDRESS 0xFDBA BIT_MASK 0x40 /end MEASUREMENT
/begin MEASUREMENT NWS_EN " Ausloesung Drive-Recorder Messung " UWORD B_TRUE 0 0 0.000000 1.000000 ECU_ADDRESS 0xFD7E BIT_MASK 0x8 /end MEASUREMENT
/begin MEASUREMENT NWS_ENKH " Ausloesung Drive-Recorder Messung " UWORD B_TRUE 0 0 0.000000 1.000000 ECU_ADDRESS 0xFD7E BIT_MASK 0x10 /end MEASUREMENT
/begin MEASUREMENT NWS_HLP " Ausloesung Drive-Recorder Messung " UWORD B_TRUE 0 0 0.000000 1.000000 ECU_ADDRESS 0xFD7E BIT_MASK 0x4 /end MEASUREMENT
/begin MEASUREMENT NWS_LL " NWS-Hilfsbit: Leerlaufschwelle" UWORD B_TRUE 0 0 0.000000 1.000000 ECU_ADDRESS 0xFD0E BIT_MASK 0x200 /end MEASUREMENT
/begin MEASUREMENT NWS_TMOT " NWS-Hilfsbit: Schwelle Tmot" UWORD B_TRUE 0 0 0.000000 1.000000 ECU_ADDRESS 0xFD0E BIT_MASK 0x80 /end MEASUREMENT
/begin MEASUREMENT NWS_WDK " NWS-Hilfsbit: Hysterese DK-Winkel" UWORD B_TRUE 0 0 0.000000 1.000000 ECU_ADDRESS 0xFD0E BIT_MASK 0x100 /end MEASUREMENT
/begin MEASUREMENT NWS_WRM " NWS-Hilfsbit: Verzoegerung im Start" UWORD B_TRUE 0 0 0.000000 1.000000 ECU_ADDRESS 0xFD0E BIT_MASK 0x40 /end MEASUREMENT
/begin MEASUREMENT OBF0 " Filtermittenfrequenz BF0" UWORD B_TRUE 0 0 0.000000 1.000000 ECU_ADDRESS 0xFD00 BIT_MASK 0x40 /end MEASUREMENT
/begin MEASUREMENT OBF1 " Filtermittenfrequenz BF1" UWORD B_TRUE 0 0 0.000000 1.000000 ECU_ADDRESS 0xFD00 BIT_MASK 0x80 /end MEASUREMENT
/begin MEASUREMENT OKRS1 " KR-Klopfsensorauswahlsignal Nr.1" UWORD B_TRUE 0 0 0.000000 1.000000 ECU_ADDRESS 0xFD00 BIT_MASK 0x8 /end MEASUREMENT
/begin MEASUREMENT OKRS3 " KR-Klopfsensorauswahlsignal Nr.3" UWORD B_TRUE 0 0 0.000000 1.000000 ECU_ADDRESS 0xFD00 BIT_MASK 0x20 /end MEASUREMENT
/begin MEASUREMENT OKRTI " KR-Testimpuls" UWORD B_TRUE 0 0 0.000000 1.000000 ECU_ADDRESS 0xFD00 BIT_MASK 0x10 /end MEASUREMENT
/begin MEASUREMENT OKRV1 " KR-Verstaerkungsfaktorauswahlsig. Nr.1" UWORD B_TRUE 0 0 0.000000 1.000000 ECU_ADDRESS 0xFD00 BIT_MASK 0x1 /end MEASUREMENT
/begin MEASUREMENT OKRV2 " KR-Verstaerkungsfaktorauswahlsig. Nr.2" UWORD B_TRUE 0 0 0.000000 1.000000 ECU_ADDRESS 0xFD00 BIT_MASK 0x2 /end MEASUREMENT
/begin MEASUREMENT OKRV3 " KR-Verstaerkungsfaktorauswahlsig. Nr.3" UWORD B_TRUE 0 0 0.000000 1.000000 ECU_ADDRESS 0xFD00 BIT_MASK 0x4 /end MEASUREMENT
/begin MEASUREMENT PECFIRST " 1 = bis ersten drei Zahnflanken (neg. Fl) registriert wurden" UWORD B_TRUE 0 0 0.000000 1.000000 ECU_ADDRESS 0xFD10 BIT_MASK 0x1 /end MEASUREMENT
/begin MEASUREMENT SAS0 " 1 = Zylinder 0 spritzt nicht ein" UWORD B_TRUE 0 0 0.000000 1.000000 ECU_ADDRESS 0xFD1A BIT_MASK 0x1 /end MEASUREMENT
/begin MEASUREMENT SAS1 " 1 = Zylinder 1 spritzt nicht ein" UWORD B_TRUE 0 0 0.000000 1.000000 ECU_ADDRESS 0xFD1A BIT_MASK 0x2 /end MEASUREMENT
/begin MEASUREMENT SAS2 " 1 = Zylinder 2 spritzt nicht ein" UWORD B_TRUE 0 0 0.000000 1.000000 ECU_ADDRESS 0xFD1A BIT_MASK 0x4 /end MEASUREMENT
/begin MEASUREMENT SAS3 " 1 = Zylinder 3 spritzt nicht ein" UWORD B_TRUE 0 0 0.000000 1.000000 ECU_ADDRESS 0xFD1A BIT_MASK 0x8 /end MEASUREMENT
/begin MEASUREMENT SAS4 " 1 = Zylinder 4 spritzt nicht ein" UWORD B_TRUE 0 0 0.000000 1.000000 ECU_ADDRESS 0xFD1A BIT_MASK 0x10 /end MEASUREMENT
/begin MEASUREMENT SAS5 " 1 = Zylinder 5 spritzt nicht ein" UWORD B_TRUE 0 0 0.000000 1.000000 ECU_ADDRESS 0xFD1A BIT_MASK 0x20 /end MEASUREMENT
/begin MEASUREMENT SAS6 " 1 = Zylinder 6 spritzt nicht ein" UWORD B_TRUE 0 0 0.000000 1.000000 ECU_ADDRESS 0xFD1A BIT_MASK 0x40 /end MEASUREMENT
/begin MEASUREMENT SAS7 " 1 = Zylinder 7 spritzt nicht ein" UWORD B_TRUE 0 0 0.000000 1.000000 ECU_ADDRESS 0xFD1A BIT_MASK 0x80 /end MEASUREMENT
/begin MEASUREMENT SB15_B1 " 1 = ushk_tmp > usmax u. tusks abgelaufen" UWORD B_TRUE 0 0 0.000000 1.000000 ECU_ADDRESS 0xB086E BIT_MASK 0x8000 /end MEASUREMENT
/begin MEASUREMENT SB15_B2 " 1 = ushk_tmp > usmax u. tusks abgelaufen" UWORD B_TRUE 0 0 0.000000 1.000000 ECU_ADDRESS 0xB0870 BIT_MASK 0x8000 /end MEASUREMENT
/begin MEASUREMENT SB3_B1 " 1 = ushk_tmp < USMIN" UWORD B_TRUE 0 0 0.000000 1.000000 ECU_ADDRESS 0xB086E BIT_MASK 0x8 /end MEASUREMENT
/begin MEASUREMENT SB3_B2 " 1 = ushk_tmp < USMIN" UWORD B_TRUE 0 0 0.000000 1.000000 ECU_ADDRESS 0xB0870 BIT_MASK 0x8 /end MEASUREMENT
/begin MEASUREMENT SB7_B1 " 1 = usrefh <=ushk_tmp <= usmax" UWORD B_TRUE 0 0 0.000000 1.000000 ECU_ADDRESS 0xB086E BIT_MASK 0x80 /end MEASUREMENT
/begin MEASUREMENT SB7_B2 " 1 = usrefh <=ushk_tmp <= usmax" UWORD B_TRUE 0 0 0.000000 1.000000 ECU_ADDRESS 0xB0870 BIT_MASK 0x80 /end MEASUREMENT
/begin MEASUREMENT SB8_B1 " 1 = ushk_tmp <= usremh" UWORD B_TRUE 0 0 0.000000 1.000000 ECU_ADDRESS 0xB086E BIT_MASK 0x100 /end MEASUREMENT
/begin MEASUREMENT SB8_B2 " 1 = ushk_tmp <= usremh" UWORD B_TRUE 0 0 0.000000 1.000000 ECU_ADDRESS 0xB0870 BIT_MASK 0x100 /end MEASUREMENT
/begin MEASUREMENT SB9_B1 " 1 = sb.sb7 || ( sb.sb8 && !db.b_adsh) )" UWORD B_TRUE 0 0 0.000000 1.000000 ECU_ADDRESS 0xB086E BIT_MASK 0x200 /end MEASUREMENT
/begin MEASUREMENT SB9_B2 " 1 = sb.sb7 || ( sb.sb8 && !db.b_adsh) )" UWORD B_TRUE 0 0 0.000000 1.000000 ECU_ADDRESS 0xB0870 BIT_MASK 0x200 /end MEASUREMENT
/begin MEASUREMENT SPONTAN0 " 1 = Spontanausloesung an EV0" UWORD B_TRUE 0 0 0.000000 1.000000 ECU_ADDRESS 0xFD18 BIT_MASK 0x100 /end MEASUREMENT
/begin MEASUREMENT SPONTAN1 " 1 = Spontanausloesung an EV1" UWORD B_TRUE 0 0 0.000000 1.000000 ECU_ADDRESS 0xFD18 BIT_MASK 0x200 /end MEASUREMENT
/begin MEASUREMENT SPONTAN2 " 1 = Spontanausloesung an EV2" UWORD B_TRUE 0 0 0.000000 1.000000 ECU_ADDRESS 0xFD18 BIT_MASK 0x400 /end MEASUREMENT
/begin MEASUREMENT SPONTAN3 " 1 = Spontanausloesung an EV3" UWORD B_TRUE 0 0 0.000000 1.000000 ECU_ADDRESS 0xFD18 BIT_MASK 0x800 /end MEASUREMENT
/begin MEASUREMENT SPONTAN4 " 1 = Spontanausloesung an EV4" UWORD B_TRUE 0 0 0.000000 1.000000 ECU_ADDRESS 0xFD18 BIT_MASK 0x1000 /end MEASUREMENT
/begin MEASUREMENT SPONTAN5 " 1 = Spontanausloesung an EV5" UWORD B_TRUE 0 0 0.000000 1.000000 ECU_ADDRESS 0xFD18 BIT_MASK 0x2000 /end MEASUREMENT
/begin MEASUREMENT SPONTAN6 " 1 = Spontanausloesung an EV6" UWORD B_TRUE 0 0 0.000000 1.000000 ECU_ADDRESS 0xFD18 BIT_MASK 0x4000 /end MEASUREMENT
/begin MEASUREMENT SPONTAN7 " 1 = Spontanausloesung an EV7" UWORD B_TRUE 0 0 0.000000 1.000000 ECU_ADDRESS 0xFD18 BIT_MASK 0x8000 /end MEASUREMENT
/begin MEASUREMENT START " 1 = 1. Zahnflanke erkannt" UWORD B_TRUE 0 0 0.000000 1.000000 ECU_ADDRESS 0xFD10 BIT_MASK 0x10 /end MEASUREMENT
/begin MEASUREMENT SYNCHRO " 1 = Einspritzung schon synchronisiert" UWORD B_TRUE 0 0 0.000000 1.000000 ECU_ADDRESS 0xFD10 BIT_MASK 0x40 /end MEASUREMENT
/begin MEASUREMENT SYNCSTART " 1 = Entprellung beendet" UWORD B_TRUE 0 0 0.000000 1.000000 ECU_ADDRESS 0xFD10 BIT_MASK 0x20 /end MEASUREMENT
/begin MEASUREMENT S_DHSV1 " '1'= %DHLS Heizung v.KAT Bank1 gesperrt" UWORD B_TRUE 0 0 0.000000 1.000000 ECU_ADDRESS 0xFDAC BIT_MASK 0x200 /end MEASUREMENT
/begin MEASUREMENT S_DHSV2 " '1'= %DHLS Heizung v.KAT Bank2 gesperrt" UWORD B_TRUE 0 0 0.000000 1.000000 ECU_ADDRESS 0xFDAE BIT_MASK 0x8 /end MEASUREMENT
/begin MEASUREMENT S_DKAT1 " '1'= %DKAT Bank1 gesperrt" UWORD B_TRUE 0 0 0.000000 1.000000 ECU_ADDRESS 0xFDAC BIT_MASK 0x10 /end MEASUREMENT
/begin MEASUREMENT S_DKAT2 " '1'= %DKAT Bank2 gesperrt" UWORD B_TRUE 0 0 0.000000 1.000000 ECU_ADDRESS 0xFDAE BIT_MASK 0x1 /end MEASUREMENT
/begin MEASUREMENT S_DLASH1 " '1'= %DLSA SH Bank1 gesperrt" UWORD B_TRUE 0 0 0.000000 1.000000 ECU_ADDRESS 0xFDAC BIT_MASK 0x800 /end MEASUREMENT
/begin MEASUREMENT S_DLASH2 " '1'= %DLSA SH Bank2 gesperrt" UWORD B_TRUE 0 0 0.000000 1.000000 ECU_ADDRESS 0xFDAE BIT_MASK 0x20 /end MEASUREMENT
/begin MEASUREMENT S_DLATP1 " '1'= %DLSA TP Bank1 gesperrt" UWORD B_TRUE 0 0 0.000000 1.000000 ECU_ADDRESS 0xFDAC BIT_MASK 0x2000 /end MEASUREMENT
/begin MEASUREMENT S_DLATP2 " '1'= %DLSA TP Bank2 gesperrt" UWORD B_TRUE 0 0 0.000000 1.000000 ECU_ADDRESS 0xFDAE BIT_MASK 0x80 /end MEASUREMENT
/begin MEASUREMENT S_DLATV1 " '1'= %DLSA ATV Bank1 gesperrt" UWORD B_TRUE 0 0 0.000000 1.000000 ECU_ADDRESS 0xFDAC BIT_MASK 0x1000 /end MEASUREMENT
/begin MEASUREMENT S_DLATV2 " '1'= %DLSA ATV Bank2 gesperrt" UWORD B_TRUE 0 0 0.000000 1.000000 ECU_ADDRESS 0xFDAE BIT_MASK 0x40 /end MEASUREMENT
/begin MEASUREMENT S_DLSH1 " '1'= %DLSH Bank1 gesperrt" UWORD B_TRUE 0 0 0.000000 1.000000 ECU_ADDRESS 0xFDAC BIT_MASK 0x100 /end MEASUREMENT
/begin MEASUREMENT S_DLSH2 " '1'= %DLSH Bank2 gesperrt" UWORD B_TRUE 0 0 0.000000 1.000000 ECU_ADDRESS 0xFDAE BIT_MASK 0x4 /end MEASUREMENT
/begin MEASUREMENT S_FS " Schalter Fahrstufe Automat" UWORD B_TRUE 0 0 0.000000 1.000000 ECU_ADDRESS 0xFDB2 BIT_MASK 0x4 /end MEASUREMENT
/begin MEASUREMENT S_GLOBAL " Globales Sperrflag" UWORD B_TRUE 0 0 0.000000 1.000000 ECU_ADDRESS 0xFDAC BIT_MASK 0x1 /end MEASUREMENT
/begin MEASUREMENT S_GLOBAL12 " Globales Sperrflag (andere ME)" UWORD B_TRUE 0 0 0.000000 1.000000 ECU_ADDRESS 0xFDAC BIT_MASK 0x2 /end MEASUREMENT
/begin MEASUREMENT S_KO_HLP "1= Tankentlueftung abbruchbereit" UWORD B_TRUE 0 0 0.000000 1.000000 ECU_ADDRESS 0xFD7A BIT_MASK 0x8000 /end MEASUREMENT
/begin MEASUREMENT S_LR1 " '1'= L-Regelung Bank1 gesperrt" UWORD B_TRUE 0 0 0.000000 1.000000 ECU_ADDRESS 0xFDAC BIT_MASK 0x4 /end MEASUREMENT
/begin MEASUREMENT S_LR2 " '1'= L-Regelung Bank2 gesperrt" UWORD B_TRUE 0 0 0.000000 1.000000 ECU_ADDRESS 0xFDAC BIT_MASK 0x8 /end MEASUREMENT
/begin MEASUREMENT S_LRSLS1 " '1'= LR gesperrt (ohne E_sls)" UWORD B_TRUE 0 0 0.000000 1.000000 ECU_ADDRESS 0xFDAE BIT_MASK 0x100 /end MEASUREMENT
/begin MEASUREMENT S_LRSLS2 " '1'= LR (Bank 2) gesperrt (ohne E_sls)" UWORD B_TRUE 0 0 0.000000 1.000000 ECU_ADDRESS 0xFDAE BIT_MASK 0x200 /end MEASUREMENT
/begin MEASUREMENT S_L_HLP1 " Ausloesung Drive-Recorder Messung " UWORD B_TRUE 0 0 0.000000 1.000000 ECU_ADDRESS 0xFD92 BIT_MASK 0x200 /end MEASUREMENT
/begin MEASUREMENT S_L_HLP2 " Ausloesung Drive-Recorder Messung " UWORD B_TRUE 0 0 0.000000 1.000000 ECU_ADDRESS 0xFD92 BIT_MASK 0x400 /end MEASUREMENT
/begin MEASUREMENT TDAFLU1_OU " Timerausgang Ausschaltverz. LFS1" UWORD B_TRUE 0 0 0.000000 1.000000 ECU_ADDRESS 0xFD9C BIT_MASK 0x200 /end MEASUREMENT
/begin MEASUREMENT TDEFLU2_OU " Timerausgang Einschaltverz. LFS2" UWORD B_TRUE 0 0 0.000000 1.000000 ECU_ADDRESS 0xFD9C BIT_MASK 0x400 /end MEASUREMENT
/begin MEASUREMENT TDLU1_OUT " Timerausgang Verzoegerungstimer 1 bei LFS" UWORD B_TRUE 0 0 0.000000 1.000000 ECU_ADDRESS 0xFD9C BIT_MASK 0x800 /end MEASUREMENT
/begin MEASUREMENT TI_CHA0 " 1 = in diesem Segment wird EV0 doppelt gewechselt" UWORD B_TRUE 0 0 0.000000 1.000000 ECU_ADDRESS 0xFD18 BIT_MASK 0x1 /end MEASUREMENT
/begin MEASUREMENT TI_CHA1 " 1 = in diesem Segment wird EV1 doppelt gewechselt" UWORD B_TRUE 0 0 0.000000 1.000000 ECU_ADDRESS 0xFD18 BIT_MASK 0x2 /end MEASUREMENT
/begin MEASUREMENT TI_CHA2 " 1 = in diesem Segment wird EV2 doppelt gewechselt" UWORD B_TRUE 0 0 0.000000 1.000000 ECU_ADDRESS 0xFD18 BIT_MASK 0x4 /end MEASUREMENT
/begin MEASUREMENT TI_CHA3 " 1 = in diesem Segment wird EV3 doppelt gewechselt" UWORD B_TRUE 0 0 0.000000 1.000000 ECU_ADDRESS 0xFD18 BIT_MASK 0x8 /end MEASUREMENT
/begin MEASUREMENT TI_CHA4 " 1 = in diesem Segment wird EV4 doppelt gewechselt" UWORD B_TRUE 0 0 0.000000 1.000000 ECU_ADDRESS 0xFD18 BIT_MASK 0x10 /end MEASUREMENT
/begin MEASUREMENT TI_CHA5 " 1 = in diesem Segment wird EV5 doppelt gewechselt" UWORD B_TRUE 0 0 0.000000 1.000000 ECU_ADDRESS 0xFD18 BIT_MASK 0x20 /end MEASUREMENT
/begin MEASUREMENT TI_CHA6 " 1 = in diesem Segment wird EV6 doppelt gewechselt" UWORD B_TRUE 0 0 0.000000 1.000000 ECU_ADDRESS 0xFD18 BIT_MASK 0x40 /end MEASUREMENT
/begin MEASUREMENT TI_CHA7 " 1 = in diesem Segment wird EV7 doppelt gewechselt" UWORD B_TRUE 0 0 0.000000 1.000000 ECU_ADDRESS 0xFD18 BIT_MASK 0x80 /end MEASUREMENT
/begin MEASUREMENT TI_OUT0 " 1 = in diesem Segment wird EV0 geschlossen" UWORD B_TRUE 0 0 0.000000 1.000000 ECU_ADDRESS 0xFD16 BIT_MASK 0x100 /end MEASUREMENT
/begin MEASUREMENT TI_OUT1 " 1 = in diesem Segment wird EV1 geschlossen" UWORD B_TRUE 0 0 0.000000 1.000000 ECU_ADDRESS 0xFD16 BIT_MASK 0x200 /end MEASUREMENT
/begin MEASUREMENT TI_OUT2 " 1 = in diesem Segment wird EV2 geschlossen" UWORD B_TRUE 0 0 0.000000 1.000000 ECU_ADDRESS 0xFD16 BIT_MASK 0x400 /end MEASUREMENT
/begin MEASUREMENT TI_OUT3 " 1 = in diesem Segment wird EV3 geschlossen" UWORD B_TRUE 0 0 0.000000 1.000000 ECU_ADDRESS 0xFD16 BIT_MASK 0x800 /end MEASUREMENT
/begin MEASUREMENT TI_OUT4 " 1 = in diesem Segment wird EV4 geschlossen" UWORD B_TRUE 0 0 0.000000 1.000000 ECU_ADDRESS 0xFD16 BIT_MASK 0x1000 /end MEASUREMENT
/begin MEASUREMENT TI_OUT5 " 1 = in diesem Segment wird EV5 geschlossen" UWORD B_TRUE 0 0 0.000000 1.000000 ECU_ADDRESS 0xFD16 BIT_MASK 0x2000 /end MEASUREMENT
/begin MEASUREMENT TI_OUT6 " 1 = in diesem Segment wird EV6 geschlossen" UWORD B_TRUE 0 0 0.000000 1.000000 ECU_ADDRESS 0xFD16 BIT_MASK 0x4000 /end MEASUREMENT
/begin MEASUREMENT TI_OUT7 " 1 = in diesem Segment wird EV7 geschlossen" UWORD B_TRUE 0 0 0.000000 1.000000 ECU_ADDRESS 0xFD16 BIT_MASK 0x8000 /end MEASUREMENT
/begin MEASUREMENT TI_WAI0 " 1 = in diesem Segment wird EV0 geoeffnet" UWORD B_TRUE 0 0 0.000000 1.000000 ECU_ADDRESS 0xFD16 BIT_MASK 0x1 /end MEASUREMENT
/begin MEASUREMENT TI_WAI1 " 1 = in diesem Segment wird EV1 geoeffnet" UWORD B_TRUE 0 0 0.000000 1.000000 ECU_ADDRESS 0xFD16 BIT_MASK 0x2 /end MEASUREMENT
/begin MEASUREMENT TI_WAI2 " 1 = in diesem Segment wird EV2 geoeffnet" UWORD B_TRUE 0 0 0.000000 1.000000 ECU_ADDRESS 0xFD16 BIT_MASK 0x4 /end MEASUREMENT
/begin MEASUREMENT TI_WAI3 " 1 = in diesem Segment wird EV3 geoeffnet" UWORD B_TRUE 0 0 0.000000 1.000000 ECU_ADDRESS 0xFD16 BIT_MASK 0x8 /end MEASUREMENT
/begin MEASUREMENT TI_WAI4 " 1 = in diesem Segment wird EV4 geoeffnet" UWORD B_TRUE 0 0 0.000000 1.000000 ECU_ADDRESS 0xFD16 BIT_MASK 0x10 /end MEASUREMENT
/begin MEASUREMENT TI_WAI5 " 1 = in diesem Segment wird EV5 geoeffnet" UWORD B_TRUE 0 0 0.000000 1.000000 ECU_ADDRESS 0xFD16 BIT_MASK 0x20 /end MEASUREMENT
/begin MEASUREMENT TI_WAI6 " 1 = in diesem Segment wird EV6 geoeffnet" UWORD B_TRUE 0 0 0.000000 1.000000 ECU_ADDRESS 0xFD16 BIT_MASK 0x40 /end MEASUREMENT
/begin MEASUREMENT TI_WAI7 " 1 = in diesem Segment wird EV7 geoeffnet" UWORD B_TRUE 0 0 0.000000 1.000000 ECU_ADDRESS 0xFD16 BIT_MASK 0x80 /end MEASUREMENT
/begin MEASUREMENT TM_EGS_VD " ValidData Getriebetemperatur" UWORD B_TRUE 0 0 0.000000 1.000000 ECU_ADDRESS 0xFDB6 BIT_MASK 0x2 /end MEASUREMENT
/begin MEASUREMENT TR_UK_DA " 1 = TR-synch. UK fand statt -> W-Speicher im 10-ms-Raster loeschen" UWORD B_TRUE 0 0 0.000000 1.000000 ECU_ADDRESS 0xFD2A BIT_MASK 0x2 /end MEASUREMENT
/begin MEASUREMENT T_BFOF " 1 = temp. B_FOF (Nowe)" UWORD B_TRUE 0 0 0.000000 1.000000 ECU_ADDRESS 0xFDBA BIT_MASK 0x200 /end MEASUREMENT
/begin MEASUREMENT T_BFOF1 " 1 = temp. B_FOF (Zyl1)" UWORD B_TRUE 0 0 0.000000 1.000000 ECU_ADDRESS 0xFDBA BIT_MASK 0x400 /end MEASUREMENT
/begin MEASUREMENT T_BFON " 1 = temp. B_FON (Nowe)" UWORD B_TRUE 0 0 0.000000 1.000000 ECU_ADDRESS 0xFDBA BIT_MASK 0x80 /end MEASUREMENT
/begin MEASUREMENT T_BFON1 " 1 = temp. B_FON (Zyl1)" UWORD B_TRUE 0 0 0.000000 1.000000 ECU_ADDRESS 0xFDBA BIT_MASK 0x100 /end MEASUREMENT
/begin MEASUREMENT VRAD_LH_VD " VRD_LH ValidData" UWORD B_TRUE 0 0 0.000000 1.000000 ECU_ADDRESS 0xFD72 BIT_MASK 0x200 /end MEASUREMENT
/begin MEASUREMENT VRAD_LV_VD " VRD_LV ValidData" UWORD B_TRUE 0 0 0.000000 1.000000 ECU_ADDRESS 0xFD72 BIT_MASK 0x800 /end MEASUREMENT
/begin MEASUREMENT VRAD_RH_VD " VRD_RH ValidData" UWORD B_TRUE 0 0 0.000000 1.000000 ECU_ADDRESS 0xFD72 BIT_MASK 0x100 /end MEASUREMENT
/begin MEASUREMENT VRAD_RV_VD " VRD_RV ValidData" UWORD B_TRUE 0 0 0.000000 1.000000 ECU_ADDRESS 0xFD72 BIT_MASK 0x400 /end MEASUREMENT
/begin MEASUREMENT WFS_C_UP " 1 = Update WFS Code erfolgte" UWORD B_TRUE 0 0 0.000000 1.000000 ECU_ADDRESS 0xFD6E BIT_MASK 0x200 /end MEASUREMENT
/begin MEASUREMENT ZAHNEPRL " 1 = wenn Zahnentprellung beendet" UWORD B_TRUE 0 0 0.000000 1.000000 ECU_ADDRESS 0xFD10 BIT_MASK 0x8 /end MEASUREMENT
/begin MEASUREMENT ZEITEPRL " 1 = wenn Zeitentprellung beendet" UWORD B_TRUE 0 0 0.000000 1.000000 ECU_ADDRESS 0xFD10 BIT_MASK 0x4 /end MEASUREMENT
/begin MEASUREMENT _B_COMERRO " Uebertragung zum ASIC ohne SSC-Error" UWORD B_TRUE 0 0 0.000000 1.000000 ECU_ADDRESS 0xFD64 BIT_MASK 0x1 /end MEASUREMENT
/begin MEASUREMENT _B_NEWEEPR " 1 = EEPROM noch unprogrammiert" UWORD B_TRUE 0 0 0.000000 1.000000 ECU_ADDRESS 0xFD04 BIT_MASK 0x8000 /end MEASUREMENT
/end MODULE
/end PROJECT
