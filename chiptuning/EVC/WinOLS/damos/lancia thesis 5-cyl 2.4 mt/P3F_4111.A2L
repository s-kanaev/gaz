ASAP2_VERSION 1 3
/begin PROJECT _ " [ME.ME3.1C.09.4111.DAMOS25]  DAMPAR_04"
/begin HEADER "Lancia Thesis 5-Zyl. 2,4 MT" PROJECT_NO 411.1 VERSION "P2FJGD66" /end HEADER
/begin MODULE DIM " "
/begin MOD_COMMON " " S_REC_LAYOUT DAMOS DEPOSIT ABSOLUTE BYTE_ORDER MSB_LAST /end MOD_COMMON
/begin COMPU_METHOD BSCHL_25L "Darstellung 0 bis 25 " RAT_FUNC "%5.2" "g" COEFFS 0 2621.000000 0.000000 0 0.000000 1.000000 /end COMPU_METHOD
/begin COMPU_METHOD BSCHL_S5L "Darstellung -6.25 bis 6.249 " RAT_FUNC "%5.3" "g" COEFFS 0 5242.000000 3.276800e+04 0 0.000000 1.000000 /end COMPU_METHOD
/begin COMPU_METHOD B_DEZ "log Zustand" TAB_VERB "%7.5" "" COMPU_TAB_REF B_DEZ /end COMPU_METHOD
/begin COMPU_METHOD B_TRUE "True" TAB_VERB "%7.5" "" COMPU_TAB_REF B_TRUE /end COMPU_METHOD
/begin COMPU_METHOD CLU_TMP "Ansaugluft-Temperatur" TAB_INTP "%7.3" "grd C" COMPU_TAB_REF CLU_TMP /end COMPU_METHOD
/begin COMPU_METHOD CMO_TMP "Motor-Temperatur (invers)" TAB_INTP "%7.3" "Grad C" COMPU_TAB_REF CMO_TMP /end COMPU_METHOD
/begin COMPU_METHOD DEZ "  Dezimalzahl in Hexzahl" RAT_FUNC "%3.0" "" COEFFS 0 1.000000 0.000000 0 0.000000 1.000000 /end COMPU_METHOD
/begin COMPU_METHOD DEZ7 "  Dezimalzahl in Hexzahl von 0-7" RAT_FUNC "%4.2" "" COEFFS 0 1.000000 0.000000 0 0.000000 1.000000 /end COMPU_METHOD
/begin COMPU_METHOD DEZL "  Dezimalzahl in 16-Bit-Hexzahl" RAT_FUNC "%5.0" "" COEFFS 0 1.000000 0.000000 0 0.000000 1.000000 /end COMPU_METHOD
/begin COMPU_METHOD DTSEGNO "Segmentwinkel mit Offset" RAT_FUNC "%7.5" "Grad KW" COEFFS 0 1.000000 2.249984 0 0.000000 1.757800e-02 /end COMPU_METHOD
/begin COMPU_METHOD DTSEGNO_S1 "Segmentwinkel  (vorzeichenbehaftet)" RAT_FUNC "%7.3" "Grad KW" COEFFS 0 1.000000 144.005530 0 0.000000 4.394700e-03 /end COMPU_METHOD
/begin COMPU_METHOD DTSEGN_S16 "Segmentwinkel  (vorzeichenbehaftet)" RAT_FUNC "%7.3" "Grad KW" COEFFS 0 1.000000 0.000000 0 0.000000 4.394700e-03 /end COMPU_METHOD
/begin COMPU_METHOD DTSEGN_S8 "Segmentwinkel (vorzeichenbehaftet)" RAT_FUNC "%7.5" "Grad KW" COEFFS 0 1.000000 0.000000 0 0.000000 1.757800e-02 /end COMPU_METHOD
/begin COMPU_METHOD DUFUELL "Umrechnung fuer delta Fuellungsgrad" RAT_FUNC "%7.4" "%" COEFFS 0 255.000000 0.000000 0 0.000000 191.250000 /end COMPU_METHOD
/begin COMPU_METHOD FKT128 "  Umsetzung des Intervalles [0;<2]" RAT_FUNC "%6.4" "" COEFFS 0 128.000000 0.000000 0 0.000000 1.000000 /end COMPU_METHOD
/begin COMPU_METHOD FKT128BG "  Umsetzung des Intervalles [0;<2]" RAT_FUNC "%6.4" "" COEFFS 0 128.000000 0.000000 0 0.000000 1.000000 /end COMPU_METHOD
/begin COMPU_METHOD FKT256 "  Umsetzung des Intervalles [0;<1]" RAT_FUNC "%6.4" "" COEFFS 0 256.000000 0.000000 0 0.000000 1.000000 /end COMPU_METHOD
/begin COMPU_METHOD FKT256L "  Umsetzung des Intervalles [0;< 256.0]" RAT_FUNC "%6.2" "" COEFFS 0 256.000000 0.000000 0 0.000000 1.000000 /end COMPU_METHOD
/begin COMPU_METHOD FKT4096L "  Umsetzung des Intervalles [0-16]" RAT_FUNC "%6.3" "" COEFFS 0 4096.000000 0.000000 0 0.000000 1.000000 /end COMPU_METHOD
/begin COMPU_METHOD FPC50L "  Korrekturfaktor fuer Aenderung um 50 [%] , 16 Bit" RAT_FUNC "%8.6" "" COEFFS 0 6.553600e+04 -3.276800e+04 0 0.000000 1.000000 /end COMPU_METHOD
/begin COMPU_METHOD LUQ "  Laufunruhe" RAT_FUNC "%7.3" "(Umdr./sec)^2" COEFFS 0 1.000000 0.000000 0 0.000000 7.366900e-01 /end COMPU_METHOD
/begin COMPU_METHOD LUQ256_S16 "  Laufunruhe (vorzeichenbehaftet)" RAT_FUNC "%7.4" "(Umdr./sec)^2" COEFFS 0 1.000000 0.000000 0 0.000000 2.877700e-03 /end COMPU_METHOD
/begin COMPU_METHOD LUQ_S8 "  Laufunruhe (vorzeichenbehaftet)" RAT_FUNC "%7.4" "(Umdr./sec)^2" COEFFS 0 1.000000 0.000000 0 0.000000 7.366900e-01 /end COMPU_METHOD
/begin COMPU_METHOD MLQ010L "  Luftmassen-Durchsatz, 16 Bit mit 0.1000[kg/h] quantisiert" RAT_FUNC "%7.2" "kg/h" COEFFS 0 1.000000 0.000000 0 0.000000 1.000000e-01 /end COMPU_METHOD
/begin COMPU_METHOD MLSMQ "MLE mit  4.000 Kg/h quantisiert" RAT_FUNC "%7.2" "kg/h" COEFFS 0 1.000000 0.000000 0 0.000000 4.000000 /end COMPU_METHOD
/begin COMPU_METHOD NGRDQ40 "  Drehzahlgradient mi 40 Upm/sec quantisiert" RAT_FUNC "%5.0" "Upm/sec" COEFFS 0 1.000000 0.000000 0 0.000000 40.000000 /end COMPU_METHOD
/begin COMPU_METHOD NQ1_W "  Drehzahlquantisierung  1.000[Upm]" RAT_FUNC "%4.0" "Upm" COEFFS 0 1.000000 0.000000 0 0.000000 1.000000 /end COMPU_METHOD
/begin COMPU_METHOD NQ25 "  Drehzahlquantisierung  25.00[Upm]" RAT_FUNC "%4.0" "Upm" COEFFS 0 1.000000 0.000000 0 0.000000 25.000000 /end COMPU_METHOD
/begin COMPU_METHOD NQ40 "  Drehzahlquantisierung  40.00[Upm]" RAT_FUNC "%5.0" "Upm" COEFFS 0 1.000000 0.000000 0 0.000000 40.000000 /end COMPU_METHOD
/begin COMPU_METHOD PAB77 "Umrechnung des Drucksensorwertes " RAT_FUNC "%6.3" "bar" COEFFS 0 7.698000 2.356000 0 0.000000 1.000000 /end COMPU_METHOD
/begin COMPU_METHOD PER0327 "percent" RAT_FUNC "%7.3" "%" COEFFS 0 327.670000 0.000000 0 0.000000 1.000000 /end COMPU_METHOD
/begin COMPU_METHOD PER0327LS "Prozentumrechnung mit  327.7[%/ms] signed-word quantisiert" RAT_FUNC "%7.3" "%/10ms" COEFFS 0 327.670000 0.000000 0 0.000000 1.000000 /end COMPU_METHOD
/begin COMPU_METHOD PER255 "percent" RAT_FUNC "%7.3" "%" COEFFS 0 255.000000 0.000000 0 0.000000 100.000000 /end COMPU_METHOD
/begin COMPU_METHOD PER25T10MS "Prozentumrechnung mit  5.120[%/ms] als signed" RAT_FUNC "%7.4" "%/10ms" COEFFS 0 5.119840 0.000000 0 0.000000 1.000000 /end COMPU_METHOD
/begin COMPU_METHOD PHI1_SY "  Zuendungsabhaengige Filterkonstante mit  0.391 %/Zuendung. quantisiert" RAT_FUNC "%7.4" "% pro Zuendung" COEFFS 0 1.000000 0.000000 0 0.000000 3.906300e-01 /end COMPU_METHOD
/begin COMPU_METHOD R_UW_Q2 " Widerstand in 16-Bit-Hexwerten " RAT_FUNC "%6.0" " Ohm " COEFFS 0 1.000000 0.000000 0 0.000000 2.000000 /end COMPU_METHOD
/begin COMPU_METHOD TEQL "  Quantisierung von te, 16 Bit mit  0.267E-2[ms]" RAT_FUNC "%7.3" "ms" COEFFS 0 1.000000 0.000000 0 0.000000 2.666700e-03 /end COMPU_METHOD
/begin COMPU_METHOD TEQ_8L "  Quantisierung von te, 16 Bit mit 0.0213[ms]" RAT_FUNC "%7.2" "ms" COEFFS 0 1.000000 0.000000 0 0.000000 2.133300e-02 /end COMPU_METHOD
/begin COMPU_METHOD TEQ_CPL "  Quantisierung von te, 16 Bitmit  0.267E-2[ms]" RAT_FUNC "%9.6" "ms" COEFFS 0 1.000000 0.000000 0 0.000000 2.666666e-03 /end COMPU_METHOD
/begin COMPU_METHOD TMP_10B "Motor-Temperatur 10-Bit (invers)" TAB_INTP "%7.3" "grad C" COMPU_TAB_REF TMP_10B /end COMPU_METHOD
/begin COMPU_METHOD TMP_79_140 "Temperaturquantisierung mit 0.24 [°C] und Offset +79°C" TAB_INTP "%7.3" "grad C" COMPU_TAB_REF TMP_79_140 /end COMPU_METHOD
/begin COMPU_METHOD TQ100L "  Zeitquantisierung mit 100[ms]" RAT_FUNC "%7.2" "sec" COEFFS 0 10.000000 0.000000 0 0.000000 1.000000 /end COMPU_METHOD
/begin COMPU_METHOD TQ360000L "  Zeitquantisierung mit 6[min]" RAT_FUNC "%6.0" "min" COEFFS 0 1.000000 0.000000 0 0.000000 6.000000 /end COMPU_METHOD
/begin COMPU_METHOD TSEGQL "  Quant. der Segmentzeit mit  0.889[us] " RAT_FUNC "%7.1" "us" COEFFS 0 1.000000 0.000000 0 0.000000 8.888900e-01 /end COMPU_METHOD
/begin COMPU_METHOD U5V "  Batteriespannung mit 5V quantisiert" RAT_FUNC "%5.3" "V" COEFFS 0 255.000000 0.000000 0 0.000000 5.000000 /end COMPU_METHOD
/begin COMPU_METHOD UBQ "  Batteriespannung mit 0.0942[V] quantisiert" RAT_FUNC "%5.2" "V" COEFFS 0 1.000000 0.000000 0 0.000000 9.421700e-02 /end COMPU_METHOD
/begin COMPU_METHOD UFUELL "Umrechnung fuer Fuellungsgrad" RAT_FUNC "%7.3" "%" COEFFS 0 255.000000 0.000000 0 0.000000 191.250000 /end COMPU_METHOD
/begin COMPU_METHOD UGESCH4 "Umrechnung fuer Geschwindigkeiten mit  4.000 quantisiert" RAT_FUNC "%7.4" "km/h" COEFFS 0 4.000000 0.000000 0 0.000000 1.000000 /end COMPU_METHOD
/begin COMPU_METHOD ULSQ "  Lambdasonden-Spannung ohne Offset" RAT_FUNC "%7.5" "V" COEFFS 0 51.000000 0.000000 0 0.000000 1.000000 /end COMPU_METHOD
/begin COMPU_METHOD ULSQL "  Lambdasonden-Spannung ohne Offset" RAT_FUNC "%7.5" "V" COEFFS 0 13107.000000 0.000000 0 0.000000 1.000000 /end COMPU_METHOD
/begin COMPU_METHOD UTMP_40 "  lineare Temperatur + Offset" RAT_FUNC "%6.2" "grd C" COEFFS 0 1.000000 40.000000 0 0.000000 1.000000 /end COMPU_METHOD
/begin COMPU_METHOD U_A "  Beschleunigungsumrechnung" RAT_FUNC "%6.3" "m/(s*s)" COEFFS 0 1.000000 0.000000 0 0.000000 1.736100e-01 /end COMPU_METHOD
/begin COMPU_METHOD VQV "  Fahrgeschwindigkeit mit Faktor  0.833 [km/h]" RAT_FUNC "%5.1" "km/h" COEFFS 0 8.333300e-01 0.000000 0 0.000000 1.000000 /end COMPU_METHOD
/begin COMPU_METHOD VQV16L "  Geschwindigkeitsumrechnung mit Faktor  16.00 [km/h]" RAT_FUNC "%6.1" "km/h" COEFFS 0 16.000000 0.000000 0 0.000000 1.000000 /end COMPU_METHOD
/begin COMPU_METHOD ZWQ "  Zuendwinkel ohne Offset mit  0.750[grad KW] quantisiert" RAT_FUNC "%6.2" "grad KW" COEFFS 0 1.000000 0.000000 0 0.000000 7.500000e-01 /end COMPU_METHOD
/begin COMPU_TAB CLU_TMP "" TAB_INTP 41 3 -50.000000 4 -45.000000 5 -40.000000 7 -35.000000 10 -30.000000 13 -25.000000 16 -20.000000 21 -15.000000 26 -10.000000 32 -5.000000 38 0.000000 46 5.000000 55 10.000000 64 15.000000 74 20.000000 84 25.000000 95 30.000000 106 35.000000 117 40.000000 128 45.000000 139 50.000000 149 55.000000 158 60.000000 167 65.000000 175 70.000000 183 75.000000 190 80.000000 196 85.000000 202 90.000000 207 95.000000 212 100.000000 216 105.000000 220 110.000000 223 115.000000 226 120.000000 229 125.000000 231 130.000000 233 135.000000 235 140.000000 237 145.000000 239 150.000000 /end COMPU_TAB
/begin COMPU_TAB CMO_TMP "" TAB_INTP 21 0 -41.000000 5 -40.000000 9 -30.000000 15 -20.150000 24 -10.120000 36 -0.140000 53 9.940000 73 19.980000 84 24.980000 95 30.020000 118 39.970000 141 49.980000 162 60.000000 180 70.080000 195 80.030000 207 90.000000 217 99.960000 225 109.910000 231 120.250000 236 129.640000 255 140.000000 /end COMPU_TAB
/begin COMPU_TAB TMP_10B "" TAB_INTP 21 18 -41.000000 20 -40.000000 35 -30.000000 59 -20.000000 95 -10.000000 146 0.000000 212 10.000000 291 20.000000 335 25.000000 381 30.000000 475 40.000000 566 50.000000 649 60.000000 721 70.000000 782 80.000000 831 90.000000 870 100.000000 901 110.000000 925 120.000000 944 130.000000 965 140.000000 /end COMPU_TAB
/begin COMPU_TAB TMP_79_140 "" TAB_INTP 8 0 77.700000 14 80.000000 63 90.000000 102 100.000000 133 110.000000 157 120.000000 176 130.000000 197 140.000000 /end COMPU_TAB
/begin COMPU_VTAB B_DEZ "" TAB_VERB 2 0 "0" 1 "1" /end COMPU_VTAB
/begin COMPU_VTAB B_TRUE "" TAB_VERB 2 0 "----" 1 "TRUE" /end COMPU_VTAB
/begin MEASUREMENT DZWM "Delta ZW gemittelt " UBYTE ZWQ 0 0 0.000000 191.250000 ECU_ADDRESS 0x6BA BIT_MASK 0xFF /end MEASUREMENT
/begin MEASUREMENT DZWZ "Delta ZW zylinderindividuell " UBYTE ZWQ 0 0 0.000000 191.250000 ECU_ADDRESS 0x6BB BIT_MASK 0xFF /end MEASUREMENT
/begin MEASUREMENT FDKHA "Hoehenabhg. DK-Adaptionsfaktor" UBYTE FKT128 0 0 0.000000 1.992190 ECU_ADDRESS 0x2002 BIT_MASK 0xFF /end MEASUREMENT
/begin MEASUREMENT GANG "Gänge vom Getriebe mit Speicherung bei getretener Kupplung " UBYTE DEZ7 0 0 0.000000 7.000000 ECU_ADDRESS 0x4AB BIT_MASK 0xFF /end MEASUREMENT
/begin MEASUREMENT MLSM "MLE" UBYTE MLSMQ 0 0 0.000000 1024.000000 ECU_ADDRESS 0xF72C BIT_MASK 0xFF /end MEASUREMENT
/begin MEASUREMENT NIST "Drehzahl " UBYTE NQ25 0 0 0.000000 6400.000000 ECU_ADDRESS 0xF72B BIT_MASK 0xFF /end MEASUREMENT
/begin MEASUREMENT NMOT "Motordrehzahl " UBYTE NQ40 0 0 0.000000 10200.000000 ECU_ADDRESS 0xF74B BIT_MASK 0xFF /end MEASUREMENT
/begin MEASUREMENT PAC "KÜHLMITTELDRUCK" UBYTE PAB77 0 0 -0.306050 32.819400 ECU_ADDRESS 0x213A BIT_MASK 0xFF /end MEASUREMENT
/begin MEASUREMENT SWPT "Pedal- u. Tempomatsollwert " UBYTE PER255 0 0 0.000000 100.000000 ECU_ADDRESS 0xF73B BIT_MASK 0xFF /end MEASUREMENT
/begin MEASUREMENT SWRES "" UBYTE PER255 0 0 0.000000 100.000000 ECU_ADDRESS 0xF73F BIT_MASK 0xFF /end MEASUREMENT
/begin MEASUREMENT TANS "Ansauglufttemperatur" UBYTE CLU_TMP 0 0 -50.000000 150.000000 ECU_ADDRESS 0xF70E BIT_MASK 0xFF /end MEASUREMENT
/begin MEASUREMENT TL8 "Last " UBYTE UFUELL 0 0 0.000000 191.250000 ECU_ADDRESS 0xF72D BIT_MASK 0xFF /end MEASUREMENT
/begin MEASUREMENT TMDMM "Motortemperaturmodell" UBYTE UTMP_40 0 0 -40.000000 216.000000 ECU_ADDRESS 0xA02 BIT_MASK 0xFF /end MEASUREMENT
/begin MEASUREMENT TMOT "Motor-Temperatur " UBYTE CMO_TMP 0 0 -41.000000 140.000000 ECU_ADDRESS 0xF70D BIT_MASK 0xFF /end MEASUREMENT
/begin MEASUREMENT TMOT_L "MOTORTEMPERATUR " UBYTE TMP_79_140 0 0 77.700000 140.000000 ECU_ADDRESS 0x2135 BIT_MASK 0xFF /end MEASUREMENT
/begin MEASUREMENT TMST "Motor-Temperatur beim Start " UBYTE CMO_TMP 0 0 -41.000000 140.000000 ECU_ADDRESS 0x258 BIT_MASK 0xFF /end MEASUREMENT
/begin MEASUREMENT UBATT "Batteriespannung " UBYTE UBQ 0 0 0.000000 24.119600 ECU_ADDRESS 0xF70C BIT_MASK 0xFF /end MEASUREMENT
/begin MEASUREMENT UNW "Umdrehungen pro NW im Start" UBYTE DEZ 0 0 0.000000 256.000000 ECU_ADDRESS 0xF732 BIT_MASK 0xFF /end MEASUREMENT
/begin MEASUREMENT VFZG "Geschwindigkeitssignal ueber Impulse" UBYTE VQV 0 0 0.000000 306.000000 ECU_ADDRESS 0x27E BIT_MASK 0xFF /end MEASUREMENT
/begin MEASUREMENT V_CAN "V_CAN " UBYTE VQV 0 0 0.000000 306.000000 ECU_ADDRESS 0x27E BIT_MASK 0xFF /end MEASUREMENT
/begin MEASUREMENT V_LFR "LFR-Geschwindigkeit " UBYTE UGESCH4 0 0 0.000000 63.750000 ECU_ADDRESS 0xF72A BIT_MASK 0xFF /end MEASUREMENT
/begin MEASUREMENT ADC_HFM " Korrigierte HFM-Spannung" UWORD DEZL 0 0 0.000000 65535.000000 ECU_ADDRESS 0xF8D0 BIT_MASK 0xFFFF /end MEASUREMENT
/begin MEASUREMENT AFNMN "Aussetzerfenster, min. Drehzahl" UBYTE NQ40 0 0 0.000000 10200.000000 ECU_ADDRESS 0xB2220 BIT_MASK 0xFF /end MEASUREMENT
/begin MEASUREMENT AFNMX "Aussetzerfenster, max. Drehzahl" UBYTE NQ40 0 0 0.000000 10200.000000 ECU_ADDRESS 0xB2221 BIT_MASK 0xFF /end MEASUREMENT
/begin MEASUREMENT AFTNMN "Aussetzerfenster temporaer, min. Drehzahl" UBYTE NQ40 0 0 0.000000 10200.000000 ECU_ADDRESS 0xB0A0E BIT_MASK 0xFF /end MEASUREMENT
/begin MEASUREMENT AFTNMX "Aussetzerfenster temporaer, max. Drehzahl" UBYTE NQ40 0 0 0.000000 10200.000000 ECU_ADDRESS 0xB0A0F BIT_MASK 0xFF /end MEASUREMENT
/begin MEASUREMENT ANWFOH "Anzahl noch in Heilbereichen zu fahrende NW" UBYTE DEZ 0 0 0.000000 256.000000 ECU_ADDRESS 0xB0A4C BIT_MASK 0xFF /end MEASUREMENT
/begin MEASUREMENT ANWFOS " Ausblend-Nockenwellenzaehler fuer DMDFON" UBYTE DEZ 0 0 0.000000 256.000000 ECU_ADDRESS 0xB07D0 BIT_MASK 0xFF /end MEASUREMENT
/begin MEASUREMENT BBWUC "Byte fuer Bedingung B_wuc als Triggerevent in DCLA" UBYTE DEZ 0 0 0.000000 256.000000 ECU_ADDRESS 0xB0F9E BIT_MASK 0xFF /end MEASUREMENT
/begin MEASUREMENT BFNMN "Betriebsfenster, min. Drehzahl" UBYTE NQ40 0 0 0.000000 10200.000000 ECU_ADDRESS 0xB0A12 BIT_MASK 0xFF /end MEASUREMENT
/begin MEASUREMENT BFNMX "Betriebsfenster, max. Drehzahl" UBYTE NQ40 0 0 0.000000 10200.000000 ECU_ADDRESS 0xB0A13 BIT_MASK 0xFF /end MEASUREMENT
/begin MEASUREMENT BFZGL_B " Fahrzeuglaengsbeschleunigung" SBYTE U_A 0 0 -22.222100 22.048500 ECU_ADDRESS 0xB061B BIT_MASK 0xFF /end MEASUREMENT
/begin MEASUREMENT BS " Signal Beschleunigungssensor" UWORD BSCHL_S5L 0 0 -6.251050 6.250860 ECU_ADDRESS 0xF978 BIT_MASK 0xFFFF /end MEASUREMENT
/begin MEASUREMENT BSMW " Speicherwert Beschleunigungssensor" UWORD BSCHL_S5L 0 0 -6.251050 6.250860 ECU_ADDRESS 0xF97A BIT_MASK 0xFFFF /end MEASUREMENT
/begin MEASUREMENT BSSP " Speicherwert Beschleunigungssensor" UWORD BSCHL_25L 0 0 0.000000 25.003800 ECU_ADDRESS 0xF984 BIT_MASK 0xFFFF /end MEASUREMENT
/begin MEASUREMENT DFSE " akt. FSE-Differenz" SBYTE DTSEGN_S8 0 0 -2.250000 2.232420 ECU_ADDRESS 0xB0765 BIT_MASK 0xFF /end MEASUREMENT
/begin MEASUREMENT DFSE01 " Max. FSE-Differenz im Drehzahlbereich 1" SBYTE DTSEGN_S8 0 0 -2.250000 2.232420 ECU_ADDRESS 0xB075E BIT_MASK 0xFF /end MEASUREMENT
/begin MEASUREMENT DFSE02 " Max. FSE-Differenz im Drehzahlbereich 2" SBYTE DTSEGN_S8 0 0 -2.250000 2.232420 ECU_ADDRESS 0xB075F BIT_MASK 0xFF /end MEASUREMENT
/begin MEASUREMENT DFSE03 " Max. FSE-Differenz im Drehzahlbereich 3" SBYTE DTSEGN_S8 0 0 -2.250000 2.232420 ECU_ADDRESS 0xB0760 BIT_MASK 0xFF /end MEASUREMENT
/begin MEASUREMENT DFSE04 " Max. FSE-Differenz im Drehzahlbereich 4" SBYTE DTSEGN_S8 0 0 -2.250000 2.232420 ECU_ADDRESS 0xB0761 BIT_MASK 0xFF /end MEASUREMENT
/begin MEASUREMENT DFSE05 " Max. FSE-Differenz im Drehzahlbereich 5" SBYTE DTSEGN_S8 0 0 -2.250000 2.232420 ECU_ADDRESS 0xB0762 BIT_MASK 0xFF /end MEASUREMENT
/begin MEASUREMENT DFSE06 " Max. FSE-Differenz im Drehzahlbereich 6" SBYTE DTSEGN_S8 0 0 -2.250000 2.232420 ECU_ADDRESS 0xB0763 BIT_MASK 0xFF /end MEASUREMENT
/begin MEASUREMENT DFSEN " Max. FSE-Differenz aus Daten" SBYTE DTSEGN_S8 0 0 -2.250000 2.232420 ECU_ADDRESS 0xB0764 BIT_MASK 0xFF /end MEASUREMENT
/begin MEASUREMENT DRPMOEL " Diagnosebits Oeldruckschalter" UBYTE DEZ 0 0 0.000000 256.000000 ECU_ADDRESS 0xB21A3 BIT_MASK 0xFF /end MEASUREMENT
/begin MEASUREMENT DRPWG " Diagnose-Bits PWG" UBYTE DEZ 0 0 0.000000 256.000000 ECU_ADDRESS 0xB21A6 BIT_MASK 0xFF /end MEASUREMENT
/begin MEASUREMENT DRSWE " Diagnose Schlechtwegerkennung" UBYTE DEZ 0 0 0.000000 256.000000 ECU_ADDRESS 0xB21D5 BIT_MASK 0xFF /end MEASUREMENT
/begin MEASUREMENT DRVFZ " Diagnose Geschwindigkeitssignal" UBYTE DEZ 0 0 0.000000 256.000000 ECU_ADDRESS 0xB219F BIT_MASK 0xFF /end MEASUREMENT
/begin MEASUREMENT DRVTSK " Diagnose FGR-Bedienhebel" UBYTE DEZ 0 0 0.000000 256.000000 ECU_ADDRESS 0xB21CE BIT_MASK 0xFF /end MEASUREMENT
/begin MEASUREMENT DTL "Delta-TL8 von DASE" SBYTE DUFUELL 0 0 -96.000000 95.250000 ECU_ADDRESS 0xB074A BIT_MASK 0xFF /end MEASUREMENT
/begin MEASUREMENT EEPCDFON " Grobadaptionswert" UWORD DEZL 0 0 0.000000 65535.000000 ECU_ADDRESS 0xB2B32 BIT_MASK 0xFFFF /end MEASUREMENT
/begin MEASUREMENT EEPFS02 "" UWORD DEZL 0 0 0.000000 65535.000000 ECU_ADDRESS 0xB2B34 BIT_MASK 0xFFFF /end MEASUREMENT
/begin MEASUREMENT EEPI_N " Drehzahlindex" UBYTE DEZ 0 0 0.000000 256.000000 ECU_ADDRESS 0xB2B44 BIT_MASK 0xFF /end MEASUREMENT
/begin MEASUREMENT EEPI_TL " Lastindex" UBYTE DEZ 0 0 0.000000 256.000000 ECU_ADDRESS 0xB2B45 BIT_MASK 0xFF /end MEASUREMENT
/begin MEASUREMENT FAMAL "Interpoliertes KFAMALU" UBYTE FKT256 0 0 0.000000 0.996090 ECU_ADDRESS 0xB075C BIT_MASK 0xFF /end MEASUREMENT
/begin MEASUREMENT FDMD_AP "Ausgabe von FLG2 aus Trommel" UBYTE DEZ 0 0 0.000000 256.000000 ECU_ADDRESS 0xF9A7 BIT_MASK 0xFF /end MEASUREMENT
/begin MEASUREMENT FESZW "WE-Anreicherungsfaktor aus %ESZW" UBYTE FKT128 0 0 0.000000 1.992190 ECU_ADDRESS 0xB0292 BIT_MASK 0xFF /end MEASUREMENT
/begin MEASUREMENT FFLUTN "" UBYTE PHI1_SY 0 0 0.000000 99.609400 ECU_ADDRESS 0xB07A4 BIT_MASK 0xFF /end MEASUREMENT
/begin MEASUREMENT FFONN1 " Statusbyte fuel-on Adaption Last-Bereich 1" UBYTE DEZ 0 0 0.000000 256.000000 ECU_ADDRESS 0xB25C0 BIT_MASK 0xFF /end MEASUREMENT
/begin MEASUREMENT FFONN2 " Statusbyte fuel-on Adaption Last-Bereich 2" UBYTE DEZ 0 0 0.000000 256.000000 ECU_ADDRESS 0xB25C1 BIT_MASK 0xFF /end MEASUREMENT
/begin MEASUREMENT FFONN3 " Statusbyte fuel-on Adaption Last-Bereich 3" UBYTE DEZ 0 0 0.000000 256.000000 ECU_ADDRESS 0xB25C2 BIT_MASK 0xFF /end MEASUREMENT
/begin MEASUREMENT FFORN1 " Statusbyte fuel-on Adaption Drehzahlinfo" UBYTE DEZ 0 0 0.000000 256.000000 ECU_ADDRESS 0xB25BE BIT_MASK 0xFF /end MEASUREMENT
/begin MEASUREMENT FFPL1 " Plausbyte fuel-on Adaption Last-Bereich 1" UBYTE DEZ 0 0 0.000000 256.000000 ECU_ADDRESS 0xB25BF BIT_MASK 0xFF /end MEASUREMENT
/begin MEASUREMENT FIVZABG " Intervallzaehler f. abgasrel. Aussetzer" UBYTE DEZ 0 0 0.000000 256.000000 ECU_ADDRESS 0xB0A29 BIT_MASK 0xFF /end MEASUREMENT
/begin MEASUREMENT FLGKAT " Statusflag kat.-sch. Aussetzern oder ti-Abschaltungen" UBYTE DEZ 0 0 0.000000 256.000000 ECU_ADDRESS 0xB0A2C BIT_MASK 0xFF /end MEASUREMENT
/begin MEASUREMENT FLGTIAB " Statusflag ti-Abschaltung bei kat.-sch. Aussetzern" UBYTE DEZ 0 0 0.000000 256.000000 ECU_ADDRESS 0xB0A2B BIT_MASK 0xFF /end MEASUREMENT
/begin MEASUREMENT FLMX " aktuell maximaler Lernfilterwert" SWORD DTSEGN_S16 0 0 -144.000000 144.000000 ECU_ADDRESS 0xB07E2 BIT_MASK 0xFFFF /end MEASUREMENT
/begin MEASUREMENT FLN11_02 " Lernfilterwert, negativ, Betriebsbereich 11, Zylinder 2" SWORD DTSEGN_S16 0 0 -144.000000 144.000000 ECU_ADDRESS 0xB25C4 BIT_MASK 0xFFFF /end MEASUREMENT
/begin MEASUREMENT FLN11_03 " Lernfilterwert, negativ" SWORD DTSEGN_S16 0 0 -144.000000 144.000000 ECU_ADDRESS 0xB25E8 BIT_MASK 0xFFFF /end MEASUREMENT
/begin MEASUREMENT FLN11_04 " Lernfilterwert, negativ" SWORD DTSEGN_S16 0 0 -144.000000 144.000000 ECU_ADDRESS 0xB260C BIT_MASK 0xFFFF /end MEASUREMENT
/begin MEASUREMENT FLN11_05 " Lernfilterwert, negativ" SWORD DTSEGN_S16 0 0 -144.000000 144.000000 ECU_ADDRESS 0xB2630 BIT_MASK 0xFFFF /end MEASUREMENT
/begin MEASUREMENT FLN11_06 " Lernfilterwert, negativ" SWORD DTSEGN_S16 0 0 -144.000000 144.000000 ECU_ADDRESS 0xB2654 BIT_MASK 0xFFFF /end MEASUREMENT
/begin MEASUREMENT FLN11_07 " Lernfilterwert, negativ" SWORD DTSEGN_S16 0 0 -144.000000 144.000000 ECU_ADDRESS 0xB2678 BIT_MASK 0xFFFF /end MEASUREMENT
/begin MEASUREMENT FLN11_08 " Lernfilterwert, negativ" SWORD DTSEGN_S16 0 0 -144.000000 144.000000 ECU_ADDRESS 0xB269C BIT_MASK 0xFFFF /end MEASUREMENT
/begin MEASUREMENT FLN12_02 " Lernfilterwert, negativ" SWORD DTSEGN_S16 0 0 -144.000000 144.000000 ECU_ADDRESS 0xB25D0 BIT_MASK 0xFFFF /end MEASUREMENT
/begin MEASUREMENT FLN12_03 " Lernfilterwert, negativ" SWORD DTSEGN_S16 0 0 -144.000000 144.000000 ECU_ADDRESS 0xB25F4 BIT_MASK 0xFFFF /end MEASUREMENT
/begin MEASUREMENT FLN12_04 " Lernfilterwert, negativ" SWORD DTSEGN_S16 0 0 -144.000000 144.000000 ECU_ADDRESS 0xB2618 BIT_MASK 0xFFFF /end MEASUREMENT
/begin MEASUREMENT FLN12_05 " Lernfilterwert, negativ" SWORD DTSEGN_S16 0 0 -144.000000 144.000000 ECU_ADDRESS 0xB263C BIT_MASK 0xFFFF /end MEASUREMENT
/begin MEASUREMENT FLN12_06 " Lernfilterwert, negativ" SWORD DTSEGN_S16 0 0 -144.000000 144.000000 ECU_ADDRESS 0xB2660 BIT_MASK 0xFFFF /end MEASUREMENT
/begin MEASUREMENT FLN12_07 " Lernfilterwert, negativ" SWORD DTSEGN_S16 0 0 -144.000000 144.000000 ECU_ADDRESS 0xB2684 BIT_MASK 0xFFFF /end MEASUREMENT
/begin MEASUREMENT FLN12_08 " Lernfilterwert, negativ" SWORD DTSEGN_S16 0 0 -144.000000 144.000000 ECU_ADDRESS 0xB26A8 BIT_MASK 0xFFFF /end MEASUREMENT
/begin MEASUREMENT FLN13_02 " Lernfilterwert, negativ" SWORD DTSEGN_S16 0 0 -144.000000 144.000000 ECU_ADDRESS 0xB25DC BIT_MASK 0xFFFF /end MEASUREMENT
/begin MEASUREMENT FLN13_03 " Lernfilterwert, negativ" SWORD DTSEGN_S16 0 0 -144.000000 144.000000 ECU_ADDRESS 0xB2600 BIT_MASK 0xFFFF /end MEASUREMENT
/begin MEASUREMENT FLN13_04 " Lernfilterwert, negativ" SWORD DTSEGN_S16 0 0 -144.000000 144.000000 ECU_ADDRESS 0xB2624 BIT_MASK 0xFFFF /end MEASUREMENT
/begin MEASUREMENT FLN13_05 " Lernfilterwert, negativ" SWORD DTSEGN_S16 0 0 -144.000000 144.000000 ECU_ADDRESS 0xB2648 BIT_MASK 0xFFFF /end MEASUREMENT
/begin MEASUREMENT FLN13_06 " Lernfilterwert, negativ" SWORD DTSEGN_S16 0 0 -144.000000 144.000000 ECU_ADDRESS 0xB266C BIT_MASK 0xFFFF /end MEASUREMENT
/begin MEASUREMENT FLN13_07 " Lernfilterwert, negativ" SWORD DTSEGN_S16 0 0 -144.000000 144.000000 ECU_ADDRESS 0xB2690 BIT_MASK 0xFFFF /end MEASUREMENT
/begin MEASUREMENT FLN13_08 " Lernfilterwert, negativ" SWORD DTSEGN_S16 0 0 -144.000000 144.000000 ECU_ADDRESS 0xB26B4 BIT_MASK 0xFFFF /end MEASUREMENT
/begin MEASUREMENT FLN21_02 " Lernfilterwert, negativ" SWORD DTSEGN_S16 0 0 -144.000000 144.000000 ECU_ADDRESS 0xB25C6 BIT_MASK 0xFFFF /end MEASUREMENT
/begin MEASUREMENT FLN21_03 " Lernfilterwert, negativ" SWORD DTSEGN_S16 0 0 -144.000000 144.000000 ECU_ADDRESS 0xB25EA BIT_MASK 0xFFFF /end MEASUREMENT
/begin MEASUREMENT FLN21_04 " Lernfilterwert, negativ" SWORD DTSEGN_S16 0 0 -144.000000 144.000000 ECU_ADDRESS 0xB260E BIT_MASK 0xFFFF /end MEASUREMENT
/begin MEASUREMENT FLN21_05 " Lernfilterwert, negativ" SWORD DTSEGN_S16 0 0 -144.000000 144.000000 ECU_ADDRESS 0xB2632 BIT_MASK 0xFFFF /end MEASUREMENT
/begin MEASUREMENT FLN21_06 " Lernfilterwert, negativ" SWORD DTSEGN_S16 0 0 -144.000000 144.000000 ECU_ADDRESS 0xB2656 BIT_MASK 0xFFFF /end MEASUREMENT
/begin MEASUREMENT FLN21_07 " Lernfilterwert, negativ" SWORD DTSEGN_S16 0 0 -144.000000 144.000000 ECU_ADDRESS 0xB267A BIT_MASK 0xFFFF /end MEASUREMENT
/begin MEASUREMENT FLN21_08 " Lernfilterwert, negativ" SWORD DTSEGN_S16 0 0 -144.000000 144.000000 ECU_ADDRESS 0xB269E BIT_MASK 0xFFFF /end MEASUREMENT
/begin MEASUREMENT FLN22_02 " Lernfilterwert, negativ" SWORD DTSEGN_S16 0 0 -144.000000 144.000000 ECU_ADDRESS 0xB25D2 BIT_MASK 0xFFFF /end MEASUREMENT
/begin MEASUREMENT FLN22_03 " Lernfilterwert, negativ" SWORD DTSEGN_S16 0 0 -144.000000 144.000000 ECU_ADDRESS 0xB25F6 BIT_MASK 0xFFFF /end MEASUREMENT
/begin MEASUREMENT FLN22_04 " Lernfilterwert, negativ" SWORD DTSEGN_S16 0 0 -144.000000 144.000000 ECU_ADDRESS 0xB261A BIT_MASK 0xFFFF /end MEASUREMENT
/begin MEASUREMENT FLN22_05 " Lernfilterwert, negativ" SWORD DTSEGN_S16 0 0 -144.000000 144.000000 ECU_ADDRESS 0xB263E BIT_MASK 0xFFFF /end MEASUREMENT
/begin MEASUREMENT FLN22_06 " Lernfilterwert, negativ" SWORD DTSEGN_S16 0 0 -144.000000 144.000000 ECU_ADDRESS 0xB2662 BIT_MASK 0xFFFF /end MEASUREMENT
/begin MEASUREMENT FLN22_07 " Lernfilterwert, negativ" SWORD DTSEGN_S16 0 0 -144.000000 144.000000 ECU_ADDRESS 0xB2686 BIT_MASK 0xFFFF /end MEASUREMENT
/begin MEASUREMENT FLN22_08 " Lernfilterwert, negativ" SWORD DTSEGN_S16 0 0 -144.000000 144.000000 ECU_ADDRESS 0xB26AA BIT_MASK 0xFFFF /end MEASUREMENT
/begin MEASUREMENT FLN23_02 " Lernfilterwert, negativ" SWORD DTSEGN_S16 0 0 -144.000000 144.000000 ECU_ADDRESS 0xB25DE BIT_MASK 0xFFFF /end MEASUREMENT
/begin MEASUREMENT FLN23_03 " Lernfilterwert, negativ" SWORD DTSEGN_S16 0 0 -144.000000 144.000000 ECU_ADDRESS 0xB2602 BIT_MASK 0xFFFF /end MEASUREMENT
/begin MEASUREMENT FLN23_04 " Lernfilterwert, negativ" SWORD DTSEGN_S16 0 0 -144.000000 144.000000 ECU_ADDRESS 0xB2626 BIT_MASK 0xFFFF /end MEASUREMENT
/begin MEASUREMENT FLN23_05 " Lernfilterwert, negativ" SWORD DTSEGN_S16 0 0 -144.000000 144.000000 ECU_ADDRESS 0xB264A BIT_MASK 0xFFFF /end MEASUREMENT
/begin MEASUREMENT FLN23_06 " Lernfilterwert, negativ" SWORD DTSEGN_S16 0 0 -144.000000 144.000000 ECU_ADDRESS 0xB266E BIT_MASK 0xFFFF /end MEASUREMENT
/begin MEASUREMENT FLN23_07 " Lernfilterwert, negativ" SWORD DTSEGN_S16 0 0 -144.000000 144.000000 ECU_ADDRESS 0xB2692 BIT_MASK 0xFFFF /end MEASUREMENT
/begin MEASUREMENT FLN23_08 " Lernfilterwert, negativ" SWORD DTSEGN_S16 0 0 -144.000000 144.000000 ECU_ADDRESS 0xB26B6 BIT_MASK 0xFFFF /end MEASUREMENT
/begin MEASUREMENT FLN31_02 " Lernfilterwert, negativ" SWORD DTSEGN_S16 0 0 -144.000000 144.000000 ECU_ADDRESS 0xB25C8 BIT_MASK 0xFFFF /end MEASUREMENT
/begin MEASUREMENT FLN31_03 " Lernfilterwert, negativ" SWORD DTSEGN_S16 0 0 -144.000000 144.000000 ECU_ADDRESS 0xB25EC BIT_MASK 0xFFFF /end MEASUREMENT
/begin MEASUREMENT FLN31_04 " Lernfilterwert, negativ" SWORD DTSEGN_S16 0 0 -144.000000 144.000000 ECU_ADDRESS 0xB2610 BIT_MASK 0xFFFF /end MEASUREMENT
/begin MEASUREMENT FLN31_05 " Lernfilterwert, negativ" SWORD DTSEGN_S16 0 0 -144.000000 144.000000 ECU_ADDRESS 0xB2634 BIT_MASK 0xFFFF /end MEASUREMENT
/begin MEASUREMENT FLN31_06 " Lernfilterwert, negativ" SWORD DTSEGN_S16 0 0 -144.000000 144.000000 ECU_ADDRESS 0xB2658 BIT_MASK 0xFFFF /end MEASUREMENT
/begin MEASUREMENT FLN31_07 " Lernfilterwert, negativ" SWORD DTSEGN_S16 0 0 -144.000000 144.000000 ECU_ADDRESS 0xB267C BIT_MASK 0xFFFF /end MEASUREMENT
/begin MEASUREMENT FLN31_08 " Lernfilterwert, negativ" SWORD DTSEGN_S16 0 0 -144.000000 144.000000 ECU_ADDRESS 0xB26A0 BIT_MASK 0xFFFF /end MEASUREMENT
/begin MEASUREMENT FLN32_02 " Lernfilterwert, negativ" SWORD DTSEGN_S16 0 0 -144.000000 144.000000 ECU_ADDRESS 0xB25D4 BIT_MASK 0xFFFF /end MEASUREMENT
/begin MEASUREMENT FLN32_03 " Lernfilterwert, negativ" SWORD DTSEGN_S16 0 0 -144.000000 144.000000 ECU_ADDRESS 0xB25F8 BIT_MASK 0xFFFF /end MEASUREMENT
/begin MEASUREMENT FLN32_04 " Lernfilterwert, negativ" SWORD DTSEGN_S16 0 0 -144.000000 144.000000 ECU_ADDRESS 0xB261C BIT_MASK 0xFFFF /end MEASUREMENT
/begin MEASUREMENT FLN32_05 " Lernfilterwert, negativ" SWORD DTSEGN_S16 0 0 -144.000000 144.000000 ECU_ADDRESS 0xB2640 BIT_MASK 0xFFFF /end MEASUREMENT
/begin MEASUREMENT FLN32_06 " Lernfilterwert, negativ" SWORD DTSEGN_S16 0 0 -144.000000 144.000000 ECU_ADDRESS 0xB2664 BIT_MASK 0xFFFF /end MEASUREMENT
/begin MEASUREMENT FLN32_07 " Lernfilterwert, negativ" SWORD DTSEGN_S16 0 0 -144.000000 144.000000 ECU_ADDRESS 0xB2688 BIT_MASK 0xFFFF /end MEASUREMENT
/begin MEASUREMENT FLN32_08 " Lernfilterwert, negativ" SWORD DTSEGN_S16 0 0 -144.000000 144.000000 ECU_ADDRESS 0xB26AC BIT_MASK 0xFFFF /end MEASUREMENT
/begin MEASUREMENT FLN33_02 " Lernfilterwert, negativ" SWORD DTSEGN_S16 0 0 -144.000000 144.000000 ECU_ADDRESS 0xB25E0 BIT_MASK 0xFFFF /end MEASUREMENT
/begin MEASUREMENT FLN33_03 " Lernfilterwert, negativ" SWORD DTSEGN_S16 0 0 -144.000000 144.000000 ECU_ADDRESS 0xB2604 BIT_MASK 0xFFFF /end MEASUREMENT
/begin MEASUREMENT FLN33_04 " Lernfilterwert, negativ" SWORD DTSEGN_S16 0 0 -144.000000 144.000000 ECU_ADDRESS 0xB2628 BIT_MASK 0xFFFF /end MEASUREMENT
/begin MEASUREMENT FLN33_05 " Lernfilterwert, negativ" SWORD DTSEGN_S16 0 0 -144.000000 144.000000 ECU_ADDRESS 0xB264C BIT_MASK 0xFFFF /end MEASUREMENT
/begin MEASUREMENT FLN33_06 " Lernfilterwert, negativ" SWORD DTSEGN_S16 0 0 -144.000000 144.000000 ECU_ADDRESS 0xB2670 BIT_MASK 0xFFFF /end MEASUREMENT
/begin MEASUREMENT FLN33_07 " Lernfilterwert, negativ" SWORD DTSEGN_S16 0 0 -144.000000 144.000000 ECU_ADDRESS 0xB2694 BIT_MASK 0xFFFF /end MEASUREMENT
/begin MEASUREMENT FLN33_08 " Lernfilterwert, negativ" SWORD DTSEGN_S16 0 0 -144.000000 144.000000 ECU_ADDRESS 0xB26B8 BIT_MASK 0xFFFF /end MEASUREMENT
/begin MEASUREMENT FLN41_02 " Lernfilterwert, negativ" SWORD DTSEGN_S16 0 0 -144.000000 144.000000 ECU_ADDRESS 0xB25CA BIT_MASK 0xFFFF /end MEASUREMENT
/begin MEASUREMENT FLN41_03 " Lernfilterwert, negativ" SWORD DTSEGN_S16 0 0 -144.000000 144.000000 ECU_ADDRESS 0xB25EE BIT_MASK 0xFFFF /end MEASUREMENT
/begin MEASUREMENT FLN41_04 " Lernfilterwert, negativ" SWORD DTSEGN_S16 0 0 -144.000000 144.000000 ECU_ADDRESS 0xB2612 BIT_MASK 0xFFFF /end MEASUREMENT
/begin MEASUREMENT FLN41_05 " Lernfilterwert, negativ" SWORD DTSEGN_S16 0 0 -144.000000 144.000000 ECU_ADDRESS 0xB2636 BIT_MASK 0xFFFF /end MEASUREMENT
/begin MEASUREMENT FLN41_06 " Lernfilterwert, negativ" SWORD DTSEGN_S16 0 0 -144.000000 144.000000 ECU_ADDRESS 0xB265A BIT_MASK 0xFFFF /end MEASUREMENT
/begin MEASUREMENT FLN41_07 " Lernfilterwert, negativ" SWORD DTSEGN_S16 0 0 -144.000000 144.000000 ECU_ADDRESS 0xB267E BIT_MASK 0xFFFF /end MEASUREMENT
/begin MEASUREMENT FLN41_08 " Lernfilterwert, negativ" SWORD DTSEGN_S16 0 0 -144.000000 144.000000 ECU_ADDRESS 0xB26A2 BIT_MASK 0xFFFF /end MEASUREMENT
/begin MEASUREMENT FLN42_02 " Lernfilterwert, negativ" SWORD DTSEGN_S16 0 0 -144.000000 144.000000 ECU_ADDRESS 0xB25D6 BIT_MASK 0xFFFF /end MEASUREMENT
/begin MEASUREMENT FLN42_03 " Lernfilterwert, negativ" SWORD DTSEGN_S16 0 0 -144.000000 144.000000 ECU_ADDRESS 0xB25FA BIT_MASK 0xFFFF /end MEASUREMENT
/begin MEASUREMENT FLN42_04 " Lernfilterwert, negativ" SWORD DTSEGN_S16 0 0 -144.000000 144.000000 ECU_ADDRESS 0xB261E BIT_MASK 0xFFFF /end MEASUREMENT
/begin MEASUREMENT FLN42_05 " Lernfilterwert, negativ" SWORD DTSEGN_S16 0 0 -144.000000 144.000000 ECU_ADDRESS 0xB2642 BIT_MASK 0xFFFF /end MEASUREMENT
/begin MEASUREMENT FLN42_06 " Lernfilterwert, negativ" SWORD DTSEGN_S16 0 0 -144.000000 144.000000 ECU_ADDRESS 0xB2666 BIT_MASK 0xFFFF /end MEASUREMENT
/begin MEASUREMENT FLN42_07 " Lernfilterwert, negativ" SWORD DTSEGN_S16 0 0 -144.000000 144.000000 ECU_ADDRESS 0xB268A BIT_MASK 0xFFFF /end MEASUREMENT
/begin MEASUREMENT FLN42_08 " Lernfilterwert, negativ" SWORD DTSEGN_S16 0 0 -144.000000 144.000000 ECU_ADDRESS 0xB26AE BIT_MASK 0xFFFF /end MEASUREMENT
/begin MEASUREMENT FLN43_02 " Lernfilterwert, negativ" SWORD DTSEGN_S16 0 0 -144.000000 144.000000 ECU_ADDRESS 0xB25E2 BIT_MASK 0xFFFF /end MEASUREMENT
/begin MEASUREMENT FLN43_03 " Lernfilterwert, negativ" SWORD DTSEGN_S16 0 0 -144.000000 144.000000 ECU_ADDRESS 0xB2606 BIT_MASK 0xFFFF /end MEASUREMENT
/begin MEASUREMENT FLN43_04 " Lernfilterwert, negativ" SWORD DTSEGN_S16 0 0 -144.000000 144.000000 ECU_ADDRESS 0xB262A BIT_MASK 0xFFFF /end MEASUREMENT
/begin MEASUREMENT FLN43_05 " Lernfilterwert, negativ" SWORD DTSEGN_S16 0 0 -144.000000 144.000000 ECU_ADDRESS 0xB264E BIT_MASK 0xFFFF /end MEASUREMENT
/begin MEASUREMENT FLN43_06 " Lernfilterwert, negativ" SWORD DTSEGN_S16 0 0 -144.000000 144.000000 ECU_ADDRESS 0xB2672 BIT_MASK 0xFFFF /end MEASUREMENT
/begin MEASUREMENT FLN43_07 " Lernfilterwert, negativ" SWORD DTSEGN_S16 0 0 -144.000000 144.000000 ECU_ADDRESS 0xB2696 BIT_MASK 0xFFFF /end MEASUREMENT
/begin MEASUREMENT FLN43_08 " Lernfilterwert, negativ" SWORD DTSEGN_S16 0 0 -144.000000 144.000000 ECU_ADDRESS 0xB26BA BIT_MASK 0xFFFF /end MEASUREMENT
/begin MEASUREMENT FLN51_02 " Lernfilterwert, negativ" SWORD DTSEGN_S16 0 0 -144.000000 144.000000 ECU_ADDRESS 0xB25CC BIT_MASK 0xFFFF /end MEASUREMENT
/begin MEASUREMENT FLN51_03 " Lernfilterwert, negativ" SWORD DTSEGN_S16 0 0 -144.000000 144.000000 ECU_ADDRESS 0xB25F0 BIT_MASK 0xFFFF /end MEASUREMENT
/begin MEASUREMENT FLN51_04 " Lernfilterwert, negativ" SWORD DTSEGN_S16 0 0 -144.000000 144.000000 ECU_ADDRESS 0xB2614 BIT_MASK 0xFFFF /end MEASUREMENT
/begin MEASUREMENT FLN51_05 " Lernfilterwert, negativ" SWORD DTSEGN_S16 0 0 -144.000000 144.000000 ECU_ADDRESS 0xB2638 BIT_MASK 0xFFFF /end MEASUREMENT
/begin MEASUREMENT FLN51_06 " Lernfilterwert, negativ" SWORD DTSEGN_S16 0 0 -144.000000 144.000000 ECU_ADDRESS 0xB265C BIT_MASK 0xFFFF /end MEASUREMENT
/begin MEASUREMENT FLN51_07 " Lernfilterwert, negativ" SWORD DTSEGN_S16 0 0 -144.000000 144.000000 ECU_ADDRESS 0xB2680 BIT_MASK 0xFFFF /end MEASUREMENT
/begin MEASUREMENT FLN51_08 " Lernfilterwert, negativ" SWORD DTSEGN_S16 0 0 -144.000000 144.000000 ECU_ADDRESS 0xB26A4 BIT_MASK 0xFFFF /end MEASUREMENT
/begin MEASUREMENT FLN52_02 " Lernfilterwert, negativ" SWORD DTSEGN_S16 0 0 -144.000000 144.000000 ECU_ADDRESS 0xB25D8 BIT_MASK 0xFFFF /end MEASUREMENT
/begin MEASUREMENT FLN52_03 " Lernfilterwert, negativ" SWORD DTSEGN_S16 0 0 -144.000000 144.000000 ECU_ADDRESS 0xB25FC BIT_MASK 0xFFFF /end MEASUREMENT
/begin MEASUREMENT FLN52_04 " Lernfilterwert, negativ" SWORD DTSEGN_S16 0 0 -144.000000 144.000000 ECU_ADDRESS 0xB2620 BIT_MASK 0xFFFF /end MEASUREMENT
/begin MEASUREMENT FLN52_05 " Lernfilterwert, negativ" SWORD DTSEGN_S16 0 0 -144.000000 144.000000 ECU_ADDRESS 0xB2644 BIT_MASK 0xFFFF /end MEASUREMENT
/begin MEASUREMENT FLN52_06 " Lernfilterwert, negativ" SWORD DTSEGN_S16 0 0 -144.000000 144.000000 ECU_ADDRESS 0xB2668 BIT_MASK 0xFFFF /end MEASUREMENT
/begin MEASUREMENT FLN52_07 " Lernfilterwert, negativ" SWORD DTSEGN_S16 0 0 -144.000000 144.000000 ECU_ADDRESS 0xB268C BIT_MASK 0xFFFF /end MEASUREMENT
/begin MEASUREMENT FLN52_08 " Lernfilterwert, negativ" SWORD DTSEGN_S16 0 0 -144.000000 144.000000 ECU_ADDRESS 0xB26B0 BIT_MASK 0xFFFF /end MEASUREMENT
/begin MEASUREMENT FLN53_02 " Lernfilterwert, negativ" SWORD DTSEGN_S16 0 0 -144.000000 144.000000 ECU_ADDRESS 0xB25E4 BIT_MASK 0xFFFF /end MEASUREMENT
/begin MEASUREMENT FLN53_03 " Lernfilterwert, negativ" SWORD DTSEGN_S16 0 0 -144.000000 144.000000 ECU_ADDRESS 0xB2608 BIT_MASK 0xFFFF /end MEASUREMENT
/begin MEASUREMENT FLN53_04 " Lernfilterwert, negativ" SWORD DTSEGN_S16 0 0 -144.000000 144.000000 ECU_ADDRESS 0xB262C BIT_MASK 0xFFFF /end MEASUREMENT
/begin MEASUREMENT FLN53_05 " Lernfilterwert, negativ" SWORD DTSEGN_S16 0 0 -144.000000 144.000000 ECU_ADDRESS 0xB2650 BIT_MASK 0xFFFF /end MEASUREMENT
/begin MEASUREMENT FLN53_06 " Lernfilterwert, negativ" SWORD DTSEGN_S16 0 0 -144.000000 144.000000 ECU_ADDRESS 0xB2674 BIT_MASK 0xFFFF /end MEASUREMENT
/begin MEASUREMENT FLN53_07 " Lernfilterwert, negativ" SWORD DTSEGN_S16 0 0 -144.000000 144.000000 ECU_ADDRESS 0xB2698 BIT_MASK 0xFFFF /end MEASUREMENT
/begin MEASUREMENT FLN53_08 " Lernfilterwert, negativ" SWORD DTSEGN_S16 0 0 -144.000000 144.000000 ECU_ADDRESS 0xB26BC BIT_MASK 0xFFFF /end MEASUREMENT
/begin MEASUREMENT FLN61_02 " Lernfilterwert, negativ" SWORD DTSEGN_S16 0 0 -144.000000 144.000000 ECU_ADDRESS 0xB25CE BIT_MASK 0xFFFF /end MEASUREMENT
/begin MEASUREMENT FLN61_03 " Lernfilterwert, negativ" SWORD DTSEGN_S16 0 0 -144.000000 144.000000 ECU_ADDRESS 0xB25F2 BIT_MASK 0xFFFF /end MEASUREMENT
/begin MEASUREMENT FLN61_04 " Lernfilterwert, negativ" SWORD DTSEGN_S16 0 0 -144.000000 144.000000 ECU_ADDRESS 0xB2616 BIT_MASK 0xFFFF /end MEASUREMENT
/begin MEASUREMENT FLN61_05 " Lernfilterwert, negativ" SWORD DTSEGN_S16 0 0 -144.000000 144.000000 ECU_ADDRESS 0xB263A BIT_MASK 0xFFFF /end MEASUREMENT
/begin MEASUREMENT FLN61_06 " Lernfilterwert, negativ" SWORD DTSEGN_S16 0 0 -144.000000 144.000000 ECU_ADDRESS 0xB265E BIT_MASK 0xFFFF /end MEASUREMENT
/begin MEASUREMENT FLN61_07 " Lernfilterwert, negativ" SWORD DTSEGN_S16 0 0 -144.000000 144.000000 ECU_ADDRESS 0xB2682 BIT_MASK 0xFFFF /end MEASUREMENT
/begin MEASUREMENT FLN61_08 " Lernfilterwert, negativ" SWORD DTSEGN_S16 0 0 -144.000000 144.000000 ECU_ADDRESS 0xB26A6 BIT_MASK 0xFFFF /end MEASUREMENT
/begin MEASUREMENT FLN62_02 " Lernfilterwert, negativ" SWORD DTSEGN_S16 0 0 -144.000000 144.000000 ECU_ADDRESS 0xB25DA BIT_MASK 0xFFFF /end MEASUREMENT
/begin MEASUREMENT FLN62_03 " Lernfilterwert, negativ" SWORD DTSEGN_S16 0 0 -144.000000 144.000000 ECU_ADDRESS 0xB25FE BIT_MASK 0xFFFF /end MEASUREMENT
/begin MEASUREMENT FLN62_04 " Lernfilterwert, negativ" SWORD DTSEGN_S16 0 0 -144.000000 144.000000 ECU_ADDRESS 0xB2622 BIT_MASK 0xFFFF /end MEASUREMENT
/begin MEASUREMENT FLN62_05 " Lernfilterwert, negativ" SWORD DTSEGN_S16 0 0 -144.000000 144.000000 ECU_ADDRESS 0xB2646 BIT_MASK 0xFFFF /end MEASUREMENT
/begin MEASUREMENT FLN62_06 " Lernfilterwert, negativ" SWORD DTSEGN_S16 0 0 -144.000000 144.000000 ECU_ADDRESS 0xB266A BIT_MASK 0xFFFF /end MEASUREMENT
/begin MEASUREMENT FLN62_07 " Lernfilterwert, negativ" SWORD DTSEGN_S16 0 0 -144.000000 144.000000 ECU_ADDRESS 0xB268E BIT_MASK 0xFFFF /end MEASUREMENT
/begin MEASUREMENT FLN62_08 " Lernfilterwert, negativ" SWORD DTSEGN_S16 0 0 -144.000000 144.000000 ECU_ADDRESS 0xB26B2 BIT_MASK 0xFFFF /end MEASUREMENT
/begin MEASUREMENT FLN63_02 " Lernfilterwert, negativ" SWORD DTSEGN_S16 0 0 -144.000000 144.000000 ECU_ADDRESS 0xB25E6 BIT_MASK 0xFFFF /end MEASUREMENT
/begin MEASUREMENT FLN63_03 " Lernfilterwert, negativ" SWORD DTSEGN_S16 0 0 -144.000000 144.000000 ECU_ADDRESS 0xB260A BIT_MASK 0xFFFF /end MEASUREMENT
/begin MEASUREMENT FLN63_04 " Lernfilterwert, negativ" SWORD DTSEGN_S16 0 0 -144.000000 144.000000 ECU_ADDRESS 0xB262E BIT_MASK 0xFFFF /end MEASUREMENT
/begin MEASUREMENT FLN63_05 " Lernfilterwert, negativ" SWORD DTSEGN_S16 0 0 -144.000000 144.000000 ECU_ADDRESS 0xB2652 BIT_MASK 0xFFFF /end MEASUREMENT
/begin MEASUREMENT FLN63_06 " Lernfilterwert, negativ" SWORD DTSEGN_S16 0 0 -144.000000 144.000000 ECU_ADDRESS 0xB2676 BIT_MASK 0xFFFF /end MEASUREMENT
/begin MEASUREMENT FLN63_07 " Lernfilterwert, negativ" SWORD DTSEGN_S16 0 0 -144.000000 144.000000 ECU_ADDRESS 0xB269A BIT_MASK 0xFFFF /end MEASUREMENT
/begin MEASUREMENT FLN63_08 " Lernfilterwert, negativ" SWORD DTSEGN_S16 0 0 -144.000000 144.000000 ECU_ADDRESS 0xB26BE BIT_MASK 0xFFFF /end MEASUREMENT
/begin MEASUREMENT FLP11_02 " Lernfilterwert, positiv, Betriebsbereich 11, Zylinder 2" SWORD DTSEGN_S16 0 0 -144.000000 144.000000 ECU_ADDRESS 0xB26C0 BIT_MASK 0xFFFF /end MEASUREMENT
/begin MEASUREMENT FLP11_03 " Lernfilterwert, positiv" SWORD DTSEGN_S16 0 0 -144.000000 144.000000 ECU_ADDRESS 0xB26E4 BIT_MASK 0xFFFF /end MEASUREMENT
/begin MEASUREMENT FLP11_04 " Lernfilterwert, positiv" SWORD DTSEGN_S16 0 0 -144.000000 144.000000 ECU_ADDRESS 0xB2708 BIT_MASK 0xFFFF /end MEASUREMENT
/begin MEASUREMENT FLP11_05 " Lernfilterwert, positiv" SWORD DTSEGN_S16 0 0 -144.000000 144.000000 ECU_ADDRESS 0xB272C BIT_MASK 0xFFFF /end MEASUREMENT
/begin MEASUREMENT FLP11_06 " Lernfilterwert, positiv" SWORD DTSEGN_S16 0 0 -144.000000 144.000000 ECU_ADDRESS 0xB2750 BIT_MASK 0xFFFF /end MEASUREMENT
/begin MEASUREMENT FLP11_07 " Lernfilterwert, positiv" SWORD DTSEGN_S16 0 0 -144.000000 144.000000 ECU_ADDRESS 0xB2774 BIT_MASK 0xFFFF /end MEASUREMENT
/begin MEASUREMENT FLP11_08 " Lernfilterwert, positiv" SWORD DTSEGN_S16 0 0 -144.000000 144.000000 ECU_ADDRESS 0xB2798 BIT_MASK 0xFFFF /end MEASUREMENT
/begin MEASUREMENT FLP12_02 " Lernfilterwert, positiv" SWORD DTSEGN_S16 0 0 -144.000000 144.000000 ECU_ADDRESS 0xB26CC BIT_MASK 0xFFFF /end MEASUREMENT
/begin MEASUREMENT FLP12_03 " Lernfilterwert, positiv" SWORD DTSEGN_S16 0 0 -144.000000 144.000000 ECU_ADDRESS 0xB26F0 BIT_MASK 0xFFFF /end MEASUREMENT
/begin MEASUREMENT FLP12_04 " Lernfilterwert, positiv" SWORD DTSEGN_S16 0 0 -144.000000 144.000000 ECU_ADDRESS 0xB2714 BIT_MASK 0xFFFF /end MEASUREMENT
/begin MEASUREMENT FLP12_05 " Lernfilterwert, positiv" SWORD DTSEGN_S16 0 0 -144.000000 144.000000 ECU_ADDRESS 0xB2738 BIT_MASK 0xFFFF /end MEASUREMENT
/begin MEASUREMENT FLP12_06 " Lernfilterwert, positiv" SWORD DTSEGN_S16 0 0 -144.000000 144.000000 ECU_ADDRESS 0xB275C BIT_MASK 0xFFFF /end MEASUREMENT
/begin MEASUREMENT FLP12_07 " Lernfilterwert, positiv" SWORD DTSEGN_S16 0 0 -144.000000 144.000000 ECU_ADDRESS 0xB2780 BIT_MASK 0xFFFF /end MEASUREMENT
/begin MEASUREMENT FLP12_08 " Lernfilterwert, positiv" SWORD DTSEGN_S16 0 0 -144.000000 144.000000 ECU_ADDRESS 0xB27A4 BIT_MASK 0xFFFF /end MEASUREMENT
/begin MEASUREMENT FLP13_02 " Lernfilterwert, positiv" SWORD DTSEGN_S16 0 0 -144.000000 144.000000 ECU_ADDRESS 0xB26D8 BIT_MASK 0xFFFF /end MEASUREMENT
/begin MEASUREMENT FLP13_03 " Lernfilterwert, positiv" SWORD DTSEGN_S16 0 0 -144.000000 144.000000 ECU_ADDRESS 0xB26FC BIT_MASK 0xFFFF /end MEASUREMENT
/begin MEASUREMENT FLP13_04 " Lernfilterwert, positiv" SWORD DTSEGN_S16 0 0 -144.000000 144.000000 ECU_ADDRESS 0xB2720 BIT_MASK 0xFFFF /end MEASUREMENT
/begin MEASUREMENT FLP13_05 " Lernfilterwert, positiv" SWORD DTSEGN_S16 0 0 -144.000000 144.000000 ECU_ADDRESS 0xB2744 BIT_MASK 0xFFFF /end MEASUREMENT
/begin MEASUREMENT FLP13_06 " Lernfilterwert, positiv" SWORD DTSEGN_S16 0 0 -144.000000 144.000000 ECU_ADDRESS 0xB2768 BIT_MASK 0xFFFF /end MEASUREMENT
/begin MEASUREMENT FLP13_07 " Lernfilterwert, positiv" SWORD DTSEGN_S16 0 0 -144.000000 144.000000 ECU_ADDRESS 0xB278C BIT_MASK 0xFFFF /end MEASUREMENT
/begin MEASUREMENT FLP13_08 " Lernfilterwert, positiv" SWORD DTSEGN_S16 0 0 -144.000000 144.000000 ECU_ADDRESS 0xB27B0 BIT_MASK 0xFFFF /end MEASUREMENT
/begin MEASUREMENT FLP21_02 " Lernfilterwert, positiv" SWORD DTSEGN_S16 0 0 -144.000000 144.000000 ECU_ADDRESS 0xB26C2 BIT_MASK 0xFFFF /end MEASUREMENT
/begin MEASUREMENT FLP21_03 " Lernfilterwert, positiv" SWORD DTSEGN_S16 0 0 -144.000000 144.000000 ECU_ADDRESS 0xB26E6 BIT_MASK 0xFFFF /end MEASUREMENT
/begin MEASUREMENT FLP21_04 " Lernfilterwert, positiv" SWORD DTSEGN_S16 0 0 -144.000000 144.000000 ECU_ADDRESS 0xB270A BIT_MASK 0xFFFF /end MEASUREMENT
/begin MEASUREMENT FLP21_05 " Lernfilterwert, positiv" SWORD DTSEGN_S16 0 0 -144.000000 144.000000 ECU_ADDRESS 0xB272E BIT_MASK 0xFFFF /end MEASUREMENT
/begin MEASUREMENT FLP21_06 " Lernfilterwert, positiv" SWORD DTSEGN_S16 0 0 -144.000000 144.000000 ECU_ADDRESS 0xB2752 BIT_MASK 0xFFFF /end MEASUREMENT
/begin MEASUREMENT FLP21_07 " Lernfilterwert, positiv" SWORD DTSEGN_S16 0 0 -144.000000 144.000000 ECU_ADDRESS 0xB2776 BIT_MASK 0xFFFF /end MEASUREMENT
/begin MEASUREMENT FLP21_08 " Lernfilterwert, positiv" SWORD DTSEGN_S16 0 0 -144.000000 144.000000 ECU_ADDRESS 0xB279A BIT_MASK 0xFFFF /end MEASUREMENT
/begin MEASUREMENT FLP22_02 " Lernfilterwert, positiv" SWORD DTSEGN_S16 0 0 -144.000000 144.000000 ECU_ADDRESS 0xB26CE BIT_MASK 0xFFFF /end MEASUREMENT
/begin MEASUREMENT FLP22_03 " Lernfilterwert, positiv" SWORD DTSEGN_S16 0 0 -144.000000 144.000000 ECU_ADDRESS 0xB26F2 BIT_MASK 0xFFFF /end MEASUREMENT
/begin MEASUREMENT FLP22_04 " Lernfilterwert, positiv" SWORD DTSEGN_S16 0 0 -144.000000 144.000000 ECU_ADDRESS 0xB2716 BIT_MASK 0xFFFF /end MEASUREMENT
/begin MEASUREMENT FLP22_05 " Lernfilterwert, positiv" SWORD DTSEGN_S16 0 0 -144.000000 144.000000 ECU_ADDRESS 0xB273A BIT_MASK 0xFFFF /end MEASUREMENT
/begin MEASUREMENT FLP22_06 " Lernfilterwert, positiv" SWORD DTSEGN_S16 0 0 -144.000000 144.000000 ECU_ADDRESS 0xB275E BIT_MASK 0xFFFF /end MEASUREMENT
/begin MEASUREMENT FLP22_07 " Lernfilterwert, positiv" SWORD DTSEGN_S16 0 0 -144.000000 144.000000 ECU_ADDRESS 0xB2782 BIT_MASK 0xFFFF /end MEASUREMENT
/begin MEASUREMENT FLP22_08 " Lernfilterwert, positiv" SWORD DTSEGN_S16 0 0 -144.000000 144.000000 ECU_ADDRESS 0xB27A6 BIT_MASK 0xFFFF /end MEASUREMENT
/begin MEASUREMENT FLP23_02 " Lernfilterwert, positiv" SWORD DTSEGN_S16 0 0 -144.000000 144.000000 ECU_ADDRESS 0xB26DA BIT_MASK 0xFFFF /end MEASUREMENT
/begin MEASUREMENT FLP23_03 " Lernfilterwert, positiv" SWORD DTSEGN_S16 0 0 -144.000000 144.000000 ECU_ADDRESS 0xB26FE BIT_MASK 0xFFFF /end MEASUREMENT
/begin MEASUREMENT FLP23_04 " Lernfilterwert, positiv" SWORD DTSEGN_S16 0 0 -144.000000 144.000000 ECU_ADDRESS 0xB2722 BIT_MASK 0xFFFF /end MEASUREMENT
/begin MEASUREMENT FLP23_05 " Lernfilterwert, positiv" SWORD DTSEGN_S16 0 0 -144.000000 144.000000 ECU_ADDRESS 0xB2746 BIT_MASK 0xFFFF /end MEASUREMENT
/begin MEASUREMENT FLP23_06 " Lernfilterwert, positiv" SWORD DTSEGN_S16 0 0 -144.000000 144.000000 ECU_ADDRESS 0xB276A BIT_MASK 0xFFFF /end MEASUREMENT
/begin MEASUREMENT FLP23_07 " Lernfilterwert, positiv" SWORD DTSEGN_S16 0 0 -144.000000 144.000000 ECU_ADDRESS 0xB278E BIT_MASK 0xFFFF /end MEASUREMENT
/begin MEASUREMENT FLP23_08 " Lernfilterwert, positiv" SWORD DTSEGN_S16 0 0 -144.000000 144.000000 ECU_ADDRESS 0xB27B2 BIT_MASK 0xFFFF /end MEASUREMENT
/begin MEASUREMENT FLP31_02 " Lernfilterwert, positiv" SWORD DTSEGN_S16 0 0 -144.000000 144.000000 ECU_ADDRESS 0xB26C4 BIT_MASK 0xFFFF /end MEASUREMENT
/begin MEASUREMENT FLP31_03 " Lernfilterwert, positiv" SWORD DTSEGN_S16 0 0 -144.000000 144.000000 ECU_ADDRESS 0xB26E8 BIT_MASK 0xFFFF /end MEASUREMENT
/begin MEASUREMENT FLP31_04 " Lernfilterwert, positiv" SWORD DTSEGN_S16 0 0 -144.000000 144.000000 ECU_ADDRESS 0xB270C BIT_MASK 0xFFFF /end MEASUREMENT
/begin MEASUREMENT FLP31_05 " Lernfilterwert, positiv" SWORD DTSEGN_S16 0 0 -144.000000 144.000000 ECU_ADDRESS 0xB2730 BIT_MASK 0xFFFF /end MEASUREMENT
/begin MEASUREMENT FLP31_06 " Lernfilterwert, positiv" SWORD DTSEGN_S16 0 0 -144.000000 144.000000 ECU_ADDRESS 0xB2754 BIT_MASK 0xFFFF /end MEASUREMENT
/begin MEASUREMENT FLP31_07 " Lernfilterwert, positiv" SWORD DTSEGN_S16 0 0 -144.000000 144.000000 ECU_ADDRESS 0xB2778 BIT_MASK 0xFFFF /end MEASUREMENT
/begin MEASUREMENT FLP31_08 " Lernfilterwert, positiv" SWORD DTSEGN_S16 0 0 -144.000000 144.000000 ECU_ADDRESS 0xB279C BIT_MASK 0xFFFF /end MEASUREMENT
/begin MEASUREMENT FLP32_02 " Lernfilterwert, positiv" SWORD DTSEGN_S16 0 0 -144.000000 144.000000 ECU_ADDRESS 0xB26D0 BIT_MASK 0xFFFF /end MEASUREMENT
/begin MEASUREMENT FLP32_03 " Lernfilterwert, positiv" SWORD DTSEGN_S16 0 0 -144.000000 144.000000 ECU_ADDRESS 0xB26F4 BIT_MASK 0xFFFF /end MEASUREMENT
/begin MEASUREMENT FLP32_04 " Lernfilterwert, positiv" SWORD DTSEGN_S16 0 0 -144.000000 144.000000 ECU_ADDRESS 0xB2718 BIT_MASK 0xFFFF /end MEASUREMENT
/begin MEASUREMENT FLP32_05 " Lernfilterwert, positiv" SWORD DTSEGN_S16 0 0 -144.000000 144.000000 ECU_ADDRESS 0xB273C BIT_MASK 0xFFFF /end MEASUREMENT
/begin MEASUREMENT FLP32_06 " Lernfilterwert, positiv" SWORD DTSEGN_S16 0 0 -144.000000 144.000000 ECU_ADDRESS 0xB2760 BIT_MASK 0xFFFF /end MEASUREMENT
/begin MEASUREMENT FLP32_07 " Lernfilterwert, positiv" SWORD DTSEGN_S16 0 0 -144.000000 144.000000 ECU_ADDRESS 0xB2784 BIT_MASK 0xFFFF /end MEASUREMENT
/begin MEASUREMENT FLP32_08 " Lernfilterwert, positiv" SWORD DTSEGN_S16 0 0 -144.000000 144.000000 ECU_ADDRESS 0xB27A8 BIT_MASK 0xFFFF /end MEASUREMENT
/begin MEASUREMENT FLP33_02 " Lernfilterwert, positiv" SWORD DTSEGN_S16 0 0 -144.000000 144.000000 ECU_ADDRESS 0xB26DC BIT_MASK 0xFFFF /end MEASUREMENT
/begin MEASUREMENT FLP33_03 " Lernfilterwert, positiv" SWORD DTSEGN_S16 0 0 -144.000000 144.000000 ECU_ADDRESS 0xB2700 BIT_MASK 0xFFFF /end MEASUREMENT
/begin MEASUREMENT FLP33_04 " Lernfilterwert, positiv" SWORD DTSEGN_S16 0 0 -144.000000 144.000000 ECU_ADDRESS 0xB2724 BIT_MASK 0xFFFF /end MEASUREMENT
/begin MEASUREMENT FLP33_05 " Lernfilterwert, positiv" SWORD DTSEGN_S16 0 0 -144.000000 144.000000 ECU_ADDRESS 0xB2748 BIT_MASK 0xFFFF /end MEASUREMENT
/begin MEASUREMENT FLP33_06 " Lernfilterwert, positiv" SWORD DTSEGN_S16 0 0 -144.000000 144.000000 ECU_ADDRESS 0xB276C BIT_MASK 0xFFFF /end MEASUREMENT
/begin MEASUREMENT FLP33_07 " Lernfilterwert, positiv" SWORD DTSEGN_S16 0 0 -144.000000 144.000000 ECU_ADDRESS 0xB2790 BIT_MASK 0xFFFF /end MEASUREMENT
/begin MEASUREMENT FLP33_08 " Lernfilterwert, positiv" SWORD DTSEGN_S16 0 0 -144.000000 144.000000 ECU_ADDRESS 0xB27B4 BIT_MASK 0xFFFF /end MEASUREMENT
/begin MEASUREMENT FLP41_02 " Lernfilterwert, positiv" SWORD DTSEGN_S16 0 0 -144.000000 144.000000 ECU_ADDRESS 0xB26C6 BIT_MASK 0xFFFF /end MEASUREMENT
/begin MEASUREMENT FLP41_03 " Lernfilterwert, positiv" SWORD DTSEGN_S16 0 0 -144.000000 144.000000 ECU_ADDRESS 0xB26EA BIT_MASK 0xFFFF /end MEASUREMENT
/begin MEASUREMENT FLP41_04 " Lernfilterwert, positiv" SWORD DTSEGN_S16 0 0 -144.000000 144.000000 ECU_ADDRESS 0xB270E BIT_MASK 0xFFFF /end MEASUREMENT
/begin MEASUREMENT FLP41_05 " Lernfilterwert, positiv" SWORD DTSEGN_S16 0 0 -144.000000 144.000000 ECU_ADDRESS 0xB2732 BIT_MASK 0xFFFF /end MEASUREMENT
/begin MEASUREMENT FLP41_06 " Lernfilterwert, positiv" SWORD DTSEGN_S16 0 0 -144.000000 144.000000 ECU_ADDRESS 0xB2756 BIT_MASK 0xFFFF /end MEASUREMENT
/begin MEASUREMENT FLP41_07 " Lernfilterwert, positiv" SWORD DTSEGN_S16 0 0 -144.000000 144.000000 ECU_ADDRESS 0xB277A BIT_MASK 0xFFFF /end MEASUREMENT
/begin MEASUREMENT FLP41_08 " Lernfilterwert, positiv" SWORD DTSEGN_S16 0 0 -144.000000 144.000000 ECU_ADDRESS 0xB279E BIT_MASK 0xFFFF /end MEASUREMENT
/begin MEASUREMENT FLP42_02 " Lernfilterwert, positiv" SWORD DTSEGN_S16 0 0 -144.000000 144.000000 ECU_ADDRESS 0xB26D2 BIT_MASK 0xFFFF /end MEASUREMENT
/begin MEASUREMENT FLP42_03 " Lernfilterwert, positiv" SWORD DTSEGN_S16 0 0 -144.000000 144.000000 ECU_ADDRESS 0xB26F6 BIT_MASK 0xFFFF /end MEASUREMENT
/begin MEASUREMENT FLP42_04 " Lernfilterwert, positiv" SWORD DTSEGN_S16 0 0 -144.000000 144.000000 ECU_ADDRESS 0xB271A BIT_MASK 0xFFFF /end MEASUREMENT
/begin MEASUREMENT FLP42_05 " Lernfilterwert, positiv" SWORD DTSEGN_S16 0 0 -144.000000 144.000000 ECU_ADDRESS 0xB273E BIT_MASK 0xFFFF /end MEASUREMENT
/begin MEASUREMENT FLP42_06 " Lernfilterwert, positiv" SWORD DTSEGN_S16 0 0 -144.000000 144.000000 ECU_ADDRESS 0xB2762 BIT_MASK 0xFFFF /end MEASUREMENT
/begin MEASUREMENT FLP42_07 " Lernfilterwert, positiv" SWORD DTSEGN_S16 0 0 -144.000000 144.000000 ECU_ADDRESS 0xB2786 BIT_MASK 0xFFFF /end MEASUREMENT
/begin MEASUREMENT FLP42_08 " Lernfilterwert, positiv" SWORD DTSEGN_S16 0 0 -144.000000 144.000000 ECU_ADDRESS 0xB27AA BIT_MASK 0xFFFF /end MEASUREMENT
/begin MEASUREMENT FLP43_02 " Lernfilterwert, positiv" SWORD DTSEGN_S16 0 0 -144.000000 144.000000 ECU_ADDRESS 0xB26DE BIT_MASK 0xFFFF /end MEASUREMENT
/begin MEASUREMENT FLP43_03 " Lernfilterwert, positiv" SWORD DTSEGN_S16 0 0 -144.000000 144.000000 ECU_ADDRESS 0xB2702 BIT_MASK 0xFFFF /end MEASUREMENT
/begin MEASUREMENT FLP43_04 " Lernfilterwert, positiv" SWORD DTSEGN_S16 0 0 -144.000000 144.000000 ECU_ADDRESS 0xB2726 BIT_MASK 0xFFFF /end MEASUREMENT
/begin MEASUREMENT FLP43_05 " Lernfilterwert, positiv" SWORD DTSEGN_S16 0 0 -144.000000 144.000000 ECU_ADDRESS 0xB274A BIT_MASK 0xFFFF /end MEASUREMENT
/begin MEASUREMENT FLP43_06 " Lernfilterwert, positiv" SWORD DTSEGN_S16 0 0 -144.000000 144.000000 ECU_ADDRESS 0xB276E BIT_MASK 0xFFFF /end MEASUREMENT
/begin MEASUREMENT FLP43_07 " Lernfilterwert, positiv" SWORD DTSEGN_S16 0 0 -144.000000 144.000000 ECU_ADDRESS 0xB2792 BIT_MASK 0xFFFF /end MEASUREMENT
/begin MEASUREMENT FLP43_08 " Lernfilterwert, positiv" SWORD DTSEGN_S16 0 0 -144.000000 144.000000 ECU_ADDRESS 0xB27B6 BIT_MASK 0xFFFF /end MEASUREMENT
/begin MEASUREMENT FLP51_02 " Lernfilterwert, positiv" SWORD DTSEGN_S16 0 0 -144.000000 144.000000 ECU_ADDRESS 0xB26C8 BIT_MASK 0xFFFF /end MEASUREMENT
/begin MEASUREMENT FLP51_03 " Lernfilterwert, positiv" SWORD DTSEGN_S16 0 0 -144.000000 144.000000 ECU_ADDRESS 0xB26EC BIT_MASK 0xFFFF /end MEASUREMENT
/begin MEASUREMENT FLP51_04 " Lernfilterwert, positiv" SWORD DTSEGN_S16 0 0 -144.000000 144.000000 ECU_ADDRESS 0xB2710 BIT_MASK 0xFFFF /end MEASUREMENT
/begin MEASUREMENT FLP51_05 " Lernfilterwert, positiv" SWORD DTSEGN_S16 0 0 -144.000000 144.000000 ECU_ADDRESS 0xB2734 BIT_MASK 0xFFFF /end MEASUREMENT
/begin MEASUREMENT FLP51_06 " Lernfilterwert, positiv" SWORD DTSEGN_S16 0 0 -144.000000 144.000000 ECU_ADDRESS 0xB2758 BIT_MASK 0xFFFF /end MEASUREMENT
/begin MEASUREMENT FLP51_07 " Lernfilterwert, positiv" SWORD DTSEGN_S16 0 0 -144.000000 144.000000 ECU_ADDRESS 0xB277C BIT_MASK 0xFFFF /end MEASUREMENT
/begin MEASUREMENT FLP51_08 " Lernfilterwert, positiv" SWORD DTSEGN_S16 0 0 -144.000000 144.000000 ECU_ADDRESS 0xB27A0 BIT_MASK 0xFFFF /end MEASUREMENT
/begin MEASUREMENT FLP52_02 " Lernfilterwert, positiv" SWORD DTSEGN_S16 0 0 -144.000000 144.000000 ECU_ADDRESS 0xB26D4 BIT_MASK 0xFFFF /end MEASUREMENT
/begin MEASUREMENT FLP52_03 " Lernfilterwert, positiv" SWORD DTSEGN_S16 0 0 -144.000000 144.000000 ECU_ADDRESS 0xB26F8 BIT_MASK 0xFFFF /end MEASUREMENT
/begin MEASUREMENT FLP52_04 " Lernfilterwert, positiv" SWORD DTSEGN_S16 0 0 -144.000000 144.000000 ECU_ADDRESS 0xB271C BIT_MASK 0xFFFF /end MEASUREMENT
/begin MEASUREMENT FLP52_05 " Lernfilterwert, positiv" SWORD DTSEGN_S16 0 0 -144.000000 144.000000 ECU_ADDRESS 0xB2740 BIT_MASK 0xFFFF /end MEASUREMENT
/begin MEASUREMENT FLP52_06 " Lernfilterwert, positiv" SWORD DTSEGN_S16 0 0 -144.000000 144.000000 ECU_ADDRESS 0xB2764 BIT_MASK 0xFFFF /end MEASUREMENT
/begin MEASUREMENT FLP52_07 " Lernfilterwert, positiv" SWORD DTSEGN_S16 0 0 -144.000000 144.000000 ECU_ADDRESS 0xB2788 BIT_MASK 0xFFFF /end MEASUREMENT
/begin MEASUREMENT FLP52_08 " Lernfilterwert, positiv" SWORD DTSEGN_S16 0 0 -144.000000 144.000000 ECU_ADDRESS 0xB27AC BIT_MASK 0xFFFF /end MEASUREMENT
/begin MEASUREMENT FLP53_02 " Lernfilterwert, positiv" SWORD DTSEGN_S16 0 0 -144.000000 144.000000 ECU_ADDRESS 0xB26E0 BIT_MASK 0xFFFF /end MEASUREMENT
/begin MEASUREMENT FLP53_03 " Lernfilterwert, positiv" SWORD DTSEGN_S16 0 0 -144.000000 144.000000 ECU_ADDRESS 0xB2704 BIT_MASK 0xFFFF /end MEASUREMENT
/begin MEASUREMENT FLP53_04 " Lernfilterwert, positiv" SWORD DTSEGN_S16 0 0 -144.000000 144.000000 ECU_ADDRESS 0xB2728 BIT_MASK 0xFFFF /end MEASUREMENT
/begin MEASUREMENT FLP53_05 " Lernfilterwert, positiv" SWORD DTSEGN_S16 0 0 -144.000000 144.000000 ECU_ADDRESS 0xB274C BIT_MASK 0xFFFF /end MEASUREMENT
/begin MEASUREMENT FLP53_06 " Lernfilterwert, positiv" SWORD DTSEGN_S16 0 0 -144.000000 144.000000 ECU_ADDRESS 0xB2770 BIT_MASK 0xFFFF /end MEASUREMENT
/begin MEASUREMENT FLP53_07 " Lernfilterwert, positiv" SWORD DTSEGN_S16 0 0 -144.000000 144.000000 ECU_ADDRESS 0xB2794 BIT_MASK 0xFFFF /end MEASUREMENT
/begin MEASUREMENT FLP53_08 " Lernfilterwert, positiv" SWORD DTSEGN_S16 0 0 -144.000000 144.000000 ECU_ADDRESS 0xB27B8 BIT_MASK 0xFFFF /end MEASUREMENT
/begin MEASUREMENT FLP61_02 " Lernfilterwert, positiv" SWORD DTSEGN_S16 0 0 -144.000000 144.000000 ECU_ADDRESS 0xB26CA BIT_MASK 0xFFFF /end MEASUREMENT
/begin MEASUREMENT FLP61_03 " Lernfilterwert, positiv" SWORD DTSEGN_S16 0 0 -144.000000 144.000000 ECU_ADDRESS 0xB26EE BIT_MASK 0xFFFF /end MEASUREMENT
/begin MEASUREMENT FLP61_04 " Lernfilterwert, positiv" SWORD DTSEGN_S16 0 0 -144.000000 144.000000 ECU_ADDRESS 0xB2712 BIT_MASK 0xFFFF /end MEASUREMENT
/begin MEASUREMENT FLP61_05 " Lernfilterwert, positiv" SWORD DTSEGN_S16 0 0 -144.000000 144.000000 ECU_ADDRESS 0xB2736 BIT_MASK 0xFFFF /end MEASUREMENT
/begin MEASUREMENT FLP61_06 " Lernfilterwert, positiv" SWORD DTSEGN_S16 0 0 -144.000000 144.000000 ECU_ADDRESS 0xB275A BIT_MASK 0xFFFF /end MEASUREMENT
/begin MEASUREMENT FLP61_07 " Lernfilterwert, positiv" SWORD DTSEGN_S16 0 0 -144.000000 144.000000 ECU_ADDRESS 0xB277E BIT_MASK 0xFFFF /end MEASUREMENT
/begin MEASUREMENT FLP61_08 " Lernfilterwert, positiv" SWORD DTSEGN_S16 0 0 -144.000000 144.000000 ECU_ADDRESS 0xB27A2 BIT_MASK 0xFFFF /end MEASUREMENT
/begin MEASUREMENT FLP62_02 " Lernfilterwert, positiv" SWORD DTSEGN_S16 0 0 -144.000000 144.000000 ECU_ADDRESS 0xB26D6 BIT_MASK 0xFFFF /end MEASUREMENT
/begin MEASUREMENT FLP62_03 " Lernfilterwert, positiv" SWORD DTSEGN_S16 0 0 -144.000000 144.000000 ECU_ADDRESS 0xB26FA BIT_MASK 0xFFFF /end MEASUREMENT
/begin MEASUREMENT FLP62_04 " Lernfilterwert, positiv" SWORD DTSEGN_S16 0 0 -144.000000 144.000000 ECU_ADDRESS 0xB271E BIT_MASK 0xFFFF /end MEASUREMENT
/begin MEASUREMENT FLP62_05 " Lernfilterwert, positiv" SWORD DTSEGN_S16 0 0 -144.000000 144.000000 ECU_ADDRESS 0xB2742 BIT_MASK 0xFFFF /end MEASUREMENT
/begin MEASUREMENT FLP62_06 " Lernfilterwert, positiv" SWORD DTSEGN_S16 0 0 -144.000000 144.000000 ECU_ADDRESS 0xB2766 BIT_MASK 0xFFFF /end MEASUREMENT
/begin MEASUREMENT FLP62_07 " Lernfilterwert, positiv" SWORD DTSEGN_S16 0 0 -144.000000 144.000000 ECU_ADDRESS 0xB278A BIT_MASK 0xFFFF /end MEASUREMENT
/begin MEASUREMENT FLP62_08 " Lernfilterwert, positiv" SWORD DTSEGN_S16 0 0 -144.000000 144.000000 ECU_ADDRESS 0xB27AE BIT_MASK 0xFFFF /end MEASUREMENT
/begin MEASUREMENT FLP63_02 " Lernfilterwert, positiv" SWORD DTSEGN_S16 0 0 -144.000000 144.000000 ECU_ADDRESS 0xB26E2 BIT_MASK 0xFFFF /end MEASUREMENT
/begin MEASUREMENT FLP63_03 " Lernfilterwert, positiv" SWORD DTSEGN_S16 0 0 -144.000000 144.000000 ECU_ADDRESS 0xB2706 BIT_MASK 0xFFFF /end MEASUREMENT
/begin MEASUREMENT FLP63_04 " Lernfilterwert, positiv" SWORD DTSEGN_S16 0 0 -144.000000 144.000000 ECU_ADDRESS 0xB272A BIT_MASK 0xFFFF /end MEASUREMENT
/begin MEASUREMENT FLP63_05 " Lernfilterwert, positiv" SWORD DTSEGN_S16 0 0 -144.000000 144.000000 ECU_ADDRESS 0xB274E BIT_MASK 0xFFFF /end MEASUREMENT
/begin MEASUREMENT FLP63_06 " Lernfilterwert, positiv" SWORD DTSEGN_S16 0 0 -144.000000 144.000000 ECU_ADDRESS 0xB2772 BIT_MASK 0xFFFF /end MEASUREMENT
/begin MEASUREMENT FLP63_07 " Lernfilterwert, positiv" SWORD DTSEGN_S16 0 0 -144.000000 144.000000 ECU_ADDRESS 0xB2796 BIT_MASK 0xFFFF /end MEASUREMENT
/begin MEASUREMENT FLP63_08 " Lernfilterwert, positiv" SWORD DTSEGN_S16 0 0 -144.000000 144.000000 ECU_ADDRESS 0xB27BA BIT_MASK 0xFFFF /end MEASUREMENT
/begin MEASUREMENT FLUTS1 "fluts(zyl)" SWORD LUQ256_S16 0 0 -94.296300 94.293400 ECU_ADDRESS 0xB078A BIT_MASK 0xFFFF /end MEASUREMENT
/begin MEASUREMENT FLUTS2 "fluts(zyl)" SWORD LUQ256_S16 0 0 -94.296300 94.293400 ECU_ADDRESS 0xB078C BIT_MASK 0xFFFF /end MEASUREMENT
/begin MEASUREMENT FLUTS3 "fluts(zyl)" SWORD LUQ256_S16 0 0 -94.296300 94.293400 ECU_ADDRESS 0xB078E BIT_MASK 0xFFFF /end MEASUREMENT
/begin MEASUREMENT FLUTS4 "fluts(zyl)" SWORD LUQ256_S16 0 0 -94.296300 94.293400 ECU_ADDRESS 0xB0790 BIT_MASK 0xFFFF /end MEASUREMENT
/begin MEASUREMENT FLUTS5 "fluts(zyl)" SWORD LUQ256_S16 0 0 -94.296300 94.293400 ECU_ADDRESS 0xB0792 BIT_MASK 0xFFFF /end MEASUREMENT
/begin MEASUREMENT FLUTS6 "fluts(zyl)" SWORD LUQ256_S16 0 0 -94.296300 94.293400 ECU_ADDRESS 0xB0794 BIT_MASK 0xFFFF /end MEASUREMENT
/begin MEASUREMENT FLUTS7 "fluts(zyl)" SWORD LUQ256_S16 0 0 -94.296300 94.293400 ECU_ADDRESS 0xB0796 BIT_MASK 0xFFFF /end MEASUREMENT
/begin MEASUREMENT FLUTS8 "fluts(zyl)" SWORD LUQ256_S16 0 0 -94.296300 94.293400 ECU_ADDRESS 0xB0798 BIT_MASK 0xFFFF /end MEASUREMENT
/begin MEASUREMENT FLUTS_AP "Ausgabe von FLUTS aus Trommel" SBYTE LUQ_S8 0 0 -94.296300 93.559600 ECU_ADDRESS 0xF9A8 BIT_MASK 0xFF /end MEASUREMENT
/begin MEASUREMENT FNS "Nachstart-Anreicherungsfaktor" UWORD FKT256L 0 0 0.000000 256.000000 ECU_ADDRESS 0xB028C BIT_MASK 0xFFFF /end MEASUREMENT
/begin MEASUREMENT FOSTAT " Statusinfotmation fuel-on Adaption" UBYTE DEZ 0 0 0.000000 256.000000 ECU_ADDRESS 0xB075D BIT_MASK 0xFF /end MEASUREMENT
/begin MEASUREMENT FRA_B1 "LRA-Integrator.low Bank1 multipl. Korr.-Faktor =f(FRAU,FRAO)" UWORD FPC50L 0 0 0.500000 1.499980 ECU_ADDRESS 0xB201C BIT_MASK 0xFFFF /end MEASUREMENT
/begin MEASUREMENT FRA_B2 "LRA-Integrator.low Bank2 multipl. Korr.-Faktor" UWORD FPC50L 0 0 0.500000 1.499980 ECU_ADDRESS 0xB201E BIT_MASK 0xFFFF /end MEASUREMENT
/begin MEASUREMENT FR_B1 " Lambda-Korrekturfaktor Bank1" UWORD FPC50L 0 0 0.500000 1.499980 ECU_ADDRESS 0xF722 BIT_MASK 0xFFFF /end MEASUREMENT
/begin MEASUREMENT FR_B2 " Lambda-Korrekturfaktor Bank2" UWORD FPC50L 0 0 0.500000 1.499980 ECU_ADDRESS 0xF724 BIT_MASK 0xFFFF /end MEASUREMENT
/begin MEASUREMENT FS11_02 " Filterwert Segmentabweichung, Betriebsbereich 11, Zylinder 2" UWORD DTSEGNO_S1 0 0 -144.000000 144.000000 ECU_ADDRESS 0xB27BC BIT_MASK 0xFFFF /end MEASUREMENT
/begin MEASUREMENT FS11_03 " Filterwert Segmentabweichung, Betriebsbereich 11" UWORD DTSEGNO_S1 0 0 -144.000000 144.000000 ECU_ADDRESS 0xB27E0 BIT_MASK 0xFFFF /end MEASUREMENT
/begin MEASUREMENT FS11_04 " Filterwert Segmentabweichung, Betriebsbereich 11" UWORD DTSEGNO_S1 0 0 -144.000000 144.000000 ECU_ADDRESS 0xB2804 BIT_MASK 0xFFFF /end MEASUREMENT
/begin MEASUREMENT FS11_05 " Filterwert Segmentabweichung, Betriebsbereich 11" UWORD DTSEGNO_S1 0 0 -144.000000 144.000000 ECU_ADDRESS 0xB2828 BIT_MASK 0xFFFF /end MEASUREMENT
/begin MEASUREMENT FS11_06 " Filterwert Segmentabweichung, Betriebsbereich 11" UWORD DTSEGNO_S1 0 0 -144.000000 144.000000 ECU_ADDRESS 0xB284C BIT_MASK 0xFFFF /end MEASUREMENT
/begin MEASUREMENT FS11_07 " Filterwert Segmentabweichung, Betriebsbereich 11" UWORD DTSEGNO_S1 0 0 -144.000000 144.000000 ECU_ADDRESS 0xB2870 BIT_MASK 0xFFFF /end MEASUREMENT
/begin MEASUREMENT FS11_08 " Filterwert Segmentabweichung, Betriebsbereich 11" UWORD DTSEGNO_S1 0 0 -144.000000 144.000000 ECU_ADDRESS 0xB2894 BIT_MASK 0xFFFF /end MEASUREMENT
/begin MEASUREMENT FS12_02 " Filterwert Segmentabweichung, Betriebsbereich 12, Zylinder 2" UWORD DTSEGNO_S1 0 0 -144.000000 144.000000 ECU_ADDRESS 0xB27C8 BIT_MASK 0xFFFF /end MEASUREMENT
/begin MEASUREMENT FS12_03 " Filterwert Segmentabweichung, Betriebsbereich 12" UWORD DTSEGNO_S1 0 0 -144.000000 144.000000 ECU_ADDRESS 0xB27EC BIT_MASK 0xFFFF /end MEASUREMENT
/begin MEASUREMENT FS12_04 " Filterwert Segmentabweichung, Betriebsbereich 12" UWORD DTSEGNO_S1 0 0 -144.000000 144.000000 ECU_ADDRESS 0xB2810 BIT_MASK 0xFFFF /end MEASUREMENT
/begin MEASUREMENT FS12_05 " Filterwert Segmentabweichung, Betriebsbereich 12" UWORD DTSEGNO_S1 0 0 -144.000000 144.000000 ECU_ADDRESS 0xB2834 BIT_MASK 0xFFFF /end MEASUREMENT
/begin MEASUREMENT FS12_06 " Filterwert Segmentabweichung, Betriebsbereich 12" UWORD DTSEGNO_S1 0 0 -144.000000 144.000000 ECU_ADDRESS 0xB2858 BIT_MASK 0xFFFF /end MEASUREMENT
/begin MEASUREMENT FS12_07 " Filterwert Segmentabweichung, Betriebsbereich 12" UWORD DTSEGNO_S1 0 0 -144.000000 144.000000 ECU_ADDRESS 0xB287C BIT_MASK 0xFFFF /end MEASUREMENT
/begin MEASUREMENT FS12_08 " Filterwert Segmentabweichung, Betriebsbereich 12" UWORD DTSEGNO_S1 0 0 -144.000000 144.000000 ECU_ADDRESS 0xB28A0 BIT_MASK 0xFFFF /end MEASUREMENT
/begin MEASUREMENT FS13_02 " Filterwert Segmentabweichung, Betriebsbereich 13, Zylinder 2" UWORD DTSEGNO_S1 0 0 -144.000000 144.000000 ECU_ADDRESS 0xB27D4 BIT_MASK 0xFFFF /end MEASUREMENT
/begin MEASUREMENT FS13_03 " Filterwert Segmentabweichung, Betriebsbereich 13" UWORD DTSEGNO_S1 0 0 -144.000000 144.000000 ECU_ADDRESS 0xB27F8 BIT_MASK 0xFFFF /end MEASUREMENT
/begin MEASUREMENT FS13_04 " Filterwert Segmentabweichung, Betriebsbereich 13" UWORD DTSEGNO_S1 0 0 -144.000000 144.000000 ECU_ADDRESS 0xB281C BIT_MASK 0xFFFF /end MEASUREMENT
/begin MEASUREMENT FS13_05 " Filterwert Segmentabweichung, Betriebsbereich 13" UWORD DTSEGNO_S1 0 0 -144.000000 144.000000 ECU_ADDRESS 0xB2840 BIT_MASK 0xFFFF /end MEASUREMENT
/begin MEASUREMENT FS13_06 " Filterwert Segmentabweichung, Betriebsbereich 13" UWORD DTSEGNO_S1 0 0 -144.000000 144.000000 ECU_ADDRESS 0xB2864 BIT_MASK 0xFFFF /end MEASUREMENT
/begin MEASUREMENT FS13_07 " Filterwert Segmentabweichung, Betriebsbereich 13" UWORD DTSEGNO_S1 0 0 -144.000000 144.000000 ECU_ADDRESS 0xB2888 BIT_MASK 0xFFFF /end MEASUREMENT
/begin MEASUREMENT FS13_08 " Filterwert Segmentabweichung, Betriebsbereich 13" UWORD DTSEGNO_S1 0 0 -144.000000 144.000000 ECU_ADDRESS 0xB28AC BIT_MASK 0xFFFF /end MEASUREMENT
/begin MEASUREMENT FS21_02 " Filterwert Segmentabweichung, Betriebsbereich 21, Zylinder 2" UWORD DTSEGNO_S1 0 0 -144.000000 144.000000 ECU_ADDRESS 0xB27BE BIT_MASK 0xFFFF /end MEASUREMENT
/begin MEASUREMENT FS21_03 " Filterwert Segmentabweichung, Betriebsbereich 21" UWORD DTSEGNO_S1 0 0 -144.000000 144.000000 ECU_ADDRESS 0xB27E2 BIT_MASK 0xFFFF /end MEASUREMENT
/begin MEASUREMENT FS21_04 " Filterwert Segmentabweichung, Betriebsbereich 21" UWORD DTSEGNO_S1 0 0 -144.000000 144.000000 ECU_ADDRESS 0xB2806 BIT_MASK 0xFFFF /end MEASUREMENT
/begin MEASUREMENT FS21_05 " Filterwert Segmentabweichung, Betriebsbereich 21" UWORD DTSEGNO_S1 0 0 -144.000000 144.000000 ECU_ADDRESS 0xB282A BIT_MASK 0xFFFF /end MEASUREMENT
/begin MEASUREMENT FS21_06 " Filterwert Segmentabweichung, Betriebsbereich 21" UWORD DTSEGNO_S1 0 0 -144.000000 144.000000 ECU_ADDRESS 0xB284E BIT_MASK 0xFFFF /end MEASUREMENT
/begin MEASUREMENT FS21_07 " Filterwert Segmentabweichung, Betriebsbereich 21" UWORD DTSEGNO_S1 0 0 -144.000000 144.000000 ECU_ADDRESS 0xB2872 BIT_MASK 0xFFFF /end MEASUREMENT
/begin MEASUREMENT FS21_08 " Filterwert Segmentabweichung, Betriebsbereich 21" UWORD DTSEGNO_S1 0 0 -144.000000 144.000000 ECU_ADDRESS 0xB2896 BIT_MASK 0xFFFF /end MEASUREMENT
/begin MEASUREMENT FS22_02 " Filterwert Segmentabweichung, Betriebsbereich 22, Zylinder 2" UWORD DTSEGNO_S1 0 0 -144.000000 144.000000 ECU_ADDRESS 0xB27CA BIT_MASK 0xFFFF /end MEASUREMENT
/begin MEASUREMENT FS22_03 " Filterwert Segmentabweichung, Betriebsbereich 21" UWORD DTSEGNO_S1 0 0 -144.000000 144.000000 ECU_ADDRESS 0xB27EE BIT_MASK 0xFFFF /end MEASUREMENT
/begin MEASUREMENT FS22_04 " Filterwert Segmentabweichung, Betriebsbereich 21" UWORD DTSEGNO_S1 0 0 -144.000000 144.000000 ECU_ADDRESS 0xB2812 BIT_MASK 0xFFFF /end MEASUREMENT
/begin MEASUREMENT FS22_05 " Filterwert Segmentabweichung, Betriebsbereich 21" UWORD DTSEGNO_S1 0 0 -144.000000 144.000000 ECU_ADDRESS 0xB2836 BIT_MASK 0xFFFF /end MEASUREMENT
/begin MEASUREMENT FS22_06 " Filterwert Segmentabweichung, Betriebsbereich 21" UWORD DTSEGNO_S1 0 0 -144.000000 144.000000 ECU_ADDRESS 0xB285A BIT_MASK 0xFFFF /end MEASUREMENT
/begin MEASUREMENT FS22_07 " Filterwert Segmentabweichung, Betriebsbereich 21" UWORD DTSEGNO_S1 0 0 -144.000000 144.000000 ECU_ADDRESS 0xB287E BIT_MASK 0xFFFF /end MEASUREMENT
/begin MEASUREMENT FS22_08 " Filterwert Segmentabweichung, Betriebsbereich 21" UWORD DTSEGNO_S1 0 0 -144.000000 144.000000 ECU_ADDRESS 0xB28A2 BIT_MASK 0xFFFF /end MEASUREMENT
/begin MEASUREMENT FS23_02 " Filterwert Segmentabweichung, Betriebsbereich 23, Zylinder 2" UWORD DTSEGNO_S1 0 0 -144.000000 144.000000 ECU_ADDRESS 0xB27D6 BIT_MASK 0xFFFF /end MEASUREMENT
/begin MEASUREMENT FS23_03 " Filterwert Segmentabweichung, Betriebsbereich 23" UWORD DTSEGNO_S1 0 0 -144.000000 144.000000 ECU_ADDRESS 0xB27FA BIT_MASK 0xFFFF /end MEASUREMENT
/begin MEASUREMENT FS23_04 " Filterwert Segmentabweichung, Betriebsbereich 23" UWORD DTSEGNO_S1 0 0 -144.000000 144.000000 ECU_ADDRESS 0xB281E BIT_MASK 0xFFFF /end MEASUREMENT
/begin MEASUREMENT FS23_05 " Filterwert Segmentabweichung, Betriebsbereich 23" UWORD DTSEGNO_S1 0 0 -144.000000 144.000000 ECU_ADDRESS 0xB2842 BIT_MASK 0xFFFF /end MEASUREMENT
/begin MEASUREMENT FS23_06 " Filterwert Segmentabweichung, Betriebsbereich 23" UWORD DTSEGNO_S1 0 0 -144.000000 144.000000 ECU_ADDRESS 0xB2866 BIT_MASK 0xFFFF /end MEASUREMENT
/begin MEASUREMENT FS23_07 " Filterwert Segmentabweichung, Betriebsbereich 23" UWORD DTSEGNO_S1 0 0 -144.000000 144.000000 ECU_ADDRESS 0xB288A BIT_MASK 0xFFFF /end MEASUREMENT
/begin MEASUREMENT FS23_08 " Filterwert Segmentabweichung, Betriebsbereich 23" UWORD DTSEGNO_S1 0 0 -144.000000 144.000000 ECU_ADDRESS 0xB28AE BIT_MASK 0xFFFF /end MEASUREMENT
/begin MEASUREMENT FS31_02 " Filterwert Segmentabweichung, Betriebsbereich 31, Zylinder 2" UWORD DTSEGNO_S1 0 0 -144.000000 144.000000 ECU_ADDRESS 0xB27C0 BIT_MASK 0xFFFF /end MEASUREMENT
/begin MEASUREMENT FS31_03 " Filterwert Segmentabweichung, Betriebsbereich 31" UWORD DTSEGNO_S1 0 0 -144.000000 144.000000 ECU_ADDRESS 0xB27E4 BIT_MASK 0xFFFF /end MEASUREMENT
/begin MEASUREMENT FS31_04 " Filterwert Segmentabweichung, Betriebsbereich 31" UWORD DTSEGNO_S1 0 0 -144.000000 144.000000 ECU_ADDRESS 0xB2808 BIT_MASK 0xFFFF /end MEASUREMENT
/begin MEASUREMENT FS31_05 " Filterwert Segmentabweichung, Betriebsbereich 31" UWORD DTSEGNO_S1 0 0 -144.000000 144.000000 ECU_ADDRESS 0xB282C BIT_MASK 0xFFFF /end MEASUREMENT
/begin MEASUREMENT FS31_06 " Filterwert Segmentabweichung, Betriebsbereich 31" UWORD DTSEGNO_S1 0 0 -144.000000 144.000000 ECU_ADDRESS 0xB2850 BIT_MASK 0xFFFF /end MEASUREMENT
/begin MEASUREMENT FS31_07 " Filterwert Segmentabweichung, Betriebsbereich 31" UWORD DTSEGNO_S1 0 0 -144.000000 144.000000 ECU_ADDRESS 0xB2874 BIT_MASK 0xFFFF /end MEASUREMENT
/begin MEASUREMENT FS31_08 " Filterwert Segmentabweichung, Betriebsbereich 31" UWORD DTSEGNO_S1 0 0 -144.000000 144.000000 ECU_ADDRESS 0xB2898 BIT_MASK 0xFFFF /end MEASUREMENT
/begin MEASUREMENT FS32_02 " Filterwert Segmentabweichung, Betriebsbereich 32, Zylinder 2" UWORD DTSEGNO_S1 0 0 -144.000000 144.000000 ECU_ADDRESS 0xB27CC BIT_MASK 0xFFFF /end MEASUREMENT
/begin MEASUREMENT FS32_03 " Filterwert Segmentabweichung, Betriebsbereich 32" UWORD DTSEGNO_S1 0 0 -144.000000 144.000000 ECU_ADDRESS 0xB27F0 BIT_MASK 0xFFFF /end MEASUREMENT
/begin MEASUREMENT FS32_04 " Filterwert Segmentabweichung, Betriebsbereich 32" UWORD DTSEGNO_S1 0 0 -144.000000 144.000000 ECU_ADDRESS 0xB2814 BIT_MASK 0xFFFF /end MEASUREMENT
/begin MEASUREMENT FS32_05 " Filterwert Segmentabweichung, Betriebsbereich 32" UWORD DTSEGNO_S1 0 0 -144.000000 144.000000 ECU_ADDRESS 0xB2838 BIT_MASK 0xFFFF /end MEASUREMENT
/begin MEASUREMENT FS32_06 " Filterwert Segmentabweichung, Betriebsbereich 32" UWORD DTSEGNO_S1 0 0 -144.000000 144.000000 ECU_ADDRESS 0xB285C BIT_MASK 0xFFFF /end MEASUREMENT
/begin MEASUREMENT FS32_07 " Filterwert Segmentabweichung, Betriebsbereich 32" UWORD DTSEGNO_S1 0 0 -144.000000 144.000000 ECU_ADDRESS 0xB2880 BIT_MASK 0xFFFF /end MEASUREMENT
/begin MEASUREMENT FS32_08 " Filterwert Segmentabweichung, Betriebsbereich 32" UWORD DTSEGNO_S1 0 0 -144.000000 144.000000 ECU_ADDRESS 0xB28A4 BIT_MASK 0xFFFF /end MEASUREMENT
/begin MEASUREMENT FS33_02 " Filterwert Segmentabweichung, Betriebsbereich 33, Zylinder 2" UWORD DTSEGNO_S1 0 0 -144.000000 144.000000 ECU_ADDRESS 0xB27D8 BIT_MASK 0xFFFF /end MEASUREMENT
/begin MEASUREMENT FS33_03 " Filterwert Segmentabweichung, Betriebsbereich 33" UWORD DTSEGNO_S1 0 0 -144.000000 144.000000 ECU_ADDRESS 0xB27FC BIT_MASK 0xFFFF /end MEASUREMENT
/begin MEASUREMENT FS33_04 " Filterwert Segmentabweichung, Betriebsbereich 33" UWORD DTSEGNO_S1 0 0 -144.000000 144.000000 ECU_ADDRESS 0xB2820 BIT_MASK 0xFFFF /end MEASUREMENT
/begin MEASUREMENT FS33_05 " Filterwert Segmentabweichung, Betriebsbereich 33" UWORD DTSEGNO_S1 0 0 -144.000000 144.000000 ECU_ADDRESS 0xB2844 BIT_MASK 0xFFFF /end MEASUREMENT
/begin MEASUREMENT FS33_06 " Filterwert Segmentabweichung, Betriebsbereich 33" UWORD DTSEGNO_S1 0 0 -144.000000 144.000000 ECU_ADDRESS 0xB2868 BIT_MASK 0xFFFF /end MEASUREMENT
/begin MEASUREMENT FS33_07 " Filterwert Segmentabweichung, Betriebsbereich 33" UWORD DTSEGNO_S1 0 0 -144.000000 144.000000 ECU_ADDRESS 0xB288C BIT_MASK 0xFFFF /end MEASUREMENT
/begin MEASUREMENT FS33_08 " Filterwert Segmentabweichung, Betriebsbereich 33" UWORD DTSEGNO_S1 0 0 -144.000000 144.000000 ECU_ADDRESS 0xB28B0 BIT_MASK 0xFFFF /end MEASUREMENT
/begin MEASUREMENT FS41_02 " Filterwert Segmentabweichung, Betriebsbereich 41, Zylinder 2" UWORD DTSEGNO_S1 0 0 -144.000000 144.000000 ECU_ADDRESS 0xB27C2 BIT_MASK 0xFFFF /end MEASUREMENT
/begin MEASUREMENT FS41_03 " Filterwert Segmentabweichung, Betriebsbereich 41" UWORD DTSEGNO_S1 0 0 -144.000000 144.000000 ECU_ADDRESS 0xB27E6 BIT_MASK 0xFFFF /end MEASUREMENT
/begin MEASUREMENT FS41_04 " Filterwert Segmentabweichung, Betriebsbereich 41" UWORD DTSEGNO_S1 0 0 -144.000000 144.000000 ECU_ADDRESS 0xB280A BIT_MASK 0xFFFF /end MEASUREMENT
/begin MEASUREMENT FS41_05 " Filterwert Segmentabweichung, Betriebsbereich 41" UWORD DTSEGNO_S1 0 0 -144.000000 144.000000 ECU_ADDRESS 0xB282E BIT_MASK 0xFFFF /end MEASUREMENT
/begin MEASUREMENT FS41_06 " Filterwert Segmentabweichung, Betriebsbereich 41" UWORD DTSEGNO_S1 0 0 -144.000000 144.000000 ECU_ADDRESS 0xB2852 BIT_MASK 0xFFFF /end MEASUREMENT
/begin MEASUREMENT FS41_07 " Filterwert Segmentabweichung, Betriebsbereich 41" UWORD DTSEGNO_S1 0 0 -144.000000 144.000000 ECU_ADDRESS 0xB2876 BIT_MASK 0xFFFF /end MEASUREMENT
/begin MEASUREMENT FS41_08 " Filterwert Segmentabweichung, Betriebsbereich 41" UWORD DTSEGNO_S1 0 0 -144.000000 144.000000 ECU_ADDRESS 0xB289A BIT_MASK 0xFFFF /end MEASUREMENT
/begin MEASUREMENT FS42_02 " Filterwert Segmentabweichung, Betriebsbereich 42, Zylinder 2" UWORD DTSEGNO_S1 0 0 -144.000000 144.000000 ECU_ADDRESS 0xB27CE BIT_MASK 0xFFFF /end MEASUREMENT
/begin MEASUREMENT FS42_03 " Filterwert Segmentabweichung, Betriebsbereich 42" UWORD DTSEGNO_S1 0 0 -144.000000 144.000000 ECU_ADDRESS 0xB27F2 BIT_MASK 0xFFFF /end MEASUREMENT
/begin MEASUREMENT FS42_04 " Filterwert Segmentabweichung, Betriebsbereich 42" UWORD DTSEGNO_S1 0 0 -144.000000 144.000000 ECU_ADDRESS 0xB2816 BIT_MASK 0xFFFF /end MEASUREMENT
/begin MEASUREMENT FS42_05 " Filterwert Segmentabweichung, Betriebsbereich 42" UWORD DTSEGNO_S1 0 0 -144.000000 144.000000 ECU_ADDRESS 0xB283A BIT_MASK 0xFFFF /end MEASUREMENT
/begin MEASUREMENT FS42_06 " Filterwert Segmentabweichung, Betriebsbereich 42" UWORD DTSEGNO_S1 0 0 -144.000000 144.000000 ECU_ADDRESS 0xB285E BIT_MASK 0xFFFF /end MEASUREMENT
/begin MEASUREMENT FS42_07 " Filterwert Segmentabweichung, Betriebsbereich 42" UWORD DTSEGNO_S1 0 0 -144.000000 144.000000 ECU_ADDRESS 0xB2882 BIT_MASK 0xFFFF /end MEASUREMENT
/begin MEASUREMENT FS42_08 " Filterwert Segmentabweichung, Betriebsbereich 42" UWORD DTSEGNO_S1 0 0 -144.000000 144.000000 ECU_ADDRESS 0xB28A6 BIT_MASK 0xFFFF /end MEASUREMENT
/begin MEASUREMENT FS43_02 " Filterwert Segmentabweichung, Betriebsbereich 43, Zylinder 2" UWORD DTSEGNO_S1 0 0 -144.000000 144.000000 ECU_ADDRESS 0xB27DA BIT_MASK 0xFFFF /end MEASUREMENT
/begin MEASUREMENT FS43_03 " Filterwert Segmentabweichung, Betriebsbereich 43" UWORD DTSEGNO_S1 0 0 -144.000000 144.000000 ECU_ADDRESS 0xB27FE BIT_MASK 0xFFFF /end MEASUREMENT
/begin MEASUREMENT FS43_04 " Filterwert Segmentabweichung, Betriebsbereich 43" UWORD DTSEGNO_S1 0 0 -144.000000 144.000000 ECU_ADDRESS 0xB2822 BIT_MASK 0xFFFF /end MEASUREMENT
/begin MEASUREMENT FS43_05 " Filterwert Segmentabweichung, Betriebsbereich 43" UWORD DTSEGNO_S1 0 0 -144.000000 144.000000 ECU_ADDRESS 0xB2846 BIT_MASK 0xFFFF /end MEASUREMENT
/begin MEASUREMENT FS43_06 " Filterwert Segmentabweichung, Betriebsbereich 43" UWORD DTSEGNO_S1 0 0 -144.000000 144.000000 ECU_ADDRESS 0xB286A BIT_MASK 0xFFFF /end MEASUREMENT
/begin MEASUREMENT FS43_07 " Filterwert Segmentabweichung, Betriebsbereich 43" UWORD DTSEGNO_S1 0 0 -144.000000 144.000000 ECU_ADDRESS 0xB288E BIT_MASK 0xFFFF /end MEASUREMENT
/begin MEASUREMENT FS43_08 " Filterwert Segmentabweichung, Betriebsbereich 43" UWORD DTSEGNO_S1 0 0 -144.000000 144.000000 ECU_ADDRESS 0xB28B2 BIT_MASK 0xFFFF /end MEASUREMENT
/begin MEASUREMENT FS51_02 " Filterwert Segmentabweichung, Betriebsbereich 51, Zylinder 2" UWORD DTSEGNO_S1 0 0 -144.000000 144.000000 ECU_ADDRESS 0xB27C4 BIT_MASK 0xFFFF /end MEASUREMENT
/begin MEASUREMENT FS51_03 " Filterwert Segmentabweichung, Betriebsbereich 51" UWORD DTSEGNO_S1 0 0 -144.000000 144.000000 ECU_ADDRESS 0xB27E8 BIT_MASK 0xFFFF /end MEASUREMENT
/begin MEASUREMENT FS51_04 " Filterwert Segmentabweichung, Betriebsbereich 51" UWORD DTSEGNO_S1 0 0 -144.000000 144.000000 ECU_ADDRESS 0xB280C BIT_MASK 0xFFFF /end MEASUREMENT
/begin MEASUREMENT FS51_05 " Filterwert Segmentabweichung, Betriebsbereich 51" UWORD DTSEGNO_S1 0 0 -144.000000 144.000000 ECU_ADDRESS 0xB2830 BIT_MASK 0xFFFF /end MEASUREMENT
/begin MEASUREMENT FS51_06 " Filterwert Segmentabweichung, Betriebsbereich 51" UWORD DTSEGNO_S1 0 0 -144.000000 144.000000 ECU_ADDRESS 0xB2854 BIT_MASK 0xFFFF /end MEASUREMENT
/begin MEASUREMENT FS51_07 " Filterwert Segmentabweichung, Betriebsbereich 51" UWORD DTSEGNO_S1 0 0 -144.000000 144.000000 ECU_ADDRESS 0xB2878 BIT_MASK 0xFFFF /end MEASUREMENT
/begin MEASUREMENT FS51_08 " Filterwert Segmentabweichung, Betriebsbereich 51" UWORD DTSEGNO_S1 0 0 -144.000000 144.000000 ECU_ADDRESS 0xB289C BIT_MASK 0xFFFF /end MEASUREMENT
/begin MEASUREMENT FS52_02 " Filterwert Segmentabweichung, Betriebsbereich 52, Zylinder 2" UWORD DTSEGNO_S1 0 0 -144.000000 144.000000 ECU_ADDRESS 0xB27D0 BIT_MASK 0xFFFF /end MEASUREMENT
/begin MEASUREMENT FS52_03 " Filterwert Segmentabweichung, Betriebsbereich 52" UWORD DTSEGNO_S1 0 0 -144.000000 144.000000 ECU_ADDRESS 0xB27F4 BIT_MASK 0xFFFF /end MEASUREMENT
/begin MEASUREMENT FS52_04 " Filterwert Segmentabweichung, Betriebsbereich 52" UWORD DTSEGNO_S1 0 0 -144.000000 144.000000 ECU_ADDRESS 0xB2818 BIT_MASK 0xFFFF /end MEASUREMENT
/begin MEASUREMENT FS52_05 " Filterwert Segmentabweichung, Betriebsbereich 52" UWORD DTSEGNO_S1 0 0 -144.000000 144.000000 ECU_ADDRESS 0xB283C BIT_MASK 0xFFFF /end MEASUREMENT
/begin MEASUREMENT FS52_06 " Filterwert Segmentabweichung, Betriebsbereich 52" UWORD DTSEGNO_S1 0 0 -144.000000 144.000000 ECU_ADDRESS 0xB2860 BIT_MASK 0xFFFF /end MEASUREMENT
/begin MEASUREMENT FS52_07 " Filterwert Segmentabweichung, Betriebsbereich 52" UWORD DTSEGNO_S1 0 0 -144.000000 144.000000 ECU_ADDRESS 0xB2884 BIT_MASK 0xFFFF /end MEASUREMENT
/begin MEASUREMENT FS52_08 " Filterwert Segmentabweichung, Betriebsbereich 52" UWORD DTSEGNO_S1 0 0 -144.000000 144.000000 ECU_ADDRESS 0xB28A8 BIT_MASK 0xFFFF /end MEASUREMENT
/begin MEASUREMENT FS53_02 " Filterwert Segmentabweichung, Betriebsbereich 53, Zylinder 2" UWORD DTSEGNO_S1 0 0 -144.000000 144.000000 ECU_ADDRESS 0xB27DC BIT_MASK 0xFFFF /end MEASUREMENT
/begin MEASUREMENT FS53_03 " Filterwert Segmentabweichung, Betriebsbereich 53" UWORD DTSEGNO_S1 0 0 -144.000000 144.000000 ECU_ADDRESS 0xB2800 BIT_MASK 0xFFFF /end MEASUREMENT
/begin MEASUREMENT FS53_04 " Filterwert Segmentabweichung, Betriebsbereich 53" UWORD DTSEGNO_S1 0 0 -144.000000 144.000000 ECU_ADDRESS 0xB2824 BIT_MASK 0xFFFF /end MEASUREMENT
/begin MEASUREMENT FS53_05 " Filterwert Segmentabweichung, Betriebsbereich 53" UWORD DTSEGNO_S1 0 0 -144.000000 144.000000 ECU_ADDRESS 0xB2848 BIT_MASK 0xFFFF /end MEASUREMENT
/begin MEASUREMENT FS53_06 " Filterwert Segmentabweichung, Betriebsbereich 53" UWORD DTSEGNO_S1 0 0 -144.000000 144.000000 ECU_ADDRESS 0xB286C BIT_MASK 0xFFFF /end MEASUREMENT
/begin MEASUREMENT FS53_07 " Filterwert Segmentabweichung, Betriebsbereich 53" UWORD DTSEGNO_S1 0 0 -144.000000 144.000000 ECU_ADDRESS 0xB2890 BIT_MASK 0xFFFF /end MEASUREMENT
/begin MEASUREMENT FS53_08 " Filterwert Segmentabweichung, Betriebsbereich 53" UWORD DTSEGNO_S1 0 0 -144.000000 144.000000 ECU_ADDRESS 0xB28B4 BIT_MASK 0xFFFF /end MEASUREMENT
/begin MEASUREMENT FS61_02 " Filterwert Segmentabweichung, Betriebsbereich 61, Zylinder 2" UWORD DTSEGNO_S1 0 0 -144.000000 144.000000 ECU_ADDRESS 0xB27C6 BIT_MASK 0xFFFF /end MEASUREMENT
/begin MEASUREMENT FS61_03 " Filterwert Segmentabweichung, Betriebsbereich 61" UWORD DTSEGNO_S1 0 0 -144.000000 144.000000 ECU_ADDRESS 0xB27EA BIT_MASK 0xFFFF /end MEASUREMENT
/begin MEASUREMENT FS61_04 " Filterwert Segmentabweichung, Betriebsbereich 61" UWORD DTSEGNO_S1 0 0 -144.000000 144.000000 ECU_ADDRESS 0xB280E BIT_MASK 0xFFFF /end MEASUREMENT
/begin MEASUREMENT FS61_05 " Filterwert Segmentabweichung, Betriebsbereich 61" UWORD DTSEGNO_S1 0 0 -144.000000 144.000000 ECU_ADDRESS 0xB2832 BIT_MASK 0xFFFF /end MEASUREMENT
/begin MEASUREMENT FS61_06 " Filterwert Segmentabweichung, Betriebsbereich 61" UWORD DTSEGNO_S1 0 0 -144.000000 144.000000 ECU_ADDRESS 0xB2856 BIT_MASK 0xFFFF /end MEASUREMENT
/begin MEASUREMENT FS61_07 " Filterwert Segmentabweichung, Betriebsbereich 61" UWORD DTSEGNO_S1 0 0 -144.000000 144.000000 ECU_ADDRESS 0xB287A BIT_MASK 0xFFFF /end MEASUREMENT
/begin MEASUREMENT FS61_08 " Filterwert Segmentabweichung, Betriebsbereich 61" UWORD DTSEGNO_S1 0 0 -144.000000 144.000000 ECU_ADDRESS 0xB289E BIT_MASK 0xFFFF /end MEASUREMENT
/begin MEASUREMENT FS62_02 " Filterwert Segmentabweichung, Betriebsbereich 62, Zylinder 2" UWORD DTSEGNO_S1 0 0 -144.000000 144.000000 ECU_ADDRESS 0xB27D2 BIT_MASK 0xFFFF /end MEASUREMENT
/begin MEASUREMENT FS62_03 " Filterwert Segmentabweichung, Betriebsbereich 62" UWORD DTSEGNO_S1 0 0 -144.000000 144.000000 ECU_ADDRESS 0xB27F6 BIT_MASK 0xFFFF /end MEASUREMENT
/begin MEASUREMENT FS62_04 " Filterwert Segmentabweichung, Betriebsbereich 62" UWORD DTSEGNO_S1 0 0 -144.000000 144.000000 ECU_ADDRESS 0xB281A BIT_MASK 0xFFFF /end MEASUREMENT
/begin MEASUREMENT FS62_05 " Filterwert Segmentabweichung, Betriebsbereich 62" UWORD DTSEGNO_S1 0 0 -144.000000 144.000000 ECU_ADDRESS 0xB283E BIT_MASK 0xFFFF /end MEASUREMENT
/begin MEASUREMENT FS62_06 " Filterwert Segmentabweichung, Betriebsbereich 62" UWORD DTSEGNO_S1 0 0 -144.000000 144.000000 ECU_ADDRESS 0xB2862 BIT_MASK 0xFFFF /end MEASUREMENT
/begin MEASUREMENT FS62_07 " Filterwert Segmentabweichung, Betriebsbereich 62" UWORD DTSEGNO_S1 0 0 -144.000000 144.000000 ECU_ADDRESS 0xB2886 BIT_MASK 0xFFFF /end MEASUREMENT
/begin MEASUREMENT FS62_08 " Filterwert Segmentabweichung, Betriebsbereich 62" UWORD DTSEGNO_S1 0 0 -144.000000 144.000000 ECU_ADDRESS 0xB28AA BIT_MASK 0xFFFF /end MEASUREMENT
/begin MEASUREMENT FS63_02 " Filterwert Segmentabweichung, Betriebsbereich 63, Zylinder 2" UWORD DTSEGNO_S1 0 0 -144.000000 144.000000 ECU_ADDRESS 0xB27DE BIT_MASK 0xFFFF /end MEASUREMENT
/begin MEASUREMENT FS63_03 " Filterwert Segmentabweichung, Betriebsbereich 63" UWORD DTSEGNO_S1 0 0 -144.000000 144.000000 ECU_ADDRESS 0xB2802 BIT_MASK 0xFFFF /end MEASUREMENT
/begin MEASUREMENT FS63_04 " Filterwert Segmentabweichung, Betriebsbereich 63" UWORD DTSEGNO_S1 0 0 -144.000000 144.000000 ECU_ADDRESS 0xB2826 BIT_MASK 0xFFFF /end MEASUREMENT
/begin MEASUREMENT FS63_05 " Filterwert Segmentabweichung, Betriebsbereich 63" UWORD DTSEGNO_S1 0 0 -144.000000 144.000000 ECU_ADDRESS 0xB284A BIT_MASK 0xFFFF /end MEASUREMENT
/begin MEASUREMENT FS63_06 " Filterwert Segmentabweichung, Betriebsbereich 63" UWORD DTSEGNO_S1 0 0 -144.000000 144.000000 ECU_ADDRESS 0xB286E BIT_MASK 0xFFFF /end MEASUREMENT
/begin MEASUREMENT FS63_07 " Filterwert Segmentabweichung, Betriebsbereich 63" UWORD DTSEGNO_S1 0 0 -144.000000 144.000000 ECU_ADDRESS 0xB2892 BIT_MASK 0xFFFF /end MEASUREMENT
/begin MEASUREMENT FS63_08 " Filterwert Segmentabweichung, Betriebsbereich 63" UWORD DTSEGNO_S1 0 0 -144.000000 144.000000 ECU_ADDRESS 0xB28B6 BIT_MASK 0xFFFF /end MEASUREMENT
/begin MEASUREMENT FSE "" SBYTE DTSEGN_S8 0 0 -2.250000 2.232420 ECU_ADDRESS 0xB07CD BIT_MASK 0xFF /end MEASUREMENT
/begin MEASUREMENT FSE11_02 " Filterwert Segmentabweichung, eingerechnet, Betriebsbereich 11, Zylinder 2" UBYTE DTSEGNO 0 0 -2.250000 2.232420 ECU_ADDRESS 0xB28B8 BIT_MASK 0xFF /end MEASUREMENT
/begin MEASUREMENT FSE11_03 " Filterwert Segmentabweichung, eingerechnet" UBYTE DTSEGNO 0 0 -2.250000 2.232420 ECU_ADDRESS 0xB28CA BIT_MASK 0xFF /end MEASUREMENT
/begin MEASUREMENT FSE11_04 " Filterwert Segmentabweichung, eingerechnet" UBYTE DTSEGNO 0 0 -2.250000 2.232420 ECU_ADDRESS 0xB28DC BIT_MASK 0xFF /end MEASUREMENT
/begin MEASUREMENT FSE11_05 " Filterwert Segmentabweichung, eingerechnet" UBYTE DTSEGNO 0 0 -2.250000 2.232420 ECU_ADDRESS 0xB28EE BIT_MASK 0xFF /end MEASUREMENT
/begin MEASUREMENT FSE11_06 " Filterwert Segmentabweichung, eingerechnet" UBYTE DTSEGNO 0 0 -2.250000 2.232420 ECU_ADDRESS 0xB2900 BIT_MASK 0xFF /end MEASUREMENT
/begin MEASUREMENT FSE11_07 " Filterwert Segmentabweichung, eingerechnet" UBYTE DTSEGNO 0 0 -2.250000 2.232420 ECU_ADDRESS 0xB2912 BIT_MASK 0xFF /end MEASUREMENT
/begin MEASUREMENT FSE11_08 " Filterwert Segmentabweichung, eingerechnet" UBYTE DTSEGNO 0 0 -2.250000 2.232420 ECU_ADDRESS 0xB2924 BIT_MASK 0xFF /end MEASUREMENT
/begin MEASUREMENT FSE12_02 " Filterwert Segmentabweichung, eingerechnet" UBYTE DTSEGNO 0 0 -2.250000 2.232420 ECU_ADDRESS 0xB28BE BIT_MASK 0xFF /end MEASUREMENT
/begin MEASUREMENT FSE12_03 " Filterwert Segmentabweichung, eingerechnet" UBYTE DTSEGNO 0 0 -2.250000 2.232420 ECU_ADDRESS 0xB28D0 BIT_MASK 0xFF /end MEASUREMENT
/begin MEASUREMENT FSE12_04 " Filterwert Segmentabweichung, eingerechnet" UBYTE DTSEGNO 0 0 -2.250000 2.232420 ECU_ADDRESS 0xB28E2 BIT_MASK 0xFF /end MEASUREMENT
/begin MEASUREMENT FSE12_05 " Filterwert Segmentabweichung, eingerechnet" UBYTE DTSEGNO 0 0 -2.250000 2.232420 ECU_ADDRESS 0xB28F4 BIT_MASK 0xFF /end MEASUREMENT
/begin MEASUREMENT FSE12_06 " Filterwert Segmentabweichung, eingerechnet" UBYTE DTSEGNO 0 0 -2.250000 2.232420 ECU_ADDRESS 0xB2906 BIT_MASK 0xFF /end MEASUREMENT
/begin MEASUREMENT FSE12_07 " Filterwert Segmentabweichung, eingerechnet" UBYTE DTSEGNO 0 0 -2.250000 2.232420 ECU_ADDRESS 0xB2918 BIT_MASK 0xFF /end MEASUREMENT
/begin MEASUREMENT FSE12_08 " Filterwert Segmentabweichung, eingerechnet" UBYTE DTSEGNO 0 0 -2.250000 2.232420 ECU_ADDRESS 0xB292A BIT_MASK 0xFF /end MEASUREMENT
/begin MEASUREMENT FSE13_02 " Filterwert Segmentabweichung, eingerechnet" UBYTE DTSEGNO 0 0 -2.250000 2.232420 ECU_ADDRESS 0xB28C4 BIT_MASK 0xFF /end MEASUREMENT
/begin MEASUREMENT FSE13_03 " Filterwert Segmentabweichung, eingerechnet" UBYTE DTSEGNO 0 0 -2.250000 2.232420 ECU_ADDRESS 0xB28D6 BIT_MASK 0xFF /end MEASUREMENT
/begin MEASUREMENT FSE13_04 " Filterwert Segmentabweichung, eingerechnet" UBYTE DTSEGNO 0 0 -2.250000 2.232420 ECU_ADDRESS 0xB28E8 BIT_MASK 0xFF /end MEASUREMENT
/begin MEASUREMENT FSE13_05 " Filterwert Segmentabweichung, eingerechnet" UBYTE DTSEGNO 0 0 -2.250000 2.232420 ECU_ADDRESS 0xB28FA BIT_MASK 0xFF /end MEASUREMENT
/begin MEASUREMENT FSE13_06 " Filterwert Segmentabweichung, eingerechnet" UBYTE DTSEGNO 0 0 -2.250000 2.232420 ECU_ADDRESS 0xB290C BIT_MASK 0xFF /end MEASUREMENT
/begin MEASUREMENT FSE13_07 " Filterwert Segmentabweichung, eingerechnet" UBYTE DTSEGNO 0 0 -2.250000 2.232420 ECU_ADDRESS 0xB291E BIT_MASK 0xFF /end MEASUREMENT
/begin MEASUREMENT FSE13_08 " Filterwert Segmentabweichung, eingerechnet" UBYTE DTSEGNO 0 0 -2.250000 2.232420 ECU_ADDRESS 0xB2930 BIT_MASK 0xFF /end MEASUREMENT
/begin MEASUREMENT FSE21_02 " Filterwert Segmentabweichung, eingerechnet" UBYTE DTSEGNO 0 0 -2.250000 2.232420 ECU_ADDRESS 0xB28B9 BIT_MASK 0xFF /end MEASUREMENT
/begin MEASUREMENT FSE21_03 " Filterwert Segmentabweichung, eingerechnet" UBYTE DTSEGNO 0 0 -2.250000 2.232420 ECU_ADDRESS 0xB28CB BIT_MASK 0xFF /end MEASUREMENT
/begin MEASUREMENT FSE21_04 " Filterwert Segmentabweichung, eingerechnet" UBYTE DTSEGNO 0 0 -2.250000 2.232420 ECU_ADDRESS 0xB28DD BIT_MASK 0xFF /end MEASUREMENT
/begin MEASUREMENT FSE21_05 " Filterwert Segmentabweichung, eingerechnet" UBYTE DTSEGNO 0 0 -2.250000 2.232420 ECU_ADDRESS 0xB28EF BIT_MASK 0xFF /end MEASUREMENT
/begin MEASUREMENT FSE21_06 " Filterwert Segmentabweichung, eingerechnet" UBYTE DTSEGNO 0 0 -2.250000 2.232420 ECU_ADDRESS 0xB2901 BIT_MASK 0xFF /end MEASUREMENT
/begin MEASUREMENT FSE21_07 " Filterwert Segmentabweichung, eingerechnet" UBYTE DTSEGNO 0 0 -2.250000 2.232420 ECU_ADDRESS 0xB2913 BIT_MASK 0xFF /end MEASUREMENT
/begin MEASUREMENT FSE21_08 " Filterwert Segmentabweichung, eingerechnet" UBYTE DTSEGNO 0 0 -2.250000 2.232420 ECU_ADDRESS 0xB2925 BIT_MASK 0xFF /end MEASUREMENT
/begin MEASUREMENT FSE22_02 " Filterwert Segmentabweichung, eingerechnet" UBYTE DTSEGNO 0 0 -2.250000 2.232420 ECU_ADDRESS 0xB28BF BIT_MASK 0xFF /end MEASUREMENT
/begin MEASUREMENT FSE22_03 " Filterwert Segmentabweichung, eingerechnet" UBYTE DTSEGNO 0 0 -2.250000 2.232420 ECU_ADDRESS 0xB28D1 BIT_MASK 0xFF /end MEASUREMENT
/begin MEASUREMENT FSE22_04 " Filterwert Segmentabweichung, eingerechnet" UBYTE DTSEGNO 0 0 -2.250000 2.232420 ECU_ADDRESS 0xB28E3 BIT_MASK 0xFF /end MEASUREMENT
/begin MEASUREMENT FSE22_05 " Filterwert Segmentabweichung, eingerechnet" UBYTE DTSEGNO 0 0 -2.250000 2.232420 ECU_ADDRESS 0xB28F5 BIT_MASK 0xFF /end MEASUREMENT
/begin MEASUREMENT FSE22_06 " Filterwert Segmentabweichung, eingerechnet" UBYTE DTSEGNO 0 0 -2.250000 2.232420 ECU_ADDRESS 0xB2907 BIT_MASK 0xFF /end MEASUREMENT
/begin MEASUREMENT FSE22_07 " Filterwert Segmentabweichung, eingerechnet" UBYTE DTSEGNO 0 0 -2.250000 2.232420 ECU_ADDRESS 0xB2919 BIT_MASK 0xFF /end MEASUREMENT
/begin MEASUREMENT FSE22_08 " Filterwert Segmentabweichung, eingerechnet" UBYTE DTSEGNO 0 0 -2.250000 2.232420 ECU_ADDRESS 0xB292B BIT_MASK 0xFF /end MEASUREMENT
/begin MEASUREMENT FSE23_02 " Filterwert Segmentabweichung, eingerechnet" UBYTE DTSEGNO 0 0 -2.250000 2.232420 ECU_ADDRESS 0xB28C5 BIT_MASK 0xFF /end MEASUREMENT
/begin MEASUREMENT FSE23_03 " Filterwert Segmentabweichung, eingerechnet" UBYTE DTSEGNO 0 0 -2.250000 2.232420 ECU_ADDRESS 0xB28D7 BIT_MASK 0xFF /end MEASUREMENT
/begin MEASUREMENT FSE23_04 " Filterwert Segmentabweichung, eingerechnet" UBYTE DTSEGNO 0 0 -2.250000 2.232420 ECU_ADDRESS 0xB28E9 BIT_MASK 0xFF /end MEASUREMENT
/begin MEASUREMENT FSE23_05 " Filterwert Segmentabweichung, eingerechnet" UBYTE DTSEGNO 0 0 -2.250000 2.232420 ECU_ADDRESS 0xB28FB BIT_MASK 0xFF /end MEASUREMENT
/begin MEASUREMENT FSE23_06 " Filterwert Segmentabweichung, eingerechnet" UBYTE DTSEGNO 0 0 -2.250000 2.232420 ECU_ADDRESS 0xB290D BIT_MASK 0xFF /end MEASUREMENT
/begin MEASUREMENT FSE23_07 " Filterwert Segmentabweichung, eingerechnet" UBYTE DTSEGNO 0 0 -2.250000 2.232420 ECU_ADDRESS 0xB291F BIT_MASK 0xFF /end MEASUREMENT
/begin MEASUREMENT FSE23_08 " Filterwert Segmentabweichung, eingerechnet" UBYTE DTSEGNO 0 0 -2.250000 2.232420 ECU_ADDRESS 0xB2931 BIT_MASK 0xFF /end MEASUREMENT
/begin MEASUREMENT FSE31_02 " Filterwert Segmentabweichung, eingerechnet" UBYTE DTSEGNO 0 0 -2.250000 2.232420 ECU_ADDRESS 0xB28BA BIT_MASK 0xFF /end MEASUREMENT
/begin MEASUREMENT FSE31_03 " Filterwert Segmentabweichung, eingerechnet" UBYTE DTSEGNO 0 0 -2.250000 2.232420 ECU_ADDRESS 0xB28CC BIT_MASK 0xFF /end MEASUREMENT
/begin MEASUREMENT FSE31_04 " Filterwert Segmentabweichung, eingerechnet" UBYTE DTSEGNO 0 0 -2.250000 2.232420 ECU_ADDRESS 0xB28DE BIT_MASK 0xFF /end MEASUREMENT
/begin MEASUREMENT FSE31_05 " Filterwert Segmentabweichung, eingerechnet" UBYTE DTSEGNO 0 0 -2.250000 2.232420 ECU_ADDRESS 0xB28F0 BIT_MASK 0xFF /end MEASUREMENT
/begin MEASUREMENT FSE31_06 " Filterwert Segmentabweichung, eingerechnet" UBYTE DTSEGNO 0 0 -2.250000 2.232420 ECU_ADDRESS 0xB2902 BIT_MASK 0xFF /end MEASUREMENT
/begin MEASUREMENT FSE31_07 " Filterwert Segmentabweichung, eingerechnet" UBYTE DTSEGNO 0 0 -2.250000 2.232420 ECU_ADDRESS 0xB2914 BIT_MASK 0xFF /end MEASUREMENT
/begin MEASUREMENT FSE31_08 " Filterwert Segmentabweichung, eingerechnet" UBYTE DTSEGNO 0 0 -2.250000 2.232420 ECU_ADDRESS 0xB2926 BIT_MASK 0xFF /end MEASUREMENT
/begin MEASUREMENT FSE32_02 " Filterwert Segmentabweichung, eingerechnet" UBYTE DTSEGNO 0 0 -2.250000 2.232420 ECU_ADDRESS 0xB28C0 BIT_MASK 0xFF /end MEASUREMENT
/begin MEASUREMENT FSE32_03 " Filterwert Segmentabweichung, eingerechnet" UBYTE DTSEGNO 0 0 -2.250000 2.232420 ECU_ADDRESS 0xB28D2 BIT_MASK 0xFF /end MEASUREMENT
/begin MEASUREMENT FSE32_04 " Filterwert Segmentabweichung, eingerechnet" UBYTE DTSEGNO 0 0 -2.250000 2.232420 ECU_ADDRESS 0xB28E4 BIT_MASK 0xFF /end MEASUREMENT
/begin MEASUREMENT FSE32_05 " Filterwert Segmentabweichung, eingerechnet" UBYTE DTSEGNO 0 0 -2.250000 2.232420 ECU_ADDRESS 0xB28F6 BIT_MASK 0xFF /end MEASUREMENT
/begin MEASUREMENT FSE32_06 " Filterwert Segmentabweichung, eingerechnet" UBYTE DTSEGNO 0 0 -2.250000 2.232420 ECU_ADDRESS 0xB2908 BIT_MASK 0xFF /end MEASUREMENT
/begin MEASUREMENT FSE32_07 " Filterwert Segmentabweichung, eingerechnet" UBYTE DTSEGNO 0 0 -2.250000 2.232420 ECU_ADDRESS 0xB291A BIT_MASK 0xFF /end MEASUREMENT
/begin MEASUREMENT FSE32_08 " Filterwert Segmentabweichung, eingerechnet" UBYTE DTSEGNO 0 0 -2.250000 2.232420 ECU_ADDRESS 0xB292C BIT_MASK 0xFF /end MEASUREMENT
/begin MEASUREMENT FSE33_02 " Filterwert Segmentabweichung, eingerechnet" UBYTE DTSEGNO 0 0 -2.250000 2.232420 ECU_ADDRESS 0xB28C6 BIT_MASK 0xFF /end MEASUREMENT
/begin MEASUREMENT FSE33_03 " Filterwert Segmentabweichung, eingerechnet" UBYTE DTSEGNO 0 0 -2.250000 2.232420 ECU_ADDRESS 0xB28D8 BIT_MASK 0xFF /end MEASUREMENT
/begin MEASUREMENT FSE33_04 " Filterwert Segmentabweichung, eingerechnet" UBYTE DTSEGNO 0 0 -2.250000 2.232420 ECU_ADDRESS 0xB28EA BIT_MASK 0xFF /end MEASUREMENT
/begin MEASUREMENT FSE33_05 " Filterwert Segmentabweichung, eingerechnet" UBYTE DTSEGNO 0 0 -2.250000 2.232420 ECU_ADDRESS 0xB28FC BIT_MASK 0xFF /end MEASUREMENT
/begin MEASUREMENT FSE33_06 " Filterwert Segmentabweichung, eingerechnet" UBYTE DTSEGNO 0 0 -2.250000 2.232420 ECU_ADDRESS 0xB290E BIT_MASK 0xFF /end MEASUREMENT
/begin MEASUREMENT FSE33_07 " Filterwert Segmentabweichung, eingerechnet" UBYTE DTSEGNO 0 0 -2.250000 2.232420 ECU_ADDRESS 0xB2920 BIT_MASK 0xFF /end MEASUREMENT
/begin MEASUREMENT FSE33_08 " Filterwert Segmentabweichung, eingerechnet" UBYTE DTSEGNO 0 0 -2.250000 2.232420 ECU_ADDRESS 0xB2932 BIT_MASK 0xFF /end MEASUREMENT
/begin MEASUREMENT FSE41_02 " Filterwert Segmentabweichung, eingerechnet" UBYTE DTSEGNO 0 0 -2.250000 2.232420 ECU_ADDRESS 0xB28BB BIT_MASK 0xFF /end MEASUREMENT
/begin MEASUREMENT FSE41_03 " Filterwert Segmentabweichung, eingerechnet" UBYTE DTSEGNO 0 0 -2.250000 2.232420 ECU_ADDRESS 0xB28CD BIT_MASK 0xFF /end MEASUREMENT
/begin MEASUREMENT FSE41_04 " Filterwert Segmentabweichung, eingerechnet" UBYTE DTSEGNO 0 0 -2.250000 2.232420 ECU_ADDRESS 0xB28DF BIT_MASK 0xFF /end MEASUREMENT
/begin MEASUREMENT FSE41_05 " Filterwert Segmentabweichung, eingerechnet" UBYTE DTSEGNO 0 0 -2.250000 2.232420 ECU_ADDRESS 0xB28F1 BIT_MASK 0xFF /end MEASUREMENT
/begin MEASUREMENT FSE41_06 " Filterwert Segmentabweichung, eingerechnet" UBYTE DTSEGNO 0 0 -2.250000 2.232420 ECU_ADDRESS 0xB2903 BIT_MASK 0xFF /end MEASUREMENT
/begin MEASUREMENT FSE41_07 " Filterwert Segmentabweichung, eingerechnet" UBYTE DTSEGNO 0 0 -2.250000 2.232420 ECU_ADDRESS 0xB2915 BIT_MASK 0xFF /end MEASUREMENT
/begin MEASUREMENT FSE41_08 " Filterwert Segmentabweichung, eingerechnet" UBYTE DTSEGNO 0 0 -2.250000 2.232420 ECU_ADDRESS 0xB2927 BIT_MASK 0xFF /end MEASUREMENT
/begin MEASUREMENT FSE42_02 " Filterwert Segmentabweichung, eingerechnet" UBYTE DTSEGNO 0 0 -2.250000 2.232420 ECU_ADDRESS 0xB28C1 BIT_MASK 0xFF /end MEASUREMENT
/begin MEASUREMENT FSE42_03 " Filterwert Segmentabweichung, eingerechnet" UBYTE DTSEGNO 0 0 -2.250000 2.232420 ECU_ADDRESS 0xB28D3 BIT_MASK 0xFF /end MEASUREMENT
/begin MEASUREMENT FSE42_04 " Filterwert Segmentabweichung, eingerechnet" UBYTE DTSEGNO 0 0 -2.250000 2.232420 ECU_ADDRESS 0xB28E5 BIT_MASK 0xFF /end MEASUREMENT
/begin MEASUREMENT FSE42_05 " Filterwert Segmentabweichung, eingerechnet" UBYTE DTSEGNO 0 0 -2.250000 2.232420 ECU_ADDRESS 0xB28F7 BIT_MASK 0xFF /end MEASUREMENT
/begin MEASUREMENT FSE42_06 " Filterwert Segmentabweichung, eingerechnet" UBYTE DTSEGNO 0 0 -2.250000 2.232420 ECU_ADDRESS 0xB2909 BIT_MASK 0xFF /end MEASUREMENT
/begin MEASUREMENT FSE42_07 " Filterwert Segmentabweichung, eingerechnet" UBYTE DTSEGNO 0 0 -2.250000 2.232420 ECU_ADDRESS 0xB291B BIT_MASK 0xFF /end MEASUREMENT
/begin MEASUREMENT FSE42_08 " Filterwert Segmentabweichung, eingerechnet" UBYTE DTSEGNO 0 0 -2.250000 2.232420 ECU_ADDRESS 0xB292D BIT_MASK 0xFF /end MEASUREMENT
/begin MEASUREMENT FSE43_02 " Filterwert Segmentabweichung, eingerechnet" UBYTE DTSEGNO 0 0 -2.250000 2.232420 ECU_ADDRESS 0xB28C7 BIT_MASK 0xFF /end MEASUREMENT
/begin MEASUREMENT FSE43_03 " Filterwert Segmentabweichung, eingerechnet" UBYTE DTSEGNO 0 0 -2.250000 2.232420 ECU_ADDRESS 0xB28D9 BIT_MASK 0xFF /end MEASUREMENT
/begin MEASUREMENT FSE43_04 " Filterwert Segmentabweichung, eingerechnet" UBYTE DTSEGNO 0 0 -2.250000 2.232420 ECU_ADDRESS 0xB28EB BIT_MASK 0xFF /end MEASUREMENT
/begin MEASUREMENT FSE43_05 " Filterwert Segmentabweichung, eingerechnet" UBYTE DTSEGNO 0 0 -2.250000 2.232420 ECU_ADDRESS 0xB28FD BIT_MASK 0xFF /end MEASUREMENT
/begin MEASUREMENT FSE43_06 " Filterwert Segmentabweichung, eingerechnet" UBYTE DTSEGNO 0 0 -2.250000 2.232420 ECU_ADDRESS 0xB290F BIT_MASK 0xFF /end MEASUREMENT
/begin MEASUREMENT FSE43_07 " Filterwert Segmentabweichung, eingerechnet" UBYTE DTSEGNO 0 0 -2.250000 2.232420 ECU_ADDRESS 0xB2921 BIT_MASK 0xFF /end MEASUREMENT
/begin MEASUREMENT FSE43_08 " Filterwert Segmentabweichung, eingerechnet" UBYTE DTSEGNO 0 0 -2.250000 2.232420 ECU_ADDRESS 0xB2933 BIT_MASK 0xFF /end MEASUREMENT
/begin MEASUREMENT FSE51_02 " Filterwert Segmentabweichung, eingerechnet" UBYTE DTSEGNO 0 0 -2.250000 2.232420 ECU_ADDRESS 0xB28BC BIT_MASK 0xFF /end MEASUREMENT
/begin MEASUREMENT FSE51_03 " Filterwert Segmentabweichung, eingerechnet" UBYTE DTSEGNO 0 0 -2.250000 2.232420 ECU_ADDRESS 0xB28CE BIT_MASK 0xFF /end MEASUREMENT
/begin MEASUREMENT FSE51_04 " Filterwert Segmentabweichung, eingerechnet" UBYTE DTSEGNO 0 0 -2.250000 2.232420 ECU_ADDRESS 0xB28E0 BIT_MASK 0xFF /end MEASUREMENT
/begin MEASUREMENT FSE51_05 " Filterwert Segmentabweichung, eingerechnet" UBYTE DTSEGNO 0 0 -2.250000 2.232420 ECU_ADDRESS 0xB28F2 BIT_MASK 0xFF /end MEASUREMENT
/begin MEASUREMENT FSE51_06 " Filterwert Segmentabweichung, eingerechnet" UBYTE DTSEGNO 0 0 -2.250000 2.232420 ECU_ADDRESS 0xB2904 BIT_MASK 0xFF /end MEASUREMENT
/begin MEASUREMENT FSE51_07 " Filterwert Segmentabweichung, eingerechnet" UBYTE DTSEGNO 0 0 -2.250000 2.232420 ECU_ADDRESS 0xB2916 BIT_MASK 0xFF /end MEASUREMENT
/begin MEASUREMENT FSE51_08 " Filterwert Segmentabweichung, eingerechnet" UBYTE DTSEGNO 0 0 -2.250000 2.232420 ECU_ADDRESS 0xB2928 BIT_MASK 0xFF /end MEASUREMENT
/begin MEASUREMENT FSE52_02 " Filterwert Segmentabweichung, eingerechnet" UBYTE DTSEGNO 0 0 -2.250000 2.232420 ECU_ADDRESS 0xB28C2 BIT_MASK 0xFF /end MEASUREMENT
/begin MEASUREMENT FSE52_03 " Filterwert Segmentabweichung, eingerechnet" UBYTE DTSEGNO 0 0 -2.250000 2.232420 ECU_ADDRESS 0xB28D4 BIT_MASK 0xFF /end MEASUREMENT
/begin MEASUREMENT FSE52_04 " Filterwert Segmentabweichung, eingerechnet" UBYTE DTSEGNO 0 0 -2.250000 2.232420 ECU_ADDRESS 0xB28E6 BIT_MASK 0xFF /end MEASUREMENT
/begin MEASUREMENT FSE52_05 " Filterwert Segmentabweichung, eingerechnet" UBYTE DTSEGNO 0 0 -2.250000 2.232420 ECU_ADDRESS 0xB28F8 BIT_MASK 0xFF /end MEASUREMENT
/begin MEASUREMENT FSE52_06 " Filterwert Segmentabweichung, eingerechnet" UBYTE DTSEGNO 0 0 -2.250000 2.232420 ECU_ADDRESS 0xB290A BIT_MASK 0xFF /end MEASUREMENT
/begin MEASUREMENT FSE52_07 " Filterwert Segmentabweichung, eingerechnet" UBYTE DTSEGNO 0 0 -2.250000 2.232420 ECU_ADDRESS 0xB291C BIT_MASK 0xFF /end MEASUREMENT
/begin MEASUREMENT FSE52_08 " Filterwert Segmentabweichung, eingerechnet" UBYTE DTSEGNO 0 0 -2.250000 2.232420 ECU_ADDRESS 0xB292E BIT_MASK 0xFF /end MEASUREMENT
/begin MEASUREMENT FSE53_02 " Filterwert Segmentabweichung, eingerechnet" UBYTE DTSEGNO 0 0 -2.250000 2.232420 ECU_ADDRESS 0xB28C8 BIT_MASK 0xFF /end MEASUREMENT
/begin MEASUREMENT FSE53_03 " Filterwert Segmentabweichung, eingerechnet" UBYTE DTSEGNO 0 0 -2.250000 2.232420 ECU_ADDRESS 0xB28DA BIT_MASK 0xFF /end MEASUREMENT
/begin MEASUREMENT FSE53_04 " Filterwert Segmentabweichung, eingerechnet" UBYTE DTSEGNO 0 0 -2.250000 2.232420 ECU_ADDRESS 0xB28EC BIT_MASK 0xFF /end MEASUREMENT
/begin MEASUREMENT FSE53_05 " Filterwert Segmentabweichung, eingerechnet" UBYTE DTSEGNO 0 0 -2.250000 2.232420 ECU_ADDRESS 0xB28FE BIT_MASK 0xFF /end MEASUREMENT
/begin MEASUREMENT FSE53_06 " Filterwert Segmentabweichung, eingerechnet" UBYTE DTSEGNO 0 0 -2.250000 2.232420 ECU_ADDRESS 0xB2910 BIT_MASK 0xFF /end MEASUREMENT
/begin MEASUREMENT FSE53_07 " Filterwert Segmentabweichung, eingerechnet" UBYTE DTSEGNO 0 0 -2.250000 2.232420 ECU_ADDRESS 0xB2922 BIT_MASK 0xFF /end MEASUREMENT
/begin MEASUREMENT FSE53_08 " Filterwert Segmentabweichung, eingerechnet" UBYTE DTSEGNO 0 0 -2.250000 2.232420 ECU_ADDRESS 0xB2934 BIT_MASK 0xFF /end MEASUREMENT
/begin MEASUREMENT FSE61_02 " Filterwert Segmentabweichung, eingerechnet" UBYTE DTSEGNO 0 0 -2.250000 2.232420 ECU_ADDRESS 0xB28BD BIT_MASK 0xFF /end MEASUREMENT
/begin MEASUREMENT FSE61_03 " Filterwert Segmentabweichung, eingerechnet" UBYTE DTSEGNO 0 0 -2.250000 2.232420 ECU_ADDRESS 0xB28CF BIT_MASK 0xFF /end MEASUREMENT
/begin MEASUREMENT FSE61_04 " Filterwert Segmentabweichung, eingerechnet" UBYTE DTSEGNO 0 0 -2.250000 2.232420 ECU_ADDRESS 0xB28E1 BIT_MASK 0xFF /end MEASUREMENT
/begin MEASUREMENT FSE61_05 " Filterwert Segmentabweichung, eingerechnet" UBYTE DTSEGNO 0 0 -2.250000 2.232420 ECU_ADDRESS 0xB28F3 BIT_MASK 0xFF /end MEASUREMENT
/begin MEASUREMENT FSE61_06 " Filterwert Segmentabweichung, eingerechnet" UBYTE DTSEGNO 0 0 -2.250000 2.232420 ECU_ADDRESS 0xB2905 BIT_MASK 0xFF /end MEASUREMENT
/begin MEASUREMENT FSE61_07 " Filterwert Segmentabweichung, eingerechnet" UBYTE DTSEGNO 0 0 -2.250000 2.232420 ECU_ADDRESS 0xB2917 BIT_MASK 0xFF /end MEASUREMENT
/begin MEASUREMENT FSE61_08 " Filterwert Segmentabweichung, eingerechnet" UBYTE DTSEGNO 0 0 -2.250000 2.232420 ECU_ADDRESS 0xB2929 BIT_MASK 0xFF /end MEASUREMENT
/begin MEASUREMENT FSE62_02 " Filterwert Segmentabweichung, eingerechnet" UBYTE DTSEGNO 0 0 -2.250000 2.232420 ECU_ADDRESS 0xB28C3 BIT_MASK 0xFF /end MEASUREMENT
/begin MEASUREMENT FSE62_03 " Filterwert Segmentabweichung, eingerechnet" UBYTE DTSEGNO 0 0 -2.250000 2.232420 ECU_ADDRESS 0xB28D5 BIT_MASK 0xFF /end MEASUREMENT
/begin MEASUREMENT FSE62_04 " Filterwert Segmentabweichung, eingerechnet" UBYTE DTSEGNO 0 0 -2.250000 2.232420 ECU_ADDRESS 0xB28E7 BIT_MASK 0xFF /end MEASUREMENT
/begin MEASUREMENT FSE62_05 " Filterwert Segmentabweichung, eingerechnet" UBYTE DTSEGNO 0 0 -2.250000 2.232420 ECU_ADDRESS 0xB28F9 BIT_MASK 0xFF /end MEASUREMENT
/begin MEASUREMENT FSE62_06 " Filterwert Segmentabweichung, eingerechnet" UBYTE DTSEGNO 0 0 -2.250000 2.232420 ECU_ADDRESS 0xB290B BIT_MASK 0xFF /end MEASUREMENT
/begin MEASUREMENT FSE62_07 " Filterwert Segmentabweichung, eingerechnet" UBYTE DTSEGNO 0 0 -2.250000 2.232420 ECU_ADDRESS 0xB291D BIT_MASK 0xFF /end MEASUREMENT
/begin MEASUREMENT FSE62_08 " Filterwert Segmentabweichung, eingerechnet" UBYTE DTSEGNO 0 0 -2.250000 2.232420 ECU_ADDRESS 0xB292F BIT_MASK 0xFF /end MEASUREMENT
/begin MEASUREMENT FSE63_02 " Filterwert Segmentabweichung, eingerechnet" UBYTE DTSEGNO 0 0 -2.250000 2.232420 ECU_ADDRESS 0xB28C9 BIT_MASK 0xFF /end MEASUREMENT
/begin MEASUREMENT FSE63_03 " Filterwert Segmentabweichung, eingerechnet" UBYTE DTSEGNO 0 0 -2.250000 2.232420 ECU_ADDRESS 0xB28DB BIT_MASK 0xFF /end MEASUREMENT
/begin MEASUREMENT FSE63_04 " Filterwert Segmentabweichung, eingerechnet" UBYTE DTSEGNO 0 0 -2.250000 2.232420 ECU_ADDRESS 0xB28ED BIT_MASK 0xFF /end MEASUREMENT
/begin MEASUREMENT FSE63_05 " Filterwert Segmentabweichung, eingerechnet" UBYTE DTSEGNO 0 0 -2.250000 2.232420 ECU_ADDRESS 0xB28FF BIT_MASK 0xFF /end MEASUREMENT
/begin MEASUREMENT FSE63_06 " Filterwert Segmentabweichung, eingerechnet" UBYTE DTSEGNO 0 0 -2.250000 2.232420 ECU_ADDRESS 0xB2911 BIT_MASK 0xFF /end MEASUREMENT
/begin MEASUREMENT FSE63_07 " Filterwert Segmentabweichung, eingerechnet" UBYTE DTSEGNO 0 0 -2.250000 2.232420 ECU_ADDRESS 0xB2923 BIT_MASK 0xFF /end MEASUREMENT
/begin MEASUREMENT FSE63_08 " Filterwert Segmentabweichung, eingerechnet" UBYTE DTSEGNO 0 0 -2.250000 2.232420 ECU_ADDRESS 0xB2935 BIT_MASK 0xFF /end MEASUREMENT
/begin MEASUREMENT FSTAT "Faktor Stationaerbetrieb Einspritzung" UWORD FKT256L 0 0 0.000000 256.000000 ECU_ADDRESS 0xB028A BIT_MASK 0xFFFF /end MEASUREMENT
/begin MEASUREMENT FSTL " AD-Wandlerwert fuer Fuellstandkontrolle" UBYTE U5V 0 0 0.000000 5.000000 ECU_ADDRESS 0xB025B BIT_MASK 0xFF /end MEASUREMENT
/begin MEASUREMENT FTEA "Tankentl.- Korr.-Faktor 100H ='1'" UWORD FKT256L 0 0 0.000000 256.000000 ECU_ADDRESS 0xF71C BIT_MASK 0xFFFF /end MEASUREMENT
/begin MEASUREMENT FWE "WE-Anreicherungsfaktor" UWORD FKT256L 0 0 0.000000 256.000000 ECU_ADDRESS 0xB0290 BIT_MASK 0xFFFF /end MEASUREMENT
/begin MEASUREMENT FWL "WL-Anreicherungsfaktor" UWORD FKT256L 0 0 0.000000 256.000000 ECU_ADDRESS 0xB028E BIT_MASK 0xFFFF /end MEASUREMENT
/begin MEASUREMENT FZW "Faktor Einspritzkorrektur bei Zuendwinkelverstellung" UBYTE FKT128 0 0 0.000000 1.992190 ECU_ADDRESS 0xB06BC BIT_MASK 0xFF /end MEASUREMENT
/begin MEASUREMENT IDXFO "Index lt. FDEF" UWORD DEZL 0 0 0.000000 65535.000000 ECU_ADDRESS 0xB07BA BIT_MASK 0xFFFF /end MEASUREMENT
/begin MEASUREMENT IDXFOB "Hi = n, Lo = tl, Index in Nibbles" UBYTE DEZ 0 0 0.000000 256.000000 ECU_ADDRESS 0xB07C7 BIT_MASK 0xFF /end MEASUREMENT
/begin MEASUREMENT IDXFON "Index n lt. FDEF" UBYTE DEZ 0 0 0.000000 256.000000 ECU_ADDRESS 0xB07BA BIT_MASK 0xFF /end MEASUREMENT
/begin MEASUREMENT IDXFOTL "Index n lt. FDEF" UBYTE DEZ 0 0 0.000000 256.000000 ECU_ADDRESS 0xB07BB BIT_MASK 0xFF /end MEASUREMENT
/begin MEASUREMENT KSWF " Kat.-Schuts-Wichtungsfaktor" UBYTE DEZ 0 0 0.000000 256.000000 ECU_ADDRESS 0xB0A2A BIT_MASK 0xFF /end MEASUREMENT
/begin MEASUREMENT LAMSBG1_W " Lambdasoll Begrenzung aus %LAMKO" UWORD FKT4096L 0 0 0.000000 16.000000 ECU_ADDRESS 0xB092C BIT_MASK 0xFFFF /end MEASUREMENT
/begin MEASUREMENT LUAR " Abstandsmass Referenzwert" SBYTE LUQ_S8 0 0 -94.296300 93.559600 ECU_ADDRESS 0xB07A5 BIT_MASK 0xFF /end MEASUREMENT
/begin MEASUREMENT LUARMN " Abstandsmass Referenzwert Minimum" SBYTE LUQ_S8 0 0 -94.296300 93.559600 ECU_ADDRESS 0xB07A6 BIT_MASK 0xFF /end MEASUREMENT
/begin MEASUREMENT LUAROFF " Abstandsmass Referenzwert Offset" UBYTE LUQ 0 0 0.000000 187.856000 ECU_ADDRESS 0xB07A7 BIT_MASK 0xFF /end MEASUREMENT
/begin MEASUREMENT LUAR_AP " Ausgabe von LUAR aus Trommel" SBYTE LUQ_S8 0 0 -94.296300 93.559600 ECU_ADDRESS 0xF9AA BIT_MASK 0xFF /end MEASUREMENT
/begin MEASUREMENT LUNW "" SBYTE LUQ_S8 0 0 -94.296300 93.559600 ECU_ADDRESS 0xB07C8 BIT_MASK 0xFF /end MEASUREMENT
/begin MEASUREMENT LUT1 "aktueller LUT-Wert fuer Zylinder 1" SBYTE LUQ_S8 0 0 -94.296300 93.559600 ECU_ADDRESS 0xB0750 BIT_MASK 0xFF /end MEASUREMENT
/begin MEASUREMENT LUT2 "aktueller LUT-Wert fuer Zylinder 2" SBYTE LUQ_S8 0 0 -94.296300 93.559600 ECU_ADDRESS 0xB0751 BIT_MASK 0xFF /end MEASUREMENT
/begin MEASUREMENT LUT3 "aktueller LUT-Wert fuer Zylinder 3" SBYTE LUQ_S8 0 0 -94.296300 93.559600 ECU_ADDRESS 0xB0752 BIT_MASK 0xFF /end MEASUREMENT
/begin MEASUREMENT LUT4 "aktueller LUT-Wert fuer Zylinder 4" SBYTE LUQ_S8 0 0 -94.296300 93.559600 ECU_ADDRESS 0xB0753 BIT_MASK 0xFF /end MEASUREMENT
/begin MEASUREMENT LUT5 "aktueller LUT-Wert fuer Zylinder 5" SBYTE LUQ_S8 0 0 -94.296300 93.559600 ECU_ADDRESS 0xB0754 BIT_MASK 0xFF /end MEASUREMENT
/begin MEASUREMENT LUT6 "aktueller LUT-Wert fuer Zylinder 6" SBYTE LUQ_S8 0 0 -94.296300 93.559600 ECU_ADDRESS 0xB0755 BIT_MASK 0xFF /end MEASUREMENT
/begin MEASUREMENT LUT7 "aktueller LUT-Wert fuer Zylinder 7" SBYTE LUQ_S8 0 0 -94.296300 93.559600 ECU_ADDRESS 0xB0756 BIT_MASK 0xFF /end MEASUREMENT
/begin MEASUREMENT LUT8 "aktueller LUT-Wert fuer Zylinder 8" SBYTE LUQ_S8 0 0 -94.296300 93.559600 ECU_ADDRESS 0xB0757 BIT_MASK 0xFF /end MEASUREMENT
/begin MEASUREMENT LUTS " ident LUT" SBYTE LUQ_S8 0 0 -94.296300 93.559600 ECU_ADDRESS 0xB07AB BIT_MASK 0xFF /end MEASUREMENT
/begin MEASUREMENT MILSTATE "" UBYTE DEZ 0 0 0.000000 256.000000 ECU_ADDRESS 0xB225D BIT_MASK 0xFF /end MEASUREMENT
/begin MEASUREMENT MLSMS "16-Bit Luftmasse ungefiltert" UWORD MLQ010L 0 0 0.000000 6553.500000 ECU_ADDRESS 0xF954 BIT_MASK 0xFFFF /end MEASUREMENT
/begin MEASUREMENT NGRAD "Drehzahlgradient (Quant.=40Upm/s)" UBYTE NGRDQ40 0 0 0.000000 10200.000000 ECU_ADDRESS 0xF731 BIT_MASK 0xFF /end MEASUREMENT
/begin MEASUREMENT NIST_1U "Drehzahl" UWORD NQ1_W 0 0 0.000000 8000.000000 ECU_ADDRESS 0xF94A BIT_MASK 0xFFFF /end MEASUREMENT
/begin MEASUREMENT PEDGR "Pedalwertgradient" SWORD PER0327LS 0 0 -100.003000 100.000000 ECU_ADDRESS 0xB04C2 BIT_MASK 0xFFFF /end MEASUREMENT
/begin MEASUREMENT PEDGR8 "Pedalwertgradient 8bit" SBYTE PER25T10MS 0 0 -25.000800 24.805400 ECU_ADDRESS 0xB04CC BIT_MASK 0xFF /end MEASUREMENT
/begin MEASUREMENT PHPW " 8 Bit Schieberegister vom Phasensignal" UBYTE DEZ 0 0 0.000000 256.000000 ECU_ADDRESS 0xB0A6F BIT_MASK 0xFF /end MEASUREMENT
/begin MEASUREMENT RINH2_W "Innenwiderstand Ri Nerst hinter Kat Bank 2" UWORD R_UW_Q2 0 0 0.000000 131070.000000 ECU_ADDRESS 0xB0FFE BIT_MASK 0xFFFF /end MEASUREMENT
/begin MEASUREMENT RINH_W "Innenwiderstand Ri Nerst hinter Kat Bank 1" UWORD R_UW_Q2 0 0 0.000000 131070.000000 ECU_ADDRESS 0xB0FFA BIT_MASK 0xFFFF /end MEASUREMENT
/begin MEASUREMENT RINOFH2_W "Innenwiderstand Ri Nerst ohne Filter hinter Kat Bank 2" UWORD R_UW_Q2 0 0 0.000000 131070.000000 ECU_ADDRESS 0xB1028 BIT_MASK 0xFFFF /end MEASUREMENT
/begin MEASUREMENT RINOFH_W "Innenwiderstand Ri Nerst ohne Filter hinter Kat Bank 1" UWORD R_UW_Q2 0 0 0.000000 131070.000000 ECU_ADDRESS 0xB1026 BIT_MASK 0xFFFF /end MEASUREMENT
/begin MEASUREMENT RINOFV2_W "Innenwiderstand Ri Nerst ohne Filter vor Kat Bank 2" UWORD R_UW_Q2 0 0 0.000000 131070.000000 ECU_ADDRESS 0xB1024 BIT_MASK 0xFFFF /end MEASUREMENT
/begin MEASUREMENT RINOFV_W "Innenwiderstand Ri Nerst ohne Filter vor Kat Bank 1" UWORD R_UW_Q2 0 0 0.000000 131070.000000 ECU_ADDRESS 0xB1022 BIT_MASK 0xFFFF /end MEASUREMENT
/begin MEASUREMENT RINV2_W "Innenwiderstand Ri Nerst vor Kat Bank 2" UWORD R_UW_Q2 0 0 0.000000 131070.000000 ECU_ADDRESS 0xB0FF6 BIT_MASK 0xFFFF /end MEASUREMENT
/begin MEASUREMENT RINV_W "Innenwiderstand Ri Nerst vor Kat Bank 1" UWORD R_UW_Q2 0 0 0.000000 131070.000000 ECU_ADDRESS 0xB0FF2 BIT_MASK 0xFFFF /end MEASUREMENT
/begin MEASUREMENT RL "relative Luftfuellung" UBYTE UFUELL 0 0 0.000000 191.250000 ECU_ADDRESS 0xF72D BIT_MASK 0xFF /end MEASUREMENT
/begin MEASUREMENT SP1S "Sollw.-Poti-Schleifer 1 (10 Bit rechtsbuendig)" UWORD DEZL 0 0 0.000000 65535.000000 ECU_ADDRESS 0xB024A BIT_MASK 0xFFFF /end MEASUREMENT
/begin MEASUREMENT SP2S "Sollw.-Poti-Schleifer 2 (10 Bit rechtsbuendig)" UWORD DEZL 0 0 0.000000 65535.000000 ECU_ADDRESS 0xB024C BIT_MASK 0xFFFF /end MEASUREMENT
/begin MEASUREMENT SPS "Sollwert-Poti-Schleifer (10 Bit rechtsbuendig)" UBYTE DEZL 0 0 0.000000 65535.000000 ECU_ADDRESS 0xB04BC BIT_MASK 0xFF /end MEASUREMENT
/begin MEASUREMENT SPSN_FGR " Sollwertvorgabe FGR auf Pedalwertbasis" UBYTE DEZ 0 0 0.000000 256.000000 ECU_ADDRESS 0xB0559 BIT_MASK 0xFF /end MEASUREMENT
/begin MEASUREMENT SPSN_MSR " Sollwertvorgabe MSR auf Pedalwertbasis" UBYTE DEZ 0 0 0.000000 256.000000 ECU_ADDRESS 0xB0556 BIT_MASK 0xFF /end MEASUREMENT
/begin MEASUREMENT SW8M " Source fuer inverse Pedalkennlinie MSR" UBYTE PER255 0 0 0.000000 100.000000 ECU_ADDRESS 0xB0557 BIT_MASK 0xFF /end MEASUREMENT
/begin MEASUREMENT SW8MKL " Wert aus inverser Pedalkennlinie MSR" UBYTE DEZ 0 0 0.000000 256.000000 ECU_ADDRESS 0xB0558 BIT_MASK 0xFF /end MEASUREMENT
/begin MEASUREMENT SW8T " Source fuer inverse Pedalkennlinie FGR" UBYTE PER255 0 0 0.000000 100.000000 ECU_ADDRESS 0xB055A BIT_MASK 0xFF /end MEASUREMENT
/begin MEASUREMENT SW8TKL " Wert aus inverser Pedalkennlinie FGR" UBYTE DEZ 0 0 0.000000 256.000000 ECU_ADDRESS 0xB055B BIT_MASK 0xFF /end MEASUREMENT
/begin MEASUREMENT SW_MSR "Sollwert MSR" UWORD PER0327 0 0 0.000000 100.000000 ECU_ADDRESS 0xB064A BIT_MASK 0xFFFF /end MEASUREMENT
/begin MEASUREMENT SW_PED "normierter Pedal-Sollwert (15 Bit rechtsbuendig)" UWORD PER0327 0 0 0.000000 100.000000 ECU_ADDRESS 0xB04C0 BIT_MASK 0xFFFF /end MEASUREMENT
/begin MEASUREMENT SW_PEDBW "bewerteter Pedal-Sollwert (15 Bit rechtsbuendig)" UWORD PER0327 0 0 0.000000 100.000000 ECU_ADDRESS 0xB02C8 BIT_MASK 0xFFFF /end MEASUREMENT
/begin MEASUREMENT SW_PEDKL "Sollwert nach Pedalkennkinie (15 Bit rechtsbuendig)" UWORD PER0327 0 0 0.000000 100.000000 ECU_ADDRESS 0xB0554 BIT_MASK 0xFFFF /end MEASUREMENT
/begin MEASUREMENT SW_TEMP "Tempomat-Sollwert (15 Bit rechtsbuendig)" UWORD PER0327 0 0 0.000000 100.000000 ECU_ADDRESS 0xB04CE BIT_MASK 0xFFFF /end MEASUREMENT
/begin MEASUREMENT TANKFST " Fuel Level Quant.: 1% /Inc" UBYTE DEZ 0 0 0.000000 256.000000 ECU_ADDRESS 0xB0C18 BIT_MASK 0xFF /end MEASUREMENT
/begin MEASUREMENT TANSLIN "Linearisierte Lufttemp." UBYTE UTMP_40 0 0 -40.000000 216.000000 ECU_ADDRESS 0xB0297 BIT_MASK 0xFF /end MEASUREMENT
/begin MEASUREMENT TEUKG "'FMT:530'Gesamtwert Uebergangskompensation" SWORD TEQ_CPL 0 0 -87.381300 87.378700 ECU_ADDRESS 0xF8E8 BIT_MASK 0xFFFF /end MEASUREMENT
/begin MEASUREMENT TFST "Tankfuellstand" UBYTE DEZ 0 0 0.000000 256.000000 ECU_ADDRESS 0xB0FC3 BIT_MASK 0xFF /end MEASUREMENT
/begin MEASUREMENT TIS_B1 "Start-Einspritzzeit BANK1" UWORD TEQ_8L 0 0 0.000000 1398.080000 ECU_ADDRESS 0xF7CC BIT_MASK 0xFFFF /end MEASUREMENT
/begin MEASUREMENT TIS_B2 "Start-Einspritzzeit BANK2" UWORD TEQ_8L 0 0 0.000000 1398.080000 ECU_ADDRESS 0xF7CE BIT_MASK 0xFFFF /end MEASUREMENT
/begin MEASUREMENT TI_B1 "Einspritzzeit BANK1 (Start: 8*TEQL)" UWORD TEQL 0 0 0.000000 174.760000 ECU_ADDRESS 0xF726 BIT_MASK 0xFFFF /end MEASUREMENT
/begin MEASUREMENT TI_B2 "Einspritzzeit BANK2 (Start: 8*TEQL)" UWORD TEQL 0 0 0.000000 174.760000 ECU_ADDRESS 0xF728 BIT_MASK 0xFFFF /end MEASUREMENT
/begin MEASUREMENT TI_VS "Verstellwert fuer Einspritzzeit" UBYTE FKT128BG 0 0 0.750000 1.250000 ECU_ADDRESS 0xB0281 BIT_MASK 0xFF /end MEASUREMENT
/begin MEASUREMENT TL_ "TL (=LAST) gefiltert" UWORD TEQL 0 0 0.000000 174.760000 ECU_ADDRESS 0xF95A BIT_MASK 0xFFFF /end MEASUREMENT
/begin MEASUREMENT TMABS "Abstelltemperatur" UBYTE CMO_TMP 0 0 -41.000000 140.000000 ECU_ADDRESS 0xB2134 BIT_MASK 0xFF /end MEASUREMENT
/begin MEASUREMENT TMABS_W "Abstelltemperatur" UWORD TMP_10B 0 0 -41.000000 140.000000 ECU_ADDRESS 0xB2132 BIT_MASK 0xFFFF /end MEASUREMENT
/begin MEASUREMENT TMEW "Motortemperatur-Ersatzwert aus Modell" UBYTE CMO_TMP 0 0 -41.000000 140.000000 ECU_ADDRESS 0xB0A01 BIT_MASK 0xFF /end MEASUREMENT
/begin MEASUREMENT TMOTLIN "Linearisierte Motortemp." UBYTE UTMP_40 0 0 -40.000000 216.000000 ECU_ADDRESS 0xB0296 BIT_MASK 0xFF /end MEASUREMENT
/begin MEASUREMENT TMOT_W " 10-Bit TMOT gefiltert(=Basis fuer 8-Bit TMOT)" UWORD TMP_10B 0 0 -41.000000 140.000000 ECU_ADDRESS 0xA04 BIT_MASK 0xFFFF /end MEASUREMENT
/begin MEASUREMENT TMSTEM "Motortemperatur bei Startende in Memory" UBYTE CMO_TMP 0 0 -41.000000 140.000000 ECU_ADDRESS 0xB1006 BIT_MASK 0xFF /end MEASUREMENT
/begin MEASUREMENT TN "Zuendabstand TN (Q=2.66us)" UWORD TEQL 0 0 0.000000 174.760000 ECU_ADDRESS 0xF712 BIT_MASK 0xFFFF /end MEASUREMENT
/begin MEASUREMENT TNST "Nachstart-Counter (Start mit B_STEND: 0->1, Begr. auf FFFFH)" UWORD TQ100L 0 0 0.000000 6553.500000 ECU_ADDRESS 0xB0278 BIT_MASK 0xFFFF /end MEASUREMENT
/begin MEASUREMENT TOP_W "Operating time seit powerfail" UWORD TQ360000L 0 0 0.000000 393210.000000 ECU_ADDRESS 0xB2530 BIT_MASK 0xFFFF /end MEASUREMENT
/begin MEASUREMENT TS01 " Segmentzeit zyl1, roh" UWORD TSEGQL 0 0 0.000000 58253.300000 ECU_ADDRESS 0xB0768 BIT_MASK 0xFFFF /end MEASUREMENT
/begin MEASUREMENT TS02 " Segmentzeit zyl2, roh" UWORD TSEGQL 0 0 0.000000 58253.300000 ECU_ADDRESS 0xB076A BIT_MASK 0xFFFF /end MEASUREMENT
/begin MEASUREMENT TS03 " Segmentzeit zyl3, roh" UWORD TSEGQL 0 0 0.000000 58253.300000 ECU_ADDRESS 0xB076C BIT_MASK 0xFFFF /end MEASUREMENT
/begin MEASUREMENT TS04 " Segmentzeit zyl4, roh" UWORD TSEGQL 0 0 0.000000 58253.300000 ECU_ADDRESS 0xB076E BIT_MASK 0xFFFF /end MEASUREMENT
/begin MEASUREMENT TS05 " Segmentzeit zyl5, roh" UWORD TSEGQL 0 0 0.000000 58253.300000 ECU_ADDRESS 0xB0770 BIT_MASK 0xFFFF /end MEASUREMENT
/begin MEASUREMENT TS06 " Segmentzeit zyl6, roh" UWORD TSEGQL 0 0 0.000000 58253.300000 ECU_ADDRESS 0xB0772 BIT_MASK 0xFFFF /end MEASUREMENT
/begin MEASUREMENT TS07 " Segmentzeit zyl7, roh" UWORD TSEGQL 0 0 0.000000 58253.300000 ECU_ADDRESS 0xB0774 BIT_MASK 0xFFFF /end MEASUREMENT
/begin MEASUREMENT TS08 " Segmentzeit zyl8, roh" UWORD TSEGQL 0 0 0.000000 58253.300000 ECU_ADDRESS 0xB0776 BIT_MASK 0xFFFF /end MEASUREMENT
/begin MEASUREMENT TSK01 " Segmentzeit zyl1, korrigiert" UWORD TSEGQL 0 0 0.000000 58253.300000 ECU_ADDRESS 0xB0778 BIT_MASK 0xFFFF /end MEASUREMENT
/begin MEASUREMENT TSK02 " Segmentzeit zyl2, korrigiert" UWORD TSEGQL 0 0 0.000000 58253.300000 ECU_ADDRESS 0xB077A BIT_MASK 0xFFFF /end MEASUREMENT
/begin MEASUREMENT TSK03 " Segmentzeit zyl3, korrigiert" UWORD TSEGQL 0 0 0.000000 58253.300000 ECU_ADDRESS 0xB077C BIT_MASK 0xFFFF /end MEASUREMENT
/begin MEASUREMENT TSK04 " Segmentzeit zyl4, korrigiert" UWORD TSEGQL 0 0 0.000000 58253.300000 ECU_ADDRESS 0xB077E BIT_MASK 0xFFFF /end MEASUREMENT
/begin MEASUREMENT TSK05 " Segmentzeit zyl5, korrigiert" UWORD TSEGQL 0 0 0.000000 58253.300000 ECU_ADDRESS 0xB0780 BIT_MASK 0xFFFF /end MEASUREMENT
/begin MEASUREMENT TSK06 " Segmentzeit zyl6, korrigiert" UWORD TSEGQL 0 0 0.000000 58253.300000 ECU_ADDRESS 0xB0782 BIT_MASK 0xFFFF /end MEASUREMENT
/begin MEASUREMENT TSK07 " Segmentzeit zyl7, korrigiert" UWORD TSEGQL 0 0 0.000000 58253.300000 ECU_ADDRESS 0xB0784 BIT_MASK 0xFFFF /end MEASUREMENT
/begin MEASUREMENT TSK08 " Segmentzeit zyl8, korrigiert" UWORD TSEGQL 0 0 0.000000 58253.300000 ECU_ADDRESS 0xB0786 BIT_MASK 0xFFFF /end MEASUREMENT
/begin MEASUREMENT TSK_AP "Ausgabe von TSK aus Trommel" UWORD TSEGQL 0 0 0.000000 58253.300000 ECU_ADDRESS 0xF9A4 BIT_MASK 0xFFFF /end MEASUREMENT
/begin MEASUREMENT TS_AP "Ausgabe von TS aus Trommel" UWORD TSEGQL 0 0 0.000000 58253.300000 ECU_ADDRESS 0xF99E BIT_MASK 0xFFFF /end MEASUREMENT
/begin MEASUREMENT USHK "Hinterkat-Lambdasonde 1" UBYTE ULSQ 0 0 0.000000 5.000000 ECU_ADDRESS 0xB0245 BIT_MASK 0xFF /end MEASUREMENT
/begin MEASUREMENT USHK1 "Hinterkat-Lambdasonde 1" UBYTE ULSQ 0 0 0.000000 5.000000 ECU_ADDRESS 0xB0245 BIT_MASK 0xFF /end MEASUREMENT
/begin MEASUREMENT USHK1W "Hinterkat-Lambdasonde1" UWORD ULSQL 0 0 0.000000 5.000000 ECU_ADDRESS 0xB0244 BIT_MASK 0xFFFF /end MEASUREMENT
/begin MEASUREMENT USHK2 "Hinterkat-Lambdasonde 2" UBYTE ULSQ 0 0 0.000000 5.000000 ECU_ADDRESS 0xB0247 BIT_MASK 0xFF /end MEASUREMENT
/begin MEASUREMENT USHK2W "Hinterkat-Lambdasonde2" UWORD ULSQL 0 0 0.000000 5.000000 ECU_ADDRESS 0xB0246 BIT_MASK 0xFFFF /end MEASUREMENT
/begin MEASUREMENT USHKR2_W "Spannung gemessen Lambdasonde hinter Kat Bank 2" UWORD ULSQL 0 0 0.000000 5.000000 ECU_ADDRESS 0xB1058 BIT_MASK 0xFFFF /end MEASUREMENT
/begin MEASUREMENT USHKR_W "Spannung gemessen Lambdasonde hinter Kat Bank 1" UWORD ULSQL 0 0 0.000000 5.000000 ECU_ADDRESS 0xB1056 BIT_MASK 0xFFFF /end MEASUREMENT
/begin MEASUREMENT USHMB2_W "Spannung Lambdasonde mit Wid. belastet hinter Kat Bank 2" UWORD ULSQL 0 0 0.000000 5.000000 ECU_ADDRESS 0xB1068 BIT_MASK 0xFFFF /end MEASUREMENT
/begin MEASUREMENT USHMB_W "Spannung Lambdasonde mit Wid. belastet hinter Kat Bank 1" UWORD ULSQL 0 0 0.000000 5.000000 ECU_ADDRESS 0xB1066 BIT_MASK 0xFFFF /end MEASUREMENT
/begin MEASUREMENT USHOB2_W "Spannung Lambdasonde ohne Belastung hinter Kat Bank 2" UWORD ULSQL 0 0 0.000000 5.000000 ECU_ADDRESS 0xB1070 BIT_MASK 0xFFFF /end MEASUREMENT
/begin MEASUREMENT USHOB_W "Spannung Lambdasonde ohne Belastung hinter Kat Bank 1" UWORD ULSQL 0 0 0.000000 5.000000 ECU_ADDRESS 0xB106E BIT_MASK 0xFFFF /end MEASUREMENT
/begin MEASUREMENT USVK1 "Vorkat-Lambdasonde 1" UBYTE ULSQ 0 0 0.000000 5.000000 ECU_ADDRESS 0xB0241 BIT_MASK 0xFF /end MEASUREMENT
/begin MEASUREMENT USVK1W "Vorkat-Lambdasonde1" UWORD ULSQL 0 0 0.000000 5.000000 ECU_ADDRESS 0xB0240 BIT_MASK 0xFFFF /end MEASUREMENT
/begin MEASUREMENT USVK2 "Vorkat-Lambdasonde 2" UBYTE ULSQ 0 0 0.000000 5.000000 ECU_ADDRESS 0xB0243 BIT_MASK 0xFF /end MEASUREMENT
/begin MEASUREMENT USVK2W "Vorkat-Lambdasonde2" UWORD ULSQL 0 0 0.000000 5.000000 ECU_ADDRESS 0xB0242 BIT_MASK 0xFFFF /end MEASUREMENT
/begin MEASUREMENT USVKR2_W "Spannung gemessen Lambdasonde vor Kat Bank 2" UWORD ULSQL 0 0 0.000000 5.000000 ECU_ADDRESS 0xB1054 BIT_MASK 0xFFFF /end MEASUREMENT
/begin MEASUREMENT USVKR_W "Spannung gemessen Lambdasonde vor Kat Bank 1" UWORD ULSQL 0 0 0.000000 5.000000 ECU_ADDRESS 0xB1052 BIT_MASK 0xFFFF /end MEASUREMENT
/begin MEASUREMENT USVMB2_W "Spannung Lambdasonde mit Wid. belastet vor Kat Bank 2" UWORD ULSQL 0 0 0.000000 5.000000 ECU_ADDRESS 0xB1064 BIT_MASK 0xFFFF /end MEASUREMENT
/begin MEASUREMENT USVMB_W "Spannung Lambdasonde mit Wid. belastet vor Kat Bank 1" UWORD ULSQL 0 0 0.000000 5.000000 ECU_ADDRESS 0xB1062 BIT_MASK 0xFFFF /end MEASUREMENT
/begin MEASUREMENT USVOB2_W "Spannung Lambdasonde ohne Belastung vor Kat Bank 2" UWORD ULSQL 0 0 0.000000 5.000000 ECU_ADDRESS 0xB106C BIT_MASK 0xFFFF /end MEASUREMENT
/begin MEASUREMENT USVOB_W "Spannung Lambdasonde ohne Belastung vor Kat Bank 1" UWORD ULSQL 0 0 0.000000 5.000000 ECU_ADDRESS 0xB106A BIT_MASK 0xFFFF /end MEASUREMENT
/begin MEASUREMENT UTANS " ADC-Zw: 10-Bit-Ansauglufttemp." UWORD TMP_10B 0 0 -41.000000 140.000000 ECU_ADDRESS 0xB032A BIT_MASK 0xFFFF /end MEASUREMENT
/begin MEASUREMENT UTMOT " ADC-Zw: 10-Bit-Motortemperatur" UWORD TMP_10B 0 0 -41.000000 140.000000 ECU_ADDRESS 0xB0328 BIT_MASK 0xFFFF /end MEASUREMENT
/begin MEASUREMENT UUBATT "ADC-Zw: Batteriespannung" UBYTE UBQ 0 0 0.000000 24.119600 ECU_ADDRESS 0xB0327 BIT_MASK 0xFF /end MEASUREMENT
/begin MEASUREMENT UUSHK2_W " Spannungswert" UWORD ULSQL 0 0 0.000000 5.000000 ECU_ADDRESS 0xB1040 BIT_MASK 0xFFFF /end MEASUREMENT
/begin MEASUREMENT UUSHK_W " Spannungswert" UWORD ULSQL 0 0 0.000000 5.000000 ECU_ADDRESS 0xB103E BIT_MASK 0xFFFF /end MEASUREMENT
/begin MEASUREMENT UUSHMB2_W " Spannungswert" UWORD ULSQL 0 0 0.000000 5.000000 ECU_ADDRESS 0xB1048 BIT_MASK 0xFFFF /end MEASUREMENT
/begin MEASUREMENT UUSHMB_W " Spannungswert" UWORD ULSQL 0 0 0.000000 5.000000 ECU_ADDRESS 0xB1046 BIT_MASK 0xFFFF /end MEASUREMENT
/begin MEASUREMENT UUSHOB2_W " Spannungswert" UWORD ULSQL 0 0 0.000000 5.000000 ECU_ADDRESS 0xB1050 BIT_MASK 0xFFFF /end MEASUREMENT
/begin MEASUREMENT UUSHOB_W " Spannungswert" UWORD ULSQL 0 0 0.000000 5.000000 ECU_ADDRESS 0xB104E BIT_MASK 0xFFFF /end MEASUREMENT
/begin MEASUREMENT UUSVK2_W " Spannungswert" UWORD ULSQL 0 0 0.000000 5.000000 ECU_ADDRESS 0xB103C BIT_MASK 0xFFFF /end MEASUREMENT
/begin MEASUREMENT UUSVK_W " Spannungswert" UWORD ULSQL 0 0 0.000000 5.000000 ECU_ADDRESS 0xB103A BIT_MASK 0xFFFF /end MEASUREMENT
/begin MEASUREMENT UUSVMB2_W " Spannungswert" UWORD ULSQL 0 0 0.000000 5.000000 ECU_ADDRESS 0xB1044 BIT_MASK 0xFFFF /end MEASUREMENT
/begin MEASUREMENT UUSVMB_W " Spannungswert" UWORD ULSQL 0 0 0.000000 5.000000 ECU_ADDRESS 0xB1042 BIT_MASK 0xFFFF /end MEASUREMENT
/begin MEASUREMENT UUSVOB2_W " Spannungswert" UWORD ULSQL 0 0 0.000000 5.000000 ECU_ADDRESS 0xB104C BIT_MASK 0xFFFF /end MEASUREMENT
/begin MEASUREMENT UUSVOB_W " Spannungswert" UWORD ULSQL 0 0 0.000000 5.000000 ECU_ADDRESS 0xB104A BIT_MASK 0xFFFF /end MEASUREMENT
/begin MEASUREMENT VFZG_W "gefilterte Geschwindigkeit" UWORD VQV16L 0 0 0.000000 4095.940000 ECU_ADDRESS 0xB027A BIT_MASK 0xFFFF /end MEASUREMENT
/begin MEASUREMENT VROHB_W "ungefil. begrenzte Geschw." UWORD VQV16L 0 0 0.000000 4095.940000 ECU_ADDRESS 0xB060A BIT_MASK 0xFFFF /end MEASUREMENT
/begin MEASUREMENT VROH_W "ungefil. Geschw." UWORD VQV16L 0 0 0.000000 4095.940000 ECU_ADDRESS 0xB0608 BIT_MASK 0xFFFF /end MEASUREMENT
/begin MEASUREMENT WGEXT " externer Zuendwinkel-Eingriff begrenzt" UBYTE ZWQ 0 0 0.000000 191.250000 ECU_ADDRESS 0xB055E BIT_MASK 0xFF /end MEASUREMENT
/begin MEASUREMENT WKR0 "Zuendwinkel aus Klopfregelung Zyl. 1" UBYTE ZWQ 0 0 0.000000 191.250000 ECU_ADDRESS 0xB0432 BIT_MASK 0xFF /end MEASUREMENT
/begin MEASUREMENT WKR1 "Zuendwinkel aus Klopfregelung Zyl. 2" UBYTE ZWQ 0 0 0.000000 191.250000 ECU_ADDRESS 0xB0433 BIT_MASK 0xFF /end MEASUREMENT
/begin MEASUREMENT WKR2 "Zuendwinkel aus Klopfregelung Zyl. 3" UBYTE ZWQ 0 0 0.000000 191.250000 ECU_ADDRESS 0xB0434 BIT_MASK 0xFF /end MEASUREMENT
/begin MEASUREMENT WKR3 "Zuendwinkel aus Klopfregelung Zyl. 4" UBYTE ZWQ 0 0 0.000000 191.250000 ECU_ADDRESS 0xB0435 BIT_MASK 0xFF /end MEASUREMENT
/begin MEASUREMENT WKR4 "Zuendwinkel aus Klopfregelung Zyl. 5" UBYTE ZWQ 0 0 0.000000 191.250000 ECU_ADDRESS 0xB0436 BIT_MASK 0xFF /end MEASUREMENT
/begin MEASUREMENT WKR5 "Zuendwinkel aus Klopfregelung Zyl. 6" UBYTE ZWQ 0 0 0.000000 191.250000 ECU_ADDRESS 0xB0437 BIT_MASK 0xFF /end MEASUREMENT
/begin MEASUREMENT WUCCNT "Warm-up cycle - counter" UBYTE DEZ 0 0 0.000000 256.000000 ECU_ADDRESS 0xB225B BIT_MASK 0xFF /end MEASUREMENT
/begin MEASUREMENT XS " Norm. Segmentabw. aktueller Zylinder im aktuellen Betriebsbereich" UWORD DTSEGNO_S1 0 0 -144.000000 144.000000 ECU_ADDRESS 0xB07E4 BIT_MASK 0xFFFF /end MEASUREMENT
/begin MEASUREMENT XS02 " Norm. Segmentabw. Zylinder 2 im aktuellen Betriebsbereich" UWORD DTSEGNO_S1 0 0 -144.000000 144.000000 ECU_ADDRESS 0xB0814 BIT_MASK 0xFFFF /end MEASUREMENT
/begin MEASUREMENT XS03 " Norm. Segmentabw. Zylinder 3 im aktuellen Betriebsbereich" UWORD DTSEGNO_S1 0 0 -144.000000 144.000000 ECU_ADDRESS 0xB0816 BIT_MASK 0xFFFF /end MEASUREMENT
/begin MEASUREMENT XS04 " Norm. Segmentabw. Zylinder 4 im aktuellen Betriebsbereich" UWORD DTSEGNO_S1 0 0 -144.000000 144.000000 ECU_ADDRESS 0xB0818 BIT_MASK 0xFFFF /end MEASUREMENT
/begin MEASUREMENT XS05 " Norm. Segmentabw. Zylinder 5 im aktuellen Betriebsbereich" UWORD DTSEGNO_S1 0 0 -144.000000 144.000000 ECU_ADDRESS 0xB081A BIT_MASK 0xFFFF /end MEASUREMENT
/begin MEASUREMENT XS06 " Norm. Segmentabw. Zylinder 6 im aktuellen Betriebsbereich" UWORD DTSEGNO_S1 0 0 -144.000000 144.000000 ECU_ADDRESS 0xB081C BIT_MASK 0xFFFF /end MEASUREMENT
/begin MEASUREMENT XS07 " Norm. Segmentabw. Zylinder 7 im aktuellen Betriebsbereich" UWORD DTSEGNO_S1 0 0 -144.000000 144.000000 ECU_ADDRESS 0xB081E BIT_MASK 0xFFFF /end MEASUREMENT
/begin MEASUREMENT XS08 " Norm. Segmentabw. Zylinder 8 im aktuellen Betriebsbereich" UWORD DTSEGNO_S1 0 0 -144.000000 144.000000 ECU_ADDRESS 0xB0820 BIT_MASK 0xFFFF /end MEASUREMENT
/begin MEASUREMENT ZPDBS " 100ms Timer Dswec 4.0" UBYTE DEZ 0 0 0.000000 256.000000 ECU_ADDRESS 0xF980 BIT_MASK 0xFF /end MEASUREMENT
/begin MEASUREMENT ZRIBERV "Ri-Berechnungszaehler nach Start vor Kat Bank 1" UBYTE DEZ 0 0 0.000000 256.000000 ECU_ADDRESS 0xB108A BIT_MASK 0xFF /end MEASUREMENT
/begin MEASUREMENT ZRIBERV2 "Ri-Berechnungszaehler nach Start vor Kat Bank 2" UBYTE DEZ 0 0 0.000000 256.000000 ECU_ADDRESS 0xB108B BIT_MASK 0xFF /end MEASUREMENT
/begin MEASUREMENT ZRINV2_W "Zeitzaehler Bereitstellung aktuelle Bedingungen b_rinv2" UWORD TQ100L 0 0 0.000000 6553.500000 ECU_ADDRESS 0xB1084 BIT_MASK 0xFFFF /end MEASUREMENT
/begin MEASUREMENT ZRINV_W "Zeitzaehler Bereitstellung aktuelle Bedingungen b_rinv" UWORD TQ100L 0 0 0.000000 6553.500000 ECU_ADDRESS 0xB1082 BIT_MASK 0xFFFF /end MEASUREMENT
/begin MEASUREMENT ZYLVEK " Zylindervektor" UBYTE DEZ 0 0 0.000000 256.000000 ECU_ADDRESS 0xF777 BIT_MASK 0xFF /end MEASUREMENT
/begin MEASUREMENT ZZDBS " 100ms Timer Dswec 4.0" UBYTE DEZ 0 0 0.000000 256.000000 ECU_ADDRESS 0xF981 BIT_MASK 0xFF /end MEASUREMENT
/begin MEASUREMENT BZSYNC " 1 = bis Bezugsmarke gefunden ist" UWORD B_TRUE 0 0 0.000000 1.000000 ECU_ADDRESS 0xFD10 BIT_MASK 0x2 /end MEASUREMENT
/begin MEASUREMENT B_AFKLT " Aussetzerfenster, Bedingung kalt (DMDMIL)" UWORD B_TRUE 0 0 0.000000 1.000000 ECU_ADDRESS 0xFDF6 BIT_MASK 0x400 /end MEASUREMENT
/begin MEASUREMENT B_AFTKLT " Aussetzerfenster temporaer, Bedingung kalt" UWORD B_TRUE 0 0 0.000000 1.000000 ECU_ADDRESS 0xFD84 BIT_MASK 0x1 /end MEASUREMENT
/begin MEASUREMENT B_AFTWRM " Aussetzerfenster temporaer, Bedingung warm" UWORD B_TRUE 0 0 0.000000 1.000000 ECU_ADDRESS 0xFD84 BIT_MASK 0x2 /end MEASUREMENT
/begin MEASUREMENT B_AFWRM " Aussetzerfenster, Bedingung warm (DMDMIL)" UWORD B_TRUE 0 0 0.000000 1.000000 ECU_ADDRESS 0xFDF6 BIT_MASK 0x800 /end MEASUREMENT
/begin MEASUREMENT B_ASR " 1 = ASR aktiv" UWORD B_TRUE 0 0 0.000000 1.000000 ECU_ADDRESS 0xFD04 BIT_MASK 0x400 /end MEASUREMENT
/begin MEASUREMENT B_AUS " 1 = Aus-Funktion (Tempomat)" UWORD B_TRUE 0 0 0.000000 1.000000 ECU_ADDRESS 0xFD0A BIT_MASK 0x40 /end MEASUREMENT
/begin MEASUREMENT B_B2 " 1 = Startbereich 2" UWORD B_TRUE 0 0 0.000000 1.000000 ECU_ADDRESS 0xFD0C BIT_MASK 0x2 /end MEASUREMENT
/begin MEASUREMENT B_BFKLT " Aussetzerfenster, Bedingung kalt" UWORD B_TRUE 0 0 0.000000 1.000000 ECU_ADDRESS 0xFD84 BIT_MASK 0x4 /end MEASUREMENT
/begin MEASUREMENT B_BFWRM " Aussetzerfenster, Bedingung warm" UWORD B_TRUE 0 0 0.000000 1.000000 ECU_ADDRESS 0xFD84 BIT_MASK 0x8 /end MEASUREMENT
/begin MEASUREMENT B_BL " = B_BREMSE" UWORD B_TRUE 0 0 0.000000 1.000000 ECU_ADDRESS 0xFD0A BIT_MASK 0x80 /end MEASUREMENT
/begin MEASUREMENT B_BLKEB " MIL-Ansteuerung blinkend eigenbestimmt" UBYTE B_TRUE 0 0 0.000000 1.000000 ECU_ADDRESS 0xB0FA1 BIT_MASK 0x4 /end MEASUREMENT
/begin MEASUREMENT B_BLKFB " MIL-Ansteuerung blinkend fremdbestimmt durch externes SG" UWORD B_TRUE 0 0 0.000000 1.000000 ECU_ADDRESS 0xFDD6 BIT_MASK 0x20 /end MEASUREMENT
/begin MEASUREMENT B_BLKMD " MIL-Ansteuerung blinkend durch Aussetzererkennung" UWORD B_TRUE 0 0 0.000000 1.000000 ECU_ADDRESS 0xFDD6 BIT_MASK 0x80 /end MEASUREMENT
/begin MEASUREMENT B_BR " = B_BREMSE" UWORD B_TRUE 0 0 0.000000 1.000000 ECU_ADDRESS 0xFD0A BIT_MASK 0x80 /end MEASUREMENT
/begin MEASUREMENT B_CDMD " Funktion ueber Codewort CDMD freigegeben" UWORD B_TRUE 0 0 0.000000 1.000000 ECU_ADDRESS 0xB1000 BIT_MASK 0x1 /end MEASUREMENT
/begin MEASUREMENT B_DBSE " Ausloesung Drive-Recorder Messung " UWORD B_TRUE 0 0 0.000000 1.000000 ECU_ADDRESS 0xFD7E BIT_MASK 0x400 /end MEASUREMENT
/begin MEASUREMENT B_DCY " Bedingung 'driving cycle' erkannt" UBYTE B_TRUE 0 0 0.000000 1.000000 ECU_ADDRESS 0xB0F9D BIT_MASK 0x1 /end MEASUREMENT
/begin MEASUREMENT B_DESEE " 1= allg. Pruefbedingungen erfuellt" UWORD B_TRUE 0 0 0.000000 1.000000 ECU_ADDRESS 0xFD8E BIT_MASK 0x1000 /end MEASUREMENT
/begin MEASUREMENT B_DKNOT_FR " DK-Notfahren" UWORD B_TRUE 0 0 0.000000 1.000000 ECU_ADDRESS 0xFD6A BIT_MASK 0x100 /end MEASUREMENT
/begin MEASUREMENT B_DMDHI_AP " 1 = DMD -High Resolution" UBYTE B_TRUE 0 0 0.000000 1.000000 ECU_ADDRESS 0xF9A7 BIT_MASK 0x80 /end MEASUREMENT
/begin MEASUREMENT B_DPAKT " Dashpot aktiv" UWORD B_TRUE 0 0 0.000000 1.000000 ECU_ADDRESS 0xFD9A BIT_MASK 0x1 /end MEASUREMENT
/begin MEASUREMENT B_DPFE "> Dashpot-Fuellungseingriff" UWORD B_TRUE 0 0 0.000000 1.000000 ECU_ADDRESS 0xFD68 BIT_MASK 0x100 /end MEASUREMENT
/begin MEASUREMENT B_DRCHA "1 = Drivewechsel" UWORD B_TRUE 0 0 0.000000 1.000000 ECU_ADDRESS 0xFD1C BIT_MASK 0x40 /end MEASUREMENT
/begin MEASUREMENT B_EDKVS2 " 1 = Bed. Adaptionsfehlerschwellen an Bank 2 aktuell ueberschritten" UWORD B_TRUE 0 0 0.000000 1.000000 ECU_ADDRESS 0xFD44 BIT_MASK 0x200 /end MEASUREMENT
/begin MEASUREMENT B_ENRINH "Bedingung Enable Ri Auswertung hinter Kat Bank 1" UBYTE B_TRUE 0 0 0.000000 1.000000 ECU_ADDRESS 0xB1020 BIT_MASK 0x2 /end MEASUREMENT
/begin MEASUREMENT B_ENRINH2 "Bedingung Enable Ri Auswertung hinter Kat Bank 2" UBYTE B_TRUE 0 0 0.000000 1.000000 ECU_ADDRESS 0xB1021 BIT_MASK 0x2 /end MEASUREMENT
/begin MEASUREMENT B_ENRINV "Bedingung Enable Ri Auswertung vor Kat Bank 1" UBYTE B_TRUE 0 0 0.000000 1.000000 ECU_ADDRESS 0xB101E BIT_MASK 0x2 /end MEASUREMENT
/begin MEASUREMENT B_ENRINV2 "Bedingung Enable Ri Auswertung vor Kat Bank 2" UBYTE B_TRUE 0 0 0.000000 1.000000 ECU_ADDRESS 0xB101F BIT_MASK 0x2 /end MEASUREMENT
/begin MEASUREMENT B_ERINOFH "Bedingung Enable Ri Auswertung ohne Filter hinter Kat Bank 1" UBYTE B_TRUE 0 0 0.000000 1.000000 ECU_ADDRESS 0xB1020 BIT_MASK 0x4 /end MEASUREMENT
/begin MEASUREMENT B_ERINOFH2 "Bedingung Enable Ri Auswertung ohne Filter hinter Kat Bank 2" UBYTE B_TRUE 0 0 0.000000 1.000000 ECU_ADDRESS 0xB1021 BIT_MASK 0x4 /end MEASUREMENT
/begin MEASUREMENT B_ERINOFV "Bedingung Enable Ri Auswertung ohne Filter vor Kat Bank 1" UBYTE B_TRUE 0 0 0.000000 1.000000 ECU_ADDRESS 0xB101E BIT_MASK 0x4 /end MEASUREMENT
/begin MEASUREMENT B_ERINOFV2 "Bedingung Enable Ri Auswertung ohne Filter vor Kat Bank 2" UBYTE B_TRUE 0 0 0.000000 1.000000 ECU_ADDRESS 0xB101F BIT_MASK 0x4 /end MEASUREMENT
/begin MEASUREMENT B_ESZW " Bedingung Einspritzkorrektur bei Zuendwinkelverstellung" UWORD B_TRUE 0 0 0.000000 1.000000 ECU_ADDRESS 0xFDB2 BIT_MASK 0x10 /end MEASUREMENT
/begin MEASUREMENT B_EVASE " >DMD freigeben wenn keine EV-Ausblendung" UWORD B_TRUE 0 0 0.000000 1.000000 ECU_ADDRESS 0xFDBE BIT_MASK 0x8000 /end MEASUREMENT
/begin MEASUREMENT B_FELA " Carb-Fehlerlampe ein" UWORD B_TRUE 0 0 0.000000 1.000000 ECU_ADDRESS 0xFD02 BIT_MASK 0x1 /end MEASUREMENT
/begin MEASUREMENT B_FGR_2T "1=FGR Bedienh. 2 oder 3 Tasten betaetigt" UWORD B_TRUE 0 0 0.000000 1.000000 ECU_ADDRESS 0xFD6C BIT_MASK 0x1 /end MEASUREMENT
/begin MEASUREMENT B_FGR_PL " 1=FGR-Bedienhebelsignal unplausibel" UWORD B_TRUE 0 0 0.000000 1.000000 ECU_ADDRESS 0xFD6C BIT_MASK 0x2 /end MEASUREMENT
/begin MEASUREMENT B_FLL " 1 = fetter Leerlauf" UWORD B_TRUE 0 0 0.000000 1.000000 ECU_ADDRESS 0xFD06 BIT_MASK 0x40 /end MEASUREMENT
/begin MEASUREMENT B_FODO " Bedingung Adaption Bereich dominant" UBYTE B_TRUE 0 0 0.000000 1.000000 ECU_ADDRESS 0xB25BC BIT_MASK 0x2 /end MEASUREMENT
/begin MEASUREMENT B_FOF " Bedingung fuel-off Adaption aktiv" UBYTE B_TRUE 0 0 0.000000 1.000000 ECU_ADDRESS 0xB25BD BIT_MASK 0x2 /end MEASUREMENT
/begin MEASUREMENT B_FOFSTP " Bedingung fuel-off Adaption gestoppt" UWORD B_TRUE 0 0 0.000000 1.000000 ECU_ADDRESS 0xFDBA BIT_MASK 0x1000 /end MEASUREMENT
/begin MEASUREMENT B_FOHE " Bedingung Adaption Bereich Heilbereich" UBYTE B_TRUE 0 0 0.000000 1.000000 ECU_ADDRESS 0xB25BC BIT_MASK 0x80 /end MEASUREMENT
/begin MEASUREMENT B_FOHOLD " Bedingung Adaption angehalten" UBYTE B_TRUE 0 0 0.000000 1.000000 ECU_ADDRESS 0xB25BD BIT_MASK 0x4 /end MEASUREMENT
/begin MEASUREMENT B_FOLUNW " Bedingung Adaption angehalten wg. lunw" UWORD B_TRUE 0 0 0.000000 1.000000 ECU_ADDRESS 0xFDBE BIT_MASK 0x40 /end MEASUREMENT
/begin MEASUREMENT B_FON " Bedingung fuel-on Adaption aktiv" UBYTE B_TRUE 0 0 0.000000 1.000000 ECU_ADDRESS 0xB25BD BIT_MASK 0x1 /end MEASUREMENT
/begin MEASUREMENT B_FONDO " Bedingung Adaption Bereich n-dominant" UBYTE B_TRUE 0 0 0.000000 1.000000 ECU_ADDRESS 0xB25BC BIT_MASK 0x8 /end MEASUREMENT
/begin MEASUREMENT B_FONSTP " Bedingung fuel-on Adaption gestoppt" UWORD B_TRUE 0 0 0.000000 1.000000 ECU_ADDRESS 0xFDBC BIT_MASK 0x8000 /end MEASUREMENT
/begin MEASUREMENT B_FONTM " Motortemperatur genuegend hoch fuer fuel-on-Adaption" UWORD B_TRUE 0 0 0.000000 1.000000 ECU_ADDRESS 0xFDBC BIT_MASK 0x4000 /end MEASUREMENT
/begin MEASUREMENT B_FOR " Bedingung Adaption ready im aktuellen Betriebsbereich" UBYTE B_TRUE 0 0 0.000000 1.000000 ECU_ADDRESS 0xB25BD BIT_MASK 0x20 /end MEASUREMENT
/begin MEASUREMENT B_FOR11 " Bedingung fuel-on Adaption ready Betriebsbereich 11" UBYTE B_TRUE 0 0 0.000000 1.000000 ECU_ADDRESS 0xB25C0 BIT_MASK 0x1 /end MEASUREMENT
/begin MEASUREMENT B_FOR12 " Bedingung fuel-on Adaption ready Betriebsbereich 12" UBYTE B_TRUE 0 0 0.000000 1.000000 ECU_ADDRESS 0xB25C1 BIT_MASK 0x1 /end MEASUREMENT
/begin MEASUREMENT B_FOR13 " Bedingung fuel-on Adaption ready Betriebsbereich 13" UBYTE B_TRUE 0 0 0.000000 1.000000 ECU_ADDRESS 0xB25C2 BIT_MASK 0x1 /end MEASUREMENT
/begin MEASUREMENT B_FOR21 " Bedingung fuel-on Adaption ready Betriebsbereich 21" UBYTE B_TRUE 0 0 0.000000 1.000000 ECU_ADDRESS 0xB25C0 BIT_MASK 0x2 /end MEASUREMENT
/begin MEASUREMENT B_FOR22 " Bedingung fuel-on Adaption ready Betriebsbereich 22" UBYTE B_TRUE 0 0 0.000000 1.000000 ECU_ADDRESS 0xB25C1 BIT_MASK 0x2 /end MEASUREMENT
/begin MEASUREMENT B_FOR23 " Bedingung fuel-on Adaption ready Betriebsbereich 23" UBYTE B_TRUE 0 0 0.000000 1.000000 ECU_ADDRESS 0xB25C2 BIT_MASK 0x2 /end MEASUREMENT
/begin MEASUREMENT B_FOR31 " Bedingung fuel-on Adaption ready Betriebsbereich 31" UBYTE B_TRUE 0 0 0.000000 1.000000 ECU_ADDRESS 0xB25C0 BIT_MASK 0x4 /end MEASUREMENT
/begin MEASUREMENT B_FOR32 " Bedingung fuel-on Adaption ready Betriebsbereich 32" UBYTE B_TRUE 0 0 0.000000 1.000000 ECU_ADDRESS 0xB25C1 BIT_MASK 0x4 /end MEASUREMENT
/begin MEASUREMENT B_FOR33 " Bedingung fuel-on Adaption ready Betriebsbereich 33" UBYTE B_TRUE 0 0 0.000000 1.000000 ECU_ADDRESS 0xB25C2 BIT_MASK 0x4 /end MEASUREMENT
/begin MEASUREMENT B_FOR41 " Bedingung fuel-on Adaption ready Betriebsbereich 41" UBYTE B_TRUE 0 0 0.000000 1.000000 ECU_ADDRESS 0xB25C0 BIT_MASK 0x8 /end MEASUREMENT
/begin MEASUREMENT B_FOR42 " Bedingung fuel-on Adaption ready Betriebsbereich 42" UBYTE B_TRUE 0 0 0.000000 1.000000 ECU_ADDRESS 0xB25C1 BIT_MASK 0x8 /end MEASUREMENT
/begin MEASUREMENT B_FOR43 " Bedingung fuel-on Adaption ready Betriebsbereich 43" UBYTE B_TRUE 0 0 0.000000 1.000000 ECU_ADDRESS 0xB25C2 BIT_MASK 0x8 /end MEASUREMENT
/begin MEASUREMENT B_FOR51 " Bedingung fuel-on Adaption ready Betriebsbereich 51" UBYTE B_TRUE 0 0 0.000000 1.000000 ECU_ADDRESS 0xB25C0 BIT_MASK 0x10 /end MEASUREMENT
/begin MEASUREMENT B_FOR52 " Bedingung fuel-on Adaption ready Betriebsbereich 52" UBYTE B_TRUE 0 0 0.000000 1.000000 ECU_ADDRESS 0xB25C1 BIT_MASK 0x10 /end MEASUREMENT
/begin MEASUREMENT B_FOR53 " Bedingung fuel-on Adaption ready Betriebsbereich 53" UBYTE B_TRUE 0 0 0.000000 1.000000 ECU_ADDRESS 0xB25C2 BIT_MASK 0x10 /end MEASUREMENT
/begin MEASUREMENT B_FOR61 " Bedingung fuel-on Adaption ready Betriebsbereich 61" UBYTE B_TRUE 0 0 0.000000 1.000000 ECU_ADDRESS 0xB25C0 BIT_MASK 0x20 /end MEASUREMENT
/begin MEASUREMENT B_FOR62 " Bedingung fuel-on Adaption ready Betriebsbereich 62" UBYTE B_TRUE 0 0 0.000000 1.000000 ECU_ADDRESS 0xB25C1 BIT_MASK 0x20 /end MEASUREMENT
/begin MEASUREMENT B_FOR63 " Bedingung fuel-on Adaption ready Betriebsbereich 63" UBYTE B_TRUE 0 0 0.000000 1.000000 ECU_ADDRESS 0xB25C2 BIT_MASK 0x20 /end MEASUREMENT
/begin MEASUREMENT B_FORDO " Bedingung Adaption ready in min. 1 dominanten Betriebsbereich" UBYTE B_TRUE 0 0 0.000000 1.000000 ECU_ADDRESS 0xB25BD BIT_MASK 0x80 /end MEASUREMENT
/begin MEASUREMENT B_FORN " Bedingung Adaption ready im aktuellen Drehzahlbereich" UBYTE B_TRUE 0 0 0.000000 1.000000 ECU_ADDRESS 0xB25BD BIT_MASK 0x40 /end MEASUREMENT
/begin MEASUREMENT B_FORN01 " Bedingung fuel-on Adaption ready Drehzahlbereich 1" UBYTE B_TRUE 0 0 0.000000 1.000000 ECU_ADDRESS 0xB25BE BIT_MASK 0x1 /end MEASUREMENT
/begin MEASUREMENT B_FORN02 " Bedingung fuel-on Adaption ready Drehzahlbereich 2" UBYTE B_TRUE 0 0 0.000000 1.000000 ECU_ADDRESS 0xB25BE BIT_MASK 0x2 /end MEASUREMENT
/begin MEASUREMENT B_FORN03 " Bedingung fuel-on Adaption ready Drehzahlbereich 3" UBYTE B_TRUE 0 0 0.000000 1.000000 ECU_ADDRESS 0xB25BE BIT_MASK 0x4 /end MEASUREMENT
/begin MEASUREMENT B_FORN04 " Bedingung fuel-on Adaption ready Drehzahlbereich 4" UBYTE B_TRUE 0 0 0.000000 1.000000 ECU_ADDRESS 0xB25BE BIT_MASK 0x8 /end MEASUREMENT
/begin MEASUREMENT B_FORN05 " Bedingung fuel-on Adaption ready Drehzahlbereich 5" UBYTE B_TRUE 0 0 0.000000 1.000000 ECU_ADDRESS 0xB25BE BIT_MASK 0x10 /end MEASUREMENT
/begin MEASUREMENT B_FORN06 " Bedingung fuel-on Adaption ready Drehzahlbereich 6" UBYTE B_TRUE 0 0 0.000000 1.000000 ECU_ADDRESS 0xB25BE BIT_MASK 0x20 /end MEASUREMENT
/begin MEASUREMENT B_FORSET " Anzeige Adaption wird rueckgesetzt" UWORD B_TRUE 0 0 0.000000 1.000000 ECU_ADDRESS 0xFDBC BIT_MASK 0x10 /end MEASUREMENT
/begin MEASUREMENT B_FORUN " Bedingung Adaption rennt" UBYTE B_TRUE 0 0 0.000000 1.000000 ECU_ADDRESS 0xB25BD BIT_MASK 0x10 /end MEASUREMENT
/begin MEASUREMENT B_FOS " Bedingung Adaption Bereich Schub" UBYTE B_TRUE 0 0 0.000000 1.000000 ECU_ADDRESS 0xB25BC BIT_MASK 0x4 /end MEASUREMENT
/begin MEASUREMENT B_FOXFG " Bedingung Adaption freigegeben" UBYTE B_TRUE 0 0 0.000000 1.000000 ECU_ADDRESS 0xB25BD BIT_MASK 0x8 /end MEASUREMENT
/begin MEASUREMENT B_FPC "EGAS Zustand Fahrprogramm City" UWORD B_TRUE 0 0 0.000000 1.000000 ECU_ADDRESS 0xFD9A BIT_MASK 0x1000 /end MEASUREMENT
/begin MEASUREMENT B_GS " 1 = Zuendwinkeleingriff GS aktiv" UWORD B_TRUE 0 0 0.000000 1.000000 ECU_ADDRESS 0xFD06 BIT_MASK 0x1000 /end MEASUREMENT
/begin MEASUREMENT B_GV "1 = Automat Variante" UWORD B_TRUE 0 0 0.000000 1.000000 ECU_ADDRESS 0xFD02 BIT_MASK 0x400 /end MEASUREMENT
/begin MEASUREMENT B_HG "1 = Handschalter Variante" UWORD B_TRUE 0 0 0.000000 1.000000 ECU_ADDRESS 0xFD0E BIT_MASK 0x10 /end MEASUREMENT
/begin MEASUREMENT B_INIT " 1 = Init. noch nicht abgeschlossen" UWORD B_TRUE 0 0 0.000000 1.000000 ECU_ADDRESS 0xFD04 BIT_MASK 0x1 /end MEASUREMENT
/begin MEASUREMENT B_I_SKA_UM "irrev. Sicherheitskraftstoffabschaltung vom UM" UWORD B_TRUE 0 0 0.000000 1.000000 ECU_ADDRESS 0xFD6A BIT_MASK 0x20 /end MEASUREMENT
/begin MEASUREMENT B_KL15 " 1 = Zuendung ein" UWORD B_TRUE 0 0 0.000000 1.000000 ECU_ADDRESS 0xFD02 BIT_MASK 0x20 /end MEASUREMENT
/begin MEASUREMENT B_KMMIL " MIL-Ansteuerung mit Relevanz zu Kilometererfassung" UBYTE B_TRUE 0 0 0.000000 1.000000 ECU_ADDRESS 0xB0FA1 BIT_MASK 0x20 /end MEASUREMENT
/begin MEASUREMENT B_KOE " Request Kompressor Endstufe ein" UWORD B_TRUE 0 0 0.000000 1.000000 ECU_ADDRESS 0xFD66 BIT_MASK 0x200 /end MEASUREMENT
/begin MEASUREMENT B_KOS " 1 = Bedingung Klimakompressor ein" UWORD B_TRUE 0 0 0.000000 1.000000 ECU_ADDRESS 0xFD0A BIT_MASK 0x200 /end MEASUREMENT
/begin MEASUREMENT B_KS "Klopfsicherheitsverst. aktiv" UWORD B_TRUE 0 0 0.000000 1.000000 ECU_ADDRESS 0xFD60 BIT_MASK 0x8 /end MEASUREMENT
/begin MEASUREMENT B_KUP " 1 = Kupplungsschalter betaetigt (Handschalter)" UWORD B_TRUE 0 0 0.000000 1.000000 ECU_ADDRESS 0xFD1E BIT_MASK 0x800 /end MEASUREMENT
/begin MEASUREMENT B_KUPCHA "1 = Kupplungswechsel" UWORD B_TRUE 0 0 0.000000 1.000000 ECU_ADDRESS 0xFD1E BIT_MASK 0x1000 /end MEASUREMENT
/begin MEASUREMENT B_KUPSTAT " 1 = Kupplungsschalter betaetigt (Handschalter)" UWORD B_TRUE 0 0 0.000000 1.000000 ECU_ADDRESS 0xFD1E BIT_MASK 0x800 /end MEASUREMENT
/begin MEASUREMENT B_LL " 1 = Leerlauf" UWORD B_TRUE 0 0 0.000000 1.000000 ECU_ADDRESS 0xFD06 BIT_MASK 0x1 /end MEASUREMENT
/begin MEASUREMENT B_LSDAKT " Lastwechselschlagdaempfung aktiv" UWORD B_TRUE 0 0 0.000000 1.000000 ECU_ADDRESS 0xFD9A BIT_MASK 0x2 /end MEASUREMENT
/begin MEASUREMENT B_LSDFE "> Lastschlagdaempfungs-Fuellungseingriff" UWORD B_TRUE 0 0 0.000000 1.000000 ECU_ADDRESS 0xFD68 BIT_MASK 0x200 /end MEASUREMENT
/begin MEASUREMENT B_LUENA " 1 = LUT-Berechnung erlaubt" UWORD B_TRUE 0 0 0.000000 1.000000 ECU_ADDRESS 0xFDBC BIT_MASK 0x200 /end MEASUREMENT
/begin MEASUREMENT B_LUSTOP " 1= Aussetzererkennung nicht aktiv" UWORD B_TRUE 0 0 0.000000 1.000000 ECU_ADDRESS 0xFDBE BIT_MASK 0x80 /end MEASUREMENT
/begin MEASUREMENT B_MDARV " kritische Aussetzerrate vorhanden f. andere Fkt." UWORD B_TRUE 0 0 0.000000 1.000000 ECU_ADDRESS 0xFD84 BIT_MASK 0x400 /end MEASUREMENT
/begin MEASUREMENT B_MDDTLA " Delta-TL8 zu gross" UWORD B_TRUE 0 0 0.000000 1.000000 ECU_ADDRESS 0xFDBE BIT_MASK 0x4 /end MEASUREMENT
/begin MEASUREMENT B_MDERK ">1= Aussetzer erkannt" UWORD B_TRUE 0 0 0.000000 1.000000 ECU_ADDRESS 0xFD84 BIT_MASK 0x4000 /end MEASUREMENT
/begin MEASUREMENT B_MDERKF " Bedingung Aussetzer erkannt" UWORD B_TRUE 0 0 0.000000 1.000000 ECU_ADDRESS 0xFDBC BIT_MASK 0x800 /end MEASUREMENT
/begin MEASUREMENT B_MDKAT " Katschaedigende Aussetzerrate ueberschritten" UWORD B_TRUE 0 0 0.000000 1.000000 ECU_ADDRESS 0xFD84 BIT_MASK 0x200 /end MEASUREMENT
/begin MEASUREMENT B_MDNG " NGRAD > DNALU" UWORD B_TRUE 0 0 0.000000 1.000000 ECU_ADDRESS 0xFDC0 BIT_MASK 0x1 /end MEASUREMENT
/begin MEASUREMENT B_MDNMOT " Drehzahlgrenzen verlassen" UWORD B_TRUE 0 0 0.000000 1.000000 ECU_ADDRESS 0xFDC0 BIT_MASK 0x2 /end MEASUREMENT
/begin MEASUREMENT B_MDSOV " Segmentzeit > FFFFh" UWORD B_TRUE 0 0 0.000000 1.000000 ECU_ADDRESS 0xFDBA BIT_MASK 0x1 /end MEASUREMENT
/begin MEASUREMENT B_MDTL " Lastgrenze unterschritten" UWORD B_TRUE 0 0 0.000000 1.000000 ECU_ADDRESS 0xFDC0 BIT_MASK 0x4 /end MEASUREMENT
/begin MEASUREMENT B_MDTNST " Segmentzeit unterschritten" UWORD B_TRUE 0 0 0.000000 1.000000 ECU_ADDRESS 0xFDC0 BIT_MASK 0x8 /end MEASUREMENT
/begin MEASUREMENT B_MIL " MIL-Ansteuerung" UWORD B_TRUE 0 0 0.000000 1.000000 ECU_ADDRESS 0xFDD6 BIT_MASK 0x2 /end MEASUREMENT
/begin MEASUREMENT B_MILBLK " MIL-Ansteuerung blinkend" UBYTE B_TRUE 0 0 0.000000 1.000000 ECU_ADDRESS 0xB0FA1 BIT_MASK 0x8 /end MEASUREMENT
/begin MEASUREMENT B_MILEB " MIL-Ansteuerung eigenbestimmt" UBYTE B_TRUE 0 0 0.000000 1.000000 ECU_ADDRESS 0xB0FA1 BIT_MASK 0x2 /end MEASUREMENT
/begin MEASUREMENT B_MILFB " MIL-Ansteuerung fremdbestimmt durch externes SG" UWORD B_TRUE 0 0 0.000000 1.000000 ECU_ADDRESS 0xFDD6 BIT_MASK 0x40 /end MEASUREMENT
/begin MEASUREMENT B_MILMD " MIL-Ansteuerung an durch Aussetzererkennung, bei ti-Abschaltung" UWORD B_TRUE 0 0 0.000000 1.000000 ECU_ADDRESS 0xFDD6 BIT_MASK 0x400 /end MEASUREMENT
/begin MEASUREMENT B_MILST " MIL-Ansteuerung Prueffunktion bei Start" UBYTE B_TRUE 0 0 0.000000 1.000000 ECU_ADDRESS 0xB0FA1 BIT_MASK 0x1 /end MEASUREMENT
/begin MEASUREMENT B_MILSTAT " MIL-Status fuer Scan-Tool Mode 1 PID$01" UBYTE B_TRUE 0 0 0.000000 1.000000 ECU_ADDRESS 0xB0FA1 BIT_MASK 0x40 /end MEASUREMENT
/begin MEASUREMENT B_MNMD " abgasrel. Aussetzer Fehler" UWORD B_TRUE 0 0 0.000000 1.000000 ECU_ADDRESS 0xFD84 BIT_MASK 0x40 /end MEASUREMENT
/begin MEASUREMENT B_MXMD " katschaedigender Aussetzer Fehler" UWORD B_TRUE 0 0 0.000000 1.000000 ECU_ADDRESS 0xFD84 BIT_MASK 0x100 /end MEASUREMENT
/begin MEASUREMENT B_NMAX " 1 = Maximaldrehzahl ueberschritten" UWORD B_TRUE 0 0 0.000000 1.000000 ECU_ADDRESS 0xFD04 BIT_MASK 0x200 /end MEASUREMENT
/begin MEASUREMENT B_NMIN " 1 = Minimaldrehzahl unterschritten" UWORD B_TRUE 0 0 0.000000 1.000000 ECU_ADDRESS 0xFD04 BIT_MASK 0x100 /end MEASUREMENT
/begin MEASUREMENT B_NMOT " Bedingung Motordrehzahl: n > NMIN" UWORD B_TRUE 0 0 0.000000 1.000000 ECU_ADDRESS 0xFDD6 BIT_MASK 0x10 /end MEASUREMENT
/begin MEASUREMENT B_NO " unendlich-Trigger fuer Fehlerpfadmanagement" UBYTE B_TRUE 0 0 0.000000 1.000000 ECU_ADDRESS 0xB2258 BIT_MASK 0x1 /end MEASUREMENT
/begin MEASUREMENT B_NOFLR " Ausloesung Drive-Recorder Messung " UWORD B_TRUE 0 0 0.000000 1.000000 ECU_ADDRESS 0xFD92 BIT_MASK 0x4 /end MEASUREMENT
/begin MEASUREMENT B_NOTL " 1 = Notluftfahren" UWORD B_TRUE 0 0 0.000000 1.000000 ECU_ADDRESS 0xFD04 BIT_MASK 0x800 /end MEASUREMENT
/begin MEASUREMENT B_NOTLU_FR "Notluftfahren vom FR" UWORD B_TRUE 0 0 0.000000 1.000000 ECU_ADDRESS 0xFD6A BIT_MASK 0x4 /end MEASUREMENT
/begin MEASUREMENT B_NOWUC " Bedingung 'kein warm up cycle' erkannt" UWORD B_TRUE 0 0 0.000000 1.000000 ECU_ADDRESS 0xFDD6 BIT_MASK 0x4 /end MEASUREMENT
/begin MEASUREMENT B_NO_TM_FR " Fahren ohne Tempomat - Betrieb" UWORD B_TRUE 0 0 0.000000 1.000000 ECU_ADDRESS 0xFD6A BIT_MASK 0x800 /end MEASUREMENT
/begin MEASUREMENT B_NPMD " abgasrel. Aussetzer Fehler im 1. Intervall" UWORD B_TRUE 0 0 0.000000 1.000000 ECU_ADDRESS 0xFD84 BIT_MASK 0x80 /end MEASUREMENT
/begin MEASUREMENT B_NSP " 1 = UKSEFI erlaubt Nachspritzer im CIFI" UWORD B_DEZ 0 0 0.000000 1.000000 ECU_ADDRESS 0xFD2A BIT_MASK 0x20 /end MEASUREMENT
/begin MEASUREMENT B_NWS " 1 = Kennfeldumschaltung bei NWS ein" UWORD B_TRUE 0 0 0.000000 1.000000 ECU_ADDRESS 0xFD06 BIT_MASK 0x200 /end MEASUREMENT
/begin MEASUREMENT B_PHEA " 1 = Abschaltung der EV's aufgrund Falschsynchronisation" UWORD B_TRUE 0 0 0.000000 1.000000 ECU_ADDRESS 0xFD64 BIT_MASK 0x8000 /end MEASUREMENT
/begin MEASUREMENT B_PHSOK " 1 = Phasensensor ok" UWORD B_TRUE 0 0 0.000000 1.000000 ECU_ADDRESS 0xFD2A BIT_MASK 0x2000 /end MEASUREMENT
/begin MEASUREMENT B_PLOK " Bedingung fuel-on Adaption plausibel" UWORD B_TRUE 0 0 0.000000 1.000000 ECU_ADDRESS 0xFDBA BIT_MASK 0x8000 /end MEASUREMENT
/begin MEASUREMENT B_PLOK01 " Bedingung fuel-on Adaption plausibel Drehzahlbereich 01" UBYTE B_TRUE 0 0 0.000000 1.000000 ECU_ADDRESS 0xB25BF BIT_MASK 0x1 /end MEASUREMENT
/begin MEASUREMENT B_PLOK02 " Bedingung fuel-on Adaption plausibel Drehzahlbereich 02" UBYTE B_TRUE 0 0 0.000000 1.000000 ECU_ADDRESS 0xB25BF BIT_MASK 0x2 /end MEASUREMENT
/begin MEASUREMENT B_PLOK03 " Bedingung fuel-on Adaption plausibel Drehzahlbereich 03" UBYTE B_TRUE 0 0 0.000000 1.000000 ECU_ADDRESS 0xB25BF BIT_MASK 0x4 /end MEASUREMENT
/begin MEASUREMENT B_PLOK04 " Bedingung fuel-on Adaption plausibel Drehzahlbereich 04" UBYTE B_TRUE 0 0 0.000000 1.000000 ECU_ADDRESS 0xB25BF BIT_MASK 0x8 /end MEASUREMENT
/begin MEASUREMENT B_PLOK05 " Bedingung fuel-on Adaption plausibel Drehzahlbereich 05" UBYTE B_TRUE 0 0 0.000000 1.000000 ECU_ADDRESS 0xB25BF BIT_MASK 0x10 /end MEASUREMENT
/begin MEASUREMENT B_PLOK06 " Bedingung fuel-on Adaption plausibel Drehzahlbereich 06" UBYTE B_TRUE 0 0 0.000000 1.000000 ECU_ADDRESS 0xB25BF BIT_MASK 0x20 /end MEASUREMENT
/begin MEASUREMENT B_PLOKN " Bedingung fuel-on Adaption im akt. n-Bereich plausibel" UWORD B_TRUE 0 0 0.000000 1.000000 ECU_ADDRESS 0xFDBA BIT_MASK 0x2000 /end MEASUREMENT
/begin MEASUREMENT B_PN " 1 = Getriebe auf P oder N" UWORD B_TRUE 0 0 0.000000 1.000000 ECU_ADDRESS 0xFD06 BIT_MASK 0x4 /end MEASUREMENT
/begin MEASUREMENT B_PRIPH " Bed. Port schalten fuer Pumpimpuls hinter Kat Bank 1" UWORD B_TRUE 0 0 0.000000 1.000000 ECU_ADDRESS 0xFD52 BIT_MASK 0x2000 /end MEASUREMENT
/begin MEASUREMENT B_PRIPH2 " Bed. Port schalten fuer Pumpimpuls hinter Kat Bank 2" UWORD B_TRUE 0 0 0.000000 1.000000 ECU_ADDRESS 0xFD52 BIT_MASK 0x4000 /end MEASUREMENT
/begin MEASUREMENT B_PRIPV " Bed. Port schalten fuer Pumpimpuls vor Kat Bank 1" UWORD B_TRUE 0 0 0.000000 1.000000 ECU_ADDRESS 0xFD52 BIT_MASK 0x800 /end MEASUREMENT
/begin MEASUREMENT B_PRIPV2 " Bed. Port schalten fuer Pumpimpuls vor Kat Bank 2" UWORD B_TRUE 0 0 0.000000 1.000000 ECU_ADDRESS 0xFD52 BIT_MASK 0x1000 /end MEASUREMENT
/begin MEASUREMENT B_RGE " Rueckwaertsgang eingelegt" UWORD B_TRUE 0 0 0.000000 1.000000 ECU_ADDRESS 0xFD72 BIT_MASK 0x4000 /end MEASUREMENT
/begin MEASUREMENT B_RIAKV " Bed. fuer Strompumpen aktualisiert vor Kat Bank 1" UBYTE B_TRUE 0 0 0.000000 1.000000 ECU_ADDRESS 0xB1012 BIT_MASK 0x1 /end MEASUREMENT
/begin MEASUREMENT B_RIAKV2 " Bed. fuer Strompumpen aktualisiert vor Kat Bank 2" UBYTE B_TRUE 0 0 0.000000 1.000000 ECU_ADDRESS 0xB1013 BIT_MASK 0x1 /end MEASUREMENT
/begin MEASUREMENT B_RIBEH " Bed. Ri berechnen hinter Kat Bank 1" UBYTE B_TRUE 0 0 0.000000 1.000000 ECU_ADDRESS 0xB1014 BIT_MASK 0x2 /end MEASUREMENT
/begin MEASUREMENT B_RIBEH2 " Bed. Ri berechnen hinter Kat Bank 2" UBYTE B_TRUE 0 0 0.000000 1.000000 ECU_ADDRESS 0xB1015 BIT_MASK 0x2 /end MEASUREMENT
/begin MEASUREMENT B_RIBEV " Bed. Ri berechnen vor Kat Bank 1" UBYTE B_TRUE 0 0 0.000000 1.000000 ECU_ADDRESS 0xB1012 BIT_MASK 0x2 /end MEASUREMENT
/begin MEASUREMENT B_RIBEV2 " Bed. Ri berechnen vor Kat Bank 2" UBYTE B_TRUE 0 0 0.000000 1.000000 ECU_ADDRESS 0xB1013 BIT_MASK 0x2 /end MEASUREMENT
/begin MEASUREMENT B_RIIBV " Bed. Sondenspannung im zul. Band fuer Strompumpen vor Kat Bank 1" UBYTE B_TRUE 0 0 0.000000 1.000000 ECU_ADDRESS 0xB1012 BIT_MASK 0x4 /end MEASUREMENT
/begin MEASUREMENT B_RIIBV2 " Bed. Sondenspannung im zul. Band fuer Strompumpen vor Kat Bank 2" UBYTE B_TRUE 0 0 0.000000 1.000000 ECU_ADDRESS 0xB1013 BIT_MASK 0x4 /end MEASUREMENT
/begin MEASUREMENT B_RIIMPH " Bedingung fuer Strompumpen hinter Kat" UWORD B_TRUE 0 0 0.000000 1.000000 ECU_ADDRESS 0xFD54 BIT_MASK 0x20 /end MEASUREMENT
/begin MEASUREMENT B_RIIMPV " Bedingung fuer Strompumpen vor Kat" UWORD B_TRUE 0 0 0.000000 1.000000 ECU_ADDRESS 0xFD54 BIT_MASK 0x10 /end MEASUREMENT
/begin MEASUREMENT B_RIMH " Bed. fuer Messen belastete Sondenspannung hinter Kat Bank 1" UBYTE B_TRUE 0 0 0.000000 1.000000 ECU_ADDRESS 0xB1014 BIT_MASK 0x40 /end MEASUREMENT
/begin MEASUREMENT B_RIMH2 " Bed. fuer Messen belastete Sondenspannung hinter Kat Bank 2" UBYTE B_TRUE 0 0 0.000000 1.000000 ECU_ADDRESS 0xB1015 BIT_MASK 0x40 /end MEASUREMENT
/begin MEASUREMENT B_RIMV " Bed. fuer Messen belastete Sondenspannung vor Kat Bank 1" UBYTE B_TRUE 0 0 0.000000 1.000000 ECU_ADDRESS 0xB1012 BIT_MASK 0x40 /end MEASUREMENT
/begin MEASUREMENT B_RIMV2 " Bed. fuer Messen belastete Sondenspannung vor Kat Bank 2" UBYTE B_TRUE 0 0 0.000000 1.000000 ECU_ADDRESS 0xB1013 BIT_MASK 0x40 /end MEASUREMENT
/begin MEASUREMENT B_RINH " Bed. Innenwiderstand Ri-Messung der Nernstsonde aktiv hinter Kat" UWORD B_TRUE 0 0 0.000000 1.000000 ECU_ADDRESS 0xFD52 BIT_MASK 0x80 /end MEASUREMENT
/begin MEASUREMENT B_RINH2 " Bed. Innenwiderstand Ri-Messung der Nernstsonde aktiv hinter Kat Bank2" UWORD B_TRUE 0 0 0.000000 1.000000 ECU_ADDRESS 0xFD52 BIT_MASK 0x100 /end MEASUREMENT
/begin MEASUREMENT B_RINV " Bed. Innenwiderstand Ri-Messung der Nernstsonde aktiv vor Kat" UWORD B_TRUE 0 0 0.000000 1.000000 ECU_ADDRESS 0xFD52 BIT_MASK 0x20 /end MEASUREMENT
/begin MEASUREMENT B_RINV2 " Bed. Innenwiderstand Ri-Messung der Nernstsonde aktiv vor Kat Bank2" UWORD B_TRUE 0 0 0.000000 1.000000 ECU_ADDRESS 0xFD52 BIT_MASK 0x40 /end MEASUREMENT
/begin MEASUREMENT B_RIPUH " Bed. Strompumpen hinter Kat Bank 1" UBYTE B_TRUE 0 0 0.000000 1.000000 ECU_ADDRESS 0xB1014 BIT_MASK 0x8 /end MEASUREMENT
/begin MEASUREMENT B_RIPUH2 " Bed. Strompumpen hinter Kat Bank 2" UBYTE B_TRUE 0 0 0.000000 1.000000 ECU_ADDRESS 0xB1015 BIT_MASK 0x8 /end MEASUREMENT
/begin MEASUREMENT B_RIPUV " Bed. Strompumpen vor Kat Bank 1" UBYTE B_TRUE 0 0 0.000000 1.000000 ECU_ADDRESS 0xB1012 BIT_MASK 0x8 /end MEASUREMENT
/begin MEASUREMENT B_RIPUV2 " Bed. Strompumpen vor Kat Bank 2" UBYTE B_TRUE 0 0 0.000000 1.000000 ECU_ADDRESS 0xB1013 BIT_MASK 0x8 /end MEASUREMENT
/begin MEASUREMENT B_RIREH "Bedingung Ri Resultat hinter Kat Bank 1" UBYTE B_TRUE 0 0 0.000000 1.000000 ECU_ADDRESS 0xB1020 BIT_MASK 0x40 /end MEASUREMENT
/begin MEASUREMENT B_RIREH2 "Bedingung Ri Resultat hinter Kat Bank 2" UBYTE B_TRUE 0 0 0.000000 1.000000 ECU_ADDRESS 0xB1021 BIT_MASK 0x40 /end MEASUREMENT
/begin MEASUREMENT B_RIREV "Bedingung Ri Resultat vor Kat Bank 1" UBYTE B_TRUE 0 0 0.000000 1.000000 ECU_ADDRESS 0xB101E BIT_MASK 0x40 /end MEASUREMENT
/begin MEASUREMENT B_RIREV2 "Bedingung Ri Resultat vor Kat Bank 2" UBYTE B_TRUE 0 0 0.000000 1.000000 ECU_ADDRESS 0xB101F BIT_MASK 0x40 /end MEASUREMENT
/begin MEASUREMENT B_SA " Schubabschaltung" UWORD B_TRUE 0 0 0.000000 1.000000 ECU_ADDRESS 0xFD08 BIT_MASK 0x8 /end MEASUREMENT
/begin MEASUREMENT B_SELESP " Bedingung Selespeedvariante" UWORD B_TRUE 0 0 0.000000 1.000000 ECU_ADDRESS 0xFD14 BIT_MASK 0x4 /end MEASUREMENT
/begin MEASUREMENT B_SHUERF " Bed. Ri-Messung aktiv hinter Kat Bank 1" UWORD B_TRUE 0 0 0.000000 1.000000 ECU_ADDRESS 0xFD54 BIT_MASK 0x4 /end MEASUREMENT
/begin MEASUREMENT B_SHUERF2 " Bed. Ri-Messung aktiv hinter Kat Bank 2" UWORD B_TRUE 0 0 0.000000 1.000000 ECU_ADDRESS 0xFD54 BIT_MASK 0x8 /end MEASUREMENT
/begin MEASUREMENT B_SKA " 1 = Sicherheitskraftstoffabsch." UWORD B_TRUE 0 0 0.000000 1.000000 ECU_ADDRESS 0xFD08 BIT_MASK 0x10 /end MEASUREMENT
/begin MEASUREMENT B_SP1 " FLC-Trigger der Aussetzererkennung" UBYTE B_TRUE 0 0 0.000000 1.000000 ECU_ADDRESS 0xB0FBF BIT_MASK 0x1 /end MEASUREMENT
/begin MEASUREMENT B_SP2 " HLC-Trigger der Aussetzererkennung" UBYTE B_TRUE 0 0 0.000000 1.000000 ECU_ADDRESS 0xB0FC0 BIT_MASK 0x1 /end MEASUREMENT
/begin MEASUREMENT B_SP3 " Spezial-Bereichs-Trigger der Diagnose Kraftstoffversorgungssystem" UBYTE B_TRUE 0 0 0.000000 1.000000 ECU_ADDRESS 0xB2257 BIT_MASK 0x1 /end MEASUREMENT
/begin MEASUREMENT B_START " 1 = Start aktiv" UWORD B_TRUE 0 0 0.000000 1.000000 ECU_ADDRESS 0xFD04 BIT_MASK 0x2 /end MEASUREMENT
/begin MEASUREMENT B_STEND " 1 = Startende erkannt" UWORD B_TRUE 0 0 0.000000 1.000000 ECU_ADDRESS 0xFD04 BIT_MASK 0x4 /end MEASUREMENT
/begin MEASUREMENT B_STZ " 1 = Pruefzeit nach Startende abgelaufen DEMS (DDVE, DPWG)" UWORD B_TRUE 0 0 0.000000 1.000000 ECU_ADDRESS 0xFD68 BIT_MASK 0x10 /end MEASUREMENT
/begin MEASUREMENT B_SVUERF " Bed. Ri-Messung aktiv vor Kat Bank 1" UWORD B_TRUE 0 0 0.000000 1.000000 ECU_ADDRESS 0xFD54 BIT_MASK 0x1 /end MEASUREMENT
/begin MEASUREMENT B_SVUERF2 " Bed. Ri-Messung aktiv vor Kat Bank 2" UWORD B_TRUE 0 0 0.000000 1.000000 ECU_ADDRESS 0xFD54 BIT_MASK 0x2 /end MEASUREMENT
/begin MEASUREMENT B_SWE " 1 = Verbot der DASE durch Schlechtwegerkennung" UWORD B_TRUE 0 0 0.000000 1.000000 ECU_ADDRESS 0xFDBC BIT_MASK 0x1 /end MEASUREMENT
/begin MEASUREMENT B_SWEV " Ausloesung Drive-Recorder Messung " UWORD B_TRUE 0 0 0.000000 1.000000 ECU_ADDRESS 0xFD7E BIT_MASK 0x80 /end MEASUREMENT
/begin MEASUREMENT B_TAL " Tank leer" UWORD B_TRUE 0 0 0.000000 1.000000 ECU_ADDRESS 0xFD7E BIT_MASK 0x800 /end MEASUREMENT
/begin MEASUREMENT B_TALVAL " Tankfuellstand ist ausgewertet" UWORD B_TRUE 0 0 0.000000 1.000000 ECU_ADDRESS 0xFD7E BIT_MASK 0x1000 /end MEASUREMENT
/begin MEASUREMENT B_TEHB " hohe Beladung" UWORD B_TRUE 0 0 0.000000 1.000000 ECU_ADDRESS 0xFD50 BIT_MASK 0x800 /end MEASUREMENT
/begin MEASUREMENT B_TEMIN " 1 = Minimale Einspritzzeit für Abschaltung LR erkannt." UWORD B_TRUE 0 0 0.000000 1.000000 ECU_ADDRESS 0xFD2E BIT_MASK 0x8000 /end MEASUREMENT
/begin MEASUREMENT B_TEVEP " 1= Endstufe-Ansteuerung TEV erfolgt" UWORD B_TRUE 0 0 0.000000 1.000000 ECU_ADDRESS 0xFD90 BIT_MASK 0x4 /end MEASUREMENT
/begin MEASUREMENT B_TIM " Zeit-Trigger fuer Fehlerpfadmanagement" UBYTE B_TRUE 0 0 0.000000 1.000000 ECU_ADDRESS 0xB0F9C BIT_MASK 0x1 /end MEASUREMENT
/begin MEASUREMENT B_TM_EIN " 1 = Fahrgesch.regelung aktiv" UWORD B_TRUE 0 0 0.000000 1.000000 ECU_ADDRESS 0xFD0A BIT_MASK 0x1 /end MEASUREMENT
/begin MEASUREMENT B_TTBMH2 " Theoretische Sondenbetriebsbereitschaft mit Heizung vK" UWORD B_TRUE 0 0 0.000000 1.000000 ECU_ADDRESS 0xFD38 BIT_MASK 0x20 /end MEASUREMENT
/begin MEASUREMENT B_TTBMHH " theoretische Sondenbereitschaft hinter Kat mit Heizung" UWORD B_TRUE 0 0 0.000000 1.000000 ECU_ADDRESS 0xFD30 BIT_MASK 0x4000 /end MEASUREMENT
/begin MEASUREMENT B_TTBMHH2 " ohne Worte" UWORD B_TRUE 0 0 0.000000 1.000000 ECU_ADDRESS 0xFD54 BIT_MASK 0x400 /end MEASUREMENT
/begin MEASUREMENT B_UB_OK "1 = Batteriespannung ok" UWORD B_TRUE 0 0 0.000000 1.000000 ECU_ADDRESS 0xFD0E BIT_MASK 0x2000 /end MEASUREMENT
/begin MEASUREMENT B_URSTA " 1 = Urstart bzw. Powerfail erkannt" UWORD B_TRUE 0 0 0.000000 1.000000 ECU_ADDRESS 0xFD04 BIT_MASK 0x4000 /end MEASUREMENT
/begin MEASUREMENT B_USBEV " Bed. fuer Zeitzaehler zur Ausblendung der Sondenbelastung vor Kat B 1" UBYTE B_TRUE 0 0 0.000000 1.000000 ECU_ADDRESS 0xB1012 BIT_MASK 0x20 /end MEASUREMENT
/begin MEASUREMENT B_USBEV2 " Bed. fuer Zeitzaehler zur Ausblendung der Sondenbelastung vor Kat B 2" UBYTE B_TRUE 0 0 0.000000 1.000000 ECU_ADDRESS 0xB1013 BIT_MASK 0x20 /end MEASUREMENT
/begin MEASUREMENT B_VFEHL " Fehler beim Geschw. Signal" UWORD B_TRUE 0 0 0.000000 1.000000 ECU_ADDRESS 0xFD10 BIT_MASK 0x200 /end MEASUREMENT
/begin MEASUREMENT B_VL "1 = Vollast" UWORD B_TRUE 0 0 0.000000 1.000000 ECU_ADDRESS 0xFD06 BIT_MASK 0x2 /end MEASUREMENT
/begin MEASUREMENT B_VNULL " Fahrzeug steht" UWORD B_TRUE 0 0 0.000000 1.000000 ECU_ADDRESS 0xFD10 BIT_MASK 0x400 /end MEASUREMENT
/begin MEASUREMENT B_VROHB " Rohgeschwindigkeit in Begrenzung" UWORD B_TRUE 0 0 0.000000 1.000000 ECU_ADDRESS 0xFD12 BIT_MASK 0x8000 /end MEASUREMENT
/begin MEASUREMENT B_WARNL " Warnlampe ein durch WFS-Recovery" UWORD B_TRUE 0 0 0.000000 1.000000 ECU_ADDRESS 0xFDD4 BIT_MASK 0x4 /end MEASUREMENT
/begin MEASUREMENT B_WE " 1 = Wiedereinsetzen aktiv" UWORD B_TRUE 0 0 0.000000 1.000000 ECU_ADDRESS 0xFD0C BIT_MASK 0x8 /end MEASUREMENT
/begin MEASUREMENT B_WEH "1 = Hartes Wiedereinsetzen" UWORD B_TRUE 0 0 0.000000 1.000000 ECU_ADDRESS 0xFD0C BIT_MASK 0x10 /end MEASUREMENT
/begin MEASUREMENT B_WK " Wandlerkupplung ueberbrueckt ???" UWORD B_TRUE 0 0 0.000000 1.000000 ECU_ADDRESS 0xFDBE BIT_MASK 0x800 /end MEASUREMENT
/begin MEASUREMENT B_WKR " Wandlerkupplung geregelt ???" UWORD B_TRUE 0 0 0.000000 1.000000 ECU_ADDRESS 0xFDBE BIT_MASK 0x1000 /end MEASUREMENT
/begin MEASUREMENT B_WLCNTR " Warnlame wird durch WFS-Recovery kontrolliert" UWORD B_TRUE 0 0 0.000000 1.000000 ECU_ADDRESS 0xFDD4 BIT_MASK 0x8 /end MEASUREMENT
/begin MEASUREMENT B_WUC " Bedingung 'warm up cycle' erkannt" UBYTE B_TRUE 0 0 0.000000 1.000000 ECU_ADDRESS 0xB0F9E BIT_MASK 0x1 /end MEASUREMENT
/begin MEASUREMENT EGS_ANF "> Anfahren v. Getriebe (DriveOff)" UWORD B_TRUE 0 0 0.000000 1.000000 ECU_ADDRESS 0xFD64 BIT_MASK 0x1000 /end MEASUREMENT
/begin MEASUREMENT EGS_AUT "Getriebe im Automatik Modus" UWORD B_TRUE 0 0 0.000000 1.000000 ECU_ADDRESS 0xFD0A BIT_MASK 0x2000 /end MEASUREMENT
/begin MEASUREMENT EI_ADCC_UM " Fehler-Bit AD-Wandler Test(UM)" UWORD B_TRUE 0 0 0.000000 1.000000 ECU_ADDRESS 0xFDF0 BIT_MASK 0x100 /end MEASUREMENT
/begin MEASUREMENT EI_IPA_UM " Fehler-Bit Lastsignalueberw. DK-Potis (UM)" UWORD B_TRUE 0 0 0.000000 1.000000 ECU_ADDRESS 0xFDF0 BIT_MASK 0x40 /end MEASUREMENT
/begin MEASUREMENT EI_MVER_UM " Fehler-Bit Momentenvergleich (UM)" UWORD B_TRUE 0 0 0.000000 1.000000 ECU_ADDRESS 0xFDF0 BIT_MASK 0x10 /end MEASUREMENT
/begin MEASUREMENT EI_NC_UM " Fehler-Bit Drehzahlueberwachung (UM)" UWORD B_TRUE 0 0 0.000000 1.000000 ECU_ADDRESS 0xFDF0 BIT_MASK 0x1 /end MEASUREMENT
/begin MEASUREMENT EI_REAC_UM " Fehler-Bit aus Fehlerreaktionsuebernahme (UM)" UWORD B_TRUE 0 0 0.000000 1.000000 ECU_ADDRESS 0xFDF0 BIT_MASK 0x20 /end MEASUREMENT
/begin MEASUREMENT EI_S12_FR " = 1 : SP1S zu SP2S unplausibel" UWORD B_TRUE 0 0 0.000000 1.000000 ECU_ADDRESS 0xFDA4 BIT_MASK 0x80 /end MEASUREMENT
/begin MEASUREMENT EI_S1MN_FR " = 1 : SP1S-Bereichsunterschreitung bei SP1S zu SP2S unpl." UWORD B_TRUE 0 0 0.000000 1.000000 ECU_ADDRESS 0xFDA4 BIT_MASK 0x20 /end MEASUREMENT
/begin MEASUREMENT EI_S1MX_FR " = 1 : SP1S-Bereichsueberschreitung" UWORD B_TRUE 0 0 0.000000 1.000000 ECU_ADDRESS 0xFDA4 BIT_MASK 0x2 /end MEASUREMENT
/begin MEASUREMENT EI_S2MN_FR " = 1 : SP2S-Bereichsunterschreitung bei SP1S zu SP2S unpl." UWORD B_TRUE 0 0 0.000000 1.000000 ECU_ADDRESS 0xFDA4 BIT_MASK 0x40 /end MEASUREMENT
/begin MEASUREMENT EI_S2MX_FR " = 1 : SP2S-Bereichsueberschreitung" UWORD B_TRUE 0 0 0.000000 1.000000 ECU_ADDRESS 0xFDA4 BIT_MASK 0x8 /end MEASUREMENT
/begin MEASUREMENT EI_SPSC_UM " Fehler-Bit Pedalsollwertpruefung (UM)" UWORD B_TRUE 0 0 0.000000 1.000000 ECU_ADDRESS 0xFDF0 BIT_MASK 0x2 /end MEASUREMENT
/begin MEASUREMENT EI_TLIP_UM " Fehler-Bit Lastsignalueberwachung aus DK (UM)" UWORD B_TRUE 0 0 0.000000 1.000000 ECU_ADDRESS 0xFDF0 BIT_MASK 0x8 /end MEASUREMENT
/begin MEASUREMENT EI_TL_UM " Fehler-Bit Lastsignalueberwachung aus Fktn. (UM)" UWORD B_TRUE 0 0 0.000000 1.000000 ECU_ADDRESS 0xFDF0 BIT_MASK 0x4 /end MEASUREMENT
/begin MEASUREMENT EI_ZWC_UM " Fehler-Bit Zuendwinkelueberwachung (UM)" UWORD B_TRUE 0 0 0.000000 1.000000 ECU_ADDRESS 0xFDF0 BIT_MASK 0x80 /end MEASUREMENT
/begin MEASUREMENT E_BM " 1 = Fehler Drehzahlgeber" UBYTE B_TRUE 0 0 0.000000 1.000000 ECU_ADDRESS 0xFDE6 BIT_MASK 0x20 /end MEASUREMENT
/begin MEASUREMENT E_CEGS " CAN-Fehler: EGS Kommunikation" UBYTE B_TRUE 0 0 0.000000 1.000000 ECU_ADDRESS 0xFDEA BIT_MASK 0x8 /end MEASUREMENT
/begin MEASUREMENT E_EV " 1 = Fehler Einspritzventile" UWORD B_TRUE 0 0 0.000000 1.000000 ECU_ADDRESS 0xFD66 BIT_MASK 0x20 /end MEASUREMENT
/begin MEASUREMENT E_EV1 " 1 = Fehler Einspritzventil 1" UBYTE B_TRUE 0 0 0.000000 1.000000 ECU_ADDRESS 0xFDE8 BIT_MASK 0x40 /end MEASUREMENT
/begin MEASUREMENT E_EV2 " 1 = Fehler Einspritzventil 2" UBYTE B_TRUE 0 0 0.000000 1.000000 ECU_ADDRESS 0xFDE8 BIT_MASK 0x80 /end MEASUREMENT
/begin MEASUREMENT E_EV3 " 1 = Fehler Einspritzventil 3" UBYTE B_TRUE 0 0 0.000000 1.000000 ECU_ADDRESS 0xFDE9 BIT_MASK 0x1 /end MEASUREMENT
/begin MEASUREMENT E_EV4 " 1 = Fehler Einspritzventil 4" UBYTE B_TRUE 0 0 0.000000 1.000000 ECU_ADDRESS 0xFDE9 BIT_MASK 0x2 /end MEASUREMENT
/begin MEASUREMENT E_EV5 " 1 = Fehler Einspritzventil 5" UBYTE B_TRUE 0 0 0.000000 1.000000 ECU_ADDRESS 0xFDE9 BIT_MASK 0x4 /end MEASUREMENT
/begin MEASUREMENT E_MD " Aussetzererkennung, Summe, abgasrelevant" UBYTE B_TRUE 0 0 0.000000 1.000000 ECU_ADDRESS 0xFDEA BIT_MASK 0x10 /end MEASUREMENT
/begin MEASUREMENT E_NWSE " 1 = Endstufenfehler Nockenwellensteuerung" UBYTE B_TRUE 0 0 0.000000 1.000000 ECU_ADDRESS 0xFDEA BIT_MASK 0x1 /end MEASUREMENT
/begin MEASUREMENT E_PEDST " 1 = Fehler Pedalanschlag" UBYTE B_TRUE 0 0 0.000000 1.000000 ECU_ADDRESS 0xFDE7 BIT_MASK 0x10 /end MEASUREMENT
/begin MEASUREMENT E_PH " Phasenfehler" UBYTE B_TRUE 0 0 0.000000 1.000000 ECU_ADDRESS 0xFDE6 BIT_MASK 0x40 /end MEASUREMENT
/begin MEASUREMENT E_PWG " 1 = Fehler PWG" UBYTE B_TRUE 0 0 0.000000 1.000000 ECU_ADDRESS 0xFDE7 BIT_MASK 0x8 /end MEASUREMENT
/begin MEASUREMENT E_SUE " 1 = Endstufenfehler Saugrohrumschaltung" UBYTE B_TRUE 0 0 0.000000 1.000000 ECU_ADDRESS 0xFDE9 BIT_MASK 0x80 /end MEASUREMENT
/begin MEASUREMENT E_SWE " 1 = Fehler Schlechtwegerkennung" UBYTE B_TRUE 0 0 0.000000 1.000000 ECU_ADDRESS 0xFDED BIT_MASK 0x4 /end MEASUREMENT
/begin MEASUREMENT E_TA " 1 = Fehler Ansauglufttemperaturfuehler" UBYTE B_TRUE 0 0 0.000000 1.000000 ECU_ADDRESS 0xFDE6 BIT_MASK 0x8 /end MEASUREMENT
/begin MEASUREMENT E_TEVE " 1 = Fehler TEV-Endstufe" UBYTE B_TRUE 0 0 0.000000 1.000000 ECU_ADDRESS 0xFDE9 BIT_MASK 0x8 /end MEASUREMENT
/begin MEASUREMENT E_TM " 1 = Fehler Kuehlmitteltemperaturfuehler" UBYTE B_TRUE 0 0 0.000000 1.000000 ECU_ADDRESS 0xFDE6 BIT_MASK 0x4 /end MEASUREMENT
/begin MEASUREMENT E_UB " 1 = Ubatt fehlerhaft" UBYTE B_TRUE 0 0 0.000000 1.000000 ECU_ADDRESS 0xFDE6 BIT_MASK 0x80 /end MEASUREMENT
/begin MEASUREMENT E_VFZ " 1 = V-Signal fehlerhaft" UBYTE B_TRUE 0 0 0.000000 1.000000 ECU_ADDRESS 0xFDE6 BIT_MASK 0x10 /end MEASUREMENT
/begin MEASUREMENT E_VTSK " Fehler Tempomat-Bedienhebel" UBYTE B_TRUE 0 0 0.000000 1.000000 ECU_ADDRESS 0xFDEC BIT_MASK 0x8 /end MEASUREMENT
/begin MEASUREMENT E_V_CAN " 1= Fehler Geschwindigkeit" UWORD B_TRUE 0 0 0.000000 1.000000 ECU_ADDRESS 0xFD6E BIT_MASK 0x800 /end MEASUREMENT
/begin MEASUREMENT F_V1 " Fehlerbit in der CAN Geschw." UWORD B_TRUE 0 0 0.000000 1.000000 ECU_ADDRESS 0xFD10 BIT_MASK 0x1000 /end MEASUREMENT
/begin MEASUREMENT S_BL " 1 = Bremse betaetigt Bremslicht" UWORD B_TRUE 0 0 0.000000 1.000000 ECU_ADDRESS 0xFD0A BIT_MASK 0x4 /end MEASUREMENT
/begin MEASUREMENT S_BR " 1 = Bremse betaetigt Bremsschalter" UWORD B_TRUE 0 0 0.000000 1.000000 ECU_ADDRESS 0xFD0A BIT_MASK 0x2 /end MEASUREMENT
/begin MEASUREMENT S_FPC " 1 = EGAS Zustand Fahrprogramm City" UWORD B_TRUE 0 0 0.000000 1.000000 ECU_ADDRESS 0xFD9E BIT_MASK 0x200 /end MEASUREMENT
/begin MEASUREMENT S_KUP " 1 = Kupplungsschalter betaetigt (Handschalter)" UWORD B_TRUE 0 0 0.000000 1.000000 ECU_ADDRESS 0xFD02 BIT_MASK 0x40 /end MEASUREMENT
/begin MEASUREMENT S_LUES1 " Schalter Motorluefter Stufe 1" UWORD B_TRUE 0 0 0.000000 1.000000 ECU_ADDRESS 0xFD9C BIT_MASK 0x10 /end MEASUREMENT
/begin MEASUREMENT S_LUES2 " Schalter Motorluefter Stufe 2" UWORD B_TRUE 0 0 0.000000 1.000000 ECU_ADDRESS 0xFD9C BIT_MASK 0x20 /end MEASUREMENT
/begin MEASUREMENT S_POEL " Oeldruckschalter-Info (1 => Druck vorhanden)" UWORD B_TRUE 0 0 0.000000 1.000000 ECU_ADDRESS 0xFD8A BIT_MASK 0x4 /end MEASUREMENT
/begin MEASUREMENT S_SCHALT " 1 = EGS schaltet (CAN)" UWORD B_TRUE 0 0 0.000000 1.000000 ECU_ADDRESS 0xFD0A BIT_MASK 0x400 /end MEASUREMENT
/begin MEASUREMENT VC_FGR " 1 = Variante mit Tempomat" UWORD B_TRUE 0 0 0.000000 1.000000 ECU_ADDRESS 0xFDF4 BIT_MASK 0x4 /end MEASUREMENT
/begin FUNCTION _DMDFON "10.12.0"
 /begin REF_CHARACTERISTIC SLFOU SLFOON LURFOST KFCFO FS2FO FS1FO FLFO DFSERES DFSEFON CDFO ANWFOST ANWFOHE ALFO /end REF_CHARACTERISTIC
 /begin LOC_MEASUREMENT XS08 XS07 XS06 XS05 XS04 XS03 XS02 TS08 TS07 TS06 TS05 TS04 TS03 TS02 TS01 TSK08 TSK07 TSK06 TSK05 TSK04 TSK03 TSK02 TSK01 TSK_AP TS_AP LUNW IDXFOTL IDXFON IDXFO FS63_08 FS63_07 FS63_06 FS63_05 FS63_04 FS63_03 FS63_02 FS62_08 FS62_07 FS62_06 FS62_05 FS62_04 FS62_03 FS62_02 FS61_08 FS61_07 FS61_06 FS61_05 FS61_04 FS61_03 FS61_02 FS53_08 FS53_07 FS53_06 FS53_05 FS53_04 FS53_03 FS53_02 FS52_08 FS52_07 FS52_06 FS52_05 FS52_04 FS52_03 FS52_02 FS51_08 FS51_07 FS51_06 FS51_05 FS51_04 FS51_03 FS51_02 FS43_08 FS43_07 FS43_06 FS43_05 FS43_04 FS43_03 FS43_02 FS42_08 FS42_07 FS42_06 FS42_05 FS42_04 FS42_03 FS42_02 FS41_08 FS41_07 FS41_06 FS41_05 FS41_04 FS41_03 FS41_02 FS33_08 FS33_07 FS33_06 FS33_05 FS33_04 FS33_03 FS33_02 FS32_08 FS32_07 FS32_06 FS32_05 FS32_04 FS32_03 FS32_02 FS31_08 FS31_07 FS31_06 FS31_05 FS31_04 FS31_03 FS31_02 FS23_08 FS23_07 FS23_06 FS23_05 FS23_04 FS23_03 FS23_02 FS22_08 FS22_07 FS22_06 FS22_05 FS22_04 FS22_03 FS22_02 FS21_08 FS21_07 FS21_06 FS21_05 FS21_04 FS21_03 FS21_02 FS13_08 FS13_07 FS13_06 FS13_05 FS13_04 FS13_03 FS13_02 FS12_08 FS12_07 FS12_06 FS12_05 FS12_04 FS12_03 FS12_02 FS11_08 FS11_07 FS11_06 FS11_05 FS11_04 FS11_03 FS11_02 FSE63_08 FSE63_07 FSE63_06 FSE63_05 FSE63_04 FSE63_03 FSE63_02 FSE62_08 FSE62_07 FSE62_06 FSE62_05 FSE62_04 FSE62_03 FSE62_02 FSE61_08 FSE61_07 FSE61_06 FSE61_05 FSE61_04 FSE61_03 FSE61_02 FSE53_08 FSE53_07 FSE53_06 FSE53_05 FSE53_04 FSE53_03 FSE53_02 FSE52_08 FSE52_07 FSE52_06 FSE52_05 FSE52_04 FSE52_03 FSE52_02 FSE51_08 FSE51_07 FSE51_06 FSE51_05 FSE51_04 FSE51_03 FSE51_02 FSE43_08 FSE43_07 FSE43_06 FSE43_05 FSE43_04 FSE43_03 FSE43_02 FSE42_08 FSE42_07 FSE42_06 FSE42_05 FSE42_04 FSE42_03 FSE42_02 FSE41_08 FSE41_07 FSE41_06 FSE41_05 FSE41_04 FSE41_03 FSE41_02 FSE33_08 FSE33_07 FSE33_06 FSE33_05 FSE33_04 FSE33_03 FSE33_02 FSE32_08 FSE32_07 FSE32_06 FSE32_05 FSE32_04 FSE32_03 FSE32_02 FSE31_08 FSE31_07 FSE31_06 FSE31_05 FSE31_04 FSE31_03 FSE31_02 FSE23_08 FSE23_07 FSE23_06 FSE23_05 FSE23_04 FSE23_03 FSE23_02 FSE22_08 FSE22_07 FSE22_06 FSE22_05 FSE22_04 FSE22_03 FSE22_02 FSE21_08 FSE21_07 FSE21_06 FSE21_05 FSE21_04 FSE21_03 FSE21_02 FSE13_08 FSE13_07 FSE13_06 FSE13_05 FSE13_04 FSE13_03 FSE13_02 FSE12_08 FSE12_07 FSE12_06 FSE12_05 FSE12_04 FSE12_03 FSE12_02 FSE11_08 FSE11_07 FSE11_06 FSE11_05 FSE11_04 FSE11_03 FSE11_02 FSE FLP63_08 FLP63_07 FLP63_06 FLP63_05 FLP63_04 FLP63_03 FLP63_02 FLP62_08 FLP62_07 FLP62_06 FLP62_05 FLP62_04 FLP62_03 FLP62_02 FLP61_08 FLP61_07 FLP61_06 FLP61_05 FLP61_04 FLP61_03 FLP61_02 FLP53_08 FLP53_07 FLP53_06 FLP53_05 FLP53_04 FLP53_03 FLP53_02 FLP52_08 FLP52_07 FLP52_06 FLP52_05 FLP52_04 FLP52_03 FLP52_02 FLP51_08 FLP51_07 FLP51_06 FLP51_05 FLP51_04 FLP51_03 FLP51_02 FLP43_08 FLP43_07 FLP43_06 FLP43_05 FLP43_04 FLP43_03 FLP43_02 FLP42_08 FLP42_07 FLP42_06 FLP42_05 FLP42_04 FLP42_03 FLP42_02 FLP41_08 FLP41_07 FLP41_06 FLP41_05 FLP41_04 FLP41_03 FLP41_02 FLP33_08 FLP33_07 FLP33_06 FLP33_05 FLP33_04 FLP33_03 FLP33_02 FLP32_08 FLP32_07 FLP32_06 FLP32_05 FLP32_04 FLP32_03 FLP32_02 FLP31_08 FLP31_07 FLP31_06 FLP31_05 FLP31_04 FLP31_03 FLP31_02 FLP23_08 FLP23_07 FLP23_06 FLP23_05 FLP23_04 FLP23_03 FLP23_02 FLP22_08 FLP22_07 FLP22_06 FLP22_05 FLP22_04 FLP22_03 FLP22_02 FLP21_08 FLP21_07 FLP21_06 FLP21_05 FLP21_04 FLP21_03 FLP21_02 FLP13_08 FLP13_07 FLP13_06 FLP13_05 FLP13_04 FLP13_03 FLP13_02 FLP12_08 FLP12_07 FLP12_06 FLP12_05 FLP12_04 FLP12_03 FLP12_02 FLP11_08 FLP11_07 FLP11_06 FLP11_05 FLP11_04 FLP11_03 FLP11_02 FLN63_08 FLN63_07 FLN63_06 FLN63_05 FLN63_04 FLN63_03 FLN63_02 FLN62_08 FLN62_07 FLN62_06 FLN62_05 FLN62_04 FLN62_03 FLN62_02 FLN61_08 FLN61_07 FLN61_06 FLN61_05 FLN61_04 FLN61_03 FLN61_02 FLN53_08 FLN53_07 FLN53_06 FLN53_05 FLN53_04 FLN53_03 FLN53_02 FLN52_08 FLN52_07 FLN52_06 FLN52_05 FLN52_04 FLN52_03 FLN52_02 FLN51_08 FLN51_07 FLN51_06 FLN51_05 FLN51_04 FLN51_03 FLN51_02 FLN43_08 FLN43_07 FLN43_06 FLN43_05 FLN43_04 FLN43_03 FLN43_02 FLN42_08 FLN42_07 FLN42_06 FLN42_05 FLN42_04 FLN42_03 FLN42_02 FLN41_08 FLN41_07 FLN41_06 FLN41_05 FLN41_04 FLN41_03 FLN41_02 FLN33_08 FLN33_07 FLN33_06 FLN33_05 FLN33_04 FLN33_03 FLN33_02 FLN32_08 FLN32_07 FLN32_06 FLN32_05 FLN32_04 FLN32_03 FLN32_02 FLN31_08 FLN31_07 FLN31_06 FLN31_05 FLN31_04 FLN31_03 FLN31_02 FLN23_08 FLN23_07 FLN23_06 FLN23_05 FLN23_04 FLN23_03 FLN23_02 FLN22_08 FLN22_07 FLN22_06 FLN22_05 FLN22_04 FLN22_03 FLN22_02 FLN21_08 FLN21_07 FLN21_06 FLN21_05 FLN21_04 FLN21_03 FLN21_02 FLN13_08 FLN13_07 FLN13_06 FLN13_05 FLN13_04 FLN13_03 FLN13_02 FLN12_08 FLN12_07 FLN12_06 FLN12_05 FLN12_04 FLN12_03 FLN12_02 FLN11_08 FLN11_07 FLN11_06 FLN11_05 FLN11_04 FLN11_03 FLN11_02 FLMX FFPL1 EEPI_TL EEPI_N EEPFS02 EEPCDFON DFSE06 DFSE05 DFSE04 DFSE03 DFSE02 DFSE01 B_PLOK06 B_PLOK05 B_PLOK04 B_PLOK03 B_PLOK02 B_PLOK01 B_PLOKN B_PLOK B_MDSOV B_FOXFG B_FOS B_FOR63 B_FOR62 B_FOR61 B_FOR53 B_FOR52 B_FOR51 B_FOR43 B_FOR42 B_FOR41 B_FOR33 B_FOR32 B_FOR31 B_FOR23 B_FOR22 B_FOR21 B_FOR13 B_FOR12 B_FOR11 B_FORUN B_FORSET B_FORN06 B_FORN05 B_FORN04 B_FORN03 B_FORN02 B_FORN01 B_FORN B_FORDO B_FOR B_FONTM B_FON B_FOLUNW B_FOHOLD B_FOHE B_FOF B_FODO ANWFOS ANWFOH IDXFOB FOSTAT FFORN1 FFONN3 FFONN2 FFONN1 DFSEN DFSE B_FONDO ZYLVEK XS TL8 NIST B_MDERKF B_LUENA B_FONSTP B_FOFSTP B_DMDHI_AP /end LOC_MEASUREMENT
/end FUNCTION
/begin FUNCTION _DMDLAD "3.10.0" /begin LOC_MEASUREMENT B_MDERK B_CDMD /end LOC_MEASUREMENT /end FUNCTION
/begin FUNCTION _DMDLU "11.10.0"
 /begin REF_CHARACTERISTIC TNALUN NFLUV LURMIN3 LURMIN2 LURMIN1 LURKTM KFLURB2 KFLURB1 KFLURB KFFLURM KFAMALU FLUV2 FLUV1 FIMALU FIAMALU DMXRLU ANALUN /end REF_CHARACTERISTIC
 /begin LOC_MEASUREMENT FAMAL LUTS TMOT RL NMOT FOSTAT B_WKR B_WK B_LUSTOP B_CDMD /end LOC_MEASUREMENT
/end FUNCTION
/begin FUNCTION _DMDLUA "8.11.0" /begin REF_CHARACTERISTIC KFLUAR FLUTN DMXRFL /end REF_CHARACTERISTIC
 /begin LOC_MEASUREMENT LUAROFF LUARMN LUAR_AP FLUTS_AP FFLUTN LUAR FLUTS8 FLUTS7 FLUTS6 FLUTS5 FLUTS4 FLUTS3 FLUTS2 FLUTS1 TL8 NIST LUT8 LUT7 LUT6 LUT5 LUT4 LUT3 LUT2 LUT1 FDMD_AP B_LUSTOP B_DMDHI_AP /end LOC_MEASUREMENT
/end FUNCTION
/begin FUNCTION _DMDMIL "3.31.0"
 /begin REF_CHARACTERISTIC TMWUC TMASKIV1 MILANTI KFKSWF FASKIV1 CWDMDE CDTMD CDMD CDCMD AZYTIAB AINTKA AHEKS1 AHEKS AHEKA AHEARV AHEAGWS AHEAGW /end REF_CHARACTERISTIC
 /begin LOC_MEASUREMENT KSWF FLGKAT FIVZABG B_NPMD B_MXMD B_MNMD BFNMX BFNMN B_BFWRM B_BFKLT B_AFWRM B_AFTWRM B_AFTKLT B_AFKLT AFTNMX AFTNMN AFNMX AFNMN FLGTIAB E_MD B_SP2 B_SP1 B_MILMD B_MDKAT B_MDARV B_BLKMD TMOT TFST RL NMOT E_EV5 E_EV4 E_EV3 E_EV2 E_EV1 E_EV B_WUC B_LUSTOP B_DCY B_CDMD /end LOC_MEASUREMENT
/end FUNCTION
/begin FUNCTION _DMDSTP "16.20.0"
 /begin REF_CHARACTERISTIC TLSALUN TLSALN1 TAMIALU TALUST SFONTM NMXALU1 NMXALU NMIALU DNALUN AVRALU /end REF_CHARACTERISTIC
 /begin LOC_MEASUREMENT B_MDTNST B_MDNMOT B_MDNG B_MDDTLA B_LUENA B_FONTM B_NOTLU_FR B_LUSTOP B_FONSTP B_FOFSTP TNST TMOT TL8 TANS S_SCHALT NIST NGRAD E_TEVE E_SUE E_NWSE E_MD E_EV E_BM DTL B_WKR B_WK B_WEH B_WE B_TEHB B_SWE B_SKA B_SA B_NWS B_MDTL B_MDSOV B_MDERKF B_KUP B_KOE B_EVASE B_EDKVS2 B_DRCHA B_CDMD /end LOC_MEASUREMENT
/end FUNCTION
/begin FUNCTION _DMFB "14.10.0" /begin REF_CHARACTERISTIC TDMFB /end REF_CHARACTERISTIC /begin LOC_MEASUREMENT E_CEGS B_STEND B_MILFB B_INIT B_GV /end LOC_MEASUREMENT /end FUNCTION
/begin FUNCTION _DMIL "29.50.0" /begin REF_CHARACTERISTIC T_WL_BLK TMILEI CWKMMIL /end REF_CHARACTERISTIC
 /begin LOC_MEASUREMENT B_MILST B_MILEB B_MILBLK B_BLKEB B_MILSTAT B_MIL B_KMMIL B_FELA MILSTATE B_WLCNTR B_WARNL B_TAL B_STEND B_NMOT B_MILMD B_MILFB B_BLKMD B_BLKFB /end LOC_MEASUREMENT
/end FUNCTION
/begin FUNCTION _DMS "6.10.0" /begin REF_CHARACTERISTIC TVDRREC /end REF_CHARACTERISTIC /end FUNCTION
/begin FUNCTION _DPEDSTOP "1.10.0" /begin REF_CHARACTERISTIC TPED2 TPED1 PWG2MAX PWG1MAX /end REF_CHARACTERISTIC /begin LOC_MEASUREMENT E_PEDST B_NOFLR SP2S SP1S E_PWG B_STZ /end LOC_MEASUREMENT /end FUNCTION
/begin FUNCTION _DPH "12.40.0" /begin REF_CHARACTERISTIC PHNOKA /end REF_CHARACTERISTIC /begin LOC_MEASUREMENT PHPW B_STEND B_PHSOK E_PH B_PHEA BZSYNC B_START B_INIT /end LOC_MEASUREMENT /end FUNCTION
/begin FUNCTION _DPMOEL "2.11.0" /begin REF_CHARACTERISTIC TDEPOEL NPMOL1 /end REF_CHARACTERISTIC /begin LOC_MEASUREMENT DRPMOEL B_NOFLR S_POEL NIST_1U /end LOC_MEASUREMENT /end FUNCTION
/begin FUNCTION _DPWG "2.21.0"
 /begin LOC_MEASUREMENT E_PWG DRPWG B_NOFLR EI_S2MX_FR EI_S2MN_FR EI_S12_FR EI_S1MX_FR EI_S1MN_FR B_STZ /end LOC_MEASUREMENT
/end FUNCTION
/begin FUNCTION _DR2SFP "1.10.0" /begin REF_CHARACTERISTIC DFPMLINE /end REF_CHARACTERISTIC /end FUNCTION
/begin FUNCTION _DSR "2.0.0"
 /begin LOC_MEASUREMENT EI_ZWC_UM EI_TL_UM EI_TLIP_UM EI_SPSC_UM EI_REAC_UM EI_NC_UM EI_MVER_UM EI_IPA_UM EI_ADCC_UM B_STZ B_I_SKA_UM /end LOC_MEASUREMENT
/end FUNCTION
/begin FUNCTION _DSWEB "6.10.0"
 /begin REF_CHARACTERISTIC ZBSMW TWVDBS FSWALUV FIBSALU FABSALU CWABSSW BSMWMX BSMWMN APDBS /end REF_CHARACTERISTIC
 /begin LOC_MEASUREMENT ZZDBS ZPDBS B_SWEV B_SWE BSSP BSMW B_DBSE E_SWE DRSWE VFZG E_VFZ BS B_INIT /end LOC_MEASUREMENT
/end FUNCTION
/begin FUNCTION _DSWEC "7.10.0" /begin REF_CHARACTERISTIC FSWALUV FIBSALU FABSALU CWABSSW /end REF_CHARACTERISTIC /begin LOC_MEASUREMENT B_SWEV BSSP B_SWE V_CAN E_SWE BS /end LOC_MEASUREMENT /end FUNCTION
/begin FUNCTION _DTEVE "5.0.0" /begin LOC_MEASUREMENT B_NOFLR E_TEVE B_TEVEP B_DESEE /end LOC_MEASUREMENT /end FUNCTION
/begin FUNCTION _DTOP "1.0.0" /begin LOC_MEASUREMENT TOP_W /end LOC_MEASUREMENT /end FUNCTION
/begin FUNCTION _DTRIG "1.10.0" /begin LOC_MEASUREMENT B_TIM B_NO B_WUC B_SP3 B_SP2 B_SP1 B_DCY /end LOC_MEASUREMENT /end FUNCTION
/begin FUNCTION _DUMWEX "1.10.0" /begin LOC_MEASUREMENT TOP_W /end LOC_MEASUREMENT /end FUNCTION
/begin FUNCTION _DVFZ "18.10.0" /begin REF_CHARACTERISTIC VFZG_E VDMN TMDV TDV NDVO NDV /end REF_CHARACTERISTIC /begin LOC_MEASUREMENT TMOT B_NOFLR E_VFZ DRVFZ VROH_W NMOT B_SA /end LOC_MEASUREMENT /end FUNCTION
/begin FUNCTION _DVTEMBED "4.10.0" /begin REF_CHARACTERISTIC TSTFL_T /end REF_CHARACTERISTIC /begin LOC_MEASUREMENT E_VTSK DRVTSK B_TM_EIN B_FGR_2T B_FGR_PL /end LOC_MEASUREMENT /end FUNCTION
/begin FUNCTION _DWUC "15.10.0" /begin REF_CHARACTERISTIC TMWUCST TMWUC /end REF_CHARACTERISTIC /begin LOC_MEASUREMENT TMSTEM WUCCNT B_WUC B_NOWUC BBWUC TMOT B_STEND /end LOC_MEASUREMENT /end FUNCTION
/begin FUNCTION _EA "221.0.0" /begin REF_CHARACTERISTIC WESBM WEEVLN WEEM KFWEE DTIREL DTIABS /end REF_CHARACTERISTIC /begin LOC_MEASUREMENT B_START B_NSP /end LOC_MEASUREMENT /end FUNCTION
/begin FUNCTION _EASTT "7.0.0" /begin REF_CHARACTERISTIC KFFNS WESSTO WESBM WEESTS WEESTN WEESTM /end REF_CHARACTERISTIC /begin LOC_MEASUREMENT B_START /end LOC_MEASUREMENT /end FUNCTION
/begin FUNCTION _ESGRU "22.0.0" /begin REF_CHARACTERISTIC TMVL NRALLM KFLF1 KFLFV KFLF FRALLM /end REF_CHARACTERISTIC /begin LOC_MEASUREMENT NMOT B_FLL B_VNULL B_VL B_SA B_LL B_GV /end LOC_MEASUREMENT /end FUNCTION
/begin FUNCTION _ESS "127.10.0" /begin REF_CHARACTERISTIC UKSS TVUB TLST TEMIN NKSM KFKSF KFFKSU FKSHA FGAT0 /end REF_CHARACTERISTIC
 /begin LOC_MEASUREMENT TIS_B2 TIS_B1 UNW UBATT TMOT TANS NIST FDKHA B_START B_NMIN B_B2 /end LOC_MEASUREMENT
/end FUNCTION
/begin FUNCTION _ESTI "40.20.0"
 /begin REF_CHARACTERISTIC TWSBTEMN TWRBTEMN TVUB TEMINLR TEMIN KFGEZS5 KFGEZS4 KFGEZS3 KFGEZS2 KFGEZS1 KFGEZS0 KFDRNW KFDR FGAT0 /end REF_CHARACTERISTIC
 /begin LOC_MEASUREMENT TI_B2 TI_B1 B_TEMIN TL_ TI_VS TEUKG LAMSBG1_W FWL FWE FTEA FSTAT FR_B2 FR_B1 FRA_B2 FRA_B1 FNS FESZW B_NWS /end LOC_MEASUREMENT
/end FUNCTION
/begin FUNCTION _ESUE "9.10.0"
 /begin LOC_MEASUREMENT B_EVASE B_START B_SA B_NOTL B_NMIN B_NMAX B_KS B_GS B_DKNOT_FR B_ASR /end LOC_MEASUREMENT
/end FUNCTION
/begin FUNCTION _ESWE "8.20.0" /begin REF_CHARACTERISTIC WEOFF SAONKUP SAON FIMWU FIMHU /end REF_CHARACTERISTIC /begin LOC_MEASUREMENT FWE B_WEH B_WE B_SA /end LOC_MEASUREMENT /end FUNCTION
/begin FUNCTION _ESZW "13.20.0"
 /begin REF_CHARACTERISTIC TVESZWN TMESZW TLRAN TLESZWN KFESZW KFESDWZ KFESDWM KFDZWES /end REF_CHARACTERISTIC
 /begin LOC_MEASUREMENT FZW DZWZ DZWM B_ESZW FESZW WKR5 WKR4 WKR3 WKR2 WKR1 WKR0 WGEXT TMOT TL8 NMOT /end LOC_MEASUREMENT
/end FUNCTION
/begin FUNCTION _FVDPLSD "3.110.0"
 /begin REF_CHARACTERISTIC VANF SWREV08 PEDGRANF NISTV08 LSDPCOD DSWLSD5M DSWLSD4M DSWLSD3M DSWLSD2M DSWLSD1M DSWLSDA DSWDPM DSWDPA /end REF_CHARACTERISTIC
 /begin LOC_MEASUREMENT B_LSDFE B_DPFE B_DPAKT SW_PEDBW B_LSDAKT V_LFR VFZG SWRES SW_PEDKL PEDGR NIST_1U NIST GANG E_VFZ EGS_ANF B_KUP B_HG B_GV B_BL /end LOC_MEASUREMENT
/end FUNCTION
/begin FUNCTION _FVNAS "7.120.0"
 /begin REF_CHARACTERISTIC SPS_MINNOT SPS_MIN SPS_MAX PWGRAMP PWGNOTMA PN_KL NOT_KL KFPEDSWA KFPEDSW KFPEDRSW I_KL HYSTERESE D_KL C_KL /end REF_CHARACTERISTIC
 /begin LOC_MEASUREMENT SW8TKL SW8T SW8MKL SW8M SWPT SW_PEDKL SW_PED SPSN_MSR SPSN_FGR PEDGR8 PEDGR SW_TEMP SW_MSR SP2S SP1S SPS S_FPC EGS_AUT EGS_ANF B_SELESP B_PN B_LL B_HG B_FPC B_BR B_BL /end LOC_MEASUREMENT
/end FUNCTION
/begin FUNCTION _GGDG "6.10.0" /begin LOC_MEASUREMENT TN NIST /end LOC_MEASUREMENT /end FUNCTION
/begin FUNCTION _GGEGAS "11.40.0" /begin REF_CHARACTERISTIC VC_KUP VC_ACC TVKUPPL TFBREMSE FGRENABLE CWBRLS /end REF_CHARACTERISTIC
 /begin LOC_MEASUREMENT B_NO_TM_FR B_RGE B_KUPSTAT B_KUPCHA B_KUP B_BL VC_FGR S_SCHALT S_KUP S_BR S_BL B_URSTA B_SELESP B_KOS B_BR B_AUS /end LOC_MEASUREMENT
/end FUNCTION
/begin FUNCTION _GGFST "15.20.0" /begin REF_CHARACTERISTIC TWNTAL TWNSTA TVFSTA TANKL FSTRES CWGGFST /end REF_CHARACTERISTIC /begin LOC_MEASUREMENT TFST FSTL B_TALVAL B_TAL TANKFST B_STEND /end LOC_MEASUREMENT /end FUNCTION
/begin FUNCTION _GGHFM "54.0.0" /begin REF_CHARACTERISTIC KHFM KFTHFM /end REF_CHARACTERISTIC /begin LOC_MEASUREMENT ADC_HFM MLSMS MLSM TANS /end LOC_MEASUREMENT /end FUNCTION
/begin FUNCTION _GGLSH "5.20.0"
 /begin REF_CHARACTERISTIC ZFRIH USRIUH USRIOH USRIMINH TUSBELH TRIIMPH TRIAKTH THSRIH TGGLS RKSP RINHMX RBEL FRINOF DUSSPH DUSRIH ANZRIBEH /end REF_CHARACTERISTIC
 /begin LOC_MEASUREMENT UUSHOB2_W UUSHOB_W UUSHMB2_W UUSHMB_W UUSHK2_W UUSHK_W USHOB2_W USHOB_W USHMB2_W USHMB_W USHKR2_W USHKR_W USHK RINOFH2_W RINOFH_W B_RIREH2 B_RIREH B_RIPUH2 B_RIPUH B_RIMH2 B_RIMH B_RIIMPH B_RIBEH2 B_RIBEH B_ERINOFH2 B_ERINOFH B_ENRINH2 B_ENRINH USHK2W USHK2 USHK1W USHK1 RINH2_W RINH_W B_SHUERF2 B_SHUERF B_RINH2 B_RINH B_PRIPH2 B_PRIPH B_TTBMHH2 B_TTBMHH B_SVUERF2 B_SVUERF B_SA B_INIT /end LOC_MEASUREMENT
/end FUNCTION
/begin FUNCTION _GGLSV "4.20.0"
 /begin REF_CHARACTERISTIC ZFRIV USRIUV USRIOV USRIMINV TUSBELV TRIIMPV TRIAKTV THSRIV TGGLS RKSP RINVMX RBEL FRINOF DUSSPV DUSRIV ANZRIBEV /end REF_CHARACTERISTIC
 /begin LOC_MEASUREMENT ZRINV2_W ZRINV_W ZRIBERV2 ZRIBERV UUSVOB2_W UUSVOB_W UUSVMB2_W UUSVMB_W UUSVK2_W UUSVK_W USVOB2_W USVOB_W USVMB2_W USVMB_W USVKR2_W USVKR_W RINOFV2_W RINOFV_W B_USBEV2 B_USBEV B_SVUERF2 B_SVUERF B_RIREV2 B_RIREV B_RIPUV2 B_RIPUV B_RIMV2 B_RIMV B_RIIMPV B_RIIBV2 B_RIIBV B_RIBEV2 B_RIBEV B_RIAKV2 B_RIAKV B_ERINOFV2 B_ERINOFV B_ENRINV2 B_ENRINV USVK2W USVK2 USVK1W USVK1 RINV2_W RINV_W B_RINV2 B_RINV B_PRIPV2 B_PRIPV B_TTBMH2 B_SHUERF2 B_SHUERF B_SA B_INIT /end LOC_MEASUREMENT
/end FUNCTION
/begin FUNCTION _GGPAC "2.10.0"
 /begin REF_CHARACTERISTIC PACLFU2 PACLFU PACLFO2 PACLFO PACDMXON PACDMXOF PACDMNON PACDMNOF CWKLIMA /end REF_CHARACTERISTIC
 /begin LOC_MEASUREMENT S_LUES2 S_LUES1 PAC /end LOC_MEASUREMENT
/end FUNCTION
/begin FUNCTION _GGTFA "4.3.0" /begin REF_CHARACTERISTIC TDTA TADMX TADMN TADE /end REF_CHARACTERISTIC /begin LOC_MEASUREMENT UTANS TANS B_NOFLR TANSLIN E_TA /end LOC_MEASUREMENT /end FUNCTION
/begin FUNCTION _GGTFM "16.40.0"
 /begin REF_CHARACTERISTIC ZFTMOT TMDMX TMDMN TMDMME TMDMMA TDTM TDMM_Q TDMM TADTM TADMM DTMDMM DTMDMA DTADTM CTSEWTM /end REF_CHARACTERISTIC
 /begin LOC_MEASUREMENT B_STEND B_NOFLR UTMOT TMST TMOT_W TMOTLIN TMOT_L TMOT TMEW TMDMM TMABS_W TMABS TANS E_TM E_TA B_SA /end LOC_MEASUREMENT
/end FUNCTION
/begin FUNCTION _GGUB "16.11.0" /begin REF_CHARACTERISTIC UBDMX UBDMN2 UBDMN1 UBDE TDUBMAX TDUB TDNSUB /end REF_CHARACTERISTIC /begin LOC_MEASUREMENT UBATT E_UB B_UB_OK VFZG UUBATT B_STEND B_KL15 B_INIT /end LOC_MEASUREMENT /end FUNCTION
/begin FUNCTION _GGVFZG "7.90.0"
 /begin REF_CHARACTERISTIC ZFV VROH_OFF VROHFIL VFZMN VFZG_MAX VFZG_E T_VEIN DSPULS CANSPEC BFZG_E /end REF_CHARACTERISTIC
 /begin LOC_MEASUREMENT VROHB_W VROH_W VFZG_W VFZG E_VFZ B_VROHB B_VNULL B_VFEHL BFZGL_B F_V1 E_V_CAN B_STEND B_INIT B_HG /end LOC_MEASUREMENT
/end FUNCTION
/end MODULE
/end PROJECT
