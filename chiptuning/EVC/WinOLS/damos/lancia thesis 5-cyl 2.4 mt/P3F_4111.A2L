ASAP2_VERSION 1 3
/begin PROJECT _ " [ME.ME3.1C.09.4111.DAMOS25]  DAMPAR_04"
/begin HEADER "Lancia Thesis 5-Zyl. 2,4 MT" PROJECT_NO 411.1 VERSION "P2FJGD66" /end HEADER
/begin MODULE DIM " "
/begin MOD_COMMON " " S_REC_LAYOUT DAMOS DEPOSIT ABSOLUTE BYTE_ORDER MSB_LAST /end MOD_COMMON
/begin COMPU_METHOD BSCHL_S5L "Darstellung -6.25 bis 6.249 " RAT_FUNC "%5.3" "g" COEFFS 0 5242.000000 3.276800e+04 0 0.000000 1.000000 /end COMPU_METHOD
/begin COMPU_METHOD CAN_ZUST "CAN state machine" TAB_VERB "%7.5" "" COMPU_TAB_REF CAN_ZUST /end COMPU_METHOD
/begin COMPU_METHOD CMO_TMP "Motor-Temperatur (invers)" TAB_INTP "%7.3" "Grad C" COMPU_TAB_REF CMO_TMP /end COMPU_METHOD
/begin COMPU_METHOD DEZ "  Dezimalzahl in Hexzahl" RAT_FUNC "%3.0" "" COEFFS 0 1.000000 0.000000 0 0.000000 1.000000 /end COMPU_METHOD
/begin COMPU_METHOD DEZL "  Dezimalzahl in 16-Bit-Hexzahl" RAT_FUNC "%5.0" "" COEFFS 0 1.000000 0.000000 0 0.000000 1.000000 /end COMPU_METHOD
/begin COMPU_METHOD DTSEGN_S8 "Segmentwinkel (vorzeichenbehaftet)" RAT_FUNC "%7.5" "Grad KW" COEFFS 0 1.000000 0.000000 0 0.000000 1.757800e-02 /end COMPU_METHOD
/begin COMPU_METHOD F256OFF "Korrekturfaktor 256 mit Offset 0.5" RAT_FUNC "%7.5" "Faktor" COEFFS 0 256.000000 -128.000000 0 0.000000 1.000000 /end COMPU_METHOD
/begin COMPU_METHOD FAK2L "  Faktor [0;<2], 16 Bit" RAT_FUNC "%8.6" "" COEFFS 0 3.276800e+04 0.000000 0 0.000000 1.000000 /end COMPU_METHOD
/begin COMPU_METHOD FAKTCIFI "  Korrekturfaktor fuer CIFI" RAT_FUNC "%9.7" "" COEFFS 0 512.000000 -384.000000 0 0.000000 1.000000 /end COMPU_METHOD
/begin COMPU_METHOD FAK_UB_B2 " 8-Bit-Hexwerte " RAT_FUNC "%9.7" "  " COEFFS 0 256.000000 0.000000 0 0.000000 2.000000 /end COMPU_METHOD
/begin COMPU_METHOD FAK_UW_B4 " 16-Bit-Hexwerte " RAT_FUNC "%11.9" "  " COEFFS 0 6.553600e+04 0.000000 0 0.000000 4.000000 /end COMPU_METHOD
/begin COMPU_METHOD FKT128 "  Umsetzung des Intervalles [0;<2]" RAT_FUNC "%6.4" "" COEFFS 0 128.000000 0.000000 0 0.000000 1.000000 /end COMPU_METHOD
/begin COMPU_METHOD FKT128L "  Umsetzung des Intervalles [0;<2] 16 Bit" RAT_FUNC "%7.3" "" COEFFS 0 128.000000 0.000000 0 0.000000 1.000000 /end COMPU_METHOD
/begin COMPU_METHOD FKT128_S " Umsetzung des Intervalles [-1;1] fuer signed byte" RAT_FUNC "%8.6" "" COEFFS 0 127.000000 0.000000 0 0.000000 1.000000 /end COMPU_METHOD
/begin COMPU_METHOD FKT16 "  Umsetzung des Intervalles [0;<16]" RAT_FUNC "%6.3" "" COEFFS 0 16.000000 0.000000 0 0.000000 1.000000 /end COMPU_METHOD
/begin COMPU_METHOD FKT256 "  Umsetzung des Intervalles [0;<1]" RAT_FUNC "%6.4" "" COEFFS 0 256.000000 0.000000 0 0.000000 1.000000 /end COMPU_METHOD
/begin COMPU_METHOD FKT256L "  Umsetzung des Intervalles [0;< 256.0]" RAT_FUNC "%6.2" "" COEFFS 0 256.000000 0.000000 0 0.000000 1.000000 /end COMPU_METHOD
/begin COMPU_METHOD FKT32 "  Umsetzung des Intervalles [0;<8]" RAT_FUNC "%6.4" "" COEFFS 0 32.000000 0.000000 0 0.000000 1.000000 /end COMPU_METHOD
/begin COMPU_METHOD FKT32768 "  Umsetzung des Intervalles [0;<2]" RAT_FUNC "%9.7" "" COEFFS 0 3.276800e+04 0.000000 0 0.000000 1.000000 /end COMPU_METHOD
/begin COMPU_METHOD FKT4096L "  Umsetzung des Intervalles [0-16]" RAT_FUNC "%6.3" "" COEFFS 0 4096.000000 0.000000 0 0.000000 1.000000 /end COMPU_METHOD
/begin COMPU_METHOD FKT512 "  Umsetzung des Intervalles [0;<0.5]" RAT_FUNC "%6.4" "" COEFFS 0 512.000000 0.000000 0 0.000000 1.000000 /end COMPU_METHOD
/begin COMPU_METHOD FKT512L "  Umsetzung des Intervalles [0;< 512.0]" RAT_FUNC "%8.4" "" COEFFS 0 512.000000 0.000000 0 0.000000 1.000000 /end COMPU_METHOD
/begin COMPU_METHOD FKT64 "  Umsetzung des Intervalles [0;<4]" RAT_FUNC "%6.4" "" COEFFS 0 64.000000 0.000000 0 0.000000 1.000000 /end COMPU_METHOD
/begin COMPU_METHOD FKT65536 "  Umsetzung des Intervalles [0;<1]" RAT_FUNC "%7.5" "" COEFFS 0 6.553600e+04 0.000000 0 0.000000 1.000000 /end COMPU_METHOD
/begin COMPU_METHOD FKT65536SL "  Umsetzung des Intervalles [-0,5;<0,5] 16Bit kompl." RAT_FUNC "%8.6" "" COEFFS 0 6.553600e+04 0.000000 0 0.000000 1.000000 /end COMPU_METHOD
/begin COMPU_METHOD FKT8192L "  Umsetzung des Intervalles [0;<8]" RAT_FUNC "%6.4" "" COEFFS 0 8192.000000 0.000000 0 0.000000 1.000000 /end COMPU_METHOD
/begin COMPU_METHOD FPC50L "  Korrekturfaktor fuer Aenderung um 50 [%] , 16 Bit" RAT_FUNC "%8.6" "" COEFFS 0 6.553600e+04 -3.276800e+04 0 0.000000 1.000000 /end COMPU_METHOD
/begin COMPU_METHOD FREQ_512SL "16-Bit Darstellung -512 ... 512 1/s " RAT_FUNC "%9.5" "1/s" COEFFS 0 6.553600e+04 0.000000 0 0.000000 1024.000000 /end COMPU_METHOD
/begin COMPU_METHOD GANG_NCA "Ganginformation verbal" TAB_VERB "%7.5" "" COMPU_TAB_REF GANG_NCA /end COMPU_METHOD
/begin COMPU_METHOD KM100ML "Kilometerstand 16-Bit, 0.1km/Ink" RAT_FUNC "%6.1" "km" COEFFS 0 10.000000 0.000000 0 0.000000 1.000000 /end COMPU_METHOD
/begin COMPU_METHOD KM182ML "Fahrstrecke, 0.182km/Ink" RAT_FUNC "%9.3" "km" COEFFS 0 360.000000 0.000000 0 0.000000 65.536000 /end COMPU_METHOD
/begin COMPU_METHOD KM2_7CML "Fahrstrecke, 0.0027m/Ink" RAT_FUNC "%8.4" "m" COEFFS 0 360.000000 0.000000 0 0.000000 1.000000 /end COMPU_METHOD
/begin COMPU_METHOD KM6553KML "Kilometerstand 16-Bit, 6553.6km/Ink" RAT_FUNC "%8.1" "km" COEFFS 0 1.000000 0.000000 0 0.000000 6553.600000 /end COMPU_METHOD
/begin COMPU_METHOD KM9_8ML "Kilometerstand 16-Bit, 0.098km/Ink" RAT_FUNC "%8.3" "km" COEFFS 0 1.000000 0.000000 0 0.000000 9.800000e-02 /end COMPU_METHOD
/begin COMPU_METHOD KM_Q36M_L "  Meterstand 16-Bit, 1000m/36000/Ink" RAT_FUNC "%7.2" "m" COEFFS 0 36.000000 0.000000 0 0.000000 1.000000 /end COMPU_METHOD
/begin COMPU_METHOD LUQ "  Laufunruhe" RAT_FUNC "%7.3" "(Umdr./sec)^2" COEFFS 0 1.000000 0.000000 0 0.000000 7.366900e-01 /end COMPU_METHOD
/begin COMPU_METHOD LUQ256_S16 "  Laufunruhe (vorzeichenbehaftet)" RAT_FUNC "%7.4" "(Umdr./sec)^2" COEFFS 0 1.000000 0.000000 0 0.000000 2.877700e-03 /end COMPU_METHOD
/begin COMPU_METHOD LUQ256_S8 "  Laufunruhe (vorzeichenbehaftet)" RAT_FUNC "%7.5" "(Umdr./sec)^2" COEFFS 0 1.000000 0.000000 0 0.000000 2.877700e-03 /end COMPU_METHOD
/begin COMPU_METHOD LUQ_S8 "  Laufunruhe (vorzeichenbehaftet)" RAT_FUNC "%7.4" "(Umdr./sec)^2" COEFFS 0 1.000000 0.000000 0 0.000000 7.366900e-01 /end COMPU_METHOD
/begin COMPU_METHOD MLQ01L "  Luftmassen-Durchsatz, 16 Bit mit 0.1[kg/h] quantisiert" RAT_FUNC "%7.2" "kg/h" COEFFS 0 10.000000 0.000000 0 0.000000 1.000000 /end COMPU_METHOD
/begin COMPU_METHOD MLQ0MG868L "Luftmasse mit 0.868 [mg] quantisiert" RAT_FUNC "%9.3" "mg/s" COEFFS 0 230.400000 0.000000 0 0.000000 200.000000 /end COMPU_METHOD
/begin COMPU_METHOD MLQ100 "  Luftmassen-Durchsatz mit  0.996E-2[kg] quantisiert" RAT_FUNC "%5.3" "kg" COEFFS 0 1.000000 0.000000 0 0.000000 9.955600e-03 /end COMPU_METHOD
/begin COMPU_METHOD MLQP256L "  Luftmassen-Durchsatz mit Faktor  2.560[g%] " RAT_FUNC "%7.1" "g%" COEFFS 0 2.560000 0.000000 0 0.000000 1.000000 /end COMPU_METHOD
/begin COMPU_METHOD MLSMQ "MLE mit  4.000 Kg/h quantisiert" RAT_FUNC "%7.2" "kg/h" COEFFS 0 1.000000 0.000000 0 0.000000 4.000000 /end COMPU_METHOD
/begin COMPU_METHOD MMQ "Motor-Momentquantisierung " RAT_FUNC "%5.1" "Nm" COEFFS 0 1.000000 0.000000 0 0.000000 2.000000 /end COMPU_METHOD
/begin COMPU_METHOD MMQOF "Motor-Momentquantisierung mit Offset" RAT_FUNC "%5.1" "Nm" COEFFS 0 1.000000 100.000000 0 0.000000 2.000000 /end COMPU_METHOD
/begin COMPU_METHOD MMQ_NORM "Normiertes Motormoment " RAT_FUNC "%4.0" "Nm" COEFFS 0 1.000000 0.000000 0 0.000000 10.000000 /end COMPU_METHOD
/begin COMPU_METHOD NQ025PN "  Drehzahlquantisierung 0.25[Upm]" RAT_FUNC "%4.0" "Upm" COEFFS 0 4.000000 0.000000 0 0.000000 1.000000 /end COMPU_METHOD
/begin COMPU_METHOD NQ025_W "  Drehzahlquantisierung  0.250[Upm]" RAT_FUNC "%5.0" "Upm" COEFFS 0 1.000000 0.000000 0 0.000000 2.500000e-01 /end COMPU_METHOD
/begin COMPU_METHOD NQ10 "  Drehzahlquantisierung  10.00[Upm]" RAT_FUNC "%4.0" "Upm" COEFFS 0 1.000000 0.000000 0 0.000000 10.000000 /end COMPU_METHOD
/begin COMPU_METHOD NQ1_W "  Drehzahlquantisierung  1.000[Upm]" RAT_FUNC "%4.0" "Upm" COEFFS 0 1.000000 0.000000 0 0.000000 1.000000 /end COMPU_METHOD
/begin COMPU_METHOD NQ25 "  Drehzahlquantisierung  25.00[Upm]" RAT_FUNC "%4.0" "Upm" COEFFS 0 1.000000 0.000000 0 0.000000 25.000000 /end COMPU_METHOD
/begin COMPU_METHOD NQ32 "  Drehzahlquantisierung  32.00[Upm]" RAT_FUNC "%4.0" "Upm" COEFFS 0 1.000000 0.000000 0 0.000000 32.000000 /end COMPU_METHOD
/begin COMPU_METHOD NQ40 "  Drehzahlquantisierung  40.00[Upm]" RAT_FUNC "%5.0" "Upm" COEFFS 0 1.000000 0.000000 0 0.000000 40.000000 /end COMPU_METHOD
/begin COMPU_METHOD PAB "Umrechnung des Drucksensorwertes " RAT_FUNC "%9.4" "hPa" COEFFS 0 1.000000 37.539105 0 0.000000 5.392000 /end COMPU_METHOD
/begin COMPU_METHOD PABD "Umrechnung des Differenz-Drucksensorwertes " RAT_FUNC "%9.4" "hPa" COEFFS 0 1.000000 0.000000 0 0.000000 5.392000 /end COMPU_METHOD
/begin COMPU_METHOD PCENT "  Prozent" RAT_FUNC "%5.2" "%" COEFFS 0 256.000000 0.000000 0 0.000000 100.000000 /end COMPU_METHOD
/begin COMPU_METHOD PCENT103OF "Prozent: -25..102.5 %" RAT_FUNC "%5.1" "%" COEFFS 0 200.000000 5000.000000 0 0.000000 100.000000 /end COMPU_METHOD
/begin COMPU_METHOD PCENT125 "Prozent 0-125% " RAT_FUNC "%7.3" "%" COEFFS 0 256.000000 0.000000 0 0.000000 125.000000 /end COMPU_METHOD
/begin COMPU_METHOD PCENT150 "Prozent 0-150% " RAT_FUNC "%7.3" "%" COEFFS 0 256.000000 0.000000 0 0.000000 150.000000 /end COMPU_METHOD
/begin COMPU_METHOD PER0327 "percent" RAT_FUNC "%7.3" "%" COEFFS 0 327.670000 0.000000 0 0.000000 1.000000 /end COMPU_METHOD
/begin COMPU_METHOD PER255 "percent" RAT_FUNC "%7.3" "%" COEFFS 0 255.000000 0.000000 0 0.000000 100.000000 /end COMPU_METHOD
/begin COMPU_METHOD PER_DKA "percent" RAT_FUNC "%7.3" "%" COEFFS 0 215.000000 0.000000 0 0.000000 100.000000 /end COMPU_METHOD
/begin COMPU_METHOD R_UW_Q2 " Widerstand in 16-Bit-Hexwerten " RAT_FUNC "%6.0" " Ohm " COEFFS 0 1.000000 0.000000 0 0.000000 2.000000 /end COMPU_METHOD
/begin COMPU_METHOD R_UW_Q32 " " RAT_FUNC "%7.0" "Ohm" COEFFS 0 1.000000 0.000000 0 0.000000 32.000000 /end COMPU_METHOD
/begin COMPU_METHOD SENSORB "8 BIT Sensorsignal" RAT_FUNC "%7.5" "V" COEFFS 0 256.000000 0.000000 0 0.000000 5.000000 /end COMPU_METHOD
/begin COMPU_METHOD SENSORW "16 BIT Sensorsignal" RAT_FUNC "%7.5" "V" COEFFS 0 6.553600e+04 0.000000 0 0.000000 5.000000 /end COMPU_METHOD
/begin COMPU_METHOD SIG32L "  Umsetzung des Intervalles [- 32.00;< 32.00]" RAT_FUNC "%6.3" "" COEFFS 0 3.276800e+04 1.048576e+06 0 0.000000 32.000000 /end COMPU_METHOD
/begin COMPU_METHOD TEQL "  Quantisierung von te, 16 Bit mit  0.267E-2[ms]" RAT_FUNC "%7.3" "ms" COEFFS 0 1.000000 0.000000 0 0.000000 2.666700e-03 /end COMPU_METHOD
/begin COMPU_METHOD TEQ_32 "  Quantisierung von tlw 8 Bit mit 0.0853[ms]" RAT_FUNC "%7.4" "ms" COEFFS 0 1.000000 0.000000 0 0.000000 8.533300e-02 /end COMPU_METHOD
/begin COMPU_METHOD TEQ_8L "  Quantisierung von te, 16 Bit mit 0.0213[ms]" RAT_FUNC "%7.2" "ms" COEFFS 0 1.000000 0.000000 0 0.000000 2.133300e-02 /end COMPU_METHOD
/begin COMPU_METHOD TEQ_CPL "  Quantisierung von te, 16 Bitmit  0.267E-2[ms]" RAT_FUNC "%9.6" "ms" COEFFS 0 1.000000 0.000000 0 0.000000 2.666666e-03 /end COMPU_METHOD
/begin COMPU_METHOD TEVIQ "  Integratorzeitkonstante in [%/s]" RAT_FUNC "%6.4" "%/s" COEFFS 0 6.553600e+04 0.000000 0 0.000000 1000.000000 /end COMPU_METHOD
/begin COMPU_METHOD TLQSL "'Luftfuellung, signed, 16 bit" RAT_FUNC "%6.1" "ms/Umdr." COEFFS 0 1.000000 0.000000 0 0.000000 4.266000e-02 /end COMPU_METHOD
/begin COMPU_METHOD TQ10 "  Zeitquantisierung mit 10[ms]" RAT_FUNC "%4.2" "sec" COEFFS 0 100.000000 0.000000 0 0.000000 1.000000 /end COMPU_METHOD
/begin COMPU_METHOD TQ100 "  Zeitquantisierung mit 100[ms]" RAT_FUNC "%4.1" "sec" COEFFS 0 10.000000 0.000000 0 0.000000 1.000000 /end COMPU_METHOD
/begin COMPU_METHOD TQ100L "  Zeitquantisierung mit 100[ms]" RAT_FUNC "%7.2" "sec" COEFFS 0 10.000000 0.000000 0 0.000000 1.000000 /end COMPU_METHOD
/begin COMPU_METHOD TQ1092STDL "  Zeitquantisierung mit 1092.3std/Inc" RAT_FUNC "%8.1" "std" COEFFS 0 60.000000 0.000000 0 0.000000 6.553600e+04 /end COMPU_METHOD
/begin COMPU_METHOD TQ10L "  Zeitquantisierung mit 10[ms]" RAT_FUNC "%6.2" "sec" COEFFS 0 100.000000 0.000000 0 0.000000 1.000000 /end COMPU_METHOD
/begin COMPU_METHOD TQ10MSS "  Zeitquantisierung mit 10[ms] signed" RAT_FUNC "%5.3" "sec" COEFFS 0 100.000000 0.000000 0 0.000000 1.000000 /end COMPU_METHOD
/begin COMPU_METHOD TQ10MSSL "  Zeitquantisierung mit 10[ms] 16Bit-signed" RAT_FUNC "%7.3" "sec" COEFFS 0 100.000000 0.000000 0 0.000000 1.000000 /end COMPU_METHOD
/begin COMPU_METHOD TQ10SL "  Zeitquantisierung mit 10[s]" RAT_FUNC "%6.0" "sec" COEFFS 0 1.000000e-01 0.000000 0 0.000000 1.000000 /end COMPU_METHOD
/begin COMPU_METHOD TQ1L "  Zeitquantisierung mit 1[ms]" RAT_FUNC "%6.3" "sec" COEFFS 0 1000.000000 0.000000 0 0.000000 1.000000 /end COMPU_METHOD
/begin COMPU_METHOD TQ1MINL "  Zeitquantisierung mit 1min/Inc" RAT_FUNC "%5.0" "min" COEFFS 0 1.000000 0.000000 0 0.000000 1.000000 /end COMPU_METHOD
/begin COMPU_METHOD TQ20 "  Zeitquantisierung mit 20[ms]" RAT_FUNC "%5.3" "sec" COEFFS 0 50.000000 0.000000 0 0.000000 1.000000 /end COMPU_METHOD
/begin COMPU_METHOD TQ200 "  Zeitquantisierung mit 200[ms]" RAT_FUNC "%5.2" "sec" COEFFS 0 5.000000 0.000000 0 0.000000 1.000000 /end COMPU_METHOD
/begin COMPU_METHOD TQ40 "  Zeitquantisierung mit 40[ms]" RAT_FUNC "%5.2" "sec" COEFFS 0 25.000000 0.000000 0 0.000000 1.000000 /end COMPU_METHOD
/begin COMPU_METHOD TSQL "  Quantisierung von te, 16 Bit mit  0.667[us] " RAT_FUNC "%7.1" "us" COEFFS 0 1.000000 0.000000 0 0.000000 6.666700e-01 /end COMPU_METHOD
/begin COMPU_METHOD TSQ_S16 "  Quantisierung von te, 16 Bit mit  0.667[us] " RAT_FUNC "%7.1" "us" COEFFS 0 1.000000 0.000000 0 0.000000 6.666700e-01 /end COMPU_METHOD
/begin COMPU_METHOD U0V_1V25 "8Bit Umsetzung des Spannungsintervalles 0..1,245V" RAT_FUNC "%5.3" "V" COEFFS 0 256.000000 0.000000 0 0.000000 1.250000 /end COMPU_METHOD
/begin COMPU_METHOD U0V_1V33 "8Bit Umsetzung des Spannungsintervalles 0..1,33V" RAT_FUNC "%5.3" "V" COEFFS 0 255.000000 0.000000 0 0.000000 1.330000 /end COMPU_METHOD
/begin COMPU_METHOD UDKL "Drosselklappenwinkel" RAT_FUNC "%7.4" "grad DK" COEFFS 0 3.276800e+04 0.000000 0 0.000000 80.916000 /end COMPU_METHOD
/begin COMPU_METHOD UFUELL "Umrechnung fuer Fuellungsgrad" RAT_FUNC "%7.3" "%" COEFFS 0 255.000000 0.000000 0 0.000000 191.250000 /end COMPU_METHOD
/begin COMPU_METHOD ULSQ "  Lambdasonden-Spannung ohne Offset" RAT_FUNC "%7.5" "V" COEFFS 0 51.000000 0.000000 0 0.000000 1.000000 /end COMPU_METHOD
/begin COMPU_METHOD ULSQL "  Lambdasonden-Spannung ohne Offset" RAT_FUNC "%7.5" "V" COEFFS 0 13107.000000 0.000000 0 0.000000 1.000000 /end COMPU_METHOD
/begin COMPU_METHOD UTABG "Abgastemperatur" RAT_FUNC "%7.3" "grad C" COEFFS 0 1.000000 48.000000 0 0.000000 4.000000 /end COMPU_METHOD
/begin COMPU_METHOD UTMP_40 "  lineare Temperatur + Offset" RAT_FUNC "%6.2" "grd C" COEFFS 0 1.000000 40.000000 0 0.000000 1.000000 /end COMPU_METHOD
/begin COMPU_METHOD UWDKL "Drosselklappenwinkel" RAT_FUNC "%7.4" "grad DK" COEFFS 0 32767.000000 0.000000 0 0.000000 80.916000 /end COMPU_METHOD
/begin COMPU_METHOD VFZG_Q1P0 " Geschwindigkeit in 8-Bit-Hexwerten " RAT_FUNC "%3.0" " km/h " COEFFS 0 1.000000 0.000000 0 0.000000 1.000000 /end COMPU_METHOD
/begin COMPU_METHOD VQV16L "  Geschwindigkeitsumrechnung mit Faktor  16.00 [km/h]" RAT_FUNC "%6.1" "km/h" COEFFS 0 16.000000 0.000000 0 0.000000 1.000000 /end COMPU_METHOD
/begin COMPU_METHOD ZWOF "  Zuendwinkel mit Offset" RAT_FUNC "%6.3" "grad KW" COEFFS 0 1.000000 78.000000 0 0.000000 7.500000e-01 /end COMPU_METHOD
/begin COMPU_METHOD ZWQ "  Zuendwinkel ohne Offset mit  0.750[grad KW] quantisiert" RAT_FUNC "%6.2" "grad KW" COEFFS 0 1.000000 0.000000 0 0.000000 7.500000e-01 /end COMPU_METHOD
/begin COMPU_TAB CMO_TMP "" TAB_INTP 21 0 -41.000000 5 -40.000000 9 -30.000000 15 -20.150000 24 -10.120000 36 -0.140000 53 9.940000 73 19.980000 84 24.980000 95 30.020000 118 39.970000 141 49.980000 162 60.000000 180 70.080000 195 80.030000 207 90.000000 217 99.960000 225 109.910000 231 120.250000 236 129.640000 255 140.000000 /end COMPU_TAB
/begin COMPU_VTAB CAN_ZUST "" TAB_VERB 8 0 "POWER_UP" 1 "CAN_INIT" 2 "BUS_OKAY" 3 "SILENCE_T" 4 "WATCH_T2" 5 "NODE_BOFF" 6 "CAN_SHTDWN" 7 "NODE_MUTE" /end COMPU_VTAB
/begin COMPU_VTAB GANG_NCA "" TAB_VERB 8 0 "undef." 1 "-1-" 2 "-2-" 3 "-3-" 4 "-4-" 5 "-5-" 6 "P/N" 7 "-R-" /end COMPU_VTAB
/begin MEASUREMENT AHKTNK "korr. Sondensignal- Amplitude normiert Bank1" UBYTE FKT256 0 0 0.000000 0.996090 ECU_ADDRESS 0xB087F BIT_MASK 0xFF /end MEASUREMENT
/begin MEASUREMENT AHKTNK2 "korr. Sondensignal- Amplitude normiert Bank2" UBYTE FKT256 0 0 0.000000 0.996090 ECU_ADDRESS 0xB0880 BIT_MASK 0xFF /end MEASUREMENT
/begin MEASUREMENT AHKTNK2S16 "DKATEL2: Ergebnis nach Subtraktion und Addition" UWORD DEZL 0 0 0.000000 65535.000000 ECU_ADDRESS 0xB0000 BIT_MASK 0xFFFF /end MEASUREMENT
/begin MEASUREMENT AHKTNK_S16 "DKATEL1: Ergebnis nach Subtraktion und Addition" UWORD DEZL 0 0 0.000000 65535.000000 ECU_ADDRESS 0xB08E6 BIT_MASK 0xFFFF /end MEASUREMENT
/begin MEASUREMENT AINT " Zdg.spez. Anzahl Intervalle mit Katschaedigung" UBYTE DEZ 0 0 0.000000 256.000000 ECU_ADDRESS 0xB0A17 BIT_MASK 0xFF /end MEASUREMENT
/begin MEASUREMENT AKATBF1S16 "AHKATB1: Subtraktion katbf1 und Filterwert1" UWORD DEZL 0 0 0.000000 65535.000000 ECU_ADDRESS 0xB0000 BIT_MASK 0xFFFF /end MEASUREMENT
/begin MEASUREMENT AKATBF2S16 "AHKATB2: Subtraktion katbf2 und Filterwert2" UWORD DEZL 0 0 0.000000 65535.000000 ECU_ADDRESS 0xB0000 BIT_MASK 0xFFFF /end MEASUREMENT
/begin MEASUREMENT AKT_DAUER " Dauer im Aktivzustand (KL15 ein)" UWORD TQ10L 0 0 0.000000 655.350000 ECU_ADDRESS 0xB1826 BIT_MASK 0xFFFF /end MEASUREMENT
/begin MEASUREMENT ANALUZ " Zaehler fuer Ausblendung Aussetzererkennung" UBYTE DEZ 0 0 0.000000 256.000000 ECU_ADDRESS 0xB0744 BIT_MASK 0xFF /end MEASUREMENT
/begin MEASUREMENT ANZTI "Freilaufender Zaehler fuer ausgegebene TIs" UBYTE DEZ 0 0 0.000000 256.000000 ECU_ADDRESS 0xB0490 BIT_MASK 0xFF /end MEASUREMENT
/begin MEASUREMENT ANZTIS "Anzahl ausgegebener TIs (Synchro)" UBYTE DEZ 0 0 0.000000 256.000000 ECU_ADDRESS 0xB0491 BIT_MASK 0xFF /end MEASUREMENT
/begin MEASUREMENT ANZTIZ "Anzahl ausgegebener TIs (10ms)" UBYTE DEZ 0 0 0.000000 256.000000 ECU_ADDRESS 0xB0492 BIT_MASK 0xFF /end MEASUREMENT
/begin MEASUREMENT ANZ_UMPRG " Anzahl der Umprogrammiervorgaenge" UBYTE DEZL 0 0 0.000000 65535.000000 ECU_ADDRESS 0xB2B1A BIT_MASK 0xFF /end MEASUREMENT
/begin MEASUREMENT APEDKT2 " Zaehler Anzahl der Pruefungen mit Fehlerergebnis bei Katdiagn., Bank2" UBYTE DEZ 0 0 0.000000 256.000000 ECU_ADDRESS 0xB088B BIT_MASK 0xFF /end MEASUREMENT
/begin MEASUREMENT ASA "Adaptionsfaktor fuer Segment A" UWORD FKT32768 0 0 0.000000 2.000000 ECU_ADDRESS 0xB2172 BIT_MASK 0xFFFF /end MEASUREMENT
/begin MEASUREMENT ASB "Adaptionsfaktor fuer Segment B" UWORD FKT32768 0 0 0.000000 2.000000 ECU_ADDRESS 0xB2174 BIT_MASK 0xFFFF /end MEASUREMENT
/begin MEASUREMENT ASC "Adaptionsfaktor fuer Segment C" UWORD FKT32768 0 0 0.000000 2.000000 ECU_ADDRESS 0xB2176 BIT_MASK 0xFFFF /end MEASUREMENT
/begin MEASUREMENT ASCBPLZ "> Zeitzaehler von RSTOUT bis Initi. ASIC Beginn [2.6us]" UWORD TEQL 0 0 0.000000 174.760000 ECU_ADDRESS 0xF752 BIT_MASK 0xFFFF /end MEASUREMENT
/begin MEASUREMENT ASCEPLZ "> Zeitzaehler von RSTOUT bis Initi. ASIC Ende [2.6us]" UWORD TEQL 0 0 0.000000 174.760000 ECU_ADDRESS 0xF756 BIT_MASK 0xFFFF /end MEASUREMENT
/begin MEASUREMENT ASD "Adaptionsfaktor fuer Segment D" UWORD FKT32768 0 0 0.000000 2.000000 ECU_ADDRESS 0xB2178 BIT_MASK 0xFFFF /end MEASUREMENT
/begin MEASUREMENT ASE "Adaptionsfaktor fuer Segment E" UWORD FKT32768 0 0 0.000000 2.000000 ECU_ADDRESS 0xB217A BIT_MASK 0xFFFF /end MEASUREMENT
/begin MEASUREMENT ASR_ST " ASR-Status-Byte" UWORD DEZL 0 0 0.000000 65535.000000 ECU_ADDRESS 0xFD24 BIT_MASK 0xFFFF /end MEASUREMENT
/begin MEASUREMENT ASR_ST1 "ASR-Status-Byte" UBYTE DEZ 0 0 0.000000 256.000000 ECU_ADDRESS 0xFD24 BIT_MASK 0xFF /end MEASUREMENT
/begin MEASUREMENT ASR_ST2 " ASR-Status-Byte" UWORD DEZL 0 0 0.000000 65535.000000 ECU_ADDRESS 0xFD26 BIT_MASK 0xFFFF /end MEASUREMENT
/begin MEASUREMENT ASR_ST3 "ASR-Status-Byte" UBYTE DEZ 0 0 0.000000 256.000000 ECU_ADDRESS 0x0 BIT_MASK 0xFF /end MEASUREMENT
/begin MEASUREMENT ATVL1 "LR-Integrator hinter Kat, Bank1 low" UWORD DEZL 0 0 0.000000 65535.000000 ECU_ADDRESS 0xB2004 BIT_MASK 0xFFFF /end MEASUREMENT
/begin MEASUREMENT ATVL2 "LR-Integrator hinter Kat, Bank2 low" UWORD DEZL 0 0 0.000000 65535.000000 ECU_ADDRESS 0xB2008 BIT_MASK 0xFFFF /end MEASUREMENT
/begin MEASUREMENT AUSGH_C_UM " Heilungszaehler Komplement-/Beschreibbarkeit" UBYTE DEZ 0 0 0.000000 256.000000 ECU_ADDRESS 0xE03F BIT_MASK 0xFF /end MEASUREMENT
/begin MEASUREMENT AUSGH_C_UR "DA ausgh_c_um" UBYTE DEZ 0 0 0.000000 256.000000 ECU_ADDRESS 0xB17E1 BIT_MASK 0xFF /end MEASUREMENT
/begin MEASUREMENT AUSG_C_UM " Fehlerentprellzaehler" UBYTE DEZ 0 0 0.000000 256.000000 ECU_ADDRESS 0xE03D BIT_MASK 0xFF /end MEASUREMENT
/begin MEASUREMENT AUSG_C_UR " DA Fehlerentprellzaehler" UBYTE DEZ 0 0 0.000000 256.000000 ECU_ADDRESS 0xB17DF BIT_MASK 0xFF /end MEASUREMENT
/begin MEASUREMENT AUSZH_C_UM " Heilungszaehler ROMZ" UBYTE DEZ 0 0 0.000000 256.000000 ECU_ADDRESS 0xE040 BIT_MASK 0xFF /end MEASUREMENT
/begin MEASUREMENT AUSZH_C_UR " DA auszh_c_um" UBYTE DEZ 0 0 0.000000 256.000000 ECU_ADDRESS 0xB17E2 BIT_MASK 0xFF /end MEASUREMENT
/begin MEASUREMENT AUSZ_C_UM " Fehlerentprellzaehler ROMZ" UBYTE DEZ 0 0 0.000000 256.000000 ECU_ADDRESS 0xE03E BIT_MASK 0xFF /end MEASUREMENT
/begin MEASUREMENT AUSZ_C_UR " DA ausz_c_um" UBYTE DEZ 0 0 0.000000 256.000000 ECU_ADDRESS 0xB17E0 BIT_MASK 0xFF /end MEASUREMENT
/begin MEASUREMENT AVAKN_R "Interpolierter Faktor aus Kennlinie AVAKN" UBYTE FKT256 0 0 0.000000 0.996090 ECU_ADDRESS 0xF8EF BIT_MASK 0xFF /end MEASUREMENT
/begin MEASUREMENT AZKRNDY " Inhalt von KL AZKRNDYN" UBYTE DEZ 0 0 0.000000 256.000000 ECU_ADDRESS 0xB06EA BIT_MASK 0xFF /end MEASUREMENT
/begin MEASUREMENT AZYTIAB_ZA "Zaehler fuer Anzahl der abgeschalteten Zylinder" UBYTE DEZ 0 0 0.000000 256.000000 ECU_ADDRESS 0xB0000 BIT_MASK 0xFF /end MEASUREMENT
/begin MEASUREMENT A_POS_FC " Fehlerzeit +b Schwelle" UBYTE TQ20 0 0 0.000000 5.100000 ECU_ADDRESS 0xB04ED BIT_MASK 0xFF /end MEASUREMENT
/begin MEASUREMENT B0 " Dauerlaufmessung Zyklusbits Byte 1" UBYTE DEZL 0 0 0.000000 65535.000000 ECU_ADDRESS 0xFA42 BIT_MASK 0xFF /end MEASUREMENT
/begin MEASUREMENT B1 " Dauerlaufmessung Zyklusbits Byte 2" UBYTE DEZL 0 0 0.000000 65535.000000 ECU_ADDRESS 0xFA43 BIT_MASK 0xFF /end MEASUREMENT
/begin MEASUREMENT B2 " Dauerlaufmessung Zyklusbits Byte 3" UBYTE DEZL 0 0 0.000000 65535.000000 ECU_ADDRESS 0xFA44 BIT_MASK 0xFF /end MEASUREMENT
/begin MEASUREMENT B3 " Dauerlaufmessung Zyklusbits Byte 4" UBYTE DEZL 0 0 0.000000 65535.000000 ECU_ADDRESS 0xFA45 BIT_MASK 0xFF /end MEASUREMENT
/begin MEASUREMENT BBD2CTR "" UBYTE DEZ 0 0 0.000000 256.000000 ECU_ADDRESS 0xB1008 BIT_MASK 0xFF /end MEASUREMENT
/begin MEASUREMENT BBNO "Byte fuer Bedingung B_no als Triggerevent in DCLA" UBYTE DEZ 0 0 0.000000 256.000000 ECU_ADDRESS 0xB2258 BIT_MASK 0xFF /end MEASUREMENT
/begin MEASUREMENT BBSP1 "Byte fuer Bedingung B_sp1 als Triggerevent in DCLA" UBYTE DEZ 0 0 0.000000 256.000000 ECU_ADDRESS 0xB0FBF BIT_MASK 0xFF /end MEASUREMENT
/begin MEASUREMENT BBSP2 "Byte fuer Bedingung B_sp2 als Triggerevent in DCLA" UBYTE DEZ 0 0 0.000000 256.000000 ECU_ADDRESS 0xB0FC0 BIT_MASK 0xFF /end MEASUREMENT
/begin MEASUREMENT BBSP3 "Byte fuer Bedingung B_sp3 als Triggerevent in DCLA" UBYTE DEZ 0 0 0.000000 256.000000 ECU_ADDRESS 0xB2257 BIT_MASK 0xFF /end MEASUREMENT
/begin MEASUREMENT BBTIM "Byte fuer Bedingung B_tim als Triggerevent in DCLA" UBYTE DEZ 0 0 0.000000 256.000000 ECU_ADDRESS 0xB0F9C BIT_MASK 0xFF /end MEASUREMENT
/begin MEASUREMENT BD_BITS " Bits für Backdoor" UBYTE DEZ 0 0 0.000000 256.000000 ECU_ADDRESS 0xB207E BIT_MASK 0xFF /end MEASUREMENT
/begin MEASUREMENT BD_CAP_1MS " Capture von T__1ms für Backdoor." UWORD TQ1L 0 0 0.000000 65.535000 ECU_ADDRESS 0xB207C BIT_MASK 0xFFFF /end MEASUREMENT
/begin MEASUREMENT BD_VL_ZAEH " Zähler der Volllastbedingungen." UBYTE DEZ 0 0 0.000000 256.000000 ECU_ADDRESS 0xB207F BIT_MASK 0xFF /end MEASUREMENT
/begin MEASUREMENT BED_CC "OperationCode ACC" UBYTE DEZ 0 0 0.000000 256.000000 ECU_ADDRESS 0xB05E6 BIT_MASK 0xFF /end MEASUREMENT
/begin MEASUREMENT BETRIEBK " Betriebsstrecke [100m*0.1s/h /Inc]" UWORD KM2_7CML 0 0 0.000000 182.042000 ECU_ADDRESS 0xB2246 BIT_MASK 0xFFFF /end MEASUREMENT
/begin MEASUREMENT BETRIEBKH " Betriebsstrecke [100m*0.1s/h /Inc*65536]" UWORD KM182ML 0 0 0.000000 11930.300000 ECU_ADDRESS 0xB2248 BIT_MASK 0xFFFF /end MEASUREMENT
/begin MEASUREMENT BETRIEBZ " Betriebsdauer [10s/Inc]" UWORD TQ10SL 0 0 0.000000 655350.000000 ECU_ADDRESS 0xB2242 BIT_MASK 0xFFFF /end MEASUREMENT
/begin MEASUREMENT BETRIEBZH " Betriebsdauer [182std/Inc]" UWORD DEZL 0 0 0.000000 65535.000000 ECU_ADDRESS 0xB2244 BIT_MASK 0xFFFF /end MEASUREMENT
/begin MEASUREMENT BETR_CAN " Betriebstreckenzaehler 9,8m/INC" UWORD KM9_8ML 0 0 0.000000 6422.430000 ECU_ADDRESS 0xB0C20 BIT_MASK 0xFFFF /end MEASUREMENT
/begin MEASUREMENT BETR_CANH " Betriebstreckenzaehler 642.2km/INC" UWORD DEZL 0 0 0.000000 65535.000000 ECU_ADDRESS 0xB0C22 BIT_MASK 0xFFFF /end MEASUREMENT
/begin MEASUREMENT BETR_K " 'Kilometerstand' in [100m/Inc]" UWORD KM100ML 0 0 0.000000 6553.500000 ECU_ADDRESS 0xB2B10 BIT_MASK 0xFFFF /end MEASUREMENT
/begin MEASUREMENT BETR_K_H " 'Kilometerstand' in [6553.6km/Inc]" UWORD KM6553KML 0 0 0.000000 786432.000000 ECU_ADDRESS 0xB2B12 BIT_MASK 0xFFFF /end MEASUREMENT
/begin MEASUREMENT BETR_Z " Betriebsdauer in [1min/Inc]" UWORD TQ1MINL 0 0 0.000000 65535.000000 ECU_ADDRESS 0xB2B0C BIT_MASK 0xFFFF /end MEASUREMENT
/begin MEASUREMENT BETR_Z_H " Betriebsdauer in [1092.3std/Inc]" UWORD TQ1092STDL 0 0 0.000000 109227.000000 ECU_ADDRESS 0xB2B0E BIT_MASK 0xFFFF /end MEASUREMENT
/begin MEASUREMENT BFTLMN "Betriebsfenster, min. Last" UBYTE UFUELL 0 0 0.000000 191.250000 ECU_ADDRESS 0xB0A14 BIT_MASK 0xFF /end MEASUREMENT
/begin MEASUREMENT BFTLMX "Betriebsfenster, max. Last" UBYTE UFUELL 0 0 0.000000 191.250000 ECU_ADDRESS 0xB0A15 BIT_MASK 0xFF /end MEASUREMENT
/begin MEASUREMENT BITS100H " Bits GGLSH des 100-ms-Rasters Bank 1" UBYTE DEZ 0 0 0.000000 256.000000 ECU_ADDRESS 0xB1020 BIT_MASK 0xFF /end MEASUREMENT
/begin MEASUREMENT BITS100V " Bits GGLSV des 100-ms-Rasters Bank 1" UBYTE DEZ 0 0 0.000000 256.000000 ECU_ADDRESS 0xB101E BIT_MASK 0xFF /end MEASUREMENT
/begin MEASUREMENT BITS10H "Bits GGLSH des 10ms-Rasters Bank 1" UBYTE DEZ 0 0 0.000000 256.000000 ECU_ADDRESS 0xB1014 BIT_MASK 0xFF /end MEASUREMENT
/begin MEASUREMENT BITS10V "Bits GGLSV des 10ms-Rasters Bank 1" UBYTE DEZ 0 0 0.000000 256.000000 ECU_ADDRESS 0xB1012 BIT_MASK 0xFF /end MEASUREMENT
/begin MEASUREMENT BITS200H " Bits GGLSH des 100-ms-Rasters Bank 2" UBYTE DEZ 0 0 0.000000 256.000000 ECU_ADDRESS 0xB1021 BIT_MASK 0xFF /end MEASUREMENT
/begin MEASUREMENT BITS200V " Bits GGLSV des 100-ms-Rasters Bank 2" UBYTE DEZ 0 0 0.000000 256.000000 ECU_ADDRESS 0xB101F BIT_MASK 0xFF /end MEASUREMENT
/begin MEASUREMENT BITS20H "Bits GGLSH des 10ms-Rasters Bank 2" UBYTE DEZ 0 0 0.000000 256.000000 ECU_ADDRESS 0xB1015 BIT_MASK 0xFF /end MEASUREMENT
/begin MEASUREMENT BITS20V "Bits GGLSV des 10ms-Rasters Bank 2" UBYTE DEZ 0 0 0.000000 256.000000 ECU_ADDRESS 0xB1013 BIT_MASK 0xFF /end MEASUREMENT
/begin MEASUREMENT BK_EVAUS " CIFI-Einspritzung \ Diese Reihen-" UWORD DEZL 0 0 0.000000 65535.000000 ECU_ADDRESS 0xFD1A BIT_MASK 0xFFFF /end MEASUREMENT
/begin MEASUREMENT BOGON_C_UM "Entprellzeit fuer Nachstartaufweitung" UBYTE DEZ 0 0 0.000000 256.000000 ECU_ADDRESS 0xE042 BIT_MASK 0xFF /end MEASUREMENT
/begin MEASUREMENT BOGON_C_UR "DA Entprellzeit fuer Nachstartaufweitung" UBYTE DEZ 0 0 0.000000 256.000000 ECU_ADDRESS 0xB17E7 BIT_MASK 0xFF /end MEASUREMENT
/begin MEASUREMENT BOGON_UR "Byte fuer DA b_bogon_um" UBYTE DEZ 0 0 0.000000 256.000000 ECU_ADDRESS 0xB17E5 BIT_MASK 0xFF /end MEASUREMENT
/begin MEASUREMENT BOS_SW_KE " Powerfailkennung fuer Programmstandsabfrage" UBYTE DEZ 0 0 0.000000 256.000000 ECU_ADDRESS 0xB2936 BIT_MASK 0xFF /end MEASUREMENT
/begin MEASUREMENT BREMS_C_UR " Byte fuer DA brems_c_um" UBYTE DEZ 0 0 0.000000 256.000000 ECU_ADDRESS 0xB17F4 BIT_MASK 0xFF /end MEASUREMENT
/begin MEASUREMENT BREMS_UR " Byte fuer DA b_brems_um" UBYTE DEZ 0 0 0.000000 256.000000 ECU_ADDRESS 0xB17F3 BIT_MASK 0xFF /end MEASUREMENT
/begin MEASUREMENT BSL_UR " Byte fuer DA b_bsl_um" UBYTE DEZ 0 0 0.000000 256.000000 ECU_ADDRESS 0xB17EF BIT_MASK 0xFF /end MEASUREMENT
/begin MEASUREMENT BSZ_UMPRG " Betriebsstreckenzaehler bei letztem Umprogrammiervorgang" UWORD DEZL 0 0 0.000000 65535.000000 ECU_ADDRESS 0xB2B1C BIT_MASK 0xFFFF /end MEASUREMENT
/begin MEASUREMENT BZACC_A_UC " Byte fuer DA bzacc_a_um" UBYTE DEZ 0 0 0.000000 256.000000 ECU_ADDRESS 0xE0C6 BIT_MASK 0xFF /end MEASUREMENT
/begin MEASUREMENT BZACC_A_UR " Byte fuer DA bzacc_a_um" UBYTE DEZ 0 0 0.000000 256.000000 ECU_ADDRESS 0xB181B BIT_MASK 0xFF /end MEASUREMENT
/begin MEASUREMENT BZMSR_A_UC " alter MSR Botschaftszaehler" UBYTE DEZ 0 0 0.000000 256.000000 ECU_ADDRESS 0xE0C0 BIT_MASK 0xFF /end MEASUREMENT
/begin MEASUREMENT BZMSR_A_UR " Byte fuer DA BZMSR_A_UM" UBYTE DEZ 0 0 0.000000 256.000000 ECU_ADDRESS 0xB1814 BIT_MASK 0xFF /end MEASUREMENT
/begin MEASUREMENT BZSGS_A_UC " Byte fuer DA bzsgs_a_um" UBYTE DEZ 0 0 0.000000 256.000000 ECU_ADDRESS 0xE0C3 BIT_MASK 0xFF /end MEASUREMENT
/begin MEASUREMENT BZSGS_A_UR " Byte fuer DA bzsgs_a_um" UBYTE DEZ 0 0 0.000000 256.000000 ECU_ADDRESS 0xB1820 BIT_MASK 0xFF /end MEASUREMENT
/begin MEASUREMENT BZ_MSR " Wert des ASR Botschaftszaehlers" UBYTE DEZ 0 0 0.000000 256.000000 ECU_ADDRESS 0xB0C45 BIT_MASK 0xFF /end MEASUREMENT
/begin MEASUREMENT BZ_MSR_A " alter Wert des ASR Botschaftszaehlers" UBYTE DEZ 0 0 0.000000 256.000000 ECU_ADDRESS 0xB0C44 BIT_MASK 0xFF /end MEASUREMENT
/begin MEASUREMENT CANCONSTS "CAN Control/Status Register" UWORD DEZL 0 0 0.000000 65535.000000 ECU_ADDRESS 0xB0BAE BIT_MASK 0xFFFF /end MEASUREMENT
/begin MEASUREMENT CANSTACC " CAN-Stand ACC" UBYTE DEZ 0 0 0.000000 256.000000 ECU_ADDRESS 0xB05F9 BIT_MASK 0xFF /end MEASUREMENT
/begin MEASUREMENT CANSTASR " CAN-Stand ASR" UBYTE DEZ 0 0 0.000000 256.000000 ECU_ADDRESS 0xB0C3E BIT_MASK 0xFF /end MEASUREMENT
/begin MEASUREMENT CANSTEGS " CAN-Stand EGS" UBYTE DEZ 0 0 0.000000 256.000000 ECU_ADDRESS 0xB0C4E BIT_MASK 0xFF /end MEASUREMENT
/begin MEASUREMENT CAN_STATE " CAN state machine" UBYTE CAN_ZUST 0 0 0.000000 7.000000 ECU_ADDRESS 0xB0BAD BIT_MASK 0xFF /end MEASUREMENT
/begin MEASUREMENT CD_BITS1_W "" UWORD DEZL 0 0 0.000000 65535.000000 ECU_ADDRESS 0xB1000 BIT_MASK 0xFFFF /end MEASUREMENT
/begin MEASUREMENT CD_BITS2_W "" UWORD DEZL 0 0 0.000000 65535.000000 ECU_ADDRESS 0xB1002 BIT_MASK 0xFFFF /end MEASUREMENT
/begin MEASUREMENT CFOXX " Statusbyte aktueller Zustand Bereich" UBYTE DEZ 0 0 0.000000 256.000000 ECU_ADDRESS 0xB25BC BIT_MASK 0xFF /end MEASUREMENT
/begin MEASUREMENT CHKRCYTIME " Wartezeit fuer Checkbyte Diag. W-Ltg." UBYTE TQ10 0 0 0.000000 2.550000 ECU_ADDRESS 0xB0000 BIT_MASK 0xFF /end MEASUREMENT
/begin MEASUREMENT CHNL_A "VS100: 24-Bytes Ausgabepuffer Raster A (tn), SW begrenzt jedoch auf 16" UWORD DEZL 0 0 0.000000 65535.000000 ECU_ADDRESS 0xB0180 BIT_MASK 0xFFFF /end MEASUREMENT
/begin MEASUREMENT CHNL_B "VS100: 32-Bytes Ausgabepuffer Raster B (10ms), SW begrenzt jedoch auf 24" UWORD DEZL 0 0 0.000000 65535.000000 ECU_ADDRESS 0xB0198 BIT_MASK 0xFFFF /end MEASUREMENT
/begin MEASUREMENT CHNL_C "VS100: 40-Bytes Ausgabepuffer Raster C (100ms), SW begrenzt jedoch auf 32" UWORD DEZL 0 0 0.000000 65535.000000 ECU_ADDRESS 0xB01B8 BIT_MASK 0xFFFF /end MEASUREMENT
/begin MEASUREMENT CNT_LAMPE " Timer der Armaturenbrettsteuerung nach Zuendung ein" UBYTE TQ100 0 0 0.000000 25.500000 ECU_ADDRESS 0xB0C83 BIT_MASK 0xFF /end MEASUREMENT
/begin MEASUREMENT CNT_PNAUS " PN-Ausschaltverzoegerungszaehler" UBYTE TQ10 0 0 0.000000 2.550000 ECU_ADDRESS 0xB05A9 BIT_MASK 0xFF /end MEASUREMENT
/begin MEASUREMENT CNT_PNEIN " PN-Einschaltverzoegerungszaehler" UBYTE TQ10 0 0 0.000000 2.550000 ECU_ADDRESS 0xB05A8 BIT_MASK 0xFF /end MEASUREMENT
/begin MEASUREMENT CNT_TMOTLA " Timer fuer Tmot-Lampenansteuerung" UWORD TQ100L 0 0 0.000000 6553.500000 ECU_ADDRESS 0xB0C84 BIT_MASK 0xFFFF /end MEASUREMENT
/begin MEASUREMENT CRYHS "Counter fuer Readinessbildung Sondenheizungs-Diagnose" UBYTE DEZ 0 0 0.000000 256.000000 ECU_ADDRESS 0xB224E BIT_MASK 0xFF /end MEASUREMENT
/begin MEASUREMENT CRYKAT "Counter fuer Readinessbildung Katalysator-Diagnose" UBYTE DEZ 0 0 0.000000 256.000000 ECU_ADDRESS 0xB224F BIT_MASK 0xFF /end MEASUREMENT
/begin MEASUREMENT CRYLS "Counter fuer Readinessbildung Lambdasonden-Diagnose" UBYTE DEZ 0 0 0.000000 256.000000 ECU_ADDRESS 0xB2250 BIT_MASK 0xFF /end MEASUREMENT
/begin MEASUREMENT CRYSLS "Counter fuer Readinessbildung Sekundaerluft-Diagnose" UBYTE DEZ 0 0 0.000000 256.000000 ECU_ADDRESS 0xB2251 BIT_MASK 0xFF /end MEASUREMENT
/begin MEASUREMENT CRYTES "Counter fuer Readinessbildung Tankentlueftungs-Diagnose" UBYTE DEZ 0 0 0.000000 256.000000 ECU_ADDRESS 0xB2252 BIT_MASK 0xFF /end MEASUREMENT
/begin MEASUREMENT CTVRIF1 " Verzoegerungszeitzaehler Bank 1 vor Kat" UBYTE TQ100 0 0 0.000000 25.500000 ECU_ADDRESS 0xB0696 BIT_MASK 0xFF /end MEASUREMENT
/begin MEASUREMENT CTVRIF3 " Verzoegerungszeitzaehler Bank 1 hinter Kat" UBYTE TQ100 0 0 0.000000 25.500000 ECU_ADDRESS 0xB0697 BIT_MASK 0xFF /end MEASUREMENT
/begin MEASUREMENT C_ACMVER " ACC-Momentenvergleich Quant.: 10ms /Inc" UBYTE TQ10 0 0 0.000000 2.550000 ECU_ADDRESS 0xB0C19 BIT_MASK 0xFF /end MEASUREMENT
/begin MEASUREMENT C_CANMUTE "Zeit CAN Mute" UWORD TQ10L 0 0 0.000000 655.350000 ECU_ADDRESS 0xB0BDA BIT_MASK 0xFFFF /end MEASUREMENT
/begin MEASUREMENT C_CANMUTEH "Heilungszeit CAN Mute" UWORD TQ10L 0 0 0.000000 655.350000 ECU_ADDRESS 0xB0BDC BIT_MASK 0xFFFF /end MEASUREMENT
/begin MEASUREMENT C_CANOFF " Zeit CAN BusOff" UWORD TQ10L 0 0 0.000000 655.350000 ECU_ADDRESS 0xB0BD8 BIT_MASK 0xFFFF /end MEASUREMENT
/begin MEASUREMENT C_EGSNP " Entprellzaehler fuer b_egsnp-Bildung" UBYTE TQ10 0 0 0.000000 2.550000 ECU_ADDRESS 0xB05AC BIT_MASK 0xFF /end MEASUREMENT
/begin MEASUREMENT C_EGSNPH " Heilungszaehler b_egsnp-Bildung" UWORD TQ10L 0 0 0.000000 655.350000 ECU_ADDRESS 0xB05B6 BIT_MASK 0xFFFF /end MEASUREMENT
/begin MEASUREMENT C_FAULACC " Anzahl Botschaftsunterbrechungen ACC" UBYTE DEZ 0 0 0.000000 256.000000 ECU_ADDRESS 0xB0BD6 BIT_MASK 0xFF /end MEASUREMENT
/begin MEASUREMENT C_FAULASR " Anzahl Botschaftsunterbrechungen ASR" UBYTE DEZ 0 0 0.000000 256.000000 ECU_ADDRESS 0xB0BD4 BIT_MASK 0xFF /end MEASUREMENT
/begin MEASUREMENT C_FAULBC " Anzahl Botschaftsunterbrechungen NBC" UBYTE DEZ 0 0 0.000000 256.000000 ECU_ADDRESS 0xB0BD3 BIT_MASK 0xFF /end MEASUREMENT
/begin MEASUREMENT C_FAULEGS " Anzahl Botschaftsunterbrechungen EGS" UBYTE DEZ 0 0 0.000000 256.000000 ECU_ADDRESS 0xB0BD5 BIT_MASK 0xFF /end MEASUREMENT
/begin MEASUREMENT C_FAULNBA " Anzahl Botschaftsunterbrechungen NBA" UBYTE DEZ 0 0 0.000000 256.000000 ECU_ADDRESS 0xB0BD7 BIT_MASK 0xFF /end MEASUREMENT
/begin MEASUREMENT C_KUPCHSP "Zeitabregelung B_KUPCHA" UBYTE TQ20 0 0 0.000000 5.100000 ECU_ADDRESS 0xB100D BIT_MASK 0xFF /end MEASUREMENT
/begin MEASUREMENT C_MDACCGR " Mittelungszeit fuer mdaccgr Berechnung*/" UBYTE TQ10 0 0 0.000000 2.550000 ECU_ADDRESS 0xB05CE BIT_MASK 0xFF /end MEASUREMENT
/begin MEASUREMENT C_MGRD " Mittelungszeit fuer mdegsgrd Berechnung*/" UBYTE TQ10 0 0 0.000000 2.550000 ECU_ADDRESS 0xB05C4 BIT_MASK 0xFF /end MEASUREMENT
/begin MEASUREMENT C_MGRDASR " Mittelungszeit fuer mdasrgrd Berechnung*/" UBYTE TQ20 0 0 0.000000 5.100000 ECU_ADDRESS 0xB056E BIT_MASK 0xFF /end MEASUREMENT
/begin MEASUREMENT C_MGRDMSR " Mittelungszeit fuer mdmsrgr Berechnung*/" UBYTE TQ20 0 0 0.000000 5.100000 ECU_ADDRESS 0xB056F BIT_MASK 0xFF /end MEASUREMENT
/begin MEASUREMENT C_NCANOFF "CAN-BusOff Ereigniszaehler" UBYTE DEZ 0 0 0.000000 256.000000 ECU_ADDRESS 0xB0BD2 BIT_MASK 0xFF /end MEASUREMENT
/begin MEASUREMENT C_NOMBC_WF " Zeit fuer fehlende Botschaft 'STATUS B-CAN'" UBYTE TQ10 0 0 0.000000 2.550000 ECU_ADDRESS 0xB0C3D BIT_MASK 0xFF /end MEASUREMENT
/begin MEASUREMENT C_NOWGSEXT "Verzoegerungszeit von wgextcalc " UBYTE TQ10 0 0 0.000000 2.550000 ECU_ADDRESS 0xB05C8 BIT_MASK 0xFF /end MEASUREMENT
/begin MEASUREMENT C_REDA_T "Verlaengerungszeit von B_red_akt " UBYTE TQ10 0 0 0.000000 2.550000 ECU_ADDRESS 0xB05C9 BIT_MASK 0xFF /end MEASUREMENT
/begin MEASUREMENT C_TFAULACC "Zeit Botschaft ohne Unterbrechung ACC" UWORD TQ10L 0 0 0.000000 655.350000 ECU_ADDRESS 0xB0C12 BIT_MASK 0xFFFF /end MEASUREMENT
/begin MEASUREMENT C_TFAULASR "Zeit Botschaft ohne Unterbrechung ASR" UWORD TQ10L 0 0 0.000000 655.350000 ECU_ADDRESS 0xB0C0A BIT_MASK 0xFFFF /end MEASUREMENT
/begin MEASUREMENT C_TFAULBC "Zeit Botschaft ohne Unterbrechung NBC" UWORD TQ10L 0 0 0.000000 655.350000 ECU_ADDRESS 0xB0C06 BIT_MASK 0xFFFF /end MEASUREMENT
/begin MEASUREMENT C_TFAULEGS "Zeit Botschaft ohne Unterbrechung EGS" UWORD TQ10L 0 0 0.000000 655.350000 ECU_ADDRESS 0xB0C0E BIT_MASK 0xFFFF /end MEASUREMENT
/begin MEASUREMENT C_TFAULNBA "Zeit Botschaft ohne Unterbrechung NBA" UWORD TQ10L 0 0 0.000000 655.350000 ECU_ADDRESS 0xB0C16 BIT_MASK 0xFFFF /end MEASUREMENT
/begin MEASUREMENT C_TFGRFDY "Zaehler fuer Entprellung B_fdyfgr" UBYTE DEZ 0 0 0.000000 256.000000 ECU_ADDRESS 0xB0C26 BIT_MASK 0xFF /end MEASUREMENT
/begin MEASUREMENT C_TVFSAM " Zeitverzoegerung fuer Schalten nach P/N" UBYTE TQ10 0 0 0.000000 2.550000 ECU_ADDRESS 0xB109F BIT_MASK 0xFF /end MEASUREMENT
/begin MEASUREMENT C_TVFSEM " Zeitverzoegerung fuer Schalten nach Drive" UBYTE TQ10 0 0 0.000000 2.550000 ECU_ADDRESS 0xB109E BIT_MASK 0xFF /end MEASUREMENT
/begin MEASUREMENT DAL_C_UM " Fehlerzaehler fuer Doppelablage" UBYTE DEZ 0 0 0.000000 256.000000 ECU_ADDRESS 0xB2231 BIT_MASK 0xFF /end MEASUREMENT
/begin MEASUREMENT DASE_STIMU " Stimuli-Eingang wird vom SG-Pin eingelesen" UBYTE DEZ 0 0 0.000000 256.000000 ECU_ADDRESS 0xF9AB BIT_MASK 0xFF /end MEASUREMENT
/begin MEASUREMENT DBDLSV " " UBYTE DEZ 0 0 0.000000 256.000000 ECU_ADDRESS 0xB2146 BIT_MASK 0xFF /end MEASUREMENT
/begin MEASUREMENT DBDLSV1 ">Interne Dauer-Zustands-Bits DLSV Bank1" UBYTE DEZ 0 0 0.000000 256.000000 ECU_ADDRESS 0xB2146 BIT_MASK 0xFF /end MEASUREMENT
/begin MEASUREMENT DFCMFCM "" UBYTE DEZ 0 0 0.000000 256.000000 ECU_ADDRESS 0xB2254 BIT_MASK 0xFF /end MEASUREMENT
/begin MEASUREMENT DFCMNO "" UBYTE DEZ 0 0 0.000000 256.000000 ECU_ADDRESS 0xB2256 BIT_MASK 0xFF /end MEASUREMENT
/begin MEASUREMENT DFCMSFP "" UBYTE DEZ 0 0 0.000000 256.000000 ECU_ADDRESS 0xB2255 BIT_MASK 0xFF /end MEASUREMENT
/begin MEASUREMENT DFP_AP " Letzter eingetragener Fehler als CDK-Wert" UWORD DEZL 0 0 0.000000 65535.000000 ECU_ADDRESS 0xB224C BIT_MASK 0xFFFF /end MEASUREMENT
/begin MEASUREMENT DFRKAB " DFRKA-Auf-/Abregelfaktor" UBYTE FKT256 0 0 0.000000 0.996090 ECU_ADDRESS 0xB0C63 BIT_MASK 0xFF /end MEASUREMENT
/begin MEASUREMENT DGST " Statusbyte Diagnose Drehzahlgerber" UBYTE DEZ 0 0 0.000000 256.000000 ECU_ADDRESS 0xB0C5A BIT_MASK 0xFF /end MEASUREMENT
/begin MEASUREMENT DGTS3 "DGTS3 (siehe %DASE)" SWORD TSQ_S16 0 0 -21845.300000 21844.700000 ECU_ADDRESS 0xB0738 BIT_MASK 0xFFFF /end MEASUREMENT
/begin MEASUREMENT DHL_OLD " alte Raddifferenz" UWORD VQV16L 0 0 0.000000 4095.940000 ECU_ADDRESS 0xF970 BIT_MASK 0xFFFF /end MEASUREMENT
/begin MEASUREMENT DHR_OLD " alte Raddifferenz" UWORD VQV16L 0 0 0.000000 4095.940000 ECU_ADDRESS 0xF972 BIT_MASK 0xFFFF /end MEASUREMENT
/begin MEASUREMENT DIAG_DRAMA " Beginn der Ablage von Diagnosebytes" UBYTE DEZ 0 0 0.000000 256.000000 ECU_ADDRESS 0xB219B BIT_MASK 0xFF /end MEASUREMENT
/begin MEASUREMENT DKAT_AUFB1 "Struktur" UWORD DEZL 0 0 0.000000 65535.000000 ECU_ADDRESS 0xB089A BIT_MASK 0xFFFF /end MEASUREMENT
/begin MEASUREMENT DKAT_AUFB2 "Struktur" UWORD DEZL 0 0 0.000000 65535.000000 ECU_ADDRESS 0xB089C BIT_MASK 0xFFFF /end MEASUREMENT
/begin MEASUREMENT DKVCAN "ueber CAN empfangene DK-Vorgabe linke Zylinderbank" UWORD UDKL 0 0 0.000000 10.112000 ECU_ADDRESS 0xB0654 BIT_MASK 0xFFFF /end MEASUREMENT
/begin MEASUREMENT DLRPER_P " P-Anteil der Stellgroesse Synchro-Regelung" SWORD FKT65536SL 0 0 -0.500000 0.499980 ECU_ADDRESS 0xB035E BIT_MASK 0xFFFF /end MEASUREMENT
/begin MEASUREMENT DLRP_INT_H " High_Word der int. LR-Synch-Integrator-Summe" SWORD FKT65536SL 0 0 -0.500000 0.499980 ECU_ADDRESS 0xB0362 BIT_MASK 0xFFFF /end MEASUREMENT
/begin MEASUREMENT DLRP_INT_L " Low_Word der int. LR-Synch-Integrator-Summe" UWORD DEZL 0 0 0.000000 65535.000000 ECU_ADDRESS 0xB0360 BIT_MASK 0xFFFF /end MEASUREMENT
/begin MEASUREMENT DLSHLOC "Locale Zwischenergebnisse zur internen! Verwendung" UWORD DEZL 0 0 0.000000 65535.000000 ECU_ADDRESS 0xB086A BIT_MASK 0xFFFF /end MEASUREMENT
/begin MEASUREMENT DLSHLOC0 "Locale Zwischenergebnisse zur internen! Verwendung" UWORD DEZ 0 0 0.000000 256.000000 ECU_ADDRESS 0xB086A BIT_MASK 0xFFFF /end MEASUREMENT
/begin MEASUREMENT DLSHLOC1 "Locale Zwischenergebnisse zur internen! Verwendung" UWORD DEZ 0 0 0.000000 256.000000 ECU_ADDRESS 0xB086C BIT_MASK 0xFFFF /end MEASUREMENT
/begin MEASUREMENT DLSHLOC2 "Locale Zwischenergebnisse zur internen! Verwendung" UWORD DEZ 0 0 0.000000 256.000000 ECU_ADDRESS 0xB086E BIT_MASK 0xFFFF /end MEASUREMENT
/begin MEASUREMENT DLSHLOC3 "Locale Zwischenergebnisse zur internen! Verwendung" UWORD DEZ 0 0 0.000000 256.000000 ECU_ADDRESS 0xB0870 BIT_MASK 0xFFFF /end MEASUREMENT
/begin MEASUREMENT DLSSA_AUFB " Byte fuer Struktur" UBYTE DEZ 0 0 0.000000 256.000000 ECU_ADDRESS 0xB0A4D BIT_MASK 0xFF /end MEASUREMENT
/begin MEASUREMENT DLSVLOC " Locale Zwischenergebnisse zur internen! Verwendung" UWORD DEZL 0 0 0.000000 65535.000000 ECU_ADDRESS 0xB084E BIT_MASK 0xFFFF /end MEASUREMENT
/begin MEASUREMENT DLSVLOC0 " Locale Zwischenergebnisse zur internen! Verwendung" UWORD DEZL 0 0 0.000000 65535.000000 ECU_ADDRESS 0xB084E BIT_MASK 0xFFFF /end MEASUREMENT
/begin MEASUREMENT DLSVLOC1 " Locale Zwischenergebnisse zur internen! Verwendung" UWORD DEZL 0 0 0.000000 65535.000000 ECU_ADDRESS 0xB0850 BIT_MASK 0xFFFF /end MEASUREMENT
/begin MEASUREMENT DLSVLOC2 " Locale Zwischenergebnisse zur internen! Verwendung" UWORD DEZL 0 0 0.000000 65535.000000 ECU_ADDRESS 0xB0852 BIT_MASK 0xFFFF /end MEASUREMENT
/begin MEASUREMENT DLSVLOC3 " Locale Zwischenergebnisse zur internen! Verwendung" UWORD DEZL 0 0 0.000000 65535.000000 ECU_ADDRESS 0xB0854 BIT_MASK 0xFFFF /end MEASUREMENT
/begin MEASUREMENT DLURS_AP " Ausgabe von DLURS aus Trommel" SBYTE LUQ_S8 0 0 -94.296300 93.559600 ECU_ADDRESS 0xF9A9 BIT_MASK 0xFF /end MEASUREMENT
/begin MEASUREMENT DLURS_DAT " Differenzbildung Referenzwert aus Daten" SBYTE LUQ_S8 0 0 -94.296300 93.559600 ECU_ADDRESS 0xB07A9 BIT_MASK 0xFF /end MEASUREMENT
/begin MEASUREMENT DLURS_Z2 " Differenzbildung Referenzwert (n-z/2)" SBYTE LUQ_S8 0 0 -94.296300 93.559600 ECU_ADDRESS 0xB07E1 BIT_MASK 0xFF /end MEASUREMENT
/begin MEASUREMENT DLUR_MIN " Minimaler Laufunruhereferenzwert" SBYTE LUQ_S8 0 0 -94.296300 93.559600 ECU_ADDRESS 0xB07E0 BIT_MASK 0xFF /end MEASUREMENT
/begin MEASUREMENT DLUTS "dluts" SBYTE LUQ_S8 0 0 -94.296300 93.559600 ECU_ADDRESS 0xB079A BIT_MASK 0xFF /end MEASUREMENT
/begin MEASUREMENT DMDBITS " DASE Bits" UWORD DEZL 0 0 0.000000 65535.000000 ECU_ADDRESS 0xFDBC BIT_MASK 0xFFFF /end MEASUREMENT
/begin MEASUREMENT DRACMVER " Diagnosebits irreverible ACC abschalten" UBYTE DEZ 0 0 0.000000 256.000000 ECU_ADDRESS 0xB21DB BIT_MASK 0xFF /end MEASUREMENT
/begin MEASUREMENT DRAMATWAL " Flagbyte fuer ATWAL im Dauerram" UBYTE DEZ 0 0 0.000000 256.000000 ECU_ADDRESS 0xB25BA BIT_MASK 0xFF /end MEASUREMENT
/begin MEASUREMENT DRAMBITW1 "" UWORD DEZL 0 0 0.000000 65535.000000 ECU_ADDRESS 0xFDF6 BIT_MASK 0xFFFF /end MEASUREMENT
/begin MEASUREMENT DRAMBITW2 "" UWORD DEZL 0 0 0.000000 65535.000000 ECU_ADDRESS 0xFDF8 BIT_MASK 0xFFFF /end MEASUREMENT
/begin MEASUREMENT DRAMBITW3 "" UWORD DEZL 0 0 0.000000 65535.000000 ECU_ADDRESS 0xFDFA BIT_MASK 0xFFFF /end MEASUREMENT
/begin MEASUREMENT DRCACC " Diagnosebits ACC ueber CAN" UBYTE DEZ 0 0 0.000000 256.000000 ECU_ADDRESS 0xB21D7 BIT_MASK 0xFF /end MEASUREMENT
/begin MEASUREMENT DRCAN " Diagnosebits CAN-Bus" UBYTE DEZ 0 0 0.000000 256.000000 ECU_ADDRESS 0xB21BC BIT_MASK 0xFF /end MEASUREMENT
/begin MEASUREMENT DRCASR " Diagnosebits ASR ueber CAN" UBYTE DEZ 0 0 0.000000 256.000000 ECU_ADDRESS 0xB21D6 BIT_MASK 0xFF /end MEASUREMENT
/begin MEASUREMENT DRCBC " CAN: Nachrichtenfehler BC" UBYTE DEZ 0 0 0.000000 256.000000 ECU_ADDRESS 0xB21BD BIT_MASK 0xFF /end MEASUREMENT
/begin MEASUREMENT DRCEGS " Diagnosebits Getriebeschnittstelle ueber CAN" UBYTE DEZ 0 0 0.000000 256.000000 ECU_ADDRESS 0xB21BE BIT_MASK 0xFF /end MEASUREMENT
/begin MEASUREMENT DRCNBA " Diagnosebits NBA ueber CAN" UBYTE DEZ 0 0 0.000000 256.000000 ECU_ADDRESS 0xB21D8 BIT_MASK 0xFF /end MEASUREMENT
/begin MEASUREMENT DRDG " Diagnose-Bits Drehzahlgeber" UBYTE DEZ 0 0 0.000000 256.000000 ECU_ADDRESS 0xB21A0 BIT_MASK 0xFF /end MEASUREMENT
/begin MEASUREMENT DREKPE " Endstufendiagnose-Bits EKP" UBYTE DEZ 0 0 0.000000 256.000000 ECU_ADDRESS 0xB21B9 BIT_MASK 0xFF /end MEASUREMENT
/begin MEASUREMENT DREV1 " Endstufendiagnose-Bits EV1" UBYTE DEZ 0 0 0.000000 256.000000 ECU_ADDRESS 0xB21B1 BIT_MASK 0xFF /end MEASUREMENT
/begin MEASUREMENT DREV2 " Endstufendiagnose-Bits EV2" UBYTE DEZ 0 0 0.000000 256.000000 ECU_ADDRESS 0xB21B2 BIT_MASK 0xFF /end MEASUREMENT
/begin MEASUREMENT DREV3 " Endstufendiagnose-Bits EV3" UBYTE DEZ 0 0 0.000000 256.000000 ECU_ADDRESS 0xB21B3 BIT_MASK 0xFF /end MEASUREMENT
/begin MEASUREMENT DREV4 " Endstufendiagnose-Bits EV4" UBYTE DEZ 0 0 0.000000 256.000000 ECU_ADDRESS 0xB21B4 BIT_MASK 0xFF /end MEASUREMENT
/begin MEASUREMENT DREV5 " Endstufendiagnose-Bits EV5" UBYTE DEZ 0 0 0.000000 256.000000 ECU_ADDRESS 0xB21B5 BIT_MASK 0xFF /end MEASUREMENT
/begin MEASUREMENT DRFELA " Endstufen-Diagnosebits Fehlerlampe" UBYTE DEZ 0 0 0.000000 256.000000 ECU_ADDRESS 0xB21B8 BIT_MASK 0xFF /end MEASUREMENT
/begin MEASUREMENT DRFGRE " Endstufen Diagnose FGR-Lampe" UBYTE DEZ 0 0 0.000000 256.000000 ECU_ADDRESS 0xB21CF BIT_MASK 0xFF /end MEASUREMENT
/begin MEASUREMENT DRHFM " Diagnosebits Luftmassenmesser HFM" UBYTE DEZ 0 0 0.000000 256.000000 ECU_ADDRESS 0xB219C BIT_MASK 0xFF /end MEASUREMENT
/begin MEASUREMENT DRHSH " Diagnose-Bits Sondenheizer hinter Kat Bank1" UBYTE DEZ 0 0 0.000000 256.000000 ECU_ADDRESS 0xB21CB BIT_MASK 0xFF /end MEASUREMENT
/begin MEASUREMENT DRHSV " Diagnose-Bits Sondenheizer vor Kat" UBYTE DEZ 0 0 0.000000 256.000000 ECU_ADDRESS 0xB21CA BIT_MASK 0xFF /end MEASUREMENT
/begin MEASUREMENT DRKAT1 " Diagnosebits fuer Katalysatorkonvertierung Bank1" UBYTE DEZ 0 0 0.000000 256.000000 ECU_ADDRESS 0xB21D1 BIT_MASK 0xFF /end MEASUREMENT
/begin MEASUREMENT DRKOSE " Endstufen-Diagnosebits fuer Klimakompressor" UBYTE DEZ 0 0 0.000000 256.000000 ECU_ADDRESS 0xB21B7 BIT_MASK 0xFF /end MEASUREMENT
/begin MEASUREMENT DRKRHW " Diagnosebits KR - HW - Test B2_BI" UBYTE DEZ 0 0 0.000000 256.000000 ECU_ADDRESS 0xB21AB BIT_MASK 0xFF /end MEASUREMENT
/begin MEASUREMENT DRKRS1 " Diagnosebits KR - Sensor1 - Abfall" UBYTE DEZ 0 0 0.000000 256.000000 ECU_ADDRESS 0xB21AC BIT_MASK 0xFF /end MEASUREMENT
/begin MEASUREMENT DRKRS2 " Diagnosebits KR - Sensor2 - Abfall" UBYTE DEZ 0 0 0.000000 256.000000 ECU_ADDRESS 0xB21AD BIT_MASK 0xFF /end MEASUREMENT
/begin MEASUREMENT DRKUPPL " Diagnosebits EGS-SG schaltet Motorsteuerung ab" UBYTE DEZ 0 0 0.000000 256.000000 ECU_ADDRESS 0xB21DA BIT_MASK 0xFF /end MEASUREMENT
/begin MEASUREMENT DRLASH1 " Diagnosebits Lambdasonden-Alterung hinter Kat" UBYTE DEZ 0 0 0.000000 256.000000 ECU_ADDRESS 0xB21C9 BIT_MASK 0xFF /end MEASUREMENT
/begin MEASUREMENT DRLATP1 " Diagnosebits Lambdasonden-Alterung TP" UBYTE DEZ 0 0 0.000000 256.000000 ECU_ADDRESS 0xB21C7 BIT_MASK 0xFF /end MEASUREMENT
/begin MEASUREMENT DRLATV1 " Diagnosebits Lambdasonden-Alterung TV" UBYTE DEZ 0 0 0.000000 256.000000 ECU_ADDRESS 0xB21C8 BIT_MASK 0xFF /end MEASUREMENT
/begin MEASUREMENT DRLFR " LFR-Diagnose" UBYTE DEZ 0 0 0.000000 256.000000 ECU_ADDRESS 0xB21AA BIT_MASK 0xFF /end MEASUREMENT
/begin MEASUREMENT DRLSH1 " Diagnosebits Lambda-Sonde hinter Kat Bank 1" UBYTE DEZ 0 0 0.000000 256.000000 ECU_ADDRESS 0xB21C6 BIT_MASK 0xFF /end MEASUREMENT
/begin MEASUREMENT DRLSV1 " Diagnosebits Lambdasondendiagn. vor Kat Bank1" UBYTE DEZ 0 0 0.000000 256.000000 ECU_ADDRESS 0xB21C5 BIT_MASK 0xFF /end MEASUREMENT
/begin MEASUREMENT DRLUES1 " Endstufen-Diagnosebits fuer Luefter Stufe 1" UBYTE DEZ 0 0 0.000000 256.000000 ECU_ADDRESS 0xB21AF BIT_MASK 0xFF /end MEASUREMENT
/begin MEASUREMENT DRLUES2 " Endstufen-Diagnosebits fuer Luefter Stufe 2" UBYTE DEZ 0 0 0.000000 256.000000 ECU_ADDRESS 0xB21B0 BIT_MASK 0xFF /end MEASUREMENT
/begin MEASUREMENT DRMD " Diagnosebits kat.schaedigender Aussetzer Summe" UBYTE DEZ 0 0 0.000000 256.000000 ECU_ADDRESS 0xB21BF BIT_MASK 0xFF /end MEASUREMENT
/begin MEASUREMENT DRMD1 " Diagnosebits kat.schaedigender Aussetzer (Soft-Zyl.1)" UBYTE DEZ 0 0 0.000000 256.000000 ECU_ADDRESS 0xB21C0 BIT_MASK 0xFF /end MEASUREMENT
/begin MEASUREMENT DRMD2 " Diagnosebits kat.schaedigender Aussetzer (Soft-Zyl.2)" UBYTE DEZ 0 0 0.000000 256.000000 ECU_ADDRESS 0xB21C1 BIT_MASK 0xFF /end MEASUREMENT
/begin MEASUREMENT DRMD3 " Diagnosebits kat.schaedigender Aussetzer (Soft-Zyl.3)" UBYTE DEZ 0 0 0.000000 256.000000 ECU_ADDRESS 0xB21C2 BIT_MASK 0xFF /end MEASUREMENT
/begin MEASUREMENT DRMD4 " Diagnosebits kat.schaedigender Aussetzer (Soft-Zyl.4)" UBYTE DEZ 0 0 0.000000 256.000000 ECU_ADDRESS 0xB21C3 BIT_MASK 0xFF /end MEASUREMENT
/begin MEASUREMENT DRMD5 " Diagnosebits kat.schaedigender Aussetzer (Soft-Zyl.5)" UBYTE DEZ 0 0 0.000000 256.000000 ECU_ADDRESS 0xB21C4 BIT_MASK 0xFF /end MEASUREMENT
/begin MEASUREMENT DRMILFB " Mil fremdbestimmt / Mil-f.b. Leitung" UBYTE DEZ 0 0 0.000000 256.000000 ECU_ADDRESS 0xB21D9 BIT_MASK 0xFF /end MEASUREMENT
/begin MEASUREMENT DRNWSE " Endstufendiagnose-Bits NWS" UBYTE DEZ 0 0 0.000000 256.000000 ECU_ADDRESS 0xB21BB BIT_MASK 0xFF /end MEASUREMENT
/begin MEASUREMENT DRPAC " Diagnosebits Klimadrucksensor" UBYTE DEZ 0 0 0.000000 256.000000 ECU_ADDRESS 0xB21DC BIT_MASK 0xFF /end MEASUREMENT
/begin MEASUREMENT DRPEDST " Diagnose Bits Pedalanschlag" UBYTE DEZ 0 0 0.000000 256.000000 ECU_ADDRESS 0xB21A7 BIT_MASK 0xFF /end MEASUREMENT
/begin MEASUREMENT DRPH " Diagnosebits Phasensensor" UBYTE DEZ 0 0 0.000000 256.000000 ECU_ADDRESS 0xB21A1 BIT_MASK 0xFF /end MEASUREMENT
/begin MEASUREMENT DRSUE " Endstufendiagnose-Bits Saugrohrumschaltung" UBYTE DEZ 0 0 0.000000 256.000000 ECU_ADDRESS 0xB21BA BIT_MASK 0xFF /end MEASUREMENT
/begin MEASUREMENT DRTEVE " Endstufendiagnose-Bits TEV" UBYTE DEZ 0 0 0.000000 256.000000 ECU_ADDRESS 0xB21B6 BIT_MASK 0xFF /end MEASUREMENT
/begin MEASUREMENT DRTFA " Diagnosebits Ansauglufttemperaturfuehler" UBYTE DEZ 0 0 0.000000 256.000000 ECU_ADDRESS 0xB219E BIT_MASK 0xFF /end MEASUREMENT
/begin MEASUREMENT DRTFM " Diagnosebits Motortemperaturfuehler" UBYTE DEZ 0 0 0.000000 256.000000 ECU_ADDRESS 0xB219D BIT_MASK 0xFF /end MEASUREMENT
/begin MEASUREMENT DRUB " Diagnosebits Batteriespannung" UBYTE DEZ 0 0 0.000000 256.000000 ECU_ADDRESS 0xB21A2 BIT_MASK 0xFF /end MEASUREMENT
/begin MEASUREMENT DRWFS " WFS Fehler" UBYTE DEZ 0 0 0.000000 256.000000 ECU_ADDRESS 0x21AE BIT_MASK 0xFF /end MEASUREMENT
/begin MEASUREMENT DSWEB_HLP " Speicherwert Beschleunigungssensor" UWORD BSCHL_S5L 0 0 -6.251050 6.250860 ECU_ADDRESS 0xF97C BIT_MASK 0xFFFF /end MEASUREMENT
/begin MEASUREMENT DTS " Segmentabw. aktueller Zylinder im aktuellen Betriebsbereich" UWORD DEZL 0 0 0.000000 65535.000000 ECU_ADDRESS 0xB07E6 BIT_MASK 0xFFFF /end MEASUREMENT
/begin MEASUREMENT DTS1 "DTS1 (siehe %DASE)" SWORD TSQ_S16 0 0 -21845.300000 21844.700000 ECU_ADDRESS 0xB072A BIT_MASK 0xFFFF /end MEASUREMENT
/begin MEASUREMENT DTS2 "DTS2 (siehe %DASE)" SWORD TSQ_S16 0 0 -21845.300000 21844.700000 ECU_ADDRESS 0xB072C BIT_MASK 0xFFFF /end MEASUREMENT
/begin MEASUREMENT DTS3 "DTS3 (siehe %DASE)" SWORD TSQ_S16 0 0 -21845.300000 21844.700000 ECU_ADDRESS 0xB072E BIT_MASK 0xFFFF /end MEASUREMENT
/begin MEASUREMENT DTS4 "DTS4 (siehe %DASE)" SWORD TSQ_S16 0 0 -21845.300000 21844.700000 ECU_ADDRESS 0xB0730 BIT_MASK 0xFFFF /end MEASUREMENT
/begin MEASUREMENT DTS5 "DTS5 (siehe %DASE)" SWORD TSQ_S16 0 0 -21845.300000 21844.700000 ECU_ADDRESS 0xB0732 BIT_MASK 0xFFFF /end MEASUREMENT
/begin MEASUREMENT DTS6 "DTS6 (siehe %DASE)" SWORD TSQ_S16 0 0 -21845.300000 21844.700000 ECU_ADDRESS 0xB073A BIT_MASK 0xFFFF /end MEASUREMENT
/begin MEASUREMENT DTSATIME "Abregelzeit ab Uebergang B_ll-->!B_ll" UBYTE TQ100 0 0 0.000000 25.500000 ECU_ADDRESS 0xB0499 BIT_MASK 0xFF /end MEASUREMENT
/begin MEASUREMENT DTSNW "" UWORD DEZL 0 0 0.000000 65535.000000 ECU_ADDRESS 0xB07CE BIT_MASK 0xFFFF /end MEASUREMENT
/begin MEASUREMENT DTSZ "DTSZ (siehe %DASE)" SWORD TSQ_S16 0 0 -21845.300000 21844.700000 ECU_ADDRESS 0xB0734 BIT_MASK 0xFFFF /end MEASUREMENT
/begin MEASUREMENT DTV_B1L " LRA-Integrator.low Bank1 addit. Korr.-Faktor f. EV-Fehler" UWORD DEZL 0 0 0.000000 65535.000000 ECU_ADDRESS 0xB2028 BIT_MASK 0xFFFF /end MEASUREMENT
/begin MEASUREMENT DTV_B2L " dto. Bank2" UWORD DEZL 0 0 0.000000 65535.000000 ECU_ADDRESS 0xB202C BIT_MASK 0xFFFF /end MEASUREMENT
/begin MEASUREMENT DUSHKAB " dynamische Ueberhoehung des Spannungssollwertes hinter Kat, Bank1 und Bank2" UBYTE U0V_1V25 0 0 0.000000 1.245120 ECU_ADDRESS 0xB03C2 BIT_MASK 0xFF /end MEASUREMENT
/begin MEASUREMENT DV " Delta V zwischen 2 Berechnungen" UWORD VQV16L 0 0 0.000000 4095.940000 ECU_ADDRESS 0xB04E8 BIT_MASK 0xFFFF /end MEASUREMENT
/begin MEASUREMENT DVL_OLD " alte Raddifferenz" UWORD VQV16L 0 0 0.000000 4095.940000 ECU_ADDRESS 0xF96C BIT_MASK 0xFFFF /end MEASUREMENT
/begin MEASUREMENT DVR_OLD " alte Raddifferenz" UWORD VQV16L 0 0 0.000000 4095.940000 ECU_ADDRESS 0xF96E BIT_MASK 0xFFFF /end MEASUREMENT
/begin MEASUREMENT DW_EXT " Wirkliche ZW-Reduktion EGS+ASR" UBYTE ZWQ 0 0 0.000000 191.250000 ECU_ADDRESS 0xB05A2 BIT_MASK 0xFF /end MEASUREMENT
/begin MEASUREMENT DYNWSE " Pseudo DR_Byte fuer NWS fuer Entprellung" UBYTE DEZ 0 0 0.000000 256.000000 ECU_ADDRESS 0xB182C BIT_MASK 0xFF /end MEASUREMENT
/begin MEASUREMENT DYVT_Z "Abregelzaehler von Adaptionssperrzeit nach Dynamik" UWORD TQ10L 0 0 0.000000 655.350000 ECU_ADDRESS 0xB046C BIT_MASK 0xFFFF /end MEASUREMENT
/begin MEASUREMENT DYZA " Dynamikzustand aktuell" UBYTE PCENT150 0 0 0.000000 149.414000 ECU_ADDRESS 0xB0C66 BIT_MASK 0xFF /end MEASUREMENT
/begin MEASUREMENT DZUEEXT " Zaehler fuer koordinierte ZW-Aenderungsbegrenzung" UBYTE DEZ 0 0 0.000000 256.000000 ECU_ADDRESS 0xB05BC BIT_MASK 0xFF /end MEASUREMENT
/begin MEASUREMENT DZWST08_UC "SST Zuendwinkeldifferenz fuer BT" UWORD DEZ 0 0 0.000000 256.000000 ECU_ADDRESS 0xE0B2 BIT_MASK 0xFFFF /end MEASUREMENT
/begin MEASUREMENT DZWST08_UM " SSt Zuendwinkeldifferenz" UWORD DEZL 0 0 0.000000 65535.000000 ECU_ADDRESS 0xE066 BIT_MASK 0xFFFF /end MEASUREMENT
/begin MEASUREMENT DZWST08_UR " DA SSt Zuendwinkeldifferenz" UWORD DEZL 0 0 0.000000 65535.000000 ECU_ADDRESS 0xB180C BIT_MASK 0xFFFF /end MEASUREMENT
/begin MEASUREMENT DZW_UC "Zuendwinkeldifferenz" UBYTE ZWOF 0 0 -78.000000 24.000000 ECU_ADDRESS 0xE089 BIT_MASK 0xFF /end MEASUREMENT
/begin MEASUREMENT ECUID_CNTR " Merker fuers Schreiben der ECU-Id ins EEPROM" UBYTE DEZ 0 0 0.000000 256.000000 ECU_ADDRESS 0xB0D29 BIT_MASK 0xFF /end MEASUREMENT
/begin MEASUREMENT EEP2BIT1 "" UWORD DEZL 0 0 0.000000 65535.000000 ECU_ADDRESS 0xFDF4 BIT_MASK 0xFFFF /end MEASUREMENT
/begin MEASUREMENT EEPFS02_00 "" UWORD DEZL 0 0 0.000000 65535.000000 ECU_ADDRESS 0xB2B34 BIT_MASK 0xFFFF /end MEASUREMENT
/begin MEASUREMENT EEPFS02_01 "" UWORD DEZL 0 0 0.000000 65535.000000 ECU_ADDRESS 0xB2B36 BIT_MASK 0xFFFF /end MEASUREMENT
/begin MEASUREMENT EEPFS02_02 "" UWORD DEZL 0 0 0.000000 65535.000000 ECU_ADDRESS 0xB2B38 BIT_MASK 0xFFFF /end MEASUREMENT
/begin MEASUREMENT EEPFS02_03 "" UWORD DEZL 0 0 0.000000 65535.000000 ECU_ADDRESS 0xB2B3A BIT_MASK 0xFFFF /end MEASUREMENT
/begin MEASUREMENT EEPFS02_04 "" UWORD DEZL 0 0 0.000000 65535.000000 ECU_ADDRESS 0xB2B3C BIT_MASK 0xFFFF /end MEASUREMENT
/begin MEASUREMENT EEPFS02_05 "" UWORD DEZL 0 0 0.000000 65535.000000 ECU_ADDRESS 0xB2B3E BIT_MASK 0xFFFF /end MEASUREMENT
/begin MEASUREMENT EEPFS02_06 "" UWORD DEZL 0 0 0.000000 65535.000000 ECU_ADDRESS 0xB0000 BIT_MASK 0xFFFF /end MEASUREMENT
/begin MEASUREMENT EEPFS02_07 "" UWORD DEZL 0 0 0.000000 65535.000000 ECU_ADDRESS 0xB0000 BIT_MASK 0xFFFF /end MEASUREMENT
/begin MEASUREMENT EGS_MC " Botschaftszaehler fuer UM" UBYTE DEZ 0 0 0.000000 256.000000 ECU_ADDRESS 0xB05ED BIT_MASK 0xFF /end MEASUREMENT
/begin MEASUREMENT EGS_MC_A "alter Wert Botschaftszaehler" UBYTE DEZ 0 0 0.000000 256.000000 ECU_ADDRESS 0xB05EE BIT_MASK 0xFF /end MEASUREMENT
/begin MEASUREMENT EGS_MESV " Drehzahlanforderung EGS" UWORD NQ1_W 0 0 0.000000 8000.000000 ECU_ADDRESS 0xB05F0 BIT_MASK 0xFFFF /end MEASUREMENT
/begin MEASUREMENT EMS_BITS1 " enthaelt Bits" UBYTE DEZ 0 0 0.000000 256.000000 ECU_ADDRESS 0xB2E46 BIT_MASK 0xFF /end MEASUREMENT
/begin MEASUREMENT ERRORCNTTC "" UBYTE DEZ 0 0 0.000000 256.000000 ECU_ADDRESS 0xB0000 BIT_MASK 0xFF /end MEASUREMENT
/begin MEASUREMENT ESWE_ABM " Ausblendmaske fuer ESWE-Fktn" UBYTE DEZ 0 0 0.000000 256.000000 ECU_ADDRESS 0xB04A0 BIT_MASK 0xFF /end MEASUREMENT
/begin MEASUREMENT ESWE_C " Zaehler Synchroraster" UWORD DEZ 0 0 0.000000 256.000000 ECU_ADDRESS 0xB04A2 BIT_MASK 0xFFFF /end MEASUREMENT
/begin MEASUREMENT ETAZW_UC " Zuendwinkelwirkungsgrad aus CMIST.mcc fuer BT" UBYTE PER255 0 0 0.000000 100.000000 ECU_ADDRESS 0xE09D BIT_MASK 0xFF /end MEASUREMENT
/begin MEASUREMENT ETAZW_UM " Zuendwinkelwirkungsgrad" UBYTE PER255 0 0 0.000000 100.000000 ECU_ADDRESS 0xE029 BIT_MASK 0xFF /end MEASUREMENT
/begin MEASUREMENT EVZ_AUS_UC "Zyl. Abschaltmaske fuer BT" UBYTE DEZ 0 0 0.000000 256.000000 ECU_ADDRESS 0xE088 BIT_MASK 0xFF /end MEASUREMENT
/begin MEASUREMENT EVZ_AUS_UR " Zyl.Abschaltmaske ESausbl." UBYTE PER255 0 0 0.000000 100.000000 ECU_ADDRESS 0xB17B8 BIT_MASK 0xFF /end MEASUREMENT
/begin MEASUREMENT E_FLAGS10 " Errorbits" UBYTE DEZ 0 0 0.000000 256.000000 ECU_ADDRESS 0xFDE6 BIT_MASK 0xFF /end MEASUREMENT
/begin MEASUREMENT E_FLAGS11 " Errorbits" UBYTE DEZ 0 0 0.000000 256.000000 ECU_ADDRESS 0xFDE7 BIT_MASK 0xFF /end MEASUREMENT
/begin MEASUREMENT E_FLAGS12 " Errorbits" UBYTE DEZ 0 0 0.000000 256.000000 ECU_ADDRESS 0xFDE8 BIT_MASK 0xFF /end MEASUREMENT
/begin MEASUREMENT E_FLAGS13 " Errorbits" UBYTE DEZ 0 0 0.000000 256.000000 ECU_ADDRESS 0xFDE9 BIT_MASK 0xFF /end MEASUREMENT
/begin MEASUREMENT E_FLAGS14 " Errorbits" UBYTE DEZ 0 0 0.000000 256.000000 ECU_ADDRESS 0xFDEA BIT_MASK 0xFF /end MEASUREMENT
/begin MEASUREMENT E_FLAGS15 " Errorbits" UBYTE DEZ 0 0 0.000000 256.000000 ECU_ADDRESS 0xFDEB BIT_MASK 0xFF /end MEASUREMENT
/begin MEASUREMENT E_FLAGS16 " Errorbits" UBYTE DEZ 0 0 0.000000 256.000000 ECU_ADDRESS 0xFDEC BIT_MASK 0xFF /end MEASUREMENT
/begin MEASUREMENT E_FLAGS17 " Errorbits" UBYTE DEZ 0 0 0.000000 256.000000 ECU_ADDRESS 0xFDED BIT_MASK 0xFF /end MEASUREMENT
/begin MEASUREMENT E_FLAGS18 " Errorbits" UBYTE DEZ 0 0 0.000000 256.000000 ECU_ADDRESS 0xFDEE BIT_MASK 0xFF /end MEASUREMENT
/begin MEASUREMENT E_FLAGS19 " Errorbits" UBYTE DEZ 0 0 0.000000 256.000000 ECU_ADDRESS 0xFDEF BIT_MASK 0xFF /end MEASUREMENT
/begin MEASUREMENT FBAKL " BA-Faktor Kurz-/Langzeitanteil" UWORD FKT128L 0 0 0.000000 511.992000 ECU_ADDRESS 0xB0478 BIT_MASK 0xFFFF /end MEASUREMENT
/begin MEASUREMENT FBANS "Nachstartfaktor UK" UWORD FKT8192L 0 0 0.000000 7.999880 ECU_ADDRESS 0xB0482 BIT_MASK 0xFFFF /end MEASUREMENT
/begin MEASUREMENT FBAW " DK-Faktor BA" UWORD FKT128L 0 0 0.000000 511.992000 ECU_ADDRESS 0xB0474 BIT_MASK 0xFFFF /end MEASUREMENT
/begin MEASUREMENT FBAWM_R "Interpolierter Faktor aus Kennlinie FBAWM" UBYTE FKT16 0 0 0.000000 15.937500 ECU_ADDRESS 0xB048E BIT_MASK 0xFF /end MEASUREMENT
/begin MEASUREMENT FBAWN_R "Interpolierter Faktor aus Kennlinie FBAWN" UBYTE FKT32 0 0 0.000000 7.968750 ECU_ADDRESS 0xB048C BIT_MASK 0xFF /end MEASUREMENT
/begin MEASUREMENT FCMACTFFT1 "FCM Byte 32, Fehleraktuell Umweltbedingung 1" UBYTE DEZ 0 0 0.000000 256.000000 ECU_ADDRESS 0xB0FE6 BIT_MASK 0xFF /end MEASUREMENT
/begin MEASUREMENT FCMACTFFT2 "FCM Byte 33, Fehleraktuell Umweltbedingung 2" UBYTE DEZ 0 0 0.000000 256.000000 ECU_ADDRESS 0xB0FE7 BIT_MASK 0xFF /end MEASUREMENT
/begin MEASUREMENT FCMACTTIMH "FCM Byte 30, Fehleraktuell Operating time seit powerfail (Quant.=6min) Highbyte" UBYTE DEZ 0 0 0.000000 256.000000 ECU_ADDRESS 0xB0FE4 BIT_MASK 0xFF /end MEASUREMENT
/begin MEASUREMENT FCMACTTIML "FCM Byte 31, Fehleraktuell Operating time seit powerfail (Quant.=6min) Lowbyte" UBYTE DEZ 0 0 0.000000 256.000000 ECU_ADDRESS 0xB0FE5 BIT_MASK 0xFF /end MEASUREMENT
/begin MEASUREMENT FCMCKS "FCM Byte 35, Checksumme" UBYTE DEZ 0 0 0.000000 256.000000 ECU_ADDRESS 0xB0FE9 BIT_MASK 0xFF /end MEASUREMENT
/begin MEASUREMENT FCMCLA "FCM Byte 5, Fehlerklasse" UBYTE DEZ 0 0 0.000000 256.000000 ECU_ADDRESS 0xB0FCB BIT_MASK 0xFF /end MEASUREMENT
/begin MEASUREMENT FCMDFP "FCM Byte 0, Fehlerpfadidentifier" UBYTE DEZ 0 0 0.000000 256.000000 ECU_ADDRESS 0xB0FC6 BIT_MASK 0xFF /end MEASUREMENT
/begin MEASUREMENT FCMDLC "FCM Byte 8, Loeschzaehler" UBYTE DEZ 0 0 0.000000 256.000000 ECU_ADDRESS 0xB0FCE BIT_MASK 0xFF /end MEASUREMENT
/begin MEASUREMENT FCMFES "FCM Byte 4, Fehlereintragsstatus" UBYTE DEZ 0 0 0.000000 256.000000 ECU_ADDRESS 0xB0FCA BIT_MASK 0xFF /end MEASUREMENT
/begin MEASUREMENT FCMFLC "FCM Byte 6, Fehlerentprellung MIL ein - Zaehler" UBYTE DEZ 0 0 0.000000 256.000000 ECU_ADDRESS 0xB0FCC BIT_MASK 0xFF /end MEASUREMENT
/begin MEASUREMENT FCMFLGLRS "FCM Byte 9, CARB FREEZE FRAME Byte, Bank 1, fuer LR" UBYTE DEZ 0 0 0.000000 256.000000 ECU_ADDRESS 0xB0FCF BIT_MASK 0xFF /end MEASUREMENT
/begin MEASUREMENT FCMFLGLRS2 "FCM Byte 10, CARB FREEZE FRAME Byte, Bank 2, fuer LR" UBYTE DEZ 0 0 0.000000 256.000000 ECU_ADDRESS 0xB0FD0 BIT_MASK 0xFF /end MEASUREMENT
/begin MEASUREMENT FCMFPS "FCM Byte 2, Fehlerpfadstatus" UBYTE DEZ 0 0 0.000000 256.000000 ECU_ADDRESS 0xB0FC8 BIT_MASK 0xFF /end MEASUREMENT
/begin MEASUREMENT FCMFR2_U "FCM Byte 15, Lambda-Regler-Ausgang Bank 2(Byte)" UBYTE FAK_UB_B2 0 0 0.000000 1.992190 ECU_ADDRESS 0xB0FD5 BIT_MASK 0xFF /end MEASUREMENT
/begin MEASUREMENT FCMFRA2_U "FCM Byte 16, multiplikative Gemischkorrektur der Gemischadaption (Byte)" UBYTE FAK_UB_B2 0 0 0.000000 1.992190 ECU_ADDRESS 0xB0FD6 BIT_MASK 0xFF /end MEASUREMENT
/begin MEASUREMENT FCMFRA_U "FCM Byte 14, multiplikative Gemischkorrektur der Gemischadaption (Byte)" UBYTE FAK_UB_B2 0 0 0.000000 1.992190 ECU_ADDRESS 0xB0FD4 BIT_MASK 0xFF /end MEASUREMENT
/begin MEASUREMENT FCMFR_U "FCM Byte 13, Lambda-Regler-Ausgang (Byte)" UBYTE FAK_UB_B2 0 0 0.000000 1.992190 ECU_ADDRESS 0xB0FD3 BIT_MASK 0xFF /end MEASUREMENT
/begin MEASUREMENT FCMHLC "FCM Byte 7, Heilungsentprellung MIL aus - Zaehler" UBYTE DEZ 0 0 0.000000 256.000000 ECU_ADDRESS 0xB0FCD BIT_MASK 0xFF /end MEASUREMENT
/begin MEASUREMENT FCMHZ "FCM Byte 34, Haeufigkeitszaehler" UBYTE DEZ 0 0 0.000000 256.000000 ECU_ADDRESS 0xB0FE8 BIT_MASK 0xFF /end MEASUREMENT
/begin MEASUREMENT FCMINIFFT1 "FCM Byte 28, Fehlerinit Umweltbedingung 1" UBYTE DEZ 0 0 0.000000 256.000000 ECU_ADDRESS 0xB0FE2 BIT_MASK 0xFF /end MEASUREMENT
/begin MEASUREMENT FCMINIFFT2 "FCM Byte 29, Fehlerinit Umweltbedingung 2" UBYTE DEZ 0 0 0.000000 256.000000 ECU_ADDRESS 0xB0FE3 BIT_MASK 0xFF /end MEASUREMENT
/begin MEASUREMENT FCMINITIMH "FCM Byte 26, Fehlerinit Operating time seit powerfail (Quant.=6min) Highbyte" UBYTE DEZ 0 0 0.000000 256.000000 ECU_ADDRESS 0xB0FE0 BIT_MASK 0xFF /end MEASUREMENT
/begin MEASUREMENT FCMINITIML "FCM Byte 27, Fehlerinit Operating time seit powerfail (Quant.=6min) Lowbyte" UBYTE DEZ 0 0 0.000000 256.000000 ECU_ADDRESS 0xB0FE1 BIT_MASK 0xFF /end MEASUREMENT
/begin MEASUREMENT FCMLEER "FCM Byte 17, leer" UBYTE DEZ 0 0 0.000000 256.000000 ECU_ADDRESS 0xB0FD7 BIT_MASK 0xFF /end MEASUREMENT
/begin MEASUREMENT FCMNMOT "FCM Byte 18, Drehzahl (Quant.=40Upm)" UBYTE NQ40 0 0 0.000000 10200.000000 ECU_ADDRESS 0xB0FD8 BIT_MASK 0xFF /end MEASUREMENT
/begin MEASUREMENT FCMRML "FCM Byte 11, relative Luftmasse (calc. load value) nach SAE J1979" UBYTE DEZ 0 0 0.000000 256.000000 ECU_ADDRESS 0xB0FD1 BIT_MASK 0xFF /end MEASUREMENT
/begin MEASUREMENT FCMTAB "" UWORD DEZL 0 0 0.000000 65535.000000 ECU_ADDRESS 0xB2260 BIT_MASK 0xFFFF /end MEASUREMENT
/begin MEASUREMENT FCMTMOT_U "FCM Byte 12, FCM Byte, Motor-Temperatur mit def. Quantisierung fuer FSP-Umwelten" UBYTE UTMP_40 0 0 -40.000000 216.000000 ECU_ADDRESS 0xB0FD2 BIT_MASK 0xFF /end MEASUREMENT
/begin MEASUREMENT FCMTSF "FCM Byte 1, Schwerezaehler" UBYTE DEZ 0 0 0.000000 256.000000 ECU_ADDRESS 0xB0FC7 BIT_MASK 0xFF /end MEASUREMENT
/begin MEASUREMENT FCMTYP "FCM Byte 3, Fehlertyp" UBYTE DEZ 0 0 0.000000 256.000000 ECU_ADDRESS 0xB0FC9 BIT_MASK 0xFF /end MEASUREMENT
/begin MEASUREMENT FCMUMWBDG1 "FCM Byte 25, Kundenumweltbedingung 6" UBYTE DEZ 0 0 0.000000 256.000000 ECU_ADDRESS 0xB0FDA BIT_MASK 0xFF /end MEASUREMENT
/begin MEASUREMENT FCMVFZG_U "FCM Byte 19, Fahrzeuggeschwindigkeit, mit def. Quantisierung fuer Tester" UBYTE VFZG_Q1P0 0 0 0.000000 255.000000 ECU_ADDRESS 0xB0FD9 BIT_MASK 0xFF /end MEASUREMENT
/begin MEASUREMENT FDINT "Bewertungsfaktor Spuelratenintegratorsteigung" UBYTE FKT16 0 0 0.000000 15.937500 ECU_ADDRESS 0xB071E BIT_MASK 0xFF /end MEASUREMENT
/begin MEASUREMENT FEHLERSPEI " 18 Fehler a 36 Byte" UWORD DEZL 0 0 0.000000 65535.000000 ECU_ADDRESS 0xB0000 BIT_MASK 0xFFFF /end MEASUREMENT
/begin MEASUREMENT FESDW_R " Maximum aus FESDWM/FESDWZ" UBYTE FKT128 0 0 0.000000 1.992190 ECU_ADDRESS 0xB06C0 BIT_MASK 0xFF /end MEASUREMENT
/begin MEASUREMENT FFON " Statusbyte Uebersicht fuel-on Adaption" UBYTE DEZ 0 0 0.000000 256.000000 ECU_ADDRESS 0xB25BD BIT_MASK 0xFF /end MEASUREMENT
/begin MEASUREMENT FGEZS0 "Zylinderindividueller Faktor fuer Zylinder 0" UBYTE FAKTCIFI 0 0 0.750000 1.250000 ECU_ADDRESS 0xF7F5 BIT_MASK 0xFF /end MEASUREMENT
/begin MEASUREMENT FGEZS1 "Zylinderindividueller Faktor fuer Zylinder 1" UBYTE FAKTCIFI 0 0 0.750000 1.250000 ECU_ADDRESS 0xF7F6 BIT_MASK 0xFF /end MEASUREMENT
/begin MEASUREMENT FGEZS2 "Zylinderindividueller Faktor fuer Zylinder 2" UBYTE FAKTCIFI 0 0 0.750000 1.250000 ECU_ADDRESS 0xF7F7 BIT_MASK 0xFF /end MEASUREMENT
/begin MEASUREMENT FGEZS3 "Zylinderindividueller Faktor fuer Zylinder 3" UBYTE FAKTCIFI 0 0 0.750000 1.250000 ECU_ADDRESS 0xF7F8 BIT_MASK 0xFF /end MEASUREMENT
/begin MEASUREMENT FGEZS4 "Zylinderindividueller Faktor fuer Zylinder 4" UBYTE FAKTCIFI 0 0 0.750000 1.250000 ECU_ADDRESS 0xF7F9 BIT_MASK 0xFF /end MEASUREMENT
/begin MEASUREMENT FGEZS5 "Zylinderindividueller Faktor fuer Zylinder 5" UBYTE FAKTCIFI 0 0 0.750000 1.250000 ECU_ADDRESS 0xF7FA BIT_MASK 0xFF /end MEASUREMENT
/begin MEASUREMENT FGEZS6 "Zylinderindividueller Faktor fuer Zylinder 6" UBYTE FAKTCIFI 0 0 0.750000 1.250000 ECU_ADDRESS 0xF7FB BIT_MASK 0xFF /end MEASUREMENT
/begin MEASUREMENT FGEZS7 "Zylinderindividueller Faktor fuer Zylinder 7" UBYTE FAKTCIFI 0 0 0.750000 1.250000 ECU_ADDRESS 0xF7FC BIT_MASK 0xFF /end MEASUREMENT
/begin MEASUREMENT FGRAB_C " Zaehler fuer Reset B_FGRAB" UBYTE TQ10 0 0 0.000000 2.550000 ECU_ADDRESS 0xB04DB BIT_MASK 0xFF /end MEASUREMENT
/begin MEASUREMENT FGREN_C " Entprellzeitzaehler fuer FGR-Tastenfreigabe" UBYTE TQ20 0 0 0.000000 5.100000 ECU_ADDRESS 0xB04EE BIT_MASK 0xFF /end MEASUREMENT
/begin MEASUREMENT FGREN_UR " Byte fuer DA b_fgren_um" UBYTE DEZ 0 0 0.000000 256.000000 ECU_ADDRESS 0xB17F2 BIT_MASK 0xFF /end MEASUREMENT
/begin MEASUREMENT FGRFKT_ALT " Letzte ausgewaehlte FGR-Funktion" UBYTE DEZ 0 0 0.000000 256.000000 ECU_ADDRESS 0xB04D5 BIT_MASK 0xFF /end MEASUREMENT
/begin MEASUREMENT FGRUM_C " Zaehler fuer Zeit seit Setzen von b_tm_ein" UBYTE TQ20 0 0 0.000000 5.100000 ECU_ADDRESS 0xB04DC BIT_MASK 0xFF /end MEASUREMENT
/begin MEASUREMENT FHAINT " FDKHA-Integrator" UWORD FAK2L 0 0 0.000000 1.999970 ECU_ADDRESS 0xB06D8 BIT_MASK 0xFFFF /end MEASUREMENT
/begin MEASUREMENT FIAXZAD "FIA1ZAD oder FIA2ZAD" UWORD FKT65536 0 0 0.000000 1.000000 ECU_ADDRESS 0xB0736 BIT_MASK 0xFFFF /end MEASUREMENT
/begin MEASUREMENT FKEF "Korrekturfaktor f. KEF, KEFMO" UBYTE FKT64 0 0 0.000000 3.984380 ECU_ADDRESS 0xB0455 BIT_MASK 0xFF /end MEASUREMENT
/begin MEASUREMENT FKMLMA "HFM-Startkorr.-Faktor" UWORD FAK2L 0 0 0.000000 1.999970 ECU_ADDRESS 0xB06C8 BIT_MASK 0xFFFF /end MEASUREMENT
/begin MEASUREMENT FKOR " Gesamt'korrekturfaktor Einspritzung" UWORD FKT256L 0 0 0.000000 256.000000 ECU_ADDRESS 0xB06C6 BIT_MASK 0xFFFF /end MEASUREMENT
/begin MEASUREMENT FKORTLR " Gesamtfaktor aus KFPU u. KFTHFM 100H = '1'" UWORD FKT256L 0 0 0.000000 256.000000 ECU_ADDRESS 0xF95E BIT_MASK 0xFFFF /end MEASUREMENT
/begin MEASUREMENT FKOR_B1 " Gesamtkor.-Faktor BANK1 MSZE-Ebene 1000H ='1'" UWORD FKT4096L 0 0 0.000000 16.000000 ECU_ADDRESS 0xF718 BIT_MASK 0xFFFF /end MEASUREMENT
/begin MEASUREMENT FKOR_B2 " Gesamtkor.-Faktor BANK2 MSZE-Ebene 1000H ='1'" UWORD FKT4096L 0 0 0.000000 16.000000 ECU_ADDRESS 0xF71A BIT_MASK 0xFFFF /end MEASUREMENT
/begin MEASUREMENT FLAG12 "Grundbetriebsbedingungen 1" UWORD DEZL 0 0 0.000000 65535.000000 ECU_ADDRESS 0xFD06 BIT_MASK 0xFFFF /end MEASUREMENT
/begin MEASUREMENT FLAG34 "Grundbetriebsbedingungen 2" UWORD DEZL 0 0 0.000000 65535.000000 ECU_ADDRESS 0xFD08 BIT_MASK 0xFFFF /end MEASUREMENT
/begin MEASUREMENT FLAG56 "" UWORD DEZL 0 0 0.000000 65535.000000 ECU_ADDRESS 0xFD0A BIT_MASK 0xFFFF /end MEASUREMENT
/begin MEASUREMENT FLAG57 "" UWORD DEZL 0 0 0.000000 65535.000000 ECU_ADDRESS 0xFD0C BIT_MASK 0xFFFF /end MEASUREMENT
/begin MEASUREMENT FLAG58 "" UWORD DEZL 0 0 0.000000 65535.000000 ECU_ADDRESS 0xFD0C BIT_MASK 0xFFFF /end MEASUREMENT
/begin MEASUREMENT FLGB_AUS " Flagbyte Ausgangssignal" UBYTE DEZ 0 0 0.000000 256.000000 ECU_ADDRESS 0xFD07 BIT_MASK 0xFF /end MEASUREMENT
/begin MEASUREMENT FLGB_EIN " Flagbyte Eingangssignale" UBYTE DEZ 0 0 0.000000 256.000000 ECU_ADDRESS 0xFD06 BIT_MASK 0xFF /end MEASUREMENT
/begin MEASUREMENT FLGB_TP1 " Flagbyte Tempomatsignale 1" UBYTE DEZ 0 0 0.000000 256.000000 ECU_ADDRESS 0xFD0A BIT_MASK 0xFF /end MEASUREMENT
/begin MEASUREMENT FLGB_TP2 " Flagbyte Tempomatsignale 2" UBYTE DEZ 0 0 0.000000 256.000000 ECU_ADDRESS 0xFD0B BIT_MASK 0xFF /end MEASUREMENT
/begin MEASUREMENT FLN_FRACT " Nachkommastellen (16bit) negativer Lernfortschrittsfilter" UWORD DEZL 0 0 0.000000 65535.000000 ECU_ADDRESS 0xB0806 BIT_MASK 0xFFFF /end MEASUREMENT
/begin MEASUREMENT FLP_FRACT " Nachkommastellen (16bit) positiver Lernfortschrittsfilter" UWORD DEZL 0 0 0.000000 65535.000000 ECU_ADDRESS 0xB07F8 BIT_MASK 0xFFFF /end MEASUREMENT
/begin MEASUREMENT FLRUB_CT "Entprellzaehler E_UB" UBYTE TQ100 0 0 0.000000 25.500000 ECU_ADDRESS 0xB0A7B BIT_MASK 0xFF /end MEASUREMENT
/begin MEASUREMENT FLURM ">" UBYTE FKT128 0 0 0.000000 1.992190 ECU_ADDRESS 0xB07B1 BIT_MASK 0xFF /end MEASUREMENT
/begin MEASUREMENT FLUTS "fluts" SWORD LUQ256_S16 0 0 -94.296300 94.293400 ECU_ADDRESS 0xB0788 BIT_MASK 0xFFFF /end MEASUREMENT
/begin MEASUREMENT FMDIASRL " relative Momentenreduktion ASRL" UBYTE PER255 0 0 0.000000 100.000000 ECU_ADDRESS 0xB0570 BIT_MASK 0xFF /end MEASUREMENT
/begin MEASUREMENT FMDIASRS " relative Momentenreduktion ASRS" UBYTE PER255 0 0 0.000000 100.000000 ECU_ADDRESS 0xB0571 BIT_MASK 0xFF /end MEASUREMENT
/begin MEASUREMENT FMDIEGS " relative Momentenreduktion EGS" UBYTE PER255 0 0 0.000000 100.000000 ECU_ADDRESS 0xB0583 BIT_MASK 0xFF /end MEASUREMENT
/begin MEASUREMENT FMDIMSR " Sollmoment ohne Selespeed-Anforderung" UBYTE PCENT 0 0 0.000000 99.609400 ECU_ADDRESS 0xB0562 BIT_MASK 0xFF /end MEASUREMENT
/begin MEASUREMENT FNS0 " Tiefpass-Initialisierungswert" UBYTE FKT128 0 0 0.000000 1.992190 ECU_ADDRESS 0xB0495 BIT_MASK 0xFF /end MEASUREMENT
/begin MEASUREMENT FNSTPO " Tiefpass-Ausgangswert (Vorkomma)" UBYTE FKT128 0 0 0.000000 1.992190 ECU_ADDRESS 0xB0496 BIT_MASK 0xFF /end MEASUREMENT
/begin MEASUREMENT FPVDK_W "Korrekturfaktor Druck vor Drosselklappe 16-Bit" UWORD FAK_UW_B4 0 0 0.000000 3.999940 ECU_ADDRESS 0xB0FEE BIT_MASK 0xFFFF /end MEASUREMENT
/begin MEASUREMENT FR1B1_SLH "AKATB1: Ergebnis Filter 1" UWORD DEZL 0 0 0.000000 65535.000000 ECU_ADDRESS 0xB0000 BIT_MASK 0xFFFF /end MEASUREMENT
/begin MEASUREMENT FR1B2_SLH "AKATB1: Ergebnis Filter 2" UWORD DEZL 0 0 0.000000 65535.000000 ECU_ADDRESS 0xB0000 BIT_MASK 0xFFFF /end MEASUREMENT
/begin MEASUREMENT FR2B1_S16 "AKATB1: Algorithmus" UWORD DEZL 0 0 0.000000 65535.000000 ECU_ADDRESS 0xB08E2 BIT_MASK 0xFFFF /end MEASUREMENT
/begin MEASUREMENT FR2B2_S16 "AKATB2: Algorithmus" UWORD DEZL 0 0 0.000000 65535.000000 ECU_ADDRESS 0xB08E4 BIT_MASK 0xFFFF /end MEASUREMENT
/begin MEASUREMENT FR2BB1_S16 "AKATB1: Filter 2- Wert" UWORD DEZL 0 0 0.000000 65535.000000 ECU_ADDRESS 0xB08DA BIT_MASK 0xFFFF /end MEASUREMENT
/begin MEASUREMENT FR2BB1_SLH "AKATB2: Ergebnis Filter 1" UWORD DEZL 0 0 0.000000 65535.000000 ECU_ADDRESS 0xB0000 BIT_MASK 0xFFFF /end MEASUREMENT
/begin MEASUREMENT FR2BB2_S16 "AKATB2: Filter 2- Wert" UWORD DEZL 0 0 0.000000 65535.000000 ECU_ADDRESS 0xB08DC BIT_MASK 0xFFFF /end MEASUREMENT
/begin MEASUREMENT FR2BB2_SLH "AKATB2: Ergebnis Filter 1" UWORD DEZL 0 0 0.000000 65535.000000 ECU_ADDRESS 0xB0000 BIT_MASK 0xFFFF /end MEASUREMENT
/begin MEASUREMENT FR3B1_S16 "AKATB1: Algorithmus" UWORD DEZL 0 0 0.000000 65535.000000 ECU_ADDRESS 0xB08DE BIT_MASK 0xFFFF /end MEASUREMENT
/begin MEASUREMENT FR3B2_S16 "AKATB2: Algorithmus" UWORD DEZL 0 0 0.000000 65535.000000 ECU_ADDRESS 0xB08E0 BIT_MASK 0xFFFF /end MEASUREMENT
/begin MEASUREMENT FRAO_B1L "LRA-Integrator.low Bank1 multipl. Korr.-Faktor (oberer Luft/Last-Bereich )" UWORD DEZL 0 0 0.000000 65535.000000 ECU_ADDRESS 0xB2014 BIT_MASK 0xFFFF /end MEASUREMENT
/begin MEASUREMENT FRAO_B2L "LRA-Integrator.low Bank2 multipl. Korr.-Faktor" UWORD DEZL 0 0 0.000000 65535.000000 ECU_ADDRESS 0xB2018 BIT_MASK 0xFFFF /end MEASUREMENT
/begin MEASUREMENT FRAU_B1L "LRA-Integrator.low Bank1 multipl. Korr.-Faktor" UWORD DEZL 0 0 0.000000 65535.000000 ECU_ADDRESS 0xB200C BIT_MASK 0xFFFF /end MEASUREMENT
/begin MEASUREMENT FRAU_B2L "LRA-Integrator.low Bank2 multipl. Korr.-Faktor" UWORD DEZL 0 0 0.000000 65535.000000 ECU_ADDRESS 0xB2010 BIT_MASK 0xFFFF /end MEASUREMENT
/begin MEASUREMENT FRM_B1L "Internes gefiltertes FR als Eingansgroesse ..." UWORD DEZL 0 0 0.000000 65535.000000 ECU_ADDRESS 0xB039E BIT_MASK 0xFFFF /end MEASUREMENT
/begin MEASUREMENT FRM_B2L "Internes gefiltertes FR als Eingansgroesse ..." UWORD DEZL 0 0 0.000000 65535.000000 ECU_ADDRESS 0xB03A2 BIT_MASK 0xFFFF /end MEASUREMENT
/begin MEASUREMENT FRPS "FR_B1-Wert nach letztem pos. P-Sprung" UWORD FPC50L 0 0 0.500000 1.499980 ECU_ADDRESS 0xB0388 BIT_MASK 0xFFFF /end MEASUREMENT
/begin MEASUREMENT FR_B1E_S16 "AKATB1: Ergebnis nach Subtraktion 1" UWORD DEZL 0 0 0.000000 65535.000000 ECU_ADDRESS 0xB08C8 BIT_MASK 0xFFFF /end MEASUREMENT
/begin MEASUREMENT FR_B2E_S16 "AKATB2: Ergebnis nach Subtraktion 1" UWORD DEZL 0 0 0.000000 65535.000000 ECU_ADDRESS 0xB08CA BIT_MASK 0xFFFF /end MEASUREMENT
/begin MEASUREMENT FS_FRACT " Nachkommastellen (16bit) Segmentzeitfilter" UWORD DEZL 0 0 0.000000 65535.000000 ECU_ADDRESS 0xB07EA BIT_MASK 0xFFFF /end MEASUREMENT
/begin MEASUREMENT FTEAINT "'FMT:530' Lambdaregelabweichung-Integrator" UWORD SIG32L 0 0 -32.000000 31.999000 ECU_ADDRESS 0xB0710 BIT_MASK 0xFFFF /end MEASUREMENT
/begin MEASUREMENT FTEFVAH "Spuelrate Hold" UWORD FKT512L 0 0 0.000000 128.000000 ECU_ADDRESS 0xB0728 BIT_MASK 0xFFFF /end MEASUREMENT
/begin MEASUREMENT FTPKOR " Korrektur fuer gemessene Periodendauer TP" UBYTE FKT128 0 0 0.000000 1.992190 ECU_ADDRESS 0xB0910 BIT_MASK 0xFF /end MEASUREMENT
/begin MEASUREMENT FVAKL " VA-Faktor Kurz-/Langzeitanteil" UWORD FKT128L 0 0 0.000000 511.992000 ECU_ADDRESS 0xB047A BIT_MASK 0xFFFF /end MEASUREMENT
/begin MEASUREMENT FVANS "Nachstartfaktor UK" UWORD FKT8192L 0 0 0.000000 7.999880 ECU_ADDRESS 0xB0480 BIT_MASK 0xFFFF /end MEASUREMENT
/begin MEASUREMENT FVAW " DK-Faktor VA" UWORD FKT128L 0 0 0.000000 511.992000 ECU_ADDRESS 0xB0476 BIT_MASK 0xFFFF /end MEASUREMENT
/begin MEASUREMENT FVAWM_R "Interpolierter Faktor aus Kennlinie FVAWM" UBYTE FKT16 0 0 0.000000 15.937500 ECU_ADDRESS 0xB048F BIT_MASK 0xFF /end MEASUREMENT
/begin MEASUREMENT FVAWN_R "Interpolierter Faktor aus Kennlinie FVAWN" UBYTE FKT32 0 0 0.000000 7.968750 ECU_ADDRESS 0xB048D BIT_MASK 0xFF /end MEASUREMENT
/begin MEASUREMENT FZABG "" UWORD DEZL 0 0 0.000000 65535.000000 ECU_ADDRESS 0xB0A34 BIT_MASK 0xFFFF /end MEASUREMENT
/begin MEASUREMENT FZABG1 "" UWORD DEZL 0 0 0.000000 65535.000000 ECU_ADDRESS 0xB0A34 BIT_MASK 0xFFFF /end MEASUREMENT
/begin MEASUREMENT FZABG2 "" UWORD DEZL 0 0 0.000000 65535.000000 ECU_ADDRESS 0xB0A36 BIT_MASK 0xFFFF /end MEASUREMENT
/begin MEASUREMENT FZABG3 "" UWORD DEZL 0 0 0.000000 65535.000000 ECU_ADDRESS 0xB0A38 BIT_MASK 0xFFFF /end MEASUREMENT
/begin MEASUREMENT FZABG4 "" UWORD DEZL 0 0 0.000000 65535.000000 ECU_ADDRESS 0xB0A3A BIT_MASK 0xFFFF /end MEASUREMENT
/begin MEASUREMENT FZABG5 "" UWORD DEZL 0 0 0.000000 65535.000000 ECU_ADDRESS 0xB0A3C BIT_MASK 0xFFFF /end MEASUREMENT
/begin MEASUREMENT FZABG6 "" UWORD DEZL 0 0 0.000000 65535.000000 ECU_ADDRESS 0xB0A3E BIT_MASK 0xFFFF /end MEASUREMENT
/begin MEASUREMENT FZABGS "Fehlerzaehler Summe f. abgasrelevante Aussetzer" UWORD DEZL 0 0 0.000000 65535.000000 ECU_ADDRESS 0xB0A1E BIT_MASK 0xFFFF /end MEASUREMENT
/begin MEASUREMENT FZARV "Fehlerzaehler Summe f. abgasrel. Aussetzer f. andere Fkt." UWORD DEZL 0 0 0.000000 65535.000000 ECU_ADDRESS 0xB0A26 BIT_MASK 0xFFFF /end MEASUREMENT
/begin MEASUREMENT FZKAT "" UWORD DEZL 0 0 0.000000 65535.000000 ECU_ADDRESS 0xB0A40 BIT_MASK 0xFFFF /end MEASUREMENT
/begin MEASUREMENT FZKAT1 "" UWORD DEZL 0 0 0.000000 65535.000000 ECU_ADDRESS 0xB0A40 BIT_MASK 0xFFFF /end MEASUREMENT
/begin MEASUREMENT FZKAT2 "" UWORD DEZL 0 0 0.000000 65535.000000 ECU_ADDRESS 0xB0A42 BIT_MASK 0xFFFF /end MEASUREMENT
/begin MEASUREMENT FZKAT3 "" UWORD DEZL 0 0 0.000000 65535.000000 ECU_ADDRESS 0xB0A44 BIT_MASK 0xFFFF /end MEASUREMENT
/begin MEASUREMENT FZKAT4 "" UWORD DEZL 0 0 0.000000 65535.000000 ECU_ADDRESS 0xB0A46 BIT_MASK 0xFFFF /end MEASUREMENT
/begin MEASUREMENT FZKAT5 "" UWORD DEZL 0 0 0.000000 65535.000000 ECU_ADDRESS 0xB0A48 BIT_MASK 0xFFFF /end MEASUREMENT
/begin MEASUREMENT FZKAT6 "" UWORD DEZL 0 0 0.000000 65535.000000 ECU_ADDRESS 0xB0A4A BIT_MASK 0xFFFF /end MEASUREMENT
/begin MEASUREMENT FZKATS "Fehlerzaehler Summe f. kat.-schaedigende Aussetzer" UWORD DEZL 0 0 0.000000 65535.000000 ECU_ADDRESS 0xB0A20 BIT_MASK 0xFFFF /end MEASUREMENT
/begin MEASUREMENT FZKATS1 "Fehlerzaehler Summe f. kat.-schaed. Aussetzer Bank1" UWORD DEZL 0 0 0.000000 65535.000000 ECU_ADDRESS 0xB0A22 BIT_MASK 0xFFFF /end MEASUREMENT
/begin MEASUREMENT FZKATS2 "Fehlerzaehler Summe f. kat.-schaed. Aussetzer Bank2" UWORD DEZL 0 0 0.000000 65535.000000 ECU_ADDRESS 0xB0A24 BIT_MASK 0xFFFF /end MEASUREMENT
/begin MEASUREMENT F_FGR_UC " Flagbyte FGr Fktn. fuer BT" UBYTE DEZ 0 0 0.000000 256.000000 ECU_ADDRESS 0xE0A7 BIT_MASK 0xFF /end MEASUREMENT
/begin MEASUREMENT F_FGR_UM "" UBYTE DEZ 0 0 0.000000 256.000000 ECU_ADDRESS 0xE048 BIT_MASK 0xFF /end MEASUREMENT
/begin MEASUREMENT GANG_NCA "Eingelegter Gang (NCA)" UBYTE GANG_NCA 0 0 0.000000 7.000000 ECU_ADDRESS 0xB04F4 BIT_MASK 0xFF /end MEASUREMENT
/begin MEASUREMENT GGFSTBIT " " UBYTE DEZ 0 0 0.000000 256.000000 ECU_ADDRESS 0xB2195 BIT_MASK 0xFF /end MEASUREMENT
/begin MEASUREMENT GGLSTAUFA1 " Wert von RL2 in AUFDLS_S_MSZE" UBYTE DEZ 0 0 0.000000 256.000000 ECU_ADDRESS 0xB108E BIT_MASK 0xFF /end MEASUREMENT
/begin MEASUREMENT GRUND1 "Grundbetriebsbedingungen" UWORD DEZL 0 0 0.000000 65535.000000 ECU_ADDRESS 0xFD04 BIT_MASK 0xFFFF /end MEASUREMENT
/begin MEASUREMENT HGPLZ "> Hintergrundprogrammlaufzeitzaehler [2.6us]" UWORD TEQL 0 0 0.000000 174.760000 ECU_ADDRESS 0xF75A BIT_MASK 0xFFFF /end MEASUREMENT
/begin MEASUREMENT HG_OBGR " Hintergrund-Obergrenze" UWORD UDKL 0 0 0.000000 10.112000 ECU_ADDRESS 0xB0514 BIT_MASK 0xFFFF /end MEASUREMENT
/begin MEASUREMENT HG_UBGR " Hintergrund-Untergrenze" UWORD UDKL 0 0 0.000000 10.112000 ECU_ADDRESS 0xB050E BIT_MASK 0xFFFF /end MEASUREMENT
/begin MEASUREMENT HOEHE " Hoehe vom Drucksensor" UBYTE PAB 0 0 -37.539100 1337.420000 ECU_ADDRESS 0xB0C82 BIT_MASK 0xFF /end MEASUREMENT
/begin MEASUREMENT HPRECHZ "Lese-(Rechen-)Zeiger auf Trommeln (HP-Sync.)" UBYTE DEZ 0 0 0.000000 256.000000 ECU_ADDRESS 0xF9B0 BIT_MASK 0xFF /end MEASUREMENT
/begin MEASUREMENT HPZYLZ " Softwarezylindernummer zugehoerig zu HPRECHZ" UBYTE DEZ 0 0 0.000000 256.000000 ECU_ADDRESS 0xB074D BIT_MASK 0xFF /end MEASUREMENT
/begin MEASUREMENT HWVAR "Hardwarevariante 1-LP,2-HY/C0,3-HY/C1..." UBYTE DEZ 0 0 0.000000 256.000000 ECU_ADDRESS 0xF749 BIT_MASK 0xFF /end MEASUREMENT
/begin MEASUREMENT I10PLZ " Laufzeit von Init. bis 10ms Raster" UWORD TEQ_8L 0 0 0.000000 1398.080000 ECU_ADDRESS 0x0 BIT_MASK 0xFFFF /end MEASUREMENT
/begin MEASUREMENT IKR0 "Klopfintegrator Zyl. 1" UWORD SENSORW 0 0 0.000000 4.999920 ECU_ADDRESS 0xB0400 BIT_MASK 0xFFFF /end MEASUREMENT
/begin MEASUREMENT IKR1 "Klopfintegrator Zyl. 2" UWORD SENSORW 0 0 0.000000 4.999920 ECU_ADDRESS 0xB0402 BIT_MASK 0xFFFF /end MEASUREMENT
/begin MEASUREMENT IKR2 "Klopfintegrator Zyl. 3" UWORD SENSORW 0 0 0.000000 4.999920 ECU_ADDRESS 0xB0404 BIT_MASK 0xFFFF /end MEASUREMENT
/begin MEASUREMENT IKR3 "Klopfintegrator Zyl. 4" UWORD SENSORW 0 0 0.000000 4.999920 ECU_ADDRESS 0xB0406 BIT_MASK 0xFFFF /end MEASUREMENT
/begin MEASUREMENT IKR4 "Klopfintegrator Zyl. 5" UWORD SENSORW 0 0 0.000000 4.999920 ECU_ADDRESS 0xB0408 BIT_MASK 0xFFFF /end MEASUREMENT
/begin MEASUREMENT IKR5 "Klopfintegrator Zyl. 6" UWORD SENSORW 0 0 0.000000 4.999920 ECU_ADDRESS 0xB040A BIT_MASK 0xFFFF /end MEASUREMENT
/begin MEASUREMENT IKR6 "Klopfintegrator Zyl. 7" UWORD SENSORW 0 0 0.000000 4.999920 ECU_ADDRESS 0xB0000 BIT_MASK 0xFFFF /end MEASUREMENT
/begin MEASUREMENT IKR7 "Klopfintegrator Zyl. 8" UWORD SENSORW 0 0 0.000000 4.999920 ECU_ADDRESS 0xB0000 BIT_MASK 0xFFFF /end MEASUREMENT
/begin MEASUREMENT IKRMO "Mom. Klopfintegrator korrigiert" UWORD SENSORW 0 0 0.000000 4.999920 ECU_ADDRESS 0xB0462 BIT_MASK 0xFFFF /end MEASUREMENT
/begin MEASUREMENT IKRMX "Klopfintegratormax aus KRTI" UWORD SENSORW 0 0 0.000000 4.999920 ECU_ADDRESS 0xB0456 BIT_MASK 0xFFFF /end MEASUREMENT
/begin MEASUREMENT IOLI_STGLD " aktuell bedientes IOLI" UBYTE DEZ 0 0 0.000000 256.000000 ECU_ADDRESS 0xB0D24 BIT_MASK 0xFF /end MEASUREMENT
/begin MEASUREMENT IP1SLL "letzter bei B_LL und b_VNUL erfasster IP1SN Wert" UBYTE PER_DKA 0 0 0.000000 100.000000 ECU_ADDRESS 0xB05A7 BIT_MASK 0xFF /end MEASUREMENT
/begin MEASUREMENT IP4KOR " IP4 Korrektur 0.0 bis 1.999 8000h = 1.0" UWORD DEZL 0 0 0.000000 65535.000000 ECU_ADDRESS 0xB222E BIT_MASK 0xFFFF /end MEASUREMENT
/begin MEASUREMENT IPA_C_UM " Fehlerzaehler IPxS-Vergleich mit unt. Anschlag" UBYTE DEZ 0 0 0.000000 256.000000 ECU_ADDRESS 0xE021 BIT_MASK 0xFF /end MEASUREMENT
/begin MEASUREMENT IPA_C_UR "Fehlerzaehler IPxS-Vergleich unterer Anschlag" UBYTE DEZ 0 0 0.000000 256.000000 ECU_ADDRESS 0xB17CA BIT_MASK 0xFF /end MEASUREMENT
/begin MEASUREMENT IPSNST08_U " SSt Istwert" UWORD DEZL 0 0 0.000000 65535.000000 ECU_ADDRESS 0x0 BIT_MASK 0xFFFF /end MEASUREMENT
/begin MEASUREMENT IPSN_UC " normiertes, aktuelles Istwertsignal BT" UBYTE PER_DKA 0 0 0.000000 100.000000 ECU_ADDRESS 0xE0F4 BIT_MASK 0xFF /end MEASUREMENT
/begin MEASUREMENT IPSN_UR " DA normiertes, aktuelles Istwertsignal " UBYTE PER_DKA 0 0 0.000000 100.000000 ECU_ADDRESS 0x17EE BIT_MASK 0xFF /end MEASUREMENT
/begin MEASUREMENT IUINT "Klopfintegratorspannung unkorrigiert" UWORD DEZL 0 0 0.000000 65535.000000 ECU_ADDRESS 0xF6CA BIT_MASK 0xFFFF /end MEASUREMENT
/begin MEASUREMENT IUSHB1 "Lambda-Sonde 1 (hK) belastet" UWORD DEZL 0 0 0.000000 65535.000000 ECU_ADDRESS 0xB03DE BIT_MASK 0xFFFF /end MEASUREMENT
/begin MEASUREMENT IUSHB2 "Lambda-Sonde 2 (hK) belastet" UWORD DEZL 0 0 0.000000 65535.000000 ECU_ADDRESS 0xB03E0 BIT_MASK 0xFFFF /end MEASUREMENT
/begin MEASUREMENT IUSHO1 "Lambda-Sonde 1 (hK) ohne Belastung" UWORD DEZL 0 0 0.000000 65535.000000 ECU_ADDRESS 0xB03E6 BIT_MASK 0xFFFF /end MEASUREMENT
/begin MEASUREMENT IUSHO2 "Lambda-Sonde 2 (hK) ohne Belastung" UWORD DEZL 0 0 0.000000 65535.000000 ECU_ADDRESS 0xB03E8 BIT_MASK 0xFFFF /end MEASUREMENT
/begin MEASUREMENT IUSVB1 "Lambda-Sonde 1 (vK) belastet" UWORD DEZL 0 0 0.000000 65535.000000 ECU_ADDRESS 0xB03DA BIT_MASK 0xFFFF /end MEASUREMENT
/begin MEASUREMENT IUSVB2 "Lambda-Sonde 2 (vK) belastet" UWORD DEZL 0 0 0.000000 65535.000000 ECU_ADDRESS 0xB03DC BIT_MASK 0xFFFF /end MEASUREMENT
/begin MEASUREMENT IUSVO1 "Lambda-Sonde 1 (vK) ohne Belastung" UWORD DEZL 0 0 0.000000 65535.000000 ECU_ADDRESS 0xB03E2 BIT_MASK 0xFFFF /end MEASUREMENT
/begin MEASUREMENT IUSVO2 "Lambda-Sonde 2 (vK) ohne Belastung" UWORD DEZL 0 0 0.000000 65535.000000 ECU_ADDRESS 0xB03E4 BIT_MASK 0xFFFF /end MEASUREMENT
/begin MEASUREMENT IVZABG " Intervallzaehler fuer abgasrelevante Aussetzer (0-1000 KW-Umdr. bzw. 0-500 NW-U" UWORD DEZL 0 0 0.000000 65535.000000 ECU_ADDRESS 0xB0A2E BIT_MASK 0xFFFF /end MEASUREMENT
/begin MEASUREMENT IVZARV " Intervallzaehler fuer abgasrel. Aussetzer (0-60 Kw-Umdr. bzw. 0-30 NW-Um.)" UWORD DEZL 0 0 0.000000 65535.000000 ECU_ADDRESS 0xB0A32 BIT_MASK 0xFFFF /end MEASUREMENT
/begin MEASUREMENT IVZKAT " Intervallzaehler fuer katschaedigende Aussetzer (0-200 Kw-Umdr. bzw. 0-100 NW-U" UWORD DEZL 0 0 0.000000 65535.000000 ECU_ADDRESS 0xB0A30 BIT_MASK 0xFFFF /end MEASUREMENT
/begin MEASUREMENT I_FON " Index tl,n intern, ab 0,0" UWORD DEZL 0 0 0.000000 65535.000000 ECU_ADDRESS 0xB07B8 BIT_MASK 0xFFFF /end MEASUREMENT
/begin MEASUREMENT I_NFON " Index ,n intern, ab 0" UBYTE DEZ 0 0 0.000000 256.000000 ECU_ADDRESS 0xB07B8 BIT_MASK 0xFF /end MEASUREMENT
/begin MEASUREMENT I_TLFON " Index tl, intern, ab 0" UBYTE DEZ 0 0 0.000000 256.000000 ECU_ADDRESS 0xB07B9 BIT_MASK 0xFF /end MEASUREMENT
/begin MEASUREMENT KATBF1AU16 "AHKATB1: neuer/alter Wert" UWORD DEZL 0 0 0.000000 65535.000000 ECU_ADDRESS 0xB0000 BIT_MASK 0xFFFF /end MEASUREMENT
/begin MEASUREMENT KATBF1_U8 "AHKATB1: Wert nach Transfer Filter 1 Bank1" UBYTE DEZ 0 0 0.000000 256.000000 ECU_ADDRESS 0xB0892 BIT_MASK 0xFF /end MEASUREMENT
/begin MEASUREMENT KATBF2 "Signal2 nach Speicher normiert Bank2" UBYTE U0V_1V33 0 0 0.000000 1.330000 ECU_ADDRESS 0xB0879 BIT_MASK 0xFF /end MEASUREMENT
/begin MEASUREMENT KATBF2AU16 "AHKATB2: neuer/alter Wert" UWORD DEZL 0 0 0.000000 65535.000000 ECU_ADDRESS 0xB0000 BIT_MASK 0xFFFF /end MEASUREMENT
/begin MEASUREMENT KATBF2_U8 "AHKATB2: Wert nach Transfer Filter 1 Bank2" UBYTE DEZ 0 0 0.000000 256.000000 ECU_ADDRESS 0xB0893 BIT_MASK 0xFF /end MEASUREMENT
/begin MEASUREMENT KATBFE1_S8 "AKATB1: Eingangsdifferenz Filter 3" UBYTE DEZ 0 0 0.000000 256.000000 ECU_ADDRESS 0xB0898 BIT_MASK 0xFF /end MEASUREMENT
/begin MEASUREMENT KATBFE2_S8 "AKATB2: Eingangsdifferenz Filter 3" UBYTE DEZ 0 0 0.000000 256.000000 ECU_ADDRESS 0xB0899 BIT_MASK 0xFF /end MEASUREMENT
/begin MEASUREMENT KATBFF1A16 "AHKATB1: neuer/alter Wert" UWORD DEZL 0 0 0.000000 65535.000000 ECU_ADDRESS 0xB0000 BIT_MASK 0xFFFF /end MEASUREMENT
/begin MEASUREMENT KATBFF2A16 "AHKATB2: neuer/alter Wert" UWORD DEZL 0 0 0.000000 65535.000000 ECU_ADDRESS 0xB0000 BIT_MASK 0xFFFF /end MEASUREMENT
/begin MEASUREMENT KATBFFM116 "AHKATB1: Wert nach Transfer Filter 2 Bank1" UWORD DEZL 0 0 0.000000 65535.000000 ECU_ADDRESS 0xB0000 BIT_MASK 0xFFFF /end MEASUREMENT
/begin MEASUREMENT KATBFFM216 "AHKATB2: Wert nach Transfer Filter 2 Bank2" UWORD DEZL 0 0 0.000000 65535.000000 ECU_ADDRESS 0xB0000 BIT_MASK 0xFFFF /end MEASUREMENT
/begin MEASUREMENT KATBFI2_W "AKATB2: Belastungssignal nach Filter Bank2" SWORD FREQ_512SL 0 0 -512.000000 511.984000 ECU_ADDRESS 0xB08A8 BIT_MASK 0xFFFF /end MEASUREMENT
/begin MEASUREMENT KATBFML_U8 "AKATB1/2: Wert aus KL_KATBFML" UBYTE DEZ 0 0 0.000000 256.000000 ECU_ADDRESS 0xB0894 BIT_MASK 0xFF /end MEASUREMENT
/begin MEASUREMENT KATBFS1_U8 "AHKATB1: Wert nach Subtraktion Bank1" UBYTE DEZ 0 0 0.000000 256.000000 ECU_ADDRESS 0xB088E BIT_MASK 0xFF /end MEASUREMENT
/begin MEASUREMENT KATBFS2 "Signal nach Speicher (Kat- Modell) Bank2" SBYTE FKT128_S 0 0 -1.000000 1.000000 ECU_ADDRESS 0xB0884 BIT_MASK 0xFF /end MEASUREMENT
/begin MEASUREMENT KATBFS2SLH "AKATB2: Ergebnis Integrator" UWORD DEZL 0 0 0.000000 65535.000000 ECU_ADDRESS 0xB0000 BIT_MASK 0xFFFF /end MEASUREMENT
/begin MEASUREMENT KATBFS2_U8 "AHKATB2: Wert nach Subtraktion Bank2" UBYTE DEZ 0 0 0.000000 256.000000 ECU_ADDRESS 0xB088F BIT_MASK 0xFF /end MEASUREMENT
/begin MEASUREMENT KATBFSA216 "AKATB2: Filter 3 Bank2" UWORD DEZL 0 0 0.000000 65535.000000 ECU_ADDRESS 0xB0000 BIT_MASK 0xFFFF /end MEASUREMENT
/begin MEASUREMENT KATBFSAS16 "AKATB1: Filter 3 Bank1" UWORD DEZL 0 0 0.000000 65535.000000 ECU_ADDRESS 0xB0000 BIT_MASK 0xFFFF /end MEASUREMENT
/begin MEASUREMENT KATBFS_SLH "AKATB1: Ergebnis Integrator" UWORD DEZL 0 0 0.000000 65535.000000 ECU_ADDRESS 0xB0000 BIT_MASK 0xFFFF /end MEASUREMENT
/begin MEASUREMENT KATBFXMS16 "DKATSTB1/2: Ergebnis nach KL und Subtraktion 1" UWORD DEZL 0 0 0.000000 65535.000000 ECU_ADDRESS 0xB0000 BIT_MASK 0xFFFF /end MEASUREMENT
/begin MEASUREMENT KATBFXM_U8 "DKATSTB1/2: Ergebnis nach KL" UBYTE DEZ 0 0 0.000000 256.000000 ECU_ADDRESS 0xB0897 BIT_MASK 0xFF /end MEASUREMENT
/begin MEASUREMENT KATBSHV "Offset fuer Lambdaregelung leicht im fetten Bereich" UWORD MLQ0MG868L 0 0 0.000000 56888.000000 ECU_ADDRESS 0xB08C6 BIT_MASK 0xFFFF /end MEASUREMENT
/begin MEASUREMENT KEF "Klopferkenungsfaktor" UBYTE FKT32 0 0 0.000000 7.968750 ECU_ADDRESS 0xB042A BIT_MASK 0xFF /end MEASUREMENT
/begin MEASUREMENT KEF0 "Klopferkenungsfaktor Zyl. 1 (SW)" UBYTE FKT32 0 0 0.000000 7.968750 ECU_ADDRESS 0xB042A BIT_MASK 0xFF /end MEASUREMENT
/begin MEASUREMENT KEF1 "Klopferkenungsfaktor Zyl. 2 (SW)" UBYTE FKT32 0 0 0.000000 7.968750 ECU_ADDRESS 0xB042B BIT_MASK 0xFF /end MEASUREMENT
/begin MEASUREMENT KEF1N_ "IP-Ergebnis Klopferkennungsfaktor 1" UBYTE FKT32 0 0 0.000000 7.968750 ECU_ADDRESS 0xB044C BIT_MASK 0xFF /end MEASUREMENT
/begin MEASUREMENT KEF2 "Klopferkenungsfaktor Zyl. 3 (SW)" UBYTE FKT32 0 0 0.000000 7.968750 ECU_ADDRESS 0xB042C BIT_MASK 0xFF /end MEASUREMENT
/begin MEASUREMENT KEF2N_ "IP-Ergebnis Klopferkennungsfaktor 2" UBYTE FKT32 0 0 0.000000 7.968750 ECU_ADDRESS 0xB044D BIT_MASK 0xFF /end MEASUREMENT
/begin MEASUREMENT KEF3 "Klopferkenungsfaktor Zyl. 4 (SW)" UBYTE FKT32 0 0 0.000000 7.968750 ECU_ADDRESS 0xB042D BIT_MASK 0xFF /end MEASUREMENT
/begin MEASUREMENT KEF3N_ "IP-Ergebnis Klopferkennungsfaktor 3" UBYTE FKT32 0 0 0.000000 7.968750 ECU_ADDRESS 0xB044E BIT_MASK 0xFF /end MEASUREMENT
/begin MEASUREMENT KEF4 "Klopferkenungsfaktor Zyl. 5 (SW)" UBYTE FKT32 0 0 0.000000 7.968750 ECU_ADDRESS 0xB042E BIT_MASK 0xFF /end MEASUREMENT
/begin MEASUREMENT KEF4N_ "IP-Ergebnis Klopferkennungsfaktor 4" UBYTE FKT32 0 0 0.000000 7.968750 ECU_ADDRESS 0xB044F BIT_MASK 0xFF /end MEASUREMENT
/begin MEASUREMENT KEF5 "Klopferkenungsfaktor Zyl. 6 (SW)" UBYTE FKT32 0 0 0.000000 7.968750 ECU_ADDRESS 0xB042F BIT_MASK 0xFF /end MEASUREMENT
/begin MEASUREMENT KEF5N_ "IP-Ergebnis Klopferkennungsfaktor 5" UBYTE FKT32 0 0 0.000000 7.968750 ECU_ADDRESS 0xB0450 BIT_MASK 0xFF /end MEASUREMENT
/begin MEASUREMENT KEF6 "Klopferkenungsfaktor Zyl. 7 (SW)" UBYTE FKT32 0 0 0.000000 7.968750 ECU_ADDRESS 0xB0430 BIT_MASK 0xFF /end MEASUREMENT
/begin MEASUREMENT KEF6N_ "IP-Ergebnis Klopferkennungsfaktor 6" UBYTE FKT32 0 0 0.000000 7.968750 ECU_ADDRESS 0xB0451 BIT_MASK 0xFF /end MEASUREMENT
/begin MEASUREMENT KEF7 "Klopferkenungsfaktor Zyl. 8 (SW)" UBYTE FKT32 0 0 0.000000 7.968750 ECU_ADDRESS 0xB0431 BIT_MASK 0xFF /end MEASUREMENT
/begin MEASUREMENT KEFMO "unselektierter KEF f. Appl." UBYTE FKT32 0 0 0.000000 7.968750 ECU_ADDRESS 0xB0453 BIT_MASK 0xFF /end MEASUREMENT
/begin MEASUREMENT KEYSTS "Key Status" UBYTE DEZ 0 0 0.000000 256.000000 ECU_ADDRESS 0xB0C24 BIT_MASK 0xFF /end MEASUREMENT
/begin MEASUREMENT KFDR_R " Korrekturfaktor Referenzdruck Druckregler" UBYTE FKT256 0 0 0.000000 0.996090 ECU_ADDRESS 0xF960 BIT_MASK 0xFF /end MEASUREMENT
/begin MEASUREMENT KFFTV_R " LRH-ATV-Gewichtung aus KFFTV" UWORD FKT128L 0 0 0.000000 511.992000 ECU_ADDRESS 0xB0396 BIT_MASK 0xFFFF /end MEASUREMENT
/begin MEASUREMENT KFMDHNR " Ergebnis aus KFMDHN" UBYTE F256OFF 0 0 0.500000 1.500000 ECU_ADDRESS 0xB0580 BIT_MASK 0xFF /end MEASUREMENT
/begin MEASUREMENT KFRTV2_R " signed LR-TV-Zeit aus KFRTV, Bank2" SWORD TQ10MSSL 0 0 -327.680000 327.670000 ECU_ADDRESS 0xB0394 BIT_MASK 0xFFFF /end MEASUREMENT
/begin MEASUREMENT KFUSRH_R "Hinterkatsonden-Schwelle High aus KF" UBYTE ULSQ 0 0 0.000000 5.000000 ECU_ADDRESS 0xB037D BIT_MASK 0xFF /end MEASUREMENT
/begin MEASUREMENT KFUSRH_RW "Hinterkatsonden-Schwelle aus KF" UWORD ULSQL 0 0 0.000000 5.000000 ECU_ADDRESS 0xB037C BIT_MASK 0xFFFF /end MEASUREMENT
/begin MEASUREMENT KFUSRH_RWL "Hinterkatsonden-Schwelle Lowbyte" UBYTE ULSQ 0 0 0.000000 5.000000 ECU_ADDRESS 0xB0000 BIT_MASK 0xFF /end MEASUREMENT
/begin MEASUREMENT KMST_SUM " Hilfsgroesse fuer kmstmil_w [1000m/36000 /Inc]" UWORD KM_Q36M_L 0 0 0.000000 1820.420000 ECU_ADDRESS 0xB224A BIT_MASK 0xFFFF /end MEASUREMENT
/begin MEASUREMENT KOP_DESLR " Korr.prog. Desensibilisierung" UBYTE DEZ 0 0 0.000000 256.000000 ECU_ADDRESS 0xB074F BIT_MASK 0xFF /end MEASUREMENT
/begin MEASUREMENT KRANR " Drehz.Stz. fuer adaptive Dyn.-KR bei Beginn Dynamik" UWORD DEZL 0 0 0.000000 65535.000000 ECU_ADDRESS 0xB06E2 BIT_MASK 0xFFFF /end MEASUREMENT
/begin MEASUREMENT KRA_LV " KR-Adaption Lastbereich" UBYTE DEZ 0 0 0.000000 256.000000 ECU_ADDRESS 0xB046F BIT_MASK 0xFF /end MEASUREMENT
/begin MEASUREMENT KRA_NV " KR-Adaption Drehzahlbereich" UBYTE DEZ 0 0 0.000000 256.000000 ECU_ADDRESS 0xB046E BIT_MASK 0xFF /end MEASUREMENT
/begin MEASUREMENT KRA_VA " KR-Adaption Last-Drehzahl-Bereich" UBYTE DEZ 0 0 0.000000 256.000000 ECU_ADDRESS 0xB0470 BIT_MASK 0xFF /end MEASUREMENT
/begin MEASUREMENT KRVF "KR-Abregelstufenbreite [Anz. Verbr.]" UBYTE DEZ 0 0 0.000000 256.000000 ECU_ADDRESS 0xB0444 BIT_MASK 0xFF /end MEASUREMENT
/begin MEASUREMENT KRVFN_ "IP-Ergebnis Klopfabregelwert" UBYTE DEZ 0 0 0.000000 256.000000 ECU_ADDRESS 0xB0447 BIT_MASK 0xFF /end MEASUREMENT
/begin MEASUREMENT KV_TE " te(zyl.nr.) für Verbrauchsermittelung" UWORD TEQL 0 0 0.000000 174.760000 ECU_ADDRESS 0xB0F8E BIT_MASK 0xFFFF /end MEASUREMENT
/begin MEASUREMENT KWP_EEP_T " Timeout-Zaehler fuers Schreiben der ECU-Id" UBYTE TQ10 0 0 0.000000 2.550000 ECU_ADDRESS 0xB0D2A BIT_MASK 0xFF /end MEASUREMENT
/begin MEASUREMENT LAHKSUMI1 " Zustandsautomat LRHK, Summand i, Bank1" UWORD DEZL 0 0 0.000000 65535.000000 ECU_ADDRESS 0xB03D2 BIT_MASK 0xFFFF /end MEASUREMENT
/begin MEASUREMENT LAHKSUMII1 " Zustandsautomat LRHK, Summand ii, Bank1" UWORD DEZL 0 0 0.000000 65535.000000 ECU_ADDRESS 0xB03D4 BIT_MASK 0xFFFF /end MEASUREMENT
/begin MEASUREMENT LAMFR_HLP1 "" UWORD FKT4096L 0 0 0.000000 16.000000 ECU_ADDRESS 0xB0924 BIT_MASK 0xFFFF /end MEASUREMENT
/begin MEASUREMENT LAMLS_HLP1 " Betrag von lamlash1_w - lamsons1_w" UWORD FKT4096L 0 0 0.000000 16.000000 ECU_ADDRESS 0xB0922 BIT_MASK 0xFFFF /end MEASUREMENT
/begin MEASUREMENT LBZ_INT " Ladebilanzintegrator mit Nachkommastellen" UWORD DEZL 0 0 0.000000 65535.000000 ECU_ADDRESS 0xB0F9A BIT_MASK 0xFFFF /end MEASUREMENT
/begin MEASUREMENT LDRDK " DK-Winkel fuer LDR" UBYTE PCENT125 0 0 0.000000 124.512000 ECU_ADDRESS 0xB0C67 BIT_MASK 0xFF /end MEASUREMENT
/begin MEASUREMENT LFR_LRN_ST " Lernstatus 1" UWORD DEZL 0 0 0.000000 65535.000000 ECU_ADDRESS 0xFD20 BIT_MASK 0xFFFF /end MEASUREMENT
/begin MEASUREMENT LFR_ST1 " LFR-Status-Word 1" UWORD DEZL 0 0 0.000000 65535.000000 ECU_ADDRESS 0xFD1C BIT_MASK 0xFFFF /end MEASUREMENT
/begin MEASUREMENT LFR_ST2 " LFR-Status-Word 2" UWORD DEZL 0 0 0.000000 65535.000000 ECU_ADDRESS 0xFD1E BIT_MASK 0xFFFF /end MEASUREMENT
/begin MEASUREMENT LFR_ST3 " LFR-Status-Word 3" UWORD DEZL 0 0 0.000000 65535.000000 ECU_ADDRESS 0x0 BIT_MASK 0xFFFF /end MEASUREMENT
/begin MEASUREMENT LOK_HELP1 " alter Wert von ushkb1" UBYTE U0V_1V25 0 0 0.000000 1.245120 ECU_ADDRESS 0xB0937 BIT_MASK 0xFF /end MEASUREMENT
/begin MEASUREMENT LO_LUM "Lowbyte von LUM_WORD = Nachkommastellen" SBYTE LUQ256_S8 0 0 -0.368340 0.365470 ECU_ADDRESS 0x0 BIT_MASK 0xFF /end MEASUREMENT
/begin MEASUREMENT LO_LUR "Lowbyte von LUR_WORD = Nachkommastellen" SBYTE LUQ256_S8 0 0 -0.368340 0.365470 ECU_ADDRESS 0x0 BIT_MASK 0xFF /end MEASUREMENT
/begin MEASUREMENT LRAFLG "Weitere LRA-Flags: b_frao.bfrau (2-fach-array[BYTE]" UBYTE DEZ 0 0 0.000000 256.000000 ECU_ADDRESS 0xB2034 BIT_MASK 0xFF /end MEASUREMENT
/begin MEASUREMENT LRG_D "y wirksamer D-Anteil -100%=FC00 0%=0000 +100%03ff" UWORD DEZL 0 0 0.000000 65535.000000 ECU_ADDRESS 0xF9D8 BIT_MASK 0xFFFF /end MEASUREMENT
/begin MEASUREMENT LRG_I " Integrator des I-Anteils (Q Highword = 0.025Grad/inc)" UWORD DEZL 0 0 0.000000 65535.000000 ECU_ADDRESS 0xF9C6 BIT_MASK 0xFFFF /end MEASUREMENT
/begin MEASUREMENT LRG_KD " KD-Faktor 0.0 bis 63.99 8000h = 32.0" UWORD DEZL 0 0 0.000000 65535.000000 ECU_ADDRESS 0xF9D2 BIT_MASK 0xFFFF /end MEASUREMENT
/begin MEASUREMENT LRG_KI " KI-Faktor 0.0 bis 3.996 8000h = 2.0" UWORD DEZL 0 0 0.000000 65535.000000 ECU_ADDRESS 0xF9CE BIT_MASK 0xFFFF /end MEASUREMENT
/begin MEASUREMENT LRG_KP " KP-Faktor 0.0 bis 31.99 8000h = 16.0" UWORD DEZL 0 0 0.000000 65535.000000 ECU_ADDRESS 0xF9D0 BIT_MASK 0xFFFF /end MEASUREMENT
/begin MEASUREMENT LRG_PID " begrenzte Summe P + I + D" UWORD DEZL 0 0 0.000000 65535.000000 ECU_ADDRESS 0xF9D4 BIT_MASK 0xFFFF /end MEASUREMENT
/begin MEASUREMENT LRG_PWM "y Ansteuertastverh. 0.0 bis 1.0 0000h bis 8ca0h" UWORD DEZL 0 0 0.000000 65535.000000 ECU_ADDRESS 0xF9D6 BIT_MASK 0xFFFF /end MEASUREMENT
/begin MEASUREMENT LRG_RAST " Rasterzaehler (2),1,0,-1" UBYTE DEZ 0 0 0.000000 256.000000 ECU_ADDRESS 0xF9DE BIT_MASK 0xFF /end MEASUREMENT
/begin MEASUREMENT LRG_X1 " IST-Wert-Filter fuer D-Anteil (Q Highword = 0.025Grad/inc)" UWORD DEZL 0 0 0.000000 65535.000000 ECU_ADDRESS 0xF9BE BIT_MASK 0xFFFF /end MEASUREMENT
/begin MEASUREMENT LRVBV_C " Zaehler fuer KFLRVBA /VA" UBYTE TQ100 0 0 0.000000 25.500000 ECU_ADDRESS 0xB03B7 BIT_MASK 0xFF /end MEASUREMENT
/begin MEASUREMENT LRVXV_R " Speicher fuer KFLRVBA /VA" UBYTE TQ100 0 0 0.000000 25.500000 ECU_ADDRESS 0xB03B8 BIT_MASK 0xFF /end MEASUREMENT
/begin MEASUREMENT LR_ZSTMA " Merker des LR-Master-Zustands" UBYTE DEZ 0 0 0.000000 256.000000 ECU_ADDRESS 0xB033E BIT_MASK 0xFF /end MEASUREMENT
/begin MEASUREMENT LR_ZSTSL " Merker des LR-Slave-Zustands" UBYTE DEZ 0 0 0.000000 256.000000 ECU_ADDRESS 0xB033F BIT_MASK 0xFF /end MEASUREMENT
/begin MEASUREMENT LR_ZUST1 "LR-Zustandsmerker (interne Groesse )" UBYTE DEZ 0 0 0.000000 256.000000 ECU_ADDRESS 0xB0376 BIT_MASK 0xFF /end MEASUREMENT
/begin MEASUREMENT LR_ZUST2 "LR-Zustandsmerker (interne Groesse )" UBYTE DEZ 0 0 0.000000 256.000000 ECU_ADDRESS 0xB0377 BIT_MASK 0xFF /end MEASUREMENT
/begin MEASUREMENT LTCHAUS "" UWORD DEZL 0 0 0.000000 65535.000000 ECU_ADDRESS 0xFD00 BIT_MASK 0xFFFF /end MEASUREMENT
/begin MEASUREMENT LUARD_BG " LUAR_DAT Aenderungsbegrenzt" UBYTE LUQ 0 0 0.000000 187.856000 ECU_ADDRESS 0xB07AA BIT_MASK 0xFF /end MEASUREMENT
/begin MEASUREMENT LUAR_DAT " Abstandsmass Referenzwert aus Daten" UBYTE LUQ 0 0 0.000000 187.856000 ECU_ADDRESS 0xB07A8 BIT_MASK 0xFF /end MEASUREMENT
/begin MEASUREMENT LUM "aktueller LUM-Wert" SBYTE LUQ_S8 0 0 -94.296300 93.559600 ECU_ADDRESS 0xF9B5 BIT_MASK 0xFF /end MEASUREMENT
/begin MEASUREMENT LUM_WORD "LUM als Word" SWORD LUQ256_S16 0 0 -94.296300 94.293400 ECU_ADDRESS 0xF9B4 BIT_MASK 0xFFFF /end MEASUREMENT
/begin MEASUREMENT LUR2_MIN " 2*Minimaler Laufunruhereferenzwert" UBYTE LUQ 0 0 0.000000 187.856000 ECU_ADDRESS 0xB07AE BIT_MASK 0xFF /end MEASUREMENT
/begin MEASUREMENT LURMS ">" SBYTE LUQ_S8 0 0 -94.296300 93.559600 ECU_ADDRESS 0xB07B0 BIT_MASK 0xFF /end MEASUREMENT
/begin MEASUREMENT LUR_ "Wirkender Laufunruhereferenzwert" SBYTE LUQ_S8 0 0 -94.296300 93.559600 ECU_ADDRESS 0xF9B3 BIT_MASK 0xFF /end MEASUREMENT
/begin MEASUREMENT LUR_AP "Ausgabe von LUR aus Trommel" SBYTE LUQ_S8 0 0 -94.296300 93.559600 ECU_ADDRESS 0xF9A2 BIT_MASK 0xFF /end MEASUREMENT
/begin MEASUREMENT LUR_DAT "Interpolierter Laufunruhereferenzwert aus Daten" SBYTE LUQ_S8 0 0 -94.296300 93.559600 ECU_ADDRESS 0xB074B BIT_MASK 0xFF /end MEASUREMENT
/begin MEASUREMENT LUR_KTM " Offset auf LURS/DLURS" SBYTE LUQ_S8 0 0 -94.296300 93.559600 ECU_ADDRESS 0xB07B2 BIT_MASK 0xFF /end MEASUREMENT
/begin MEASUREMENT LUR_MIN "Minimaler Laufunruhereferenzwert" SBYTE LUQ_S8 0 0 -94.296300 93.559600 ECU_ADDRESS 0xB074C BIT_MASK 0xFF /end MEASUREMENT
/begin MEASUREMENT LUR_WIRK " wirkendes LUR (abgesenkt)" SBYTE LUQ_S8 0 0 -94.296300 93.559600 ECU_ADDRESS 0xB07D1 BIT_MASK 0xFF /end MEASUREMENT
/begin MEASUREMENT LUR_WORD "LUR als Word" SWORD LUQ256_S16 0 0 -94.296300 94.293400 ECU_ADDRESS 0xF9B2 BIT_MASK 0xFFFF /end MEASUREMENT
/begin MEASUREMENT LUT10 "aktueller LUT-Wert fuer Zylinder 10" SBYTE LUQ_S8 0 0 -94.296300 93.559600 ECU_ADDRESS 0xB0759 BIT_MASK 0xFF /end MEASUREMENT
/begin MEASUREMENT LUT11 "aktueller LUT-Wert fuer Zylinder 11" SBYTE LUQ_S8 0 0 -94.296300 93.559600 ECU_ADDRESS 0xB075A BIT_MASK 0xFF /end MEASUREMENT
/begin MEASUREMENT LUT12 "aktueller LUT-Wert fuer Zylinder 12" SBYTE LUQ_S8 0 0 -94.296300 93.559600 ECU_ADDRESS 0xB075B BIT_MASK 0xFF /end MEASUREMENT
/begin MEASUREMENT LUT9 "aktueller LUT-Wert fuer Zylinder 9" SBYTE LUQ_S8 0 0 -94.296300 93.559600 ECU_ADDRESS 0xB0758 BIT_MASK 0xFF /end MEASUREMENT
/begin MEASUREMENT LUTFLG_AP " " UWORD DEZL 0 0 0.000000 65535.000000 ECU_ADDRESS 0xF9A0 BIT_MASK 0xFFFF /end MEASUREMENT
/begin MEASUREMENT LUT_AP "Ausgabe von LUT aus Trommel" SBYTE LUQ_S8 0 0 -94.296300 93.559600 ECU_ADDRESS 0xF9A1 BIT_MASK 0xFF /end MEASUREMENT
/begin MEASUREMENT LUT_REF "Referenzwert (DGTS3 oder DTS6 oder 2*DTS6)" SWORD TSQ_S16 0 0 -21845.300000 21844.700000 ECU_ADDRESS 0xB073C BIT_MASK 0xFFFF /end MEASUREMENT
/begin MEASUREMENT MACC_UC " Momentenanforderung vom ACC" UBYTE MMQ 0 0 0.000000 512.000000 ECU_ADDRESS 0xE0C8 BIT_MASK 0xFF /end MEASUREMENT
/begin MEASUREMENT MACC_UR " DA Momentenanforderung ACC" UBYTE MMQ 0 0 0.000000 512.000000 ECU_ADDRESS 0xB181C BIT_MASK 0xFF /end MEASUREMENT
/begin MEASUREMENT MAXFSE " Max. FSE" SBYTE DTSEGN_S8 0 0 -2.250000 2.232420 ECU_ADDRESS 0xB0767 BIT_MASK 0xFF /end MEASUREMENT
/begin MEASUREMENT MDACC "Sollmomentvorgabe von ACC" UBYTE PCENT 0 0 0.000000 99.609400 ECU_ADDRESS 0xB05DC BIT_MASK 0xFF /end MEASUREMENT
/begin MEASUREMENT MDACC2 " Momentvorg. f. UM -> Komplem. v. (mdegs+egs_mc)" UBYTE DEZ 0 0 0.000000 256.000000 ECU_ADDRESS 0xB05FA BIT_MASK 0xFF /end MEASUREMENT
/begin MEASUREMENT MDACCALT " alter Wert Momentenanforderung" UBYTE MMQ 0 0 0.000000 512.000000 ECU_ADDRESS 0xB05CD BIT_MASK 0xFF /end MEASUREMENT
/begin MEASUREMENT MDACCBGR " begrenztes Moment" UBYTE MMQ 0 0 0.000000 512.000000 ECU_ADDRESS 0xB05CF BIT_MASK 0xFF /end MEASUREMENT
/begin MEASUREMENT MDACC_A_UC " erhoehender ACC-Eingriff (alter Wert)" UBYTE PCENT 0 0 0.000000 99.609400 ECU_ADDRESS 0xE0C9 BIT_MASK 0xFF /end MEASUREMENT
/begin MEASUREMENT MDACC_A_UM " Momentenanforderung ACC" UBYTE PCENT 0 0 0.000000 99.609400 ECU_ADDRESS 0xE073 BIT_MASK 0xFF /end MEASUREMENT
/begin MEASUREMENT MDACC_A_UR " Momentenanforderung ACC" UBYTE PCENT 0 0 0.000000 99.609400 ECU_ADDRESS 0xB181D BIT_MASK 0xFF /end MEASUREMENT
/begin MEASUREMENT MDACVER " ACC-Momentenvergleich Quant.: 10ms /Inc" UBYTE MMQ 0 0 0.000000 512.000000 ECU_ADDRESS 0xB0C1A BIT_MASK 0xFF /end MEASUREMENT
/begin MEASUREMENT MDANSR " Ergebnis aus MDANS" UBYTE F256OFF 0 0 0.500000 1.500000 ECU_ADDRESS 0xB0581 BIT_MASK 0xFF /end MEASUREMENT
/begin MEASUREMENT MDASRALT " Momentenanforderung ASR alter Wert" UBYTE MMQ 0 0 0.000000 512.000000 ECU_ADDRESS 0xB0564 BIT_MASK 0xFF /end MEASUREMENT
/begin MEASUREMENT MDASRL " Momentenanforderung ASR langsam" UBYTE PCENT 0 0 0.000000 99.609400 ECU_ADDRESS 0xB0C40 BIT_MASK 0xFF /end MEASUREMENT
/begin MEASUREMENT MDASRL_MMQ " Momentenanforderung ASR langsam" UBYTE MMQ 0 0 0.000000 512.000000 ECU_ADDRESS 0xB0C42 BIT_MASK 0xFF /end MEASUREMENT
/begin MEASUREMENT MDASRS " Momentenanforderung ASR schnell" UBYTE PCENT 0 0 0.000000 99.609400 ECU_ADDRESS 0xB0C3F BIT_MASK 0xFF /end MEASUREMENT
/begin MEASUREMENT MDASRS_MMQ " Momentenanforderung ASR schnell" UBYTE MMQ 0 0 0.000000 512.000000 ECU_ADDRESS 0xB0C41 BIT_MASK 0xFF /end MEASUREMENT
/begin MEASUREMENT MDDN_NCA " Reduzieranforderung EGS" UBYTE PCENT 0 0 0.000000 99.609400 ECU_ADDRESS 0xB05F4 BIT_MASK 0xFF /end MEASUREMENT
/begin MEASUREMENT MDEGS "Sollmomentvorgabe von Selespeed" UBYTE PCENT 0 0 0.000000 99.609400 ECU_ADDRESS 0xB05C6 BIT_MASK 0xFF /end MEASUREMENT
/begin MEASUREMENT MDEGS2 " Momentvorg. f. UM -> Komplem. v. (mdegs+egs_mc)" UBYTE DEZ 0 0 0.000000 256.000000 ECU_ADDRESS 0xB05EC BIT_MASK 0xFF /end MEASUREMENT
/begin MEASUREMENT MDEGSALT " alter Wert Momentenanforderung" UBYTE MMQ 0 0 0.000000 512.000000 ECU_ADDRESS 0xB05C3 BIT_MASK 0xFF /end MEASUREMENT
/begin MEASUREMENT MDEGSBGR " begrenztes" UBYTE MMQ 0 0 0.000000 512.000000 ECU_ADDRESS 0xB05C5 BIT_MASK 0xFF /end MEASUREMENT
/begin MEASUREMENT MDEGS_C "S_SCHALT Ueberwachungszaehler" UWORD TQ10L 0 0 0.000000 655.350000 ECU_ADDRESS 0xB057E BIT_MASK 0xFFFF /end MEASUREMENT
/begin MEASUREMENT MDEGS_MMQ "MDEGS umgerechnet in [MMQ]" UBYTE MMQ 0 0 0.000000 512.000000 ECU_ADDRESS 0xB05C7 BIT_MASK 0xFF /end MEASUREMENT
/begin MEASUREMENT MDEGTC_C " Ueberwachungszaehler fuer Torque Constant Anforderung" UWORD TQ10L 0 0 0.000000 655.350000 ECU_ADDRESS 0xB05B4 BIT_MASK 0xFFFF /end MEASUREMENT
/begin MEASUREMENT MDEGTD_C " Ueberwachungszaehler fuer Tourque Decrease Anforderung" UWORD TQ10L 0 0 0.000000 655.350000 ECU_ADDRESS 0xB05B0 BIT_MASK 0xFFFF /end MEASUREMENT
/begin MEASUREMENT MDEGTU_C " Ueberwachungszaehler fuer Tourque Increase Anforderung" UWORD TQ10L 0 0 0.000000 655.350000 ECU_ADDRESS 0xB05B2 BIT_MASK 0xFFFF /end MEASUREMENT
/begin MEASUREMENT MDEXTS " Externes Sollmoment" UBYTE MMQ 0 0 0.000000 512.000000 ECU_ADDRESS 0xB055D BIT_MASK 0xFF /end MEASUREMENT
/begin MEASUREMENT MDFW "Indiziertes Motormoment aus mdind bzw. mdindtc" UBYTE MMQ 0 0 0.000000 512.000000 ECU_ADDRESS 0xB0595 BIT_MASK 0xFF /end MEASUREMENT
/begin MEASUREMENT MDIND " Indiziertes Motormoment" UBYTE MMQ 0 0 0.000000 512.000000 ECU_ADDRESS 0xB0589 BIT_MASK 0xFF /end MEASUREMENT
/begin MEASUREMENT MDINDSTA " Indiziertes Motormoment bei Basiszuendwinkel" UBYTE MMQ 0 0 0.000000 512.000000 ECU_ADDRESS 0xB058B BIT_MASK 0xFF /end MEASUREMENT
/begin MEASUREMENT MDINDTC " Indiziertes Motormoment (aus Model)" UBYTE MMQ 0 0 0.000000 512.000000 ECU_ADDRESS 0xB0591 BIT_MASK 0xFF /end MEASUREMENT
/begin MEASUREMENT MDIND_OA "indiziertes Motorm. vor Ausblendung" UBYTE MMQ 0 0 0.000000 512.000000 ECU_ADDRESS 0xB0594 BIT_MASK 0xFF /end MEASUREMENT
/begin MEASUREMENT MDIND_PCNT " MDIND in [PCENT] Indiziertes Motormoment" UBYTE PCENT 0 0 0.000000 99.609400 ECU_ADDRESS 0xB0C54 BIT_MASK 0xFF /end MEASUREMENT
/begin MEASUREMENT MDMAX " maximales Motormoment" UBYTE MMQ 0 0 0.000000 512.000000 ECU_ADDRESS 0xB058A BIT_MASK 0xFF /end MEASUREMENT
/begin MEASUREMENT MDMAXRECNR "Ersatzwert fuer mdmax im Fehlerfall" UBYTE MMQ 0 0 0.000000 512.000000 ECU_ADDRESS 0xB0602 BIT_MASK 0xFF /end MEASUREMENT
/begin MEASUREMENT MDMAX_MMQ "Drehmomentbegrenzung EGS umgerechnet in [MMQ]" UBYTE MMQ 0 0 0.000000 512.000000 ECU_ADDRESS 0xB0600 BIT_MASK 0xFF /end MEASUREMENT
/begin MEASUREMENT MDMAX_NCA " Drehmomentbegrenzung EGS" UBYTE PCENT 0 0 0.000000 99.609400 ECU_ADDRESS 0xB05F2 BIT_MASK 0xFF /end MEASUREMENT
/begin MEASUREMENT MDMSR " Momentenanforderung MSR" UBYTE PCENT 0 0 0.000000 99.609400 ECU_ADDRESS 0xB0C52 BIT_MASK 0xFF /end MEASUREMENT
/begin MEASUREMENT MDMSRALT " Momentenanforderung MSR alter Wert" UBYTE MMQ 0 0 0.000000 512.000000 ECU_ADDRESS 0xB0563 BIT_MASK 0xFF /end MEASUREMENT
/begin MEASUREMENT MDMSRBGR " Moment von MSR (begrenzt auf MDMSRKL)" UBYTE MMQ 0 0 0.000000 512.000000 ECU_ADDRESS 0xB0565 BIT_MASK 0xFF /end MEASUREMENT
/begin MEASUREMENT MDMSR_MMQ " Momentenanforderung MSR" UBYTE MMQ 0 0 0.000000 512.000000 ECU_ADDRESS 0xB0C53 BIT_MASK 0xFF /end MEASUREMENT
/begin MEASUREMENT MDNOKAC " Ergebnis von KFMDNOKN mit Source tl8ac */" UBYTE MMQ 0 0 0.000000 512.000000 ECU_ADDRESS 0xB059F BIT_MASK 0xFF /end MEASUREMENT
/begin MEASUREMENT MDNOKC " Wert aus KFMNOKTC" UBYTE MMQ 0 0 0.000000 512.000000 ECU_ADDRESS 0xB0592 BIT_MASK 0xFF /end MEASUREMENT
/begin MEASUREMENT MDNOKH " Ergebnis aus MDNOKHA" UWORD FKT256L 0 0 0.000000 256.000000 ECU_ADDRESS 0xB0598 BIT_MASK 0xFFFF /end MEASUREMENT
/begin MEASUREMENT MDNORM_CAN "DA Software-Overflow von Momenten in 5Nm/Inc" UBYTE DEZ 0 0 0.000000 256.000000 ECU_ADDRESS 0x5E8 BIT_MASK 0xFF /end MEASUREMENT
/begin MEASUREMENT MDNORM_MAX "DA plausibilisiertes MDNORM fuer CAN" UBYTE MMQ_NORM 0 0 0.000000 2550.000000 ECU_ADDRESS 0x5E9 BIT_MASK 0xFF /end MEASUREMENT
/begin MEASUREMENT MDRED " MDIND-MD_RED" UBYTE MMQ 0 0 0.000000 512.000000 ECU_ADDRESS 0xB0596 BIT_MASK 0xFF /end MEASUREMENT
/begin MEASUREMENT MDS "Ergebnis KFMDSN" UBYTE MMQ 0 0 0.000000 512.000000 ECU_ADDRESS 0xB058C BIT_MASK 0xFF /end MEASUREMENT
/begin MEASUREMENT MDSOLL " Sollmoment" UBYTE MMQ 0 0 0.000000 512.000000 ECU_ADDRESS 0xB05EA BIT_MASK 0xFF /end MEASUREMENT
/begin MEASUREMENT MDSOLLSTA " Motorsollmoment bei Basiszuendwinkel*/" UBYTE MMQ 0 0 0.000000 512.000000 ECU_ADDRESS 0xB05A0 BIT_MASK 0xFF /end MEASUREMENT
/begin MEASUREMENT MDSOLL_OA " Motorsollmoment ohne Ausblendung*/" UBYTE MMQ 0 0 0.000000 512.000000 ECU_ADDRESS 0xB05A1 BIT_MASK 0xFF /end MEASUREMENT
/begin MEASUREMENT MDSSOLL " Motorsollmoment fuer ACC ueber CAN*/" UBYTE MMQ 0 0 0.000000 512.000000 ECU_ADDRESS 0xB05A4 BIT_MASK 0xFF /end MEASUREMENT
/begin MEASUREMENT MDSSOLLOK " Motorsollmoment lokaler Zwischenspeicher*/" UBYTE MMQ 0 0 0.000000 512.000000 ECU_ADDRESS 0xB05A5 BIT_MASK 0xFF /end MEASUREMENT
/begin MEASUREMENT MDST08_UM " Sollwert-Stuetzstelle zur Erm. des Offset" UWORD DEZL 0 0 0.000000 65535.000000 ECU_ADDRESS 0xE078 BIT_MASK 0xFFFF /end MEASUREMENT
/begin MEASUREMENT MDST08_UR " DA Sollwert-Stuetzstelle zur Erm. des Offset" UWORD DEZL 0 0 0.000000 65535.000000 ECU_ADDRESS 0xB1802 BIT_MASK 0xFFFF /end MEASUREMENT
/begin MEASUREMENT MDSTATUS " Status Momentenreduktion" UBYTE PCENT 0 0 0.000000 99.609400 ECU_ADDRESS 0xB0C43 BIT_MASK 0xFF /end MEASUREMENT
/begin MEASUREMENT MDUP_MMQ "Drehmomentanhebung EGS umgerechnet in [MMQ]" UBYTE MMQ 0 0 0.000000 512.000000 ECU_ADDRESS 0xB0601 BIT_MASK 0xFF /end MEASUREMENT
/begin MEASUREMENT MDUP_NCA " Drehmomentanhebung EGS" UBYTE PCENT103OF 0 0 -25.000000 102.500000 ECU_ADDRESS 0xB05F3 BIT_MASK 0xFF /end MEASUREMENT
/begin MEASUREMENT MDVERL "Reibmoment" UBYTE MMQ 0 0 0.000000 512.000000 ECU_ADDRESS 0xB0593 BIT_MASK 0xFF /end MEASUREMENT
/begin MEASUREMENT MDWONCR " Sollmoment ohne Selespeed-Anforderung" UBYTE MMQ 0 0 0.000000 512.000000 ECU_ADDRESS 0xB0561 BIT_MASK 0xFF /end MEASUREMENT
/begin MEASUREMENT MD_EGS " MomentenReduktionAnforderung EGS" UBYTE MMQ 0 0 0.000000 512.000000 ECU_ADDRESS 0xB0584 BIT_MASK 0xFF /end MEASUREMENT
/begin MEASUREMENT MD_MOT " Momentvorgabe Fahrer" UBYTE MMQOF 0 0 -100.000000 410.000000 ECU_ADDRESS 0xB0586 BIT_MASK 0xFF /end MEASUREMENT
/begin MEASUREMENT MD_MOT_EGS " Rueckmeldung Momentenvorgabe Fahrer" UBYTE MMQOF 0 0 -100.000000 410.000000 ECU_ADDRESS 0xB0560 BIT_MASK 0xFF /end MEASUREMENT
/begin MEASUREMENT MD_MOT_NCA " Momentvorgabe vor EGS" UBYTE PCENT103OF 0 0 -25.000000 102.500000 ECU_ADDRESS 0xB05F5 BIT_MASK 0xFF /end MEASUREMENT
/begin MEASUREMENT MD_RED " Istmomentenreduktion gesamt" UBYTE MMQ 0 0 0.000000 512.000000 ECU_ADDRESS 0xB0585 BIT_MASK 0xFF /end MEASUREMENT
/begin MEASUREMENT MD_RED_ASR " Istmomentenreduktion aus ASR-Eingriff" UBYTE MMQ 0 0 0.000000 512.000000 ECU_ADDRESS 0xB0588 BIT_MASK 0xFF /end MEASUREMENT
/begin MEASUREMENT MD_RED_EGS " Istmomentenreduktion aus EGS-Eingriff" UBYTE MMQ 0 0 0.000000 512.000000 ECU_ADDRESS 0xB0587 BIT_MASK 0xFF /end MEASUREMENT
/begin MEASUREMENT MD_RED_NCA " Reduzierrueckmeldung an EGS" UBYTE PCENT103OF 0 0 -25.000000 102.500000 ECU_ADDRESS 0xB05F6 BIT_MASK 0xFF /end MEASUREMENT
/begin MEASUREMENT ME7_BITS " Bitwort fuer ME7 Bits" UWORD DEZL 0 0 0.000000 65535.000000 ECU_ADDRESS 0xFDD6 BIT_MASK 0xFFFF /end MEASUREMENT
/begin MEASUREMENT MERH_UM " erhoehender Eingriff" UBYTE DEZ 0 0 0.000000 256.000000 ECU_ADDRESS 0xE023 BIT_MASK 0xFF /end MEASUREMENT
/begin MEASUREMENT MERH_UR " erhoehender Eingriff" UBYTE DEZ 0 0 0.000000 256.000000 ECU_ADDRESS 0xB1822 BIT_MASK 0xFF /end MEASUREMENT
/begin MEASUREMENT MFGR_UC "Tempomat Eingriff BT" UBYTE UFUELL 0 0 0.000000 191.250000 ECU_ADDRESS 0xE087 BIT_MASK 0xFF /end MEASUREMENT
/begin MEASUREMENT MFLTIM "Messfensterlaenge als Zeit" UWORD TEQL 0 0 0.000000 174.760000 ECU_ADDRESS 0xB045A BIT_MASK 0xFFFF /end MEASUREMENT
/begin MEASUREMENT MFZYLV "Zylindervektor auf MFA synchr." UWORD DEZL 0 0 0.000000 65535.000000 ECU_ADDRESS 0xB0416 BIT_MASK 0xFFFF /end MEASUREMENT
/begin MEASUREMENT MILSTAT "" UBYTE DEZ 0 0 0.000000 256.000000 ECU_ADDRESS 0xB0FA1 BIT_MASK 0xFF /end MEASUREMENT
/begin MEASUREMENT MINFSE " Min. FSE" SBYTE DTSEGN_S8 0 0 -2.250000 2.232420 ECU_ADDRESS 0xB0766 BIT_MASK 0xFF /end MEASUREMENT
/begin MEASUREMENT MIOPT_UC " theor. opt. Istmoment" UBYTE MMQ 0 0 0.000000 512.000000 ECU_ADDRESS 0xE09F BIT_MASK 0xFF /end MEASUREMENT
/begin MEASUREMENT MIOPT_UM " theor. opt. Istmoment" UBYTE MMQ 0 0 0.000000 512.000000 ECU_ADDRESS 0xE027 BIT_MASK 0xFF /end MEASUREMENT
/begin MEASUREMENT MI_UC " Istmoment aus cist.mcc fuer BT" UBYTE MMQ 0 0 0.000000 512.000000 ECU_ADDRESS 0xE09C BIT_MASK 0xFF /end MEASUREMENT
/begin MEASUREMENT MI_UR " DA Istmoment" UBYTE MMQ 0 0 0.000000 512.000000 ECU_ADDRESS 0xB17CD BIT_MASK 0xFF /end MEASUREMENT
/begin MEASUREMENT MLNKAL "dto. Low-Byte" UBYTE DEZ 0 0 0.000000 256.000000 ECU_ADDRESS 0xB038C BIT_MASK 0xFF /end MEASUREMENT
/begin MEASUREMENT MLNKAW "Integrierter Luftstrom nach SAS f. MLLRH" UWORD MLQP256L 0 0 0.000000 25599.600000 ECU_ADDRESS 0xB038C BIT_MASK 0xFFFF /end MEASUREMENT
/begin MEASUREMENT MLNSA "Integrierter Luftstrom nach SAS f. MLLRH" UBYTE MLQ100 0 0 0.000000 2.538680 ECU_ADDRESS 0xB038B BIT_MASK 0xFF /end MEASUREMENT
/begin MEASUREMENT MLNSAW "Integrierter Luftstrom nach SAS f. MLLRH" UWORD MLQP256L 0 0 0.000000 25599.600000 ECU_ADDRESS 0xB038A BIT_MASK 0xFFFF /end MEASUREMENT
/begin MEASUREMENT MLSR "8-Bit-Luftmasse (MLSMS/MLE8_Q) ungefiltert (QUANT: 4.0kg/h)" UBYTE MLSMQ 0 0 0.000000 1024.000000 ECU_ADDRESS 0xB095A BIT_MASK 0xFF /end MEASUREMENT
/begin MEASUREMENT MLS_HLP1 " Hilfsgröße" UBYTE PCENT 0 0 0.000000 99.609400 ECU_ADDRESS 0xB2144 BIT_MASK 0xFF /end MEASUREMENT
/begin MEASUREMENT MLS_HLP2 " Hilfsgröße" UBYTE PCENT 0 0 0.000000 99.609400 ECU_ADDRESS 0xB2145 BIT_MASK 0xFF /end MEASUREMENT
/begin MEASUREMENT ML_W "Luftmassenfluss gefiltert (Word)" UWORD MLQ01L 0 0 0.000000 6553.500000 ECU_ADDRESS 0xB0FEC BIT_MASK 0xFFFF /end MEASUREMENT
/begin MEASUREMENT MMOT "Motorsollmoment fuer Reduzier/Erhoehungswinkel-Kennfeld" UBYTE MMQ 0 0 0.000000 512.000000 ECU_ADDRESS 0xF73C BIT_MASK 0xFF /end MEASUREMENT
/begin MEASUREMENT MMSR_UC " Momentenanforderung von MSR" UBYTE MMQ 0 0 0.000000 512.000000 ECU_ADDRESS 0xE0B9 BIT_MASK 0xFF /end MEASUREMENT
/begin MEASUREMENT MMSR_UR " DA Sollmomentvorgabe vom MSR" UBYTE MMQ 0 0 0.000000 512.000000 ECU_ADDRESS 0xB1817 BIT_MASK 0xFF /end MEASUREMENT
/begin MEASUREMENT MPED_UC " zul. Moment Pedal" UBYTE MMQ 0 0 0.000000 512.000000 ECU_ADDRESS 0xE0A0 BIT_MASK 0xFF /end MEASUREMENT
/begin MEASUREMENT MS50_C "Zaehler fuer 50ms Raster" UBYTE DEZ 0 0 0.000000 256.000000 ECU_ADDRESS 0xB0875 BIT_MASK 0xFF /end MEASUREMENT
/begin MEASUREMENT MS50_DLSSA " Zaehler 50ms" UBYTE DEZ 0 0 0.000000 256.000000 ECU_ADDRESS 0xB0A4E BIT_MASK 0xFF /end MEASUREMENT
/begin MEASUREMENT MSGS_UC " Momentenanforderung von SGS" UBYTE MMQ 0 0 0.000000 512.000000 ECU_ADDRESS 0xE0B8 BIT_MASK 0xFF /end MEASUREMENT
/begin MEASUREMENT MSGS_UR " DA erhoehender Getriebe-Eingriff" UBYTE MMQ 0 0 0.000000 512.000000 ECU_ADDRESS 0xB1821 BIT_MASK 0xFF /end MEASUREMENT
/begin MEASUREMENT MSRC_C_UC " Fehlerzaehler MSR-Eingriff fuer BT" UBYTE DEZ 0 0 0.000000 256.000000 ECU_ADDRESS 0xE0A8 BIT_MASK 0xFF /end MEASUREMENT
/begin MEASUREMENT MSRC_C_UR " Byte fuer DA MSRC_C_UM" UBYTE DEZ 0 0 0.000000 256.000000 ECU_ADDRESS 0xB1816 BIT_MASK 0xFF /end MEASUREMENT
/begin MEASUREMENT MSRNU_C_UC " Entprellzaehler in MSR" UBYTE DEZ 0 0 0.000000 256.000000 ECU_ADDRESS 0xE0BA BIT_MASK 0xFF /end MEASUREMENT
/begin MEASUREMENT MSRNU_C_UR " DA Entprellzaehler in MSR" UBYTE DEZ 0 0 0.000000 256.000000 ECU_ADDRESS 0xB1818 BIT_MASK 0xFF /end MEASUREMENT
/begin MEASUREMENT MVER_C_UC " Fehlerzaehler aus CMVER.mcc fuer BT" UBYTE DEZ 0 0 0.000000 256.000000 ECU_ADDRESS 0xE08A BIT_MASK 0xFF /end MEASUREMENT
/begin MEASUREMENT MVER_C_UM " Fehlerzaehler mver" UBYTE DEZ 0 0 0.000000 256.000000 ECU_ADDRESS 0xE037 BIT_MASK 0xFF /end MEASUREMENT
/begin MEASUREMENT MVER_C_UR " DA Fehlerzaehler" UBYTE DEZ 0 0 0.000000 256.000000 ECU_ADDRESS 0xB17DA BIT_MASK 0xFF /end MEASUREMENT
/begin MEASUREMENT MZFO_UC "zulaessiges Moment fuer BT" UBYTE DEZ 0 0 0.000000 256.000000 ECU_ADDRESS 0xE0A2 BIT_MASK 0xFF /end MEASUREMENT
/begin MEASUREMENT MZFO_UM " zulaessiges Moment" UBYTE MMQ 0 0 0.000000 512.000000 ECU_ADDRESS 0xE038 BIT_MASK 0xFF /end MEASUREMENT
/begin MEASUREMENT MZF_LOW_UC " Filter Nachkommastellen aus CMZF.mcc fuer BT" UBYTE DEZ 0 0 0.000000 256.000000 ECU_ADDRESS 0xE08E BIT_MASK 0xFF /end MEASUREMENT
/begin MEASUREMENT MZF_LOW_UR " DA Nachkommastellen M-Vorgabe" UBYTE DEZ 0 0 0.000000 256.000000 ECU_ADDRESS 0xB17CF BIT_MASK 0xFF /end MEASUREMENT
/begin MEASUREMENT MZF_UC " gefiltertes Moment as CMZF.mcc fuer BT" UBYTE DEZ 0 0 0.000000 256.000000 ECU_ADDRESS 0xE08D BIT_MASK 0xFF /end MEASUREMENT
/begin MEASUREMENT MZF_UR " DA Moment-Vorgabe um tv verz." UBYTE DEZ 0 0 0.000000 256.000000 ECU_ADDRESS 0xB17CE BIT_MASK 0xFF /end MEASUREMENT
/begin MEASUREMENT MZO_UC " Toleranz-Moment" UBYTE MMQ 0 0 0.000000 512.000000 ECU_ADDRESS 0xE0A1 BIT_MASK 0xFF /end MEASUREMENT
/begin MEASUREMENT MZO_UR " DA Toleranz-Moment" UBYTE MMQ 0 0 0.000000 512.000000 ECU_ADDRESS 0xB17CB BIT_MASK 0xFF /end MEASUREMENT
/begin MEASUREMENT MZT_UC " Momentvorgabe um TV verzoegert" UBYTE DEZ 0 0 0.000000 256.000000 ECU_ADDRESS 0xE098 BIT_MASK 0xFF /end MEASUREMENT
/begin MEASUREMENT MZT_UM " Moment-Vorgabe um tv verzoeg." UBYTE MMQ 0 0 0.000000 512.000000 ECU_ADDRESS 0xE02D BIT_MASK 0xFF /end MEASUREMENT
/begin MEASUREMENT MZ_UC "Zul. Moment aus cmzul.mcc fuer BT" UBYTE MMQ 0 0 0.000000 512.000000 ECU_ADDRESS 0xE09B BIT_MASK 0xFF /end MEASUREMENT
/begin MEASUREMENT MZ_UR " DA zulaessiges Moment" UBYTE MMQ 0 0 0.000000 512.000000 ECU_ADDRESS 0xB17CC BIT_MASK 0xFF /end MEASUREMENT
/begin MEASUREMENT N10 "Drehzahl" UBYTE NQ10 0 0 0.000000 2550.000000 ECU_ADDRESS 0xB0824 BIT_MASK 0xFF /end MEASUREMENT
/begin MEASUREMENT N1FON " Indexeckpunkt" UBYTE NQ25 0 0 0.000000 6400.000000 ECU_ADDRESS 0xB07BC BIT_MASK 0xFF /end MEASUREMENT
/begin MEASUREMENT N2FON " Indexeckpunkt" UBYTE NQ25 0 0 0.000000 6400.000000 ECU_ADDRESS 0xB07BD BIT_MASK 0xFF /end MEASUREMENT
/begin MEASUREMENT N32 "Drehzahl (Quant.=32Upm)" UBYTE NQ32 0 0 0.000000 8160.000000 ECU_ADDRESS 0xF74D BIT_MASK 0xFF /end MEASUREMENT
/begin MEASUREMENT N3FON " Indexeckpunkt" UBYTE NQ25 0 0 0.000000 6400.000000 ECU_ADDRESS 0xB07BE BIT_MASK 0xFF /end MEASUREMENT
/begin MEASUREMENT N4FON " Indexeckpunkt" UBYTE NQ25 0 0 0.000000 6400.000000 ECU_ADDRESS 0xB07BF BIT_MASK 0xFF /end MEASUREMENT
/begin MEASUREMENT N5FON " Indexeckpunkt" UBYTE NQ25 0 0 0.000000 6400.000000 ECU_ADDRESS 0xB07C0 BIT_MASK 0xFF /end MEASUREMENT
/begin MEASUREMENT N6FON " Indexeckpunkt" UBYTE NQ25 0 0 0.000000 6400.000000 ECU_ADDRESS 0xB07C1 BIT_MASK 0xFF /end MEASUREMENT
/begin MEASUREMENT N7FON " Indexeckpunkt" UBYTE NQ25 0 0 0.000000 6400.000000 ECU_ADDRESS 0xB07C2 BIT_MASK 0xFF /end MEASUREMENT
/begin MEASUREMENT NCM_ZYKL " Zykluszeit senden NCm Botschaft" UBYTE TQ10 0 0 0.000000 2.550000 ECU_ADDRESS 0xB0C38 BIT_MASK 0xFF /end MEASUREMENT
/begin MEASUREMENT NC_C_UM " Fehlerzaehler fuer Drehzahlvergleich der FU" UBYTE DEZ 0 0 0.000000 256.000000 ECU_ADDRESS 0xE00A BIT_MASK 0xFF /end MEASUREMENT
/begin MEASUREMENT NC_C_UR " DA Fehlerzaehler fuer Drehzahlvergleich der FU" UBYTE DEZ 0 0 0.000000 256.000000 ECU_ADDRESS 0xB17BA BIT_MASK 0xFF /end MEASUREMENT
/begin MEASUREMENT NFINK "TP-Filterausgang Nachkommastelle" UBYTE NQ25 0 0 0.000000 6400.000000 ECU_ADDRESS 0xB04A8 BIT_MASK 0xFF /end MEASUREMENT
/begin MEASUREMENT NIPST08_UM " SSt Drehzahl" UWORD DEZL 0 0 0.000000 65535.000000 ECU_ADDRESS 0xE05C BIT_MASK 0xFFFF /end MEASUREMENT
/begin MEASUREMENT NIPST08_UR " DA SSt Drehzahl" UWORD DEZL 0 0 0.000000 65535.000000 ECU_ADDRESS 0xB17FC BIT_MASK 0xFFFF /end MEASUREMENT
/begin MEASUREMENT NIST_1UALT "Drehzahl" UWORD NQ1_W 0 0 0.000000 8000.000000 ECU_ADDRESS 0xB0822 BIT_MASK 0xFFFF /end MEASUREMENT
/begin MEASUREMENT NIST_ALT "Drehzahl fuer Drehzahlgradientenber." UWORD NQ1_W 0 0 0.000000 8000.000000 ECU_ADDRESS 0xB06C4 BIT_MASK 0xFFFF /end MEASUREMENT
/begin MEASUREMENT NIST_UC "Drehzahl fuer BT" UBYTE NQ25 0 0 0.000000 6400.000000 ECU_ADDRESS 0xE083 BIT_MASK 0xFF /end MEASUREMENT
/begin MEASUREMENT NIST_UR " DA Istdrehzahl fuer FU" UBYTE NQ25 0 0 0.000000 6400.000000 ECU_ADDRESS 0xB17B9 BIT_MASK 0xFF /end MEASUREMENT
/begin MEASUREMENT NLF_DAUER " Dauer des Nachlaufs (KL15 aus)" UWORD TQ10L 0 0 0.000000 655.350000 ECU_ADDRESS 0xB1824 BIT_MASK 0xFFFF /end MEASUREMENT
/begin MEASUREMENT NMAX " Drehzahlgrenze" UWORD NQ025_W 0 0 0.000000 12000.000000 ECU_ADDRESS 0xB0C6C BIT_MASK 0xFFFF /end MEASUREMENT
/begin MEASUREMENT NMAXA " Hoechste gefahrene Drehzahl" UBYTE NQ40 0 0 0.000000 10200.000000 ECU_ADDRESS 0xB2B19 BIT_MASK 0xFF /end MEASUREMENT
/begin MEASUREMENT NMAXE " Drehzahlgrenze EGAS" UWORD NQ025_W 0 0 0.000000 12000.000000 ECU_ADDRESS 0xB0C6E BIT_MASK 0xFFFF /end MEASUREMENT
/begin MEASUREMENT NMAXE_Z " Zaehler Abstufung I-Anteil" UBYTE DEZ 0 0 0.000000 256.000000 ECU_ADDRESS 0xB0C81 BIT_MASK 0xFF /end MEASUREMENT
/begin MEASUREMENT NMOT_W_ALT " Speicher Drehzahl" UWORD NQ025_W 0 0 0.000000 12000.000000 ECU_ADDRESS 0xB0C70 BIT_MASK 0xFFFF /end MEASUREMENT
/begin MEASUREMENT NMST08_UC "SST Moment fuer BT" UWORD DEZ 0 0 0.000000 256.000000 ECU_ADDRESS 0xE0AE BIT_MASK 0xFFFF /end MEASUREMENT
/begin MEASUREMENT NMST08_UM " SSt Moment" UWORD DEZL 0 0 0.000000 65535.000000 ECU_ADDRESS 0xE062 BIT_MASK 0xFFFF /end MEASUREMENT
/begin MEASUREMENT NMST08_UR " DA SSt Moment" UWORD DEZL 0 0 0.000000 65535.000000 ECU_ADDRESS 0xB1808 BIT_MASK 0xFFFF /end MEASUREMENT
/begin MEASUREMENT NMXSGS " Nmaxwert aus NMAXSGS" UWORD NQ025_W 0 0 0.000000 12000.000000 ECU_ADDRESS 0xB0C7C BIT_MASK 0xFFFF /end MEASUREMENT
/begin MEASUREMENT NPEDST08_U "SST Pedalsollwert fuer BT" UWORD DEZ 0 0 0.000000 256.000000 ECU_ADDRESS 0x0 BIT_MASK 0xFFFF /end MEASUREMENT
/begin MEASUREMENT NSAKT_UR "Byte fuer DA b_nsakt_um" UBYTE DEZ 0 0 0.000000 256.000000 ECU_ADDRESS 0xB17E6 BIT_MASK 0xFF /end MEASUREMENT
/begin MEASUREMENT NSC_C_UM " Nachstartzeitzaehler" UWORD DEZL 0 0 0.000000 65535.000000 ECU_ADDRESS 0xE070 BIT_MASK 0xFFFF /end MEASUREMENT
/begin MEASUREMENT NSC_C_UR " DA Nachstart-Zeitzaehler" UWORD DEZL 0 0 0.000000 65535.000000 ECU_ADDRESS 0xB1812 BIT_MASK 0xFFFF /end MEASUREMENT
/begin MEASUREMENT NSEND_UR " Byte fuer DA b_nsend_um" UBYTE DEZ 0 0 0.000000 256.000000 ECU_ADDRESS 0xB17E4 BIT_MASK 0xFF /end MEASUREMENT
/begin MEASUREMENT NSKA_UC "Grenzdrehzahl fuer Einspritzausbl. fuer BT" UBYTE NQ25 0 0 0.000000 6400.000000 ECU_ADDRESS 0xE084 BIT_MASK 0xFF /end MEASUREMENT
/begin MEASUREMENT NSKA_UR " DA Grenzdrehzahl Ausblendung" UBYTE DEZ 0 0 0.000000 256.000000 ECU_ADDRESS 0xB17DD BIT_MASK 0xFF /end MEASUREMENT
/begin MEASUREMENT NSUB_CT "Batterie-Erholzeit nach Start - Zaehler" UWORD TQ100L 0 0 0.000000 6553.500000 ECU_ADDRESS 0xB0A76 BIT_MASK 0xFFFF /end MEASUREMENT
/begin MEASUREMENT NW_DASE " Ausblend-Nockenwellenzaehler fuer Aussetzer" UBYTE DEZ 0 0 0.000000 256.000000 ECU_ADDRESS 0xB074E BIT_MASK 0xFF /end MEASUREMENT
/begin MEASUREMENT NZWST08_UC "SST Zuendwinkel fuer BT" UWORD DEZ 0 0 0.000000 256.000000 ECU_ADDRESS 0xE0B0 BIT_MASK 0xFFFF /end MEASUREMENT
/begin MEASUREMENT NZWST08_UM " SSt Zuendwinkel" UWORD DEZL 0 0 0.000000 65535.000000 ECU_ADDRESS 0xE064 BIT_MASK 0xFFFF /end MEASUREMENT
/begin MEASUREMENT NZWST08_UR " DA SSt Zuendwinkel" UWORD DEZL 0 0 0.000000 65535.000000 ECU_ADDRESS 0xB180A BIT_MASK 0xFFFF /end MEASUREMENT
/begin MEASUREMENT NZ_UM " Motordrehzahl aus rasterzeitkorrigierte Zaehnezahl" UBYTE NQ25 0 0 0.000000 6400.000000 ECU_ADDRESS 0xE009 BIT_MASK 0xFF /end MEASUREMENT
/begin MEASUREMENT N_GRAD " Drehzahlgradient 0.25U/min" SWORD NQ025PN 0 0 -8192.000000 8191.750000 ECU_ADDRESS 0xB0C72 BIT_MASK 0xFFFF /end MEASUREMENT
/begin MEASUREMENT OBGR_TMP " temporaere Obergrenze" UWORD UDKL 0 0 0.000000 10.112000 ECU_ADDRESS 0xB0512 BIT_MASK 0xFFFF /end MEASUREMENT
/begin MEASUREMENT OKUB_CT "Entprellzaehler B_NOFLR DUBT" UBYTE TQ100 0 0 0.000000 25.500000 ECU_ADDRESS 0xB0A7A BIT_MASK 0xFF /end MEASUREMENT
/begin MEASUREMENT PERCNTI1 " Zustandsautomat LRHK, Zaehler i, Bank1" UWORD DEZL 0 0 0.000000 65535.000000 ECU_ADDRESS 0xB03CE BIT_MASK 0xFFFF /end MEASUREMENT
/begin MEASUREMENT PERCNTII1 " Zustandsautomat LRHK, Zaehler ii, Bank1" UWORD DEZL 0 0 0.000000 65535.000000 ECU_ADDRESS 0xB03D0 BIT_MASK 0xFFFF /end MEASUREMENT
/begin MEASUREMENT PLRHAV1_R " Gewichtung P-Anteil LRHK ueber Kat-Alterung, Bank1" UWORD FKT256L 0 0 0.000000 256.000000 ECU_ADDRESS 0xB039A BIT_MASK 0xFFFF /end MEASUREMENT
/begin MEASUREMENT PLRHML_R " Gewichtung P-Anteil LRHK, Bank1 und Bank2" UWORD TQ10L 0 0 0.000000 655.350000 ECU_ADDRESS 0xB0398 BIT_MASK 0xFFFF /end MEASUREMENT
/begin MEASUREMENT PL_MONI_UM "Fehlertabelle der UM Monitorfunktion" UWORD DEZ 0 0 0.000000 256.000000 ECU_ADDRESS 0xB21E2 BIT_MASK 0xFFFF /end MEASUREMENT
/begin MEASUREMENT PL_PTR_UM "Zeiger auf momentan freien Pl. Tab. UM Monitor" UBYTE DEZ 0 0 0.000000 256.000000 ECU_ADDRESS 0xB21E1 BIT_MASK 0xFF /end MEASUREMENT
/begin MEASUREMENT PORTS "" UWORD DEZL 0 0 0.000000 65535.000000 ECU_ADDRESS 0xFD02 BIT_MASK 0xFFFF /end MEASUREMENT
/begin MEASUREMENT POS " Waehlhebelposition" UBYTE DEZ 0 0 0.000000 256.000000 ECU_ADDRESS 0xB057D BIT_MASK 0xFF /end MEASUREMENT
/begin MEASUREMENT PRE100MS "100ms-Rasteruntersetzung" UBYTE DEZ 0 0 0.000000 256.000000 ECU_ADDRESS 0xB0493 BIT_MASK 0xFF /end MEASUREMENT
/begin MEASUREMENT PRUEFBL " Register fuer zu pruefenden Block" UBYTE DEZ 0 0 0.000000 256.000000 ECU_ADDRESS 0xE03C BIT_MASK 0xFF /end MEASUREMENT
/begin MEASUREMENT PSAUG "Saugrohrdruck" UBYTE PAB 0 0 -37.539100 1337.420000 ECU_ADDRESS 0xF70F BIT_MASK 0xFF /end MEASUREMENT
/begin MEASUREMENT PSO "Saugrohrdruck-Offset" UBYTE PABD 0 0 0.000000 1374.960000 ECU_ADDRESS 0xB0826 BIT_MASK 0xFF /end MEASUREMENT
/begin MEASUREMENT PSZUEN " Spiegelram zum Zuendungsport" UWORD DEZL 0 0 0.000000 65535.000000 ECU_ADDRESS 0xFA38 BIT_MASK 0xFFFF /end MEASUREMENT
/begin MEASUREMENT PTV1 " P-Anteil Lambda-Regelung Bank1" SBYTE TQ10MSS 0 0 -1.280000 1.270000 ECU_ADDRESS 0xB03B6 BIT_MASK 0xFF /end MEASUREMENT
/begin MEASUREMENT PT_MZF_UC " Zeiger fuer Schieberegister in CMZF.mcc fuer BT" UBYTE DEZ 0 0 0.000000 256.000000 ECU_ADDRESS 0xE08F BIT_MASK 0xFF /end MEASUREMENT
/begin MEASUREMENT PT_MZF_UM " Zeiger Schiebereg. spsn" UBYTE DEZ 0 0 0.000000 256.000000 ECU_ADDRESS 0xE02E BIT_MASK 0xFF /end MEASUREMENT
/begin MEASUREMENT PT_MZF_UR " DA Zeiger Schiebereg. mzfn" UBYTE DEZ 0 0 0.000000 256.000000 ECU_ADDRESS 0x17D1 BIT_MASK 0xFF /end MEASUREMENT
/begin MEASUREMENT RAM_C_UM " Fehlerzaehler fuer RAM-Pruefung" UBYTE DEZ 0 0 0.000000 256.000000 ECU_ADDRESS 0xB2230 BIT_MASK 0xFF /end MEASUREMENT
/begin MEASUREMENT REAC_C1_UC " Fehlerzaehler aus CREAC.mcc fuer BT" UBYTE DEZ 0 0 0.000000 256.000000 ECU_ADDRESS 0xE08B BIT_MASK 0xFF /end MEASUREMENT
/begin MEASUREMENT REAC_C1_UR " Fehlerzaehler reac fuer inaktive SKA aus FU" UBYTE DEZ 0 0 0.000000 256.000000 ECU_ADDRESS 0xB17DB BIT_MASK 0xFF /end MEASUREMENT
/begin MEASUREMENT REAC_C2_UC " Fehlerzaehler aus CREAC.mcc fuer BT" UBYTE DEZ 0 0 0.000000 256.000000 ECU_ADDRESS 0xE08C BIT_MASK 0xFF /end MEASUREMENT
/begin MEASUREMENT REAC_C2_UR " Fehlerzaehler reac fuer aktive SKA aus FU" UBYTE DEZ 0 0 0.000000 256.000000 ECU_ADDRESS 0xB17DC BIT_MASK 0xFF /end MEASUREMENT
/begin MEASUREMENT REAC_C_UM " Fehlerzaehler fuer Fehlerreaktionsueberwachung" UBYTE DEZ 0 0 0.000000 256.000000 ECU_ADDRESS 0xB2234 BIT_MASK 0xFF /end MEASUREMENT
/begin MEASUREMENT REDNEU " neue Zahl der Reduzierstufen vor Freigabe" UBYTE DEZ 0 0 0.000000 256.000000 ECU_ADDRESS 0xB05BE BIT_MASK 0xFF /end MEASUREMENT
/begin MEASUREMENT REDS_C " Entprellzaehler bei Reduzierstufenumschaltung" UBYTE TQ10 0 0 0.000000 2.550000 ECU_ADDRESS 0xB05BF BIT_MASK 0xFF /end MEASUREMENT
/begin MEASUREMENT RINKFH1 "Kennfeldinhalt hinter Kat Bank 1" UWORD R_UW_Q32 0 0 0.000000 2097120.000000 ECU_ADDRESS 0xB069E BIT_MASK 0xFFFF /end MEASUREMENT
/begin MEASUREMENT RINKFV1 "Kennfeldinhalt vor Kat Bank 1" UWORD R_UW_Q32 0 0 0.000000 2097120.000000 ECU_ADDRESS 0xB069C BIT_MASK 0xFFFF /end MEASUREMENT
/begin MEASUREMENT RINSH1_W "Innenwiderstand Sonde vor Kat Bank 1" UWORD R_UW_Q2 0 0 0.000000 131070.000000 ECU_ADDRESS 0xB069A BIT_MASK 0xFFFF /end MEASUREMENT
/begin MEASUREMENT RINSV1_W "Innenwiderstand Sonde vor Kat Bank 1" UWORD R_UW_Q2 0 0 0.000000 131070.000000 ECU_ADDRESS 0xB0698 BIT_MASK 0xFFFF /end MEASUREMENT
/begin MEASUREMENT RKR0 "KR- Referenzpegel Zyl. 1" UWORD SENSORW 0 0 0.000000 4.999920 ECU_ADDRESS 0xB03F0 BIT_MASK 0xFFFF /end MEASUREMENT
/begin MEASUREMENT RKR1 "KR- Referenzpegel Zyl. 2" UWORD SENSORW 0 0 0.000000 4.999920 ECU_ADDRESS 0xB03F2 BIT_MASK 0xFFFF /end MEASUREMENT
/begin MEASUREMENT RKR2 "KR- Referenzpegel Zyl. 3" UWORD SENSORW 0 0 0.000000 4.999920 ECU_ADDRESS 0xB03F4 BIT_MASK 0xFFFF /end MEASUREMENT
/begin MEASUREMENT RKR3 "KR- Referenzpegel Zyl. 4" UWORD SENSORW 0 0 0.000000 4.999920 ECU_ADDRESS 0xB03F6 BIT_MASK 0xFFFF /end MEASUREMENT
/begin MEASUREMENT RKR4 "KR- Referenzpegel Zyl. 5" UWORD SENSORW 0 0 0.000000 4.999920 ECU_ADDRESS 0xB03F8 BIT_MASK 0xFFFF /end MEASUREMENT
/begin MEASUREMENT RKR5 "KR- Referenzpegel Zyl. 6" UWORD SENSORW 0 0 0.000000 4.999920 ECU_ADDRESS 0xB03FA BIT_MASK 0xFFFF /end MEASUREMENT
/begin MEASUREMENT RKR6 "KR- Referenzpegel Zyl. 7" UWORD SENSORW 0 0 0.000000 4.999920 ECU_ADDRESS 0xB0000 BIT_MASK 0xFFFF /end MEASUREMENT
/begin MEASUREMENT RKR7 "KR- Referenzpegel Zyl. 8" UWORD SENSORW 0 0 0.000000 4.999920 ECU_ADDRESS 0xB0000 BIT_MASK 0xFFFF /end MEASUREMENT
/begin MEASUREMENT RKRN0 "Absolute(normierte) KR-Referenz Zyl. 1" UBYTE SENSORB 0 0 0.000000 4.980470 ECU_ADDRESS 0xB041A BIT_MASK 0xFF /end MEASUREMENT
/begin MEASUREMENT RKRN1 "Absolute(normierte) KR-Referenz Zyl. 2" UBYTE SENSORB 0 0 0.000000 4.980470 ECU_ADDRESS 0xB041B BIT_MASK 0xFF /end MEASUREMENT
/begin MEASUREMENT RKRN2 "Absolute(normierte) KR-Referenz Zyl. 3" UBYTE SENSORB 0 0 0.000000 4.980470 ECU_ADDRESS 0xB041C BIT_MASK 0xFF /end MEASUREMENT
/begin MEASUREMENT RKRN3 "Absolute(normierte) KR-Referenz Zyl. 4" UBYTE SENSORB 0 0 0.000000 4.980470 ECU_ADDRESS 0xB041D BIT_MASK 0xFF /end MEASUREMENT
/begin MEASUREMENT RKRN4 "Absolute(normierte) KR-Referenz Zyl. 5" UBYTE SENSORB 0 0 0.000000 4.980470 ECU_ADDRESS 0xB041E BIT_MASK 0xFF /end MEASUREMENT
/begin MEASUREMENT RKRN5 "Absolute(normierte) KR-Referenz Zyl. 6" UBYTE SENSORB 0 0 0.000000 4.980470 ECU_ADDRESS 0xB041F BIT_MASK 0xFF /end MEASUREMENT
/begin MEASUREMENT RKRN6 "Absolute(normierte) KR-Referenz Zyl. 7" UBYTE SENSORB 0 0 0.000000 4.980470 ECU_ADDRESS 0xB0420 BIT_MASK 0xFF /end MEASUREMENT
/begin MEASUREMENT RKRN7 "Absolute(normierte) KR-Referenz Zyl. 8" UBYTE SENSORB 0 0 0.000000 4.980470 ECU_ADDRESS 0xB0421 BIT_MASK 0xFF /end MEASUREMENT
/begin MEASUREMENT RKRNMO "unselektiertes rkrn f. Appl." UBYTE SENSORB 0 0 0.000000 4.980470 ECU_ADDRESS 0xB0452 BIT_MASK 0xFF /end MEASUREMENT
/begin MEASUREMENT RKRNMW "KR-Referenzpegel-Mittelwert, normiert" UBYTE SENSORB 0 0 0.000000 4.980470 ECU_ADDRESS 0xB0442 BIT_MASK 0xFF /end MEASUREMENT
/begin MEASUREMENT RKRNMW1 "" UBYTE SENSORB 0 0 0.000000 4.980470 ECU_ADDRESS 0xB0442 BIT_MASK 0xFF /end MEASUREMENT
/begin MEASUREMENT RKRNMW2 "" UBYTE SENSORB 0 0 0.000000 4.980470 ECU_ADDRESS 0xB0443 BIT_MASK 0xFF /end MEASUREMENT
/begin MEASUREMENT RLDKTHP " rl-Signal hochpassgefiltert" UBYTE UFUELL 0 0 0.000000 191.250000 ECU_ADDRESS 0xB0885 BIT_MASK 0xFF /end MEASUREMENT
/begin MEASUREMENT RLDKTHP2 " rl-Signal hochpassgefiltert, Bank2" UBYTE UFUELL 0 0 0.000000 191.250000 ECU_ADDRESS 0xB0886 BIT_MASK 0xFF /end MEASUREMENT
/begin MEASUREMENT RLDKTSO_U8 "DKATSTP1/2: Wert obere Lastkennlinie KL_RLDKTSO" UBYTE DEZ 0 0 0.000000 256.000000 ECU_ADDRESS 0xB0895 BIT_MASK 0xFF /end MEASUREMENT
/begin MEASUREMENT RLDKTSU_U8 "DKATSTP1/2: Wert untere Lastkennlinie KL_RLDKTSU" UBYTE DEZ 0 0 0.000000 256.000000 ECU_ADDRESS 0xB0896 BIT_MASK 0xFF /end MEASUREMENT
/begin MEASUREMENT RMP_LOAD " Rampen-Anforderung im FGR aus 100ms Raster" UBYTE DEZ 0 0 0.000000 256.000000 ECU_ADDRESS 0xB04DA BIT_MASK 0xFF /end MEASUREMENT
/begin MEASUREMENT ROMCHKPLZ "> Programmlaufzeit 1.Refresh bis Romcheck [2.6us]" UWORD TEQL 0 0 0.000000 174.760000 ECU_ADDRESS 0xF768 BIT_MASK 0xFFFF /end MEASUREMENT
/begin MEASUREMENT ROMC_BITS " Bit-Feld fuer Status ROM-Pruefung" UBYTE DEZ 0 0 0.000000 256.000000 ECU_ADDRESS 0xB223C BIT_MASK 0xFF /end MEASUREMENT
/begin MEASUREMENT ROMC_C " Fehlerzaehler fuer ROMC Modul" UBYTE DEZ 0 0 0.000000 256.000000 ECU_ADDRESS 0xB223B BIT_MASK 0xFF /end MEASUREMENT
/begin MEASUREMENT ROMERR " Nummer des Pruefblocks mit ROM-Fehler" UBYTE DEZ 0 0 0.000000 256.000000 ECU_ADDRESS 0xB2237 BIT_MASK 0xFF /end MEASUREMENT
/begin MEASUREMENT ROMZ_C_UM " Fehlerzaehler fuer ROMZ" UBYTE DEZ 0 0 0.000000 256.000000 ECU_ADDRESS 0xB2232 BIT_MASK 0xFF /end MEASUREMENT
/begin MEASUREMENT ROM_IRR " irreversibler Fehler bei ROM-Check" UBYTE DEZ 0 0 0.000000 256.000000 ECU_ADDRESS 0xB2239 BIT_MASK 0xFF /end MEASUREMENT
/begin MEASUREMENT ROM_PTR_UM " Zeiger auf Summand" UWORD DEZL 0 0 0.000000 65535.000000 ECU_ADDRESS 0xE06A BIT_MASK 0xFFFF /end MEASUREMENT
/begin MEASUREMENT ROM_PTR_UR " Komplement Zeiger auf Summand" UWORD DEZL 0 0 0.000000 65535.000000 ECU_ADDRESS 0xB1810 BIT_MASK 0xFFFF /end MEASUREMENT
/begin MEASUREMENT ROM_REP " wiederholter Fehler bei ROM-Check" UBYTE DEZ 0 0 0.000000 256.000000 ECU_ADDRESS 0xB223A BIT_MASK 0xFF /end MEASUREMENT
/begin MEASUREMENT ROM_REV " reverssibler Fehler bei ROM-Check" UBYTE DEZ 0 0 0.000000 256.000000 ECU_ADDRESS 0xB2238 BIT_MASK 0xFF /end MEASUREMENT
/begin MEASUREMENT R_ANALU " Interpolierter Wert von ANALUN" UBYTE DEZ 0 0 0.000000 256.000000 ECU_ADDRESS 0xB0746 BIT_MASK 0xFF /end MEASUREMENT
/begin MEASUREMENT R_CLRDRREC " Ruecknahmezeit fuer B_DRREC fuer DMS" UWORD DEZL 0 0 0.000000 65535.000000 ECU_ADDRESS 0x1BD6 BIT_MASK 0xFFFF /end MEASUREMENT
/begin MEASUREMENT R_DTLALU " Interpolierter Wert von DTLALUN" UBYTE UFUELL 0 0 0.000000 191.250000 ECU_ADDRESS 0xB0748 BIT_MASK 0xFF /end MEASUREMENT
/begin MEASUREMENT R_FLAGS_UC " Byte fuer Statusinformationen BT" UBYTE DEZ 0 0 0.000000 256.000000 ECU_ADDRESS 0xE099 BIT_MASK 0xFF /end MEASUREMENT
/begin MEASUREMENT R_FLAGS_UM "" UBYTE DEZ 0 0 0.000000 256.000000 ECU_ADDRESS 0xE000 BIT_MASK 0xFF /end MEASUREMENT
/begin MEASUREMENT R_FSAOFFM " LFR Integ.offset beim Schalten nach P/N" UWORD PER0327 0 0 0.000000 100.000000 ECU_ADDRESS 0xB109A BIT_MASK 0xFFFF /end MEASUREMENT
/begin MEASUREMENT R_FSEOFFM " LFR Integ.offset beim Schalten nach Drive" UWORD PER0327 0 0 0.000000 100.000000 ECU_ADDRESS 0xB1098 BIT_MASK 0xFFFF /end MEASUREMENT
/begin MEASUREMENT R_SWTEMPN " Inhalt von SW_TEMPN bzw. SW_TEMPN1 (Automat)" UBYTE PER255 0 0 0.000000 100.000000 ECU_ADDRESS 0xB04F0 BIT_MASK 0xFF /end MEASUREMENT
/begin MEASUREMENT R_TEST1 " Testbyte 1 fuer VS100/PCAM" UBYTE DEZ 0 0 0.000000 256.000000 ECU_ADDRESS 0xB02CE BIT_MASK 0xFF /end MEASUREMENT
/begin MEASUREMENT R_TEST2 " Testbyte 2 fuer VS100/PCAM" UBYTE DEZ 0 0 0.000000 256.000000 ECU_ADDRESS 0xB02D0 BIT_MASK 0xFF /end MEASUREMENT
/begin MEASUREMENT R_TEST3 " Testbyte 3 fuer VS100/PCAM" UBYTE DEZ 0 0 0.000000 256.000000 ECU_ADDRESS 0xB02D2 BIT_MASK 0xFF /end MEASUREMENT
/begin MEASUREMENT R_TEST4 " Testbyte 4 fuer VS100/PCAM" UBYTE DEZ 0 0 0.000000 256.000000 ECU_ADDRESS 0xB02D4 BIT_MASK 0xFF /end MEASUREMENT
/begin MEASUREMENT R_TEST5 " Testbyte 5 fuer VS100/PCAM" UBYTE DEZ 0 0 0.000000 256.000000 ECU_ADDRESS 0xB02D6 BIT_MASK 0xFF /end MEASUREMENT
/begin MEASUREMENT R_TEST6 " Testbyte 6 fuer VS100/PCAM" UBYTE DEZ 0 0 0.000000 256.000000 ECU_ADDRESS 0xB02D8 BIT_MASK 0xFF /end MEASUREMENT
/begin MEASUREMENT R_TEST7 " Testbyte 7 fuer VS100/PCAM" UBYTE DEZ 0 0 0.000000 256.000000 ECU_ADDRESS 0xB02DA BIT_MASK 0xFF /end MEASUREMENT
/begin MEASUREMENT R_TEST8 " Testbyte 8 fuer VS100/PCAM" UBYTE DEZ 0 0 0.000000 256.000000 ECU_ADDRESS 0xB02DC BIT_MASK 0xFF /end MEASUREMENT
/begin MEASUREMENT R_TNALU " Interpolierter Wert von TNALUN" UBYTE DEZ 0 0 0.000000 256.000000 ECU_ADDRESS 0xB0747 BIT_MASK 0xFF /end MEASUREMENT
/begin MEASUREMENT R_TVDRREC " Zeit nach Taupunkterk. fuer DMS" UWORD DEZL 0 0 0.000000 65535.000000 ECU_ADDRESS 0x1BD4 BIT_MASK 0xFFFF /end MEASUREMENT
/begin MEASUREMENT R_TVFSAM " Zwischenspeicher fuer TVFSAM" UBYTE TQ10 0 0 0.000000 2.550000 ECU_ADDRESS 0xB109D BIT_MASK 0xFF /end MEASUREMENT
/begin MEASUREMENT R_TVFSEM " Zwischenspeicher fuer TVFSEM" UBYTE TQ10 0 0 0.000000 2.550000 ECU_ADDRESS 0xB109C BIT_MASK 0xFF /end MEASUREMENT
/begin MEASUREMENT R_WMAX " gleich wie WMAXMEN" UBYTE ZWQ 0 0 0.000000 191.250000 ECU_ADDRESS 0xF740 BIT_MASK 0xFF /end MEASUREMENT
/begin MEASUREMENT SDTLWD "Delta TLW-Wert (W-Speicher) - DLUKW" SBYTE TLQSL 0 0 -1397.880000 1397.840000 ECU_ADDRESS 0xB0488 BIT_MASK 0xFF /end MEASUREMENT
/begin MEASUREMENT SFPAAA "" UWORD DEZL 0 0 0.000000 65535.000000 ECU_ADDRESS 0xB2532 BIT_MASK 0xFFFF /end MEASUREMENT
/begin MEASUREMENT SFPACMVER "Diagnose irreversible ACC abschalten" UWORD DEZL 0 0 0.000000 65535.000000 ECU_ADDRESS 0xB25B2 BIT_MASK 0xFFFF /end MEASUREMENT
/begin MEASUREMENT SFPBL "Status Fehlerpfad: Diagnose Bremslichtschalter" UWORD DEZL 0 0 0.000000 65535.000000 ECU_ADDRESS 0xB259C BIT_MASK 0xFFFF /end MEASUREMENT
/begin MEASUREMENT SFPCACC "Diagnose ACC" UWORD DEZL 0 0 0.000000 65535.000000 ECU_ADDRESS 0xB25AA BIT_MASK 0xFFFF /end MEASUREMENT
/begin MEASUREMENT SFPCAN "Status Fehlerpfad: Diagnose CAN" UWORD DEZL 0 0 0.000000 65535.000000 ECU_ADDRESS 0xB2574 BIT_MASK 0xFFFF /end MEASUREMENT
/begin MEASUREMENT SFPCASR "Diagnose ASR" UWORD DEZL 0 0 0.000000 65535.000000 ECU_ADDRESS 0xB25A8 BIT_MASK 0xFFFF /end MEASUREMENT
/begin MEASUREMENT SFPCBC "Status Fehlerpfad: CAN Nachrichtenfehler BC" UWORD DEZL 0 0 0.000000 65535.000000 ECU_ADDRESS 0xB2576 BIT_MASK 0xFFFF /end MEASUREMENT
/begin MEASUREMENT SFPCEGS "Status Fehlerpfad: Diagnose Getriebeschnittstelle ueber CAN" UWORD DEZL 0 0 0.000000 65535.000000 ECU_ADDRESS 0xB2578 BIT_MASK 0xFFFF /end MEASUREMENT
/begin MEASUREMENT SFPCNBA "Diagnose NBA" UWORD DEZL 0 0 0.000000 65535.000000 ECU_ADDRESS 0xB25AC BIT_MASK 0xFFFF /end MEASUREMENT
/begin MEASUREMENT SFPDG "Status Fehlerpfad: Diagnose-Bits Drehzahlgeber" UWORD DEZL 0 0 0.000000 65535.000000 ECU_ADDRESS 0xB253C BIT_MASK 0xFFFF /end MEASUREMENT
/begin MEASUREMENT SFPDTV1 "Status Fehlerpfad: LR-Adaption ti-additiv, Bank1" UWORD DEZL 0 0 0.000000 65535.000000 ECU_ADDRESS 0xB25A4 BIT_MASK 0xFFFF /end MEASUREMENT
/begin MEASUREMENT SFPDVE "Status Fehlerpfad: Diagnose-Bits DK-Steller" UWORD DEZL 0 0 0.000000 65535.000000 ECU_ADDRESS 0xB2544 BIT_MASK 0xFFFF /end MEASUREMENT
/begin MEASUREMENT SFPEKPE "Status Fehlerpfad: Endstufendiagnose-Bits EKP" UWORD DEZL 0 0 0.000000 65535.000000 ECU_ADDRESS 0xB256E BIT_MASK 0xFFFF /end MEASUREMENT
/begin MEASUREMENT SFPEV1 "Status Fehlerpfad: Endstufendiagnose-Bits EV1" UWORD DEZL 0 0 0.000000 65535.000000 ECU_ADDRESS 0xB255E BIT_MASK 0xFFFF /end MEASUREMENT
/begin MEASUREMENT SFPEV2 "Status Fehlerpfad: Endstufendiagnose-Bits EV2" UWORD DEZL 0 0 0.000000 65535.000000 ECU_ADDRESS 0xB2560 BIT_MASK 0xFFFF /end MEASUREMENT
/begin MEASUREMENT SFPEV3 "Status Fehlerpfad: Endstufendiagnose-Bits EV3" UWORD DEZL 0 0 0.000000 65535.000000 ECU_ADDRESS 0xB2562 BIT_MASK 0xFFFF /end MEASUREMENT
/begin MEASUREMENT SFPEV4 "Status Fehlerpfad: Endstufendiagnose-Bits EV4" UWORD DEZL 0 0 0.000000 65535.000000 ECU_ADDRESS 0xB2564 BIT_MASK 0xFFFF /end MEASUREMENT
/begin MEASUREMENT SFPEV5 "Status Fehlerpfad: Endstufendiagnose-Bits EV5" UWORD DEZL 0 0 0.000000 65535.000000 ECU_ADDRESS 0xB2566 BIT_MASK 0xFFFF /end MEASUREMENT
/begin MEASUREMENT SFPFELA "Status Fehlerpfad: Endstufen-Diagnosebits Fehlerlampe" UWORD DEZL 0 0 0.000000 65535.000000 ECU_ADDRESS 0xB256C BIT_MASK 0xFFFF /end MEASUREMENT
/begin MEASUREMENT SFPFGRE "Status Fehlerpfad: Diagnose FGR-Lampe" UWORD DEZL 0 0 0.000000 65535.000000 ECU_ADDRESS 0xB259A BIT_MASK 0xFFFF /end MEASUREMENT
/begin MEASUREMENT SFPFRA1 "Status Fehlerpfad: LR-Adaption multiplikativ, Bank1" UWORD DEZL 0 0 0.000000 65535.000000 ECU_ADDRESS 0xB25A2 BIT_MASK 0xFFFF /end MEASUREMENT
/begin MEASUREMENT SFPHFM "Status Fehlerpfad: Diagnosebits Luftmassenmesser HFM" UWORD DEZL 0 0 0.000000 65535.000000 ECU_ADDRESS 0xB2534 BIT_MASK 0xFFFF /end MEASUREMENT
/begin MEASUREMENT SFPHSH "Status Fehlerpfad: Diagnose Lambdasonden-Heizungs-diagn. h. Kat Bank1" UWORD DEZL 0 0 0.000000 65535.000000 ECU_ADDRESS 0xB2592 BIT_MASK 0xFFFF /end MEASUREMENT
/begin MEASUREMENT SFPHSHE "Status Fehlerpfad: Endstufen-Diagnose Sondenheizer hinter Kat Bank1" UWORD DEZL 0 0 0.000000 65535.000000 ECU_ADDRESS 0xB2596 BIT_MASK 0xFFFF /end MEASUREMENT
/begin MEASUREMENT SFPHSV "Status Fehlerpfad: Diagnose Lambdasonden-Heizungs-diagn. vor Kat" UWORD DEZL 0 0 0.000000 65535.000000 ECU_ADDRESS 0xB2590 BIT_MASK 0xFFFF /end MEASUREMENT
/begin MEASUREMENT SFPHSVE "Status Fehlerpfad: Endstufen-Diagnosebits Sondenheizer v. Kat" UWORD DEZL 0 0 0.000000 65535.000000 ECU_ADDRESS 0xB2594 BIT_MASK 0xFFFF /end MEASUREMENT
/begin MEASUREMENT SFPIPDK "Status Fehlerpfad: Diagnose-Bits Istwertpoti" UWORD DEZL 0 0 0.000000 65535.000000 ECU_ADDRESS 0xB2546 BIT_MASK 0xFFFF /end MEASUREMENT
/begin MEASUREMENT SFPKAT1 "Status Fehlerpfad: Katalysatorkonvertierung Bank1" UWORD DEZL 0 0 0.000000 65535.000000 ECU_ADDRESS 0xB259E BIT_MASK 0xFFFF /end MEASUREMENT
/begin MEASUREMENT SFPKOSE "Status Fehlerpfad: Endstufen-Diagnosebits fuer Klimakompressor" UWORD DEZL 0 0 0.000000 65535.000000 ECU_ADDRESS 0xB256A BIT_MASK 0xFFFF /end MEASUREMENT
/begin MEASUREMENT SFPKRHW "Status Fehlerpfad: Diagnosebits KR - HW - Test B2_BI" UWORD DEZL 0 0 0.000000 65535.000000 ECU_ADDRESS 0xB2552 BIT_MASK 0xFFFF /end MEASUREMENT
/begin MEASUREMENT SFPKRS1 "Status Fehlerpfad: Diagnosebits KR - Sensor1 - Abfall" UWORD DEZL 0 0 0.000000 65535.000000 ECU_ADDRESS 0xB2554 BIT_MASK 0xFFFF /end MEASUREMENT
/begin MEASUREMENT SFPKRS2 "Status Fehlerpfad: Diagnosebits KR - Sensor2 - Abfall" UWORD DEZL 0 0 0.000000 65535.000000 ECU_ADDRESS 0xB2556 BIT_MASK 0xFFFF /end MEASUREMENT
/begin MEASUREMENT SFPKUPPL "Diagnose EGS-SG schaltet Motorsteuerung ab" UWORD DEZL 0 0 0.000000 65535.000000 ECU_ADDRESS 0xB25B0 BIT_MASK 0xFFFF /end MEASUREMENT
/begin MEASUREMENT SFPLFR "Status Fehlerpfad: LFR-Diagnose" UWORD DEZL 0 0 0.000000 65535.000000 ECU_ADDRESS 0xB2550 BIT_MASK 0xFFFF /end MEASUREMENT
/begin MEASUREMENT SFPLSH1 "Status Fehlerpfad: Diag Lambdasondenbetriebsbereitschaft. h. Kat Bank1" UWORD DEZL 0 0 0.000000 65535.000000 ECU_ADDRESS 0xB2588 BIT_MASK 0xFFFF /end MEASUREMENT
/begin MEASUREMENT SFPLSV1 "Status Fehlerpfad: Diagnosebits Lambdasondendiagn. vor Kat Bank1" UWORD DEZL 0 0 0.000000 65535.000000 ECU_ADDRESS 0xB2586 BIT_MASK 0xFFFF /end MEASUREMENT
/begin MEASUREMENT SFPLUES1 "Status Fehlerpfad: Endstufen-Diagnosebits fuer Luefter Stufe 1" UWORD DEZL 0 0 0.000000 65535.000000 ECU_ADDRESS 0xB255A BIT_MASK 0xFFFF /end MEASUREMENT
/begin MEASUREMENT SFPLUES2 "Status Fehlerpfad: Endstufen-Diagnosebits fuer Luefter Stufe 2" UWORD DEZL 0 0 0.000000 65535.000000 ECU_ADDRESS 0xB255C BIT_MASK 0xFFFF /end MEASUREMENT
/begin MEASUREMENT SFPMD "Status Fehlerpfad: Diagnose Ausetzererkennung gesamt" UWORD DEZL 0 0 0.000000 65535.000000 ECU_ADDRESS 0xB257A BIT_MASK 0xFFFF /end MEASUREMENT
/begin MEASUREMENT SFPMD1 "Status Fehlerpfad: Diagnose Ausetzererkennung Zyl. 1" UWORD DEZL 0 0 0.000000 65535.000000 ECU_ADDRESS 0xB257C BIT_MASK 0xFFFF /end MEASUREMENT
/begin MEASUREMENT SFPMD2 "Status Fehlerpfad: Diagnose Ausetzererkennung Zyl. 2" UWORD DEZL 0 0 0.000000 65535.000000 ECU_ADDRESS 0xB257E BIT_MASK 0xFFFF /end MEASUREMENT
/begin MEASUREMENT SFPMD3 "Status Fehlerpfad: Diagnose Ausetzererkennung Zyl. 3" UWORD DEZL 0 0 0.000000 65535.000000 ECU_ADDRESS 0xB2580 BIT_MASK 0xFFFF /end MEASUREMENT
/begin MEASUREMENT SFPMD4 "Status Fehlerpfad: Diagnose Ausetzererkennung Zyl. 4" UWORD DEZL 0 0 0.000000 65535.000000 ECU_ADDRESS 0xB2582 BIT_MASK 0xFFFF /end MEASUREMENT
/begin MEASUREMENT SFPMD5 "Status Fehlerpfad: Diagnose Ausetzererkennung Zyl. 5" UWORD DEZL 0 0 0.000000 65535.000000 ECU_ADDRESS 0xB2584 BIT_MASK 0xFFFF /end MEASUREMENT
/begin MEASUREMENT SFPMILFB "Diagnose Mil fremdbestimmt" UWORD DEZL 0 0 0.000000 65535.000000 ECU_ADDRESS 0xB25AE BIT_MASK 0xFFFF /end MEASUREMENT
/begin MEASUREMENT SFPNWSE "Status Fehlerpfad: Endstufendiagnose-Bits NWS" UWORD DEZL 0 0 0.000000 65535.000000 ECU_ADDRESS 0xB2572 BIT_MASK 0xFFFF /end MEASUREMENT
/begin MEASUREMENT SFPPEDST "Status Fehlerpfad: Diagnose Bits Pedalanschlag" UWORD DEZL 0 0 0.000000 65535.000000 ECU_ADDRESS 0xB254A BIT_MASK 0xFFFF /end MEASUREMENT
/begin MEASUREMENT SFPPH "Status Fehlerpfad: Diagnosebits Phasensensor" UWORD DEZL 0 0 0.000000 65535.000000 ECU_ADDRESS 0xB253E BIT_MASK 0xFFFF /end MEASUREMENT
/begin MEASUREMENT SFPPMOEL "Status Fehlerpfad: Diagnosebits Oeldruckschalter" UWORD DEZL 0 0 0.000000 65535.000000 ECU_ADDRESS 0xB2542 BIT_MASK 0xFFFF /end MEASUREMENT
/begin MEASUREMENT SFPPWG "Status Fehlerpfad: Diagnose-Bits PWG" UWORD DEZL 0 0 0.000000 65535.000000 ECU_ADDRESS 0xB2548 BIT_MASK 0xFFFF /end MEASUREMENT
/begin MEASUREMENT SFPRSKA "Status Fehlerpfad: Diagnose reversible Sicherheitskraftstoffabschalten" UWORD DEZL 0 0 0.000000 65535.000000 ECU_ADDRESS 0xB254C BIT_MASK 0xFFFF /end MEASUREMENT
/begin MEASUREMENT SFPSKAUM "Status Fehlerpfad: Diagnose Sicherheitskraftstoffab. von Ueberwachungsfkt." UWORD DEZL 0 0 0.000000 65535.000000 ECU_ADDRESS 0xB254E BIT_MASK 0xFFFF /end MEASUREMENT
/begin MEASUREMENT SFPSUE "Status Fehlerpfad: Endstufendiagnose-Bits Saugrohrumschaltung" UWORD DEZL 0 0 0.000000 65535.000000 ECU_ADDRESS 0xB2570 BIT_MASK 0xFFFF /end MEASUREMENT
/begin MEASUREMENT SFPSWE "Status Fehlerpfad: Schlechtwegerkennung" UWORD DEZL 0 0 0.000000 65535.000000 ECU_ADDRESS 0xB25A6 BIT_MASK 0xFFFF /end MEASUREMENT
/begin MEASUREMENT SFPTEVE "Status Fehlerpfad: Endstufendiagnose-Bits TEV" UWORD DEZL 0 0 0.000000 65535.000000 ECU_ADDRESS 0xB2568 BIT_MASK 0xFFFF /end MEASUREMENT
/begin MEASUREMENT SFPTFA "Status Fehlerpfad: Diagnosebits Ansauglufttemperaturfuehler" UWORD DEZL 0 0 0.000000 65535.000000 ECU_ADDRESS 0xB2538 BIT_MASK 0xFFFF /end MEASUREMENT
/begin MEASUREMENT SFPTFM "Status Fehlerpfad: Diagnosebits Motortemperaturfuehler" UWORD DEZL 0 0 0.000000 65535.000000 ECU_ADDRESS 0xB2536 BIT_MASK 0xFFFF /end MEASUREMENT
/begin MEASUREMENT SFPTRA1 "Status Fehlerpfad: LR-Adaption QL-additiv, Bank1" UWORD DEZL 0 0 0.000000 65535.000000 ECU_ADDRESS 0xB25A0 BIT_MASK 0xFFFF /end MEASUREMENT
/begin MEASUREMENT SFPUB "Status Fehlerpfad: Diagnosebits Batteriespannung" UWORD DEZL 0 0 0.000000 65535.000000 ECU_ADDRESS 0xB2540 BIT_MASK 0xFFFF /end MEASUREMENT
/begin MEASUREMENT SFPVFZ "Status Fehlerpfad: Diagnose Geschwindigkeitssignal" UWORD DEZL 0 0 0.000000 65535.000000 ECU_ADDRESS 0xB253A BIT_MASK 0xFFFF /end MEASUREMENT
/begin MEASUREMENT SFPVTSK "Status Fehlerpfad: Diagnose FGR-Bedienhebel" UWORD DEZL 0 0 0.000000 65535.000000 ECU_ADDRESS 0xB2598 BIT_MASK 0xFFFF /end MEASUREMENT
/begin MEASUREMENT SFPWFS "Status Fehlerpfad: WFS Fehler" UWORD DEZL 0 0 0.000000 65535.000000 ECU_ADDRESS 0xB2558 BIT_MASK 0xFFFF /end MEASUREMENT
/begin MEASUREMENT SFPZZZ "" UWORD DEZL 0 0 0.000000 65535.000000 ECU_ADDRESS 0xB25B6 BIT_MASK 0xFFFF /end MEASUREMENT
/begin MEASUREMENT SGADVB_C "Stoergroessen-Adaptions-Verbotzeit-Zaehler" UWORD TQ10L 0 0 0.000000 655.350000 ECU_ADDRESS 0xB053E BIT_MASK 0xFFFF /end MEASUREMENT
/begin MEASUREMENT SGNALT1 "LR-Gemischvorzeichen Bank1" UBYTE DEZ 0 0 0.000000 256.000000 ECU_ADDRESS 0xB0336 BIT_MASK 0xFF /end MEASUREMENT
/begin MEASUREMENT SGNALT2 "LR-Gemischvorzeichen Bank1" UBYTE DEZ 0 0 0.000000 256.000000 ECU_ADDRESS 0xB0337 BIT_MASK 0xFF /end MEASUREMENT
/begin MEASUREMENT SGSC_C_UC " DA Entprellzaehler in SGS" UBYTE DEZ 0 0 0.000000 256.000000 ECU_ADDRESS 0xE0C1 BIT_MASK 0xFF /end MEASUREMENT
/begin MEASUREMENT SGSC_C_UR " DA Entprellzaehler in SGS" UBYTE DEZ 0 0 0.000000 256.000000 ECU_ADDRESS 0xB181E BIT_MASK 0xFF /end MEASUREMENT
/begin MEASUREMENT SGSNU_C_UC " DA Entprellzaehler in SGS" UBYTE DEZ 0 0 0.000000 256.000000 ECU_ADDRESS 0xE0C2 BIT_MASK 0xFF /end MEASUREMENT
/begin MEASUREMENT SGSNU_C_UR " DA Entprellzaehler in SGS" UBYTE DEZ 0 0 0.000000 256.000000 ECU_ADDRESS 0xB181F BIT_MASK 0xFF /end MEASUREMENT
/begin MEASUREMENT SP1P_A_UR " Byte fuer DA sp1p_a_um" UBYTE DEZ 0 0 0.000000 256.000000 ECU_ADDRESS 0xB17E9 BIT_MASK 0xFF /end MEASUREMENT
/begin MEASUREMENT SP1P_ST_UR " Byte fuer DA sp1p_st_um" UBYTE DEZ 0 0 0.000000 256.000000 ECU_ADDRESS 0xB17EB BIT_MASK 0xFF /end MEASUREMENT
/begin MEASUREMENT SP1SN "SP1S modifiziert (standardisiert)(10 Bit rechtsbuendig)" UWORD DEZL 0 0 0.000000 65535.000000 ECU_ADDRESS 0xB024E BIT_MASK 0xFFFF /end MEASUREMENT
/begin MEASUREMENT SP1S_A_UR " Byte fuer DA sp1s_a_um" UBYTE DEZ 0 0 0.000000 256.000000 ECU_ADDRESS 0xB17E8 BIT_MASK 0xFF /end MEASUREMENT
/begin MEASUREMENT SP1S_ST_UR "Byte fuer DA sp1s_st_um" UBYTE DEZ 0 0 0.000000 256.000000 ECU_ADDRESS 0xB17EA BIT_MASK 0xFF /end MEASUREMENT
/begin MEASUREMENT SP1S_UR " Sollwertpoti 1" UBYTE PER255 0 0 0.000000 100.000000 ECU_ADDRESS 0xB17B4 BIT_MASK 0xFF /end MEASUREMENT
/begin MEASUREMENT SP2SN "SP2S modifiziert (standardisiert)(10 Bit rechtsbuendig)" UWORD DEZL 0 0 0.000000 65535.000000 ECU_ADDRESS 0xB0250 BIT_MASK 0xFFFF /end MEASUREMENT
/begin MEASUREMENT SP2S_UR " Sollwertpoti 2" UBYTE PER255 0 0 0.000000 100.000000 ECU_ADDRESS 0xB17B5 BIT_MASK 0xFF /end MEASUREMENT
/begin MEASUREMENT SPINTSTL "Spuelratenintegrator Steigung" UBYTE TEVIQ 0 0 0.000000 3.890990 ECU_ADDRESS 0xB0724 BIT_MASK 0xFF /end MEASUREMENT
/begin MEASUREMENT SPMST08_UM " SSt Sollwert" UWORD DEZL 0 0 0.000000 65535.000000 ECU_ADDRESS 0xE076 BIT_MASK 0xFFFF /end MEASUREMENT
/begin MEASUREMENT SPMST08_UR " DA SSt Sollwert" UWORD DEZL 0 0 0.000000 65535.000000 ECU_ADDRESS 0xB1800 BIT_MASK 0xFFFF /end MEASUREMENT
/begin MEASUREMENT SPSC_C_UR " DA Fehlerzaehler SP1S-SP2S unplausibel" UBYTE PER255 0 0 0.000000 100.000000 ECU_ADDRESS 0xB17BC BIT_MASK 0xFF /end MEASUREMENT
/begin MEASUREMENT SPSNFGR_UC " Uebernommener FGR Sollwert fuer BT" UBYTE PER255 0 0 0.000000 100.000000 ECU_ADDRESS 0xE0A5 BIT_MASK 0xFF /end MEASUREMENT
/begin MEASUREMENT SPSNFGR_UR " Byte fuer DA spsnfgr_um" UBYTE DEZ 0 0 0.000000 256.000000 ECU_ADDRESS 0xB17F5 BIT_MASK 0xFF /end MEASUREMENT
/begin MEASUREMENT SPSNMAX_UC " Maximaler Sollwert fuer BT" UBYTE PER255 0 0 0.000000 100.000000 ECU_ADDRESS 0xE0A4 BIT_MASK 0xFF /end MEASUREMENT
/begin MEASUREMENT SPSNMAX_UR " DA max. zul. Pedalsollw." UBYTE DEZ 0 0 0.000000 256.000000 ECU_ADDRESS 0xB1804 BIT_MASK 0xFF /end MEASUREMENT
/begin MEASUREMENT SPSNMSR_UC " Uebernommener MSR Sollwert fuer BT" UBYTE PER255 0 0 0.000000 100.000000 ECU_ADDRESS 0xE0A6 BIT_MASK 0xFF /end MEASUREMENT
/begin MEASUREMENT SPSNMSR_UM " zul. Pedalwert aus MSR in der FU" UBYTE DEZ 0 0 0.000000 256.000000 ECU_ADDRESS 0xE04C BIT_MASK 0xFF /end MEASUREMENT
/begin MEASUREMENT SPSNMSR_UR " Byte fuer DA SPSNMSR_UR" UBYTE DEZ 0 0 0.000000 256.000000 ECU_ADDRESS 0xB1815 BIT_MASK 0xFF /end MEASUREMENT
/begin MEASUREMENT SPSNST08_U " SST Sollwert fuer BT" UWORD DEZ 0 0 0.000000 256.000000 ECU_ADDRESS 0x0 BIT_MASK 0xFFFF /end MEASUREMENT
/begin MEASUREMENT SPSN_FGRUC " Sollwert aus FGR-FKT fuer BT" UBYTE PER255 0 0 0.000000 100.000000 ECU_ADDRESS 0xE0A3 BIT_MASK 0xFF /end MEASUREMENT
/begin MEASUREMENT SPSN_MSRUC " Sollwert MSR fuer BT" UBYTE PER255 0 0 0.000000 100.000000 ECU_ADDRESS 0xE0A9 BIT_MASK 0xFF /end MEASUREMENT
/begin MEASUREMENT SPSN_UC "Normierter Sollwert BT" UBYTE PER255 0 0 0.000000 100.000000 ECU_ADDRESS 0xE082 BIT_MASK 0xFF /end MEASUREMENT
/begin MEASUREMENT SPSN_UR " DA normierte Sollwert-Vorgabe" UBYTE PER255 0 0 0.000000 100.000000 ECU_ADDRESS 0xB17BB BIT_MASK 0xFF /end MEASUREMENT
/begin MEASUREMENT SPS_SAV " Sollwert-Poti-Schleifer von vor 10ms" UWORD DEZL 0 0 0.000000 65535.000000 ECU_ADDRESS 0xB1828 BIT_MASK 0xFFFF /end MEASUREMENT
/begin MEASUREMENT SPUELMIN1 "Spuelratenbegrenzung 1" UBYTE FKT512 0 0 0.000000 0.500000 ECU_ADDRESS 0xB071B BIT_MASK 0xFF /end MEASUREMENT
/begin MEASUREMENT SPUELMIN2 "Spuelratenbegrenzung 2" UBYTE FKT512 0 0 0.000000 0.500000 ECU_ADDRESS 0xB071C BIT_MASK 0xFF /end MEASUREMENT
/begin MEASUREMENT SPUELMIN3 "Spuelratenbegrenzung 3" UBYTE FKT512 0 0 0.000000 0.500000 ECU_ADDRESS 0xB071D BIT_MASK 0xFF /end MEASUREMENT
/begin MEASUREMENT SRSTZ_UR " Byte DA b_srstz_um" UBYTE DEZ 0 0 0.000000 256.000000 ECU_ADDRESS 0xB17ED BIT_MASK 0xFF /end MEASUREMENT
/begin MEASUREMENT SRST_C_UM " Zaehler fuer Diagnose" UBYTE DEZ 0 0 0.000000 256.000000 ECU_ADDRESS 0xB2233 BIT_MASK 0xFF /end MEASUREMENT
/begin MEASUREMENT SR_MZF_UC " Schieberegister fuer Totzeit in CMZF.mcc fuer BT" UBYTE DEZ 0 0 0.000000 256.000000 ECU_ADDRESS 0xE090 BIT_MASK 0xFF /end MEASUREMENT
/begin MEASUREMENT SSFLAGS10 " Errorbits" UBYTE DEZ 0 0 0.000000 256.000000 ECU_ADDRESS 0xFDE0 BIT_MASK 0xFF /end MEASUREMENT
/begin MEASUREMENT SSFLAGS11 " Errorbits" UBYTE DEZ 0 0 0.000000 256.000000 ECU_ADDRESS 0xFDE1 BIT_MASK 0xFF /end MEASUREMENT
/begin MEASUREMENT SSFLAGS12 " Errorbits" UBYTE DEZ 0 0 0.000000 256.000000 ECU_ADDRESS 0xFDE2 BIT_MASK 0xFF /end MEASUREMENT
/begin MEASUREMENT SSFLAGS13 " Errorbits" UBYTE DEZ 0 0 0.000000 256.000000 ECU_ADDRESS 0xFDE3 BIT_MASK 0xFF /end MEASUREMENT
/begin MEASUREMENT SSFLAGS14 " Errorbits" UBYTE DEZ 0 0 0.000000 256.000000 ECU_ADDRESS 0xFDE4 BIT_MASK 0xFF /end MEASUREMENT
/begin MEASUREMENT SSFLAGS15 " Errorbits" UBYTE DEZ 0 0 0.000000 256.000000 ECU_ADDRESS 0xFDE5 BIT_MASK 0xFF /end MEASUREMENT
/begin MEASUREMENT STAZYL " erster Zylinder fuer weiches WE" UBYTE DEZ 0 0 0.000000 256.000000 ECU_ADDRESS 0xB049F BIT_MASK 0xFF /end MEASUREMENT
/begin MEASUREMENT STGK_C " Stellgroessenklammerungs-Zaehler" UBYTE TQ10 0 0 0.000000 2.550000 ECU_ADDRESS 0xB0528 BIT_MASK 0xFF /end MEASUREMENT
/begin MEASUREMENT STGLD_ACTR " Zeitzaehler STGLD-aktiv" UWORD TQ10L 0 0 0.000000 655.350000 ECU_ADDRESS 0xB0D20 BIT_MASK 0xFFFF /end MEASUREMENT
/begin MEASUREMENT STGLD_CS " controlState Parameter" UBYTE DEZ 0 0 0.000000 256.000000 ECU_ADDRESS 0xB0D27 BIT_MASK 0xFF /end MEASUREMENT
/begin MEASUREMENT STGLD_IOCP " InputOutputControlParameter" UBYTE DEZ 0 0 0.000000 256.000000 ECU_ADDRESS 0xB0D26 BIT_MASK 0xFF /end MEASUREMENT
/begin MEASUREMENT STGLD_PCTR " Phasenzaehler fuer Stellgl.-Ansteuerung" UBYTE TQ10 0 0 0.000000 2.550000 ECU_ADDRESS 0xB0D22 BIT_MASK 0xFF /end MEASUREMENT
/begin MEASUREMENT STGLD_RESU " Ergebnisparameter" UBYTE DEZ 0 0 0.000000 256.000000 ECU_ADDRESS 0xB0000 BIT_MASK 0xFF /end MEASUREMENT
/begin MEASUREMENT STGLD_TN_C " Pulsbreitenzaehler fuer TN-Ausgabe" UBYTE DEZ 0 0 0.000000 256.000000 ECU_ADDRESS 0xB0000 BIT_MASK 0xFF /end MEASUREMENT
/begin MEASUREMENT STGMFA "Stellgroessen-Mitfuehranteil (LFR5)" SWORD UWDKL 0 0 -80.916000 80.916000 ECU_ADDRESS 0xB053C BIT_MASK 0xFFFF /end MEASUREMENT
/begin MEASUREMENT STGSW "Stellgroessen-Sollwert" UWORD UDKL 0 0 0.000000 10.112000 ECU_ADDRESS 0xB0518 BIT_MASK 0xFFFF /end MEASUREMENT
/begin MEASUREMENT STR_CAN_S " Synchronisationszaehler f. Streckenz." UBYTE DEZ 0 0 0.000000 256.000000 ECU_ADDRESS 0xB0C1E BIT_MASK 0xFF /end MEASUREMENT
/begin MEASUREMENT SUMME_UM " Register fuer Summe */" UWORD DEZL 0 0 0.000000 65535.000000 ECU_ADDRESS 0xE06C BIT_MASK 0xFFFF /end MEASUREMENT
/begin MEASUREMENT SW_ACC " SollwertDK ACC (15 bit rechtsbuendig)" UWORD PER0327 0 0 0.000000 100.000000 ECU_ADDRESS 0xB05DE BIT_MASK 0xFFFF /end MEASUREMENT
/begin MEASUREMENT SW_ACCNK " Nachkommastellen von sw_acc_a" UWORD DEZL 0 0 0.000000 65535.000000 ECU_ADDRESS 0xB05D8 BIT_MASK 0xFFFF /end MEASUREMENT
/begin MEASUREMENT SW_ACCUF " ungefilterter Wert v. SW_ACC" UWORD PER0327 0 0 0.000000 100.000000 ECU_ADDRESS 0xB05DA BIT_MASK 0xFFFF /end MEASUREMENT
/begin MEASUREMENT SW_ACC_PED " SollwertDK ACC ohne LL-Anteil (15 bit rechtsbuendig)" UWORD PER0327 0 0 0.000000 100.000000 ECU_ADDRESS 0xB05E0 BIT_MASK 0xFFFF /end MEASUREMENT
/begin MEASUREMENT SW_DP "Sollwert aus Dashpot-Funktion" UWORD PER0327 0 0 0.000000 100.000000 ECU_ADDRESS 0xB02C4 BIT_MASK 0xFFFF /end MEASUREMENT
/begin MEASUREMENT SW_EGS " Sollwert Selespeed (15 bit rechtsbuendig)" UWORD PER0327 0 0 0.000000 100.000000 ECU_ADDRESS 0xB05FE BIT_MASK 0xFFFF /end MEASUREMENT
/begin MEASUREMENT SW_EGSNK " Nachkommastellen von sw_egs_a" UWORD DEZL 0 0 0.000000 65535.000000 ECU_ADDRESS 0xB05B8 BIT_MASK 0xFFFF /end MEASUREMENT
/begin MEASUREMENT SW_EGSUF " ungefilterter Wert v. SW_EGS" UWORD PER0327 0 0 0.000000 100.000000 ECU_ADDRESS 0xB05BA BIT_MASK 0xFFFF /end MEASUREMENT
/begin MEASUREMENT SW_ESDLL_R "Leerlauf-Sollwert rechts bei gesteuerter EMS-DK-Verstellung" UWORD PER0327 0 0 0.000000 100.000000 ECU_ADDRESS 0xB0650 BIT_MASK 0xFFFF /end MEASUREMENT
/begin MEASUREMENT SW_LSD "Sollwert aus Lastschlagdaempfung" UWORD PER0327 0 0 0.000000 100.000000 ECU_ADDRESS 0xB02C6 BIT_MASK 0xFFFF /end MEASUREMENT
/begin MEASUREMENT SW_MAX_NCA " Max. SollwertDK fuer Wandlerschutz" UWORD PER0327 0 0 0.000000 100.000000 ECU_ADDRESS 0xB0606 BIT_MASK 0xFFFF /end MEASUREMENT
/begin MEASUREMENT SW_PEDBW_A "Speicher fuer bewerteten Pedal-Sollwert" UWORD PER0327 0 0 0.000000 100.000000 ECU_ADDRESS 0xB0000 BIT_MASK 0xFFFF /end MEASUREMENT
/begin MEASUREMENT SW_PT_B "Maxmimum aus sw_nachl (=min(sw_pedbw,sw_max_n)) und sw_temp" UBYTE PER255 0 0 0.000000 100.000000 ECU_ADDRESS 0xB0656 BIT_MASK 0xFF /end MEASUREMENT
/begin MEASUREMENT SW_PT_W " Sollwertmaximum aus Fahrerwunsch und FGR/ACC" UWORD PER0327 0 0 0.000000 100.000000 ECU_ADDRESS 0xB0658 BIT_MASK 0xFFFF /end MEASUREMENT
/begin MEASUREMENT SYPLZ "> Syncro-Programmlaufzeitzaehler [2.6us]" UWORD TEQL 0 0 0.000000 174.760000 ECU_ADDRESS 0xF762 BIT_MASK 0xFFFF /end MEASUREMENT
/begin MEASUREMENT SZTCALC " Schließzeit aus Hintergrund (in fester Quant.: 2,66 us)" UWORD TEQL 0 0 0.000000 174.760000 ECU_ADDRESS 0xF798 BIT_MASK 0xFFFF /end MEASUREMENT
/begin MEASUREMENT S_DFFM1 " Sperrflags" UWORD DEZL 0 0 0.000000 65535.000000 ECU_ADDRESS 0xFDAC BIT_MASK 0xFFFF /end MEASUREMENT
/begin MEASUREMENT S_DFFM2 " Sperrflags" UWORD DEZL 0 0 0.000000 65535.000000 ECU_ADDRESS 0xFDAE BIT_MASK 0xFFFF /end MEASUREMENT
/begin MEASUREMENT S_FLAGS_UC " Byte fuer Statusinformation Befehlstest" UBYTE DEZ 0 0 0.000000 256.000000 ECU_ADDRESS 0xE09A BIT_MASK 0xFF /end MEASUREMENT
/begin MEASUREMENT S_FLAGS_UM "" UBYTE DEZ 0 0 0.000000 256.000000 ECU_ADDRESS 0xE001 BIT_MASK 0xFF /end MEASUREMENT
/begin MEASUREMENT T2H_ALT " Alter Timer 2 Ueberlauf" UBYTE DEZ 0 0 0.000000 256.000000 ECU_ADDRESS 0xF999 BIT_MASK 0xFF /end MEASUREMENT
/begin MEASUREMENT T2H_NEU " Neuer Timer 2 Ueberlauf" UBYTE DEZ 0 0 0.000000 256.000000 ECU_ADDRESS 0xF998 BIT_MASK 0xFF /end MEASUREMENT
/begin MEASUREMENT T2_ALT " Alter Timer2-Wert (Referenz)" UWORD DEZL 0 0 0.000000 65535.000000 ECU_ADDRESS 0xF994 BIT_MASK 0xFFFF /end MEASUREMENT
/begin MEASUREMENT T2_NEU " Neuer Timer2-Wert" UWORD DEZL 0 0 0.000000 65535.000000 ECU_ADDRESS 0xF992 BIT_MASK 0xFFFF /end MEASUREMENT
/begin MEASUREMENT TABWVZ_T " Verzugszeit nach Rueckdreher fuer Reset" UBYTE TQ10 0 0 0.000000 2.550000 ECU_ADDRESS 0xB1097 BIT_MASK 0xFF /end MEASUREMENT
/begin MEASUREMENT TADSKLTC1 " Verz. fuer Aderschluss bei kalter Sonde (Bank 1)" UBYTE TQ100 0 0 0.000000 25.500000 ECU_ADDRESS 0xB0842 BIT_MASK 0xFF /end MEASUREMENT
/begin MEASUREMENT TADSKLTC2 " Verz. fuer Aderschluss bei kalter Sonde (Bank 2)" UBYTE TQ100 0 0 0.000000 25.500000 ECU_ADDRESS 0xB0843 BIT_MASK 0xFF /end MEASUREMENT
/begin MEASUREMENT TALT_UM " Timerwert des vorh. Berechnungszeitpunktes im 40ms-Raster" UWORD DEZL 0 0 0.000000 65535.000000 ECU_ADDRESS 0xE052 BIT_MASK 0xFFFF /end MEASUREMENT
/begin MEASUREMENT TALT_UR " DA ZZwert des vorh. Berechnungszeitpunktes im 40ms-Raster" UWORD DEZL 0 0 0.000000 65535.000000 ECU_ADDRESS 0xB17F8 BIT_MASK 0xFFFF /end MEASUREMENT
/begin MEASUREMENT TASIGC1 " Zeit Ausblendung Stoerspitzen ausserhalb Band fuer Erk. Signalunterbr.(B1)" UBYTE TQ100 0 0 0.000000 25.500000 ECU_ADDRESS 0xB0844 BIT_MASK 0xFF /end MEASUREMENT
/begin MEASUREMENT TASIGC2 " Zeit Ausblendung Stoerspitzen ausserhalb Band fuer Erk. Signalunterbr.(B2)" UBYTE TQ100 0 0 0.000000 25.500000 ECU_ADDRESS 0xB0845 BIT_MASK 0xFF /end MEASUREMENT
/begin MEASUREMENT TASIGHC ">" UBYTE TQ100 0 0 0.000000 25.500000 ECU_ADDRESS 0xB0866 BIT_MASK 0xFF /end MEASUREMENT
/begin MEASUREMENT TASIGRMC1 "" UBYTE TQ100 0 0 0.000000 25.500000 ECU_ADDRESS 0xB0846 BIT_MASK 0xFF /end MEASUREMENT
/begin MEASUREMENT TASIGRMC2 "" UBYTE TQ100 0 0 0.000000 25.500000 ECU_ADDRESS 0xB0847 BIT_MASK 0xFF /end MEASUREMENT
/begin MEASUREMENT TATEVK "Tastv. Tankentl.vor Korrketu" UBYTE PCENT 0 0 0.000000 99.609400 ECU_ADDRESS 0xB029D BIT_MASK 0xFF /end MEASUREMENT
/begin MEASUREMENT TATMVFZ "Abgastemperatur vor Kat TANSLIN-Filter Ergebnis" UBYTE UTABG 0 0 -48.000000 972.000000 ECU_ADDRESS 0xB067D BIT_MASK 0xFF /end MEASUREMENT
/begin MEASUREMENT TATMVFZW "Abgastemp. TANSLIN-Filter laeuft mit Wort, Highbyte ist Ergebnis" UWORD DEZL 0 0 0.000000 65535.000000 ECU_ADDRESS 0xB067C BIT_MASK 0xFFFF /end MEASUREMENT
/begin MEASUREMENT TBGR20 " Hintergrundlaufzeit in 20 ms" UBYTE TQ20 0 0 0.000000 5.100000 ECU_ADDRESS 0xB062E BIT_MASK 0xFF /end MEASUREMENT
/begin MEASUREMENT TBLRHC1 "Verz.-Zeit f. B_lrh1 nach B_LR1" UBYTE TQ100 0 0 0.000000 25.500000 ECU_ADDRESS 0xB0374 BIT_MASK 0xFF /end MEASUREMENT
/begin MEASUREMENT TBLRHC2 "Verz.-Zeit f. B_lrh2 nach B_LR2" UBYTE TQ100 0 0 0.000000 25.500000 ECU_ADDRESS 0xB0375 BIT_MASK 0xFF /end MEASUREMENT
/begin MEASUREMENT TC6KATA " Tester: Anzahl der ausgabebereiten Wertebloecke" UBYTE DEZ 0 0 0.000000 256.000000 ECU_ADDRESS 0xB218E BIT_MASK 0xFF /end MEASUREMENT
/begin MEASUREMENT TCAP_UM " Timerwert des akt. Berechnungszeitpunktes im 40ms-Raster" UWORD DEZL 0 0 0.000000 65535.000000 ECU_ADDRESS 0xE050 BIT_MASK 0xFFFF /end MEASUREMENT
/begin MEASUREMENT TDAFLU1 " Zeitabregelung TDALU1" UBYTE TQ10 0 0 0.000000 2.550000 ECU_ADDRESS 0xB0C6A BIT_MASK 0xFF /end MEASUREMENT
/begin MEASUREMENT TDDFAC1_TO " Entprellung MAX-Fehler PAC" UWORD TQ10L 0 0 0.000000 655.350000 ECU_ADDRESS 0xB0000 BIT_MASK 0xFFFF /end MEASUREMENT
/begin MEASUREMENT TDDFAC2_TO " Entprellung MIN-Fehler PAC" UWORD TQ10L 0 0 0.000000 655.350000 ECU_ADDRESS 0xB0000 BIT_MASK 0xFFFF /end MEASUREMENT
/begin MEASUREMENT TDDFAC3_TO " Entprellung Fehlerheilung PAC" UWORD TQ10L 0 0 0.000000 655.350000 ECU_ADDRESS 0xB0000 BIT_MASK 0xFFFF /end MEASUREMENT
/begin MEASUREMENT TDDFMAX " Entprellzaehler Max-Fehler DDF" UBYTE TQ100 0 0 0.000000 25.500000 ECU_ADDRESS 0xB0D17 BIT_MASK 0xFF /end MEASUREMENT
/begin MEASUREMENT TDDFMIN " Entprellzaehler Min-Fehler DDF" UBYTE TQ100 0 0 0.000000 25.500000 ECU_ADDRESS 0xB0D16 BIT_MASK 0xFF /end MEASUREMENT
/begin MEASUREMENT TDDFNOFLR " Entprellzaehler kein Fehler DDF" UBYTE TQ100 0 0 0.000000 25.500000 ECU_ADDRESS 0xB0D19 BIT_MASK 0xFF /end MEASUREMENT
/begin MEASUREMENT TDDFRPLAUS " Entprellzaehler Ruecksetzen Plausfehler DDF" UBYTE TQ100 0 0 0.000000 25.500000 ECU_ADDRESS 0xB0D15 BIT_MASK 0xFF /end MEASUREMENT
/begin MEASUREMENT TDDFSPLAUS " Entprellzaehler Setzen Plausfehler DDF" UBYTE TQ100 0 0 0.000000 25.500000 ECU_ADDRESS 0xB0D14 BIT_MASK 0xFF /end MEASUREMENT
/begin MEASUREMENT TDDFST " Entprellzaehler Start DDF" UBYTE TQ100 0 0 0.000000 25.500000 ECU_ADDRESS 0xB0D18 BIT_MASK 0xFF /end MEASUREMENT
/begin MEASUREMENT TDEFLU2 " Zeitabregelung TDELU" UBYTE TQ40 0 0 0.000000 10.200000 ECU_ADDRESS 0xB0C6B BIT_MASK 0xFF /end MEASUREMENT
/begin MEASUREMENT TDIF_UM " Differenz der Berechnungszeitpunkte in Timersteps" UWORD DEZL 0 0 0.000000 65535.000000 ECU_ADDRESS 0xE054 BIT_MASK 0xFFFF /end MEASUREMENT
/begin MEASUREMENT TDKSZ1 "" UBYTE TQ200 0 0 0.000000 51.000000 ECU_ADDRESS 0xB212A BIT_MASK 0xFF /end MEASUREMENT
/begin MEASUREMENT TDKSZ2 "" UBYTE TQ200 0 0 0.000000 51.000000 ECU_ADDRESS 0xB212B BIT_MASK 0xFF /end MEASUREMENT
/begin MEASUREMENT TDKSZH1 "" UBYTE TQ200 0 0 0.000000 51.000000 ECU_ADDRESS 0xB212C BIT_MASK 0xFF /end MEASUREMENT
/begin MEASUREMENT TDKSZH2 "" UBYTE TQ200 0 0 0.000000 51.000000 ECU_ADDRESS 0xB212D BIT_MASK 0xFF /end MEASUREMENT
/begin MEASUREMENT TDLRPERZ1 " Zaehler Sperrzeit nach B_lr1" UWORD TQ10L 0 0 0.000000 655.350000 ECU_ADDRESS 0xB0914 BIT_MASK 0xFFFF /end MEASUREMENT
/begin MEASUREMENT TDLU1 " Zeitabregelung TDFELU1, TDFALU1" UBYTE TQ20 0 0 0.000000 5.100000 ECU_ADDRESS 0xB0C68 BIT_MASK 0xFF /end MEASUREMENT
/begin MEASUREMENT TDLU2 " Zeitabregelung TDFELU2, TDFALU2" UBYTE TQ20 0 0 0.000000 5.100000 ECU_ADDRESS 0xB0C69 BIT_MASK 0xFF /end MEASUREMENT
/begin MEASUREMENT TDTA_Z "Heilungs- u. Entprellzeitzaehler" UBYTE TQ10 0 0 0.000000 2.550000 ECU_ADDRESS 0xB0A0D BIT_MASK 0xFF /end MEASUREMENT
/begin MEASUREMENT TDTM_Z "Heilungs- u. Entprellzeitzaehler" UBYTE TQ10 0 0 0.000000 2.550000 ECU_ADDRESS 0xB0A00 BIT_MASK 0xFF /end MEASUREMENT
/begin MEASUREMENT TDUBMAX_CT "Entprellzaehler Ubatt Max-Fehler" UBYTE TQ100L 0 0 0.000000 6553.500000 ECU_ADDRESS 0xB0A78 BIT_MASK 0xFF /end MEASUREMENT
/begin MEASUREMENT TDWFLA_C " Fehlerlampen Ausschaltverzugszeit" UBYTE TQ10 0 0 0.000000 2.550000 ECU_ADDRESS 0xB0C89 BIT_MASK 0xFF /end MEASUREMENT
/begin MEASUREMENT TDWFLE_C " Fehlerlampen Einschaltverzugszeit" UBYTE TQ10 0 0 0.000000 2.550000 ECU_ADDRESS 0xB0C8A BIT_MASK 0xFF /end MEASUREMENT
/begin MEASUREMENT TE_BMIN " minimale Einspritzzeit beider Bänke" UWORD TEQL 0 0 0.000000 174.760000 ECU_ADDRESS 0xB03EA BIT_MASK 0xFFFF /end MEASUREMENT
/begin MEASUREMENT TFDKHA_T "Timer fuer TFDKHA-Rastergenerierung" UBYTE TQ100 0 0 0.000000 25.500000 ECU_ADDRESS 0xB06DC BIT_MASK 0xFF /end MEASUREMENT
/begin MEASUREMENT TFRAZ_T1 "Timer fuer Verweilzeit in fra Bank 1" UWORD TQ100L 0 0 0.000000 6553.500000 ECU_ADDRESS 0xB094E BIT_MASK 0xFFFF /end MEASUREMENT
/begin MEASUREMENT TFRAZ_T2 "Timer fuer Verweilzeit in fra Bank 2" UWORD TQ100L 0 0 0.000000 6553.500000 ECU_ADDRESS 0xB0950 BIT_MASK 0xFFFF /end MEASUREMENT
/begin MEASUREMENT TFRN1_HILF " Hilfszaehler" UWORD TQ10L 0 0 0.000000 655.350000 ECU_ADDRESS 0xB0368 BIT_MASK 0xFFFF /end MEASUREMENT
/begin MEASUREMENT TFRN2_HILF " Hilfszaehler" UWORD TQ10L 0 0 0.000000 655.350000 ECU_ADDRESS 0xB0370 BIT_MASK 0xFFFF /end MEASUREMENT
/begin MEASUREMENT TFRP1_HILF " Hilfszaehler" UWORD TQ10L 0 0 0.000000 655.350000 ECU_ADDRESS 0xB036A BIT_MASK 0xFFFF /end MEASUREMENT
/begin MEASUREMENT TFRP2_HILF " Hilfszaehler" UWORD TQ10L 0 0 0.000000 655.350000 ECU_ADDRESS 0xB0372 BIT_MASK 0xFFFF /end MEASUREMENT
/begin MEASUREMENT THAS_T "Timer fuer schnelle Hoehenadaption" UBYTE TQ100 0 0 0.000000 25.500000 ECU_ADDRESS 0xB06DB BIT_MASK 0xFF /end MEASUREMENT
/begin MEASUREMENT TIADD_B1 "Additiver Anteil von Einspritzzeit Bank 1" UWORD TEQL 0 0 0.000000 174.760000 ECU_ADDRESS 0xF7C8 BIT_MASK 0xFFFF /end MEASUREMENT
/begin MEASUREMENT TIADD_B2 "Additiver Anteil von Einspritzzeit Bank 2" UBYTE TEQL 0 0 0.000000 174.760000 ECU_ADDRESS 0xF7CA BIT_MASK 0xFF /end MEASUREMENT
/begin MEASUREMENT TIADD_ST "Addit. Anteil des Start-TI Bank1/2 intern" UWORD TEQ_8L 0 0 0.000000 1398.080000 ECU_ADDRESS 0xF7D2 BIT_MASK 0xFFFF /end MEASUREMENT
/begin MEASUREMENT TI_AUSB " Anforderung EV-Ausblendung von ASR-SG (0...6 Zyl.)" UBYTE DEZ 0 0 0.000000 256.000000 ECU_ADDRESS 0xB0576 BIT_MASK 0xFF /end MEASUREMENT
/begin MEASUREMENT TI_EV0 "Einspritzzeit Zylinder 0" UWORD TEQL 0 0 0.000000 174.760000 ECU_ADDRESS 0xF7A8 BIT_MASK 0xFFFF /end MEASUREMENT
/begin MEASUREMENT TI_EV1 "Einspritzzeit Zylinder 1" UWORD TEQL 0 0 0.000000 174.760000 ECU_ADDRESS 0xF7AA BIT_MASK 0xFFFF /end MEASUREMENT
/begin MEASUREMENT TI_EV2 "Einspritzzeit Zylinder 2" UWORD TEQL 0 0 0.000000 174.760000 ECU_ADDRESS 0xF7AC BIT_MASK 0xFFFF /end MEASUREMENT
/begin MEASUREMENT TI_EV3 "Einspritzzeit Zylinder 3" UWORD TEQL 0 0 0.000000 174.760000 ECU_ADDRESS 0xF7AE BIT_MASK 0xFFFF /end MEASUREMENT
/begin MEASUREMENT TI_EV4 "Einspritzzeit Zylinder 4" UWORD TEQL 0 0 0.000000 174.760000 ECU_ADDRESS 0xF7B0 BIT_MASK 0xFFFF /end MEASUREMENT
/begin MEASUREMENT TI_EV5 "Einspritzzeit Zylinder 5" UWORD TEQL 0 0 0.000000 174.760000 ECU_ADDRESS 0xF7B2 BIT_MASK 0xFFFF /end MEASUREMENT
/begin MEASUREMENT TI_EV6 "Einspritzzeit Zylinder 6" UWORD TEQL 0 0 0.000000 174.760000 ECU_ADDRESS 0xF7B4 BIT_MASK 0xFFFF /end MEASUREMENT
/begin MEASUREMENT TI_EV7 "Einspritzzeit Zylinder 7" UWORD TEQL 0 0 0.000000 174.760000 ECU_ADDRESS 0xF7B6 BIT_MASK 0xFFFF /end MEASUREMENT
/begin MEASUREMENT TI_INTEG " KVA-Einspritzzeit-Integrator" UWORD TEQL 0 0 0.000000 174.760000 ECU_ADDRESS 0xFA26 BIT_MASK 0xFFFF /end MEASUREMENT
/begin MEASUREMENT TI_INTEG_H " KVA-Einspritzzeit-Integrator [174ms/Inc]" UWORD DEZL 0 0 0.000000 65535.000000 ECU_ADDRESS 0xFA28 BIT_MASK 0xFFFF /end MEASUREMENT
/begin MEASUREMENT TL1FON " Indexeckpunkt" UBYTE UFUELL 0 0 0.000000 191.250000 ECU_ADDRESS 0xB07C3 BIT_MASK 0xFF /end MEASUREMENT
/begin MEASUREMENT TL2FON " Indexeckpunkt" UBYTE UFUELL 0 0 0.000000 191.250000 ECU_ADDRESS 0xB07C4 BIT_MASK 0xFF /end MEASUREMENT
/begin MEASUREMENT TL3FON " Indexeckpunkt" UBYTE UFUELL 0 0 0.000000 191.250000 ECU_ADDRESS 0xB07C5 BIT_MASK 0xFF /end MEASUREMENT
/begin MEASUREMENT TL4FON " Indexeckpunkt" UBYTE UFUELL 0 0 0.000000 191.250000 ECU_ADDRESS 0xB07C6 BIT_MASK 0xFF /end MEASUREMENT
/begin MEASUREMENT TL8AC "Normierte Last fuer Momentberechnung ACC (Quant.=0.5%)" UBYTE UFUELL 0 0 0.000000 191.250000 ECU_ADDRESS 0xB059B BIT_MASK 0xFF /end MEASUREMENT
/begin MEASUREMENT TL8ST08_UC " SST Lastsignal fuer BT" UWORD DEZ 0 0 0.000000 256.000000 ECU_ADDRESS 0xE0AC BIT_MASK 0xFFFF /end MEASUREMENT
/begin MEASUREMENT TL8ST08_UM " SSt Lastsignal" UWORD DEZL 0 0 0.000000 65535.000000 ECU_ADDRESS 0xE060 BIT_MASK 0xFFFF /end MEASUREMENT
/begin MEASUREMENT TL8ST08_UR " DA SSt Lastsignal" UWORD DEZL 0 0 0.000000 65535.000000 ECU_ADDRESS 0xB1806 BIT_MASK 0xFFFF /end MEASUREMENT
/begin MEASUREMENT TL8_ALT "Alte Last TL8" UBYTE PCENT 0 0 0.000000 99.609400 ECU_ADDRESS 0xF8F0 BIT_MASK 0xFF /end MEASUREMENT
/begin MEASUREMENT TL8_DASE "Referenz fuer Delta-TL8 Bildung" UBYTE UFUELL 0 0 0.000000 191.250000 ECU_ADDRESS 0xB0749 BIT_MASK 0xFF /end MEASUREMENT
/begin MEASUREMENT TL8_UC "normiertes Lastsignal fuer BT" UBYTE UFUELL 0 0 0.000000 191.250000 ECU_ADDRESS 0xE086 BIT_MASK 0xFF /end MEASUREMENT
/begin MEASUREMENT TL8_UR " 8-B normiertes Lastsignal" UBYTE UFUELL 0 0 0.000000 191.250000 ECU_ADDRESS 0xB17B6 BIT_MASK 0xFF /end MEASUREMENT
/begin MEASUREMENT TLIPF_LOW_ " Nachkommastellen des Filterwertes" UBYTE DEZ 0 0 0.000000 256.000000 ECU_ADDRESS 0x0 BIT_MASK 0xFF /end MEASUREMENT
/begin MEASUREMENT TLIPF_UM " TL-Info aus DK-Istwert nach TP-Filter" UBYTE DEZ 0 0 0.000000 256.000000 ECU_ADDRESS 0xE012 BIT_MASK 0xFF /end MEASUREMENT
/begin MEASUREMENT TLIPF_UR " DA TL-Info aus DK-Istwert nach TP-Filter" UBYTE DEZ 0 0 0.000000 256.000000 ECU_ADDRESS 0xB17BD BIT_MASK 0xFF /end MEASUREMENT
/begin MEASUREMENT TLIPT_UM " TL-Info aus DK-Istwert nach Totzeit" UBYTE DEZ 0 0 0.000000 256.000000 ECU_ADDRESS 0xE011 BIT_MASK 0xFF /end MEASUREMENT
/begin MEASUREMENT TLIP_C_UM " Fehlerzaehler TL-Vergleich mit DK-Last-Info" UBYTE DEZ 0 0 0.000000 256.000000 ECU_ADDRESS 0xE017 BIT_MASK 0xFF /end MEASUREMENT
/begin MEASUREMENT TLIP_C_UR " DA Fehlerzaehler TL-Vergleich mit DK-Last-Info" UBYTE DEZ 0 0 0.000000 256.000000 ECU_ADDRESS 0xB17C0 BIT_MASK 0xFF /end MEASUREMENT
/begin MEASUREMENT TLIP_UM " TL-Info aus DK-Istwert" UBYTE DEZ 0 0 0.000000 256.000000 ECU_ADDRESS 0xE010 BIT_MASK 0xFF /end MEASUREMENT
/begin MEASUREMENT TLKRN_R "KR-Last-Regelschwelle f. B_kr" UBYTE UFUELL 0 0 0.000000 191.250000 ECU_ADDRESS 0xB0445 BIT_MASK 0xFF /end MEASUREMENT
/begin MEASUREMENT TLLUR_AP " " UWORD DEZL 0 0 0.000000 65535.000000 ECU_ADDRESS 0xF9A2 BIT_MASK 0xFFFF /end MEASUREMENT
/begin MEASUREMENT TLM "TLM (=LAST) gefiltert" UWORD TEQL 0 0 0.000000 174.760000 ECU_ADDRESS 0xF966 BIT_MASK 0xFFFF /end MEASUREMENT
/begin MEASUREMENT TLRAN_R "TL8-Schwelle(nist) aus KL tlran" UBYTE UFUELL 0 0 0.000000 191.250000 ECU_ADDRESS 0xB03A9 BIT_MASK 0xFF /end MEASUREMENT
/begin MEASUREMENT TLRFILT "TLR gefiltert mit ZTLFLFN" UWORD TEQL 0 0 0.000000 174.760000 ECU_ADDRESS 0xB06B4 BIT_MASK 0xFFFF /end MEASUREMENT
/begin MEASUREMENT TLRHUN_R "TL8-Schwelle(nist) aus KL tlrhun" UBYTE UFUELL 0 0 0.000000 191.250000 ECU_ADDRESS 0xB03B1 BIT_MASK 0xFF /end MEASUREMENT
/begin MEASUREMENT TLROK_C "Zaehler fuer TL-Regelungs-Pruefung" UWORD TQ100L 0 0 0.000000 6553.500000 ECU_ADDRESS 0xB0000 BIT_MASK 0xFFFF /end MEASUREMENT
/begin MEASUREMENT TLRSAZ "Verz.-Zaehler f. tlrsa (b_sa ) Qu. 0.1 s" UBYTE TQ100 0 0 0.000000 25.500000 ECU_ADDRESS 0xB03A6 BIT_MASK 0xFF /end MEASUREMENT
/begin MEASUREMENT TLSTA_R "Startlast aus TLSTAM bzw. KFTLSTA" UBYTE UFUELL 0 0 0.000000 191.250000 ECU_ADDRESS 0xF961 BIT_MASK 0xFF /end MEASUREMENT
/begin MEASUREMENT TLS_TMP "aktueller TL-Sollwert der LFR" UBYTE UFUELL 0 0 0.000000 191.250000 ECU_ADDRESS 0xB0551 BIT_MASK 0xFF /end MEASUREMENT
/begin MEASUREMENT TLWAC "Nebenlastsignal fuer Momentberechnung ACC, Q=32*2.666us" UBYTE TEQ_32 0 0 0.000000 21.760000 ECU_ADDRESS 0xB059C BIT_MASK 0xFF /end MEASUREMENT
/begin MEASUREMENT TLWTC "Nebenlastsignal Q=32*2.666us" UBYTE TEQ_32 0 0 0.000000 21.760000 ECU_ADDRESS 0xB0590 BIT_MASK 0xFF /end MEASUREMENT
/begin MEASUREMENT TLW_ALT "Altes Nebenlastsignal" UBYTE TEQ_32 0 0 0.000000 21.760000 ECU_ADDRESS 0xB048A BIT_MASK 0xFF /end MEASUREMENT
/begin MEASUREMENT TLW_URALT "20ms-altes Nebenlastsignal" UBYTE TEQ_32 0 0 0.000000 21.760000 ECU_ADDRESS 0xB048B BIT_MASK 0xFF /end MEASUREMENT
/begin MEASUREMENT TLZO_UM " Ergebnis aus Grenzwertberechnung oben" UBYTE DEZ 0 0 0.000000 256.000000 ECU_ADDRESS 0xE015 BIT_MASK 0xFF /end MEASUREMENT
/begin MEASUREMENT TLZU_UM " Ergebnis aus Grenzwertberechnung unten" UBYTE DEZ 0 0 0.000000 256.000000 ECU_ADDRESS 0xE014 BIT_MASK 0xFF /end MEASUREMENT
/begin MEASUREMENT TL_AP "Ausgabe von TL8 aus Trommel" UBYTE UFUELL 0 0 0.000000 191.250000 ECU_ADDRESS 0x0 BIT_MASK 0xFF /end MEASUREMENT
/begin MEASUREMENT TL_C_UM " Fehlerzaehler TL-Vergleich mit der Funktion" UBYTE DEZ 0 0 0.000000 256.000000 ECU_ADDRESS 0xE016 BIT_MASK 0xFF /end MEASUREMENT
/begin MEASUREMENT TL_C_UR " DA Fehlerzaehler TL-Vergleich mit der Funktion" UBYTE DEZ 0 0 0.000000 256.000000 ECU_ADDRESS 0xB17BF BIT_MASK 0xFF /end MEASUREMENT
/begin MEASUREMENT TL_PTR_UM " Zeiger Schieberegister 'tlip'" UBYTE DEZ 0 0 0.000000 256.000000 ECU_ADDRESS 0xE018 BIT_MASK 0xFF /end MEASUREMENT
/begin MEASUREMENT TL_PTR_UR " DA Zeiger Schieberegister 'tlip'" UBYTE DEZ 0 0 0.000000 256.000000 ECU_ADDRESS 0xB17C1 BIT_MASK 0xFF /end MEASUREMENT
/begin MEASUREMENT TL_UM " Lastsignal (Q/n) 16Bit" UWORD TEQL 0 0 0.000000 174.760000 ECU_ADDRESS 0xE04E BIT_MASK 0xFFFF /end MEASUREMENT
/begin MEASUREMENT TL_UR " Lastsignal (Q/n) 16Bit" UWORD DEZL 0 0 0.000000 65535.000000 ECU_ADDRESS 0xB17F6 BIT_MASK 0xFFFF /end MEASUREMENT
/begin MEASUREMENT TMASK " Tmot im Start f. DMDMIL" UBYTE CMO_TMP 0 0 -41.000000 140.000000 ECU_ADDRESS 0xB0A28 BIT_MASK 0xFF /end MEASUREMENT
/begin MEASUREMENT TMDSWEB " 100ms Timer Dswec 4.0" UBYTE TQ10 0 0 0.000000 2.550000 ECU_ADDRESS 0xF982 BIT_MASK 0xFF /end MEASUREMENT
/begin MEASUREMENT TMDSWEC " 100ms Timer Dswec 4.0" UBYTE TQ10L 0 0 0.000000 655.350000 ECU_ADDRESS 0xF986 BIT_MASK 0xFF /end MEASUREMENT
/begin MEASUREMENT TMLRTMS_ "LR-Freigabetemp. aus TMLRTMS(Starttemp.)" UBYTE CMO_TMP 0 0 -41.000000 140.000000 ECU_ADDRESS 0xB03AC BIT_MASK 0xFF /end MEASUREMENT
/begin MEASUREMENT TMVDBS_C1 " Neuer Timer1-Wert" UWORD TQ10L 0 0 0.000000 655.350000 ECU_ADDRESS 0xF974 BIT_MASK 0xFFFF /end MEASUREMENT
/begin MEASUREMENT TMVDBS_C2 " Neuer Timer2-Wert" UWORD TQ10L 0 0 0.000000 655.350000 ECU_ADDRESS 0xF976 BIT_MASK 0xFFFF /end MEASUREMENT
/begin MEASUREMENT TM_EGS " GetriebeOeltemperatur" UBYTE UTMP_40 0 0 -40.000000 216.000000 ECU_ADDRESS 0xB05F7 BIT_MASK 0xFF /end MEASUREMENT
/begin MEASUREMENT TN2 "Zuendabstand TN (Q=2.66us | im Start 21.33us)" UWORD TEQL 0 0 0.000000 174.760000 ECU_ADDRESS 0xF714 BIT_MASK 0xFFFF /end MEASUREMENT
/begin MEASUREMENT TNALUZ " Zaehler fuer Testphase Aussetzererkennung" UBYTE DEZ 0 0 0.000000 256.000000 ECU_ADDRESS 0xB0745 BIT_MASK 0xFF /end MEASUREMENT
/begin MEASUREMENT TNMAXAT_C " Zaehler Getriebeschutz" UBYTE DEZ 0 0 0.000000 256.000000 ECU_ADDRESS 0xB0C80 BIT_MASK 0xFF /end MEASUREMENT
/begin MEASUREMENT TNMAXKE_C " Zaehler Kurzzeitdrehzahlgrenze EGAS" UBYTE DEZ 0 0 0.000000 256.000000 ECU_ADDRESS 0xB0C7F BIT_MASK 0xFF /end MEASUREMENT
/begin MEASUREMENT TNMAXK_C " Zaehler Kurzzeitdrehzahlgrenze" UBYTE DEZ 0 0 0.000000 256.000000 ECU_ADDRESS 0xB0C7E BIT_MASK 0xFF /end MEASUREMENT
/begin MEASUREMENT TNSTDNC1 " Zeitfenster nach Start fuer Sonde kalt (Bank 1)" UBYTE TQ100 0 0 0.000000 25.500000 ECU_ADDRESS 0xB0838 BIT_MASK 0xFF /end MEASUREMENT
/begin MEASUREMENT TNSTDNC2 " Zeitfenster nach Start fuer Sonde kalt (Bank 2)" UBYTE TQ100 0 0 0.000000 25.500000 ECU_ADDRESS 0xB0839 BIT_MASK 0xFF /end MEASUREMENT
/begin MEASUREMENT TNSUUK_T "Zeitzaehler fuer Unterdrueckung UKSEFI im Nachstart" UWORD TQ100L 0 0 0.000000 6553.500000 ECU_ADDRESS 0xB0472 BIT_MASK 0xFFFF /end MEASUREMENT
/begin MEASUREMENT TNWSKHM_C "Zaehler Sperrzeit NWS im Warmlauf bei Kat-Heizen" UWORD TQ10L 0 0 0.000000 655.350000 ECU_ADDRESS 0xF9E2 BIT_MASK 0xFFFF /end MEASUREMENT
/begin MEASUREMENT TPDKATLRP1 "" UBYTE UFUELL 0 0 0.000000 191.250000 ECU_ADDRESS 0xB090A BIT_MASK 0xFF /end MEASUREMENT
/begin MEASUREMENT TPED1_C " Fehlerzeitzaehler sp1s" UBYTE TQ10 0 0 0.000000 2.550000 ECU_ADDRESS 0xB0D1A BIT_MASK 0xFF /end MEASUREMENT
/begin MEASUREMENT TPED2_C " Fehlerzeitzaehler sp2s" UBYTE TQ10 0 0 0.000000 2.550000 ECU_ADDRESS 0xB0D1B BIT_MASK 0xFF /end MEASUREMENT
/begin MEASUREMENT TPERMA " Periodendauer Master-Bank" UWORD TQ10L 0 0 0.000000 655.350000 ECU_ADDRESS 0xB0348 BIT_MASK 0xFFFF /end MEASUREMENT
/begin MEASUREMENT TPERSL " Periodendauer Slave-Bank" UWORD TQ10L 0 0 0.000000 655.350000 ECU_ADDRESS 0xB0358 BIT_MASK 0xFFFF /end MEASUREMENT
/begin MEASUREMENT TPLNWSE " Entprellzeit fuer NWS Endstufenfehler" UWORD TQ10L 0 0 0.000000 655.350000 ECU_ADDRESS 0xB182A BIT_MASK 0xFFFF /end MEASUREMENT
/begin MEASUREMENT TRAB1Z "Verz.-Zaehler f. trab1 (tlran1 ) Qu. 0.1 s" UBYTE TQ100 0 0 0.000000 25.500000 ECU_ADDRESS 0xB03A8 BIT_MASK 0xFF /end MEASUREMENT
/begin MEASUREMENT TRABZ "Verz.-Zaehler f. trab (tlran ) Qu. 0.1 s" UBYTE TQ100 0 0 0.000000 25.500000 ECU_ADDRESS 0xB03A7 BIT_MASK 0xFF /end MEASUREMENT
/begin MEASUREMENT TRAZS1 "TRA-Integrator Bank 1 Zwischenwert" SWORD TEQ_CPL 0 0 -87.381300 87.378700 ECU_ADDRESS 0xB094A BIT_MASK 0xFFFF /end MEASUREMENT
/begin MEASUREMENT TRA_B1L " LRA-Integrator.low Bank1 addit. Korr.-Faktor" UWORD DEZL 0 0 0.000000 65535.000000 ECU_ADDRESS 0xB2020 BIT_MASK 0xFFFF /end MEASUREMENT
/begin MEASUREMENT TRA_B2L " dto. Bank2" UWORD DEZL 0 0 0.000000 65535.000000 ECU_ADDRESS 0xB2024 BIT_MASK 0xFFFF /end MEASUREMENT
/begin MEASUREMENT TRGID_B " Triggerident Ausgabe Raster B (10ms)" UWORD DEZL 0 0 0.000000 65535.000000 ECU_ADDRESS 0xB0204 BIT_MASK 0xFFFF /end MEASUREMENT
/begin MEASUREMENT TRGID_C " Triggerident Ausgabe Raster C (100ms)" UWORD DEZL 0 0 0.000000 65535.000000 ECU_ADDRESS 0xB0206 BIT_MASK 0xFFFF /end MEASUREMENT
/begin MEASUREMENT TRGSEGAD "VS100: Triggersegment-Adresse" UWORD DEZL 0 0 0.000000 65535.000000 ECU_ADDRESS 0xB0200 BIT_MASK 0xFFFF /end MEASUREMENT
/begin MEASUREMENT TRGSEG_A " Trigger Messdatentransfer Raster A (winkelsynchron)" UWORD DEZL 0 0 0.000000 65535.000000 ECU_ADDRESS 0xB023C BIT_MASK 0xFFFF /end MEASUREMENT
/begin MEASUREMENT TRGSEG_B " Trigger Messdatentransfer Raster B (10ms) u. C (100ms)" UWORD DEZL 0 0 0.000000 65535.000000 ECU_ADDRESS 0xB023E BIT_MASK 0xFFFF /end MEASUREMENT
/begin MEASUREMENT TRMESSZ "Schreibzeiger auf Trommeln (TR-synchron)" UBYTE DEZ 0 0 0.000000 256.000000 ECU_ADDRESS 0xF9AF BIT_MASK 0xFF /end MEASUREMENT
/begin MEASUREMENT TRSAC1 " Sondenueberwachungszeit 'Ausschalten'" UBYTE TQ100 0 0 0.000000 25.500000 ECU_ADDRESS 0xB082A BIT_MASK 0xFF /end MEASUREMENT
/begin MEASUREMENT TRSAC2 " Sondenueberwachungszeit 'Ausschalten'" UBYTE TQ100 0 0 0.000000 25.500000 ECU_ADDRESS 0xB082B BIT_MASK 0xFF /end MEASUREMENT
/begin MEASUREMENT TRSAHC " Sondenueberwachungszeit 'Ausschalten'" UWORD TQ100L 0 0 0.000000 6553.500000 ECU_ADDRESS 0xB0856 BIT_MASK 0xFFFF /end MEASUREMENT
/begin MEASUREMENT TRSAHC1 " Sondenueberwachungszeit 'Ausschalten'" UWORD TQ100L 0 0 0.000000 6553.500000 ECU_ADDRESS 0xB0856 BIT_MASK 0xFFFF /end MEASUREMENT
/begin MEASUREMENT TRSAHC2 " Sondenueberwachungszeit 'Ausschalten'" UWORD TQ100L 0 0 0.000000 6553.500000 ECU_ADDRESS 0xB0858 BIT_MASK 0xFFFF /end MEASUREMENT
/begin MEASUREMENT TRSEC1 " Sondenueberwachungszeit 'Einschalten'" UBYTE TQ100 0 0 0.000000 25.500000 ECU_ADDRESS 0xB0828 BIT_MASK 0xFF /end MEASUREMENT
/begin MEASUREMENT TRSEC2 " Sondenueberwachungszeit 'Einschalten'" UBYTE TQ100 0 0 0.000000 25.500000 ECU_ADDRESS 0xB0829 BIT_MASK 0xFF /end MEASUREMENT
/begin MEASUREMENT TRSEHC " Sondenueberwachungszeit 'Einschalten'" UBYTE TQ100 0 0 0.000000 25.500000 ECU_ADDRESS 0xB0872 BIT_MASK 0xFF /end MEASUREMENT
/begin MEASUREMENT TRSEHC1 " Sondenueberwachungszeit 'Einschalten'" UBYTE TQ100 0 0 0.000000 25.500000 ECU_ADDRESS 0xB0872 BIT_MASK 0xFF /end MEASUREMENT
/begin MEASUREMENT TRSEHC2 " Sondenueberwachungszeit 'Einschalten'" UBYTE TQ100 0 0 0.000000 25.500000 ECU_ADDRESS 0xB0873 BIT_MASK 0xFF /end MEASUREMENT
/begin MEASUREMENT TS "Addit. TI-Spannungskorr (im St. *8)" UWORD TEQL 0 0 0.000000 174.760000 ECU_ADDRESS 0xF95C BIT_MASK 0xFFFF /end MEASUREMENT
/begin MEASUREMENT TS2H_ASE " Aktueller Segmentzeit Overflow [Ttn]" UBYTE DEZ 0 0 0.000000 256.000000 ECU_ADDRESS 0xF99A BIT_MASK 0xFF /end MEASUREMENT
/begin MEASUREMENT TS2_ASE " Aktuelle Segmentzeit [Ttn]" UWORD TSQL 0 0 0.000000 43690.000000 ECU_ADDRESS 0xF996 BIT_MASK 0xFFFF /end MEASUREMENT
/begin MEASUREMENT TSAM "Counter von T_sa_m" UBYTE TQ20 0 0 0.000000 5.100000 ECU_ADDRESS 0xB05E7 BIT_MASK 0xFF /end MEASUREMENT
/begin MEASUREMENT TSFON_OFFS " Zeigervariable Roh-Segmentzeiten-Tabelle zum Aufruf %DMDFON" UBYTE DEZ 0 0 0.000000 256.000000 ECU_ADDRESS 0xB0000 BIT_MASK 0xFF /end MEASUREMENT
/begin MEASUREMENT TSNW_3 " Segmentzeit hoch 3" UWORD DEZL 0 0 0.000000 65535.000000 ECU_ADDRESS 0xB07CA BIT_MASK 0xFFFF /end MEASUREMENT
/begin MEASUREMENT TSNW_3_EXP " 2-er Exponent von TS_3" UBYTE DEZ 0 0 0.000000 256.000000 ECU_ADDRESS 0xB07CC BIT_MASK 0xFF /end MEASUREMENT
/begin MEASUREMENT TSPER_C1 "Sperrzeit-Zaehler Sonde 1" UBYTE TQ10 0 0 0.000000 2.550000 ECU_ADDRESS 0xB0379 BIT_MASK 0xFF /end MEASUREMENT
/begin MEASUREMENT TSPER_C2 "Sperrzeit-Zaehler Sonde 2" UBYTE TQ10 0 0 0.000000 2.550000 ECU_ADDRESS 0xB037A BIT_MASK 0xFF /end MEASUREMENT
/begin MEASUREMENT TSTEAAZ " Zaehler Sperrzeit nach B_te" UBYTE TQ100 0 0 0.000000 25.500000 ECU_ADDRESS 0xB0911 BIT_MASK 0xFF /end MEASUREMENT
/begin MEASUREMENT TSTFL_C " Entprellz. fuer FGR-Fehler Loeschen" UBYTE TQ20 0 0 0.000000 5.100000 ECU_ADDRESS 0xB04EF BIT_MASK 0xFF /end MEASUREMENT
/begin MEASUREMENT TST_VERBOT " solange Zaehler >0 ist wird keine" UBYTE TQ20 0 0 0.000000 5.100000 ECU_ADDRESS 0xB0000 BIT_MASK 0xFF /end MEASUREMENT
/begin MEASUREMENT TS_3 "> Segmentzeit hoch 3" UWORD DEZL 0 0 0.000000 65535.000000 ECU_ADDRESS 0xF9AC BIT_MASK 0xFFFF /end MEASUREMENT
/begin MEASUREMENT TS_3_EXP "> 2-er Exponent von TS_3" UBYTE DEZ 0 0 0.000000 256.000000 ECU_ADDRESS 0xF9AE BIT_MASK 0xFF /end MEASUREMENT
/begin MEASUREMENT TS_AC_B1 " tatsaechliche TI-Spannungskorr Bank1 (im St. *8)" UWORD TEQL 0 0 0.000000 174.760000 ECU_ADDRESS 0xFA2E BIT_MASK 0xFFFF /end MEASUREMENT
/begin MEASUREMENT TS_AC_B2 " tatsaechliche TI-Spannungskorr Bank2 (im St. *8)" UWORD TEQL 0 0 0.000000 174.760000 ECU_ADDRESS 0xFA30 BIT_MASK 0xFFFF /end MEASUREMENT
/end MODULE
/end PROJECT
