ASAP2_VERSION 1 3
/begin PROJECT _ " [ME.ME3.1C.09.4111.DAMOS25]  DAMPAR_04"
/begin HEADER "Lancia Thesis 5-Zyl. 2,4 MT" PROJECT_NO 411.1 VERSION "P2FJGD66" /end HEADER
/begin MODULE DIM " "
/begin MOD_COMMON " " S_REC_LAYOUT DAMOS DEPOSIT ABSOLUTE BYTE_ORDER MSB_LAST /end MOD_COMMON
/begin CHARACTERISTIC ABGMSIGH "Abgastemperaturschwelle fuer Signalunterbrechung mit Ri-Dia hinter Kat" VALUE 0x83D8 DAMOS_FW1 0 UTABG -48.000000 972.000000 /end CHARACTERISTIC
/begin RECORD_LAYOUT DAMOS_FW1 FNC_VALUES 1 UBYTE COLUMN_DIR DIRECT /end RECORD_LAYOUT
/begin CHARACTERISTIC ABGMSIGV "Abgastemp.schwelle Signalunterbrechung mit Ri-Diagnose" VALUE 0x83A8 DAMOS_FW1 0 UTABG -48.000000 972.000000 /end CHARACTERISTIC
/begin CHARACTERISTIC ACCC_T_UM "Fehlerzeit fuer ACC-Ueberwachung der FU" VALUE 0x8832 DAMOS_FW1 0 TQ20 0.000000 5.100000 /end CHARACTERISTIC
/begin CHARACTERISTIC ACCNC_T_UM "Fehlerzeit fuer ACC-Konsistensfehler der FU" VALUE 0x8834 DAMOS_FW1 0 TQ20 0.000000 5.100000 /end CHARACTERISTIC
/begin CHARACTERISTIC ACCNU_T_UM "Fehlerzeit fuer ACC-Ueberwachung der FU" VALUE 0x8833 DAMOS_FW1 0 TQ20 0.000000 5.100000 /end CHARACTERISTIC
/begin CHARACTERISTIC ADCC_T_UM "Fehlerentprellzeit bei unplaus. AD-Signal f. FU" VALUE 0x8826 DAMOS_FW1 0 TQ10 0.000000 2.550000 /end CHARACTERISTIC
/begin CHARACTERISTIC ADI_MAX "Maximalwert fuer Adaptions-Integrator" VALUE 0x85C8 DAMOS_FW3 0 UDKL 0.000000 10.112030 EXTENDED_LIMITS 0.000000 10.112000 /end CHARACTERISTIC
/begin RECORD_LAYOUT DAMOS_FW3 FNC_VALUES 1 UWORD COLUMN_DIR DIRECT /end RECORD_LAYOUT
/begin CHARACTERISTIC ADKATNF "Ueberwachungszeit bis 'Zyklus geprueft' Meldung erfolgt" VALUE 0x8374 DAMOS_FW1 0 U0V_24V 0.000000 23.873100 /end CHARACTERISTIC
/begin CHARACTERISTIC ADMBRKL "TL-Sollwert fuer Anfahrdrehmoment-Begrenzung rueckwaerts als f(NIST)" CURVE 0xBFD3 DAMOS_GKL1 0 UFUELL 0.000000 191.250000
 /begin AXIS_DESCR COM_AXIS NIST NQ25 8 0.000000 0.000000 AXIS_PTS_REF NISTV08 EXTENDED_LIMITS 0.000000 6400.000000 /end AXIS_DESCR
/end CHARACTERISTIC
/begin RECORD_LAYOUT DAMOS_GKL1 FNC_VALUES 1 UBYTE COLUMN_DIR DIRECT /end RECORD_LAYOUT
/begin CHARACTERISTIC ADMBR_VH "Vorhalt fuer Anfahrdrehmoment-Begrenzung rueckwaerts" VALUE 0x875A DAMOS_FW3 0 PER0327 0.000000 100.000000 /end CHARACTERISTIC
/begin CHARACTERISTIC ADMBVKL "TL-Sollwert fuer Anfahrdrehmoment-Begrenzung vorwaerts als f(NIST)" CURVE 0xBFCB DAMOS_GKL1 0 UFUELL 0.000000 191.250000
 /begin AXIS_DESCR COM_AXIS NIST NQ25 8 0.000000 0.000000 AXIS_PTS_REF NISTV08 EXTENDED_LIMITS 0.000000 6400.000000 /end AXIS_DESCR
/end CHARACTERISTIC
/begin CHARACTERISTIC ADMBV_VH "Vorhalt fuer Anfahrdrehmoment-Begrenzung vorwaerts" VALUE 0x8758 DAMOS_FW3 0 PER0327 0.000000 100.000000 /end CHARACTERISTIC
/begin CHARACTERISTIC ADMB_RP "Rampen-Delta fuer Sollwert Anfahrdrehmoment-Begrenzung" VALUE 0x8756 DAMOS_FW3 0 PER0327 0.000000 100.000000 /end CHARACTERISTIC
/begin CHARACTERISTIC ADOFDZAN "Adaptionsoffset bei Ladebilanz als f(NIST)" CURVE 0xC0ED DAMOS_GKL1 0 UWKL10 0.000000 10.069900
 /begin AXIS_DESCR COM_AXIS NIST NQ25 4 0.000000 0.000000 AXIS_PTS_REF NISTV06 EXTENDED_LIMITS 0.000000 6400.000000 /end AXIS_DESCR
/end CHARACTERISTIC
/begin CHARACTERISTIC ADOF_F "Adaptionsoffset bei Fahrt als f(NIST)" CURVE 0xC0E1 DAMOS_GKL1 0 UWKL10 0.000000 10.069900
 /begin AXIS_DESCR COM_AXIS NIST NQ25 4 0.000000 0.000000 AXIS_PTS_REF NISTV06 EXTENDED_LIMITS 0.000000 6400.000000 /end AXIS_DESCR
/end CHARACTERISTIC
/begin CHARACTERISTIC ADOF_FK "Adaptionsoffset bei Fahrt und Klimakompressor als f(NIST)" CURVE 0xC0E9 DAMOS_GKL1 0 UWKL10 0.000000 10.069900
 /begin AXIS_DESCR COM_AXIS NIST NQ25 4 0.000000 0.000000 AXIS_PTS_REF NISTV06 EXTENDED_LIMITS 0.000000 6400.000000 /end AXIS_DESCR
/end CHARACTERISTIC
/begin CHARACTERISTIC ADOF_N "Adaptionsoffset bei Neutral als f(NIST)" CURVE 0xC0DD DAMOS_GKL1 0 UWKL10 0.000000 10.069900
 /begin AXIS_DESCR COM_AXIS NIST NQ25 4 0.000000 0.000000 AXIS_PTS_REF NISTV06 EXTENDED_LIMITS 0.000000 6400.000000 /end AXIS_DESCR
/end CHARACTERISTIC
/begin CHARACTERISTIC ADOF_NK "Adaptionsoffset bei Neutral und Klimakompressor als f(NIST)" CURVE 0xC0E5 DAMOS_GKL1 0 UWKL10 0.000000 10.069900
 /begin AXIS_DESCR COM_AXIS NIST NQ25 4 0.000000 0.000000 AXIS_PTS_REF NISTV06 EXTENDED_LIMITS 0.000000 6400.000000 /end AXIS_DESCR
/end CHARACTERISTIC
/begin CHARACTERISTIC AD_HW "Adaptionsinitialisierungswert als f(FDKHA)" CURVE 0xBFBB DAMOS_GKL1 0 UWKL10 0.000000 10.069900
 /begin AXIS_DESCR COM_AXIS FDKHA FKT128 8 0.000000 0.000000 AXIS_PTS_REF FDKHAV08 EXTENDED_LIMITS 0.000000 1.992190 /end AXIS_DESCR
/end CHARACTERISTIC
/begin CHARACTERISTIC AD_P_MT "Motortemperaturschwelle fuer positive Adaption" VALUE 0x85B5 DAMOS_FW1 0 CMO_TMP -41.000000 140.000000 /end CHARACTERISTIC
/begin CHARACTERISTIC AD_RP_T "Adaptions-Rampenzeit" VALUE 0x85B6 DAMOS_FW1 0 TQ10 0.000000 2.550000 /end CHARACTERISTIC
/begin CHARACTERISTIC AHEAGW "Aussetzerhaeufigkeit zum Erreichen der gesetzlichen Abgaslimits" VALUE 0x8470 DAMOS_FW3 0 DEZL 0.000000 65535.000000 /end CHARACTERISTIC
/begin CHARACTERISTIC AHEAGWS "Aussetzerhaeufigkeit zum Erreichen der gesetzlichen Abgaslimits" VALUE 0x8472 DAMOS_FW3 0 DEZL 0.000000 65535.000000 /end CHARACTERISTIC
/begin CHARACTERISTIC AHEARV "Aussetzerhaeufigkeit für Ausblendung weiterer Fkt." VALUE 0x847A DAMOS_FW3 0 DEZL 0.000000 65535.000000 /end CHARACTERISTIC
/begin CHARACTERISTIC AHEKA "Aussetzerhaeufigkeit zum Erreichen einer Kraftstoffabschaltung" VALUE 0x8474 DAMOS_FW3 0 DEZL 0.000000 65535.000000 /end CHARACTERISTIC
/begin CHARACTERISTIC AHEKS "Aussetzerhaeufigkeit zum Erreichen einer Katalysatorschaedigung" VALUE 0x8476 DAMOS_FW3 0 DEZL 0.000000 65535.000000 /end CHARACTERISTIC
/begin CHARACTERISTIC AHEKS1 "Aussetzerhaeufigkeit zum Erreichen einer Katalysatorschaedigung" VALUE 0x8478 DAMOS_FW3 0 DEZL 0.000000 65535.000000 /end CHARACTERISTIC
/begin CHARACTERISTIC AHKATMN "Schwellwert Katalysator gut" VALUE 0x8375 DAMOS_FW1 0 FKT256 0.000000 0.996094 EXTENDED_LIMITS 0.000000 0.996090 /end CHARACTERISTIC
/begin CHARACTERISTIC AHKATMX "Schwellwert Katalysator defekt" VALUE 0x8376 DAMOS_FW1 0 FKT256 0.000000 0.996094 EXTENDED_LIMITS 0.000000 0.996090 /end CHARACTERISTIC
/begin CHARACTERISTIC AHKATS "Schwellwert fuer Summe AHKAT, AHKAT2" VALUE 0x8377 DAMOS_FW1 0 FKT128 0.000000 1.992188 EXTENDED_LIMITS 0.000000 1.992190 /end CHARACTERISTIC
/begin CHARACTERISTIC AHKATSB "Schwellwert fuer Summenbereichfehler" VALUE 0x8378 DAMOS_FW1 0 FKT256 0.000000 0.996094 EXTENDED_LIMITS 0.000000 0.996090 /end CHARACTERISTIC
/begin CHARACTERISTIC AHKTISW "Setzwert fuer Integrator in Signalauswertung" VALUE 0x837A DAMOS_FW3 0 TQ12MS5L 0.000000 819.187500 EXTENDED_LIMITS 0.000000 819.188000 /end CHARACTERISTIC
/begin CHARACTERISTIC AHKTMXT "Schwellwert Katalysator defekt bei Testerbetrieb" VALUE 0x837C DAMOS_FW1 0 FKT256 0.000000 0.996094 EXTENDED_LIMITS 0.000000 0.996090 /end CHARACTERISTIC
/begin CHARACTERISTIC AHKTTSW "Setzwert fuer Zeitgeber in Signalauswertung" VALUE 0x837E DAMOS_FW3 0 TQ50L 0.000000 3276.750000 /end CHARACTERISTIC
/begin CHARACTERISTIC AINTKA "Anzahl Intervalle mit Katschädigung für ti-Abschaltung" VALUE 0x847C DAMOS_FW1 0 DEZ 0.000000 256.000000 /end CHARACTERISTIC
/begin CHARACTERISTIC ALFO " " VALUE 0x8318 DAMOS_FW3 0 DTSEGNL 0.000000 287.995600 EXTENDED_LIMITS 0.000000 287.996000 /end CHARACTERISTIC
/begin CHARACTERISTIC ANALUN "Anzahl Verbrennungen fuer Ausblendungn nach erkannten Aussetzer" CURVE 0xB783 DAMOS_GKL1 0 DEZ 0.000000 256.000000
 /begin AXIS_DESCR COM_AXIS NIST NQ25 8 0.000000 0.000000 AXIS_PTS_REF NDMDV08 EXTENDED_LIMITS 0.000000 6400.000000 /end AXIS_DESCR
/end CHARACTERISTIC
/begin CHARACTERISTIC ANWFOHE " " VALUE 0x8314 DAMOS_FW1 0 DEZ 0.000000 256.000000 /end CHARACTERISTIC
/begin CHARACTERISTIC ANWFOST " " VALUE 0x8310 DAMOS_FW1 0 DEZ 0.000000 256.000000 /end CHARACTERISTIC
/begin CHARACTERISTIC ANZDPVK "Anzahl der Perioden fuer Ready-Flag der Usvk-Periodenueberwachung" VALUE 0x8323 DAMOS_FW1 0 DEZ 0.000000 256.000000 /end CHARACTERISTIC
/begin CHARACTERISTIC ANZDYNSH "Anzahl der Dynamikmessungen fuer Schwingungspruefung Sonde hinter Kat" VALUE 0x8345 DAMOS_FW1 0 DEZ 0.000000 256.000000 /end CHARACTERISTIC
/begin CHARACTERISTIC ANZGEM "Schwelle fuer Gemischfehlerausloesung" VALUE 0x83A9 DAMOS_FW1 0 DEZ 0.000000 256.000000 /end CHARACTERISTIC
/begin CHARACTERISTIC ANZRIBEH "Anzahl Ri-Berechnungen hinter Kat" VALUE 0x83E8 DAMOS_FW1 0 DEZ 0.000000 256.000000 /end CHARACTERISTIC
/begin CHARACTERISTIC ANZRIBEV "Anzahl Ri-Berechnungen vor Katersalatohr" VALUE 0x83E9 DAMOS_FW1 0 DEZ 0.000000 256.000000 /end CHARACTERISTIC
/begin CHARACTERISTIC ANZTP "Anzahl auszublendender Perioden fuer Periodendauerueberwachung" VALUE 0x8322 DAMOS_FW1 0 DEZ 0.000000 256.000000 /end CHARACTERISTIC
/begin CHARACTERISTIC APDBS "Anzahl für die Prüfzyklen für die Diagnose Beschleunigungssensor " VALUE 0x82F7 DAMOS_FW1 0 DEZ 0.000000 256.000000 /end CHARACTERISTIC
/begin CHARACTERISTIC APEKTDX "max. Anzahl Fehlerpruefungen bei Kat-Diagnose" VALUE 0x8380 DAMOS_FW1 0 DEZ 0.000000 256.000000 /end CHARACTERISTIC
/begin CHARACTERISTIC ATMTANS "Korrektur Abgastemperatur" CURVE 0xB07F DAMOS_GKL1 0 UTABGR 0.000000 1020.000000
 /begin AXIS_DESCR COM_AXIS TANS CLU_TMP 8 0.000000 0.000000 AXIS_PTS_REF TANSV08 EXTENDED_LIMITS -50.000000 150.000000 /end AXIS_DESCR
/end CHARACTERISTIC
/begin CHARACTERISTIC ATVFETTO "Oberer Grenzwert fuer ATVFETT" VALUE 0x8482 DAMOS_FW1 0 TQ40 0.000000 10.200000 /end CHARACTERISTIC
/begin CHARACTERISTIC ATVFETTU "Unterer Grenzwert fuer ATVFETT" VALUE 0x8483 DAMOS_FW1 0 TQ40 0.000000 10.200000 /end CHARACTERISTIC
/begin CHARACTERISTIC ATVINI1 "Initialisierungswert fuer Stellgroesse atv, Bank1" VALUE 0x822F DAMOS_FW2 0 TQ10MSS -1.280000 1.270000 /end CHARACTERISTIC
/begin RECORD_LAYOUT DAMOS_FW2 FNC_VALUES 1 SBYTE COLUMN_DIR DIRECT /end RECORD_LAYOUT
/begin CHARACTERISTIC ATVMAGO "Oberer Grenzwert fuer ATVMAGER" VALUE 0x8484 DAMOS_FW1 0 TQ40 0.000000 10.200000 /end CHARACTERISTIC
/begin CHARACTERISTIC ATVMAGU "Unterer Grenzwert fuer ATVMAGER" VALUE 0x8485 DAMOS_FW1 0 TQ40 0.000000 10.200000 /end CHARACTERISTIC
/begin CHARACTERISTIC AUSGH_T_UM "Max. Fehlerzeit f. Heilung RAM-Absicherung in der FU" VALUE 0x8820 DAMOS_FW1 0 UMFAUSG 0.000000 10200.000000 /end CHARACTERISTIC
/begin CHARACTERISTIC AUSG_T_UM "Max. Fehlerzeit f. Entprellung SW-Reset in der ausg-FU" VALUE 0x881E DAMOS_FW1 0 UMFAUSG 0.000000 10200.000000 /end CHARACTERISTIC
/begin CHARACTERISTIC AUSZH_T_UM "Max. Fehlerzeit f. Heilung ROM in der FU" VALUE 0x8821 DAMOS_FW1 0 UMFAUSG 0.000000 10200.000000 /end CHARACTERISTIC
/begin CHARACTERISTIC AUSZ_T_UM "Max. Anzahl Prüfung Datapage im Fehlerfall in der ausg-FU" VALUE 0x881F DAMOS_FW1 0 DEZ 0.000000 256.000000 /end CHARACTERISTIC
/begin CHARACTERISTIC AUS_Z "Zeit  bis SW_TEMP = 0 bei AUS mit Rampe" VALUE 0x8664 DAMOS_FW1 0 TQ100 0.000000 2.500000 EXTENDED_LIMITS 0.000000 25.500000 /end CHARACTERISTIC
/begin CHARACTERISTIC AUS_Z_WA "Zeit bis SW_TEMP = 0 bei AUS mit Rampe nach WA" VALUE 0x8665 DAMOS_FW1 0 TQ100 0.000000 2.500000 EXTENDED_LIMITS 0.000000 25.500000 /end CHARACTERISTIC
/begin CHARACTERISTIC AVKATFS "Setzwert fuer AVKATF wenn Powerfail" VALUE 0x8381 DAMOS_FW1 0 FKT256 0.000000 0.996094 EXTENDED_LIMITS 0.000000 0.996090 /end CHARACTERISTIC
/begin CHARACTERISTIC AVRALU "Anzahl NW-Umdr. bei Reaktivierung Aussetzererkennung nach Ausblendung" VALUE 0x8307 DAMOS_FW1 0 DEZ 0.000000 256.000000 /end CHARACTERISTIC
/begin CHARACTERISTIC AZKRLDYN "Anzahl Zuendungen pro Zyl. bei KR-Lastdynamik" CURVE 0xD3A6 DAMOS_KL97 0 DEZ 0.000000 256.000000 /begin AXIS_DESCR STD_AXIS NMOT NQ40 8 0.000000 10200.000000 /end AXIS_DESCR /end CHARACTERISTIC
/begin RECORD_LAYOUT DAMOS_KL97 SRC_ADDR_X 1 UWORD NO_AXIS_PTS_X 2 UBYTE AXIS_PTS_X 3 UBYTE INDEX_INCR DIRECT FNC_VALUES 4 UBYTE COLUMN_DIR DIRECT /end RECORD_LAYOUT
/begin CHARACTERISTIC AZKRNDYN "Anzahl Zuendungen pro Zyl. bei KR-Drehzahldynamik" CURVE 0xD3BA DAMOS_KL97 0 DEZ 0.000000 256.000000 /begin AXIS_DESCR STD_AXIS NMOT NQ40 8 0.000000 10200.000000 /end AXIS_DESCR /end CHARACTERISTIC
/begin CHARACTERISTIC AZYTIAB "Maximale Anzahl von Zylindern mi Ti-Abschaltung aufgrund von Aussetzern" VALUE 0x846E DAMOS_FW1 0 DEZ 0.000000 256.000000 /end CHARACTERISTIC
/begin CHARACTERISTIC A_FGR_NEG "-b Schwelle fuer FGR-Abschaltung" VALUE 0x8680 DAMOS_FW2 0 U_A -1.736100 -0.173610 EXTENDED_LIMITS -22.222100 22.048500 /end CHARACTERISTIC
/begin CHARACTERISTIC A_FGR_POS "+b Schwelle fuer FGR-Abschaltung" VALUE 0x8681 DAMOS_FW2 0 U_A 0.173610 1.736100 EXTENDED_LIMITS -22.222100 22.048500 /end CHARACTERISTIC
/begin CHARACTERISTIC A_NEG_FT "Fehlerzeit -b Schwelle" VALUE 0x8682 DAMOS_FW1 0 TQ20 0.000000 1.600000 EXTENDED_LIMITS 0.000000 5.100000 /end CHARACTERISTIC
/begin CHARACTERISTIC A_POS_FT "Fehlerzeit +b Schwelle" VALUE 0x8683 DAMOS_FW1 0 TQ20 0.000000 2.500000 EXTENDED_LIMITS 0.000000 5.100000 /end CHARACTERISTIC
/begin CHARACTERISTIC BFZG_E "Ersatzbeschleunigung im Fehlerfall" VALUE 0x87C8 DAMOS_FW2 0 U_A -22.222080 22.048470 EXTENDED_LIMITS -22.222100 22.048500 /end CHARACTERISTIC
/begin CHARACTERISTIC BGRPR_MT "Motortemperaturschwelle fuer Begrenzungspruefung" VALUE 0x85BC DAMOS_FW1 0 CMO_TMP -41.000000 140.000000 /end CHARACTERISTIC
/begin CHARACTERISTIC BM_KORR "Gangabhaengige Korrektur nach Verzoegerung" CURVE 0x86A8 DAMOS_FKL1 0 VQV16 0.000000 15.937500
 /begin AXIS_DESCR FIX_AXIS IR0 DEZ 7 0.000000 6.000000 FIX_AXIS_PAR 0 0 7 EXTENDED_LIMITS 0.000000 256.000000 /end AXIS_DESCR
/end CHARACTERISTIC
/begin RECORD_LAYOUT DAMOS_FKL1 FNC_VALUES 1 UBYTE COLUMN_DIR DIRECT /end RECORD_LAYOUT
/begin CHARACTERISTIC BM_ZEIT "Zeit bis SW_TEMP = 0 bei der Verzoegerung" CURVE 0x86BE DAMOS_FKL3 0 TQ100L 0.000000 6553.500000
 /begin AXIS_DESCR FIX_AXIS IR0 DEZ 7 0.000000 6.000000 FIX_AXIS_PAR 0 0 7 EXTENDED_LIMITS 0.000000 256.000000 /end AXIS_DESCR
/end CHARACTERISTIC
/begin RECORD_LAYOUT DAMOS_FKL3 FNC_VALUES 1 UWORD COLUMN_DIR DIRECT /end RECORD_LAYOUT
/begin CHARACTERISTIC BOGON_T_UM "Entprellzeit der FU" VALUE 0x8811 DAMOS_FW1 0 UMFNSC 0.000000 2621400.000000 /end CHARACTERISTIC
/begin CHARACTERISTIC BOS_HW_NR "BOSCH-Hardware-Nr." ASCII 0x80D1 DAMOS_ASCII 0 NoCompuMethod 0.000000 0.000000 NUMBER 11 EXTENDED_LIMITS 0.000000 2621400.000000 /end CHARACTERISTIC
/begin RECORD_LAYOUT DAMOS_ASCII FNC_VALUES 1 UBYTE COLUMN_DIR DIRECT /end RECORD_LAYOUT
/begin CHARACTERISTIC BOS_HW_VS "1.Ziffer Wachstums-Nr." VALUE 0x80DC DAMOS_FW1 0 DEZ 0.000000 256.000000 /end CHARACTERISTIC
/begin CHARACTERISTIC BOS_SW_NR "BOSCH-Software-Nummer" ASCII 0x80DD DAMOS_ASCII 0 NoCompuMethod 0.000000 0.000000 NUMBER 11 EXTENDED_LIMITS 0.000000 256.000000 /end CHARACTERISTIC
/begin CHARACTERISTIC BOS_SW_VS "2. und 3. Ziffer der Wachstumsnr." CURVE 0x80E8 DAMOS_FKL1 0 DEZ 0.000000 256.000000
 /begin AXIS_DESCR FIX_AXIS IR0 DEZ 2 0.000000 1.000000 FIX_AXIS_PAR 0 0 2 EXTENDED_LIMITS 0.000000 256.000000 /end AXIS_DESCR
/end CHARACTERISTIC
/begin CHARACTERISTIC BP_KORR "Gangabhaengige Korrektur nach Beschleunigung" CURVE 0x86A1 DAMOS_FKL1 0 VQV16 0.000000 15.937500
 /begin AXIS_DESCR FIX_AXIS IR0 DEZ 7 0.000000 6.000000 FIX_AXIS_PAR 0 0 7 EXTENDED_LIMITS 0.000000 256.000000 /end AXIS_DESCR
/end CHARACTERISTIC
/begin CHARACTERISTIC BREMS_T_UM "Entprellzeit Bremssignalerfassung in der FU" VALUE 0x882A DAMOS_FW1 0 TQ40 0.000000 10.200000 /end CHARACTERISTIC
/begin CHARACTERISTIC BSMWMN "Minimalwert Ausgang Nullpktfilter Signal Beschleunigungssensor" VALUE 0x82F0 DAMOS_FW3 0 U5VL 0.000000 5.000000 /end CHARACTERISTIC
/begin CHARACTERISTIC BSMWMX "Maximalwert Ausgang Nullpktfilter Signal Beschleunigungssensor" VALUE 0x82F2 DAMOS_FW3 0 U5VL 0.000000 5.000000 /end CHARACTERISTIC
/begin CHARACTERISTIC BZ_ACC_M "ACC Botschaftszaehler-Maske" VALUE 0x8831 DAMOS_FW1 0 DEZ 0.000000 256.000000 /end CHARACTERISTIC
/begin CHARACTERISTIC BZ_MSR_M "MSR Botschaftszaehler-Maske" VALUE 0x882E DAMOS_FW1 0 DEZ 0.000000 256.000000 /end CHARACTERISTIC
/begin CHARACTERISTIC BZ_SGS_M "SGS Botschaftszaehler-Maske" VALUE 0x8835 DAMOS_FW1 0 DEZ 0.000000 256.000000 /end CHARACTERISTIC
/begin CHARACTERISTIC B_FAC_TN "Hintergrund-TN-Sollwert im Betrieb bei Fahrt und Klima Ein als f(TMOT)" CURVE 0xC37B DAMOS_GKL1 0 UTNQ 352.941200 90000.000000
 /begin AXIS_DESCR COM_AXIS TMOT CMO_TMP 12 0.000000 0.000000 AXIS_PTS_REF TMOTV08 EXTENDED_LIMITS -41.000000 140.000000 /end AXIS_DESCR
 EXTENDED_LIMITS 352.941000 90000.000000 /end CHARACTERISTIC
/begin CHARACTERISTIC B_F_TN "Hintergrund-TN-Sollwert im Betrieb bei Fahrt als f(TMOT)" CURVE 0xBF0F DAMOS_GKL1 0 UTNQ 352.941200 90000.000000
 /begin AXIS_DESCR COM_AXIS TMOT CMO_TMP 12 0.000000 0.000000 AXIS_PTS_REF TMOTV08 EXTENDED_LIMITS -41.000000 140.000000 /end AXIS_DESCR
 EXTENDED_LIMITS 352.941000 90000.000000 /end CHARACTERISTIC
/begin CHARACTERISTIC B_F_UG "Betriebsuntergrenzen-Anteil bei Fahrt als f(TMOT)" CURVE 0xBF84 DAMOS_GKL1 0 UWKL10 0.000000 10.069900
 /begin AXIS_DESCR COM_AXIS TMOT CMO_TMP 12 0.000000 0.000000 AXIS_PTS_REF TMOTV08 EXTENDED_LIMITS -41.000000 140.000000 /end AXIS_DESCR
/end CHARACTERISTIC
/begin CHARACTERISTIC B_NAC_TN "Hintergrund-TN-Sollwert im Betrieb bei Neutral und Klima Ein als f(TMOT)" CURVE 0xC387 DAMOS_GKL1 0 UTNQ 352.941200 90000.000000
 /begin AXIS_DESCR COM_AXIS TMOT CMO_TMP 12 0.000000 0.000000 AXIS_PTS_REF TMOTV08 EXTENDED_LIMITS -41.000000 140.000000 /end AXIS_DESCR
 EXTENDED_LIMITS 352.941000 90000.000000 /end CHARACTERISTIC
/begin CHARACTERISTIC B_NAC_TN1 "Hintergrund-TN-Sollwert im Betrieb bei Neutral und Klima Ein als f(TMOT), B_GV =" CURVE 0xC3AB DAMOS_GKL1 0 UTNQ 352.941200 90000.000000
 /begin AXIS_DESCR COM_AXIS TMOT CMO_TMP 12 0.000000 0.000000 AXIS_PTS_REF TMOTV08 EXTENDED_LIMITS -41.000000 140.000000 /end AXIS_DESCR
 EXTENDED_LIMITS 352.941000 90000.000000 /end CHARACTERISTIC
/begin CHARACTERISTIC B_N_TN "Hintergrund-TN-Sollwert im Betrieb bei Neutral als f(TMOT)" CURVE 0xBF03 DAMOS_GKL1 0 UTNQ 352.941200 90000.000000
 /begin AXIS_DESCR COM_AXIS TMOT CMO_TMP 12 0.000000 0.000000 AXIS_PTS_REF TMOTV08 EXTENDED_LIMITS -41.000000 140.000000 /end AXIS_DESCR
 EXTENDED_LIMITS 352.941000 90000.000000 /end CHARACTERISTIC
/begin CHARACTERISTIC B_N_TN1 "Hintergrund-TN-Sollwert im Betrieb bei Neutral als f(TMOT), B_GV = 1" CURVE 0xC3B7 DAMOS_GKL1 0 UTNQ 352.941200 90000.000000
 /begin AXIS_DESCR COM_AXIS TMOT CMO_TMP 12 0.000000 0.000000 AXIS_PTS_REF TMOTV08 EXTENDED_LIMITS -41.000000 140.000000 /end AXIS_DESCR
 EXTENDED_LIMITS 352.941000 90000.000000 /end CHARACTERISTIC
/begin CHARACTERISTIC B_N_UG "Betriebsuntergrenzen-Anteil bei Neutral als f(TMOT)" CURVE 0xBF78 DAMOS_GKL1 0 UWKL10 0.000000 10.069900
 /begin AXIS_DESCR COM_AXIS TMOT CMO_TMP 12 0.000000 0.000000 AXIS_PTS_REF TMOTV08 EXTENDED_LIMITS -41.000000 140.000000 /end AXIS_DESCR
/end CHARACTERISTIC
/begin CHARACTERISTIC B_OG "Betriebsobergrenze als f(NIST)" CURVE 0xBF57 DAMOS_GKL1 0 UWKL15 0.000000 10.073480
 /begin AXIS_DESCR COM_AXIS NIST NQ25 9 0.000000 0.000000 AXIS_PTS_REF NISTV10 EXTENDED_LIMITS 0.000000 6400.000000 /end AXIS_DESCR
 EXTENDED_LIMITS 0.000000 15.110200 /end CHARACTERISTIC
/begin CHARACTERISTIC CANSPEC "Wert groesser als 0 -> CAN vorhanden" VALUE 0x87D4 DAMOS_FW1 0 DEZ 0.000000 256.000000 /end CHARACTERISTIC
/begin CHARACTERISTIC CANSTAND "Kennzeichnung akt. CAN Spec." VALUE 0x84C0 DAMOS_FW1 0 DEZ 0.000000 256.000000 /end CHARACTERISTIC
/begin CHARACTERISTIC CDAGR "Codewort DAGR abschalten (EURO-Codierung), CD..=0 -> keine Diagnose" VALUE 0x8842 DAMOS_FW1 0 DEZ 0.000000 256.000000 /end CHARACTERISTIC
/begin CHARACTERISTIC CDCAAA "" VAL_BLK 0x897C DAMOS_FWB3 0 DEZL 0.000000 65535.000000 NUMBER 4 /end CHARACTERISTIC
/begin RECORD_LAYOUT DAMOS_FWB3 FNC_VALUES 1 UWORD COLUMN_DIR DIRECT /end RECORD_LAYOUT
/begin CHARACTERISTIC CDCACMVER "Codewort CARB: Diagnose irreversible ACC abschalten" VAL_BLK 0x8B7C DAMOS_FWB3 0 DEZL 0.000000 65535.000000 NUMBER 4 /end CHARACTERISTIC
/begin CHARACTERISTIC CDCBL "Codewort CARB: Diagnose Bremsschalter" VAL_BLK 0x8B24 DAMOS_FWB3 0 DEZL 0.000000 65535.000000 NUMBER 4 /end CHARACTERISTIC
/begin CHARACTERISTIC CDCCACC "Codewort CARB: Diagnose CAN Nachrichtenfehler ACC" VAL_BLK 0x8B5C DAMOS_FWB3 0 DEZL 0.000000 65535.000000 NUMBER 4 /end CHARACTERISTIC
/begin CHARACTERISTIC CDCCAN "Codewort CARB: Diagnose CAN" VAL_BLK 0x8A84 DAMOS_FWB3 0 DEZL 0.000000 65535.000000 NUMBER 4 /end CHARACTERISTIC
/begin CHARACTERISTIC CDCCASR "Codewort CARB 9                ==9: Index 52" VAL_BLK 0x8B54 DAMOS_FWB3 0 DEZL 0.000000 65535.000000 NUMBER 4 /end CHARACTERISTIC
/begin CHARACTERISTIC CDCCBC "Codewort CARB: Diagnose CAN Nachrichtenfehler BodyComputer" VAL_BLK 0x8A8C DAMOS_FWB3 0 DEZL 0.000000 65535.000000 NUMBER 4 /end CHARACTERISTIC
/begin CHARACTERISTIC CDCCEGS "Codewort CARB: Diagnose Getriebeschnittstelle ueber CAN" VAL_BLK 0x8A94 DAMOS_FWB3 0 DEZL 0.000000 65535.000000 NUMBER 4 /end CHARACTERISTIC
/begin CHARACTERISTIC CDCCNBA "Codewort CARB: Diagnose CAN Nachrichtenfehler NBA" VAL_BLK 0x8B64 DAMOS_FWB3 0 DEZL 0.000000 65535.000000 NUMBER 4 /end CHARACTERISTIC
/begin CHARACTERISTIC CDCDG "Codewort CARB: Diagnose-Bits Drehzahlgeber" VAL_BLK 0x89A4 DAMOS_FWB3 0 DEZL 0.000000 65535.000000 NUMBER 4 /end CHARACTERISTIC
/begin CHARACTERISTIC CDCDTV1 "Codewort CARB: LR-Adaption ti-additiv, Bank1" VAL_BLK 0x8B44 DAMOS_FWB3 0 DEZL 0.000000 65535.000000 NUMBER 4 /end CHARACTERISTIC
/begin CHARACTERISTIC CDCDVE "Codewort CARB: Diagnose-Bits DK-Steller" VAL_BLK 0x89C4 DAMOS_FWB3 0 DEZL 0.000000 65535.000000 NUMBER 4 /end CHARACTERISTIC
/begin CHARACTERISTIC CDCEKPE "Codewort CARB: Endstufendiagnose-Bits EKP" VAL_BLK 0x8A6C DAMOS_FWB3 0 DEZL 0.000000 65535.000000 NUMBER 4 /end CHARACTERISTIC
/begin CHARACTERISTIC CDCEV1 "Codewort CARB: Endstufendiagnose-Bits EV1" VAL_BLK 0x8A2C DAMOS_FWB3 0 DEZL 0.000000 65535.000000 NUMBER 4 /end CHARACTERISTIC
/begin CHARACTERISTIC CDCEV2 "Codewort CARB: Endstufendiagnose-Bits EV2" VAL_BLK 0x8A34 DAMOS_FWB3 0 DEZL 0.000000 65535.000000 NUMBER 4 /end CHARACTERISTIC
/begin CHARACTERISTIC CDCEV3 "Codewort CARB: Endstufendiagnose-Bits EV3" VAL_BLK 0x8A3C DAMOS_FWB3 0 DEZL 0.000000 65535.000000 NUMBER 4 /end CHARACTERISTIC
/begin CHARACTERISTIC CDCEV4 "Codewort CARB: Endstufendiagnose-Bits EV4" VAL_BLK 0x8A44 DAMOS_FWB3 0 DEZL 0.000000 65535.000000 NUMBER 4 /end CHARACTERISTIC
/begin CHARACTERISTIC CDCEV5 "Codewort CARB: Endstufendiagnose-Bits EV5" VAL_BLK 0x8A4C DAMOS_FWB3 0 DEZL 0.000000 65535.000000 NUMBER 4 /end CHARACTERISTIC
/begin CHARACTERISTIC CDCFELA "Codewort CARB: Endstufen-Diagnosebits Fehlerlampe" VAL_BLK 0x8A64 DAMOS_FWB3 0 DEZL 0.000000 65535.000000 NUMBER 4 /end CHARACTERISTIC
/begin CHARACTERISTIC CDCFGRE "Codewort CARB: Diagnose FGR-Lampe" VAL_BLK 0x8B1C DAMOS_FWB3 0 DEZL 0.000000 65535.000000 NUMBER 4 /end CHARACTERISTIC
/begin CHARACTERISTIC CDCFRA1 "Codewort CARB 9                ==9: Index 56" VAL_BLK 0x8B3C DAMOS_FWB3 0 DEZL 0.000000 65535.000000 NUMBER 4 /end CHARACTERISTIC
/begin CHARACTERISTIC CDCHFM "Codewort CARB: Diagnosebits Luftmassenmesser HFM" VAL_BLK 0x8984 DAMOS_FWB3 0 DEZL 0.000000 65535.000000 NUMBER 4 /end CHARACTERISTIC
/begin CHARACTERISTIC CDCHSH "Codewort CARB: Diagnosebits Sondenheizung hinter Kat" VAL_BLK 0x8AFC DAMOS_FWB3 0 DEZL 0.000000 65535.000000 NUMBER 4 /end CHARACTERISTIC
/begin CHARACTERISTIC CDCHSHE "Codewort CARB: Endstufen-Diagnosebits Sondenheizung hinter Kat" VAL_BLK 0x8B0C DAMOS_FWB3 0 DEZL 0.000000 65535.000000 NUMBER 4 /end CHARACTERISTIC
/begin CHARACTERISTIC CDCHSV "Codewort CARB: Endstufen-Diagnosebits Sondenheizer v.  Kat" VAL_BLK 0x8AF4 DAMOS_FWB3 0 DEZL 0.000000 65535.000000 NUMBER 4 /end CHARACTERISTIC
/begin CHARACTERISTIC CDCHSVE "Codewort CARB: Endstufen-Diagnosebits Sondenheizer v.  Kat" VAL_BLK 0x8B04 DAMOS_FWB3 0 DEZL 0.000000 65535.000000 NUMBER 4 /end CHARACTERISTIC
/begin CHARACTERISTIC CDCIPDK "Codewort CARB: Diagnose-Bits Istwertpoti" VAL_BLK 0x89CC DAMOS_FWB3 0 DEZL 0.000000 65535.000000 NUMBER 4 /end CHARACTERISTIC
/begin CHARACTERISTIC CDCKAT1 "Codewort CARB: Diagnose Katalysatorkonvertierung, Bank1" VAL_BLK 0x8B2C DAMOS_FWB3 0 DEZL 0.000000 65535.000000 NUMBER 4 /end CHARACTERISTIC
/begin CHARACTERISTIC CDCKOSE "Codewort CARB: Endstufen-Diagnosebits fuer Klimakompressor" VAL_BLK 0x8A5C DAMOS_FWB3 0 DEZL 0.000000 65535.000000 NUMBER 4 /end CHARACTERISTIC
/begin CHARACTERISTIC CDCKRHW "Codewort CARB: Diagnosebits KR - HW - Test       B2_BI" VAL_BLK 0x89FC DAMOS_FWB3 0 DEZL 0.000000 65535.000000 NUMBER 4 /end CHARACTERISTIC
/begin CHARACTERISTIC CDCKRS1 "Codewort CARB: Diagnosebits KR - Sensor1 - Abfall" VAL_BLK 0x8A04 DAMOS_FWB3 0 DEZL 0.000000 65535.000000 NUMBER 4 /end CHARACTERISTIC
/begin CHARACTERISTIC CDCKRS2 "Codewort CARB: Diagnosebits KR - Sensor2 - Abfall" VAL_BLK 0x8A0C DAMOS_FWB3 0 DEZL 0.000000 65535.000000 NUMBER 4 /end CHARACTERISTIC
/begin CHARACTERISTIC CDCKUPPL "Codewort CARB: Diagnose EGS-SG schaltet Motonic ab" VAL_BLK 0x8B74 DAMOS_FWB3 0 DEZL 0.000000 65535.000000 NUMBER 4 /end CHARACTERISTIC
/begin CHARACTERISTIC CDCLASH1 "Codewort CARB: Diagnose Lambdasonden-Alterung hinter Kat" VAL_BLK 0x8AEC DAMOS_FWB3 0 DEZL 0.000000 65535.000000 NUMBER 4 /end CHARACTERISTIC
/begin CHARACTERISTIC CDCLATP1 "Codewort CARB: Diagnose Lambdasonden-Alterung TP" VAL_BLK 0x8ADC DAMOS_FWB3 0 DEZL 0.000000 65535.000000 NUMBER 4 /end CHARACTERISTIC
/begin CHARACTERISTIC CDCLATV1 "Codewort CARB: Diagnose Lambdasonden-Alterung TV" VAL_BLK 0x8AE4 DAMOS_FWB3 0 DEZL 0.000000 65535.000000 NUMBER 4 /end CHARACTERISTIC
/begin CHARACTERISTIC CDCLFR "Codewort CARB: LFR-Diagnose" VAL_BLK 0x89F4 DAMOS_FWB3 0 DEZL 0.000000 65535.000000 NUMBER 4 /end CHARACTERISTIC
/begin CHARACTERISTIC CDCLSH1 "Codewort CARB: Diagnose Lambdasonde hinter Kat (Index 41)" VAL_BLK 0x8AD4 DAMOS_FWB3 0 DEZL 0.000000 65535.000000 NUMBER 4 /end CHARACTERISTIC
/begin CHARACTERISTIC CDCLSV1 "Codewort CARB: Diagnosebits Lambdasondendiagn. vor Kat Bank1" VAL_BLK 0x8ACC DAMOS_FWB3 0 DEZL 0.000000 65535.000000 NUMBER 4 /end CHARACTERISTIC
/begin CHARACTERISTIC CDCLUES1 "Codewort CARB: Endstufen-Diagnosebits fuer Luefter Stufe 1" VAL_BLK 0x8A1C DAMOS_FWB3 0 DEZL 0.000000 65535.000000 NUMBER 4 /end CHARACTERISTIC
/begin CHARACTERISTIC CDCLUES2 "Codewort CARB: Endstufen-Diagnosebits fuer Luefter Stufe 2" VAL_BLK 0x8A24 DAMOS_FWB3 0 DEZL 0.000000 65535.000000 NUMBER 4 /end CHARACTERISTIC
/begin CHARACTERISTIC CDCMD "Codewort CARB: Diagnose Aussetererkennung gesamt " VAL_BLK 0x8A9C DAMOS_FWB3 0 DEZL 0.000000 65535.000000 NUMBER 4 /end CHARACTERISTIC
/begin CHARACTERISTIC CDCMD1 "Codewort CARB: Diagnose Aussetererkennung Zyl. 1 " VAL_BLK 0x8AA4 DAMOS_FWB3 0 DEZL 0.000000 65535.000000 NUMBER 4 /end CHARACTERISTIC
/begin CHARACTERISTIC CDCMD2 "Codewort CARB: Diagnose Aussetererkennung Zyl. 2 " VAL_BLK 0x8AAC DAMOS_FWB3 0 DEZL 0.000000 65535.000000 NUMBER 4 /end CHARACTERISTIC
/begin CHARACTERISTIC CDCMD3 "Codewort CARB: Diagnose Aussetererkennung Zyl. 3 " VAL_BLK 0x8AB4 DAMOS_FWB3 0 DEZL 0.000000 65535.000000 NUMBER 4 /end CHARACTERISTIC
/begin CHARACTERISTIC CDCMD4 "Codewort CARB: Diagnose Aussetererkennung Zyl. 4 " VAL_BLK 0x8ABC DAMOS_FWB3 0 DEZL 0.000000 65535.000000 NUMBER 4 /end CHARACTERISTIC
/begin CHARACTERISTIC CDCMD5 "Codewort CARB: Diagnose Aussetererkennung Zyl. 5 " VAL_BLK 0x8AC4 DAMOS_FWB3 0 DEZL 0.000000 65535.000000 NUMBER 4 /end CHARACTERISTIC
/begin CHARACTERISTIC CDCMILFB "Codewort CARB: Diagnose Mil fremdbestimmt" VAL_BLK 0x8B6C DAMOS_FWB3 0 DEZL 0.000000 65535.000000 NUMBER 4 /end CHARACTERISTIC
/begin CHARACTERISTIC CDCNWSE "Codewort CARB: Endstufendiagnose-Bits NWS" VAL_BLK 0x8A7C DAMOS_FWB3 0 DEZL 0.000000 65535.000000 NUMBER 4 /end CHARACTERISTIC
/begin CHARACTERISTIC CDCPAC "Codewort CARB: Diagnose Klimadrucksensor" VAL_BLK 0x8B84 DAMOS_FWB3 0 DEZL 0.000000 65535.000000 NUMBER 4 /end CHARACTERISTIC
/begin CHARACTERISTIC CDCPEDST "Codewort CARB: Diagnose Bits Pedalanschlag" VAL_BLK 0x89DC DAMOS_FWB3 0 DEZL 0.000000 65535.000000 NUMBER 4 /end CHARACTERISTIC
/begin CHARACTERISTIC CDCPH "Codewort CARB: Diagnosebits Phasensensor" VAL_BLK 0x89AC DAMOS_FWB3 0 DEZL 0.000000 65535.000000 NUMBER 4 /end CHARACTERISTIC
/begin CHARACTERISTIC CDCPMOEL " " VAL_BLK 0x89BC DAMOS_FWB3 0 DEZL 0.000000 65535.000000 NUMBER 4 /end CHARACTERISTIC
/begin CHARACTERISTIC CDCPWG "Codewort CARB: Diagnose-Bits PWG" VAL_BLK 0x89D4 DAMOS_FWB3 0 DEZL 0.000000 65535.000000 NUMBER 4 /end CHARACTERISTIC
/begin CHARACTERISTIC CDCRSKA "Codewort CARB: Diagnose reversible Sicherheitskraftstoffabschalten" VAL_BLK 0x89E4 DAMOS_FWB3 0 DEZL 0.000000 65535.000000 NUMBER 4 /end CHARACTERISTIC
/begin CHARACTERISTIC CDCSKAUM "Codewort CARB: Diagnose Sicherheitskraftstoffab. von Ueberwachungsfkt." VAL_BLK 0x89EC DAMOS_FWB3 0 DEZL 0.000000 65535.000000 NUMBER 4 /end CHARACTERISTIC
/begin CHARACTERISTIC CDCSUE "Codewort CARB: Endstufendiagnose-Bits Saugrohrumschaltung" VAL_BLK 0x8A74 DAMOS_FWB3 0 DEZL 0.000000 65535.000000 NUMBER 4 /end CHARACTERISTIC
/begin CHARACTERISTIC CDCSWE "Codewort CARB: Schlechtwegerkennung" VAL_BLK 0x8B4C DAMOS_FWB3 0 DEZL 0.000000 65535.000000 NUMBER 4 /end CHARACTERISTIC
/begin CHARACTERISTIC CDCTEVE "Codewort CARB: Endstufendiagnose-Bits TEV" VAL_BLK 0x8A54 DAMOS_FWB3 0 DEZL 0.000000 65535.000000 NUMBER 4 /end CHARACTERISTIC
/begin CHARACTERISTIC CDCTFA "Codewort CARB: Diagnosebits Ansauglufttemperaturfuehler" VAL_BLK 0x8994 DAMOS_FWB3 0 DEZL 0.000000 65535.000000 NUMBER 4 /end CHARACTERISTIC
/begin CHARACTERISTIC CDCTFM "Codewort CARB: Diagnosebits Motortemperaturfuehler" VAL_BLK 0x898C DAMOS_FWB3 0 DEZL 0.000000 65535.000000 NUMBER 4 /end CHARACTERISTIC
/begin CHARACTERISTIC CDCTRA1 "Codewort CARB: LR-Adaption QL-additiv, Bank1" VAL_BLK 0x8B34 DAMOS_FWB3 0 DEZL 0.000000 65535.000000 NUMBER 4 /end CHARACTERISTIC
/begin CHARACTERISTIC CDCUB "Codewort CARB: Diagnosebits Batteriespannung" VAL_BLK 0x89B4 DAMOS_FWB3 0 DEZL 0.000000 65535.000000 NUMBER 4 /end CHARACTERISTIC
/begin CHARACTERISTIC CDCVFZ "Codewort CARB: Diagnose Geschwindigkeitssignal" VAL_BLK 0x899C DAMOS_FWB3 0 DEZL 0.000000 65535.000000 NUMBER 4 /end CHARACTERISTIC
/begin CHARACTERISTIC CDCVTSK "Codewort CARB: Diagnose FGR-Bedienhebel" VAL_BLK 0x8B14 DAMOS_FWB3 0 DEZL 0.000000 65535.000000 NUMBER 4 /end CHARACTERISTIC
/begin CHARACTERISTIC CDCWFS "Codewort CARB: WFS Fehler" VAL_BLK 0x8A14 DAMOS_FWB3 0 DEZL 0.000000 65535.000000 NUMBER 4 /end CHARACTERISTIC
/begin CHARACTERISTIC CDCZZZ "" VAL_BLK 0x8B8C DAMOS_FWB3 0 DEZL 0.000000 65535.000000 NUMBER 4 /end CHARACTERISTIC
/begin CHARACTERISTIC CDFO " " VALUE 0x8313 DAMOS_FW1 0 DEZ 0.000000 256.000000 /end CHARACTERISTIC
/begin CHARACTERISTIC CDHSVE "Codewort Heizerdiagnose vor Kat im (CDHSVE = 0  => keine Diagnose)" VALUE 0x8843 DAMOS_FW1 0 DEZ 0.000000 256.000000 /end CHARACTERISTIC
/begin CHARACTERISTIC CDKAAA "" VALUE 0x8B94 DAMOS_FW3 0 DEZL 0.000000 65535.000000 /end CHARACTERISTIC
/begin CHARACTERISTIC CDKACMVER "Codewort Kunde: Diagnose irreversible ACC abschalten" VALUE 0x8C14 DAMOS_FW3 0 DEZL 0.000000 65535.000000 /end CHARACTERISTIC
/begin CHARACTERISTIC CDKAT "Codewort Kat-Diagnose im OBDII-Mode (invers: Europa-Mode)" VALUE 0x8382 DAMOS_FW1 0 DEZ 0.000000 256.000000 /end CHARACTERISTIC
/begin CHARACTERISTIC CDKBL "Codewort Kunde: Diagnose Bremsschalter" VALUE 0x8BFE DAMOS_FW3 0 DEZL 0.000000 65535.000000 /end CHARACTERISTIC
/begin CHARACTERISTIC CDKCACC "Codewort Kunde: Diagnose CAN Nachrichtenfehler ACC" VALUE 0x8C0C DAMOS_FW3 0 DEZL 0.000000 65535.000000 /end CHARACTERISTIC
/begin CHARACTERISTIC CDKCAN "Codewort Kunde: Diagnose CAN" VALUE 0x8BD6 DAMOS_FW3 0 DEZL 0.000000 65535.000000 /end CHARACTERISTIC
/begin CHARACTERISTIC CDKCASR "Codewort Kunde 9               ==9: Index 52" VALUE 0x8C0A DAMOS_FW3 0 DEZL 0.000000 65535.000000 /end CHARACTERISTIC
/begin CHARACTERISTIC CDKCBC "Codewort Kunde: Diagnose CAN Nachrichtenfehler BodyComputer" VALUE 0x8BD8 DAMOS_FW3 0 DEZL 0.000000 65535.000000 /end CHARACTERISTIC
/begin CHARACTERISTIC CDKCEGS "Codewort Kunde: Diagnose Getriebeschnittstelle ueber CAN" VALUE 0x8BDA DAMOS_FW3 0 DEZL 0.000000 65535.000000 /end CHARACTERISTIC
/begin CHARACTERISTIC CDKCNBA "Codewort Kunde: Diagnose CAN Nachrichtenfehler NBA" VALUE 0x8C0E DAMOS_FW3 0 DEZL 0.000000 65535.000000 /end CHARACTERISTIC
/begin CHARACTERISTIC CDKDG "Codewort Kunde: Diagnose-Bits Drehzahlgeber" VALUE 0x8B9E DAMOS_FW3 0 DEZL 0.000000 65535.000000 /end CHARACTERISTIC
/begin CHARACTERISTIC CDKDTV1 "Codewort Kunde: LR-Adaption ti-additiv, Bank1" VALUE 0x8C06 DAMOS_FW3 0 DEZL 0.000000 65535.000000 /end CHARACTERISTIC
/begin CHARACTERISTIC CDKDVE "Codewort Kunde: Diagnose-Bits DK-Steller" VALUE 0x8BA6 DAMOS_FW3 0 DEZL 0.000000 65535.000000 /end CHARACTERISTIC
/begin CHARACTERISTIC CDKEKPE "Codewort Kunde: Endstufendiagnose-Bits EKP" VALUE 0x8BD0 DAMOS_FW3 0 DEZL 0.000000 65535.000000 /end CHARACTERISTIC
/begin CHARACTERISTIC CDKEV1 "Codewort Kunde: Endstufendiagnose-Bits EV1" VALUE 0x8BC0 DAMOS_FW3 0 DEZL 0.000000 65535.000000 /end CHARACTERISTIC
/begin CHARACTERISTIC CDKEV2 "Codewort Kunde: Endstufendiagnose-Bits EV2" VALUE 0x8BC2 DAMOS_FW3 0 DEZL 0.000000 65535.000000 /end CHARACTERISTIC
/begin CHARACTERISTIC CDKEV3 "Codewort Kunde: Endstufendiagnose-Bits EV3" VALUE 0x8BC4 DAMOS_FW3 0 DEZL 0.000000 65535.000000 /end CHARACTERISTIC
/begin CHARACTERISTIC CDKEV4 "Codewort Kunde: Endstufendiagnose-Bits EV4" VALUE 0x8BC6 DAMOS_FW3 0 DEZL 0.000000 65535.000000 /end CHARACTERISTIC
/begin CHARACTERISTIC CDKEV5 "Codewort Kunde: Endstufendiagnose-Bits EV5" VALUE 0x8BC8 DAMOS_FW3 0 DEZL 0.000000 65535.000000 /end CHARACTERISTIC
/begin CHARACTERISTIC CDKFELA "Codewort Kunde: Endstufen-Diagnosebits Fehlerlampe" VALUE 0x8BCE DAMOS_FW3 0 DEZL 0.000000 65535.000000 /end CHARACTERISTIC
/begin CHARACTERISTIC CDKFGRE "Codewort Kunde: Diagnose FGR-Lampe" VALUE 0x8BFC DAMOS_FW3 0 DEZL 0.000000 65535.000000 /end CHARACTERISTIC
/begin CHARACTERISTIC CDKFRA1 "Codewort Kunde 9               ==9: Index 56" VALUE 0x8C04 DAMOS_FW3 0 DEZL 0.000000 65535.000000 /end CHARACTERISTIC
/begin CHARACTERISTIC CDKHFM "Codewort Kunde: Diagnosebits Luftmassenmesser HFM" VALUE 0x8B96 DAMOS_FW3 0 DEZL 0.000000 65535.000000 /end CHARACTERISTIC
/begin CHARACTERISTIC CDKHSH "Codewort Kunde: Diagnosebits Sondenheizung hinter Kat" VALUE 0x8BF4 DAMOS_FW3 0 DEZL 0.000000 65535.000000 /end CHARACTERISTIC
/begin CHARACTERISTIC CDKHSHE "Codewort Kunde: Endstufen-Diagnosebits Sondenheizung hinter Kat" VALUE 0x8BF8 DAMOS_FW3 0 DEZL 0.000000 65535.000000 /end CHARACTERISTIC
/begin CHARACTERISTIC CDKHSV "Codewort Kunde: Endstufen-Diagnosebits Sondenheizer v.  Kat" VALUE 0x8BF2 DAMOS_FW3 0 DEZL 0.000000 65535.000000 /end CHARACTERISTIC
/begin CHARACTERISTIC CDKHSVE "Codewort Kunde: Endstufen-Diagnosebits Sondenheizer v.  Kat" VALUE 0x8BF6 DAMOS_FW3 0 DEZL 0.000000 65535.000000 /end CHARACTERISTIC
/begin CHARACTERISTIC CDKIPDK "Codewort Kunde: Diagnose-Bits Istwertpoti" VALUE 0x8BA8 DAMOS_FW3 0 DEZL 0.000000 65535.000000 /end CHARACTERISTIC
/begin CHARACTERISTIC CDKKAT1 "Codewort Kunde: Diagnose Katalysatorkonvertierung, Bank1" VALUE 0x8C00 DAMOS_FW3 0 DEZL 0.000000 65535.000000 /end CHARACTERISTIC
/begin CHARACTERISTIC CDKKOSE "Codewort Kunde: Endstufen-Diagnosebits fuer Klimakompressor" VALUE 0x8BCC DAMOS_FW3 0 DEZL 0.000000 65535.000000 /end CHARACTERISTIC
/begin CHARACTERISTIC CDKKRHW "Codewort Kunde: Diagnosebits KR - HW - Test       B2_BI" VALUE 0x8BB4 DAMOS_FW3 0 DEZL 0.000000 65535.000000 /end CHARACTERISTIC
/begin CHARACTERISTIC CDKKRS1 "Codewort Kunde: Diagnosebits KR - Sensor1 - Abfall" VALUE 0x8BB6 DAMOS_FW3 0 DEZL 0.000000 65535.000000 /end CHARACTERISTIC
/begin CHARACTERISTIC CDKKRS2 "Codewort Kunde: Diagnosebits KR - Sensor2 - Abfall" VALUE 0x8BB8 DAMOS_FW3 0 DEZL 0.000000 65535.000000 /end CHARACTERISTIC
/begin CHARACTERISTIC CDKKUPPL "Codewort Kunde: Diagnose EGS_SG schalte Motronic ab" VALUE 0x8C12 DAMOS_FW3 0 DEZL 0.000000 65535.000000 /end CHARACTERISTIC
/begin CHARACTERISTIC CDKLASH1 "Codewort Kunde: Diagnose Lambdasonden-Alterung hinter Kat" VALUE 0x8BF0 DAMOS_FW3 0 DEZL 0.000000 65535.000000 /end CHARACTERISTIC
/begin CHARACTERISTIC CDKLATP1 "Codewort Kunde: Diagnose Lambdasonden-Alterung TP" VALUE 0x8BEC DAMOS_FW3 0 DEZL 0.000000 65535.000000 /end CHARACTERISTIC
/begin CHARACTERISTIC CDKLATV1 "Codewort Kunde: Diagnose Lambdasonden-Alterung TV" VALUE 0x8BEE DAMOS_FW3 0 DEZL 0.000000 65535.000000 /end CHARACTERISTIC
/begin CHARACTERISTIC CDKLFR "Codewort Kunde: LFR-Diagnose" VALUE 0x8BB2 DAMOS_FW3 0 DEZL 0.000000 65535.000000 /end CHARACTERISTIC
/begin CHARACTERISTIC CDKLSH1 "Codewort Kunde: Diagnose Lambdasonde hinter Kat (Index 41)" VALUE 0x8BEA DAMOS_FW3 0 DEZL 0.000000 65535.000000 /end CHARACTERISTIC
/begin CHARACTERISTIC CDKLSV1 "Codewort Kunde: Diagnosebits Lambdasondendiagn. vor Kat Bank1" VALUE 0x8BE8 DAMOS_FW3 0 DEZL 0.000000 65535.000000 /end CHARACTERISTIC
/begin CHARACTERISTIC CDKLUES1 "Codewort Kunde: Endstufen-Diagnosebits fuer Luefter Stufe 1" VALUE 0x8BBC DAMOS_FW3 0 DEZL 0.000000 65535.000000 /end CHARACTERISTIC
/begin CHARACTERISTIC CDKLUES2 "Codewort Kunde: Endstufen-Diagnosebits fuer Luefter Stufe 2" VALUE 0x8BBE DAMOS_FW3 0 DEZL 0.000000 65535.000000 /end CHARACTERISTIC
/begin CHARACTERISTIC CDKMD "Codewort Kunde: Diagnose Aussetzererkennung gesamt" VALUE 0x8BDC DAMOS_FW3 0 DEZL 0.000000 65535.000000 /end CHARACTERISTIC
/begin CHARACTERISTIC CDKMD1 "Codewort Kunde: Diagnose Aussetzererkennung Zyl. 1" VALUE 0x8BDE DAMOS_FW3 0 DEZL 0.000000 65535.000000 /end CHARACTERISTIC
/begin CHARACTERISTIC CDKMD2 "Codewort Kunde: Diagnose Aussetzererkennung Zyl. 2" VALUE 0x8BE0 DAMOS_FW3 0 DEZL 0.000000 65535.000000 /end CHARACTERISTIC
/begin CHARACTERISTIC CDKMD3 "Codewort Kunde: Diagnose Aussetzererkennung Zyl. 3" VALUE 0x8BE2 DAMOS_FW3 0 DEZL 0.000000 65535.000000 /end CHARACTERISTIC
/begin CHARACTERISTIC CDKMD4 "Codewort Kunde: Diagnose Aussetzererkennung Zyl. 4" VALUE 0x8BE4 DAMOS_FW3 0 DEZL 0.000000 65535.000000 /end CHARACTERISTIC
/begin CHARACTERISTIC CDKMD5 "Codewort Kunde: Diagnose Aussetzererkennung Zyl. 5" VALUE 0x8BE6 DAMOS_FW3 0 DEZL 0.000000 65535.000000 /end CHARACTERISTIC
/begin CHARACTERISTIC CDKMILFB "Codewort Kunde: Diagnose Mil fremdbestimmt" VALUE 0x8C10 DAMOS_FW3 0 DEZL 0.000000 65535.000000 /end CHARACTERISTIC
/begin CHARACTERISTIC CDKNWSE "Codewort Kunde: Endstufendiagnose-Bits NWS" VALUE 0x8BD4 DAMOS_FW3 0 DEZL 0.000000 65535.000000 /end CHARACTERISTIC
/begin CHARACTERISTIC CDKPAC "Codewort Kunde: Diagnose Klimadrucksensor" VALUE 0x8C16 DAMOS_FW3 0 DEZL 0.000000 65535.000000 /end CHARACTERISTIC
/begin CHARACTERISTIC CDKPEDST "Codewort Kunde: Diagnose Bits Pedalanschlag" VALUE 0x8BAC DAMOS_FW3 0 DEZL 0.000000 65535.000000 /end CHARACTERISTIC
/begin CHARACTERISTIC CDKPH "Codewort Kunde: Diagnosebits Phasensensor" VALUE 0x8BA0 DAMOS_FW3 0 DEZL 0.000000 65535.000000 /end CHARACTERISTIC
/begin CHARACTERISTIC CDKPMOEL " " VALUE 0x8BA4 DAMOS_FW3 0 DEZL 0.000000 65535.000000 /end CHARACTERISTIC
/begin CHARACTERISTIC CDKPWG "Codewort Kunde: Diagnose-Bits PWG" VALUE 0x8BAA DAMOS_FW3 0 DEZL 0.000000 65535.000000 /end CHARACTERISTIC
/begin CHARACTERISTIC CDKRSKA "Codewort Kunde: Diagnose reversible Sicherheitskraftstoffabschalten" VALUE 0x8BAE DAMOS_FW3 0 DEZL 0.000000 65535.000000 /end CHARACTERISTIC
/begin CHARACTERISTIC CDKSKAUM "Codewort Kunde: Diagnose Sicherheitskraftstoffab. von Ueberwachungsfkt." VALUE 0x8BB0 DAMOS_FW3 0 DEZL 0.000000 65535.000000 /end CHARACTERISTIC
/begin CHARACTERISTIC CDKSUE "Codewort Kunde: Endstufendiagnose-Bits Saugrohrumschaltung" VALUE 0x8BD2 DAMOS_FW3 0 DEZL 0.000000 65535.000000 /end CHARACTERISTIC
/begin CHARACTERISTIC CDKSWE "Codewort Kunde: Schlechtwegerkennung" VALUE 0x8C08 DAMOS_FW3 0 DEZL 0.000000 65535.000000 /end CHARACTERISTIC
/begin CHARACTERISTIC CDKTEVE "Codewort Kunde: Endstufendiagnose-Bits TEV" VALUE 0x8BCA DAMOS_FW3 0 DEZL 0.000000 65535.000000 /end CHARACTERISTIC
/begin CHARACTERISTIC CDKTFA "Codewort Kunde: Diagnosebits Ansauglufttemperaturfuehler" VALUE 0x8B9A DAMOS_FW3 0 DEZL 0.000000 65535.000000 /end CHARACTERISTIC
/begin CHARACTERISTIC CDKTFM "Codewort Kunde: Diagnosebits Motortemperaturfuehler" VALUE 0x8B98 DAMOS_FW3 0 DEZL 0.000000 65535.000000 /end CHARACTERISTIC
/begin CHARACTERISTIC CDKTRA1 "Codewort Kunde: LR-Adaption QL-additiv, Bank1" VALUE 0x8C02 DAMOS_FW3 0 DEZL 0.000000 65535.000000 /end CHARACTERISTIC
/begin CHARACTERISTIC CDKUB "Codewort Kunde: Diagnosebits Batteriespannung" VALUE 0x8BA2 DAMOS_FW3 0 DEZL 0.000000 65535.000000 /end CHARACTERISTIC
/begin CHARACTERISTIC CDKVFZ "Codewort Kunde: Diagnose Geschwindigkeitssignal" VALUE 0x8B9C DAMOS_FW3 0 DEZL 0.000000 65535.000000 /end CHARACTERISTIC
/begin CHARACTERISTIC CDKVTSK "Codewort Kunde: Diagnose FGR-Bedienhebel" VALUE 0x8BFA DAMOS_FW3 0 DEZL 0.000000 65535.000000 /end CHARACTERISTIC
/begin CHARACTERISTIC CDKWFS "Codewort Kunde: WFS Fehler" VALUE 0x8BBA DAMOS_FW3 0 DEZL 0.000000 65535.000000 /end CHARACTERISTIC
/begin CHARACTERISTIC CDKZZZ "" VALUE 0x8C18 DAMOS_FW3 0 DEZL 0.000000 65535.000000 /end CHARACTERISTIC
/begin CHARACTERISTIC CDLASH "Codewort Lambdasondenalterungsdiagnose (SHK) im OBDII-Mode (invers: Europa-Mode)" VALUE 0x8346 DAMOS_FW1 0 DEZ 0.000000 256.000000 /end CHARACTERISTIC
/begin CHARACTERISTIC CDLDP "Codewort LDP-Diagnose im OBDII-Modus (invers: Europa-Modus), CD..=0 -> keine Dia" VALUE 0x8844 DAMOS_FW1 0 DEZ 0.000000 256.000000 /end CHARACTERISTIC
/begin CHARACTERISTIC CDLSH "Codewort Sondendiagnose hinter Kat" VALUE 0x83AA DAMOS_FW1 0 DEZ 0.000000 256.000000 /end CHARACTERISTIC
/begin CHARACTERISTIC CDLSV "Codewort Sondendiagnose vor KAT im OBDII-Mode (invers:Europa-Mode)" VALUE 0x8845 DAMOS_FW1 0 DEZ 0.000000 256.000000 /end CHARACTERISTIC
/begin CHARACTERISTIC CDMD "Sperren der DMDMIL bei CDMD=0" VALUE 0x8480 DAMOS_FW1 0 DEZ 0.000000 256.000000 /end CHARACTERISTIC
/begin CHARACTERISTIC CDSLS "Euro-Byte für Diagnose Sekundärluft-System" VALUE 0x8846 DAMOS_FW1 0 DEZ 0.000000 256.000000 /end CHARACTERISTIC
/begin CHARACTERISTIC CDTAAA "" VALUE 0x8C1A DAMOS_FW3 0 DEZL 0.000000 65535.000000 /end CHARACTERISTIC
/begin CHARACTERISTIC CDTACMVER "Codewort Tester: Diagnose irreversible ACC abschalten" VALUE 0x8C9A DAMOS_FW3 0 DEZL 0.000000 65535.000000 /end CHARACTERISTIC
/begin CHARACTERISTIC CDTBL "Codewort Tester: Diagnose Bremsschalter" VALUE 0x8C84 DAMOS_FW3 0 DEZL 0.000000 65535.000000 /end CHARACTERISTIC
/begin CHARACTERISTIC CDTCACC "Codewort Tester: Diagnose CAN Nachrichtenfehler ACC" VALUE 0x8C92 DAMOS_FW3 0 DEZL 0.000000 65535.000000 /end CHARACTERISTIC
/begin CHARACTERISTIC CDTCAN "Codewort Tester: Diagnose CAN" VALUE 0x8C5C DAMOS_FW3 0 DEZL 0.000000 65535.000000 /end CHARACTERISTIC
/begin CHARACTERISTIC CDTCASR "Codewort Tester 9              ==9: Index 52" VALUE 0x8C90 DAMOS_FW3 0 DEZL 0.000000 65535.000000 /end CHARACTERISTIC
/begin CHARACTERISTIC CDTCBC "Codewort Tester: Diagnose CAN Nachrichtenfehler BodyComputer" VALUE 0x8C5E DAMOS_FW3 0 DEZL 0.000000 65535.000000 /end CHARACTERISTIC
/begin CHARACTERISTIC CDTCEGS "Codewort Tester: Diagnose Getriebeschnittstelle ueber CAN" VALUE 0x8C60 DAMOS_FW3 0 DEZL 0.000000 65535.000000 /end CHARACTERISTIC
/begin CHARACTERISTIC CDTCNBA "Codewort Tester: Diagnose CAN Nachrichtenfehler NBA" VALUE 0x8C94 DAMOS_FW3 0 DEZL 0.000000 65535.000000 /end CHARACTERISTIC
/begin CHARACTERISTIC CDTDG "Codewort Tester: Diagnose-Bits Drehzahlgeber" VALUE 0x8C24 DAMOS_FW3 0 DEZL 0.000000 65535.000000 /end CHARACTERISTIC
/begin CHARACTERISTIC CDTDTV1 "Codewort Tester: LR-Adaption ti-additiv, Bank1" VALUE 0x8C8C DAMOS_FW3 0 DEZL 0.000000 65535.000000 /end CHARACTERISTIC
/begin CHARACTERISTIC CDTDVE "Codewort Tester: Diagnose-Bits DK-Steller" VALUE 0x8C2C DAMOS_FW3 0 DEZL 0.000000 65535.000000 /end CHARACTERISTIC
/begin CHARACTERISTIC CDTEKPE "Codewort Tester: Endstufendiagnose-Bits EKP" VALUE 0x8C56 DAMOS_FW3 0 DEZL 0.000000 65535.000000 /end CHARACTERISTIC
/begin CHARACTERISTIC CDTES "Codewort Tankentlüftungsdiagnose abschalten (EURO-Codierung), CD..=0 ->keine Dia" VALUE 0x8847 DAMOS_FW1 0 DEZ 0.000000 256.000000 /end CHARACTERISTIC
/begin CHARACTERISTIC CDTEV1 "Codewort Tester: Endstufendiagnose-Bits EV1" VALUE 0x8C46 DAMOS_FW3 0 DEZL 0.000000 65535.000000 /end CHARACTERISTIC
/begin CHARACTERISTIC CDTEV2 "Codewort Tester: Endstufendiagnose-Bits EV2" VALUE 0x8C48 DAMOS_FW3 0 DEZL 0.000000 65535.000000 /end CHARACTERISTIC
/begin CHARACTERISTIC CDTEV3 "Codewort Tester: Endstufendiagnose-Bits EV3" VALUE 0x8C4A DAMOS_FW3 0 DEZL 0.000000 65535.000000 /end CHARACTERISTIC
/begin CHARACTERISTIC CDTEV4 "Codewort Tester: Endstufendiagnose-Bits EV4" VALUE 0x8C4C DAMOS_FW3 0 DEZL 0.000000 65535.000000 /end CHARACTERISTIC
/begin CHARACTERISTIC CDTEV5 "Codewort Tester: Endstufendiagnose-Bits EV5" VALUE 0x8C4E DAMOS_FW3 0 DEZL 0.000000 65535.000000 /end CHARACTERISTIC
/begin CHARACTERISTIC CDTFELA "Codewort Tester: Endstufen-Diagnosebits Fehlerlampe" VALUE 0x8C54 DAMOS_FW3 0 DEZL 0.000000 65535.000000 /end CHARACTERISTIC
/begin CHARACTERISTIC CDTFGRE "Codewort Tester: Diagnose FGR-Lampe" VALUE 0x8C82 DAMOS_FW3 0 DEZL 0.000000 65535.000000 /end CHARACTERISTIC
/begin CHARACTERISTIC CDTFRA1 "Codewort Tester 9              ==9: Index 56" VALUE 0x8C8A DAMOS_FW3 0 DEZL 0.000000 65535.000000 /end CHARACTERISTIC
/begin CHARACTERISTIC CDTHFM "Codewort Tester: Diagnosebits Luftmassenmesser HFM" VALUE 0x8C1C DAMOS_FW3 0 DEZL 0.000000 65535.000000 /end CHARACTERISTIC
/begin CHARACTERISTIC CDTHSH "Codewort Tester: Diagnosebits Sondenheizung hinter Kat" VALUE 0x8C7A DAMOS_FW3 0 DEZL 0.000000 65535.000000 /end CHARACTERISTIC
/begin CHARACTERISTIC CDTHSHE "Codewort Tester: Endstufen-Diagnosebits Sondenheizung hinter Kat" VALUE 0x8C7E DAMOS_FW3 0 DEZL 0.000000 65535.000000 /end CHARACTERISTIC
/begin CHARACTERISTIC CDTHSV "Codewort Tester: Endstufen-Diagnosebits Sondenheizer v.  Kat" VALUE 0x8C78 DAMOS_FW3 0 DEZL 0.000000 65535.000000 /end CHARACTERISTIC
/begin CHARACTERISTIC CDTHSVE "Codewort Tester: Endstufen-Diagnosebits Sondenheizer v.  Kat" VALUE 0x8C7C DAMOS_FW3 0 DEZL 0.000000 65535.000000 /end CHARACTERISTIC
/begin CHARACTERISTIC CDTIPDK "Codewort Tester: Diagnose-Bits Istwertpoti" VALUE 0x8C2E DAMOS_FW3 0 DEZL 0.000000 65535.000000 /end CHARACTERISTIC
/begin CHARACTERISTIC CDTKAT1 "Codewort Tester: Diagnose Katalysatorkonvertierung, Bank1" VALUE 0x8C86 DAMOS_FW3 0 DEZL 0.000000 65535.000000 /end CHARACTERISTIC
/begin CHARACTERISTIC CDTKOSE "Codewort Tester: Endstufen-Diagnosebits fuer Klimakompressor" VALUE 0x8C52 DAMOS_FW3 0 DEZL 0.000000 65535.000000 /end CHARACTERISTIC
/begin CHARACTERISTIC CDTKRHW "Codewort Tester: Diagnosebits KR - HW - Test       B2_BI" VALUE 0x8C3A DAMOS_FW3 0 DEZL 0.000000 65535.000000 /end CHARACTERISTIC
/begin CHARACTERISTIC CDTKRS1 "Codewort Tester: Diagnosebits KR - Sensor1 - Abfall" VALUE 0x8C3C DAMOS_FW3 0 DEZL 0.000000 65535.000000 /end CHARACTERISTIC
/begin CHARACTERISTIC CDTKRS2 "Codewort Tester: Diagnosebits KR - Sensor2 - Abfall" VALUE 0x8C3E DAMOS_FW3 0 DEZL 0.000000 65535.000000 /end CHARACTERISTIC
/begin CHARACTERISTIC CDTKUPPL "Codewort Tester: Diagnose EGS-SG schaltet Motronic ab" VALUE 0x8C98 DAMOS_FW3 0 DEZL 0.000000 65535.000000 /end CHARACTERISTIC
/begin CHARACTERISTIC CDTLASH1 "Codewort Tester: Diagnose Lambdasonden-Alterung hinter Kat" VALUE 0x8C76 DAMOS_FW3 0 DEZL 0.000000 65535.000000 /end CHARACTERISTIC
/begin CHARACTERISTIC CDTLATP1 "Codewort Tester: Diagnose Lambdasonden-Alterung TP" VALUE 0x8C72 DAMOS_FW3 0 DEZL 0.000000 65535.000000 /end CHARACTERISTIC
/begin CHARACTERISTIC CDTLATV1 "Codewort Tester: Diagnose Lambdasonden-Alterung TV" VALUE 0x8C74 DAMOS_FW3 0 DEZL 0.000000 65535.000000 /end CHARACTERISTIC
/begin CHARACTERISTIC CDTLFR "Codewort Tester: LFR-Diagnose" VALUE 0x8C38 DAMOS_FW3 0 DEZL 0.000000 65535.000000 /end CHARACTERISTIC
/begin CHARACTERISTIC CDTLSH1 "Codewort Tester: Diagnose Lambdasonde hinter Kat (Index 41)" VALUE 0x8C70 DAMOS_FW3 0 DEZL 0.000000 65535.000000 /end CHARACTERISTIC
/begin CHARACTERISTIC CDTLSV1 "Codewort Tester: Diagnosebits Lambdasondendiagn. vor Kat Bank1" VALUE 0x8C6E DAMOS_FW3 0 DEZL 0.000000 65535.000000 /end CHARACTERISTIC
/begin CHARACTERISTIC CDTLUES1 "Codewort Tester: Endstufen-Diagnosebits fuer Luefter Stufe 1" VALUE 0x8C42 DAMOS_FW3 0 DEZL 0.000000 65535.000000 /end CHARACTERISTIC
/begin CHARACTERISTIC CDTLUES2 "Codewort Tester: Endstufen-Diagnosebits fuer Luefter Stufe 2" VALUE 0x8C44 DAMOS_FW3 0 DEZL 0.000000 65535.000000 /end CHARACTERISTIC
/begin CHARACTERISTIC CDTMD "Codewort Kunde: Diagnose Aussetzererkennung gesamt" VALUE 0x8C62 DAMOS_FW3 0 DEZL 0.000000 65535.000000 /end CHARACTERISTIC
/begin CHARACTERISTIC CDTMD1 "Codewort Kunde: Diagnose Aussetzererkennung Zyl. 1" VALUE 0x8C64 DAMOS_FW3 0 DEZL 0.000000 65535.000000 /end CHARACTERISTIC
/begin CHARACTERISTIC CDTMD2 "Codewort Kunde: Diagnose Aussetzererkennung Zyl. 2" VALUE 0x8C66 DAMOS_FW3 0 DEZL 0.000000 65535.000000 /end CHARACTERISTIC
/begin CHARACTERISTIC CDTMD3 "Codewort Kunde: Diagnose Aussetzererkennung Zyl. 3" VALUE 0x8C68 DAMOS_FW3 0 DEZL 0.000000 65535.000000 /end CHARACTERISTIC
/begin CHARACTERISTIC CDTMD4 "Codewort Kunde: Diagnose Aussetzererkennung Zyl. 4" VALUE 0x8C6A DAMOS_FW3 0 DEZL 0.000000 65535.000000 /end CHARACTERISTIC
/begin CHARACTERISTIC CDTMD5 "Codewort Kunde: Diagnose Aussetzererkennung Zyl. 5" VALUE 0x8C6C DAMOS_FW3 0 DEZL 0.000000 65535.000000 /end CHARACTERISTIC
/begin CHARACTERISTIC CDTMILFB "Codewort Tester: Diagnose Mil fremdbestimmt" VALUE 0x8C96 DAMOS_FW3 0 DEZL 0.000000 65535.000000 /end CHARACTERISTIC
/begin CHARACTERISTIC CDTNWSE "Codewort Tester: Endstufendiagnose-Bits NWS" VALUE 0x8C5A DAMOS_FW3 0 DEZL 0.000000 65535.000000 /end CHARACTERISTIC
/begin CHARACTERISTIC CDTPAC "Codewort Tester: Diagnose Klimadrucksensor" VALUE 0x8C9C DAMOS_FW3 0 DEZL 0.000000 65535.000000 /end CHARACTERISTIC
/begin CHARACTERISTIC CDTPEDST "Codewort Tester: Diagnose Bits Pedalanschlag" VALUE 0x8C32 DAMOS_FW3 0 DEZL 0.000000 65535.000000 /end CHARACTERISTIC
/begin CHARACTERISTIC CDTPH "Codewort Tester: Diagnosebits Phasensensor" VALUE 0x8C26 DAMOS_FW3 0 DEZL 0.000000 65535.000000 /end CHARACTERISTIC
/begin CHARACTERISTIC CDTPMOEL " " VALUE 0x8C2A DAMOS_FW3 0 DEZL 0.000000 65535.000000 /end CHARACTERISTIC
/begin CHARACTERISTIC CDTPWG "Codewort Tester: Diagnose-Bits PWG" VALUE 0x8C30 DAMOS_FW3 0 DEZL 0.000000 65535.000000 /end CHARACTERISTIC
/begin CHARACTERISTIC CDTRSKA "Codewort Tester: Diagnose reversible Sicherheitskraftstoffabschalten" VALUE 0x8C34 DAMOS_FW3 0 DEZL 0.000000 65535.000000 /end CHARACTERISTIC
/begin CHARACTERISTIC CDTSKAUM "Codewort Tester: Diagnose Sicherheitskraftstoffab. von Ueberwachungsfkt." VALUE 0x8C36 DAMOS_FW3 0 DEZL 0.000000 65535.000000 /end CHARACTERISTIC
/begin CHARACTERISTIC CDTSUE "Codewort Tester: Endstufendiagnose-Bits Saugrohrumschaltung" VALUE 0x8C58 DAMOS_FW3 0 DEZL 0.000000 65535.000000 /end CHARACTERISTIC
/begin CHARACTERISTIC CDTSWE "Codewort Tester: Schlechtwegerkennung" VALUE 0x8C8E DAMOS_FW3 0 DEZL 0.000000 65535.000000 /end CHARACTERISTIC
/begin CHARACTERISTIC CDTTEVE "Codewort Tester: Endstufendiagnose-Bits TEV" VALUE 0x8C50 DAMOS_FW3 0 DEZL 0.000000 65535.000000 /end CHARACTERISTIC
/begin CHARACTERISTIC CDTTFA "Codewort Tester: Diagnosebits Ansauglufttemperaturfuehler" VALUE 0x8C20 DAMOS_FW3 0 DEZL 0.000000 65535.000000 /end CHARACTERISTIC
/begin CHARACTERISTIC CDTTFM "Codewort Tester: Diagnosebits Motortemperaturfuehler" VALUE 0x8C1E DAMOS_FW3 0 DEZL 0.000000 65535.000000 /end CHARACTERISTIC
/begin CHARACTERISTIC CDTTRA1 "Codewort Tester: LR-Adaption QL-additiv, Bank1" VALUE 0x8C88 DAMOS_FW3 0 DEZL 0.000000 65535.000000 /end CHARACTERISTIC
/begin CHARACTERISTIC CDTUB "Codewort Tester: Diagnosebits Batteriespannung" VALUE 0x8C28 DAMOS_FW3 0 DEZL 0.000000 65535.000000 /end CHARACTERISTIC
/begin CHARACTERISTIC CDTVFZ "Codewort Tester: Diagnose Geschwindigkeitssignal" VALUE 0x8C22 DAMOS_FW3 0 DEZL 0.000000 65535.000000 /end CHARACTERISTIC
/begin CHARACTERISTIC CDTVTSK "Codewort Tester: Diagnose FGR-Bedienhebel" VALUE 0x8C80 DAMOS_FW3 0 DEZL 0.000000 65535.000000 /end CHARACTERISTIC
/begin CHARACTERISTIC CDTWFS "Codewort Tester: WFS Fehler" VALUE 0x8C40 DAMOS_FW3 0 DEZL 0.000000 65535.000000 /end CHARACTERISTIC
/begin CHARACTERISTIC CDTZZZ "" VALUE 0x8C9E DAMOS_FW3 0 DEZL 0.000000 65535.000000 /end CHARACTERISTIC
/begin CHARACTERISTIC CLAAAA "" VALUE 0x8870 DAMOS_FW1 0 DEZ 0.000000 256.000000 /end CHARACTERISTIC
/begin CHARACTERISTIC CLAACMVER "Fehlerklasse: Diagnose irreversible ACC abschalten" VALUE 0x88B0 DAMOS_FW1 0 DEZ 0.000000 256.000000 /end CHARACTERISTIC
/begin CHARACTERISTIC CLABL "Fehlerklasse: Diagnose Bremsschalter" VALUE 0x88A5 DAMOS_FW1 0 DEZ 0.000000 256.000000 /end CHARACTERISTIC
/begin CHARACTERISTIC CLACACC "Fehlerklasse: Diagnose CAN Nachrichtenfehler ACC" VALUE 0x88AC DAMOS_FW1 0 DEZ 0.000000 256.000000 /end CHARACTERISTIC
/begin CHARACTERISTIC CLACAN "Fehlerklasse: Diagnose CAN" VALUE 0x8891 DAMOS_FW1 0 DEZ 0.000000 256.000000 /end CHARACTERISTIC
/begin CHARACTERISTIC CLACASR "Fehlerklasse 9                 ==9: Index 52" VALUE 0x88AB DAMOS_FW1 0 DEZ 0.000000 256.000000 /end CHARACTERISTIC
/begin CHARACTERISTIC CLACBC "Fehlerklasse: Diagnose CAN Nachrichtenfehler BodyComputer" VALUE 0x8892 DAMOS_FW1 0 DEZ 0.000000 256.000000 /end CHARACTERISTIC
/begin CHARACTERISTIC CLACEGS "Fehlerklasse: Diagnose Getriebeschnittstelle ueber CAN" VALUE 0x8893 DAMOS_FW1 0 DEZ 0.000000 256.000000 /end CHARACTERISTIC
/begin CHARACTERISTIC CLACNBA "Fehlerklasse: Diagnose CAN Nachrichtenfehler NBA" VALUE 0x88AD DAMOS_FW1 0 DEZ 0.000000 256.000000 /end CHARACTERISTIC
/begin CHARACTERISTIC CLADG "Fehlerklasse: Diagnose-Bits Drehzahlgeber" VALUE 0x8875 DAMOS_FW1 0 DEZ 0.000000 256.000000 /end CHARACTERISTIC
/begin CHARACTERISTIC CLADTV1 "Fehlerklasse: LR-Adaption ti-additiv, Bank1" VALUE 0x88A9 DAMOS_FW1 0 DEZ 0.000000 256.000000 /end CHARACTERISTIC
/begin CHARACTERISTIC CLADVE "Fehlerklasse: Diagnose-Bits DK-Steller" VALUE 0x8879 DAMOS_FW1 0 DEZ 0.000000 256.000000 /end CHARACTERISTIC
/begin CHARACTERISTIC CLAEKPE "Fehlerklasse: Endstufendiagnose-Bits EKP" VALUE 0x888E DAMOS_FW1 0 DEZ 0.000000 256.000000 /end CHARACTERISTIC
/begin CHARACTERISTIC CLAEV1 "Fehlerklasse: Endstufendiagnose-Bits EV1" VALUE 0x8886 DAMOS_FW1 0 DEZ 0.000000 256.000000 /end CHARACTERISTIC
/begin CHARACTERISTIC CLAEV2 "Fehlerklasse: Endstufendiagnose-Bits EV2" VALUE 0x8887 DAMOS_FW1 0 DEZ 0.000000 256.000000 /end CHARACTERISTIC
/begin CHARACTERISTIC CLAEV3 "Fehlerklasse: Endstufendiagnose-Bits EV3" VALUE 0x8888 DAMOS_FW1 0 DEZ 0.000000 256.000000 /end CHARACTERISTIC
/begin CHARACTERISTIC CLAEV4 "Fehlerklasse: Endstufendiagnose-Bits EV4" VALUE 0x8889 DAMOS_FW1 0 DEZ 0.000000 256.000000 /end CHARACTERISTIC
/begin CHARACTERISTIC CLAEV5 "Fehlerklasse: Endstufendiagnose-Bits EV5" VALUE 0x888A DAMOS_FW1 0 DEZ 0.000000 256.000000 /end CHARACTERISTIC
/begin CHARACTERISTIC CLAFELA "Fehlerklasse: Endstufen-Diagnosebits Fehlerlampe" VALUE 0x888D DAMOS_FW1 0 DEZ 0.000000 256.000000 /end CHARACTERISTIC
/begin CHARACTERISTIC CLAFGRE "Fehlerklasse: Diagnose FGR-Lampe" VALUE 0x88A4 DAMOS_FW1 0 DEZ 0.000000 256.000000 /end CHARACTERISTIC
/begin CHARACTERISTIC CLAFRA1 "Fehlerklasse 9                 ==9: Index 56" VALUE 0x88A8 DAMOS_FW1 0 DEZ 0.000000 256.000000 /end CHARACTERISTIC
/begin CHARACTERISTIC CLAHFM "Fehlerklasse: Diagnosebits Luftmassenmesser HFM" VALUE 0x8871 DAMOS_FW1 0 DEZ 0.000000 256.000000 /end CHARACTERISTIC
/begin CHARACTERISTIC CLAHSH "Fehlerklasse: Endstufen-Diagnosebits Sondenheizung hinterKat" VALUE 0x88A0 DAMOS_FW1 0 DEZ 0.000000 256.000000 /end CHARACTERISTIC
/begin CHARACTERISTIC CLAHSHE "Fehlerklasse: Endstufen-Diagnosebits Sondenheizung hinter Kat" VALUE 0x88A2 DAMOS_FW1 0 DEZ 0.000000 256.000000 /end CHARACTERISTIC
/begin RECORD_LAYOUT DAMOS_SST97 SRC_ADDR_X 1 UWORD NO_AXIS_PTS_X 2 UBYTE AXIS_PTS_X 3 UBYTE INDEX_INCR DIRECT /end RECORD_LAYOUT
/begin AXIS_PTS FDKHAV08 "Hoehenabhg. DK-Adaptionsfaktor-Stuetzstellen" 0x8EDA FDKHA DAMOS_SST97 0 FKT128 8 0.000000 1.992188 EXTENDED_LIMITS 0.000000 1.992190 /end AXIS_PTS
/begin AXIS_PTS NDMDV08 "Drehzahlstuetzstellen f. DMD" 0x8CFC NIST DAMOS_SST97 0 NQ25 8 0.000000 6400.000000 /end AXIS_PTS
/begin AXIS_PTS NISTV06 "Drehzahlstuetzstellenverteilung" 0x8D3C NIST DAMOS_SST97 0 NQ25 4 0.000000 6400.000000 /end AXIS_PTS
/begin AXIS_PTS NISTV08 "Drehzahlstützstellenverteilung" 0x8D44 NIST DAMOS_SST97 0 NQ25 8 0.000000 6400.000000 /end AXIS_PTS
/begin AXIS_PTS NISTV10 "Drehzahlstuetzstellenverteilung" 0x8D5C NIST DAMOS_SST97 0 NQ25 9 0.000000 6400.000000 /end AXIS_PTS
/begin AXIS_PTS TANSV08 "Stuetzstellenverteilung Lufttemperatur" 0x8DA4 TANS DAMOS_SST97 0 CLU_TMP 8 -50.000000 150.000000 /end AXIS_PTS
/begin AXIS_PTS TMOTV08 "Motortemperaturstuetzstellen" 0x8D7C TMOT DAMOS_SST97 0 CMO_TMP 12 -41.000000 140.000000 /end AXIS_PTS
/begin COMPU_METHOD B_DEZ "log Zustand" TAB_VERB "%7.5" "" COMPU_TAB_REF B_DEZ /end COMPU_METHOD
/begin COMPU_METHOD B_TRUE "True" TAB_VERB "%7.5" "" COMPU_TAB_REF B_TRUE /end COMPU_METHOD
/begin COMPU_METHOD CLU_TMP "Ansaugluft-Temperatur" TAB_INTP "%7.3" "grd C" COMPU_TAB_REF CLU_TMP /end COMPU_METHOD
/begin COMPU_METHOD CMO_TMP "Motor-Temperatur (invers)" TAB_INTP "%7.3" "Grad C" COMPU_TAB_REF CMO_TMP /end COMPU_METHOD
/begin COMPU_METHOD DEZ "  Dezimalzahl in Hexzahl" RAT_FUNC "%3.0" "" COEFFS 0 1.000000 0.000000 0 0.000000 1.000000 /end COMPU_METHOD
/begin COMPU_METHOD DEZ7 "  Dezimalzahl in Hexzahl von 0-7" RAT_FUNC "%4.2" "" COEFFS 0 1.000000 0.000000 0 0.000000 1.000000 /end COMPU_METHOD
/begin COMPU_METHOD DEZL "  Dezimalzahl in 16-Bit-Hexzahl" RAT_FUNC "%5.0" "" COEFFS 0 1.000000 0.000000 0 0.000000 1.000000 /end COMPU_METHOD
/begin COMPU_METHOD DTSEGNL "Segmentwinkel" RAT_FUNC "%7.3" "Grad KW" COEFFS 0 1.000000 0.000000 0 0.000000 4.394500e-03 /end COMPU_METHOD
/begin COMPU_METHOD FKT0001 "  Quantisierung mit 0.01 " RAT_FUNC "%7.5" "" COEFFS 0 1.000000 0.000000 0 0.000000 1.000000e-02 /end COMPU_METHOD
/begin COMPU_METHOD FKT128 "  Umsetzung des Intervalles [0;<2]" RAT_FUNC "%6.4" "" COEFFS 0 128.000000 0.000000 0 0.000000 1.000000 /end COMPU_METHOD
/begin COMPU_METHOD FKT128SL "Darstellung -256 bis 255 " RAT_FUNC "%7.3" "" COEFFS 0 128.000000 0.000000 0 0.000000 1.000000 /end COMPU_METHOD
/begin COMPU_METHOD FKT131072 "  Umsetzung des Intervalles [0;<0.5]" RAT_FUNC "%7.5" "" COEFFS 0 1.310720e+05 0.000000 0 0.000000 1.000000 /end COMPU_METHOD
/begin COMPU_METHOD FKT256 "  Umsetzung des Intervalles [0;<1]" RAT_FUNC "%6.4" "" COEFFS 0 256.000000 0.000000 0 0.000000 1.000000 /end COMPU_METHOD
/begin COMPU_METHOD FKT256L "  Umsetzung des Intervalles [0;< 256.0]" RAT_FUNC "%6.2" "" COEFFS 0 256.000000 0.000000 0 0.000000 1.000000 /end COMPU_METHOD
/begin COMPU_METHOD FKT32 "  Umsetzung des Intervalles [0;<8]" RAT_FUNC "%6.4" "" COEFFS 0 32.000000 0.000000 0 0.000000 1.000000 /end COMPU_METHOD
/begin COMPU_METHOD FKT32L "  Umsetzung des Intervalles [0;<2048]" RAT_FUNC "%6.1" "" COEFFS 0 32.000000 0.000000 0 0.000000 1.000000 /end COMPU_METHOD
/begin COMPU_METHOD FKT51 "  Umsetzung des Intervalles [0;< 4.980]" RAT_FUNC "%7.5" "" COEFFS 0 51.200000 0.000000 0 0.000000 1.000000 /end COMPU_METHOD
/begin COMPU_METHOD FKT512 "  Umsetzung des Intervalles [0;<0.5]" RAT_FUNC "%6.4" "" COEFFS 0 512.000000 0.000000 0 0.000000 1.000000 /end COMPU_METHOD
/begin COMPU_METHOD FKT65536 "  Umsetzung des Intervalles [0;<1]" RAT_FUNC "%7.5" "" COEFFS 0 6.553600e+04 0.000000 0 0.000000 1.000000 /end COMPU_METHOD
/begin COMPU_METHOD FKT65536SL "  Umsetzung des Intervalles [-0,5;<0,5] 16Bit kompl." RAT_FUNC "%8.6" "" COEFFS 0 6.553600e+04 0.000000 0 0.000000 1.000000 /end COMPU_METHOD
/begin COMPU_METHOD FKT65536SO "  Umsetzung des Intervalles [-0,5;<0,5] 16Bit mit Offset" RAT_FUNC "%8.6" "" COEFFS 0 6.553600e+04 3.276800e+04 0 0.000000 1.000000 /end COMPU_METHOD
/begin COMPU_METHOD FKT_LAMBDA "8-Bit Umsetzung des Lambdaintervalles 0,97 .. 1,0298" RAT_FUNC "%6.4" "" COEFFS 0 256.000000 -248.320000 0 0.000000 6.000000e-02 /end COMPU_METHOD
/begin COMPU_METHOD FPC50L "  Korrekturfaktor fuer Aenderung um 50 [%] , 16 Bit" RAT_FUNC "%8.6" "" COEFFS 0 6.553600e+04 -3.276800e+04 0 0.000000 1.000000 /end COMPU_METHOD
/begin COMPU_METHOD KM_L "  Kilometerstand 16-Bit, 1km/Ink" RAT_FUNC "%5.0" "km" COEFFS 0 1.000000 0.000000 0 0.000000 1.000000 /end COMPU_METHOD
/begin COMPU_METHOD KVA0022 "Kraftstoffverbrauch in [l/h]" RAT_FUNC "%7.3" "l/h" COEFFS 0 10000.000000 0.000000 0 0.000000 22.000000 /end COMPU_METHOD
/begin COMPU_METHOD MLQ010 "  Luftmassen-Durchsatz mit 0.1000[kg/h] quantisiert " RAT_FUNC "%7.4" "kg/h" COEFFS 0 1.000000 0.000000 0 0.000000 1.000000e-01 /end COMPU_METHOD
/begin COMPU_METHOD MLQ010L "  Luftmassen-Durchsatz, 16 Bit mit 0.1000[kg/h] quantisiert" RAT_FUNC "%7.2" "kg/h" COEFFS 0 1.000000 0.000000 0 0.000000 1.000000e-01 /end COMPU_METHOD
/begin COMPU_METHOD MLQ100 "  Luftmassen-Durchsatz mit  0.996E-2[kg] quantisiert" RAT_FUNC "%5.3" "kg" COEFFS 0 1.000000 0.000000 0 0.000000 9.955600e-03 /end COMPU_METHOD
/begin COMPU_METHOD MLQ256L "  Luftmassen-Durchsatz mit Faktor  256.0[g] " RAT_FUNC "%7.3" "g" COEFFS 0 256.000000 0.000000 0 0.000000 1.000000 /end COMPU_METHOD
/begin COMPU_METHOD MLQP512L "  Luftmassen-Durchsatz mit Faktor  5.120[g%] " RAT_FUNC "%7.1" "g%" COEFFS 0 5.120000 0.000000 0 0.000000 1.000000 /end COMPU_METHOD
/begin COMPU_METHOD MLSMQ "MLE mit  4.000 Kg/h quantisiert" RAT_FUNC "%7.2" "kg/h" COEFFS 0 1.000000 0.000000 0 0.000000 4.000000 /end COMPU_METHOD
/begin COMPU_METHOD MMQ "Motor-Momentquantisierung " RAT_FUNC "%5.1" "Nm" COEFFS 0 1.000000 0.000000 0 0.000000 2.000000 /end COMPU_METHOD
/begin COMPU_METHOD M_UB_B1020 " Massenfluß in 8-Bit-Hexwerten " RAT_FUNC "%4.0" " kg/h " COEFFS 0 1.000000 0.000000 0 0.000000 4.000000 /end COMPU_METHOD
/begin COMPU_METHOD NGRDQ10OF "  Drehzahlgradient" RAT_FUNC "%6.1" "Upm/sec" COEFFS 0 1.000000 0.000000 0 0.000000 10.000000 /end COMPU_METHOD
/begin COMPU_METHOD NQ1_W "  Drehzahlquantisierung  1.000[Upm]" RAT_FUNC "%4.0" "Upm" COEFFS 0 1.000000 0.000000 0 0.000000 1.000000 /end COMPU_METHOD
/begin COMPU_METHOD NQ25 "  Drehzahlquantisierung  25.00[Upm]" RAT_FUNC "%4.0" "Upm" COEFFS 0 1.000000 0.000000 0 0.000000 25.000000 /end COMPU_METHOD
/begin COMPU_METHOD NQ40 "  Drehzahlquantisierung  40.00[Upm]" RAT_FUNC "%5.0" "Upm" COEFFS 0 1.000000 0.000000 0 0.000000 40.000000 /end COMPU_METHOD
/begin COMPU_METHOD NQ5 "  Drehzahlquantisierung  5.000[Upm]" RAT_FUNC "%4.0" "Upm" COEFFS 0 1.000000 0.000000 0 0.000000 5.000000 /end COMPU_METHOD
/begin COMPU_METHOD PAB "Umrechnung des Drucksensorwertes " RAT_FUNC "%9.4" "hPa" COEFFS 0 1.000000 37.539105 0 0.000000 5.392000 /end COMPU_METHOD
/begin COMPU_METHOD PAB77 "Umrechnung des Drucksensorwertes " RAT_FUNC "%6.3" "bar" COEFFS 0 7.698000 2.356000 0 0.000000 1.000000 /end COMPU_METHOD
/begin COMPU_METHOD PCENT "  Prozent" RAT_FUNC "%5.2" "%" COEFFS 0 256.000000 0.000000 0 0.000000 100.000000 /end COMPU_METHOD
/begin COMPU_METHOD PER0327 "percent" RAT_FUNC "%7.3" "%" COEFFS 0 327.670000 0.000000 0 0.000000 1.000000 /end COMPU_METHOD
/begin COMPU_METHOD PER255 "percent" RAT_FUNC "%7.3" "%" COEFFS 0 255.000000 0.000000 0 0.000000 100.000000 /end COMPU_METHOD
/begin COMPU_METHOD PER_DKA "percent" RAT_FUNC "%7.3" "%" COEFFS 0 215.000000 0.000000 0 0.000000 100.000000 /end COMPU_METHOD
/begin COMPU_METHOD SENSORW "16 BIT Sensorsignal" RAT_FUNC "%7.5" "V" COEFFS 0 6.553600e+04 0.000000 0 0.000000 5.000000 /end COMPU_METHOD
/begin COMPU_METHOD SIG32L "  Umsetzung des Intervalles [- 32.00;< 32.00]" RAT_FUNC "%6.3" "" COEFFS 0 3.276800e+04 1.048576e+06 0 0.000000 32.000000 /end COMPU_METHOD
/begin COMPU_METHOD TEQL "  Quantisierung von te, 16 Bit mit  0.267E-2[ms]" RAT_FUNC "%7.3" "ms" COEFFS 0 1.000000 0.000000 0 0.000000 2.666700e-03 /end COMPU_METHOD
/begin COMPU_METHOD TEQ_12LCPL "  Quantisierung von te, 16 Bit" RAT_FUNC "%7.2" "ms" COEFFS 0 1.000000 0.000000 0 0.000000 3.200000e-02 /end COMPU_METHOD
/begin COMPU_METHOD TEQ_32 "  Quantisierung von tlw 8 Bit mit 0.0853[ms]" RAT_FUNC "%7.4" "ms" COEFFS 0 1.000000 0.000000 0 0.000000 8.533300e-02 /end COMPU_METHOD
/begin COMPU_METHOD TEQ_CPL "  Quantisierung von te, 16 Bitmit  0.267E-2[ms]" RAT_FUNC "%9.6" "ms" COEFFS 0 1.000000 0.000000 0 0.000000 2.666666e-03 /end COMPU_METHOD
/begin COMPU_METHOD TLQSL "'Luftfuellung, signed, 16 bit" RAT_FUNC "%6.1" "ms/Umdr." COEFFS 0 1.000000 0.000000 0 0.000000 4.266000e-02 /end COMPU_METHOD
/begin COMPU_METHOD TMP_10B "Motor-Temperatur 10-Bit (invers)" TAB_INTP "%7.3" "grad C" COMPU_TAB_REF TMP_10B /end COMPU_METHOD
/begin COMPU_METHOD TMP_79_140 "Temperaturquantisierung mit 0.24 [°C] und Offset +79°C" TAB_INTP "%7.3" "grad C" COMPU_TAB_REF TMP_79_140 /end COMPU_METHOD
/begin COMPU_METHOD TQ10 "  Zeitquantisierung mit 10[ms]" RAT_FUNC "%4.2" "sec" COEFFS 0 100.000000 0.000000 0 0.000000 1.000000 /end COMPU_METHOD
/begin COMPU_METHOD TQ100 "  Zeitquantisierung mit 100[ms]" RAT_FUNC "%4.1" "sec" COEFFS 0 10.000000 0.000000 0 0.000000 1.000000 /end COMPU_METHOD
/begin COMPU_METHOD TQ1000 "  Zeitquantisierung mit 1 [s]" RAT_FUNC "%7.3" "sec" COEFFS 0 1.000000 0.000000 0 0.000000 1.000000 /end COMPU_METHOD
/begin COMPU_METHOD TQ100L "  Zeitquantisierung mit 100[ms]" RAT_FUNC "%7.2" "sec" COEFFS 0 10.000000 0.000000 0 0.000000 1.000000 /end COMPU_METHOD
/begin COMPU_METHOD TQ10L "  Zeitquantisierung mit 10[ms]" RAT_FUNC "%6.2" "sec" COEFFS 0 100.000000 0.000000 0 0.000000 1.000000 /end COMPU_METHOD
/begin COMPU_METHOD TQ10MSS "  Zeitquantisierung mit 10[ms] signed" RAT_FUNC "%5.3" "sec" COEFFS 0 100.000000 0.000000 0 0.000000 1.000000 /end COMPU_METHOD
/begin COMPU_METHOD TQ10MSSL "  Zeitquantisierung mit 10[ms] 16Bit-signed" RAT_FUNC "%7.3" "sec" COEFFS 0 100.000000 0.000000 0 0.000000 1.000000 /end COMPU_METHOD
/begin COMPU_METHOD TQ12MS5L "  Zeitquantisierung mit 12.5[ms]" RAT_FUNC "%9.5" "sec" COEFFS 0 1.000000 0.000000 0 0.000000 1.250000e-02 /end COMPU_METHOD
/begin COMPU_METHOD TQ20 "  Zeitquantisierung mit 20[ms]" RAT_FUNC "%5.3" "sec" COEFFS 0 50.000000 0.000000 0 0.000000 1.000000 /end COMPU_METHOD
/begin COMPU_METHOD TQ40 "  Zeitquantisierung mit 40[ms]" RAT_FUNC "%5.2" "sec" COEFFS 0 25.000000 0.000000 0 0.000000 1.000000 /end COMPU_METHOD
/begin COMPU_METHOD TQ50L "  Zeitquantisierung mit 50[ms]" RAT_FUNC "%9.4" "sec" COEFFS 0 20.000000 0.000000 0 0.000000 1.000000 /end COMPU_METHOD
/begin COMPU_METHOD TTEVQL2 "  Quantisierung von Timer tev 16 Bit mit  0.267E-2 [ms]" RAT_FUNC "%7.3" "ms" COEFFS 0 1.000000 0.000000 0 0.000000 2.666700e-03 /end COMPU_METHOD
/begin COMPU_METHOD U0V_0V03 "8Bit Umsetzung des Spannungsintervalles 0..0,03V" RAT_FUNC "%6.5" "V" COEFFS 0 256.000000 0.000000 0 0.000000 3.000000e-02 /end COMPU_METHOD
/begin COMPU_METHOD U0V_1V25 "8Bit Umsetzung des Spannungsintervalles 0..1,245V" RAT_FUNC "%5.3" "V" COEFFS 0 256.000000 0.000000 0 0.000000 1.250000 /end COMPU_METHOD
/begin COMPU_METHOD U0V_24V " Kehrwert Spannung in 8-Bit-Hexwerten " RAT_FUNC "%9.6" " 1/V " COEFFS 0 1.000000 0.000000 0 0.000000 9.362000e-02 /end COMPU_METHOD
/begin COMPU_METHOD U5VL "  A/D-Wandelwert mit 5V quantisiert" RAT_FUNC "%5.3" "V" COEFFS 0 65535.000000 0.000000 0 0.000000 5.000000 /end COMPU_METHOD
/begin COMPU_METHOD UBQ "  Batteriespannung mit 0.0942[V] quantisiert" RAT_FUNC "%5.2" "V" COEFFS 0 1.000000 0.000000 0 0.000000 9.421700e-02 /end COMPU_METHOD
/begin COMPU_METHOD UDCLR "  Umrechnung Spannung mit 0.0196 quantisiert" RAT_FUNC "%7.5" "V" COEFFS 0 1.000000 0.000000 0 0.000000 1.960000e-02 /end COMPU_METHOD
/begin COMPU_METHOD UDKL "Drosselklappenwinkel" RAT_FUNC "%7.4" "grad DK" COEFFS 0 3.276800e+04 0.000000 0 0.000000 80.916000 /end COMPU_METHOD
/begin COMPU_METHOD UDWDK "Drosselklappenwinkeländerung" RAT_FUNC "%7.4" "grad DK/20ms" COEFFS 0 256.000000 0.000000 0 0.000000 80.916000 /end COMPU_METHOD
/begin COMPU_METHOD UFUELL "Umrechnung fuer Fuellungsgrad" RAT_FUNC "%7.3" "%" COEFFS 0 255.000000 0.000000 0 0.000000 191.250000 /end COMPU_METHOD
/begin COMPU_METHOD UGESCH4 "Umrechnung fuer Geschwindigkeiten mit  4.000 quantisiert" RAT_FUNC "%7.4" "km/h" COEFFS 0 4.000000 0.000000 0 0.000000 1.000000 /end COMPU_METHOD
/begin COMPU_METHOD ULSQ "  Lambdasonden-Spannung ohne Offset" RAT_FUNC "%7.5" "V" COEFFS 0 51.000000 0.000000 0 0.000000 1.000000 /end COMPU_METHOD
/begin COMPU_METHOD ULSQL "  Lambdasonden-Spannung ohne Offset" RAT_FUNC "%7.5" "V" COEFFS 0 13107.000000 0.000000 0 0.000000 1.000000 /end COMPU_METHOD
/begin COMPU_METHOD UMFAUSG " Zeitquantisierung Ueberwachung ausg in [ms] mit ausg_anz=   1.000 " RAT_FUNC "%5.0" "ms" COEFFS 0 1.000000 0.000000 0 0.000000 40.000000 /end COMPU_METHOD
/begin COMPU_METHOD UMFNSC " Zeitquantisierung Ueberwachung nsc in [ms] mit nsc_anz=  1.000 " RAT_FUNC "%7.0" "ms" COEFFS 0 1.000000 0.000000 0 0.000000 40.000000 /end COMPU_METHOD
/begin COMPU_METHOD UTABG "Abgastemperatur" RAT_FUNC "%7.3" "grad C" COEFFS 0 1.000000 48.000000 0 0.000000 4.000000 /end COMPU_METHOD
/begin COMPU_METHOD UTABGR "Abgastemperatur relativ" RAT_FUNC "%7.2" "grad C" COEFFS 0 1.000000 0.000000 0 0.000000 4.000000 /end COMPU_METHOD
/begin COMPU_METHOD UTMP_40 "  lineare Temperatur + Offset" RAT_FUNC "%6.2" "grd C" COEFFS 0 1.000000 40.000000 0 0.000000 1.000000 /end COMPU_METHOD
/begin COMPU_METHOD UTNQ " Drehzahlquantisierung mit  0.167   [Upm]" RAT_FUNC "%9.3" "Upm " COEFFS 0 0.000000 15000.000000 0 1.666667e-01 0.000000 /end COMPU_METHOD
/begin COMPU_METHOD UWDK "Drosselklappenwinkel" RAT_FUNC "%7.4" "grad DK" COEFFS 0 256.000000 0.000000 0 0.000000 80.916000 /end COMPU_METHOD
/begin COMPU_METHOD UWKL10 "Drosselklappenwinkel" RAT_FUNC "%7.4" "grad DK" COEFFS 0 25.323000 0.000000 0 0.000000 1.000000 /end COMPU_METHOD
/begin COMPU_METHOD UWKL15 "Drosselklappenwinkel" RAT_FUNC "%7.4" "grad DK" COEFFS 0 16.876000 0.000000 0 0.000000 1.000000 /end COMPU_METHOD
/begin COMPU_METHOD U_A "  Beschleunigungsumrechnung" RAT_FUNC "%6.3" "m/(s*s)" COEFFS 0 1.000000 0.000000 0 0.000000 1.736100e-01 /end COMPU_METHOD
/begin COMPU_METHOD VQV "  Fahrgeschwindigkeit mit Faktor  0.833 [km/h]" RAT_FUNC "%5.1" "km/h" COEFFS 0 8.333300e-01 0.000000 0 0.000000 1.000000 /end COMPU_METHOD
/begin COMPU_METHOD VQV16 "  Geschwindigkeitsumrechnung mit Faktor  16.00 [km/h]" RAT_FUNC "%5.2" "km/h" COEFFS 0 16.000000 0.000000 0 0.000000 1.000000 /end COMPU_METHOD
/begin COMPU_METHOD VQV16L "  Geschwindigkeitsumrechnung mit Faktor  16.00 [km/h]" RAT_FUNC "%6.1" "km/h" COEFFS 0 16.000000 0.000000 0 0.000000 1.000000 /end COMPU_METHOD
/begin COMPU_METHOD ZWKOOF "  Zuendwinkelkorrektur mit Offset mit  0.750[grad KW] quantisiert" RAT_FUNC "%5.2" "grad KW" COEFFS 0 1.000000 96.000000 0 0.000000 7.500000e-01 /end COMPU_METHOD
/begin COMPU_METHOD ZWKOOFBG "  Zuendwinkelkorrektur mit Offset mit  0.750[grad KW] quantisiert" RAT_FUNC "%5.2" "grad KW" COEFFS 0 1.000000 96.000000 0 0.000000 7.500000e-01 /end COMPU_METHOD
/begin COMPU_METHOD ZWNEG "  Zuendwinkelverstellung nach frueh mit -0.750[grad KW] quantisiert" RAT_FUNC "%5.2" "grad KW" COEFFS 0 1.000000 0.000000 0 0.000000 -7.500000e-01 /end COMPU_METHOD
/begin COMPU_METHOD ZWNEGBG "  Zuendwinkelverstellung nach frueh mit -0.750[grad KW] quantisiert" RAT_FUNC "%5.2" "grad KW" COEFFS 0 1.000000 0.000000 0 0.000000 -7.500000e-01 /end COMPU_METHOD
/begin COMPU_METHOD ZWOF "  Zuendwinkel mit Offset" RAT_FUNC "%6.3" "grad KW" COEFFS 0 1.000000 78.000000 0 0.000000 7.500000e-01 /end COMPU_METHOD
/begin COMPU_METHOD ZWQ "  Zuendwinkel ohne Offset mit  0.750[grad KW] quantisiert" RAT_FUNC "%6.2" "grad KW" COEFFS 0 1.000000 0.000000 0 0.000000 7.500000e-01 /end COMPU_METHOD
/begin COMPU_METHOD NoCompuMethod "" RAT_FUNC "%4.0" "" COEFFS 0 1 0 0 0 1 /end COMPU_METHOD
/begin COMPU_TAB CLU_TMP "" TAB_INTP 41 3 -50.000000 4 -45.000000 5 -40.000000 7 -35.000000 10 -30.000000 13 -25.000000 16 -20.000000 21 -15.000000 26 -10.000000 32 -5.000000 38 0.000000 46 5.000000 55 10.000000 64 15.000000 74 20.000000 84 25.000000 95 30.000000 106 35.000000 117 40.000000 128 45.000000 139 50.000000 149 55.000000 158 60.000000 167 65.000000 175 70.000000 183 75.000000 190 80.000000 196 85.000000 202 90.000000 207 95.000000 212 100.000000 216 105.000000 220 110.000000 223 115.000000 226 120.000000 229 125.000000 231 130.000000 233 135.000000 235 140.000000 237 145.000000 239 150.000000 /end COMPU_TAB
/begin COMPU_TAB CMO_TMP "" TAB_INTP 21 0 -41.000000 5 -40.000000 9 -30.000000 15 -20.150000 24 -10.120000 36 -0.140000 53 9.940000 73 19.980000 84 24.980000 95 30.020000 118 39.970000 141 49.980000 162 60.000000 180 70.080000 195 80.030000 207 90.000000 217 99.960000 225 109.910000 231 120.250000 236 129.640000 255 140.000000 /end COMPU_TAB
/begin COMPU_TAB TMP_10B "" TAB_INTP 21 18 -41.000000 20 -40.000000 35 -30.000000 59 -20.000000 95 -10.000000 146 0.000000 212 10.000000 291 20.000000 335 25.000000 381 30.000000 475 40.000000 566 50.000000 649 60.000000 721 70.000000 782 80.000000 831 90.000000 870 100.000000 901 110.000000 925 120.000000 944 130.000000 965 140.000000 /end COMPU_TAB
/begin COMPU_TAB TMP_79_140 "" TAB_INTP 8 0 77.700000 14 80.000000 63 90.000000 102 100.000000 133 110.000000 157 120.000000 176 130.000000 197 140.000000 /end COMPU_TAB
/begin COMPU_VTAB B_DEZ "" TAB_VERB 2 0 "0" 1 "1" /end COMPU_VTAB
/begin COMPU_VTAB B_TRUE "" TAB_VERB 2 0 "----" 1 "TRUE" /end COMPU_VTAB
/begin MEASUREMENT A_POS "Beschleunigungssource " SBYTE U_A 0 0 -22.222100 22.048500 ECU_ADDRESS 0xF73E BIT_MASK 0xFF /end MEASUREMENT
/begin MEASUREMENT DZWSPAET " " UBYTE ZWQ 0 0 0.000000 191.250000 ECU_ADDRESS 0x67F BIT_MASK 0xFF /end MEASUREMENT
/begin MEASUREMENT FDKHA "Hoehenabhg. DK-Adaptionsfaktor" UBYTE FKT128 0 0 0.000000 1.992190 ECU_ADDRESS 0x2002 BIT_MASK 0xFF /end MEASUREMENT
/begin MEASUREMENT GANG_I "Gänge vom Getriebe" UBYTE DEZ7 0 0 0.000000 7.000000 ECU_ADDRESS 0x4F3 BIT_MASK 0xFF /end MEASUREMENT
/begin MEASUREMENT LBZ "Ladebilanzintegrator aus LLRUB" UBYTE DEZ 0 0 0.000000 256.000000 ECU_ADDRESS 0xF9B BIT_MASK 0xFF /end MEASUREMENT
/begin MEASUREMENT LFANCOUB "LÜFTERLEISTUNG" UBYTE PCENT 0 0 0.000000 99.609400 ECU_ADDRESS 0x2142 BIT_MASK 0xFF /end MEASUREMENT
/begin MEASUREMENT MLSM "MLE" UBYTE MLSMQ 0 0 0.000000 1024.000000 ECU_ADDRESS 0xF72C BIT_MASK 0xFF /end MEASUREMENT
/begin MEASUREMENT MLSP "Source f. Luftmasse" UBYTE MLSMQ 0 0 0.000000 1024.000000 ECU_ADDRESS 0xC59 BIT_MASK 0xFF /end MEASUREMENT
/begin MEASUREMENT MZ_UM "zul. Moment von der Überwachungsfunktion" UBYTE MMQ 0 0 0.000000 512.000000 ECU_ADDRESS 0xE026 BIT_MASK 0xFF /end MEASUREMENT
/begin MEASUREMENT NDIF "Drezahldifferenzbetrags-Source" UBYTE NQ5 0 0 0.000000 1275.000000 ECU_ADDRESS 0x54E BIT_MASK 0xFF /end MEASUREMENT
/begin MEASUREMENT NIST "Drehzahl " UBYTE NQ25 0 0 0.000000 6400.000000 ECU_ADDRESS 0xF72B BIT_MASK 0xFF /end MEASUREMENT
/begin MEASUREMENT NIST_UM "Drehzahl fuer Ueberwachung" UBYTE NQ25 0 0 0.000000 6400.000000 ECU_ADDRESS 0xE008 BIT_MASK 0xFF /end MEASUREMENT
/begin MEASUREMENT NMOT "Motordrehzahl " UBYTE NQ40 0 0 0.000000 10200.000000 ECU_ADDRESS 0xF74B BIT_MASK 0xFF /end MEASUREMENT
/begin MEASUREMENT PAC "KÜHLMITTELDRUCK" UBYTE PAB77 0 0 -0.306050 32.819400 ECU_ADDRESS 0x213A BIT_MASK 0xFF /end MEASUREMENT
/begin MEASUREMENT SPSNMAX_UM "max. Pedalwert für Überwachungsfunktion" UBYTE DEZ 0 0 0.000000 256.000000 ECU_ADDRESS 0xE074 BIT_MASK 0xFF /end MEASUREMENT
/begin MEASUREMENT SPSN_UM "normierte Sollwertvorgabe" UBYTE DEZ 0 0 0.000000 256.000000 ECU_ADDRESS 0xE00C BIT_MASK 0xFF /end MEASUREMENT
/begin MEASUREMENT SWPT "Pedal- u. Tempomatsollwert " UBYTE PER255 0 0 0.000000 100.000000 ECU_ADDRESS 0xF73B BIT_MASK 0xFF /end MEASUREMENT
/begin MEASUREMENT SWRES "" UBYTE PER255 0 0 0.000000 100.000000 ECU_ADDRESS 0xF73F BIT_MASK 0xFF /end MEASUREMENT
/begin MEASUREMENT TABGM "" UBYTE UTABG 0 0 -48.000000 972.000000 ECU_ADDRESS 0x673 BIT_MASK 0xFF /end MEASUREMENT
/begin MEASUREMENT TANS "Ansauglufttemperatur" UBYTE CLU_TMP 0 0 -50.000000 150.000000 ECU_ADDRESS 0xF70E BIT_MASK 0xFF /end MEASUREMENT
/begin MEASUREMENT TATE "" UBYTE PCENT 0 0 0.000000 99.609400 ECU_ADDRESS 0x29C BIT_MASK 0xFF /end MEASUREMENT
/begin MEASUREMENT TKATM "" UBYTE UTABG 0 0 -48.000000 972.000000 ECU_ADDRESS 0x675 BIT_MASK 0xFF /end MEASUREMENT
/begin MEASUREMENT TL8 "Last " UBYTE UFUELL 0 0 0.000000 191.250000 ECU_ADDRESS 0xF72D BIT_MASK 0xFF /end MEASUREMENT
/begin MEASUREMENT TL8Z "Last " UBYTE UFUELL 0 0 0.000000 191.250000 ECU_ADDRESS 0xF964 BIT_MASK 0xFF /end MEASUREMENT
/begin MEASUREMENT TMOT "Motor-Temperatur " UBYTE CMO_TMP 0 0 -41.000000 140.000000 ECU_ADDRESS 0xF70D BIT_MASK 0xFF /end MEASUREMENT
/begin MEASUREMENT TMOT_L "MOTORTEMPERATUR " UBYTE TMP_79_140 0 0 77.700000 140.000000 ECU_ADDRESS 0x2135 BIT_MASK 0xFF /end MEASUREMENT
/begin MEASUREMENT TMST "Motor-Temperatur beim Start " UBYTE CMO_TMP 0 0 -41.000000 140.000000 ECU_ADDRESS 0x258 BIT_MASK 0xFF /end MEASUREMENT
/begin MEASUREMENT UBATT "Batteriespannung " UBYTE UBQ 0 0 0.000000 24.119600 ECU_ADDRESS 0xF70C BIT_MASK 0xFF /end MEASUREMENT
/begin MEASUREMENT VFZG "Geschwindigkeitssignal ueber Impulse" UBYTE VQV 0 0 0.000000 306.000000 ECU_ADDRESS 0x27E BIT_MASK 0xFF /end MEASUREMENT
/begin MEASUREMENT V_LFR "LFR-Geschwindigkeit " UBYTE UGESCH4 0 0 0.000000 63.750000 ECU_ADDRESS 0xF72A BIT_MASK 0xFF /end MEASUREMENT
/begin MEASUREMENT WDKBL "Winkel" UBYTE UWDK 0 0 0.000000 80.599900 ECU_ADDRESS 0xF72F BIT_MASK 0xFF /end MEASUREMENT
/begin MEASUREMENT WKH "ZW fuer Korrektur Katheizen" UBYTE ZWQ 0 0 0.000000 191.250000 ECU_ADDRESS 0x285 BIT_MASK 0xFF /end MEASUREMENT
/begin MEASUREMENT ACCC_C_UM " Entprellzaehler in ACC" UBYTE DEZ 0 0 0.000000 256.000000 ECU_ADDRESS 0xE07C BIT_MASK 0xFF /end MEASUREMENT
/begin MEASUREMENT ACCNU_C_UM " Entprellzaehler NU in ACC" UBYTE DEZ 0 0 0.000000 256.000000 ECU_ADDRESS 0xE07D BIT_MASK 0xFF /end MEASUREMENT
/begin MEASUREMENT ADCC_C_UM " Fehlerzaehler ADC-Test" UBYTE DEZ 0 0 0.000000 256.000000 ECU_ADDRESS 0xE047 BIT_MASK 0xFF /end MEASUREMENT
/begin MEASUREMENT AD_G_MIN "Adaptions-Minimal-Grundwert" UWORD UDKL 0 0 0.000000 10.112000 ECU_ADDRESS 0xB0520 BIT_MASK 0xFFFF /end MEASUREMENT
/begin MEASUREMENT ATVH1 "LR-Integrator hinter Kat, Bank1 high" SWORD TQ10MSSL 0 0 -327.680000 327.670000 ECU_ADDRESS 0xB2006 BIT_MASK 0xFFFF /end MEASUREMENT
/begin MEASUREMENT ATVH2 "LR-Integrator hinter Kat, Bank2 high" SWORD TQ10MSSL 0 0 -327.680000 327.670000 ECU_ADDRESS 0xB200A BIT_MASK 0xFFFF /end MEASUREMENT
/begin MEASUREMENT ATVINII1 " Initialisierungswert fuer Stellgroesse atv, Bank1" SBYTE TQ10MSS 0 0 -1.280000 1.270000 ECU_ADDRESS 0xB03CD BIT_MASK 0xFF /end MEASUREMENT
/begin MEASUREMENT AVKATF1 "Amplitudenverhaeltnis gefiltert laafh1/laafv1" UBYTE FKT256 0 0 0.000000 0.996090 ECU_ADDRESS 0xB218C BIT_MASK 0xFF /end MEASUREMENT
/begin MEASUREMENT AVKATF2 "Amplitudenverhaeltnis gefiltert laafh2/laafv2" UBYTE FKT256 0 0 0.000000 0.996090 ECU_ADDRESS 0xB218D BIT_MASK 0xFF /end MEASUREMENT
/begin MEASUREMENT A_NEG_FC " Fehlerzeit -b Schwelle" UBYTE TQ20 0 0 0.000000 5.100000 ECU_ADDRESS 0xB04EC BIT_MASK 0xFF /end MEASUREMENT
/begin MEASUREMENT BFZGL_B " Fahrzeuglaengsbeschleunigung" SBYTE U_A 0 0 -22.222100 22.048500 ECU_ADDRESS 0xB061B BIT_MASK 0xFF /end MEASUREMENT
/begin MEASUREMENT BREMS_C_UM " Entprellzaehler Bremserfassung" UBYTE DEZ 0 0 0.000000 256.000000 ECU_ADDRESS 0xE049 BIT_MASK 0xFF /end MEASUREMENT
/begin MEASUREMENT BZACC_A_UM " alter ACC Botschaftszaehler" UBYTE DEZ 0 0 0.000000 256.000000 ECU_ADDRESS 0xE07E BIT_MASK 0xFF /end MEASUREMENT
/begin MEASUREMENT BZMSR_A_UM " alter MSr Botschaftszaehler" UBYTE DEZ 0 0 0.000000 256.000000 ECU_ADDRESS 0xE04B BIT_MASK 0xFF /end MEASUREMENT
/begin MEASUREMENT BZSGS_A_UM " Byte fuer DA bzsgs_a_um" UBYTE DEZ 0 0 0.000000 256.000000 ECU_ADDRESS 0xE081 BIT_MASK 0xFF /end MEASUREMENT
/begin MEASUREMENT CAN_ACCBUF "DA CAN-Emulation fuer ACC" UBYTE DEZ 0 0 0.000000 256.000000 ECU_ADDRESS 0xBB9 BIT_MASK 0xFF /end MEASUREMENT
/begin MEASUREMENT CAN_ASRBUF "DA CAN-Emulation fuer ASR/MSR" UBYTE DEZ 0 0 0.000000 256.000000 ECU_ADDRESS 0xBB0 BIT_MASK 0xFF /end MEASUREMENT
/begin MEASUREMENT CAN_NBABUF "DA CAN-Emulation fuer Bremsassistent" UBYTE DEZ 0 0 0.000000 256.000000 ECU_ADDRESS 0xBC9 BIT_MASK 0xFF /end MEASUREMENT
/begin MEASUREMENT CAN_SGSBUF "DA CAN-Emulation fuer Getriebe" UBYTE DEZ 0 0 0.000000 256.000000 ECU_ADDRESS 0xBC1 BIT_MASK 0xFF /end MEASUREMENT
/begin MEASUREMENT CW_ERFIL "Status Codewort Filtervariante fuer Ausgabe der AS-Fehler an GST" UBYTE DEZ 0 0 0.000000 256.000000 ECU_ADDRESS 0xB0FBD BIT_MASK 0xFF /end MEASUREMENT
/begin MEASUREMENT DANTEIL "D-Anteil" UWORD DEZL 0 0 0.000000 65535.000000 ECU_ADDRESS 0xB04FE BIT_MASK 0xFFFF /end MEASUREMENT
/begin MEASUREMENT DCLR "DC-Lagereglerausgang" UBYTE UDCLR 0 0 0.000000 4.998000 ECU_ADDRESS 0xB0259 BIT_MASK 0xFF /end MEASUREMENT
/begin MEASUREMENT DFRKA "DELTA-FR fuer gesteuertes KAT-Ausraeumen" UBYTE FKT512 0 0 0.000000 0.500000 ECU_ADDRESS 0xB0C62 BIT_MASK 0xFF /end MEASUREMENT
/begin MEASUREMENT DFTEA " Faktor Gemischadaption bei Tankentlueftung Abweichung von 1" UWORD FKT65536SO 0 0 -0.500000 0.499980 ECU_ADDRESS 0xB0714 BIT_MASK 0xFFFF /end MEASUREMENT
/begin MEASUREMENT DFTEAB "Betrag Abweichung Tankentl.faktor von 1" UBYTE FKT512 0 0 0.000000 0.500000 ECU_ADDRESS 0xB0720 BIT_MASK 0xFF /end MEASUREMENT
/begin MEASUREMENT DFV "gefilterte Geschwindigkeit vorne links" UWORD VQV16L 0 0 0.000000 4095.940000 ECU_ADDRESS 0xB027A BIT_MASK 0xFFFF /end MEASUREMENT
/begin MEASUREMENT DIFSP12_C "Fehlerz.: zu grosse Abweichung [10ms/Step]" UBYTE DEZ 0 0 0.000000 256.000000 ECU_ADDRESS 0xB06B0 BIT_MASK 0xFF /end MEASUREMENT
/begin MEASUREMENT DLASHKI1 " gewichtete Pseudo-Lambda-Diff fuer I-Anteil, Bank1" SWORD FKT128SL 0 0 -256.000000 255.992000 ECU_ADDRESS 0xB03D6 BIT_MASK 0xFFFF /end MEASUREMENT
/begin MEASUREMENT DLASHKM1 " Delta-Lambda aus Lambdaregelung hinter Kat, Bank1" UBYTE U0V_0V03 0 0 0.000000 0.029883 ECU_ADDRESS 0xB03CC BIT_MASK 0xFF /end MEASUREMENT
/begin MEASUREMENT DLASHKP1 " gewichtete Pseudo-Lambda-Diff fuer P-Anteil, Bank1" SWORD FKT128SL 0 0 -256.000000 255.992000 ECU_ADDRESS 0xB03D8 BIT_MASK 0xFFFF /end MEASUREMENT
/begin MEASUREMENT DLRPER "Stellgroesse LR-Synchro-Regelung" SWORD FKT65536SL 0 0 -0.500000 0.499980 ECU_ADDRESS 0xB033C BIT_MASK 0xFFFF /end MEASUREMENT
/begin MEASUREMENT DN "Betrag Drehzahldifferenz" UBYTE NQ25 0 0 0.000000 6400.000000 ECU_ADDRESS 0xB04AA BIT_MASK 0xFF /end MEASUREMENT
/begin MEASUREMENT DNDT "Drehzahlgradient" SBYTE NGRDQ10OF 0 0 -1270.000000 1270.000000 ECU_ADDRESS 0xB0825 BIT_MASK 0xFF /end MEASUREMENT
/begin MEASUREMENT DTV_B1 "'fmt:530' LRA-Integrator Bank1 addit. Korr.-Faktor f. EV-Fehler" SWORD TEQ_CPL 0 0 -87.381300 87.378700 ECU_ADDRESS 0xB202A BIT_MASK 0xFFFF /end MEASUREMENT
/begin MEASUREMENT DTV_B2 "'fmt:530' LRA-Integrator Bank2 addit. Korr.-Faktor f. EV-Fehler" SWORD TEQ_CPL 0 0 -87.381300 87.378700 ECU_ADDRESS 0xB202E BIT_MASK 0xFFFF /end MEASUREMENT
/begin MEASUREMENT DUB " |UBSOLL-UBATT| fuer Ladebilanzregelung" UBYTE UBQ 0 0 0.000000 24.119600 ECU_ADDRESS 0xB0F96 BIT_MASK 0xFF /end MEASUREMENT
/begin MEASUREMENT DWDKBL "Drosselklappenwinkelaenderung" SBYTE UDWDK 0 0 -40.458000 40.141900 ECU_ADDRESS 0xF730 BIT_MASK 0xFF /end MEASUREMENT
/begin MEASUREMENT DWKRS "Klopf-Sicherheitsspaetverstellung" UBYTE ZWQ 0 0 0.000000 191.250000 ECU_ADDRESS 0xB0468 BIT_MASK 0xFF /end MEASUREMENT
/begin MEASUREMENT EVZ_AUS_UM " Zyl.Abschaltmaske ESausbl." UBYTE PER255 0 0 0.000000 100.000000 ECU_ADDRESS 0xE007 BIT_MASK 0xFF /end MEASUREMENT
/begin MEASUREMENT FANS_R " Ansaugluftkorrektur fuer TLW-Bestimmung" UBYTE FKT128 0 0 0.000000 1.992190 ECU_ADDRESS 0xB06CC BIT_MASK 0xFF /end MEASUREMENT
/begin MEASUREMENT FFZDFP "Fehlerpfadidentifikationsnummer (dfp) zum Freeze-Frame Zero" UBYTE DEZ 0 0 0.000000 256.000000 ECU_ADDRESS 0xB0FA0 BIT_MASK 0xFF /end MEASUREMENT
/begin MEASUREMENT FGRFKT " Ausgewaehlte FGR-Funktion" UBYTE DEZ 0 0 0.000000 256.000000 ECU_ADDRESS 0xB04D4 BIT_MASK 0xFF /end MEASUREMENT
/begin MEASUREMENT FLGLRS " CARB FREEZE FRAME Byte, Bank 1, fuer LR" UBYTE DEZ 0 0 0.000000 256.000000 ECU_ADDRESS 0xB03AD BIT_MASK 0xFF /end MEASUREMENT
/begin MEASUREMENT FLGLRS2 " CARB FREEZE FRAME Byte, Bank 2, fuer LR" UBYTE DEZ 0 0 0.000000 256.000000 ECU_ADDRESS 0xB03AE BIT_MASK 0xFF /end MEASUREMENT
/begin MEASUREMENT FRAO_B1 "LRA-Integrator.high Bank1 multipl. Korr.-Faktor" UWORD FPC50L 0 0 0.500000 1.499980 ECU_ADDRESS 0xB2016 BIT_MASK 0xFFFF /end MEASUREMENT
/begin MEASUREMENT FRAO_B2 "LRA-Integrator.high Bank2 multipl. Korr.-Faktor" UWORD FPC50L 0 0 0.500000 1.499980 ECU_ADDRESS 0xB201A BIT_MASK 0xFFFF /end MEASUREMENT
/begin MEASUREMENT FRAU_B1 "LRA-Integrator.high Bank1 multipl. Korr.-Faktor" UWORD FPC50L 0 0 0.500000 1.499980 ECU_ADDRESS 0xB200E BIT_MASK 0xFFFF /end MEASUREMENT
/begin MEASUREMENT FRAU_B2 "LRA-Integrator.high Bank2 multipl. Korr.-Faktor" UWORD FPC50L 0 0 0.500000 1.499980 ECU_ADDRESS 0xB2012 BIT_MASK 0xFFFF /end MEASUREMENT
/begin MEASUREMENT FRA_B1 "LRA-Integrator.low Bank1 multipl. Korr.-Faktor =f(FRAU,FRAO)" UWORD FPC50L 0 0 0.500000 1.499980 ECU_ADDRESS 0xB201C BIT_MASK 0xFFFF /end MEASUREMENT
/begin MEASUREMENT FRA_B2 "LRA-Integrator.low Bank2 multipl. Korr.-Faktor" UWORD FPC50L 0 0 0.500000 1.499980 ECU_ADDRESS 0xB201E BIT_MASK 0xFFFF /end MEASUREMENT
/begin MEASUREMENT FRI_ "LR-Integrator-Steigung" UWORD FKT65536 0 0 0.000000 1.000000 ECU_ADDRESS 0xB0380 BIT_MASK 0xFFFF /end MEASUREMENT
/begin MEASUREMENT FRMN "LR-Integrator -Min-Begr.frmin/..sl" UWORD FPC50L 0 0 0.500000 1.499980 ECU_ADDRESS 0xB0386 BIT_MASK 0xFFFF /end MEASUREMENT
/begin MEASUREMENT FRMX "LR-Integrator-Steigung -Max-Begr.frmax/..sl" UWORD FPC50L 0 0 0.500000 1.499980 ECU_ADDRESS 0xB0384 BIT_MASK 0xFFFF /end MEASUREMENT
/begin MEASUREMENT FRM_B1 "gefiltertes FR f. Adaption, Bank1" UWORD FPC50L 0 0 0.500000 1.499980 ECU_ADDRESS 0xB03A0 BIT_MASK 0xFFFF /end MEASUREMENT
/begin MEASUREMENT FRM_B2 "gefiltertes FR f. Adaption, Bank2" UWORD FPC50L 0 0 0.500000 1.499980 ECU_ADDRESS 0xB03A4 BIT_MASK 0xFFFF /end MEASUREMENT
/begin MEASUREMENT FRP_ "LR-Integrator-P-Sprung" UWORD FKT65536 0 0 0.000000 1.000000 ECU_ADDRESS 0xB0382 BIT_MASK 0xFFFF /end MEASUREMENT
/begin MEASUREMENT FR_B1 " Lambda-Korrekturfaktor Bank1" UWORD FPC50L 0 0 0.500000 1.499980 ECU_ADDRESS 0xF722 BIT_MASK 0xFFFF /end MEASUREMENT
/begin MEASUREMENT FR_B2 " Lambda-Korrekturfaktor Bank2" UWORD FPC50L 0 0 0.500000 1.499980 ECU_ADDRESS 0xF724 BIT_MASK 0xFFFF /end MEASUREMENT
/begin MEASUREMENT FR_IB1 " LR-interner Lambda-Korrekturfaktor Bank1" UWORD FPC50L 0 0 0.500000 1.499980 ECU_ADDRESS 0xF71E BIT_MASK 0xFFFF /end MEASUREMENT
/begin MEASUREMENT FR_IB2 " LR-interner Lambda-Korrekturfaktor Bank2" UWORD FPC50L 0 0 0.500000 1.499980 ECU_ADDRESS 0xF720 BIT_MASK 0xFFFF /end MEASUREMENT
/begin MEASUREMENT FTEA "Tankentl.- Korr.-Faktor 100H ='1'" UWORD FKT256L 0 0 0.000000 256.000000 ECU_ADDRESS 0xF71C BIT_MASK 0xFFFF /end MEASUREMENT
/begin MEASUREMENT FTEAD "'FMT:530' Lambdaregelabweichung" UWORD SIG32L 0 0 -32.000000 31.999000 ECU_ADDRESS 0xB0712 BIT_MASK 0xFFFF /end MEASUREMENT
/begin MEASUREMENT FTEFVA "Spuelrate" UWORD FKT131072 0 0 0.000000 0.500000 ECU_ADDRESS 0xB0716 BIT_MASK 0xFFFF /end MEASUREMENT
/begin MEASUREMENT FWE "WE-Anreicherungsfaktor" UWORD FKT256L 0 0 0.000000 256.000000 ECU_ADDRESS 0xB0290 BIT_MASK 0xFFFF /end MEASUREMENT
/begin MEASUREMENT FWKHZ "KAT-Heizung Gewichtungsfaktor bei Teillast" UBYTE FKT256 0 0 0.000000 0.996090 ECU_ADDRESS 0xB04B9 BIT_MASK 0xFF /end MEASUREMENT
/begin MEASUREMENT FWKHZL " KAT-Heizung Gewichtungsfaktor bei Leerlauf" UBYTE FKT256 0 0 0.000000 0.996090 ECU_ADDRESS 0xB04BA BIT_MASK 0xFF /end MEASUREMENT
/begin MEASUREMENT FWL "WL-Anreicherungsfaktor" UWORD FKT256L 0 0 0.000000 256.000000 ECU_ADDRESS 0xB028E BIT_MASK 0xFFFF /end MEASUREMENT
/begin MEASUREMENT H_IANTEIL "High Word I-Anteil" UWORD DEZL 0 0 0.000000 65535.000000 ECU_ADDRESS 0xB0504 BIT_MASK 0xFFFF /end MEASUREMENT
/begin MEASUREMENT IKR "Klopfintegratoren" UWORD SENSORW 0 0 0.000000 4.999920 ECU_ADDRESS 0xB0400 BIT_MASK 0xFFFF /end MEASUREMENT
/begin MEASUREMENT ILMLKA "Integrierte Fettflaeche f. LRKA" UWORD MLQP512L 0 0 0.000000 12799.800000 ECU_ADDRESS 0xB0C5E BIT_MASK 0xFFFF /end MEASUREMENT
/begin MEASUREMENT IMLKA "Integrierter Luftmasse f. LRKA" UWORD MLQ256L 0 0 0.000000 255.996000 ECU_ADDRESS 0xB0C5C BIT_MASK 0xFFFF /end MEASUREMENT
/begin MEASUREMENT IP123DIF_C "IP123-Differenz-Fehlerzaehler" UBYTE TQ10 0 0 0.000000 2.550000 ECU_ADDRESS 0xB0704 BIT_MASK 0xFF /end MEASUREMENT
/begin MEASUREMENT IP12DIF_C "IP12-Differenz-Fehlerzaehler" UBYTE TQ10 0 0 0.000000 2.550000 ECU_ADDRESS 0xB0701 BIT_MASK 0xFF /end MEASUREMENT
/begin MEASUREMENT IP13DIF_C "IP13-Differenz-Fehlerzaehler" UBYTE TQ10 0 0 0.000000 2.550000 ECU_ADDRESS 0xB0702 BIT_MASK 0xFF /end MEASUREMENT
/begin MEASUREMENT IP1BER_C "IP1-Bereichs-Fehlerzaehler" UBYTE TQ10 0 0 0.000000 2.550000 ECU_ADDRESS 0xB06FD BIT_MASK 0xFF /end MEASUREMENT
/begin MEASUREMENT IP1S "Istwertpoti 1" UBYTE PER255 0 0 0.000000 100.000000 ECU_ADDRESS 0xB0255 BIT_MASK 0xFF /end MEASUREMENT
/begin MEASUREMENT IP1SEL_C "IP1-Auswahl-Verzoegerungszeitzaehler" UBYTE TQ10 0 0 0.000000 2.550000 ECU_ADDRESS 0xB06FF BIT_MASK 0xFF /end MEASUREMENT
/begin MEASUREMENT IP1SN "DK-Istwert vom Poti 1 umgerechnet auf steigende Gerade o. u. Anschlag" UBYTE PER_DKA 0 0 0.000000 100.000000 ECU_ADDRESS 0xB06FA BIT_MASK 0xFF /end MEASUREMENT
/begin MEASUREMENT IP23DIF_C "IP23-Differenz-Fehlerzaehler" UBYTE TQ10 0 0 0.000000 2.550000 ECU_ADDRESS 0xB0703 BIT_MASK 0xFF /end MEASUREMENT
/begin MEASUREMENT IP2BER_C "IP2-Bereichs-Fehlerzaehler" UBYTE TQ10 0 0 0.000000 2.550000 ECU_ADDRESS 0xB06FE BIT_MASK 0xFF /end MEASUREMENT
/begin MEASUREMENT IP2S "Istwertpoti 2" UBYTE PER255 0 0 0.000000 100.000000 ECU_ADDRESS 0xB0256 BIT_MASK 0xFF /end MEASUREMENT
/begin MEASUREMENT IP2SEL_C "IP2-Auswahl-Verzoegerungszeitzaehler" UBYTE TQ10 0 0 0.000000 2.550000 ECU_ADDRESS 0xB0700 BIT_MASK 0xFF /end MEASUREMENT
/begin MEASUREMENT IP2SN "DK-Istwert vom Poti 2 umgerechnet auf steigende Gerade o. u. Anschlag" UBYTE PER_DKA 0 0 0.000000 100.000000 ECU_ADDRESS 0xB06FB BIT_MASK 0xFF /end MEASUREMENT
/begin MEASUREMENT IP3SN " aus TLR berechneter DK-Winkel (normiert)" UBYTE PER_DKA 0 0 0.000000 100.000000 ECU_ADDRESS 0xB06B6 BIT_MASK 0xFF /end MEASUREMENT
/begin MEASUREMENT IPSN_FR " momentaner DK-Istwert vom FR" UBYTE PER_DKA 0 0 0.000000 100.000000 ECU_ADDRESS 0xB06FC BIT_MASK 0xFF /end MEASUREMENT
/begin MEASUREMENT KEK " Korrigierter K-Faktor" UBYTE FKT32 0 0 0.000000 7.968750 ECU_ADDRESS 0xB06E5 BIT_MASK 0xFF /end MEASUREMENT
/begin MEASUREMENT KMSTMIL_W " 'Kilometerstand' in [1km/Inc]" UWORD KM_L 0 0 0.000000 65535.000000 ECU_ADDRESS 0xB2B14 BIT_MASK 0xFFFF /end MEASUREMENT
/begin MEASUREMENT KORR_B_C " Korrekturzeitzaehler nach +b" UBYTE TQ100 0 0 0.000000 25.500000 ECU_ADDRESS 0xB04D7 BIT_MASK 0xFF /end MEASUREMENT
/begin MEASUREMENT KORR_V_C " Korrekturzeitzaehler nach -b" UBYTE TQ100 0 0 0.000000 25.500000 ECU_ADDRESS 0xB04D8 BIT_MASK 0xFF /end MEASUREMENT
/begin MEASUREMENT KVAT " Kraftstoffverbrauch [0.0022l/h/Inc]" UWORD KVA0022 0 0 0.000000 144.177000 ECU_ADDRESS 0xFA2A BIT_MASK 0xFFFF /end MEASUREMENT
/begin MEASUREMENT LAHKMZ1 " Zustandsbyte des Automaten: fr-synchrone Mittelung Pseudo-Lambda hinter Kat, Ba" UBYTE DEZ 0 0 0.000000 256.000000 ECU_ADDRESS 0xB03C6 BIT_MASK 0xFF /end MEASUREMENT
/begin MEASUREMENT LAMHF1 " Pseudolinearisiertes Lambda hinter Kat, PT1-gefiltert, Bank1" UBYTE FKT_LAMBDA 0 0 0.970000 1.029770 ECU_ADDRESS 0xB03C8 BIT_MASK 0xFF /end MEASUREMENT
/begin MEASUREMENT LAMHM1 " fr-synchron gemittelter Pseudo Lambda-Ist-Wert, Bank1" UBYTE FKT_LAMBDA 0 0 0.970000 1.029770 ECU_ADDRESS 0xB03C7 BIT_MASK 0xFF /end MEASUREMENT
/begin MEASUREMENT LAMLGM " Laufgrenze Lambda mager" UBYTE FKT128 0 0 0.000000 1.992190 ECU_ADDRESS 0xB0936 BIT_MASK 0xFF /end MEASUREMENT
/begin MEASUREMENT LAMSOLH " Pseudo Lambda-Soll-Wert, Bank1 und Bank2" UBYTE FKT_LAMBDA 0 0 0.970000 1.029770 ECU_ADDRESS 0xB03C9 BIT_MASK 0xFF /end MEASUREMENT
/begin MEASUREMENT LAMSONH1 " Pseudo Lambda-Ist-Wert, Bank1" UBYTE FKT_LAMBDA 0 0 0.970000 1.029770 ECU_ADDRESS 0xB03CA BIT_MASK 0xFF /end MEASUREMENT
/begin MEASUREMENT LFANCOM " Lüftungsleistung Grundwert" UBYTE PCENT 0 0 0.000000 99.609400 ECU_ADDRESS 0xB2141 BIT_MASK 0xFF /end MEASUREMENT
/begin MEASUREMENT LFANCOMAR " Lüftungsleistung im Nachlauf" UBYTE PCENT 0 0 0.000000 99.609400 ECU_ADDRESS 0xB2140 BIT_MASK 0xFF /end MEASUREMENT
/begin MEASUREMENT LFREAC " Lüfterleistung abhängig von Klimaanlage" UBYTE PCENT 0 0 0.000000 99.609400 ECU_ADDRESS 0xB213F BIT_MASK 0xFF /end MEASUREMENT
/begin MEASUREMENT LFREQFZ " Lüfterleistung abhängig von tmot, pac, ..." UBYTE PCENT 0 0 0.000000 99.609400 ECU_ADDRESS 0xB213D BIT_MASK 0xFF /end MEASUREMENT
/begin MEASUREMENT LFREQMOT " angforderte Lüftungsleistung tmot-abhängig" UBYTE PCENT 0 0 0.000000 99.609400 ECU_ADDRESS 0xB213E BIT_MASK 0xFF /end MEASUREMENT
/begin MEASUREMENT LRKAZ "LRKA-Zustand" UBYTE DEZ 0 0 0.000000 256.000000 ECU_ADDRESS 0xB0C60 BIT_MASK 0xFF /end MEASUREMENT
/begin MEASUREMENT LZAVB_C "Langzeit-Adaptions-Verbotzeit-Zaehler" UWORD TQ100L 0 0 0.000000 6553.500000 ECU_ADDRESS 0xB0526 BIT_MASK 0xFFFF /end MEASUREMENT
/begin MEASUREMENT LZA_GW "Langzeit-Adaptions-Grundwert" UWORD UDKL 0 0 0.000000 10.112000 ECU_ADDRESS 0xB2B0A BIT_MASK 0xFFFF /end MEASUREMENT
/begin MEASUREMENT L_IANTEIL "Low Word I-Anteil" UWORD DEZL 0 0 0.000000 65535.000000 ECU_ADDRESS 0xB0502 BIT_MASK 0xFFFF /end MEASUREMENT
/begin MEASUREMENT MACC_UM " Momentenanforderung vom ACC" UBYTE MMQ 0 0 0.000000 512.000000 ECU_ADDRESS 0xE072 BIT_MASK 0xFF /end MEASUREMENT
/begin MEASUREMENT ML "Luftmassenfluss" UBYTE M_UB_B1020 0 0 0.000000 1020.000000 ECU_ADDRESS 0xF72C BIT_MASK 0xFF /end MEASUREMENT
/begin MEASUREMENT MLNKA "Integrierter Luftstrom nach SAS f. MLLRH" UBYTE MLQ100 0 0 0.000000 2.538680 ECU_ADDRESS 0xB038D BIT_MASK 0xFF /end MEASUREMENT
/begin MEASUREMENT MLSMW "16-Bit Luftmasse gefiltert" UWORD MLQ010L 0 0 0.000000 6553.500000 ECU_ADDRESS 0xF956 BIT_MASK 0xFFFF /end MEASUREMENT
/begin MEASUREMENT MMSR_UM " Momentenanforderung von MSR" UBYTE MMQ 0 0 0.000000 512.000000 ECU_ADDRESS 0xE07A BIT_MASK 0xFF /end MEASUREMENT
/begin MEASUREMENT MPED_UM " zul. Moment Pedal" UBYTE MMQ 0 0 0.000000 512.000000 ECU_ADDRESS 0xE024 BIT_MASK 0xFF /end MEASUREMENT
/begin MEASUREMENT MSGS_UM " erhoehender Getriebe-Eingriff" UBYTE MMQ 0 0 0.000000 512.000000 ECU_ADDRESS 0xE022 BIT_MASK 0xFF /end MEASUREMENT
/begin MEASUREMENT MSRC_C_UM " Fehlerzaehler MSR-Eingriff" UBYTE DEZ 0 0 0.000000 256.000000 ECU_ADDRESS 0xE04D BIT_MASK 0xFF /end MEASUREMENT
/begin MEASUREMENT MSRNU_C_UM " Entprellzaehler in MSR" UBYTE DEZ 0 0 0.000000 256.000000 ECU_ADDRESS 0xE07B BIT_MASK 0xFF /end MEASUREMENT
/begin MEASUREMENT MZF_LOW_UM " Nachkommastellen Mom.-Vorgabe" UBYTE DEZ 0 0 0.000000 256.000000 ECU_ADDRESS 0xE02C BIT_MASK 0xFF /end MEASUREMENT
/begin MEASUREMENT MZF_UM " gefiltertes Moment" UBYTE MMQ 0 0 0.000000 512.000000 ECU_ADDRESS 0xE02B BIT_MASK 0xFF /end MEASUREMENT
/begin MEASUREMENT MZO_UM " Toleranz-Moment" UBYTE MMQ 0 0 0.000000 512.000000 ECU_ADDRESS 0xE025 BIT_MASK 0xFF /end MEASUREMENT
/begin MEASUREMENT NAB "Abschaltedrehzahl" UBYTE NQ25 0 0 0.000000 6400.000000 ECU_ADDRESS 0xB049A BIT_MASK 0xFF /end MEASUREMENT
/begin MEASUREMENT NIST_1U "Drehzahl" UWORD NQ1_W 0 0 0.000000 8000.000000 ECU_ADDRESS 0xF94A BIT_MASK 0xFFFF /end MEASUREMENT
/begin MEASUREMENT NIST_5U "Drehzahl" UWORD DEZL 0 0 0.000000 65535.000000 ECU_ADDRESS 0xB06C2 BIT_MASK 0xFFFF /end MEASUREMENT
/begin MEASUREMENT NSKA_UM " Grenzdrehzahl fuer komplette Einspritzausbl. in Fehlerreaktion" UBYTE NQ25 0 0 0.000000 6400.000000 ECU_ADDRESS 0xE03B BIT_MASK 0xFF /end MEASUREMENT
/begin MEASUREMENT NSOLL "NO COMMENT" UWORD NQ1_W 0 0 0.000000 8000.000000 ECU_ADDRESS 0xB052C BIT_MASK 0xFFFF /end MEASUREMENT
/begin MEASUREMENT NSOLL_1U "Soll-Drehzahl" UWORD NQ1_W 0 0 0.000000 8000.000000 ECU_ADDRESS 0xB052C BIT_MASK 0xFFFF /end MEASUREMENT
/begin MEASUREMENT NWE "Wiedereinsetzdrehzahl" UBYTE NQ25 0 0 0.000000 6400.000000 ECU_ADDRESS 0xB049C BIT_MASK 0xFF /end MEASUREMENT
/begin MEASUREMENT OBGR "Obergrenze" UWORD UDKL 0 0 0.000000 10.112000 ECU_ADDRESS 0xB0510 BIT_MASK 0xFFFF /end MEASUREMENT
/begin MEASUREMENT OGANOFIN "Offset zur Obergrenzberechnung beim Anfahren in der LFR" UBYTE UWKL10 0 0 0.000000 10.069900 ECU_ADDRESS 0xB0550 BIT_MASK 0xFF /end MEASUREMENT
/begin MEASUREMENT OGROOFIN "Offset zur Obergrenzberechnung beim Rollen in der LFR" UBYTE UWKL10 0 0 0.000000 10.069900 ECU_ADDRESS 0xB054F BIT_MASK 0xFF /end MEASUREMENT
/begin MEASUREMENT PANTEIL "P-Anteil" UWORD DEZL 0 0 0.000000 65535.000000 ECU_ADDRESS 0xB0500 BIT_MASK 0xFFFF /end MEASUREMENT
/begin MEASUREMENT PHLSNH "normierte Heizleistung der Lambdasonde hinter Kat" UBYTE FKT0001 0 0 0.000000 2.560000 ECU_ADDRESS 0xB0695 BIT_MASK 0xFF /end MEASUREMENT
/begin MEASUREMENT PHLSNV "normierte Heizleistung der Lambdasonde vor Kat" UBYTE FKT0001 0 0 0.000000 2.560000 ECU_ADDRESS 0xB0694 BIT_MASK 0xFF /end MEASUREMENT
/begin MEASUREMENT REAC_C1_UM " Fehlerzaehler reac fuer inaktive SKA aus FU" UBYTE DEZ 0 0 0.000000 256.000000 ECU_ADDRESS 0xE039 BIT_MASK 0xFF /end MEASUREMENT
/begin MEASUREMENT REAC_C2_UM " Fehlerzaehler reac fuer aktive SKA aus FU" UBYTE DEZ 0 0 0.000000 256.000000 ECU_ADDRESS 0xE03A BIT_MASK 0xFF /end MEASUREMENT
/begin MEASUREMENT REDST "Zahl der Reduzierstufen" UBYTE DEZ 0 0 0.000000 256.000000 ECU_ADDRESS 0xB05BD BIT_MASK 0xFF /end MEASUREMENT
/begin MEASUREMENT RKR "KR- Referenz" UWORD SENSORW 0 0 0.000000 4.999920 ECU_ADDRESS 0xB03F0 BIT_MASK 0xFFFF /end MEASUREMENT
/begin MEASUREMENT RST_TV " Uebergabe-Byte fuer die Kennung zur" UBYTE DEZ 0 0 0.000000 256.000000 ECU_ADDRESS 0xB2235 BIT_MASK 0xFF /end MEASUREMENT
/begin MEASUREMENT SDTLW "Delta TLW-Wert (W-Speicher)" SBYTE TLQSL 0 0 -1397.880000 1397.840000 ECU_ADDRESS 0xB0486 BIT_MASK 0xFF /end MEASUREMENT
/begin MEASUREMENT SDWFK "'FMT:530'Delta WF Kurzzeit-Wert (K-Speicher)" SWORD TEQ_12LCPL 0 0 -1048.580000 1048.540000 ECU_ADDRESS 0xF8E6 BIT_MASK 0xFFFF /end MEASUREMENT
/begin MEASUREMENT SDWFL "'FMT:530'Delta WF Langzeit-Wert (L-Speicher)" SWORD TEQ_12LCPL 0 0 -1048.580000 1048.540000 ECU_ADDRESS 0xF8E4 BIT_MASK 0xFFFF /end MEASUREMENT
/begin MEASUREMENT SGNLAM1 " LR-Gemischvorzeichen Bank1" UBYTE DEZ 0 0 0.000000 256.000000 ECU_ADDRESS 0xB0334 BIT_MASK 0xFF /end MEASUREMENT
/begin MEASUREMENT SGNLAM2 " LR-Gemischvorzeichen Bank2" UBYTE DEZ 0 0 0.000000 256.000000 ECU_ADDRESS 0xB0335 BIT_MASK 0xFF /end MEASUREMENT
/begin MEASUREMENT SGSC_C_UM " DA Entprellzaehler in SGS" UBYTE DEZ 0 0 0.000000 256.000000 ECU_ADDRESS 0xE07F BIT_MASK 0xFF /end MEASUREMENT
/begin MEASUREMENT SGSNU_C_UM " DA Entprellzaehler in SGS" UBYTE DEZ 0 0 0.000000 256.000000 ECU_ADDRESS 0xE080 BIT_MASK 0xFF /end MEASUREMENT
/begin MEASUREMENT SIGNALZEIT " Dauer der Tastenbetaetigung" UBYTE TQ20 0 0 0.000000 5.100000 ECU_ADDRESS 0xB04D6 BIT_MASK 0xFF /end MEASUREMENT
/begin MEASUREMENT SP1MAX_C "Fehlerz.: SP1S > SPSMAX [10ms/Step]" UBYTE DEZ 0 0 0.000000 256.000000 ECU_ADDRESS 0xB06AC BIT_MASK 0xFF /end MEASUREMENT
/begin MEASUREMENT SP1MIN_C "Fehlerz.: SP1S < SPSMIN [10ms/Step]" UBYTE DEZ 0 0 0.000000 256.000000 ECU_ADDRESS 0xB06AE BIT_MASK 0xFF /end MEASUREMENT
/begin MEASUREMENT SP1P_A_UM " Sollwertpoti UM alter Wert" UBYTE DEZ 0 0 0.000000 256.000000 ECU_ADDRESS 0xE044 BIT_MASK 0xFF /end MEASUREMENT
/begin MEASUREMENT SP1P_ST_UM " Stationaerzaehler fuer SP1p_r" UBYTE DEZ 0 0 0.000000 256.000000 ECU_ADDRESS 0xE046 BIT_MASK 0xFF /end MEASUREMENT
/begin MEASUREMENT SP1S "Sollw.-Poti-Schleifer 1 (10 Bit rechtsbuendig)" UWORD DEZL 0 0 0.000000 65535.000000 ECU_ADDRESS 0xB024A BIT_MASK 0xFFFF /end MEASUREMENT
/begin MEASUREMENT SP1S_A_UM " Sollwertpoti 1 alter Wert" UBYTE DEZ 0 0 0.000000 256.000000 ECU_ADDRESS 0xE043 BIT_MASK 0xFF /end MEASUREMENT
/begin MEASUREMENT SP1S_ST_UM " Stationaerzaehler fuer SP1s_r" UBYTE DEZ 0 0 0.000000 256.000000 ECU_ADDRESS 0xE045 BIT_MASK 0xFF /end MEASUREMENT
/begin MEASUREMENT SP1S_UM " Sollwertpoti 1" UBYTE PER255 0 0 0.000000 100.000000 ECU_ADDRESS 0xE003 BIT_MASK 0xFF /end MEASUREMENT
/begin MEASUREMENT SP2MAX_C "Fehlerz.: SP2S > SPSMAX [10ms/Step]" UBYTE DEZ 0 0 0.000000 256.000000 ECU_ADDRESS 0xB06AD BIT_MASK 0xFF /end MEASUREMENT
/begin MEASUREMENT SP2MIN_C "Fehlerz.: SP2S < SPSMIN [10ms/Step]" UBYTE DEZ 0 0 0.000000 256.000000 ECU_ADDRESS 0xB06AF BIT_MASK 0xFF /end MEASUREMENT
/begin MEASUREMENT SP2S "Sollw.-Poti-Schleifer 2 (10 Bit rechtsbuendig)" UWORD DEZL 0 0 0.000000 65535.000000 ECU_ADDRESS 0xB024C BIT_MASK 0xFFFF /end MEASUREMENT
/begin MEASUREMENT SP2S_UM " Sollwertpoti 2" UBYTE PER255 0 0 0.000000 100.000000 ECU_ADDRESS 0xE004 BIT_MASK 0xFF /end MEASUREMENT
/begin MEASUREMENT SPS "Sollwert-Poti-Schleifer (10 Bit rechtsbuendig)" UBYTE DEZL 0 0 0.000000 65535.000000 ECU_ADDRESS 0xB04BC BIT_MASK 0xFF /end MEASUREMENT
/begin MEASUREMENT SPSC_C_UM " Fehlerzaehler SP1S-SP2S unplausibel" UBYTE DEZ 0 0 0.000000 256.000000 ECU_ADDRESS 0xE00F BIT_MASK 0xFF /end MEASUREMENT
/begin MEASUREMENT SPSNFGR_UM " zulaessiger Pedalwert aus FGR" UBYTE DEZ 0 0 0.000000 256.000000 ECU_ADDRESS 0xE04A BIT_MASK 0xFF /end MEASUREMENT
/begin MEASUREMENT SPSN_FGR " Sollwertvorgabe FGR auf Pedalwertbasis" UBYTE DEZ 0 0 0.000000 256.000000 ECU_ADDRESS 0xB0559 BIT_MASK 0xFF /end MEASUREMENT
/begin MEASUREMENT STGADI "Adaptionsintegrator" UWORD UDKL 0 0 0.000000 10.112000 ECU_ADDRESS 0xB051E BIT_MASK 0xFFFF /end MEASUREMENT
/begin MEASUREMENT STGMW "Stellgroessen-Momentanwert" UWORD UDKL 0 0 0.000000 10.112000 ECU_ADDRESS 0xB0506 BIT_MASK 0xFFFF /end MEASUREMENT
/begin MEASUREMENT SW_NACHL "Sollwert nach Pedalkenlinie drehzahlbegrenzt" UWORD PER0327 0 0 0.000000 100.000000 ECU_ADDRESS 0xB063E BIT_MASK 0xFFFF /end MEASUREMENT
/begin MEASUREMENT SW_TEMP "Tempomat-Sollwert (15 Bit rechtsbuendig)" UWORD PER0327 0 0 0.000000 100.000000 ECU_ADDRESS 0xB04CE BIT_MASK 0xFFFF /end MEASUREMENT
/begin MEASUREMENT SW_VMAX "Sollwert Vmax-Begrenzung" UWORD PER0327 0 0 0.000000 100.000000 ECU_ADDRESS 0xB0646 BIT_MASK 0xFFFF /end MEASUREMENT
/begin MEASUREMENT TANSLIN "Linearisierte Lufttemp." UBYTE UTMP_40 0 0 -40.000000 216.000000 ECU_ADDRESS 0xB0297 BIT_MASK 0xFF /end MEASUREMENT
/begin MEASUREMENT TASTE_ALT " FGR-Taste alt" UBYTE DEZ 0 0 0.000000 256.000000 ECU_ADDRESS 0xB04D3 BIT_MASK 0xFF /end MEASUREMENT
/begin MEASUREMENT TASTE_NEU " FGR-Taste neu" UBYTE DEZ 0 0 0.000000 256.000000 ECU_ADDRESS 0xB04D2 BIT_MASK 0xFF /end MEASUREMENT
/begin MEASUREMENT TATEI "internes Tastverhaeltnis" UBYTE PCENT 0 0 0.000000 99.609400 ECU_ADDRESS 0xB071F BIT_MASK 0xFF /end MEASUREMENT
/begin MEASUREMENT TC6KATC " Tester: Test Limit Type und Component ID" UBYTE DEZ 0 0 0.000000 256.000000 ECU_ADDRESS 0xB218F BIT_MASK 0xFF /end MEASUREMENT
/begin MEASUREMENT TC6KATC2 " Tester: Test Limit Type und Component ID" UBYTE DEZ 0 0 0.000000 256.000000 ECU_ADDRESS 0xB2190 BIT_MASK 0xFF /end MEASUREMENT
/begin MEASUREMENT TC6KATS " Tester: ... zugehoerige Diagnoseschwelle" UBYTE DEZ 0 0 0.000000 256.000000 ECU_ADDRESS 0xB2193 BIT_MASK 0xFF /end MEASUREMENT
/begin MEASUREMENT TC6KATS2 " Tester: ... zugehoerige Diagnoseschwelle" UBYTE DEZ 0 0 0.000000 256.000000 ECU_ADDRESS 0xB2194 BIT_MASK 0xFF /end MEASUREMENT
/begin MEASUREMENT TC6KATW " Tester: aktuell bereitgestellter Messwert..." UBYTE DEZ 0 0 0.000000 256.000000 ECU_ADDRESS 0xB2191 BIT_MASK 0xFF /end MEASUREMENT
/begin MEASUREMENT TC6KATW2 " Tester: aktuell bereitgestellter Messwert..." UBYTE DEZ 0 0 0.000000 256.000000 ECU_ADDRESS 0xB2192 BIT_MASK 0xFF /end MEASUREMENT
/begin MEASUREMENT TEPHC "Zaehler fueR GA/TE-Phase" UWORD TQ100L 0 0 0.000000 6553.500000 ECU_ADDRESS 0xB070A BIT_MASK 0xFFFF /end MEASUREMENT
/begin MEASUREMENT TEUKG "'FMT:530'Gesamtwert Uebergangskompensation" SWORD TEQ_CPL 0 0 -87.381300 87.378700 ECU_ADDRESS 0xF8E8 BIT_MASK 0xFFFF /end MEASUREMENT
/begin MEASUREMENT TEUKK "'FMT:530'K-Speicheranteil Uebergangskompensation" SWORD TEQ_12LCPL 0 0 -1048.580000 1048.540000 ECU_ADDRESS 0xB047C BIT_MASK 0xFFFF /end MEASUREMENT
/begin MEASUREMENT TEUKL "'FMT:530'L-Speicheranteil Uebergangskompensation" SWORD TEQ_12LCPL 0 0 -1048.580000 1048.540000 ECU_ADDRESS 0xB047E BIT_MASK 0xFFFF /end MEASUREMENT
/begin MEASUREMENT TEUKWM "'FMT:530'Drosselklappenanteil Uebergangskompensation" SWORD TEQ_CPL 0 0 -87.381300 87.378700 ECU_ADDRESS 0xF8EA BIT_MASK 0xFFFF /end MEASUREMENT
/begin MEASUREMENT TEVPER " Periodendauer" UWORD TTEVQL2 0 0 0.000000 174.760000 ECU_ADDRESS 0xB0718 BIT_MASK 0xFFFF /end MEASUREMENT
/begin MEASUREMENT TFETTIF " Fettzeit Slave waehrend Fettper.Master, intern im Slave-Zustaut." UWORD TQ10L 0 0 0.000000 655.350000 ECU_ADDRESS 0xB034C BIT_MASK 0xFFFF /end MEASUREMENT
/begin MEASUREMENT TFETTIM " Fettzeit Slave waehrend Magerper.Master, intern im Slave-Zustaut." UWORD TQ10L 0 0 0.000000 655.350000 ECU_ADDRESS 0xB034E BIT_MASK 0xFFFF /end MEASUREMENT
/begin MEASUREMENT TFETTIMA " Fettzeit Master-Bank, intern im Master-Zustandsautomat" UWORD TQ10L 0 0 0.000000 655.350000 ECU_ADDRESS 0xB0340 BIT_MASK 0xFFFF /end MEASUREMENT
/begin MEASUREMENT TFETTMA " Fettzeit Master-Bank" UWORD TQ10L 0 0 0.000000 655.350000 ECU_ADDRESS 0xB0342 BIT_MASK 0xFFFF /end MEASUREMENT
/begin MEASUREMENT TFETTSL " Fettzeit Slave-Bank" UWORD TQ10L 0 0 0.000000 655.350000 ECU_ADDRESS 0xB0350 BIT_MASK 0xFFFF /end MEASUREMENT
/begin MEASUREMENT TFRN1_W " Zeit FR negativ" UWORD TQ10L 0 0 0.000000 655.350000 ECU_ADDRESS 0xB0364 BIT_MASK 0xFFFF /end MEASUREMENT
/begin MEASUREMENT TFRN2_W " Zeit FR negativ" UWORD TQ10L 0 0 0.000000 655.350000 ECU_ADDRESS 0xB036C BIT_MASK 0xFFFF /end MEASUREMENT
/begin MEASUREMENT TFRP1_W " Zeit FR positiv" UWORD TQ10L 0 0 0.000000 655.350000 ECU_ADDRESS 0xB0366 BIT_MASK 0xFFFF /end MEASUREMENT
/begin MEASUREMENT TFRP2_W " Zeit FR positiv" UWORD TQ10L 0 0 0.000000 655.350000 ECU_ADDRESS 0xB036E BIT_MASK 0xFFFF /end MEASUREMENT
/begin MEASUREMENT THHAIST "Auszeit fuer Sondenheizung hinter Kat" UBYTE TQ10 0 0 0.000000 2.550000 ECU_ADDRESS 0xB068F BIT_MASK 0xFF /end MEASUREMENT
/begin MEASUREMENT THHAT "unkorrigierte Ausschaltzeit Sondenheizung hinter Kat" UBYTE TQ10 0 0 0.000000 2.550000 ECU_ADDRESS 0xB068D BIT_MASK 0xFF /end MEASUREMENT
/begin MEASUREMENT THVAIST "Auszeit fuer Sondenheizung vor Kat" UBYTE TQ10 0 0 0.000000 2.550000 ECU_ADDRESS 0xB068E BIT_MASK 0xFF /end MEASUREMENT
/begin MEASUREMENT THVAT "unkorrigierte Ausschaltzeit Sondenheizung vor Kat" UBYTE TQ10 0 0 0.000000 2.550000 ECU_ADDRESS 0xB068C BIT_MASK 0xFF /end MEASUREMENT
/begin MEASUREMENT TLFSAR " Abstellzeit" UBYTE TQ1000 0 0 0.000000 255.000000 ECU_ADDRESS 0xB2136 BIT_MASK 0xFF /end MEASUREMENT
/begin MEASUREMENT TLREGAW "TL-Reglerausgangswert" UWORD UDKL 0 0 0.000000 10.112000 ECU_ADDRESS 0xB052E BIT_MASK 0xFFFF /end MEASUREMENT
/begin MEASUREMENT TLW "Nebenlastsignal Q=32*2.666us" UBYTE TEQ_32 0 0 0.000000 21.760000 ECU_ADDRESS 0xF72E BIT_MASK 0xFF /end MEASUREMENT
/begin MEASUREMENT TL_ "TL (=LAST) gefiltert" UWORD TEQL 0 0 0.000000 174.760000 ECU_ADDRESS 0xF95A BIT_MASK 0xFFFF /end MEASUREMENT
/begin MEASUREMENT TMABS_W "Abstelltemperatur" UWORD TMP_10B 0 0 -41.000000 140.000000 ECU_ADDRESS 0xB2132 BIT_MASK 0xFFFF /end MEASUREMENT
/begin MEASUREMENT TMAGERMA " Magerzeit Master-Bank" UWORD TQ10L 0 0 0.000000 655.350000 ECU_ADDRESS 0xB0346 BIT_MASK 0xFFFF /end MEASUREMENT
/begin MEASUREMENT TMAGERSL " Magerzeit Slave-Bank" UWORD TQ10L 0 0 0.000000 655.350000 ECU_ADDRESS 0xB0356 BIT_MASK 0xFFFF /end MEASUREMENT
/begin MEASUREMENT TMAGRIF " Magerzeit Slave waehrend Fettper.Master, intern im Slave-Zustaut." UWORD TQ10L 0 0 0.000000 655.350000 ECU_ADDRESS 0xB0352 BIT_MASK 0xFFFF /end MEASUREMENT
/begin MEASUREMENT TMAGRIM " Magerzeit Slave waehrend Magerper.Master, intern im Slave-Zustaut." UWORD TQ10L 0 0 0.000000 655.350000 ECU_ADDRESS 0xB0354 BIT_MASK 0xFFFF /end MEASUREMENT
/begin MEASUREMENT TMAGRIMA " Magerzeit Master-Bank, intern im Master-Zustandsautomat" UWORD TQ10L 0 0 0.000000 655.350000 ECU_ADDRESS 0xB0344 BIT_MASK 0xFFFF /end MEASUREMENT
/begin MEASUREMENT TMOTLIN "Linearisierte Motortemp." UBYTE UTMP_40 0 0 -40.000000 216.000000 ECU_ADDRESS 0xB0296 BIT_MASK 0xFF /end MEASUREMENT
/begin MEASUREMENT TMOT_W " 10-Bit TMOT gefiltert(=Basis fuer 8-Bit TMOT)" UWORD TMP_10B 0 0 -41.000000 140.000000 ECU_ADDRESS 0xA04 BIT_MASK 0xFFFF /end MEASUREMENT
/begin MEASUREMENT TMSTLIN "Linearisierte Motortemp. bei Startende" UBYTE UTMP_40 0 0 -40.000000 216.000000 ECU_ADDRESS 0xB0298 BIT_MASK 0xFF /end MEASUREMENT
/begin MEASUREMENT TNSUBAT " TN aus Ladebilanzregelung LLRUB" UBYTE UTNQ 0 0 352.941000 90000.000000 ECU_ADDRESS 0xB0F97 BIT_MASK 0xFF /end MEASUREMENT
/begin MEASUREMENT TRADTV_B1 "'FMT:530' Add. LRA-Korrekturfaktor Bank1" SWORD TEQ_CPL 0 0 -87.381300 87.378700 ECU_ADDRESS 0xB2030 BIT_MASK 0xFFFF /end MEASUREMENT
/begin MEASUREMENT TRADTV_B2 "'FMT:530' Add. LRA-Korrekturfaktor Bank2" SWORD TEQ_CPL 0 0 -87.381300 87.378700 ECU_ADDRESS 0xB2032 BIT_MASK 0xFFFF /end MEASUREMENT
/begin MEASUREMENT TRA_B1 "'fmt:530' LRA-Integrator Bank1 addit. Korr.-Faktor" SWORD TEQ_CPL 0 0 -87.381300 87.378700 ECU_ADDRESS 0xB2022 BIT_MASK 0xFFFF /end MEASUREMENT
/begin MEASUREMENT TRA_B2 "'fmt:530' LRA-Integrator Bank2 addit. Korr.-Faktor" SWORD TEQ_CPL 0 0 -87.381300 87.378700 ECU_ADDRESS 0xB2026 BIT_MASK 0xFFFF /end MEASUREMENT
/begin MEASUREMENT TSAKA "Schubdauer-Auszaehlung feur LRKA TQ100" UBYTE TQ100 0 0 0.000000 25.500000 ECU_ADDRESS 0xB0C61 BIT_MASK 0xFF /end MEASUREMENT
/begin MEASUREMENT TSPERRML "aus KL TSPERN interpolierte Sperrzeit" UBYTE TQ10 0 0 0.000000 2.550000 ECU_ADDRESS 0xB0378 BIT_MASK 0xFF /end MEASUREMENT
/begin MEASUREMENT TSTFLT_C " Fehlerzaehler Doppeltastenbetaetigung" UBYTE TQ20 0 0 0.000000 5.100000 ECU_ADDRESS 0xB04D1 BIT_MASK 0xFF /end MEASUREMENT
/begin MEASUREMENT TVFMS1 "LR-TV-Summe Bank1 nach Fettmager-Sprung" UBYTE TQ10 0 0 0.000000 2.550000 ECU_ADDRESS 0xB0330 BIT_MASK 0xFF /end MEASUREMENT
/begin MEASUREMENT TVFMS2 "LR-TV-Summe Bank2 nach Fettmager-Sprung" UBYTE TQ10 0 0 0.000000 2.550000 ECU_ADDRESS 0xB0331 BIT_MASK 0xFF /end MEASUREMENT
/begin MEASUREMENT TVLRH1 "signed LR-TV-Zeit hKat Banc 1" SWORD TQ10MSSL 0 0 -327.680000 327.670000 ECU_ADDRESS 0xB038E BIT_MASK 0xFFFF /end MEASUREMENT
/begin MEASUREMENT TVLRH2 "signed LR-TV-Zeit hKat Banc 2" SWORD TQ10MSSL 0 0 -327.680000 327.670000 ECU_ADDRESS 0xB0390 BIT_MASK 0xFFFF /end MEASUREMENT
/begin MEASUREMENT TVLRHI1 " tv I-Anteil, Bank1" SWORD TQ10MSSL 0 0 -327.680000 327.670000 ECU_ADDRESS 0xB03B2 BIT_MASK 0xFFFF /end MEASUREMENT
/begin MEASUREMENT TVLRHI2 " tv I-Anteil, Bank2" SWORD TQ10MSSL 0 0 -327.680000 327.670000 ECU_ADDRESS 0xB03B4 BIT_MASK 0xFFFF /end MEASUREMENT
/begin MEASUREMENT TVLRHP1 "LRHK-TV-P-Summe Bank1" SBYTE TQ10MSS 0 0 -1.280000 1.270000 ECU_ADDRESS 0xB03AF BIT_MASK 0xFF /end MEASUREMENT
/begin MEASUREMENT TVLRHP2 "LRHK-TV-P-Summe Bank2" SBYTE TQ10MSS 0 0 -1.280000 1.270000 ECU_ADDRESS 0xB03B0 BIT_MASK 0xFF /end MEASUREMENT
/begin MEASUREMENT TVMFS1 "LR-TV-Summe Bank1 nach Magerfett-Sprung" UBYTE TQ10 0 0 0.000000 2.550000 ECU_ADDRESS 0xB0332 BIT_MASK 0xFF /end MEASUREMENT
/begin MEASUREMENT TVMFS2 "LR-TV-Summe Bank2 nach Magerfett-Sprung" UBYTE TQ10 0 0 0.000000 2.550000 ECU_ADDRESS 0xB0333 BIT_MASK 0xFF /end MEASUREMENT
/begin MEASUREMENT TVMLF " Tastverhältnisausgabe für Motorlüfter" UBYTE PCENT 0 0 0.000000 99.609400 ECU_ADDRESS 0xB2143 BIT_MASK 0xFF /end MEASUREMENT
/begin MEASUREMENT TVTIME1 "LR-TV-Zeitzaehler Bank1" UBYTE TQ10 0 0 0.000000 2.550000 ECU_ADDRESS 0xB032E BIT_MASK 0xFF /end MEASUREMENT
/begin MEASUREMENT TVTIME2 "LR-TV-Zeitzaehler Bank2" UBYTE TQ10 0 0 0.000000 2.550000 ECU_ADDRESS 0xB032F BIT_MASK 0xFF /end MEASUREMENT
/begin MEASUREMENT UBF " gefiltertes Ubatt fuer Ladebilanzregelung" UBYTE UBQ 0 0 0.000000 24.119600 ECU_ADDRESS 0xB0F92 BIT_MASK 0xFF /end MEASUREMENT
/begin MEASUREMENT UBGR "Untergrenze (LFR4)" UWORD UDKL 0 0 0.000000 10.112000 ECU_ADDRESS 0xB050A BIT_MASK 0xFFFF /end MEASUREMENT
/begin MEASUREMENT UEBVER "Uebersetzungsverhaeltnis (Gang)" UBYTE FKT51 0 0 0.000000 4.980470 ECU_ADDRESS 0xB0C5B BIT_MASK 0xFF /end MEASUREMENT
/begin MEASUREMENT UG_DANT "Untergrenzen-D-Anteil (LFR4)" UWORD UDKL 0 0 0.000000 10.112000 ECU_ADDRESS 0xB0534 BIT_MASK 0xFFFF /end MEASUREMENT
/begin MEASUREMENT UPSAUG "ADC-Zw: Saugrohrdruck" UBYTE PAB 0 0 -37.539100 1337.420000 ECU_ADDRESS 0xB0326 BIT_MASK 0xFF /end MEASUREMENT
/begin MEASUREMENT USHK "Hinterkat-Lambdasonde 1" UBYTE ULSQ 0 0 0.000000 5.000000 ECU_ADDRESS 0xB0245 BIT_MASK 0xFF /end MEASUREMENT
/begin MEASUREMENT USHK1 "Hinterkat-Lambdasonde 1" UBYTE ULSQ 0 0 0.000000 5.000000 ECU_ADDRESS 0xB0245 BIT_MASK 0xFF /end MEASUREMENT
/begin MEASUREMENT USHK1W "Hinterkat-Lambdasonde1" UWORD ULSQL 0 0 0.000000 5.000000 ECU_ADDRESS 0xB0244 BIT_MASK 0xFFFF /end MEASUREMENT
/begin MEASUREMENT USHK2 "Hinterkat-Lambdasonde 2" UBYTE ULSQ 0 0 0.000000 5.000000 ECU_ADDRESS 0xB0247 BIT_MASK 0xFF /end MEASUREMENT
/begin MEASUREMENT USHK2W "Hinterkat-Lambdasonde2" UWORD ULSQL 0 0 0.000000 5.000000 ECU_ADDRESS 0xB0246 BIT_MASK 0xFFFF /end MEASUREMENT
/begin MEASUREMENT USHKB1 " Spannung Lambdasonde hinter Kat, Bank1" UBYTE U0V_1V25 0 0 0.000000 1.245120 ECU_ADDRESS 0xB03C1 BIT_MASK 0xFF /end MEASUREMENT
/begin MEASUREMENT USRHK " aktuelle Regelschwelle Lambdasignal hinter Kat" UBYTE U0V_1V25 0 0 0.000000 1.245120 ECU_ADDRESS 0xB03C3 BIT_MASK 0xFF /end MEASUREMENT
/begin MEASUREMENT USVK "Vorkat-Lambdasonde 1" UBYTE ULSQ 0 0 0.000000 5.000000 ECU_ADDRESS 0xB0241 BIT_MASK 0xFF /end MEASUREMENT
/begin MEASUREMENT USVK1 "Vorkat-Lambdasonde 1" UBYTE ULSQ 0 0 0.000000 5.000000 ECU_ADDRESS 0xB0241 BIT_MASK 0xFF /end MEASUREMENT
/begin MEASUREMENT USVK2 "Vorkat-Lambdasonde 2" UBYTE ULSQ 0 0 0.000000 5.000000 ECU_ADDRESS 0xB0243 BIT_MASK 0xFF /end MEASUREMENT
/begin MEASUREMENT UTANS " ADC-Zw: 10-Bit-Ansauglufttemp." UWORD TMP_10B 0 0 -41.000000 140.000000 ECU_ADDRESS 0xB032A BIT_MASK 0xFFFF /end MEASUREMENT
/begin MEASUREMENT UTMOT " ADC-Zw: 10-Bit-Motortemperatur" UWORD TMP_10B 0 0 -41.000000 140.000000 ECU_ADDRESS 0xB0328 BIT_MASK 0xFFFF /end MEASUREMENT
/begin MEASUREMENT UUBATT "ADC-Zw: Batteriespannung" UBYTE UBQ 0 0 0.000000 24.119600 ECU_ADDRESS 0xB0327 BIT_MASK 0xFF /end MEASUREMENT
/begin MEASUREMENT VFZG_W "gefilterte Geschwindigkeit" UWORD VQV16L 0 0 0.000000 4095.940000 ECU_ADDRESS 0xB027A BIT_MASK 0xFFFF /end MEASUREMENT
/begin MEASUREMENT VIRKR " Verhaeltnis Integrator / Referenzpegel KR" UWORD FKT32L 0 0 0.000000 2047.970000 ECU_ADDRESS 0xB06DE BIT_MASK 0xFFFF /end MEASUREMENT
/begin MEASUREMENT VKR "KR-Verstaerkung [0,1..6] 2,4...128fach]" UBYTE DEZ 0 0 0.000000 256.000000 ECU_ADDRESS 0xB0422 BIT_MASK 0xFF /end MEASUREMENT
/begin MEASUREMENT VREGO "Volumenstrom durch TEV" UBYTE MLQ010 0 0 0.000000 25.500000 ECU_ADDRESS 0xB071A BIT_MASK 0xFF /end MEASUREMENT
/begin MEASUREMENT V_OFF " Offset auf Vregler" UWORD VQV16L 0 0 0.000000 4095.940000 ECU_ADDRESS 0xB04EA BIT_MASK 0xFFFF /end MEASUREMENT
/begin MEASUREMENT V_REGLER " FGR Reglergeschwindigkeit" UWORD VQV16L 0 0 0.000000 4095.940000 ECU_ADDRESS 0xB04E2 BIT_MASK 0xFFFF /end MEASUREMENT
/begin MEASUREMENT V_REGLER_1 " FGR:v_regler + v_off" UWORD VQV16L 0 0 0.000000 4095.940000 ECU_ADDRESS 0xB04E0 BIT_MASK 0xFFFF /end MEASUREMENT
/begin MEASUREMENT V_SOLL " FGR Sollgeschwindigkeit" UWORD VQV16L 0 0 0.000000 4095.940000 ECU_ADDRESS 0xB04DE BIT_MASK 0xFFFF /end MEASUREMENT
/begin MEASUREMENT WARDY "Spaetwinkel aus dynamischer Antiruckelfkt." UBYTE ZWQ 0 0 0.000000 191.250000 ECU_ADDRESS 0xF735 BIT_MASK 0xFF /end MEASUREMENT
/begin MEASUREMENT WA_RAMPE " Steuerbyte fuer WA-Rampen" UBYTE DEZ 0 0 0.000000 256.000000 ECU_ADDRESS 0xB04D9 BIT_MASK 0xFF /end MEASUREMENT
/begin MEASUREMENT WBER "Berechneter Winkel vor Doppelzuendung" UBYTE ZWOF 0 0 -78.000000 24.000000 ECU_ADDRESS 0xF781 BIT_MASK 0xFF /end MEASUREMENT
/begin MEASUREMENT WBERKRM "Wie WBER mit mittleren KR-Anteil" UBYTE ZWOF 0 0 -78.000000 24.000000 ECU_ADDRESS 0xFA3B BIT_MASK 0xFF /end MEASUREMENT
/begin MEASUREMENT WCALC "Zuendwinkel vor AEnderungsbegrenzung" UBYTE ZWOF 0 0 -78.000000 24.000000 ECU_ADDRESS 0xF77D BIT_MASK 0xFF /end MEASUREMENT
/begin MEASUREMENT WDKBA "Winkel Drosselklappe bezogen auf DK-Anschlag" UBYTE UWDK 0 0 0.000000 80.599900 ECU_ADDRESS 0xF72F BIT_MASK 0xFF /end MEASUREMENT
/begin MEASUREMENT WGS "Zuendwinkel Getriebeschutz-Eingriff" UBYTE ZWQ 0 0 0.000000 191.250000 ECU_ADDRESS 0xF737 BIT_MASK 0xFF /end MEASUREMENT
/begin MEASUREMENT WKFZW " Interpolationsergebnis in WSTA.A66 (%STAT_W)" UBYTE ZWOF 0 0 -78.000000 24.000000 ECU_ADDRESS 0xB0680 BIT_MASK 0xFF /end MEASUREMENT
/begin MEASUREMENT WKR "KR-Spaetverstellung" UBYTE ZWQ 0 0 0.000000 191.250000 ECU_ADDRESS 0xB0432 BIT_MASK 0xFF /end MEASUREMENT
/begin MEASUREMENT WKR0 "Zuendwinkel aus Klopfregelung Zyl. 1" UBYTE ZWQ 0 0 0.000000 191.250000 ECU_ADDRESS 0xB0432 BIT_MASK 0xFF /end MEASUREMENT
/begin MEASUREMENT WKR1 "Zuendwinkel aus Klopfregelung Zyl. 2" UBYTE ZWQ 0 0 0.000000 191.250000 ECU_ADDRESS 0xB0433 BIT_MASK 0xFF /end MEASUREMENT
/begin MEASUREMENT WKR2 "Zuendwinkel aus Klopfregelung Zyl. 3" UBYTE ZWQ 0 0 0.000000 191.250000 ECU_ADDRESS 0xB0434 BIT_MASK 0xFF /end MEASUREMENT
/begin MEASUREMENT WKR3 "Zuendwinkel aus Klopfregelung Zyl. 4" UBYTE ZWQ 0 0 0.000000 191.250000 ECU_ADDRESS 0xB0435 BIT_MASK 0xFF /end MEASUREMENT
/begin MEASUREMENT WKR4 "Zuendwinkel aus Klopfregelung Zyl. 5" UBYTE ZWQ 0 0 0.000000 191.250000 ECU_ADDRESS 0xB0436 BIT_MASK 0xFF /end MEASUREMENT
/begin MEASUREMENT WKR5 "Zuendwinkel aus Klopfregelung Zyl. 6" UBYTE ZWQ 0 0 0.000000 191.250000 ECU_ADDRESS 0xB0437 BIT_MASK 0xFF /end MEASUREMENT
/begin MEASUREMENT WKRDY " Zuendwinkel-Dynamikvorhalt" UBYTE ZWQ 0 0 0.000000 191.250000 ECU_ADDRESS 0xB06E4 BIT_MASK 0xFF /end MEASUREMENT
/begin MEASUREMENT WKRDYA " Adaptiver Zuendwinkel-Dynamikvorhalt n<KRAN1" UBYTE ZWQ 0 0 0.000000 191.250000 ECU_ADDRESS 0xB2159 BIT_MASK 0xFF /end MEASUREMENT
/begin MEASUREMENT WKRM "Mittleres wkr ueber alle Zylinder" UBYTE ZWQ 0 0 0.000000 191.250000 ECU_ADDRESS 0xB029E BIT_MASK 0xFF /end MEASUREMENT
/begin MEASUREMENT WLLR "Zuendwinkel fuer LLR-Unterstuetzung" UBYTE ZWKOOF 0 0 -96.000000 96.000000 ECU_ADDRESS 0xB0288 BIT_MASK 0xFF /end MEASUREMENT
/begin MEASUREMENT WMDZ "Zuendwinkel aus ASR-Eingriff" UBYTE ZWQ 0 0 0.000000 191.250000 ECU_ADDRESS 0xB0C55 BIT_MASK 0xFF /end MEASUREMENT
/begin MEASUREMENT WNS "Zuendwinkel fuer Nachstart" UBYTE ZWQ 0 0 0.000000 191.250000 ECU_ADDRESS 0xF733 BIT_MASK 0xFF /end MEASUREMENT
/begin MEASUREMENT WOUT "auszugebender Zuendwinkel" UBYTE ZWOF 0 0 -78.000000 24.000000 ECU_ADDRESS 0xF739 BIT_MASK 0xFF /end MEASUREMENT
/begin MEASUREMENT WOUT_OP "auszugebender Zuendwinkel ohne Phasenkorrektur" UBYTE ZWOF 0 0 -78.000000 24.000000 ECU_ADDRESS 0xF738 BIT_MASK 0xFF /end MEASUREMENT
/begin MEASUREMENT WSTAT "Stationaer-/Grundzuendwinkel" UBYTE ZWOF 0 0 -78.000000 24.000000 ECU_ADDRESS 0xB0283 BIT_MASK 0xFF /end MEASUREMENT
/begin MEASUREMENT WTANS "Zuendwinkel fuer Ansaugluftkorrektur" UBYTE ZWQ 0 0 0.000000 191.250000 ECU_ADDRESS 0xB0286 BIT_MASK 0xFF /end MEASUREMENT
/begin MEASUREMENT WVS "Zuendwinkelverstellung" UBYTE ZWKOOFBG 0 0 -25.500000 25.500000 ECU_ADDRESS 0xB0287 BIT_MASK 0xFF /end MEASUREMENT
/begin MEASUREMENT WVS0 "ZW-Verstellung Zuendung 0" UBYTE ZWNEGBG 0 0 -25.500000 0.000000 ECU_ADDRESS 0xF741 BIT_MASK 0xFF /end MEASUREMENT
/begin MEASUREMENT WVS1 "ZW-Verstellung Zuendung 1" UBYTE ZWNEGBG 0 0 -25.500000 0.000000 ECU_ADDRESS 0xF742 BIT_MASK 0xFF /end MEASUREMENT
/begin MEASUREMENT WVS2 "ZW-Verstellung Zuendung 2" UBYTE ZWNEGBG 0 0 -25.500000 0.000000 ECU_ADDRESS 0xF743 BIT_MASK 0xFF /end MEASUREMENT
/begin MEASUREMENT WVS3 "ZW-Verstellung Zuendung 3" UBYTE ZWNEGBG 0 0 -25.500000 0.000000 ECU_ADDRESS 0xF744 BIT_MASK 0xFF /end MEASUREMENT
/begin MEASUREMENT WVS4 "ZW-Verstellung Zuendung 4" UBYTE ZWNEGBG 0 0 -25.500000 0.000000 ECU_ADDRESS 0xF745 BIT_MASK 0xFF /end MEASUREMENT
/begin MEASUREMENT WVS5 "ZW-Verstellung Zuendung 5" UBYTE ZWNEGBG 0 0 -25.500000 0.000000 ECU_ADDRESS 0xF746 BIT_MASK 0xFF /end MEASUREMENT
/begin MEASUREMENT WWL "Zuendwinkel Warmlauf" UBYTE ZWNEG 0 0 -72.000000 0.000000 ECU_ADDRESS 0xB0284 BIT_MASK 0xFF /end MEASUREMENT
/begin MEASUREMENT WZWB "AEnderungsbegrenzter Zuendwinkel" UBYTE ZWOF 0 0 -78.000000 24.000000 ECU_ADDRESS 0xF77F BIT_MASK 0xFF /end MEASUREMENT
/begin MEASUREMENT ZLDY " NW-Synchrone Zeitabregelung des Dynamikvorhaltes" UBYTE DEZ 0 0 0.000000 256.000000 ECU_ADDRESS 0xB06E6 BIT_MASK 0xFF /end MEASUREMENT
/begin MEASUREMENT ZZKH "Zuendungszaehler KAT-Heizung" UWORD DEZL 0 0 0.000000 65535.000000 ECU_ADDRESS 0xB029A BIT_MASK 0xFFFF /end MEASUREMENT
/begin MEASUREMENT B_AC " Ausloesung Drive-Recorder Messung " UWORD B_TRUE 0 0 0.000000 1.000000 ECU_ADDRESS 0xFD06 BIT_MASK 0x10 /end MEASUREMENT
/begin MEASUREMENT B_ADAPFG "1 = Adaptions-Freigabe" UWORD B_TRUE 0 0 0.000000 1.000000 ECU_ADDRESS 0xFD1E BIT_MASK 0x8 /end MEASUREMENT
/begin MEASUREMENT B_ASRAKT "1 = Motorsollmoment-Reduktion (ASR aktiv)" UWORD B_TRUE 0 0 0.000000 1.000000 ECU_ADDRESS 0xFD26 BIT_MASK 0x4 /end MEASUREMENT
/begin MEASUREMENT B_ATMTPA " Taupunkt ueberschritten vor Kat" UWORD B_TRUE 0 0 0.000000 1.000000 ECU_ADDRESS 0xFD50 BIT_MASK 0x10 /end MEASUREMENT
/begin MEASUREMENT B_ATMTPF " Bedingung Taupunkt vor Kat ueberschritten (last trip)" UWORD B_TRUE 0 0 0.000000 1.000000 ECU_ADDRESS 0xFDFA BIT_MASK 0x4 /end MEASUREMENT
/begin MEASUREMENT B_ATMTPK "Bedingung Taupunkt ueberschritten hinter Kat" UWORD B_TRUE 0 0 0.000000 1.000000 ECU_ADDRESS 0xFDFA BIT_MASK 0x1 /end MEASUREMENT
/begin MEASUREMENT B_ATMTPL " Bedingung Taupunktendezeit abgelaufen (last trip)" UWORD B_TRUE 0 0 0.000000 1.000000 ECU_ADDRESS 0xFDFA BIT_MASK 0x8 /end MEASUREMENT
/begin MEASUREMENT B_ATVINI1 " 1 = Integrator atv initialisieren, Bank1" UWORD B_TRUE 0 0 0.000000 1.000000 ECU_ADDRESS 0xFD30 BIT_MASK 0x200 /end MEASUREMENT
/begin MEASUREMENT B_AUS " 1 = Aus-Funktion (Tempomat)" UWORD B_TRUE 0 0 0.000000 1.000000 ECU_ADDRESS 0xFD0A BIT_MASK 0x40 /end MEASUREMENT
/begin MEASUREMENT B_BREMSE " 1 = Bremse betaetigt" UWORD B_TRUE 0 0 0.000000 1.000000 ECU_ADDRESS 0xFD0A BIT_MASK 0x80 /end MEASUREMENT
/begin MEASUREMENT B_CDAGR " Funktion ueber Codewort CDAGR freigegeben" UWORD B_TRUE 0 0 0.000000 1.000000 ECU_ADDRESS 0xB1000 BIT_MASK 0x8000 /end MEASUREMENT
/begin MEASUREMENT B_CDKAT " Funktion ueber Codewort CDKAT freigegeben" UWORD B_TRUE 0 0 0.000000 1.000000 ECU_ADDRESS 0xB1000 BIT_MASK 0x100 /end MEASUREMENT
/begin MEASUREMENT B_CDSLS " Funktion ueber Codewort CDSLS freigegeben" UWORD B_TRUE 0 0 0.000000 1.000000 ECU_ADDRESS 0xB1002 BIT_MASK 0x1 /end MEASUREMENT
/begin MEASUREMENT B_CDTES " Funktion ueber Codewort CDTES freigegeben" UWORD B_TRUE 0 0 0.000000 1.000000 ECU_ADDRESS 0xB1000 BIT_MASK 0x2000 /end MEASUREMENT
/begin MEASUREMENT B_DKNOT_FR " DK-Notfahren" UWORD B_TRUE 0 0 0.000000 1.000000 ECU_ADDRESS 0xFD6A BIT_MASK 0x100 /end MEASUREMENT
/begin MEASUREMENT B_DKTLP " '1' = Umschaltung LR_Parameter angefordert" UWORD B_TRUE 0 0 0.000000 1.000000 ECU_ADDRESS 0xFD46 BIT_MASK 0x1000 /end MEASUREMENT
/begin MEASUREMENT B_DLAHM1 "> 1 = Pseudo-Lambda hinter Kat > 1.0, Bank1" UWORD B_TRUE 0 0 0.000000 1.000000 ECU_ADDRESS 0xFD30 BIT_MASK 0x100 /end MEASUREMENT
/begin MEASUREMENT B_DR10V "1 = Drivewechsel-Verzoegerung" UWORD B_TRUE 0 0 0.000000 1.000000 ECU_ADDRESS 0xFD1C BIT_MASK 0x20 /end MEASUREMENT
/begin MEASUREMENT B_DRCHA "1 = Drivewechsel" UWORD B_TRUE 0 0 0.000000 1.000000 ECU_ADDRESS 0xFD1C BIT_MASK 0x40 /end MEASUREMENT
/begin MEASUREMENT B_DRSGA "1 = Drive-Stoergroessen-Aufschaltung" UWORD B_TRUE 0 0 0.000000 1.000000 ECU_ADDRESS 0xFD1C BIT_MASK 0x80 /end MEASUREMENT
/begin MEASUREMENT B_DRSTAT "1 = Drive-Zustand" UWORD B_TRUE 0 0 0.000000 1.000000 ECU_ADDRESS 0xFD1C BIT_MASK 0x10 /end MEASUREMENT
/begin MEASUREMENT B_DSLS " '1'= SLS-Diagnose aktiv" UWORD B_TRUE 0 0 0.000000 1.000000 ECU_ADDRESS 0xFD5A BIT_MASK 0x4 /end MEASUREMENT
/begin MEASUREMENT B_DTV1 "> 1 = DTV enable Bank1" UWORD B_TRUE 0 0 0.000000 1.000000 ECU_ADDRESS 0xFD44 BIT_MASK 0x40 /end MEASUREMENT
/begin MEASUREMENT B_DTV2 "> 1 = DTV enable Bank2" UWORD B_TRUE 0 0 0.000000 1.000000 ECU_ADDRESS 0xFD44 BIT_MASK 0x80 /end MEASUREMENT
/begin MEASUREMENT B_DZAAKT " 1 = DZA ist aktiv" UWORD B_TRUE 0 0 0.000000 1.000000 ECU_ADDRESS 0xFD20 BIT_MASK 0x4 /end MEASUREMENT
/begin MEASUREMENT B_EDKVS1 " 1 = Bed. Adaptionsfehlerschwellen an Bank 1 aktuell ueberschritten" UWORD B_TRUE 0 0 0.000000 1.000000 ECU_ADDRESS 0xFD44 BIT_MASK 0x100 /end MEASUREMENT
/begin MEASUREMENT B_EDKVS2 " 1 = Bed. Adaptionsfehlerschwellen an Bank 2 aktuell ueberschritten" UWORD B_TRUE 0 0 0.000000 1.000000 ECU_ADDRESS 0xFD44 BIT_MASK 0x200 /end MEASUREMENT
/begin MEASUREMENT B_EVLOC " Status alle lokalen Einspritzventile werden angesteuert" UWORD B_TRUE 0 0 0.000000 1.000000 ECU_ADDRESS 0xFD42 BIT_MASK 0x8000 /end MEASUREMENT
/begin MEASUREMENT B_FGRAB " '1'= FGR schaltet ab" UWORD B_TRUE 0 0 0.000000 1.000000 ECU_ADDRESS 0xFD7A BIT_MASK 0x40 /end MEASUREMENT
/begin MEASUREMENT B_FGRENF " '1'= FGR enable im Funktionsrechner" UWORD B_TRUE 0 0 0.000000 1.000000 ECU_ADDRESS 0xFD7A BIT_MASK 0x20 /end MEASUREMENT
/begin MEASUREMENT B_FGRLA "Zustand FGR Betriebslampe" UWORD B_TRUE 0 0 0.000000 1.000000 ECU_ADDRESS 0xFD66 BIT_MASK 0x100 /end MEASUREMENT
/begin MEASUREMENT B_FGR_2T "1=FGR Bedienh. 2 oder 3 Tasten betaetigt" UWORD B_TRUE 0 0 0.000000 1.000000 ECU_ADDRESS 0xFD6C BIT_MASK 0x1 /end MEASUREMENT
/begin MEASUREMENT B_FGR_PL " 1=FGR-Bedienhebelsignal unplausibel" UWORD B_TRUE 0 0 0.000000 1.000000 ECU_ADDRESS 0xFD6C BIT_MASK 0x2 /end MEASUREMENT
/begin MEASUREMENT B_FGR_UM " FGR Eingriff in der Fu erlaubt" UWORD DEZ 0 0 0.000000 256.000000 ECU_ADDRESS 0xFDAA BIT_MASK 0x8 /end MEASUREMENT
/begin MEASUREMENT B_FGR_VG " 1= Vollgas (fuer FGR)" UWORD B_TRUE 0 0 0.000000 1.000000 ECU_ADDRESS 0xFD6C BIT_MASK 0x100 /end MEASUREMENT
/begin MEASUREMENT B_FLL " 1 = fetter Leerlauf" UWORD B_TRUE 0 0 0.000000 1.000000 ECU_ADDRESS 0xFD06 BIT_MASK 0x40 /end MEASUREMENT
/begin MEASUREMENT B_FMS1 " Fett-Mager-Sprung Vorkat-Sonde1" UWORD B_TRUE 0 0 0.000000 1.000000 ECU_ADDRESS 0xFD2E BIT_MASK 0x1 /end MEASUREMENT
/begin MEASUREMENT B_FMS2 " Fett-Mager-Sprung Vorkat-Sonde2" UWORD B_TRUE 0 0 0.000000 1.000000 ECU_ADDRESS 0xFD2E BIT_MASK 0x8 /end MEASUREMENT
/begin MEASUREMENT B_FPAKT "1= Fahrpedal aktiv Vist > Vsol" UWORD B_TRUE 0 0 0.000000 1.000000 ECU_ADDRESS 0xFD6C BIT_MASK 0x800 /end MEASUREMENT
/begin MEASUREMENT B_FP_SP1S " 0 1 0" UWORD B_TRUE 0 0 0.000000 1.000000 ECU_ADDRESS 0xFD5E BIT_MASK 0x10 /end MEASUREMENT
/begin MEASUREMENT B_FP_SPSMI " 0 SP2S gueltig x SP1S gueltig 1 SPSMIN gueltig" UWORD B_TRUE 0 0 0.000000 1.000000 ECU_ADDRESS 0xFD5E BIT_MASK 0x20 /end MEASUREMENT
/begin MEASUREMENT B_FRA1 "> 1 = FRA-Integrator Banc1" UWORD B_TRUE 0 0 0.000000 1.000000 ECU_ADDRESS 0xFD44 BIT_MASK 0x4 /end MEASUREMENT
/begin MEASUREMENT B_FRA2 "> 1 = FRA-Integrator Banc2" UWORD B_TRUE 0 0 0.000000 1.000000 ECU_ADDRESS 0xFD44 BIT_MASK 0x8 /end MEASUREMENT
/begin MEASUREMENT B_FRAO1 " Ausloesung Drive-Recorder Messung " UBYTE B_TRUE 0 0 0.000000 1.000000 ECU_ADDRESS 0xB2034 BIT_MASK 0x4 /end MEASUREMENT
/begin MEASUREMENT B_FRAO2 " Ausloesung Drive-Recorder Messung " UBYTE B_TRUE 0 0 0.000000 1.000000 ECU_ADDRESS 0xB2034 BIT_MASK 0x8 /end MEASUREMENT
/begin MEASUREMENT B_FRAU1 " Ausloesung Drive-Recorder Messung " UBYTE B_TRUE 0 0 0.000000 1.000000 ECU_ADDRESS 0xB2034 BIT_MASK 0x1 /end MEASUREMENT
/begin MEASUREMENT B_FRAU2 " Ausloesung Drive-Recorder Messung " UBYTE B_TRUE 0 0 0.000000 1.000000 ECU_ADDRESS 0xB2034 BIT_MASK 0x2 /end MEASUREMENT
/begin MEASUREMENT B_FSAOFF " LFR Integ.offset auf I-Anteil beim Schalten nach P/N" UWORD B_TRUE 0 0 0.000000 1.000000 ECU_ADDRESS 0xFDDC BIT_MASK 0x2 /end MEASUREMENT
/begin MEASUREMENT B_FSEOFF " LFR Integ.offset auf I-Anteil beim Schalten nach Drive" UWORD B_TRUE 0 0 0.000000 1.000000 ECU_ADDRESS 0xFDDC BIT_MASK 0x1 /end MEASUREMENT
/begin MEASUREMENT B_GA "> 1 = Gemischadaptionsphase" UWORD B_TRUE 0 0 0.000000 1.000000 ECU_ADDRESS 0xFD0E BIT_MASK 0x4 /end MEASUREMENT
/begin MEASUREMENT B_GASP "> 1 = Gemischadaption gesperrt" UWORD B_TRUE 0 0 0.000000 1.000000 ECU_ADDRESS 0xFD0E BIT_MASK 0x2 /end MEASUREMENT
/begin MEASUREMENT B_GV "1 = Automat Variante" UWORD B_TRUE 0 0 0.000000 1.000000 ECU_ADDRESS 0xFD02 BIT_MASK 0x400 /end MEASUREMENT
/begin MEASUREMENT B_HG "1 = Handschalter Variante" UWORD B_TRUE 0 0 0.000000 1.000000 ECU_ADDRESS 0xFD0E BIT_MASK 0x10 /end MEASUREMENT
/begin MEASUREMENT B_HSHE " Sondenheizung hinten ein/aus" UWORD B_TRUE 0 0 0.000000 1.000000 ECU_ADDRESS 0xFD02 BIT_MASK 0x4 /end MEASUREMENT
/begin MEASUREMENT B_HSHMX " Bed. max. Leistung der Sondenheizung hinter Kat" UWORD B_TRUE 0 0 0.000000 1.000000 ECU_ADDRESS 0xFD50 BIT_MASK 0x2 /end MEASUREMENT
/begin MEASUREMENT B_HSVE " Sondenheizung vorn ein/aus" UWORD B_TRUE 0 0 0.000000 1.000000 ECU_ADDRESS 0xFD02 BIT_MASK 0x2 /end MEASUREMENT
/begin MEASUREMENT B_HSVMX " Bed. max. Leistung der Sondenheizung vor Kat" UWORD B_TRUE 0 0 0.000000 1.000000 ECU_ADDRESS 0xFD50 BIT_MASK 0x1 /end MEASUREMENT
/begin MEASUREMENT B_INIT " 1 = Init. noch nicht abgeschlossen" UWORD B_TRUE 0 0 0.000000 1.000000 ECU_ADDRESS 0xFD04 BIT_MASK 0x1 /end MEASUREMENT
/begin MEASUREMENT B_IP2SEL_F " '1'= IP2-Umschaltung vom FR" UWORD B_TRUE 0 0 0.000000 1.000000 ECU_ADDRESS 0xFD5E BIT_MASK 0x1000 /end MEASUREMENT
/begin MEASUREMENT B_IP3OK_FR " '1'= IP3-Ok vom FR" UWORD B_TRUE 0 0 0.000000 1.000000 ECU_ADDRESS 0xFD5E BIT_MASK 0x4000 /end MEASUREMENT
/begin MEASUREMENT B_IP3REQ_F " '1'= IP3-Entscheidung vom FR" UWORD B_TRUE 0 0 0.000000 1.000000 ECU_ADDRESS 0xFD5E BIT_MASK 0x2000 /end MEASUREMENT
/begin MEASUREMENT B_ISOPROT " 1= Reizung nach ISO 14230-4 WUP" UWORD B_TRUE 0 0 0.000000 1.000000 ECU_ADDRESS 0xFDD6 BIT_MASK 0x4000 /end MEASUREMENT
/begin MEASUREMENT B_I_SKA_FR "irrev. Sicherheitskraftstoffabschaltung vom FR" UWORD B_TRUE 0 0 0.000000 1.000000 ECU_ADDRESS 0xFD6A BIT_MASK 0x10 /end MEASUREMENT
/begin MEASUREMENT B_I_SKA_UM "irrev. Sicherheitskraftstoffabschaltung vom UM" UWORD B_TRUE 0 0 0.000000 1.000000 ECU_ADDRESS 0xFD6A BIT_MASK 0x20 /end MEASUREMENT
/begin MEASUREMENT B_KATWA "> 1= Kat brennt ab bank1" UWORD B_TRUE 0 0 0.000000 1.000000 ECU_ADDRESS 0xFDA8 BIT_MASK 0x100 /end MEASUREMENT
/begin MEASUREMENT B_KATWA2 "> 1= Kat brennt ab bank2" UWORD B_TRUE 0 0 0.000000 1.000000 ECU_ADDRESS 0xFDA8 BIT_MASK 0x200 /end MEASUREMENT
/begin MEASUREMENT B_KH " 1 = Katheizen aktiv" UWORD B_TRUE 0 0 0.000000 1.000000 ECU_ADDRESS 0xFD08 BIT_MASK 0x2 /end MEASUREMENT
/begin MEASUREMENT B_KL15 " 1 = Zuendung ein" UWORD B_TRUE 0 0 0.000000 1.000000 ECU_ADDRESS 0xFD02 BIT_MASK 0x20 /end MEASUREMENT
/begin MEASUREMENT B_KLDYNRM " 1 = Normales Klopfen während der Dynamik erkannt" UWORD B_TRUE 0 0 0.000000 1.000000 ECU_ADDRESS 0xFD98 BIT_MASK 0x10 /end MEASUREMENT
/begin MEASUREMENT B_KLDYSTK " 1 = Starkes Klopfen während der Dynamik erkannt" UWORD B_TRUE 0 0 0.000000 1.000000 ECU_ADDRESS 0xFD98 BIT_MASK 0x8 /end MEASUREMENT
/begin MEASUREMENT B_KLME " Allg. Klopfmeldung" UWORD B_TRUE 0 0 0.000000 1.000000 ECU_ADDRESS 0xFD60 BIT_MASK 0x20 /end MEASUREMENT
/begin MEASUREMENT B_KLOFVB "1=Klimaoffset Verbot" UWORD B_TRUE 0 0 0.000000 1.000000 ECU_ADDRESS 0xFD1E BIT_MASK 0x200 /end MEASUREMENT
/begin MEASUREMENT B_KOAX " 1 = Zwangseinschalten Klimakompressor" UWORD B_TRUE 0 0 0.000000 1.000000 ECU_ADDRESS 0xFD04 BIT_MASK 0x40 /end MEASUREMENT
/begin MEASUREMENT B_KOE " Request Kompressor Endstufe ein" UWORD B_TRUE 0 0 0.000000 1.000000 ECU_ADDRESS 0xFD66 BIT_MASK 0x200 /end MEASUREMENT
/begin MEASUREMENT B_KOS " 1 = Bedingung Klimakompressor ein" UWORD B_TRUE 0 0 0.000000 1.000000 ECU_ADDRESS 0xFD0A BIT_MASK 0x200 /end MEASUREMENT
/begin MEASUREMENT B_KR " KR 'ein'" UWORD B_TRUE 0 0 0.000000 1.000000 ECU_ADDRESS 0xFD06 BIT_MASK 0x800 /end MEASUREMENT
/begin MEASUREMENT B_KRA "> KRA 'ein'" UWORD B_TRUE 0 0 0.000000 1.000000 ECU_ADDRESS 0xFD60 BIT_MASK 0x100 /end MEASUREMENT
/begin MEASUREMENT B_KRLDY " 1 = Dynamische-KR aktiv" UWORD B_TRUE 0 0 0.000000 1.000000 ECU_ADDRESS 0xFD98 BIT_MASK 0x1 /end MEASUREMENT
/begin MEASUREMENT B_KRLDYA " 1 = Adaption der Dynamische-KR aktiv" UWORD B_TRUE 0 0 0.000000 1.000000 ECU_ADDRESS 0xFD98 BIT_MASK 0x2 /end MEASUREMENT
/begin MEASUREMENT B_KRNDY " 1 = Drehzahldynamik fuer KR aktiv" UWORD B_TRUE 0 0 0.000000 1.000000 ECU_ADDRESS 0xFD98 BIT_MASK 0x20 /end MEASUREMENT
/begin MEASUREMENT B_KRPAKT "1 = konstante Reglerparameter aktiv" UWORD B_TRUE 0 0 0.000000 1.000000 ECU_ADDRESS 0xFD1E BIT_MASK 0x8000 /end MEASUREMENT
/begin MEASUREMENT B_KS "Klopfsicherheitsverst. aktiv" UWORD B_TRUE 0 0 0.000000 1.000000 ECU_ADDRESS 0xFD60 BIT_MASK 0x8 /end MEASUREMENT
/begin MEASUREMENT B_KUP " 1 = Kupplungsschalter betaetigt (Handschalter)" UWORD B_TRUE 0 0 0.000000 1.000000 ECU_ADDRESS 0xFD1E BIT_MASK 0x800 /end MEASUREMENT
/begin MEASUREMENT B_KUPCHA "1 = Kupplungswechsel" UWORD B_TRUE 0 0 0.000000 1.000000 ECU_ADDRESS 0xFD1E BIT_MASK 0x1000 /end MEASUREMENT
/begin MEASUREMENT B_LAMPE "1=Ansteuerung der Armaturenbrettlampen" UWORD B_TRUE 0 0 0.000000 1.000000 ECU_ADDRESS 0xFD68 BIT_MASK 0x400 /end MEASUREMENT
/begin MEASUREMENT B_LL " 1 = Leerlauf" UWORD B_TRUE 0 0 0.000000 1.000000 ECU_ADDRESS 0xFD06 BIT_MASK 0x1 /end MEASUREMENT
/begin MEASUREMENT B_LL01V "1 = Lastwechsel-Verzoegerung" UWORD B_TRUE 0 0 0.000000 1.000000 ECU_ADDRESS 0xFD1C BIT_MASK 0x2000 /end MEASUREMENT
/begin MEASUREMENT B_LLEW " 1 = Zuendwinkeleingriff Leerlauf aktiv" UWORD B_TRUE 0 0 0.000000 1.000000 ECU_ADDRESS 0xFD12 BIT_MASK 0x1000 /end MEASUREMENT
/begin MEASUREMENT B_LLSTAT "1 = Leerlauf-Zustand" UWORD B_TRUE 0 0 0.000000 1.000000 ECU_ADDRESS 0xFD1C BIT_MASK 0x1000 /end MEASUREMENT
/begin MEASUREMENT B_LR " 1 = Lambdaregelung v.KAT B1 aktiv" UWORD B_TRUE 0 0 0.000000 1.000000 ECU_ADDRESS 0xFD06 BIT_MASK 0x4000 /end MEASUREMENT
/begin MEASUREMENT B_LR1 " 1 = Lambdaregelung v.KAT B1 aktiv" UWORD B_TRUE 0 0 0.000000 1.000000 ECU_ADDRESS 0xFD06 BIT_MASK 0x4000 /end MEASUREMENT
/begin MEASUREMENT B_LR2 " 1 = Lambdaregelung v.KAT B2 aktiv" UWORD B_TRUE 0 0 0.000000 1.000000 ECU_ADDRESS 0xFD06 BIT_MASK 0x8000 /end MEASUREMENT
/begin MEASUREMENT B_LRA1 "> 1 = LRA enable Bank1" UWORD B_TRUE 0 0 0.000000 1.000000 ECU_ADDRESS 0xFD44 BIT_MASK 0x1 /end MEASUREMENT
/begin MEASUREMENT B_LRA2 "> 1 = LRA enable Bank2" UWORD B_TRUE 0 0 0.000000 1.000000 ECU_ADDRESS 0xFD44 BIT_MASK 0x2 /end MEASUREMENT
/begin MEASUREMENT B_LRAR " hohe Beladung fuer Gemischadaption" UWORD B_TRUE 0 0 0.000000 1.000000 ECU_ADDRESS 0xFD50 BIT_MASK 0x1000 /end MEASUREMENT
/begin MEASUREMENT B_LRKA "> 1 = Katausraeumfkt. aktiv LRKA-Ausgang" UWORD B_TRUE 0 0 0.000000 1.000000 ECU_ADDRESS 0xFD32 BIT_MASK 0x2 /end MEASUREMENT
/begin MEASUREMENT B_LRKAE "1 = gesteuertes Katausraeumfkt. enable" UWORD B_TRUE 0 0 0.000000 1.000000 ECU_ADDRESS 0xFD32 BIT_MASK 0x8 /end MEASUREMENT
/begin MEASUREMENT B_LRND1 " 1 = LR B1 aktiv trotz evtl. gesetztem E_sls" UWORD B_TRUE 0 0 0.000000 1.000000 ECU_ADDRESS 0xFD2C BIT_MASK 0x100 /end MEASUREMENT
/begin MEASUREMENT B_LRND2 " 1 = LR B2 aktiv trotz evtl. gesetztem E_sls" UWORD B_TRUE 0 0 0.000000 1.000000 ECU_ADDRESS 0xFD2C BIT_MASK 0x200 /end MEASUREMENT
/begin MEASUREMENT B_LRPSPA " 1 = proj. spez. LR-Ausschaltung" UWORD B_TRUE 0 0 0.000000 1.000000 ECU_ADDRESS 0xFD2C BIT_MASK 0x4 /end MEASUREMENT
/begin MEASUREMENT B_LRSP1 " Sprung Vorkat-Sonde1" UWORD B_TRUE 0 0 0.000000 1.000000 ECU_ADDRESS 0xFD2E BIT_MASK 0x4 /end MEASUREMENT
/begin MEASUREMENT B_LRSP2 " Sprung Vorkat-Sonde2" UWORD B_TRUE 0 0 0.000000 1.000000 ECU_ADDRESS 0xFD2E BIT_MASK 0x20 /end MEASUREMENT
/begin MEASUREMENT B_LRSYNC " '1' = Bedingung fr_b1-/fr_b2-Synchronisierung aktiv" UWORD B_TRUE 0 0 0.000000 1.000000 ECU_ADDRESS 0xFD48 BIT_MASK 0x2 /end MEASUREMENT
/begin MEASUREMENT B_LRSYNI " Bedingung fr_b1-/fr_b2-Synchronisierung aktiv, lokal" UWORD B_TRUE 0 0 0.000000 1.000000 ECU_ADDRESS 0xFD2E BIT_MASK 0x800 /end MEASUREMENT
/begin MEASUREMENT B_LRSYR "> 1 = LRHK-Zustandsautomat inaktiv" UWORD B_TRUE 0 0 0.000000 1.000000 ECU_ADDRESS 0xFD30 BIT_MASK 0x80 /end MEASUREMENT
/begin MEASUREMENT B_LRTL "1 = L-Regelung wegen tl>tlran abgeschaltet" UWORD B_TRUE 0 0 0.000000 1.000000 ECU_ADDRESS 0xFD2C BIT_MASK 0x8000 /end MEASUREMENT
/begin MEASUREMENT B_LRTMOTH " 1 = tmot ok fuer LR" UWORD B_TRUE 0 0 0.000000 1.000000 ECU_ADDRESS 0xFD2C BIT_MASK 0x8 /end MEASUREMENT
/begin MEASUREMENT B_LUE2CNF " Motorluefter 2 Konfiguration" UWORD B_TRUE 0 0 0.000000 1.000000 ECU_ADDRESS 0xFDF8 BIT_MASK 0x1 /end MEASUREMENT
/begin MEASUREMENT B_LUES1 " Bdg. Einschalten Luefterstufe 1" UWORD B_TRUE 0 0 0.000000 1.000000 ECU_ADDRESS 0xFD9C BIT_MASK 0x4 /end MEASUREMENT
/begin MEASUREMENT B_LUES2 " Bdg. Einschalten Luefterstufe 2" UWORD B_TRUE 0 0 0.000000 1.000000 ECU_ADDRESS 0xFD9C BIT_MASK 0x8 /end MEASUREMENT
/begin MEASUREMENT B_LZAFG "1 = Langzeit-Adaptions-Freigabe" UWORD B_TRUE 0 0 0.000000 1.000000 ECU_ADDRESS 0xFD1E BIT_MASK 0x20 /end MEASUREMENT
/begin MEASUREMENT B_LZAGS "1 = Langzeit-Adaptions-Grundwert-Speicherung" UWORD B_TRUE 0 0 0.000000 1.000000 ECU_ADDRESS 0xFD1E BIT_MASK 0x40 /end MEASUREMENT
/begin MEASUREMENT B_LZAVB "1 = Langzeit-Adaptionsverbot" UWORD B_TRUE 0 0 0.000000 1.000000 ECU_ADDRESS 0xFD1E BIT_MASK 0x10 /end MEASUREMENT
/begin MEASUREMENT B_MFS1 " Mager-Fett-Sprung Vorkat-Sonde1" UWORD B_TRUE 0 0 0.000000 1.000000 ECU_ADDRESS 0xFD2E BIT_MASK 0x2 /end MEASUREMENT
/begin MEASUREMENT B_MFS2 " Mager-Fett-Sprung Vorkat-Sonde2" UWORD B_TRUE 0 0 0.000000 1.000000 ECU_ADDRESS 0xFD2E BIT_MASK 0x10 /end MEASUREMENT
/begin MEASUREMENT B_MILSTAT " MIL-Status fuer Scan-Tool Mode 1 PID$01" UBYTE B_TRUE 0 0 0.000000 1.000000 ECU_ADDRESS 0xB0FA1 BIT_MASK 0x40 /end MEASUREMENT
/begin MEASUREMENT B_NAC " 1 = erhoehte LL-Drehzahl bei Klimaanlage" UWORD B_TRUE 0 0 0.000000 1.000000 ECU_ADDRESS 0xFD04 BIT_MASK 0x8 /end MEASUREMENT
/begin MEASUREMENT B_NLMLS " Ausloesung Drive-Recorder Messung " UWORD B_TRUE 0 0 0.000000 1.000000 ECU_ADDRESS 0xFD92 BIT_MASK 0x40 /end MEASUREMENT
/begin MEASUREMENT B_NMAX " 1 = Maximaldrehzahl ueberschritten" UWORD B_TRUE 0 0 0.000000 1.000000 ECU_ADDRESS 0xFD04 BIT_MASK 0x200 /end MEASUREMENT
/begin MEASUREMENT B_NMIN " 1 = Minimaldrehzahl unterschritten" UWORD B_TRUE 0 0 0.000000 1.000000 ECU_ADDRESS 0xFD04 BIT_MASK 0x100 /end MEASUREMENT
/begin MEASUREMENT B_NOACC_FR " ACC-Verbot" UWORD B_TRUE 0 0 0.000000 1.000000 ECU_ADDRESS 0xFDC6 BIT_MASK 0x400 /end MEASUREMENT
/begin MEASUREMENT B_NOACC_UM " ACC-Momentenvorgabe in FU nicht uebern." UWORD B_TRUE 0 0 0.000000 1.000000 ECU_ADDRESS 0xFDC6 BIT_MASK 0x200 /end MEASUREMENT
/begin MEASUREMENT B_NOMNBA " Botschaftsunterbrechung CAN NBA" UWORD B_TRUE 0 0 0.000000 1.000000 ECU_ADDRESS 0xFD86 BIT_MASK 0x800 /end MEASUREMENT
/begin MEASUREMENT B_NOMSR_FR " MSR-Verbot" UWORD B_TRUE 0 0 0.000000 1.000000 ECU_ADDRESS 0xFD26 BIT_MASK 0x40 /end MEASUREMENT
/begin MEASUREMENT B_NOMSR_UM " MSR-Momentenvorgabe in FU nicht uebern." UWORD B_TRUE 0 0 0.000000 1.000000 ECU_ADDRESS 0xFD24 BIT_MASK 0x2000 /end MEASUREMENT
/begin MEASUREMENT B_NOSGS_FR " SGS-Verbot" UWORD B_TRUE 0 0 0.000000 1.000000 ECU_ADDRESS 0xFDC6 BIT_MASK 0x1000 /end MEASUREMENT
/begin MEASUREMENT B_NOSGS_UM " SGS-Momentenvorgabe in FU nicht uebern." UWORD B_TRUE 0 0 0.000000 1.000000 ECU_ADDRESS 0xFDC6 BIT_MASK 0x800 /end MEASUREMENT
/begin MEASUREMENT B_NOTL " 1 = Notluftfahren" UWORD B_TRUE 0 0 0.000000 1.000000 ECU_ADDRESS 0xFD04 BIT_MASK 0x800 /end MEASUREMENT
/begin MEASUREMENT B_NOTLU_FR "Notluftfahren vom FR" UWORD B_TRUE 0 0 0.000000 1.000000 ECU_ADDRESS 0xFD6A BIT_MASK 0x4 /end MEASUREMENT
/begin MEASUREMENT B_NO_TM_FR " Fahren ohne Tempomat - Betrieb" UWORD B_TRUE 0 0 0.000000 1.000000 ECU_ADDRESS 0xFD6A BIT_MASK 0x800 /end MEASUREMENT
/begin MEASUREMENT B_NSP " 1 = UKSEFI erlaubt Nachspritzer im CIFI" UWORD B_DEZ 0 0 0.000000 1.000000 ECU_ADDRESS 0xFD2A BIT_MASK 0x20 /end MEASUREMENT
/begin MEASUREMENT B_NSW " 1 = Nachstartkorrektur freigegeben" UWORD B_TRUE 0 0 0.000000 1.000000 ECU_ADDRESS 0xFD12 BIT_MASK 0x400 /end MEASUREMENT
/begin MEASUREMENT B_NWS " 1 = Kennfeldumschaltung bei NWS ein" UWORD B_TRUE 0 0 0.000000 1.000000 ECU_ADDRESS 0xFD06 BIT_MASK 0x200 /end MEASUREMENT
/begin MEASUREMENT B_PN " 1 = Getriebe auf P oder N" UWORD B_TRUE 0 0 0.000000 1.000000 ECU_ADDRESS 0xFD06 BIT_MASK 0x4 /end MEASUREMENT
/begin MEASUREMENT B_PNSTAT " 1 = PN-Zustand (unverzoegert)" UWORD B_TRUE 0 0 0.000000 1.000000 ECU_ADDRESS 0xFD1E BIT_MASK 0x4000 /end MEASUREMENT
/begin MEASUREMENT B_QAC " 1 = Mehrluft, um erhoehte LL-n ohne Klimakomp." UWORD B_TRUE 0 0 0.000000 1.000000 ECU_ADDRESS 0xFD04 BIT_MASK 0x1000 /end MEASUREMENT
/begin MEASUREMENT B_QKO " 1 = Mehrluft bei laufendem Klimakompressor" UWORD B_TRUE 0 0 0.000000 1.000000 ECU_ADDRESS 0xFD04 BIT_MASK 0x2000 /end MEASUREMENT
/begin MEASUREMENT B_QLUE1 " Bdg. fuer Zusatzluft fuer Luefterstufe 1" UWORD B_TRUE 0 0 0.000000 1.000000 ECU_ADDRESS 0xFD9C BIT_MASK 0x1 /end MEASUREMENT
/begin MEASUREMENT B_QLUE2 " Bdg. fuer Zusatzluft fuer Luefterstufe 2" UWORD B_TRUE 0 0 0.000000 1.000000 ECU_ADDRESS 0xFD9C BIT_MASK 0x2 /end MEASUREMENT
/begin MEASUREMENT B_REDKL " Freigabe Reduz. UeK-,K- und L-Anteil" UWORD B_DEZ 0 0 0.000000 1.000000 ECU_ADDRESS 0xFD2A BIT_MASK 0x80 /end MEASUREMENT
/begin MEASUREMENT B_REDSA " Anforderung SA durch Schaltvorgang vom Selespeed" UWORD B_TRUE 0 0 0.000000 1.000000 ECU_ADDRESS 0xFD7C BIT_MASK 0x1 /end MEASUREMENT
/begin MEASUREMENT B_REDW " Freigabe Reduz. des UK-DK.-Anteils" UWORD B_DEZ 0 0 0.000000 1.000000 ECU_ADDRESS 0xFD2A BIT_MASK 0x100 /end MEASUREMENT
/begin MEASUREMENT B_REHS " Restart Sondenheizung" UWORD B_TRUE 0 0 0.000000 1.000000 ECU_ADDRESS 0xFD50 BIT_MASK 0x8000 /end MEASUREMENT
/begin MEASUREMENT B_RESWLL " Reset W-Speicher UKSEFI" UWORD B_DEZ 0 0 0.000000 1.000000 ECU_ADDRESS 0xFD2A BIT_MASK 0x200 /end MEASUREMENT
/begin MEASUREMENT B_RGE " Rueckwaertsgang eingelegt" UWORD B_TRUE 0 0 0.000000 1.000000 ECU_ADDRESS 0xFD72 BIT_MASK 0x4000 /end MEASUREMENT
/begin MEASUREMENT B_RGH " Rueckwaertsgang aktiv (Hardware-Info)" UWORD DEZ 0 0 0.000000 256.000000 ECU_ADDRESS 0xFDAA BIT_MASK 0x10 /end MEASUREMENT
/begin MEASUREMENT B_R_SKA_FR "rev. Sicherheitskraftstoffabschaltung vom FR" UWORD B_TRUE 0 0 0.000000 1.000000 ECU_ADDRESS 0xFD6A BIT_MASK 0x40 /end MEASUREMENT
/begin MEASUREMENT B_SA " Schubabschaltung" UWORD B_TRUE 0 0 0.000000 1.000000 ECU_ADDRESS 0xFD08 BIT_MASK 0x8 /end MEASUREMENT
/begin MEASUREMENT B_SB " 1 = Setzen beschleunigen (Tempomat)" UWORD B_TRUE 0 0 0.000000 1.000000 ECU_ADDRESS 0xFD0A BIT_MASK 0x8 /end MEASUREMENT
/begin MEASUREMENT B_SBBHK1 " 1 = Betriebsbereitschaft L-Sonde h.KAT B1" UWORD B_TRUE 0 0 0.000000 1.000000 ECU_ADDRESS 0xFD30 BIT_MASK 0x1 /end MEASUREMENT
/begin MEASUREMENT B_SBBHK2 " 1 = Betriebsbereitschaft L-Sonde h.KAT B2" UWORD B_TRUE 0 0 0.000000 1.000000 ECU_ADDRESS 0xFD30 BIT_MASK 0x2 /end MEASUREMENT
/begin MEASUREMENT B_SBBVK1 "1 = Betriebsbereitschaft L-Sonde v.KAT B1" UWORD B_TRUE 0 0 0.000000 1.000000 ECU_ADDRESS 0xFD2C BIT_MASK 0x1 /end MEASUREMENT
/begin MEASUREMENT B_SB_HIGH " 1= sb auf High-Pegel" UWORD B_TRUE 0 0 0.000000 1.000000 ECU_ADDRESS 0xFD6C BIT_MASK 0x8 /end MEASUREMENT
/begin MEASUREMENT B_SELESP " Bedingung Selespeedvariante" UWORD B_TRUE 0 0 0.000000 1.000000 ECU_ADDRESS 0xFD14 BIT_MASK 0x4 /end MEASUREMENT
/begin MEASUREMENT B_SGADVB "1 = Stoergroessen-Adaptionsverbot" UWORD B_TRUE 0 0 0.000000 1.000000 ECU_ADDRESS 0xFD1E BIT_MASK 0x1 /end MEASUREMENT
/begin MEASUREMENT B_SKA " 1 = Sicherheitskraftstoffabsch." UWORD B_TRUE 0 0 0.000000 1.000000 ECU_ADDRESS 0xFD08 BIT_MASK 0x10 /end MEASUREMENT
/begin MEASUREMENT B_SLS " Sekundaerluftsteuerung" UWORD B_TRUE 0 0 0.000000 1.000000 ECU_ADDRESS 0xFD06 BIT_MASK 0x100 /end MEASUREMENT
/begin MEASUREMENT B_SP1LHO " '1'= SP1S-LL-Hochohmigkeit" UWORD B_TRUE 0 0 0.000000 1.000000 ECU_ADDRESS 0xFD5E BIT_MASK 0x400 /end MEASUREMENT
/begin MEASUREMENT B_SP1LHOSP " 1 = gespeicherte SP1S-LL-Hochohmigkeit" UWORD B_TRUE 0 0 0.000000 1.000000 ECU_ADDRESS 0xFDF6 BIT_MASK 0x2000 /end MEASUREMENT
/begin MEASUREMENT B_SP1S " '1'= PWG-Notfahren mit SP1S" UWORD B_TRUE 0 0 0.000000 1.000000 ECU_ADDRESS 0xFD5E BIT_MASK 0x2 /end MEASUREMENT
/begin MEASUREMENT B_SP1SMIN " '1'= SP1SMIN-Bereichsverletzung" UWORD B_TRUE 0 0 0.000000 1.000000 ECU_ADDRESS 0xFD5E BIT_MASK 0x100 /end MEASUREMENT
/begin MEASUREMENT B_SP2LHO " '1'= SP2S-LL-Hochohmigkeit" UWORD B_TRUE 0 0 0.000000 1.000000 ECU_ADDRESS 0xFD5E BIT_MASK 0x800 /end MEASUREMENT
/begin MEASUREMENT B_SP2LHOSP " 1 = gespeicherte SP2S-LL-Hochohmigkeit" UWORD B_TRUE 0 0 0.000000 1.000000 ECU_ADDRESS 0xFDF6 BIT_MASK 0x4000 /end MEASUREMENT
/begin MEASUREMENT B_SP2S " Ausloesung Drive-Recorder Messung " UWORD B_TRUE 0 0 0.000000 1.000000 ECU_ADDRESS 0xFD5E BIT_MASK 0x4 /end MEASUREMENT
/begin MEASUREMENT B_SP2SMIN " '1'= SP2SMIN-Bereichsverletzung" UWORD B_TRUE 0 0 0.000000 1.000000 ECU_ADDRESS 0xFD5E BIT_MASK 0x200 /end MEASUREMENT
/begin MEASUREMENT B_SPSMIN " '1'= PWG-Notfahren mit SPSMIN" UWORD B_TRUE 0 0 0.000000 1.000000 ECU_ADDRESS 0xFD5E BIT_MASK 0x8 /end MEASUREMENT
/begin MEASUREMENT B_STADVB "1 = Start-Adaptionsverbot" UWORD B_TRUE 0 0 0.000000 1.000000 ECU_ADDRESS 0xFD1E BIT_MASK 0x2 /end MEASUREMENT
/begin MEASUREMENT B_STAKT "1 = Start ist aktiv" UWORD B_TRUE 0 0 0.000000 1.000000 ECU_ADDRESS 0xFD1C BIT_MASK 0x1 /end MEASUREMENT
/begin MEASUREMENT B_START " 1 = Start aktiv" UWORD B_TRUE 0 0 0.000000 1.000000 ECU_ADDRESS 0xFD04 BIT_MASK 0x2 /end MEASUREMENT
/begin MEASUREMENT B_STEND " 1 = Startende erkannt" UWORD B_TRUE 0 0 0.000000 1.000000 ECU_ADDRESS 0xFD04 BIT_MASK 0x4 /end MEASUREMENT
/begin MEASUREMENT B_SU1 " 1 = Saugrohrumschaltung 1" UWORD B_TRUE 0 0 0.000000 1.000000 ECU_ADDRESS 0xFD9A BIT_MASK 0x40 /end MEASUREMENT
/begin MEASUREMENT B_SUAKR " Sperren KR-Adaption waehrend SU ZW-Rampe" UWORD DEZ 0 0 0.000000 256.000000 ECU_ADDRESS 0xFD60 BIT_MASK 0x400 /end MEASUREMENT
/begin MEASUREMENT B_SV " 1 = Setzen verzoegern (Tempomat)" UWORD B_TRUE 0 0 0.000000 1.000000 ECU_ADDRESS 0xFD0A BIT_MASK 0x10 /end MEASUREMENT
/begin MEASUREMENT B_SV_HIGH " 1= sv auf High-Pegel" UWORD B_TRUE 0 0 0.000000 1.000000 ECU_ADDRESS 0xFD6C BIT_MASK 0x10 /end MEASUREMENT
/begin MEASUREMENT B_SYNCM1 " Bedingung Bank1 ist Master" UWORD B_TRUE 0 0 0.000000 1.000000 ECU_ADDRESS 0xFD2E BIT_MASK 0x100 /end MEASUREMENT
/begin MEASUREMENT B_SYNCM2 " Bedingung Bank2 ist Master" UWORD B_TRUE 0 0 0.000000 1.000000 ECU_ADDRESS 0xFD2E BIT_MASK 0x200 /end MEASUREMENT
/begin MEASUREMENT B_TE " Tankentlueftung aktiv" UWORD B_TRUE 0 0 0.000000 1.000000 ECU_ADDRESS 0xFD06 BIT_MASK 0x2000 /end MEASUREMENT
/begin MEASUREMENT B_TEABB "1= Tankentlueftung abbruchbereit" UWORD B_TRUE 0 0 0.000000 1.000000 ECU_ADDRESS 0xFD7A BIT_MASK 0x4000 /end MEASUREMENT
/begin MEASUREMENT B_TEF " Tankentlueftung prinzipiell freigegeben" UWORD B_TRUE 0 0 0.000000 1.000000 ECU_ADDRESS 0xFD50 BIT_MASK 0x2000 /end MEASUREMENT
/begin MEASUREMENT B_TEHB " hohe Beladung" UWORD B_TRUE 0 0 0.000000 1.000000 ECU_ADDRESS 0xFD50 BIT_MASK 0x800 /end MEASUREMENT
/begin MEASUREMENT B_TEI " Funktionsinterne TE-Aktivierung" UWORD B_TRUE 0 0 0.000000 1.000000 ECU_ADDRESS 0xFD50 BIT_MASK 0x100 /end MEASUREMENT
/begin MEASUREMENT B_TEMIN " 1 = Minimale Einspritzzeit für Abschaltung LR erkannt." UWORD B_TRUE 0 0 0.000000 1.000000 ECU_ADDRESS 0xFD2E BIT_MASK 0x8000 /end MEASUREMENT
/begin MEASUREMENT B_TEMPFE " Tempomat Fuellungseingriff" UWORD B_TRUE 0 0 0.000000 1.000000 ECU_ADDRESS 0xFD4E BIT_MASK 0x40 /end MEASUREMENT
/begin MEASUREMENT B_TEP " Tankentlueftungsphase" UWORD B_TRUE 0 0 0.000000 1.000000 ECU_ADDRESS 0xFD50 BIT_MASK 0x200 /end MEASUREMENT
/begin MEASUREMENT B_TEPI " Bedingung TE-Phase intern aktiv" UWORD B_TRUE 0 0 0.000000 1.000000 ECU_ADDRESS 0xFD50 BIT_MASK 0x80 /end MEASUREMENT
/begin MEASUREMENT B_TLROK "1 = TL-Regelung OK" UWORD B_TRUE 0 0 0.000000 1.000000 ECU_ADDRESS 0xFD1E BIT_MASK 0x4 /end MEASUREMENT
/begin MEASUREMENT B_TLRSA "> 1 = LR-WE-Delay nach B_sa bis tlrsa vorbei" UWORD B_TRUE 0 0 0.000000 1.000000 ECU_ADDRESS 0xFD2C BIT_MASK 0x400 /end MEASUREMENT
/begin MEASUREMENT B_TM_AB_FR " Anforderung 'TEMP AUS' an SR" UWORD B_TRUE 0 0 0.000000 1.000000 ECU_ADDRESS 0xFD0A BIT_MASK 0x4000 /end MEASUREMENT
/begin MEASUREMENT B_TM_EIN " 1 = Fahrgesch.regelung aktiv" UWORD B_TRUE 0 0 0.000000 1.000000 ECU_ADDRESS 0xFD0A BIT_MASK 0x1 /end MEASUREMENT
/begin MEASUREMENT B_TRA1 "> 1 = TRA enable Bank1" UWORD B_TRUE 0 0 0.000000 1.000000 ECU_ADDRESS 0xFD44 BIT_MASK 0x10 /end MEASUREMENT
/begin MEASUREMENT B_TRA2 "> 1 = TRA enable Bank2" UWORD B_TRUE 0 0 0.000000 1.000000 ECU_ADDRESS 0xFD44 BIT_MASK 0x20 /end MEASUREMENT
/begin MEASUREMENT B_UBINI " 1 = Ladebilanzregelung freigegeben" UWORD B_TRUE 0 0 0.000000 1.000000 ECU_ADDRESS 0x0 BIT_MASK 0x1 /end MEASUREMENT
/begin MEASUREMENT B_UBUM " 1 = negative Ladebilanz" UWORD B_TRUE 0 0 0.000000 1.000000 ECU_ADDRESS 0x0 BIT_MASK 0x2 /end MEASUREMENT
/begin MEASUREMENT B_UB_OK "1 = Batteriespannung ok" UWORD B_TRUE 0 0 0.000000 1.000000 ECU_ADDRESS 0xFD0E BIT_MASK 0x2000 /end MEASUREMENT
/begin MEASUREMENT B_UGOFFG " 1 = Untergrenzenoffset-Freigabe" UWORD B_TRUE 0 0 0.000000 1.000000 ECU_ADDRESS 0xFD20 BIT_MASK 0x10 /end MEASUREMENT
/begin MEASUREMENT B_UGOFVB " 1 = Untergrenzenoffset-Verbot" UWORD B_TRUE 0 0 0.000000 1.000000 ECU_ADDRESS 0xFD20 BIT_MASK 0x8 /end MEASUREMENT
/begin MEASUREMENT B_UKG " 1 = UeK wirkt stark" UWORD B_TRUE 0 0 0.000000 1.000000 ECU_ADDRESS 0xFD28 BIT_MASK 0x4000 /end MEASUREMENT
/begin MEASUREMENT B_URSTA " 1 = Urstart bzw. Powerfail erkannt" UWORD B_TRUE 0 0 0.000000 1.000000 ECU_ADDRESS 0xFD04 BIT_MASK 0x4000 /end MEASUREMENT
/begin MEASUREMENT B_VANF " 1 = Zustand Anfahrgeschw. erreicht" UWORD B_TRUE 0 0 0.000000 1.000000 ECU_ADDRESS 0xFD20 BIT_MASK 0x80 /end MEASUREMENT
/begin MEASUREMENT B_VARA " 1 = Geschwindigkeitsb. fuer AR-Funktion erfuellt" UWORD B_TRUE 0 0 0.000000 1.000000 ECU_ADDRESS 0xFD12 BIT_MASK 0x2000 /end MEASUREMENT
/begin MEASUREMENT B_VL "1 = Vollast" UWORD B_TRUE 0 0 0.000000 1.000000 ECU_ADDRESS 0xFD06 BIT_MASK 0x2 /end MEASUREMENT
/begin MEASUREMENT B_VMAXO " Vmaxo-Bit Vmax-Schwelle ueberschritten" UWORD B_TRUE 0 0 0.000000 1.000000 ECU_ADDRESS 0xFD9A BIT_MASK 0x400 /end MEASUREMENT
/begin MEASUREMENT B_VNS " Bdg. Fahrzeug rollt nicht waehrend Nachstart" UWORD B_TRUE 0 0 0.000000 1.000000 ECU_ADDRESS 0xFD20 BIT_MASK 0x200 /end MEASUREMENT
/begin MEASUREMENT B_VPWGERR " Vermuteter PWG Fehler" UWORD B_TRUE 0 0 0.000000 1.000000 ECU_ADDRESS 0xFD7C BIT_MASK 0x8000 /end MEASUREMENT
/begin MEASUREMENT B_VSTAT "1 = Geschwindigkeits-Zustand" UWORD B_TRUE 0 0 0.000000 1.000000 ECU_ADDRESS 0xFD1C BIT_MASK 0x100 /end MEASUREMENT
/begin MEASUREMENT B_VVORH " Vorhalt-Bit Vorhaltschwelle ueberschritten" UWORD B_TRUE 0 0 0.000000 1.000000 ECU_ADDRESS 0xFD9A BIT_MASK 0x200 /end MEASUREMENT
/begin MEASUREMENT B_WA " 1 = Wiederaufnahme (Tempomat" UWORD B_TRUE 0 0 0.000000 1.000000 ECU_ADDRESS 0xFD0A BIT_MASK 0x20 /end MEASUREMENT
/begin MEASUREMENT B_WA_HIGH " 1= wa auf High-Pegel" UWORD B_TRUE 0 0 0.000000 1.000000 ECU_ADDRESS 0xFD6C BIT_MASK 0x20 /end MEASUREMENT
/begin MEASUREMENT B_WE " 1 = Wiedereinsetzen aktiv" UWORD B_TRUE 0 0 0.000000 1.000000 ECU_ADDRESS 0xFD0C BIT_MASK 0x8 /end MEASUREMENT
/begin MEASUREMENT B_WEH "1 = Hartes Wiedereinsetzen" UWORD B_TRUE 0 0 0.000000 1.000000 ECU_ADDRESS 0xFD0C BIT_MASK 0x10 /end MEASUREMENT
/begin MEASUREMENT B_WEHKA "1= Hartes Wiedereinsetzen fuer Katausraeumen" UWORD B_TRUE 0 0 0.000000 1.000000 ECU_ADDRESS 0xFD32 BIT_MASK 0x4 /end MEASUREMENT
/begin MEASUREMENT EI_ACCC_UM " Keine Uebernahme des ACC-Momentes" UWORD B_TRUE 0 0 0.000000 1.000000 ECU_ADDRESS 0xFDF0 BIT_MASK 0x8000 /end MEASUREMENT
/begin MEASUREMENT EI_ADCC_UM " Fehler-Bit AD-Wandler Test(UM)" UWORD B_TRUE 0 0 0.000000 1.000000 ECU_ADDRESS 0xFDF0 BIT_MASK 0x100 /end MEASUREMENT
/begin MEASUREMENT EI_ANEG_FR " = 1 : Tempomat -b Schwelle" UWORD B_TRUE 0 0 0.000000 1.000000 ECU_ADDRESS 0xFDA4 BIT_MASK 0x800 /end MEASUREMENT
/begin MEASUREMENT EI_APOS_FR " 1 = Tempomat +b Schwelle" UWORD B_TRUE 0 0 0.000000 1.000000 ECU_ADDRESS 0xFDA4 BIT_MASK 0x1000 /end MEASUREMENT
/begin MEASUREMENT EI_D13_FR " = 1 : IP1SN zu IP3SN im DK-Poti-Notfahren unpl." UWORD B_TRUE 0 0 0.000000 1.000000 ECU_ADDRESS 0xFDA6 BIT_MASK 0x20 /end MEASUREMENT
/begin MEASUREMENT EI_D1B_FR " = 1 : IP1S-Bereichsfehler im DK-Poti-Notfahren" UWORD B_TRUE 0 0 0.000000 1.000000 ECU_ADDRESS 0xFDA6 BIT_MASK 0x4 /end MEASUREMENT
/begin MEASUREMENT EI_D23_FR " = 1 : IP2SN zu IP3SN im DK-Poti-Notfahren unpl." UWORD B_TRUE 0 0 0.000000 1.000000 ECU_ADDRESS 0xFDA6 BIT_MASK 0x40 /end MEASUREMENT
/begin MEASUREMENT EI_D2B_FR " = 1 : IP2S-Bereichsfehler im DK-Poti-Notfahren" UWORD B_TRUE 0 0 0.000000 1.000000 ECU_ADDRESS 0xFDA6 BIT_MASK 0x8 /end MEASUREMENT
/begin MEASUREMENT EI_D3_FR " = 1 : IP3SN im DK-Poti-Notfahren wg. HFM-Fehler nicht berechenbar" UWORD B_TRUE 0 0 0.000000 1.000000 ECU_ADDRESS 0xFDA6 BIT_MASK 0x80 /end MEASUREMENT
/begin MEASUREMENT EI_I123_FR " = 1 : IP1SN zu IP2SN zu IP3SN unpl. bei N > N_DKIST" UWORD B_TRUE 0 0 0.000000 1.000000 ECU_ADDRESS 0xFDA6 BIT_MASK 0x10 /end MEASUREMENT
/begin MEASUREMENT EI_I1B_FR " = 1 : IP1S-Bereichsfehler" UWORD B_TRUE 0 0 0.000000 1.000000 ECU_ADDRESS 0xFDA6 BIT_MASK 0x1000 /end MEASUREMENT
/begin MEASUREMENT EI_I1_FR " = 1 : IP1S zu IP2S bei N > N_DKIST unplaus und IP2S zu IP3S plausi" UWORD B_TRUE 0 0 0.000000 1.000000 ECU_ADDRESS 0xFDA6 BIT_MASK 0x4000 /end MEASUREMENT
/begin MEASUREMENT EI_I2B_FR " = 1 : IP2S-Bereichsfehler bei N > N_DKIST" UWORD B_TRUE 0 0 0.000000 1.000000 ECU_ADDRESS 0xFDA6 BIT_MASK 0x2000 /end MEASUREMENT
/begin MEASUREMENT EI_I2_FR " = 1 : IP1S zu IP2S bei N > N_DKIST unplaus und IP1S zu IP3S plausi" UWORD B_TRUE 0 0 0.000000 1.000000 ECU_ADDRESS 0xFDA6 BIT_MASK 0x8000 /end MEASUREMENT
/begin MEASUREMENT EI_MSRC_UM " Fehler-Bit MSR Ueberwachung" UWORD B_TRUE 0 0 0.000000 1.000000 ECU_ADDRESS 0xFDF0 BIT_MASK 0x2000 /end MEASUREMENT
/begin MEASUREMENT EI_REAC_UM " Fehler-Bit aus Fehlerreaktionsuebernahme (UM)" UWORD B_TRUE 0 0 0.000000 1.000000 ECU_ADDRESS 0xFDF0 BIT_MASK 0x20 /end MEASUREMENT
/begin MEASUREMENT EI_S12_FR " = 1 : SP1S zu SP2S unplausibel" UWORD B_TRUE 0 0 0.000000 1.000000 ECU_ADDRESS 0xFDA4 BIT_MASK 0x80 /end MEASUREMENT
/begin MEASUREMENT EI_S1MN_FR " = 1 : SP1S-Bereichsunterschreitung bei SP1S zu SP2S unpl." UWORD B_TRUE 0 0 0.000000 1.000000 ECU_ADDRESS 0xFDA4 BIT_MASK 0x20 /end MEASUREMENT
/begin MEASUREMENT EI_S1MX_FR " = 1 : SP1S-Bereichsueberschreitung" UWORD B_TRUE 0 0 0.000000 1.000000 ECU_ADDRESS 0xFDA4 BIT_MASK 0x2 /end MEASUREMENT
/begin MEASUREMENT EI_S2MN_FR " = 1 : SP2S-Bereichsunterschreitung bei SP1S zu SP2S unpl." UWORD B_TRUE 0 0 0.000000 1.000000 ECU_ADDRESS 0xFDA4 BIT_MASK 0x40 /end MEASUREMENT
/begin MEASUREMENT EI_S2MX_FR " = 1 : SP2S-Bereichsueberschreitung" UWORD B_TRUE 0 0 0.000000 1.000000 ECU_ADDRESS 0xFDA4 BIT_MASK 0x8 /end MEASUREMENT
/begin MEASUREMENT EI_SGSC_UM " Keine Uebernahme des SGS-Momentes" UWORD B_TRUE 0 0 0.000000 1.000000 ECU_ADDRESS 0xFDF0 BIT_MASK 0x1000 /end MEASUREMENT
/begin MEASUREMENT EI_SPSC_UM " Fehler-Bit Pedalsollwertpruefung (UM)" UWORD B_TRUE 0 0 0.000000 1.000000 ECU_ADDRESS 0xFDF0 BIT_MASK 0x2 /end MEASUREMENT
/begin MEASUREMENT EMS_NSL_AK "1 = Nachstart ist aktiv" UWORD B_TRUE 0 0 0.000000 1.000000 ECU_ADDRESS 0xFD1C BIT_MASK 0x2 /end MEASUREMENT
/begin MEASUREMENT E_BREMSE "> 1 = Fehler Schalter Bremse" UWORD B_TRUE 0 0 0.000000 1.000000 ECU_ADDRESS 0xFD5A BIT_MASK 0x1000 /end MEASUREMENT
/begin MEASUREMENT E_CEGS " CAN-Fehler: EGS Kommunikation" UBYTE B_TRUE 0 0 0.000000 1.000000 ECU_ADDRESS 0xFDEA BIT_MASK 0x8 /end MEASUREMENT
/begin MEASUREMENT E_DK " 1 = Fehler Drosselklappengeber" UBYTE B_TRUE 0 0 0.000000 1.000000 ECU_ADDRESS 0xFDE7 BIT_MASK 0x2 /end MEASUREMENT
/begin MEASUREMENT E_EV " 1 = Fehler Einspritzventile" UWORD B_TRUE 0 0 0.000000 1.000000 ECU_ADDRESS 0xFD66 BIT_MASK 0x20 /end MEASUREMENT
/begin MEASUREMENT E_FRA1 " 1 = Fehler LR-Adaption multiplikativ, Bank1" UBYTE B_TRUE 0 0 0.000000 1.000000 ECU_ADDRESS 0xFDED BIT_MASK 0x1 /end MEASUREMENT
/begin MEASUREMENT E_HFM " 1 = HFM-Error" UBYTE B_TRUE 0 0 0.000000 1.000000 ECU_ADDRESS 0xFDE6 BIT_MASK 0x2 /end MEASUREMENT
/begin MEASUREMENT E_HSH " Fehler Heizung Lambda-Sonde hinter Kat Bank1" UBYTE B_TRUE 0 0 0.000000 1.000000 ECU_ADDRESS 0xFDEC BIT_MASK 0x1 /end MEASUREMENT
/begin MEASUREMENT E_HSV " Fehler Heizung Lambda-Sonde vor Kat Bank1" UBYTE B_TRUE 0 0 0.000000 1.000000 ECU_ADDRESS 0xFDEB BIT_MASK 0x80 /end MEASUREMENT
/begin MEASUREMENT E_KAT1 " 1 = Fehler Katalysatorkonvertierung, Bank1" UBYTE B_TRUE 0 0 0.000000 1.000000 ECU_ADDRESS 0xFDEC BIT_MASK 0x40 /end MEASUREMENT
/begin MEASUREMENT E_KRHW " KR-Hardware-Sammelfehler B2_BI" UBYTE B_TRUE 0 0 0.000000 1.000000 ECU_ADDRESS 0xFDE8 BIT_MASK 0x1 /end MEASUREMENT
/begin MEASUREMENT E_KS1 " Sensor1-Abfall" UBYTE B_TRUE 0 0 0.000000 1.000000 ECU_ADDRESS 0xFDE8 BIT_MASK 0x2 /end MEASUREMENT
/begin MEASUREMENT E_KS2 " Sensor2-Abfall" UBYTE B_TRUE 0 0 0.000000 1.000000 ECU_ADDRESS 0xFDE8 BIT_MASK 0x4 /end MEASUREMENT
/begin MEASUREMENT E_KUPPL " Fehler: EGS-SG schaltet Motorsteuerung ab" UBYTE B_TRUE 0 0 0.000000 1.000000 ECU_ADDRESS 0xFDED BIT_MASK 0x80 /end MEASUREMENT
/begin MEASUREMENT E_LM " 1 = Lasterfassungsfehler" UBYTE B_TRUE 0 0 0.000000 1.000000 ECU_ADDRESS 0xFDE6 BIT_MASK 0x2 /end MEASUREMENT
/begin MEASUREMENT E_LSH1 " Diagnose Lambda-Sonde 1 hinter Kat Bank1" UBYTE B_TRUE 0 0 0.000000 1.000000 ECU_ADDRESS 0xFDEB BIT_MASK 0x8 /end MEASUREMENT
/begin MEASUREMENT E_LSV1 " Fehler Lambda-Sonde vor Kat Bank 1" UBYTE B_TRUE 0 0 0.000000 1.000000 ECU_ADDRESS 0xFDEB BIT_MASK 0x4 /end MEASUREMENT
/begin MEASUREMENT E_LUES1 " Endstufen Fehler: Luefter Stufe 1" UBYTE B_TRUE 0 0 0.000000 1.000000 ECU_ADDRESS 0xFDE8 BIT_MASK 0x10 /end MEASUREMENT
/begin MEASUREMENT E_MD " Aussetzererkennung, Summe, abgasrelevant" UBYTE B_TRUE 0 0 0.000000 1.000000 ECU_ADDRESS 0xFDEA BIT_MASK 0x10 /end MEASUREMENT
/begin MEASUREMENT E_NWSE " 1 = Endstufenfehler Nockenwellensteuerung" UBYTE B_TRUE 0 0 0.000000 1.000000 ECU_ADDRESS 0xFDEA BIT_MASK 0x1 /end MEASUREMENT
/begin MEASUREMENT E_OBDLR "> 1 = OBDII-Summenfehlerbit f. LREB" UWORD B_TRUE 0 0 0.000000 1.000000 ECU_ADDRESS 0xFD32 BIT_MASK 0x4000 /end MEASUREMENT
/begin MEASUREMENT E_PH " Phasenfehler" UBYTE B_TRUE 0 0 0.000000 1.000000 ECU_ADDRESS 0xFDE6 BIT_MASK 0x40 /end MEASUREMENT
/begin MEASUREMENT E_TEVE " 1 = Fehler TEV-Endstufe" UBYTE B_TRUE 0 0 0.000000 1.000000 ECU_ADDRESS 0xFDE9 BIT_MASK 0x8 /end MEASUREMENT
/begin MEASUREMENT E_TM " 1 = Fehler Kuehlmitteltemperaturfuehler" UBYTE B_TRUE 0 0 0.000000 1.000000 ECU_ADDRESS 0xFDE6 BIT_MASK 0x4 /end MEASUREMENT
/begin MEASUREMENT E_TRA1 " 1 = Fehler LR-Adaption QL-additiv, Bank1" UBYTE B_TRUE 0 0 0.000000 1.000000 ECU_ADDRESS 0xFDEC BIT_MASK 0x80 /end MEASUREMENT
/begin MEASUREMENT E_UB " 1 = Ubatt fehlerhaft" UBYTE B_TRUE 0 0 0.000000 1.000000 ECU_ADDRESS 0xFDE6 BIT_MASK 0x80 /end MEASUREMENT
/begin MEASUREMENT S_BL " 1 = Bremse betaetigt Bremslicht" UWORD B_TRUE 0 0 0.000000 1.000000 ECU_ADDRESS 0xFD0A BIT_MASK 0x4 /end MEASUREMENT
/begin MEASUREMENT S_BR " 1 = Bremse betaetigt Bremsschalter" UWORD B_TRUE 0 0 0.000000 1.000000 ECU_ADDRESS 0xFD0A BIT_MASK 0x2 /end MEASUREMENT
/begin MEASUREMENT S_KO " 1 = Klimakompressoranforderung aktiv" UWORD B_TRUE 0 0 0.000000 1.000000 ECU_ADDRESS 0xFD04 BIT_MASK 0x20 /end MEASUREMENT
/begin MEASUREMENT S_KUP " 1 = Kupplungsschalter betaetigt (Handschalter)" UWORD B_TRUE 0 0 0.000000 1.000000 ECU_ADDRESS 0xFD02 BIT_MASK 0x40 /end MEASUREMENT
/begin MEASUREMENT S_LUES1 " Schalter Motorluefter Stufe 1" UWORD B_TRUE 0 0 0.000000 1.000000 ECU_ADDRESS 0xFD9C BIT_MASK 0x10 /end MEASUREMENT
/begin MEASUREMENT S_LUES2 " Schalter Motorluefter Stufe 2" UWORD B_TRUE 0 0 0.000000 1.000000 ECU_ADDRESS 0xFD9C BIT_MASK 0x20 /end MEASUREMENT
/begin MEASUREMENT VC_FGR " 1 = Variante mit Tempomat" UWORD B_TRUE 0 0 0.000000 1.000000 ECU_ADDRESS 0xFDF4 BIT_MASK 0x4 /end MEASUREMENT
/begin FUNCTION _HLS "60.10.0"
 /begin REF_CHARACTERISTIC UHSN UBHS TVHSREDV TVHSREDH TMOHSMN THVAWU THVA THSVKTA THSHKTK THHAWU THHA THEV THEH /end REF_CHARACTERISTIC
 /begin LOC_MEASUREMENT THVAT THVAIST THHAT THHAIST B_REHS B_HSVMX B_HSHMX PHLSNV PHLSNH B_HSVE B_HSHE UBATT TMOT TKATM TABGM B_STEND B_SBBVK1 B_SBBHK2 B_SBBHK1 B_INIT B_ATMTPL B_ATMTPK B_ATMTPF B_ATMTPA /end LOC_MEASUREMENT
/end FUNCTION
/begin FUNCTION _HWSIG "3.11.0"
 /begin LOC_MEASUREMENT UUBATT UTMOT UTANS UPSAUG SP2S SP1S S_KUP S_KO S_BR S_BL IP2SN IP2S IP1SN IP1S DCLR B_RGH B_KL15 /end LOC_MEASUREMENT
/end FUNCTION
/begin FUNCTION _IPSC "1.40.0"
 /begin REF_CHARACTERISTIC N_DKIST IP23DIF_T IP2SMIN IP2SMAX IP2SEL_T IP2BER_T IP13DIF_T IP123DIF_T IP12DIF_T IP1SMIN IP1SMAX IP1SEL_T IP1BER_T IPDIFKL DIF_IP23 DIF_IP13 DIF_IP12 /end REF_CHARACTERISTIC
 /begin LOC_MEASUREMENT IP23DIF_C IP2SN IP2SEL_C IP2BER_C IP13DIF_C IP123DIF_C IP12DIF_C IP1SN IP1SEL_C IP1BER_C IPSN_FR EI_I2_FR EI_I2B_FR EI_I123_FR EI_I1_FR EI_I1B_FR EI_D3_FR EI_D23_FR EI_D2B_FR EI_D13_FR EI_D1B_FR B_I_SKA_FR B_IP3REQ_F B_IP3OK_FR B_IP2SEL_F B_DKNOT_FR NIST IP3SN IP2S IP1S E_LM E_HFM B_UB_OK B_I_SKA_UM /end LOC_MEASUREMENT
/end FUNCTION
/begin FUNCTION _KATW "1.1.0" /begin REF_CHARACTERISTIC KATW_V KATW_UG KATW_TM KATW_OG KATWGT KATW_D /end REF_CHARACTERISTIC /begin LOC_MEASUREMENT MLSP B_KATWA2 B_KATWA /end LOC_MEASUREMENT /end FUNCTION
/begin FUNCTION _KE "113.40.0"
 /begin REF_CHARACTERISTIC VKRIRU VKRIRO REFINI NKRREFIN KRIMX KRFTP3 KRFTP2 KFMAKR KEMR KEMLN KEF6N KEF5N KEF4N KEF3N KEF2N KEF1N FMFKR FKELDY /end REF_CHARACTERISTIC
 /begin LOC_MEASUREMENT KEK VKR RKR IKR B_KR /end LOC_MEASUREMENT
/end FUNCTION
/begin FUNCTION _KHZ "14.40.0"
 /begin REF_CHARACTERISTIC NKH KFWKHT1 KFWKHT KFWKHL1 KFWKHL KFKHAT1 KFKHAT KFKHAL1 KFKHAL KFFWKH FDKHAKHO DZZKH1 DZZKH DTKH /end REF_CHARACTERISTIC
 /begin LOC_MEASUREMENT FWKHZL FWKHZ WKH B_KH ZZKH TMSTLIN TMST TMOT TL8 TANSLIN TANS NMOT NIST FDKHA B_STEND B_SA B_LL B_GV /end LOC_MEASUREMENT
/end FUNCTION
/begin FUNCTION _KOS "84.40.0"
 /begin REF_CHARACTERISTIC TVKOE1 TVKOE TNSTKO TNACMX TMKOAU TMKOAO TKOEMNN TKOAMXN TKOAMNN TEC1 TEC KFWDKOE KFWDKOA KFDWDKOA /end REF_CHARACTERISTIC
 /begin LOC_MEASUREMENT B_QKO B_QAC B_NAC B_KOS B_KOE B_KOAX WDKBL TMOT S_KO B_START /end LOC_MEASUREMENT
/end FUNCTION
/begin FUNCTION _KR "64.60.0"
 /begin REF_CHARACTERISTIC WKRLZOF WKRDMXN WKRDMNN LZFUER1 LZFUER KRVFN KRNLZ1 KRNLZ KRMXN KRFK /end REF_CHARACTERISTIC
 /begin LOC_MEASUREMENT WKR5 WKR4 WKR3 WKR2 WKR1 WKR0 WKRM WKR /end LOC_MEASUREMENT
/end FUNCTION
/begin FUNCTION _KRA "117.10.0"
 /begin REF_CHARACTERISTIC TMKRA TLKRN NKRA KRAP KRAN4 KRAN3 KRAN2 KRAN1 KRANH KRAL2 KRAL1 KRALH DYVT /end REF_CHARACTERISTIC
 /begin LOC_MEASUREMENT B_KRA WKR TMOT TL8 NIST B_VL B_SUAKR B_KS B_KRLDY B_KR /end LOC_MEASUREMENT
/end FUNCTION
/begin FUNCTION _KRDY "2.10.0"
 /begin REF_CHARACTERISTIC TMKR TMDYNA KRFTP3 KRFTP2 KRFKN KRFK KRAN4 KRAN3 KRAN2 KRAN1 KRANH KEFNDY FKELDYA FKELDY DYESN DYADMX DNKRDY AZKRNDYN AZKRLDYN /end REF_CHARACTERISTIC
 /begin LOC_MEASUREMENT ZLDY WKRDYA B_KLME B_KLDYSTK B_KLDYNRM WKRDY B_KRNDY B_KRLDYA B_KRLDY VIRKR TMOT NMOT KEK DWDKBL DNDT B_LL /end LOC_MEASUREMENT
/end FUNCTION
/begin FUNCTION _KS "25.10.0" /begin REF_CHARACTERISTIC KFWKS /end REF_CHARACTERISTIC
 /begin LOC_MEASUREMENT B_KS B_KR WKR5 WKR4 WKR3 WKR2 WKR1 WKR0 WKRM DWKRS WKR TL8 NMOT E_PH E_KS2 E_KS1 E_KRHW /end LOC_MEASUREMENT
/end FUNCTION
/begin FUNCTION _KUE "80.20.0" /begin REF_CHARACTERISTIC TMKRA TMKR TLKRN NKRF KRMXN KRAP /end REF_CHARACTERISTIC
 /begin LOC_MEASUREMENT WKR TL8 E_PH E_KS2 E_KS1 E_KRHW DWKRS B_KS B_KRLDY B_KRA B_KR /end LOC_MEASUREMENT
/end FUNCTION
/begin FUNCTION _KVA "46.50.0" /begin REF_CHARACTERISTIC KVACAL /end REF_CHARACTERISTIC /begin LOC_MEASUREMENT KVAT /end LOC_MEASUREMENT /end FUNCTION
/begin FUNCTION _LAMKO "13.10.0" /begin REF_CHARACTERISTIC LAMLGMTM LAMLGF /end REF_CHARACTERISTIC /begin LOC_MEASUREMENT LAMLGM TMOT /end LOC_MEASUREMENT /end FUNCTION
/begin FUNCTION _LFR5 "5.150.2"
 /begin REF_CHARACTERISTIC ZKN ZKD V_TNH V_TN V_ROLL VOBGR VNS VC_GETR VANF UGOFVB_T UG_F_OF UGDZKN UGDZKD UGDVER UG_DMAX TVFSEM TVFSAM TNS_NRP TNS_HRP TLRPR_T TL_M_UG TL_IVER TLDKHUB SUBRE ST_OG1 ST_OG ST_NS_RP ST_HW STGK_T PVERPOS PVERNEG PVERH PVER OGROLLOF OGANFOF1 NSPLT NS_OG NSNTNS1 NSNTNS NSFTNS1 NSFTNS NS_B_RP N_M_UG N_I_OFH N_I_OF NDIFV08 LUES2_UG LUES2OFF LUES1_UG LUES1OFF LL01V_T KTL8_UG KOE_UG KOEOFF KLTLSLFR KLOFVB_T KLOFBW_T KH_UG KHOFF IVERPOSH IVERPOS IVERNEGH IVERNEG FSEOFFM FSAOFFM F_M_UG DVERNEG DVERH DVER DR10V_T DRSGA_T B_OG B_N_UG B_N_TN1 B_N_TN B_NAC_TN1 B_NAC_TN B_F_UG B_F_TN B_FAC_TN /end REF_CHARACTERISTIC
 /begin LOC_MEASUREMENT V_LFR UG_DANT OGROOFIN OGANOFIN B_VNS B_VANF B_UGOFVB B_UGOFFG B_KUPCHA B_KRPAKT B_FSEOFF B_FSAOFF UBGR TLREGAW STGMW PANTEIL OBGR NSOLL_1U L_IANTEIL H_IANTEIL EMS_NSL_AK DANTEIL B_VSTAT B_TLROK B_STAKT B_STADVB B_SGADVB B_PNSTAT B_LZAVB B_LL01V B_LLSTAT B_KLOFVB B_DR10V B_DRSTAT B_DRSGA WKH TMST TMOT TL8 NIST_1U NIST NDIF E_TRA1 E_HFM E_FRA1 B_QLUE2 B_QLUE1 B_NMIN B_NAC B_LL B_KOS B_KH /end LOC_MEASUREMENT
/end FUNCTION
/begin FUNCTION _LFR5A "3.60.0"
 /begin REF_CHARACTERISTIC ST_AD_VW STADVB_T SGADVB_T NSNUG NSFUG N_OF_AD LZAVB_T LZA_U_MT LZA_U_AT LZA_P_OF LZA_O_MT LZA_O_AT LZA_N_OF LZAGSV_T LZA_GMAX LZA_GINI LUES2_UG LUES1_UG LL01V_T KOE_UG KH_UG B_N_UG B_F_UG AD_RP_T AD_P_MT ADOF_NK ADOF_N ADOF_FK ADOF_F ADOFDZAN ADI_MAX AD_HW /end REF_CHARACTERISTIC
 /begin LOC_MEASUREMENT V_LFR LZAVB_C STGADI LZA_GW B_LZAGS B_LZAFG B_ADAPFG AD_G_MIN WKH TMOT TANS STGMW NMOT NIST FDKHA E_LSV1 E_HFM E_EV B_VSTAT B_STAKT B_STADVB B_SGADVB B_LZAVB B_LUES2 B_LUES1 B_LLSTAT B_KOS B_KOE B_KH B_HG B_DZAAKT B_DRSTAT B_DRCHA /end LOC_MEASUREMENT
/end FUNCTION
/begin FUNCTION _LFS "8.120.0"
 /begin REF_CHARACTERISTIC TN2LF TN1LF TMLF2 TMLF1 TMELU2 TMELU1 TMALU2 TMALU1 TDFELU2 TDFELU1 TDFALU2 TDFALU1 TDELU2 TDALU1 LUE2CNF CWLFS /end REF_CHARACTERISTIC
 /begin LOC_MEASUREMENT B_QLUE2 B_QLUE1 B_LUE2CNF B_LUES2 B_LUES1 TMOT_W TMABS_W S_LUES2 S_LUES1 E_LUES1 B_START /end LOC_MEASUREMENT
/end FUNCTION
/begin FUNCTION _LLRUB "3.10.0" /begin REF_CHARACTERISTIC ZKLBZP ZKLBZNN ZKFUB UBSOLL TWLLRUB TNSRUB /end REF_CHARACTERISTIC /begin LOC_MEASUREMENT UBF UBATT LBZ DUB TNSUBAT B_UBUM B_UBINI /end LOC_MEASUREMENT /end FUNCTION
/begin FUNCTION _LLW "9.40.0" /begin REF_CHARACTERISTIC WLLNPDN WLLNNDN WLLDPDN WLLDNDN VARA KFWLLNPDN /end REF_CHARACTERISTIC
 /begin LOC_MEASUREMENT WLLR VFZG NSOLL NIST_5U DNDT B_VARA B_SA B_PN B_NOTL B_LLEW B_LL B_KUP TMOT B_KUPCHA /end LOC_MEASUREMENT
/end FUNCTION
/begin FUNCTION _LR "86.30.0"
 /begin REF_CHARACTERISTIC ZLRSYNI USR TSPERN KFRTV2 KFRTV KFRP KFRI KFLRSYNP KFLRSYNI FRMIN2 FRMIN1 FRMINTS2 FRMINTS1 FRMIN FRMAX DLRPERMX DLRPERMN CWLRSYNC /end REF_CHARACTERISTIC
 /begin LOC_MEASUREMENT TVTIME2 TVTIME1 TVMFS2 TVMFS1 TVFMS2 TVFMS1 TSPERRML TMAGRIMA TMAGRIM TMAGRIF TMAGERSL TMAGERMA TFETTSL TFETTMA TFETTIMA TFETTIM TFETTIF SGNLAM2 SGNLAM1 FRP_ FRMX FRMN FR_IB2 FR_IB1 FRI_ DLRPER B_MFS2 B_MFS1 B_LRSYNI B_LRSP2 B_LRSP1 B_FMS2 B_FMS1 TFRP2_W TFRP1_W TFRN2_W TFRN1_W FR_B2 FR_B1 B_SYNCM2 B_SYNCM1 USVK2 USVK1 USHK2 USHK1 TVLRH2 TVLRH1 TMOT TL8 NMOT DFRKA B_LR2 B_LR1 B_LRND2 B_LRND1 B_DKTLP /end LOC_MEASUREMENT
/end FUNCTION
/begin FUNCTION _LRA "124.30.0"
 /begin REF_CHARACTERISTIC ZKTRA ZKFRM ZKFRAU ZKFRAO ZKDTV TVLRA TRAMX TRAMN TMRAO TMRAA TLU4 TLU3 TLU2 TLO3 TLO2 TARA NU3 NO1 NOLRA MLU4 MLU2 MLRU MLRO MLO3 MLO2 MLO1 FRAUMX FRAUMN FRAOMX FRAOMN DTVMX DTVMN /end REF_CHARACTERISTIC
 /begin LOC_MEASUREMENT FRM_B2 FRM_B1 FRAO_B2 FRAO_B1 B_FRA2 B_FRA1 B_FRAO2 B_FRAO1 B_DTV2 B_DTV1 TRADTV_B2 TRADTV_B1 TRA_B2 TRA_B1 FRAU_B2 FRAU_B1 FRA_B2 FRA_B1 DTV_B2 DTV_B1 B_TRA2 B_TRA1 B_LRA2 B_LRA1 B_GASP B_FRAU2 B_FRAU1 TMOT TL8 TANS REDST NIST MLSMW MLSM FR_B2 FR_B1 E_UB E_TM E_TEVE E_HFM B_VL B_SLS B_LR2 B_LR1 B_GA B_DSLS B_ASRAKT /end LOC_MEASUREMENT
/end FUNCTION
/begin FUNCTION _LREB "115.270.0"
 /begin REF_CHARACTERISTIC TRABN1 TRABN TMLRTS TMLRLTS TLRSA TLRAN KFLRVVA KFLRVBA DTMR /end REF_CHARACTERISTIC
 /begin LOC_MEASUREMENT B_LRTMOTH B_LRPSPA FLGLRS2 E_OBDLR B_TLRSA B_LR2 B_LR1 B_LRTL B_LRND2 B_LRND1 TMOT TL8 SDWFL E_LSV1 E_LSH1 E_EV B_VL B_UKG B_TEMIN B_STEND B_SKA B_SBBVK1 B_SA B_REDSA B_NOTLU_FR B_NMAX B_LRKA B_FLL /end LOC_MEASUREMENT
/end FUNCTION
/begin FUNCTION _LRHK "38.10.0"
 /begin REF_CHARACTERISTIC ZUSHKAB ZLRHML ZLASOHML TLRHUN TLLRHO TKATMLRH TBLRH PLRHML PLRHAV NLRHU NLRHO MLLRH LALIUSH KFUSRHK KFFTV KDLAHKPM KDLAHKPF KDLAHKIM KDLAHKIF DUSHKAAB CLRHK ATVINI1 /end REF_CHARACTERISTIC
 /begin LOC_MEASUREMENT USRHK USHKB1 TVLRHP2 TVLRHP1 TVLRHI2 TVLRHI1 MLNKA LAMSOLH LAMHM1 LAMHF1 LAHKMZ1 DLASHKP1 DLASHKM1 DLASHKI1 B_LR2 B_LR1 B_LRSYR B_LRSP2 B_LRSP1 B_DLAHM1 B_ATVINI1 AVKATF2 AVKATF1 ATVINII1 ATVH2 ATVH1 TVLRH2 TVLRH1 LAMSONH1 USHK2W USHK2 USHK1W USHK1 TL8 TKATM NMOT NIST MLSM E_KAT1 E_HSV E_HSH E_HFM B_UKG B_TEHB B_SBBHK2 B_SBBHK1 B_SA B_LRSYNC B_LRKA B_EDKVS2 B_EDKVS1 B_DSLS /end LOC_MEASUREMENT
/end FUNCTION
/begin FUNCTION _LRKA "5.60.0"
 /begin REF_CHARACTERISTIC USHKAMX TSAKAMN TKATMLRH TDFRKAU TDFRKAD NLRKA IMLKAMN ILMLKAXS ILMLKAXD ILMLKAX DWDKLRKA DFRKAML /end REF_CHARACTERISTIC
 /begin LOC_MEASUREMENT TSAKA LRKAZ IMLKA ILMLKA B_WEHKA B_LRKAE DFRKA B_LRKA USHK2W USHK1W TKATM NIST MLSMW FWE DWDKBL B_START B_SLS B_SBBHK2 B_SBBHK1 B_SA B_LR2 B_LR1 B_DSLS /end LOC_MEASUREMENT
/end FUNCTION
/begin FUNCTION _LTK_W "2.0.0" /begin REF_CHARACTERISTIC KFZWTMA FWANSTL /end REF_CHARACTERISTIC /begin LOC_MEASUREMENT TMOT TL8 TANS /end LOC_MEASUREMENT /end FUNCTION
/begin FUNCTION _MLS "62.40.0"
 /begin REF_CHARACTERISTIC TN2LF TN1LF TMLF2 TMLF1 PWMMLF LFREQTMOT LFREQAF2 LFREQAF KFLFREQAC FMLVFZ FMLUB CWKLIMA /end REF_CHARACTERISTIC
 /begin LOC_MEASUREMENT TLFSAR LFREQMOT LFREQFZ LFREAC LFANCOUB LFANCOMAR LFANCOM TVMLF B_NLMLS VFZG UBATT TMOT_L TMABS_W S_LUES2 S_LUES1 PAC B_STEND B_KL15 /end LOC_MEASUREMENT
/end FUNCTION
/begin FUNCTION _NFB "2.10.0"
 /begin REF_CHARACTERISTIC ZABNFB7 ZABNFB6 ZABNFB5 ZABNFB4 ZABNFB3 ZABNFB2 ZABNFB1 SWPEDNOT PWNFB NNFB6 NNFB5 NNFB4 NNFB3 NNFB2 NNFB1 NMAXSW /end REF_CHARACTERISTIC
 /begin LOC_MEASUREMENT B_NOTL SWPT NSOLL_1U NIST_1U B_NOTLU_FR /end LOC_MEASUREMENT
/end FUNCTION
/begin FUNCTION _NST "78.10.0" /begin REF_CHARACTERISTIC KFZNS KFNSLN KFFNS FZNS FUZNSM /end REF_CHARACTERISTIC /begin LOC_MEASUREMENT TMOT B_GV /end LOC_MEASUREMENT /end FUNCTION
/begin FUNCTION _NS_W "2.10.0" /begin REF_CHARACTERISTIC DWNSDN DNWNS /end REF_CHARACTERISTIC /begin LOC_MEASUREMENT DN WNS B_NSW NSOLL_1U NIST_1U B_LL /end LOC_MEASUREMENT /end FUNCTION
/begin FUNCTION _NWS "46.100.0"
 /begin REF_CHARACTERISTIC ZZNWSKH TNWSM TNWSKHM TNWSE TNWM TMNWS TLNWSKHEN TLNWSKHAN TLNWSEN TLNWSAN SWNWSKHEN SWNWSKHAN SWNWSEN SWNWSAN NWSCNF NNWS KLDNNWSM CNFNWS /end REF_CHARACTERISTIC
 /begin LOC_MEASUREMENT B_NWS ZZKH TMOT TL8 SWRES NSOLL_1U NMOT E_NWSE E_DK B_STEND B_LL B_KH /end LOC_MEASUREMENT
/end FUNCTION
/begin FUNCTION _PSOL "4.30.0"
 /begin REF_CHARACTERISTIC SP2SMIN SP2SMAX SP2MIN_T SP2MAX_T SP2LHO_T SP1SMIN SP1SMAX SP1MIN_T SP1MAX_T SP1LHO_T SPS_VG SPS_TL PWGRAMP PWGNOTMA DISP12_T DIF12_VG DIF12_LL /end REF_CHARACTERISTIC
 /begin LOC_MEASUREMENT SP2MIN_C SP2MAX_C SP1MIN_C SP1MAX_C DIFSP12_C B_VPWGERR B_SP2SMIN B_SP2S B_SP2LHOSP B_SP2LHO B_SP1SMIN B_SP1S B_SP1LHOSP B_SP1LHO B_SPSMIN SPS EI_S2MX_FR EI_S2MN_FR EI_S12_FR EI_S1MX_FR EI_S1MN_FR B_FP_SP1S B_FP_SPSMI SP2S SP1S B_UB_OK /end LOC_MEASUREMENT
/end FUNCTION
/begin FUNCTION _SCATT "20.60.0" /begin LOC_MEASUREMENT B_ISOPROT /end LOC_MEASUREMENT /end FUNCTION
/begin FUNCTION _SDKNOT "2.50.0"
 /begin REF_CHARACTERISTIC ZTLFLFN NISTV08 N_DKIST KFIP3S IP23DIF_T IP2SMIN IP2SMAX IP2SEL_T IP2BER_T IP13DIF_T IP123DIF_T IP12DIF_T IP1SMIN IP1SMAX IP1SEL_T IP1BER_T IPDIFKL FANS DKMAXKL DIF_IP23 DIF_IP13 DIF_IP12 /end REF_CHARACTERISTIC
 /begin LOC_MEASUREMENT IP3SN IP2BER_C IP1BER_C IP23DIF_C IP13DIF_C IP123DIF_C IP12DIF_C IPSN_FR B_IP3REQ_F B_IP3OK_FR B_IP2SEL_F B_DKNOT_FR TL_ TANS NIST IP2SN IP2S IP1SN IP1S FDKHA FANS_R E_LM B_UB_OK B_I_SKA_FR /end LOC_MEASUREMENT
/end FUNCTION
/begin FUNCTION _SREAKT "3.10.0" /begin REF_CHARACTERISTIC SPS_MIN PWGRAMP PWGNOTMA IPSNNOT DKMAXKL /end REF_CHARACTERISTIC
 /begin LOC_MEASUREMENT B_R_SKA_FR B_NOTL IP3SN IPSN_FR B_NOTLU_FR B_I_SKA_UM B_I_SKA_FR B_DKNOT_FR /end LOC_MEASUREMENT
/end FUNCTION
/begin FUNCTION _SST "69.5.0"
 /begin REF_CHARACTERISTIC WDKV08 VLFRV06 VCANV08 UBV04 TSTMOTV08 TMOTV08 TL8V16 TATEV08 TANSV08 SWREV08 SWPTV16 SWNLV08 SPSNV08_UM NPEDV08_UM NISTV16 NISTV10 NISTV09 NISTV08 NISTV06 NISTV05 NDKATV05 NDIFV08 MLV06 FDKHAV08 AV08 /end REF_CHARACTERISTIC
/end FUNCTION
/begin FUNCTION _STAT_W "191.100.0" /begin REF_CHARACTERISTIC KFZWVNW KFZWV KFZWNW KFZW KFWLL /end REF_CHARACTERISTIC /begin LOC_MEASUREMENT WKFZW B_PN B_NWS B_HG WSTAT DZWSPAET WOUT_OP TL8Z B_VL /end LOC_MEASUREMENT /end FUNCTION
/begin FUNCTION _ST_W "23.0.0" /begin REF_CHARACTERISTIC WSTN WSTM TNWST /end REF_CHARACTERISTIC /begin LOC_MEASUREMENT NIST B_STEND B_START /end LOC_MEASUREMENT /end FUNCTION
/begin FUNCTION _SU "61.10.0" /begin REF_CHARACTERISTIC WDKSU1N SUCNF DWDKSU /end REF_CHARACTERISTIC /begin LOC_MEASUREMENT B_SU1 WDKBL /end LOC_MEASUREMENT /end FUNCTION
/begin FUNCTION _TC1MOD "20.111.0" /begin REF_CHARACTERISTIC CWOBD /end REF_CHARACTERISTIC
 /begin LOC_MEASUREMENT WDKBA VFZG USVK2 USVK USHK2 USHK TMOTLIN TANSLIN KMSTMIL_W FLGLRS2 FLGLRS B_SLS B_MILSTAT B_ISOPROT /end LOC_MEASUREMENT
/end FUNCTION
/begin FUNCTION _TC2MOD "20.71.0" /begin LOC_MEASUREMENT FFZDFP B_ISOPROT /end LOC_MEASUREMENT /end FUNCTION
/begin FUNCTION _TC5MOD "20.30.0" /begin LOC_MEASUREMENT B_ISOPROT /end LOC_MEASUREMENT /end FUNCTION
/begin FUNCTION _TC6MOD "22.90.0"
 /begin LOC_MEASUREMENT TC6KATW2 TC6KATW TC6KATS2 TC6KATS TC6KATC2 TC6KATC B_ISOPROT B_CDTES B_CDSLS B_CDKAT B_CDAGR /end LOC_MEASUREMENT
/end FUNCTION
/begin FUNCTION _TC8MOD "20.20.0" /begin LOC_MEASUREMENT B_ISOPROT /end LOC_MEASUREMENT /end FUNCTION
/begin FUNCTION _TC9MOD "10.10.0" /begin REF_CHARACTERISTIC FA_CALID /end REF_CHARACTERISTIC /begin LOC_MEASUREMENT B_ISOPROT /end LOC_MEASUREMENT /end FUNCTION
/begin FUNCTION _TCSORT "3.30.0" /begin REF_CHARACTERISTIC CWERFIL /end REF_CHARACTERISTIC /begin LOC_MEASUREMENT CW_ERFIL /end LOC_MEASUREMENT /end FUNCTION
/begin FUNCTION _TEB "52.40.0"
 /begin REF_CHARACTERISTIC ZQTEML ZFTEAML TVTEV TTEMN TTEINI TTEGAINI TTEGA TTEAUS TTEAE TTE TMTE TLRAN TFTEFVA TATEPUU TATEPU TATEPOO TATEPO TATEAD TANSTE KORTATE KFVOBL KFTEFMA KFTEBL KFFTEAX FZQTE FTEHB FTEFVAA FTEFHB FTEADMX FTEADMN FTEADINI FTEADAB FRTEU FRTEO /end REF_CHARACTERISTIC
 /begin LOC_MEASUREMENT VREGO TEVPER TEPHC TATEI FTEFVA FTEAD DFTEAB DFTEA B_TEPI B_TEP B_TEF B_TEABB TATE FTEA B_TEI B_TEHB B_TE B_GA WDKBL TMOT NIST ML E_TEVE B_TLRSA B_STEND B_SLS B_LRAR B_LR B_GASP B_EVLOC /end LOC_MEASUREMENT
/end FUNCTION
/begin FUNCTION _UEBVER "3.0.0" /begin REF_CHARACTERISTIC TABAGUE HGUE5 /end REF_CHARACTERISTIC /begin LOC_MEASUREMENT UEBVER B_HG /end LOC_MEASUREMENT /end FUNCTION
/begin FUNCTION _UFACCC "6.10.0" /begin REF_CHARACTERISTIC BZ_ACC_M ACCNU_T_UM ACCNC_T_UM ACCC_T_UM /end REF_CHARACTERISTIC
 /begin LOC_MEASUREMENT MACC_UM EI_ACCC_UM BZACC_A_UM B_NOACC_UM ACCNU_C_UM ACCC_C_UM CAN_NBABUF CAN_ACCBUF B_NOMNBA B_NOACC_FR /end LOC_MEASUREMENT
/end FUNCTION
/begin FUNCTION _UFEING "11.10.0" /begin LOC_MEASUREMENT SP2S_UM SP1S_UM EVZ_AUS_UM B_UB_OK B_NOTLU_FR B_I_SKA_FR /end LOC_MEASUREMENT /end FUNCTION
/begin FUNCTION _UFFGRC "4.10.0" /begin REF_CHARACTERISTIC VMIN_UM /end REF_CHARACTERISTIC /begin LOC_MEASUREMENT SPSNFGR_UM B_FGR_UM VFZG_W SPSN_FGR B_TEMPFE /end LOC_MEASUREMENT /end FUNCTION
/begin FUNCTION _UFFGRE "10.20.0" /begin REF_CHARACTERISTIC BREMS_T_UM /end REF_CHARACTERISTIC /begin LOC_MEASUREMENT BREMS_C_UM VC_FGR S_BR S_BL B_WA B_SV B_SB B_FGRAB B_AUS /end LOC_MEASUREMENT /end FUNCTION
/begin FUNCTION _UFMIST "1.0.0" /begin REF_CHARACTERISTIC KFMI_UM DZWV08_UM /end REF_CHARACTERISTIC /end FUNCTION
/begin FUNCTION _UFMSRC "21.10.0" /begin REF_CHARACTERISTIC MSRNU_T_UM MSRC_T_UM BZ_MSR_M /end REF_CHARACTERISTIC
 /begin LOC_MEASUREMENT MSRNU_C_UM MSRC_C_UM MMSR_UM EI_MSRC_UM BZMSR_A_UM B_NOMSR_UM CAN_ASRBUF B_NOMSR_FR /end LOC_MEASUREMENT
/end FUNCTION
/begin FUNCTION _UFMZF "1.10.0" /begin REF_CHARACTERISTIC MZFTV_UM MZFFIL_UM /end REF_CHARACTERISTIC /begin LOC_MEASUREMENT MZF_LOW_UM MZF_UM MZ_UM /end LOC_MEASUREMENT /end FUNCTION
/begin FUNCTION _UFMZUL "14.10.0"
 /begin REF_CHARACTERISTIC VC_ACC SPSMV08_UM NMV08_UM MDV08_UM KFMZS_UM KFMZOF_UM KFMZB_UM /end REF_CHARACTERISTIC
 /begin LOC_MEASUREMENT SPSNMAX_UM MPED_UM MZ_UM MZO_UM SPSN_UM SPSNFGR_UM NIST_UM MSGS_UM MMSR_UM MACC_UM /end LOC_MEASUREMENT
/end FUNCTION
/begin FUNCTION _UFNSC "1.10.0" /begin REF_CHARACTERISTIC BOGON_T_UM /end REF_CHARACTERISTIC /end FUNCTION
/begin FUNCTION _UFREAC "2.21.0" /begin REF_CHARACTERISTIC RST_TV_UM REAC_T2_UM REAC_T1_UM KLNPED_UM /end REF_CHARACTERISTIC
 /begin LOC_MEASUREMENT REAC_C2_UM REAC_C1_UM NSKA_UM RST_TV EI_REAC_UM B_I_SKA_UM SPSN_UM NIST_UM EVZ_AUS_UM /end LOC_MEASUREMENT
/end FUNCTION
/begin FUNCTION _UFSGSC "9.10.0" /begin REF_CHARACTERISTIC SGSNU_T_UM SGSC_T_UM BZ_SGS_M /end REF_CHARACTERISTIC
 /begin LOC_MEASUREMENT SGSNU_C_UM SGSC_C_UM MSGS_UM EI_SGSC_UM BZSGS_A_UM B_NOSGS_UM CAN_SGSBUF B_NOSGS_FR /end LOC_MEASUREMENT
/end FUNCTION
/begin FUNCTION _UFSPSC "10.10.0" /begin REF_CHARACTERISTIC SP12VG_UM SP12LL_UM SPSVG_UM SPSC_T_UM /end REF_CHARACTERISTIC
 /begin LOC_MEASUREMENT SP2S_UM SP1S_UM SPSC_C_UM SPSN_UM EI_SPSC_UM B_I_SKA_UM B_SP2S B_SP1S B_SPSMIN /end LOC_MEASUREMENT
/end FUNCTION
/begin FUNCTION _UKSEFI "54.20.0"
 /begin REF_CHARACTERISTIC ZVALM ZUKNST ZUKK ZBALM TNSUUK TLWNSP TEUKGNSP SDWFLU NSWO KLWF KFVAKL KFBAKL KFAVAK KFABAK FVAWN FVAWM FVANST FUKNSTM FBAWN FBAWM DUKK DLUKW CUKWLL /end REF_CHARACTERISTIC
 /begin LOC_MEASUREMENT TEUKWM TEUKL TEUKK SDWFL SDWFK SDTLW B_RESWLL B_REDW B_REDKL TEUKG B_UKG B_NSP TL8 TLW E_DK B_LL /end LOC_MEASUREMENT
/end FUNCTION
/begin FUNCTION _URADCC "2.20.0" /begin REF_CHARACTERISTIC SP1_STAT_T SP1_STAT SP1ADC_DIF ADCC_T_UM /end REF_CHARACTERISTIC
 /begin LOC_MEASUREMENT SP1S_ST_UM SP1S_A_UM SP1P_ST_UM SP1P_A_UM ADCC_C_UM EI_ADCC_UM B_I_SKA_UM /end LOC_MEASUREMENT
/end FUNCTION
/begin FUNCTION _URMEM "1.11.0" /begin REF_CHARACTERISTIC RST_TV_UM /end REF_CHARACTERISTIC /begin LOC_MEASUREMENT RST_TV /end LOC_MEASUREMENT /end FUNCTION
/begin FUNCTION _URROM "1.10.0" /end FUNCTION
/begin FUNCTION _VAR "302.20.0" /begin REF_CHARACTERISTIC VC_GETR FGRENABLE /end REF_CHARACTERISTIC /begin LOC_MEASUREMENT VC_FGR B_SELESP B_URSTA B_HG B_GV B_AUS /end LOC_MEASUREMENT /end FUNCTION
/begin FUNCTION _VTEMBED "3.60.0"
 /begin REF_CHARACTERISTIC VC_GETR TSTFLT_T TSTFL_T T_FGREN FGR_VMIN FGR_VMAX FGR_VAUS A_POS_FT A_NEG_FT A_FGR_POS A_FGR_NEG /end REF_CHARACTERISTIC
 /begin LOC_MEASUREMENT TSTFLT_C TASTE_NEU TASTE_ALT B_WA_HIGH B_SV_HIGH B_SB_HIGH B_NO_TM_FR A_NEG_FC EI_APOS_FR EI_ANEG_FR B_WA B_TM_EIN B_TM_AB_FR B_SV B_SB B_FGR_2T B_FGR_PL B_FGRENF B_AUS VFZG_W VC_FGR NIST GANG_I E_MD E_LM E_KUPPL E_EV E_CEGS E_BREMSE B_TEMPFE B_RGE B_PN B_NOTLU_FR B_NMAX B_KUP B_I_SKA_UM B_I_SKA_FR B_HG B_GV BFZGL_B B_DKNOT_FR B_BREMSE /end LOC_MEASUREMENT
/end FUNCTION
/begin FUNCTION _VTEMLAMP "1.20.0" /begin REF_CHARACTERISTIC T_LAMPE /end REF_CHARACTERISTIC /begin LOC_MEASUREMENT B_FGRLA VC_FGR B_NO_TM_FR B_NMIN B_LAMPE B_FGRENF /end LOC_MEASUREMENT /end FUNCTION
/begin FUNCTION _VTEMREG "4.90.0"
 /begin REF_CHARACTERISTIC WASOLL_A WA_DV_3 WA_DV_2 WA_DV_1 WA_B_4 WA_B_3 WA_B_2 V_SOLL_U V_SOLL_O V_OFFMIN V_OFFMAX VCANV08 TZ_FGR1 TZ_FGR TSTFLT_T TN_FGR1 TN_FGR TIP_UP TIP_DOWN TEMPFELL SW_TEMPN1 SW_TEMPN SV_STA SOLL_A K_R_FGR1 K_R_FGR KORR_V_T KORR_B_T K_FGR1 K_FGR FGR_VMIN FGR_VMAX FGR_VAUS DVTIPUD DELTA_V2 DELTA_V1 DELTA_FP BP_KORR BM_ZEIT BM_KORR AUS_Z_WA AUS_Z A_NEG_FT A_FGR_POS /end REF_CHARACTERISTIC
 /begin LOC_MEASUREMENT WA_RAMPE V_SOLL V_REGLER_1 V_REGLER V_OFF TSTFLT_C TASTE_NEU TASTE_ALT SW_TEMP SIGNALZEIT KORR_V_C KORR_B_C FGRFKT B_FGR_VG A_NEG_FC B_TM_EIN B_TM_AB_FR B_FPAKT GANG_I B_WA B_TEMPFE B_SV B_SB B_BREMSE /end LOC_MEASUREMENT
/end FUNCTION
/begin FUNCTION _V_BEGR "15.0.0" /begin REF_CHARACTERISTIC VVORH VMAXO VHYST VABSCH PV_VMAX IV_VMAX AV08 /end REF_CHARACTERISTIC /begin LOC_MEASUREMENT B_VVORH B_VMAXO A_POS SW_VMAX TL8 SW_NACHL DFV /end LOC_MEASUREMENT /end FUNCTION
/begin FUNCTION _WFS "4.0.0"
 /begin REF_CHARACTERISTIC VWFSMX TWFSVU TWFSPROH TDWFSVN SWFSRCHH KWFSOPT KWFSE CDTWFS /end REF_CHARACTERISTIC
/end FUNCTION
/begin FUNCTION _WL_E "83.50.0" /begin REF_CHARACTERISTIC KFWLM KFWLLL KFWL KFFWLW FLKHM FKHM /end REF_CHARACTERISTIC /begin LOC_MEASUREMENT FWL TMOT TL8 B_SA B_LL /end LOC_MEASUREMENT /end FUNCTION
/begin FUNCTION _WL_W "113.10.0" /begin REF_CHARACTERISTIC WTLM WLLM KFWLW KFWLLW /end REF_CHARACTERISTIC /begin LOC_MEASUREMENT B_SA B_LL WWL TMOT TL8 NIST /end LOC_MEASUREMENT /end FUNCTION
/begin FUNCTION _ZUE "276.40.0" /begin REF_CHARACTERISTIC WPHN WMINME WMAXMEN KFSZT /end REF_CHARACTERISTIC
 /begin LOC_MEASUREMENT WZWB WWL WVS5 WVS4 WVS3 WVS2 WVS1 WVS0 WVS WTANS WSTAT WOUT_OP WOUT WNS WMDZ WLLR WKRDY WKR WKH WGS WCALC WBER WARDY B_START B_HG WBERKRM /end LOC_MEASUREMENT
/end FUNCTION
/begin FUNCTION _ZWB "25.1.0"
 /begin REF_CHARACTERISTIC TLZWB DZUE5 DZUE4 DZUE3 DZUE2 DZUE1 DNZB DINK5 DINK4 DINK3 DINK2 DINK1 /end REF_CHARACTERISTIC
/end FUNCTION
/begin FUNCTION _ZWSAWE "6.20.0"
 /begin REF_CHARACTERISTIC WEOFF UWEW UWEH TLSN SAONKUP SAON NGWE FIMWU FIMHU DZWENW DZWENH DZUE5 DZUE4 DZUE3 DTSA DTLWE DNWEK DNSAL DNSAH DINK5 DINK4 DINK3 /end REF_CHARACTERISTIC
 /begin LOC_MEASUREMENT NWE NAB B_WEH B_WE B_SA B_LL B_AC /end LOC_MEASUREMENT
/end FUNCTION
/end MODULE
/end PROJECT
