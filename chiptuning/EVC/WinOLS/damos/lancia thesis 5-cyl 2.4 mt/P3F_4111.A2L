ASAP2_VERSION 1 3
/begin PROJECT _ " [ME.ME3.1C.09.4111.DAMOS25]  DAMPAR_04"
/begin HEADER "Lancia Thesis 5-Zyl. 2,4 MT" PROJECT_NO 411.1 VERSION "P2FJGD66" /end HEADER
/begin MODULE DIM " "
/begin MOD_COMMON " " S_REC_LAYOUT DAMOS DEPOSIT ABSOLUTE BYTE_ORDER MSB_LAST /end MOD_COMMON
/begin RECORD_LAYOUT DAMOS_FW1 FNC_VALUES 1 UBYTE COLUMN_DIR DIRECT /end RECORD_LAYOUT
/begin RECORD_LAYOUT DAMOS_FW3 FNC_VALUES 1 UWORD COLUMN_DIR DIRECT /end RECORD_LAYOUT
/begin RECORD_LAYOUT DAMOS_GKL1 FNC_VALUES 1 UBYTE COLUMN_DIR DIRECT /end RECORD_LAYOUT
/begin RECORD_LAYOUT DAMOS_FW2 FNC_VALUES 1 SBYTE COLUMN_DIR DIRECT /end RECORD_LAYOUT
/begin AXIS_PTS AV08 "Beschleunigungsstuetzstellen" 0x8ECE A_POS DAMOS_SST103 0 U_A 8 -22.222080 22.048470 EXTENDED_LIMITS -22.222100 22.048500 /end AXIS_PTS
/begin RECORD_LAYOUT DAMOS_SST103 SRC_ADDR_X 1 UWORD NO_AXIS_PTS_X 2 UBYTE AXIS_PTS_X 3 SBYTE INDEX_INCR DIRECT /end RECORD_LAYOUT
/begin RECORD_LAYOUT DAMOS_KL97 SRC_ADDR_X 1 UWORD NO_AXIS_PTS_X 2 UBYTE AXIS_PTS_X 3 UBYTE INDEX_INCR DIRECT FNC_VALUES 4 UBYTE COLUMN_DIR DIRECT /end RECORD_LAYOUT
/begin RECORD_LAYOUT DAMOS_FKL1 FNC_VALUES 1 UBYTE COLUMN_DIR DIRECT /end RECORD_LAYOUT
/begin RECORD_LAYOUT DAMOS_FKL3 FNC_VALUES 1 UWORD COLUMN_DIR DIRECT /end RECORD_LAYOUT
/begin RECORD_LAYOUT DAMOS_ASCII FNC_VALUES 1 UBYTE COLUMN_DIR DIRECT /end RECORD_LAYOUT
/begin RECORD_LAYOUT DAMOS_FW4 FNC_VALUES 1 SWORD COLUMN_DIR DIRECT /end RECORD_LAYOUT
/begin RECORD_LAYOUT DAMOS_GKF1 FNC_VALUES 1 UBYTE COLUMN_DIR DIRECT /end RECORD_LAYOUT
/begin RECORD_LAYOUT DAMOS_SST97 SRC_ADDR_X 1 UWORD NO_AXIS_PTS_X 2 UBYTE AXIS_PTS_X 3 UBYTE INDEX_INCR DIRECT /end RECORD_LAYOUT
/begin AXIS_PTS DUM08 "Dummystuetzstellen" 0x8E84 IR0 DAMOS_SST97 0 DEZ 8 0.000000 256.000000 /end AXIS_PTS
/begin RECORD_LAYOUT DAMOS_KL98 SRC_ADDR_X 1 UWORD NO_AXIS_PTS_X 2 UBYTE AXIS_PTS_X 3 UBYTE INDEX_INCR DIRECT FNC_VALUES 4 SBYTE COLUMN_DIR DIRECT /end RECORD_LAYOUT
/begin AXIS_PTS FDKHAV08 "Hoehenabhg. DK-Adaptionsfaktor-Stuetzstellen" 0x8EDA FDKHA DAMOS_SST97 0 FKT128 8 0.000000 1.992188 EXTENDED_LIMITS 0.000000 1.992190 /end AXIS_PTS
/begin RECORD_LAYOUT DAMOS_FWB1 FNC_VALUES 1 UBYTE COLUMN_DIR DIRECT /end RECORD_LAYOUT
/begin AXIS_PTS MLV06 "Luftmassenstuetzstellen" 0x8DBC MLSM DAMOS_SST97 0 MLSMQ 6 0.000000 1024.000000 /end AXIS_PTS
/begin AXIS_PTS NDIFV08 "Drehzahldifferenzbetrags-Stützstellenverteilung" 0x8EF2 NDIF DAMOS_SST97 0 NQ5 8 0.000000 1275.000000 /end AXIS_PTS
/begin AXIS_PTS NDKATV05 "Drehzahlstuetzstellen f. DKAT" 0x8DE4 NIST DAMOS_SST97 0 NQ25 5 0.000000 6400.000000 /end AXIS_PTS
/begin AXIS_PTS NDMDV08 "Drehzahlstuetzstellen f. DMD" 0x8CFC NIST DAMOS_SST97 0 NQ25 8 0.000000 6400.000000 /end AXIS_PTS
/begin AXIS_PTS NFOV06 "Drehzahlstuezstellen" 0x8CEC NIST DAMOS_SST97 0 NQ25 6 0.000000 6400.000000 /end AXIS_PTS
/begin CHARACTERISTIC NGANGMIN "Schwelle für Gangerkennung, Mindestwert Plausibilitätstest" VALUE 0x851E DAMOS_FW3 0 NQ025_W 0.000000 12000.000000 /end CHARACTERISTIC
/begin CHARACTERISTIC NGRADFIL "EGAS Nmax Filterkonstante fuer Drehzahlgradient" VALUE 0x81B5 DAMOS_FW1 0 PCENT 0.000000 99.609380 EXTENDED_LIMITS 0.000000 99.609400 /end CHARACTERISTIC
/begin CHARACTERISTIC NGWE "Drehzahlgradientenschwelle, Wiedereinsetzen" VALUE 0x811B DAMOS_FW1 0 NGRDQ40 0.000000 10200.000000 /end CHARACTERISTIC
/begin AXIS_PTS NISTV05 "Drehzahlstuetzstellenverteilung" 0x8D34 NIST DAMOS_SST97 0 NQ25 4 0.000000 6400.000000 /end AXIS_PTS
/begin AXIS_PTS NISTV08 "Drehzahlstützstellenverteilung" 0x8D44 NIST DAMOS_SST97 0 NQ25 8 0.000000 6400.000000 /end AXIS_PTS
/begin AXIS_PTS NISTV10 "Drehzahlstuetzstellenverteilung" 0x8D5C NIST DAMOS_SST97 0 NQ25 9 0.000000 6400.000000 /end AXIS_PTS
/begin CHARACTERISTIC NKH "Drehzahlschwelle KAT-Heizung" VALUE 0x8171 DAMOS_FW1 0 NQ25 0.000000 6400.000000 /end CHARACTERISTIC
/begin CHARACTERISTIC NKRA "Ein-Aus-Schalt-Drehzahlschwelle für Klopfadaption" VALUE 0x8295 DAMOS_FW1 0 NQ25 0.000000 6400.000000 /end CHARACTERISTIC
/begin CHARACTERISTIC NKRF "N-Schwelle fuer Klopfregelung aktiv" VALUE 0x828A DAMOS_FW1 0 NQ25 0.000000 6400.000000 /end CHARACTERISTIC
/begin CHARACTERISTIC NKRREFIN "Drehzahlschwelle für Einrechnen von REFINI" VALUE 0x82AC DAMOS_FW1 0 NQ40 0.000000 10200.000000 /end CHARACTERISTIC
/begin CHARACTERISTIC NKSM "Übergangsdrehzahl Startbereiche B1 -> B2" CURVE 0x94CE DAMOS_KL97 0 NQ25 0.000000 6400.000000 /begin AXIS_DESCR STD_AXIS TMOT CMO_TMP 5 -41.000000 140.000000 /end AXIS_DESCR /end CHARACTERISTIC
/begin CHARACTERISTIC NKTDX "maximale Drehzahlgrenze DKAT fuer Berechnung" VALUE 0x8396 DAMOS_FW1 0 NQ25 0.000000 6400.000000 /end CHARACTERISTIC
/begin CHARACTERISTIC NLRHO "obere Drehzahlgrenze fuer Regelung hinter KAT" VALUE 0x820D DAMOS_FW1 0 NQ25 0.000000 6400.000000 /end CHARACTERISTIC
/begin CHARACTERISTIC NLRHU "untere Drehzahlgrenze fuer Regelung hinter KAT" VALUE 0x820C DAMOS_FW1 0 NQ25 0.000000 6400.000000 /end CHARACTERISTIC
/begin CHARACTERISTIC NLRKA "N-Schwelle ueber der LRKA gesperrt wird" VALUE 0x8573 DAMOS_FW1 0 NQ25 0.000000 6400.000000 /end CHARACTERISTIC
/begin CHARACTERISTIC NMAXAT "Grenzdrehzahl bei Getriebeschutz" VALUE 0x81AA DAMOS_FW1 0 NQ40 0.000000 10200.000000 /end CHARACTERISTIC
/begin CHARACTERISTIC NMAXD "Dauer-Grenzdrehzahl" VALUE 0x81A8 DAMOS_FW1 0 NQ40 0.000000 10200.000000 /end CHARACTERISTIC
/begin CHARACTERISTIC NMAXDE "Dauerdrehzahl fuer Drehzahlregler" CURVE 0xC473 DAMOS_GKL1 0 NQ40 0.000000 10200.000000
 /begin AXIS_DESCR COM_AXIS TMOT CMO_TMP 12 0.000000 0.000000 AXIS_PTS_REF TMOTV08 EXTENDED_LIMITS -41.000000 140.000000 /end AXIS_DESCR
/end CHARACTERISTIC
/begin CHARACTERISTIC NMAXDV "Maximaldrehzahl bei fehlerhaftem V-Signal" VALUE 0x81A6 DAMOS_FW1 0 NQ40 0.000000 10200.000000 /end CHARACTERISTIC
/begin CHARACTERISTIC NMAXE_C "EGAS NMAX Anzahl der Stufen beim I_Setzwert" VALUE 0x81B6 DAMOS_FW1 0 DEZ 0.000000 256.000000 /end CHARACTERISTIC
/begin CHARACTERISTIC NMAXK "Kurzzeit-Grenzdrehzahl" VALUE 0x81A9 DAMOS_FW1 0 NQ40 0.000000 10200.000000 /end CHARACTERISTIC
/begin CHARACTERISTIC NMAXKE "Kurzzeit-Grenzdrehzahl EGAS-Regler" VALUE 0x81B4 DAMOS_FW1 0 NQ40 0.000000 10200.000000 /end CHARACTERISTIC
/begin CHARACTERISTIC NMAXR "Reset-Drehzahlschwelle fuer Ueberdrehzaehler" VALUE 0x81A7 DAMOS_FW1 0 NQ40 0.000000 10200.000000 /end CHARACTERISTIC
/begin CHARACTERISTIC NMAXRE "Reset-Drehzahlschwelle fuer Ueberdrehzaehler EGAS-Regler" VALUE 0x81B3 DAMOS_FW1 0 NQ40 0.000000 10200.000000 /end CHARACTERISTIC
/begin CHARACTERISTIC NMAXSGS "Geschwindigkeitsschwelle durch Selespeed-SG" VALUE 0x81AC DAMOS_FW1 0 NQ40 0.000000 10200.000000 /end CHARACTERISTIC
/begin CHARACTERISTIC NMAXSW "Maximal-Drehzahl als Funktion des Pedal- u. Tempomat-Sollwerts" CURVE 0xC0A9 DAMOS_GKL1 0 NQ32 0.000000 8160.000000
 /begin AXIS_DESCR COM_AXIS SWPT PER255 16 0.000000 0.000000 AXIS_PTS_REF SWPTV16 EXTENDED_LIMITS 0.000000 100.000000 /end AXIS_DESCR
/end CHARACTERISTIC
/begin CHARACTERISTIC NMAXU "Untere NMAX-Schwelle fuer Drehzahlbegrenzungserfassung" VALUE 0x81C6 DAMOS_FW1 0 NQ40 0.000000 10200.000000 /end CHARACTERISTIC
/begin CHARACTERISTIC NMAXWF "Grenzdrehzahl bei Wandler-Fliehkraftschutz" VALUE 0x81B1 DAMOS_FW1 0 NQ40 0.000000 10200.000000 /end CHARACTERISTIC
/begin CHARACTERISTIC NMIALU "Min. Drehzahl fuer Ausblendung der Aussetzererkennung" VALUE 0x8302 DAMOS_FW1 0 NQ25 0.000000 6400.000000 /end CHARACTERISTIC
/begin CHARACTERISTIC NMIN "Minimaldrehzahl" VALUE 0x81A4 DAMOS_FW3 0 NQ1_W 0.000000 8000.000000 /end CHARACTERISTIC
/begin CHARACTERISTIC NMIN_UM "Minimaldrehzahl f. FU" VALUE 0x87F1 DAMOS_FW1 0 NQ25 0.000000 6400.000000 /end CHARACTERISTIC
/begin CHARACTERISTIC NMOT_HI "Kein Leerlauf ab dieser Schwelle aufwaerts" VALUE 0x859C DAMOS_FW3 0 NQ1_W 0.000000 8000.000000 /end CHARACTERISTIC
/begin CHARACTERISTIC NMOT_LO "Leerlauf ab dieser Schwelle aufwaerts" VALUE 0x859E DAMOS_FW3 0 NQ1_W 0.000000 8000.000000 /end CHARACTERISTIC
/begin CHARACTERISTIC NMXALU "Max. Drehzahl fuer Ausblendung der Aussetzererkennung" VALUE 0x8303 DAMOS_FW1 0 NQ25 0.000000 6400.000000 /end CHARACTERISTIC
/begin CHARACTERISTIC NMXALU1 "Max. Drehzahl fuer Ausblendung der Aussetzererkennung" VALUE 0x8304 DAMOS_FW1 0 NQ25 0.000000 6400.000000 /end CHARACTERISTIC
/begin CHARACTERISTIC NNFB1 "Drehzahl-Schwelle1 fuer Zylinder-Abschaltung" VALUE 0x876A DAMOS_FW1 0 NQ25 0.000000 6400.000000 /end CHARACTERISTIC
/begin CHARACTERISTIC NNFB2 "Drehzahl-Schwelle2 fuer Zylinder-Abschaltung" VALUE 0x876B DAMOS_FW1 0 NQ25 0.000000 6400.000000 /end CHARACTERISTIC
/begin CHARACTERISTIC NNFB3 "Drehzahl-Schwelle3 fuer Zylinder-Abschaltung" VALUE 0x876C DAMOS_FW1 0 NQ25 0.000000 6400.000000 /end CHARACTERISTIC
/begin CHARACTERISTIC NNFB4 "Drehzahl-Schwelle4 fuer Zylinder-Abschaltung" VALUE 0x876D DAMOS_FW1 0 NQ25 0.000000 6400.000000 /end CHARACTERISTIC
/begin CHARACTERISTIC NNFB5 "Drehzahl-Schwelle5 fuer Zylinder-Abschaltung" VALUE 0x876E DAMOS_FW1 0 NQ25 0.000000 6400.000000 /end CHARACTERISTIC
/begin CHARACTERISTIC NNFB6 "Drehzahl-Schwelle6 fuer Zylinder-Abschaltung" VALUE 0x876F DAMOS_FW1 0 NQ25 0.000000 6400.000000 /end CHARACTERISTIC
/begin CHARACTERISTIC NNST "Drehzahluebergang Normal -> Start" VALUE 0x8114 DAMOS_FW3 0 NQ1_W 0.000000 8000.000000 /end CHARACTERISTIC
/begin CHARACTERISTIC NNWS "Drehzahlschwelle der NWS-Umschaltung für LL" VALUE 0x8231 DAMOS_FW1 0 NQ40 0.000000 10200.000000 /end CHARACTERISTIC
/begin CHARACTERISTIC NO1 "Grenze fuer Adaptionsbereichs-Bestimmung" VALUE 0x8217 DAMOS_FW1 0 NQ25 0.000000 6400.000000 /end CHARACTERISTIC
/begin CHARACTERISTIC NOLRA "Enable/Disable-Bits (0/1) der LRA-Integration" VALUE 0x822B DAMOS_FW1 0 DEZ 0.000000 256.000000 /end CHARACTERISTIC
/begin CHARACTERISTIC NORED "Unterdrueckung Reduzierstufen" VALUE 0x878F DAMOS_FW1 0 DEZ 0.000000 256.000000 /end CHARACTERISTIC
/begin CHARACTERISTIC NOT_KL "Pedalkennlinie beim PWG-Notfahren " CURVE 0xBED4 DAMOS_KL97 0 PER255 0.000000 100.000000 /begin AXIS_DESCR STD_AXIS SWPT PER255 16 0.000000 100.000000 /end AXIS_DESCR /end CHARACTERISTIC
/begin CHARACTERISTIC NPMOL1 "Obere Drehzahlschwelle für Oeldurckschalterdiag. " VALUE 0x8442 DAMOS_FW3 0 NQ1_W 0.000000 8000.000000 /end CHARACTERISTIC
/begin CHARACTERISTIC NRALLM "Drehzahlschwelle für Lambda-Regler aus im Leerlauf" CURVE 0x9B60 DAMOS_KL97 0 NQ40 0.000000 10200.000000 /begin AXIS_DESCR STD_AXIS TMOT CMO_TMP 7 -41.000000 140.000000 /end AXIS_DESCR /end CHARACTERISTIC
/begin CHARACTERISTIC NREDMIN " Drehzahlschwelle fuer EV Ausblendung im LL" VALUE 0x878E DAMOS_FW1 0 NQ40 0.000000 10200.000000 /end CHARACTERISTIC
/begin CHARACTERISTIC NREDMSR "MSR-Drehzahlschwelle" VALUE 0x8611 DAMOS_FW1 0 NQ25 0.000000 6400.000000 /end CHARACTERISTIC
/begin CHARACTERISTIC NSC_T_UM "Max. Nachstartzeit der FU" VALUE 0x8814 DAMOS_FW3 0 UMFNSC 0.000000 2621400.000000 /end CHARACTERISTIC
/begin CHARACTERISTIC NSFTNS "Hintergrund-TN-Sollwert im Nachstart bei Fahrt als f(TMST)" CURVE 0xBF27 DAMOS_GKL1 0 UTNQ 352.941200 90000.000000
 /begin AXIS_DESCR COM_AXIS TMST CMO_TMP 12 0.000000 0.000000 AXIS_PTS_REF TSTMOTV08 EXTENDED_LIMITS -41.000000 140.000000 /end AXIS_DESCR
 EXTENDED_LIMITS 352.941000 90000.000000 /end CHARACTERISTIC
/begin CHARACTERISTIC NSFTNS1 "Hintergrund-TN-Sollwert im Nachstart bei Fahrt als f(TMST), B_GV = 1" CURVE 0xC39F DAMOS_GKL1 0 UTNQ 352.941200 90000.000000
 /begin AXIS_DESCR COM_AXIS TMST CMO_TMP 12 0.000000 0.000000 AXIS_PTS_REF TSTMOTV08 EXTENDED_LIMITS -41.000000 140.000000 /end AXIS_DESCR
 EXTENDED_LIMITS 352.941000 90000.000000 /end CHARACTERISTIC
/begin CHARACTERISTIC NSFUG "Nachstart-Untergrenzen-Anteil bei Fahrt als f(TMOT)" CURVE 0xBF6C DAMOS_GKL1 0 UWKL10 0.000000 10.069900
 /begin AXIS_DESCR COM_AXIS TMOT CMO_TMP 12 0.000000 0.000000 AXIS_PTS_REF TMOTV08 EXTENDED_LIMITS -41.000000 140.000000 /end AXIS_DESCR
/end CHARACTERISTIC
/begin CHARACTERISTIC NSNTNS "Hintergrund-TN-Sollwert im Nachstart bei Neutral als f(TMST)" CURVE 0xBF1B DAMOS_GKL1 0 UTNQ 352.941200 90000.000000
 /begin AXIS_DESCR COM_AXIS TMST CMO_TMP 12 0.000000 0.000000 AXIS_PTS_REF TSTMOTV08 EXTENDED_LIMITS -41.000000 140.000000 /end AXIS_DESCR
 EXTENDED_LIMITS 352.941000 90000.000000 /end CHARACTERISTIC
/begin CHARACTERISTIC NSNTNS1 "Hintergrund-TN-Sollwert im Nachstart bei Neutral als f(TMST), b_gv = 1" CURVE 0xC393 DAMOS_GKL1 0 UTNQ 352.941200 90000.000000
 /begin AXIS_DESCR COM_AXIS TMST CMO_TMP 12 0.000000 0.000000 AXIS_PTS_REF TSTMOTV08 EXTENDED_LIMITS -41.000000 140.000000 /end AXIS_DESCR
 EXTENDED_LIMITS 352.941000 90000.000000 /end CHARACTERISTIC
/begin CHARACTERISTIC NSNUG "Nachstart-Untergrenzen-Anteil bei Neutral als f(TMOT)" CURVE 0xBF60 DAMOS_GKL1 0 UWKL10 0.000000 10.069900
 /begin AXIS_DESCR COM_AXIS TMOT CMO_TMP 12 0.000000 0.000000 AXIS_PTS_REF TMOTV08 EXTENDED_LIMITS -41.000000 140.000000 /end AXIS_DESCR
/end CHARACTERISTIC
/begin CHARACTERISTIC NSPLT "Nachstart-Plateauzeit als f(TMST)" CURVE 0xBF33 DAMOS_GKL1 0 TQ800 0.000000 51.200000
 /begin AXIS_DESCR COM_AXIS TMST CMO_TMP 12 0.000000 0.000000 AXIS_PTS_REF TSTMOTV08 EXTENDED_LIMITS -41.000000 140.000000 /end AXIS_DESCR
 EXTENDED_LIMITS 0.000000 204.000000 /end CHARACTERISTIC
/begin CHARACTERISTIC NSTNM "Motortemperaturabhaengige Uebergangsdrehzahl Start -> Normal" CURVE 0x9548 DAMOS_GKL1 0 NQ25 0.000000 6400.000000
 /begin AXIS_DESCR COM_AXIS TMOT CMO_TMP 12 0.000000 0.000000 AXIS_PTS_REF TMOTV08 EXTENDED_LIMITS -41.000000 140.000000 /end AXIS_DESCR
/end CHARACTERISTIC
/begin CHARACTERISTIC NSWO "Drehzahlschwelle für Freigabe Übergangskompensation" VALUE 0x8149 DAMOS_FW1 0 NQ25 0.000000 6400.000000 /end CHARACTERISTIC
/begin CHARACTERISTIC NS_B_RP "Rampe fuer Obergr. von Nachstart- auf Betri.-Wert" VALUE 0x85A8 DAMOS_FW3 0 UDKL 0.000000 10.112030 EXTENDED_LIMITS 0.000000 10.112000 /end CHARACTERISTIC
/begin CHARACTERISTIC NS_OG "Nachstart-Obergrenze als f(TMST)" CURVE 0xBF4B DAMOS_GKL1 0 UWKL15 0.000000 15.110220
 /begin AXIS_DESCR COM_AXIS TMST CMO_TMP 12 0.000000 0.000000 AXIS_PTS_REF TSTMOTV08 EXTENDED_LIMITS -41.000000 140.000000 /end AXIS_DESCR
 EXTENDED_LIMITS 0.000000 15.110200 /end CHARACTERISTIC
/begin CHARACTERISTIC NTLIP_UM "Minimaldrehzahl f. tl-Vergleich f. FU" VALUE 0x87FE DAMOS_FW1 0 NQ25 0.000000 6400.000000 /end CHARACTERISTIC
/begin CHARACTERISTIC NTPKTO "obere Drehzahlschwelle fuer Periodendauer-Kurztest" VALUE 0x8325 DAMOS_FW1 0 NQ40 0.000000 10200.000000 /end CHARACTERISTIC
/begin CHARACTERISTIC NTPKTU "untere Drehzahlschwelle fuer Periodendauer-Kurztest" VALUE 0x8326 DAMOS_FW1 0 NQ40 0.000000 10200.000000 /end CHARACTERISTIC
/begin CHARACTERISTIC NTPVKO "obere Drehzahlschwelle fuer Periodendauerueberwachung vor Kat" VALUE 0x8327 DAMOS_FW1 0 NQ40 0.000000 10200.000000 /end CHARACTERISTIC
/begin CHARACTERISTIC NTPVKU "untere Drehzahlschwelle fuer Periodendauerueberwachung vor Kat" VALUE 0x8328 DAMOS_FW1 0 NQ40 0.000000 10200.000000 /end CHARACTERISTIC
/begin CHARACTERISTIC NU3 "Grenze fuer Adaptionsbereichs-Bestimmung (untere Schwelle fuer dtv)" VALUE 0x8218 DAMOS_FW1 0 NQ25 0.000000 6400.000000 /end CHARACTERISTIC
/begin CHARACTERISTIC NWSCNF "Konfiguration des NWS-Relais (1=pos. Logik)" VALUE 0x8232 DAMOS_FW1 0 DEZ 0.000000 256.000000 /end CHARACTERISTIC
/begin CHARACTERISTIC NZMUL_UM "Mult. f. Umre. Zahnerf. in Drehzahl f. FU" VALUE 0x87F6 DAMOS_FW3 0 NZZEQL 1.000000 8081.896000 EXTENDED_LIMITS 1.000000 8081.900000 /end CHARACTERISTIC
/begin CHARACTERISTIC N_DKIST "Drehzahlschw. fuer Istwert-Plaus." VALUE 0x865B DAMOS_FW1 0 NQ25 0.000000 1300.000000 EXTENDED_LIMITS 0.000000 6400.000000 /end CHARACTERISTIC
/begin CHARACTERISTIC N_FPR "Drehzahlschwelle fuer Federpruefungsabbruch" VALUE 0x84BE DAMOS_FW3 0 NQ1_W 0.000000 200.000000 EXTENDED_LIMITS 0.000000 8000.000000 /end CHARACTERISTIC
/begin CHARACTERISTIC N_I_OF "Drehzahl-Offset f. I-Verstaerkungs-Umschaltung, LFR" VALUE 0x85D6 DAMOS_FW3 0 NQ1_W 0.000000 8000.000000 /end CHARACTERISTIC
/begin CHARACTERISTIC N_I_OFH "Drehzahl-Offset f. I-Verstaerkungs-Umschaltung, LFR, Handschaltung" VALUE 0x85D8 DAMOS_FW3 0 NQ1_W 0.000000 8000.000000 /end CHARACTERISTIC
/begin CHARACTERISTIC N_LWB "Drehzahl-Schwelle, oberhalb der die Lastwert-Begrenzung aktiv ist" VALUE 0x8762 DAMOS_FW3 0 NQ1_W 0.000000 8000.000000 /end CHARACTERISTIC
/begin CHARACTERISTIC N_M_UG "Untergrenzen-Anteil bei Neutral als f(NIST)" CURVE 0xBFA0 DAMOS_GKL1 0 UWKL10 0.000000 10.069900
 /begin AXIS_DESCR COM_AXIS NIST NQ25 9 0.000000 0.000000 AXIS_PTS_REF NISTV10 EXTENDED_LIMITS 0.000000 6400.000000 /end AXIS_DESCR
/end CHARACTERISTIC
/begin CHARACTERISTIC N_NONST_UM "Drehzahlschwelle f. Pedal LL-Vorgabe der FU" VALUE 0x8810 DAMOS_FW1 0 NQ25 0.000000 6400.000000 /end CHARACTERISTIC
/begin CHARACTERISTIC N_NONU_UM "Drehzahlschwelle f. Nachrichtenunterbrechung-Erkennung in der FU" VALUE 0x880F DAMOS_FW1 0 NQ25 0.000000 6400.000000 /end CHARACTERISTIC
/begin CHARACTERISTIC N_OF_AD "Drehzahloffset fuer Adaption" VALUE 0x85F2 DAMOS_FW3 0 NQ1_W 0.000000 8000.000000 /end CHARACTERISTIC
/begin CHARACTERISTIC N_OG_OF "Drehzahl-Offset fuer LL-Regler an der Obergrenze" VALUE 0x85C0 DAMOS_FW3 0 NQ1_W 0.000000 8000.000000 /end CHARACTERISTIC
/begin CHARACTERISTIC N_START_UM "Drehzahlschwelle f. Starterkennung" VALUE 0x880D DAMOS_FW1 0 NQ25 0.000000 6400.000000 /end CHARACTERISTIC
/begin CHARACTERISTIC N_STEND_UM "Drehzahlschwelle f. Startendeerkennung" VALUE 0x880E DAMOS_FW1 0 NQ25 0.000000 6400.000000 /end CHARACTERISTIC
/begin CHARACTERISTIC N_SW_MAX "Drehzahl ab der SW nicht mehr begrenzt wird" VALUE 0x859A DAMOS_FW3 0 NQ1_W 0.000000 8000.000000 /end CHARACTERISTIC
/begin CHARACTERISTIC N_UG_OF "Drehzahl-Offset fuer LL-Regler an der Untergrenze" VALUE 0x85BE DAMOS_FW3 0 NQ1_W 0.000000 8000.000000 /end CHARACTERISTIC
/begin CHARACTERISTIC OGANFOF1 "Offset beim Anfahren für Handschalter" CURVE 0xC31A DAMOS_KL97 0 UWKL10 0.000000 10.069900 /begin AXIS_DESCR STD_AXIS TMOT CMO_TMP 6 -41.000000 140.000000 /end AXIS_DESCR /end CHARACTERISTIC
/begin CHARACTERISTIC OGROLLOF "Roll-Offset für Handschalter" CURVE 0xC32A DAMOS_KL97 0 UWKL10 0.000000 10.069900 /begin AXIS_DESCR STD_AXIS TMOT CMO_TMP 6 -41.000000 140.000000 /end AXIS_DESCR /end CHARACTERISTIC
/begin CHARACTERISTIC PACDMNOF "untere Kältemitteldruckschwelle für Klimakompressorausschalten" VALUE 0x87BB DAMOS_FW1 0 PAB77 -0.306054 32.819430 EXTENDED_LIMITS -0.306050 32.819400 /end CHARACTERISTIC
/begin CHARACTERISTIC PACDMNON " untere Kältemitteldruckschwelle für Klimakompressoreinschalten" VALUE 0x87BA DAMOS_FW1 0 PAB77 -0.306054 32.819430 EXTENDED_LIMITS -0.306050 32.819400 /end CHARACTERISTIC
/begin CHARACTERISTIC PACDMXOF " obere Kältemitteldruckschwelle für Klimakompressorausschalten" VALUE 0x87BD DAMOS_FW1 0 PAB77 -0.306054 32.819430 EXTENDED_LIMITS -0.306050 32.819400 /end CHARACTERISTIC
/begin CHARACTERISTIC PACDMXON " obere Kältemitteldruckschwelle für Klimakompressoreinschalten" VALUE 0x87BC DAMOS_FW1 0 PAB77 -0.306054 32.819430 EXTENDED_LIMITS -0.306050 32.819400 /end CHARACTERISTIC
/begin CHARACTERISTIC PACLFO " obere AC-Druckschwelle für Motorlüftersteuerung" VALUE 0x87BE DAMOS_FW1 0 PAB77 -0.306054 32.819430 EXTENDED_LIMITS -0.306050 32.819400 /end CHARACTERISTIC
/begin CHARACTERISTIC PACLFO2 " obere AC-Druckschwelle 2 für Motorlüftersteuerung" VALUE 0x87C0 DAMOS_FW1 0 PAB77 -0.306054 32.819430 EXTENDED_LIMITS -0.306050 32.819400 /end CHARACTERISTIC
/begin CHARACTERISTIC PACLFU " untere AC-Druckschwelle für Motorlüftersteuerung" VALUE 0x87BF DAMOS_FW1 0 PAB77 -0.306054 32.819430 EXTENDED_LIMITS -0.306050 32.819400 /end CHARACTERISTIC
/begin CHARACTERISTIC PACLFU2 " untere AC-Druckschwelle 2 für Motorlüftersteuerung" VALUE 0x87C1 DAMOS_FW1 0 PAB77 -0.306054 32.819430 EXTENDED_LIMITS -0.306050 32.819400 /end CHARACTERISTIC
/begin CHARACTERISTIC PEDARDMX "Pedalgradient zum Abbruch der dyn. Antiruckelfkt." VALUE 0x819A DAMOS_FW4 0 PER0327LS -100.003000 100.000000 /end CHARACTERISTIC
/begin CHARACTERISTIC PEDARDYN "Pedalgradient fuer Ausloesung der dyn. Antiruckelfkt." CURVE 0xA6D0 DAMOS_KL98 0 PER25T10MS -25.000760 24.805440 /begin AXIS_DESCR STD_AXIS NMOT NQ40 6 0.000000 10200.000000 /end AXIS_DESCR EXTENDED_LIMITS -25.000800 24.805400 /end CHARACTERISTIC
/begin CHARACTERISTIC PEDGRANF "Pedalgradient fuer Abruch Lastschlagdaempfung" VALUE 0x8602 DAMOS_FW4 0 PER0327LS -100.003000 100.000000 /end CHARACTERISTIC
/begin CHARACTERISTIC PEDGRWE "Pedalwertanstiegs-Schwelle hartes WE" VALUE 0x811C DAMOS_FW4 0 PER0327LS -100.003000 100.000000 /end CHARACTERISTIC
/begin CHARACTERISTIC PHNOKA "Anfangswert fuer Zaehler Phasensignal nicht ok" VALUE 0x851D DAMOS_FW1 0 DEZ 0.000000 256.000000 /end CHARACTERISTIC
/begin CHARACTERISTIC PLRHAV "Wichtungsfaktor des P-Anteils in der LRHK ueber Kat-Alterung" CURVE 0x81EA DAMOS_FKL1 0 FKT256 0.000000 0.996094
 /begin AXIS_DESCR FIX_AXIS AVKATF FKT256 8 0.000000 0.875000 FIX_AXIS_PAR 0 5 8 EXTENDED_LIMITS 0.000000 0.996090 /end AXIS_DESCR
 EXTENDED_LIMITS 0.000000 0.996090 /end CHARACTERISTIC
/begin CHARACTERISTIC PLRHML "P-Anteil LRHK, wirkt zusammen mit gewicht. Sondenspann.diff. hKat" CURVE 0xAD3A DAMOS_KL97 0 TQ10 0.000000 2.550000 /begin AXIS_DESCR STD_AXIS MLSM MLSMQ 25 0.000000 1024.000000 /end AXIS_DESCR /end CHARACTERISTIC
/begin CHARACTERISTIC PN_KL "Pedalwert als Funktion des Pedal-Sollwertes bei Getriebestellung P/N" CURVE 0xBB55 DAMOS_GKL1 0 PER255 0.000000 100.000000
 /begin AXIS_DESCR COM_AXIS SWPT PER255 16 0.000000 0.000000 AXIS_PTS_REF SWPTV16 EXTENDED_LIMITS 0.000000 100.000000 /end AXIS_DESCR
/end CHARACTERISTIC
/begin CHARACTERISTIC PROG_DATE "Programmierdatum/Freigabedatum" CURVE 0x80FF DAMOS_FKL1 0 BCD 0.000000 99.000000
 /begin AXIS_DESCR FIX_AXIS IR0 DEZ 4 0.000000 3.000000 FIX_AXIS_PAR 0 0 4 EXTENDED_LIMITS 0.000000 256.000000 /end AXIS_DESCR
/end CHARACTERISTIC
/begin CHARACTERISTIC PVER "P-Verstaerkung" VALUE 0x85A4 DAMOS_FW1 0 UPVER05 0.000000 0.729583 EXTENDED_LIMITS 0.000000 0.729580 /end CHARACTERISTIC
/begin CHARACTERISTIC PVERH "P-Verstaerkung bei Handschaltung" VALUE 0x85A5 DAMOS_FW1 0 UPVER05 0.000000 0.729583 EXTENDED_LIMITS 0.000000 0.729580 /end CHARACTERISTIC
/begin CHARACTERISTIC PVERNEG "P-Verstaerkungs-Kennl. für LFR4-Handsch. fuer neg. N-abweichung" CURVE 0xC101 DAMOS_GKL1 0 UPVER 0.000000 93.751430
 /begin AXIS_DESCR COM_AXIS NDIF NQ5 8 0.000000 0.000000 AXIS_PTS_REF NDIFV08 EXTENDED_LIMITS 0.000000 1275.000000 /end AXIS_DESCR
 EXTENDED_LIMITS 0.000000 93.751400 /end CHARACTERISTIC
/begin CHARACTERISTIC PVERPOS "P-Verstaerkungs-Kennlinie für LFR4-Handschalter" CURVE 0xC0F9 DAMOS_GKL1 0 UPVER 0.000000 93.751430
 /begin AXIS_DESCR COM_AXIS NDIF NQ5 8 0.000000 0.000000 AXIS_PTS_REF NDIFV08 EXTENDED_LIMITS 0.000000 1275.000000 /end AXIS_DESCR
 EXTENDED_LIMITS 0.000000 93.751400 /end CHARACTERISTIC
/begin CHARACTERISTIC PV_VMAX "P-Verstaerkung fuer Vmax-Begrenzung" VALUE 0x8750 DAMOS_FW3 0 UPV_VMAXL 0.000000 262140.000000 /end CHARACTERISTIC
/begin CHARACTERISTIC PWG1MAX "Pedaleinstell-Überwachung, Maximalwert SP1S" VALUE 0x87EC DAMOS_FW3 0 PER1023 0.000000 100.000000 /end CHARACTERISTIC
/begin CHARACTERISTIC PWG2MAX "Pedaleinstell-Überwachung, Maximalwert SP2S" VALUE 0x87EE DAMOS_FW3 0 PER1023 0.000000 100.000000 /end CHARACTERISTIC
/begin CHARACTERISTIC PWGNOTMA "max. Pedalsollwertbegr. beim PWG-Notfahren" VALUE 0x865C DAMOS_FW3 0 PER0327 0.000000 100.000000 /end CHARACTERISTIC
/begin CHARACTERISTIC PWGRAMP "Rampensteigung beim PWG-Notfahren /10ms" VALUE 0x865E DAMOS_FW3 0 PER0327 0.000000 100.000000 /end CHARACTERISTIC
/begin CHARACTERISTIC PWMMLF "Faktor für PWMausgang" CURVE 0xCF6E DAMOS_KL97 0 PCENT 0.000000 99.609380
 /begin AXIS_DESCR STD_AXIS LFANCOUB PCENT 4 0.000000 99.609380 EXTENDED_LIMITS 0.000000 99.609400 /end AXIS_DESCR
 EXTENDED_LIMITS 0.000000 99.609400 /end CHARACTERISTIC
/begin CHARACTERISTIC PWNFB "Pedalwertschwelle" VALUE 0x8769 DAMOS_FW1 0 PER255 0.000000 100.000000 /end CHARACTERISTIC
/begin CHARACTERISTIC RBEL "Belastungswiderstand fuer Pumpstromerzeugung" VALUE 0x83F6 DAMOS_FW3 0 R_UW_Q2 0.000000 131070.000000 /end CHARACTERISTIC
/begin CHARACTERISTIC REAC_T1_UM "Max. Fehlerzeit f. inaktive SKA in der reac-FU" VALUE 0x881C DAMOS_FW1 0 UMFREAC 0.000000 10200.000000 /end CHARACTERISTIC
/begin CHARACTERISTIC REAC_T2_UM "Max. Fehlerzeit f. aktive SKA in der reac-FU" VALUE 0x881D DAMOS_FW1 0 UMFREAC 0.000000 10200.000000 /end CHARACTERISTIC
/begin CHARACTERISTIC REDA_T "Verlaengerungszeit B_red_akt" VALUE 0x8541 DAMOS_FW1 0 TQ10 0.000000 2.550000 /end CHARACTERISTIC
/begin CHARACTERISTIC REDSAAG "Reduzierstufenschwelle fuers Ausloesen von B_weh" CURVE 0x90D6 DAMOS_KL97 0 DEZ 0.000000 256.000000 /begin AXIS_DESCR STD_AXIS GANG_I DEZ7 6 0.000000 7.000000 /end AXIS_DESCR /end CHARACTERISTIC
/begin CHARACTERISTIC REDSAEG "Reduzierstufenschwelle fuers Zuruecknehmen von B_weh" CURVE 0x90E6 DAMOS_KL97 0 DEZ 0.000000 256.000000 /begin AXIS_DESCR STD_AXIS GANG_I DEZ7 6 0.000000 7.000000 /end AXIS_DESCR /end CHARACTERISTIC
/begin CHARACTERISTIC REDS_T "Entprellzeit für Reduzierstufenumschaltung" VALUE 0x878C DAMOS_FW1 0 TQ10 0.000000 2.550000 /end CHARACTERISTIC
/begin CHARACTERISTIC REFINI "Referenzpegel beim Übergang von KR inaktiv nach aktiv" VALUE 0x82AE DAMOS_FW3 0 SENSORW 0.000000 4.999924 EXTENDED_LIMITS 0.000000 4.999920 /end CHARACTERISTIC
/begin CHARACTERISTIC REP_SHOP "Repair-Shop-Code" ASCII 0x80F5 DAMOS_ASCII 0 NoCompuMethod 0.000000 0.000000 NUMBER 10 EXTENDED_LIMITS 0.000000 4.999920 /end CHARACTERISTIC
/begin CHARACTERISTIC RINHMX " " VALUE 0x83F8 DAMOS_FW3 0 R_UW_Q2 0.000000 131070.000000 /end CHARACTERISTIC
/begin CHARACTERISTIC RINVMX " " VALUE 0x83FA DAMOS_FW3 0 R_UW_Q2 0.000000 131070.000000 /end CHARACTERISTIC
/begin CHARACTERISTIC RISIGRESH "Schwelle fuer Reset Signalunterbrechung mit Ri-Diagnose hinter Kat" VALUE 0x83DC DAMOS_FW3 0 R_UW_Q2 0.000000 131070.000000 /end CHARACTERISTIC
/begin CHARACTERISTIC RISIGRESV "Schwelle fuer Reset Signalunterbrechung mit Ri-Diagnose vor Kat" VALUE 0x83AE DAMOS_FW3 0 R_UW_Q2 0.000000 131070.000000 /end CHARACTERISTIC
/begin CHARACTERISTIC RKSP "Widerstand zwischen kongurierende Spannung und Sondensignal" VALUE 0x83FC DAMOS_FW3 0 R_UW_Q2 0.000000 131070.000000 /end CHARACTERISTIC
/begin CHARACTERISTIC RLDKTOT "obere Lastgrenze fuer Funktionsanforderung" VALUE 0x8397 DAMOS_FW1 0 UFUELL 0.000000 191.250000 /end CHARACTERISTIC
/begin CHARACTERISTIC RLDKTSO "obere Lastkennlinie fuer DKAT aktiv" CURVE 0xB7AF DAMOS_GKL1 0 UFUELL 0.000000 191.250000
 /begin AXIS_DESCR COM_AXIS NIST NQ25 5 0.000000 0.000000 AXIS_PTS_REF NDKATV05 EXTENDED_LIMITS 0.000000 6400.000000 /end AXIS_DESCR
/end CHARACTERISTIC
/begin CHARACTERISTIC RLDKTSU "untere Lastkennlinie fuer DKAT aktiv" CURVE 0xB7B4 DAMOS_GKL1 0 UFUELL 0.000000 191.250000
 /begin AXIS_DESCR COM_AXIS NIST NQ25 5 0.000000 0.000000 AXIS_PTS_REF NDKATV05 EXTENDED_LIMITS 0.000000 6400.000000 /end AXIS_DESCR
/end CHARACTERISTIC
/begin CHARACTERISTIC RLDKTUT "untere Lastgrenze fuer Funktionsanforderung" VALUE 0x8398 DAMOS_FW1 0 UFUELL 0.000000 191.250000 /end CHARACTERISTIC
/begin CHARACTERISTIC ROMC_INAKT "Kennung für ROM-Check-Fehlerreaktion passiv" VALUE 0x87E9 DAMOS_FW1 0 DEZ 0.000000 256.000000 /end CHARACTERISTIC
/begin CHARACTERISTIC RST_TV_UM "Kennung zur Anford. eines Reset-Tastverh. aus der FU" VALUE 0x8822 DAMOS_FW1 0 DEZ 0.000000 256.000000 /end CHARACTERISTIC
/begin CHARACTERISTIC SAFK1 "Zeitkonstante fuer USVKJ-Filter ( DLSSA )" VALUE 0x8486 DAMOS_FW1 0 FKT256 0.000000 0.996094 EXTENDED_LIMITS 0.000000 0.996090 /end CHARACTERISTIC
/begin CHARACTERISTIC SAFK2 "Zeitkonstante fuer TUSPN-Filter ( DLSSA )" VALUE 0x8487 DAMOS_FW1 0 FKT256 0.000000 0.996094 EXTENDED_LIMITS 0.000000 0.996090 /end CHARACTERISTIC
/begin CHARACTERISTIC SAON "Zylindereinblendungen weiches SA" CURVE 0x9BA3 DAMOS_GKL1 0 DEZ 0.000000 256.000000
 /begin AXIS_DESCR COM_AXIS IR0 DEZ 8 0.000000 0.000000 AXIS_PTS_REF DUM08 EXTENDED_LIMITS 0.000000 256.000000 /end AXIS_DESCR
/end CHARACTERISTIC
/begin CHARACTERISTIC SAONKUP "Zylindereinblendungen weiches SA bei Kuppl. getreten" CURVE 0x9BB3 DAMOS_GKL1 0 DEZ 0.000000 256.000000
 /begin AXIS_DESCR COM_AXIS IR0 DEZ 8 0.000000 0.000000 AXIS_PTS_REF DUM08 EXTENDED_LIMITS 0.000000 256.000000 /end AXIS_DESCR
/end CHARACTERISTIC
/begin CHARACTERISTIC SAS_BLL "Abreg. der Abschaltdreh. bei SA triggern bei 0: !B_LL -> B_LL" VALUE 0x8123 DAMOS_FW1 0 DEZ 0.000000 1.000000 EXTENDED_LIMITS 0.000000 256.000000 /end CHARACTERISTIC
/begin CHARACTERISTIC SDWFLU "Schwelle Langzeitspeicher UK gross" VALUE 0x814C DAMOS_FW3 0 TEQ_12L 0.000000 2097.120000 /end CHARACTERISTIC
/begin CHARACTERISTIC SFONTM " " VALUE 0x8312 DAMOS_FW1 0 CMO_TMP -41.000000 140.000000 /end CHARACTERISTIC
/begin CHARACTERISTIC SGADVB_T "Stoergroessen-Adaptions-Verbotszeit" VALUE 0x85B0 DAMOS_FW3 0 TQ10L 0.000000 655.350000 /end CHARACTERISTIC
/begin CHARACTERISTIC SGSC_T_UM "Fehlerzeit fuer SGS-Ueberwachung der FU" VALUE 0x8836 DAMOS_FW1 0 TQ20 0.000000 5.100000 /end CHARACTERISTIC
/begin CHARACTERISTIC SGSNU_T_UM "Fehlerzeit fuer SGS-Ueberwachung der FU" VALUE 0x8837 DAMOS_FW1 0 TQ20 0.000000 5.100000 /end CHARACTERISTIC
/begin CHARACTERISTIC SKA_DRHZ_U "Motordrehzahlgrenze in der reac-FU" VALUE 0x881B DAMOS_FW1 0 NQ25 0.000000 6400.000000 /end CHARACTERISTIC
/begin CHARACTERISTIC SLFOON " " CURVE 0xB77D DAMOS_GKL1 0 DTSEGN 0.000000 1.120605
 /begin AXIS_DESCR COM_AXIS NIST NQ25 6 0.000000 0.000000 AXIS_PTS_REF NFOV06 EXTENDED_LIMITS 0.000000 6400.000000 /end AXIS_DESCR
 EXTENDED_LIMITS 0.000000 1.120610 /end CHARACTERISTIC
/begin CHARACTERISTIC SLFOU " " VALUE 0x8320 DAMOS_FW3 0 DTSEGNL 0.000000 287.995600 EXTENDED_LIMITS 0.000000 287.996000 /end CHARACTERISTIC
/begin CHARACTERISTIC SMLDYN "Luftmassenschwelle fuer Sondendynamik hinter Kat" VALUE 0x835C DAMOS_FW3 0 MLQ360L 0.000000 182.041700 EXTENDED_LIMITS 0.000000 182.042000 /end CHARACTERISTIC
/begin AXIS_PTS SNM16KRUB "Stuetzstellenverteilung Klopfregelung" 0x8F8A NMOT DAMOS_SST97 0 NQ40 16 0.000000 10200.000000 /end AXIS_PTS
/begin CHARACTERISTIC SOLL_A "Sollbeschleunigung" VALUE 0x8668 DAMOS_FW2 0 U_A -22.222080 22.048470 EXTENDED_LIMITS -22.222100 22.048500 /end CHARACTERISTIC
/begin CHARACTERISTIC SP12LL_UM "max. Diff. zw. SP1S und SP2S unter Vollgasschwelle f. FU" VALUE 0x8809 DAMOS_FW1 0 PER255 0.000000 100.000000 /end CHARACTERISTIC
/begin CHARACTERISTIC SP12MX_T "Fehlerzeit bei SP1S, SP2S > SPSMAX" VALUE 0x8632 DAMOS_FW1 0 TQ10 0.000000 2.550000 /end CHARACTERISTIC
/begin CHARACTERISTIC SP12VG_UM "max. Diff. zw. SP1S und SP2S ueber Vollgasschwelle f. FU" VALUE 0x880A DAMOS_FW1 0 PER255 0.000000 100.000000 /end CHARACTERISTIC
/begin CHARACTERISTIC SP1ADC_DIF "max. Diff. zw. sp1s_r und sp1p_r" VALUE 0x8829 DAMOS_FW1 0 U5V 0.000000 5.000000 /end CHARACTERISTIC
/begin CHARACTERISTIC SP1LHO_T "Fehlerzeit bei SP1S-LL-Hochohmigkkeit" VALUE 0x8640 DAMOS_FW1 0 TQ10 0.000000 2.550000 /end CHARACTERISTIC
/begin CHARACTERISTIC SP1MAX_T "Fehlerzeit bei SP1S > SP1SMAX" VALUE 0x8630 DAMOS_FW1 0 TQ10 0.140000 0.140000 EXTENDED_LIMITS 0.000000 2.550000 /end CHARACTERISTIC
/begin CHARACTERISTIC SP1MIN_T "Fehlerzeit bei SP1S < SP1SMIN" VALUE 0x862E DAMOS_FW1 0 TQ10 0.140000 0.140000 EXTENDED_LIMITS 0.000000 2.550000 /end CHARACTERISTIC
/begin CHARACTERISTIC SP1SMAX "maximaler plausibler Sollwert" VALUE 0x8638 DAMOS_FW3 0 PER1023 79.960900 98.142720 EXTENDED_LIMITS 0.000000 100.000000 /end CHARACTERISTIC
/begin CHARACTERISTIC SP1SMIN "minimaler plausibler Sollwert" VALUE 0x8634 DAMOS_FW3 0 PER1023 7.917889 12.023460 EXTENDED_LIMITS 0.000000 100.000000 /end CHARACTERISTIC
/begin CHARACTERISTIC SP1_STAT "Bandbreite f. die Erkennung auf sp1s stationär f. FU" VALUE 0x8827 DAMOS_FW1 0 U5V 0.000000 5.000000 /end CHARACTERISTIC
/begin CHARACTERISTIC SP1_STAT_T "Entprellzeit f. Erkennung sp1s stationär f. FU" VALUE 0x8828 DAMOS_FW1 0 TQ10 0.000000 2.550000 /end CHARACTERISTIC
/begin CHARACTERISTIC SP2LHO_T "Fehlerzeit bei SP2S-LL-Hochohmigkkeit" VALUE 0x8641 DAMOS_FW1 0 TQ10 0.000000 2.550000 /end CHARACTERISTIC
/begin CHARACTERISTIC SP2MAX_T "Fehlerzeit bei SP2S > SP2SMAX" VALUE 0x8631 DAMOS_FW1 0 TQ10 0.140000 0.140000 EXTENDED_LIMITS 0.000000 2.550000 /end CHARACTERISTIC
/begin CHARACTERISTIC SP2MIN_T "Fehlerzeit bei SP2S < SP2SMIN" VALUE 0x862F DAMOS_FW1 0 TQ10 0.140000 0.140000 EXTENDED_LIMITS 0.000000 2.550000 /end CHARACTERISTIC
/begin CHARACTERISTIC SP2SMAX "maximaler plausibler Sollwert" VALUE 0x863A DAMOS_FW3 0 PER1023 79.960900 99.120230 EXTENDED_LIMITS 0.000000 100.000000 /end CHARACTERISTIC
/begin CHARACTERISTIC SP2SMIN "minimaler plausibler Sollwert" VALUE 0x8636 DAMOS_FW3 0 PER1023 4.985337 9.970675 EXTENDED_LIMITS 0.000000 100.000000 /end CHARACTERISTIC
/begin CHARACTERISTIC SPSC_MIN_U "Minimalwert f. Pedal-Sollwertkorrektur f. FU" VALUE 0x8808 DAMOS_FW1 0 PER255 0.000000 100.000000 /end CHARACTERISTIC
/begin CHARACTERISTIC SPSC_T_UM "Fehlerzeit bei zueinander unplaus. Sollwerten in der FU" VALUE 0x880C DAMOS_FW1 0 UMFSPSC 0.000000 10200.000000 /end CHARACTERISTIC
/begin CHARACTERISTIC SPSVG_UM "Vollgasschwelle z. Umsch. der max. Diff. f.FU" VALUE 0x880B DAMOS_FW1 0 PER255 0.000000 100.000000 /end CHARACTERISTIC
/begin CHARACTERISTIC SPS_MAX "obere Normierungsgrenze" VALUE 0x8594 DAMOS_FW3 0 PER0327 0.000000 100.000000 /end CHARACTERISTIC
/begin CHARACTERISTIC SPS_MIN "untere Normierungsgrenze" VALUE 0x8590 DAMOS_FW3 0 PER0327 15.997800 21.997740 EXTENDED_LIMITS 0.000000 100.000000 /end CHARACTERISTIC
/begin CHARACTERISTIC SPS_MINNOT "untere Normierungsgrenze bei PWGNOT" VALUE 0x8592 DAMOS_FW3 0 PER0327 15.997800 21.997740 EXTENDED_LIMITS 0.000000 100.000000 /end CHARACTERISTIC
/begin CHARACTERISTIC SPS_TL "Teillast-Sollwert-Schwelle" VALUE 0x8648 DAMOS_FW3 0 PER1023 0.000000 100.000000 /end CHARACTERISTIC
/begin CHARACTERISTIC SPS_VG "Vollgas-Sollwert-Schwelle" VALUE 0x8646 DAMOS_FW3 0 PER1023 55.718480 100.000000 EXTENDED_LIMITS 0.000000 100.000000 /end CHARACTERISTIC
/begin CHARACTERISTIC SRYAGR "Schwelle für Readiness-Bildung Abgasrückführungs-Diagnose" VALUE 0x883A DAMOS_FW1 0 DEZ 0.000000 256.000000 /end CHARACTERISTIC
/begin CHARACTERISTIC SRYHS "Schwelle für Readiness-Bildung Sondenheizungs-Diagnose" VALUE 0x883B DAMOS_FW1 0 DEZ 0.000000 256.000000 /end CHARACTERISTIC
/begin CHARACTERISTIC SRYKAT "Schwelle für Readiness-Bildung Katalysator-Diagnose" VALUE 0x883C DAMOS_FW1 0 DEZ 0.000000 256.000000 /end CHARACTERISTIC
/begin CHARACTERISTIC SRYLS "Schwelle für Readiness-Bildung Lambdasonden-Diagnose" VALUE 0x883D DAMOS_FW1 0 DEZ 0.000000 256.000000 /end CHARACTERISTIC
/begin CHARACTERISTIC SRYSLS "Schwelle für Readiness-Bildung Sekundärluft-Diagnose" VALUE 0x883E DAMOS_FW1 0 DEZ 0.000000 256.000000 /end CHARACTERISTIC
/begin CHARACTERISTIC SRYTES "Schwelle für Readiness-Bildung Tankentlüftungs-Diagnose" VALUE 0x883F DAMOS_FW1 0 DEZ 0.000000 256.000000 /end CHARACTERISTIC
/begin CHARACTERISTIC STADVB_T "Start-Adaptions-Verbotzeit" VALUE 0x85C2 DAMOS_FW3 0 TQ100L 0.000000 6553.500000 /end CHARACTERISTIC
/begin CHARACTERISTIC STGK_T "Stellgroessenklammerungs-Zeit" VALUE 0x85F4 DAMOS_FW3 0 TQ10L 0.000000 655.350000 /end CHARACTERISTIC
/begin CHARACTERISTIC ST_AD_VW "Start-Adaptions-Vorhaltwert" VALUE 0x85C6 DAMOS_FW3 0 UDKL 0.000000 10.112030 EXTENDED_LIMITS 0.000000 10.112000 /end CHARACTERISTIC
/begin CHARACTERISTIC ST_HW "Adaptionsinitialisierungswert als f(FDKHA)" CURVE 0xBFC3 DAMOS_GKL1 0 UWKL10 0.000000 10.069900
 /begin AXIS_DESCR COM_AXIS FDKHA FKT128 8 0.000000 0.000000 AXIS_PTS_REF FDKHAV08 EXTENDED_LIMITS 0.000000 1.992190 /end AXIS_DESCR
/end CHARACTERISTIC
/begin CHARACTERISTIC ST_NS_RP "Rampe fuer Unter- und Obergrenze v. Start- und Nachstart-Werte" VALUE 0x85A6 DAMOS_FW3 0 UDKL 0.000000 10.112030 EXTENDED_LIMITS 0.000000 10.112000 /end CHARACTERISTIC
/begin CHARACTERISTIC ST_OG "Start-Obergrenze als f(TMOT)" CURVE 0xBF3F DAMOS_GKL1 0 UWKL15 0.000000 15.110220
 /begin AXIS_DESCR COM_AXIS TMOT CMO_TMP 12 0.000000 0.000000 AXIS_PTS_REF TMOTV08 EXTENDED_LIMITS -41.000000 140.000000 /end AXIS_DESCR
 EXTENDED_LIMITS 0.000000 15.110200 /end CHARACTERISTIC
/begin CHARACTERISTIC ST_OG1 "Start-Obergrenze als f(TMOT) (Automat)" CURVE 0xC3C3 DAMOS_GKL1 0 UWKL15 0.000000 15.110220
 /begin AXIS_DESCR COM_AXIS TMOT CMO_TMP 12 0.000000 0.000000 AXIS_PTS_REF TMOTV08 EXTENDED_LIMITS -41.000000 140.000000 /end AXIS_DESCR
 EXTENDED_LIMITS 0.000000 15.110200 /end CHARACTERISTIC
/begin CHARACTERISTIC SUBRE "Schubreserve" VALUE 0x85CC DAMOS_FW3 0 UDKL 0.000000 10.112030 EXTENDED_LIMITS 0.000000 10.112000 /end CHARACTERISTIC
/begin CHARACTERISTIC SUCNF "Konfiguration für Saugrohrumschaltung Polarität" VALUE 0x81CE DAMOS_FW1 0 DEZ 0.000000 256.000000 /end CHARACTERISTIC
/begin CHARACTERISTIC SV_STA "minimaler Startwert fuer SW_TEMP" VALUE 0x8670 DAMOS_FW3 0 PER0327 0.000000 100.000000 /end CHARACTERISTIC
/begin CHARACTERISTIC SWACCRMP "DeltaSollwertDK/100ms der ACC-Rampe" VALUE 0x8612 DAMOS_FW3 0 PER0327 0.000000 100.000000 /end CHARACTERISTIC
/begin CHARACTERISTIC SWASRRMP "Rampen-Delta der ASR-Rampe" VALUE 0x860D DAMOS_FW1 0 PER0128 0.000000 99.612410 EXTENDED_LIMITS 0.000000 99.612400 /end CHARACTERISTIC
/begin CHARACTERISTIC SWEGSRMP "DeltaSollwertDK/100ms der EGS-Rampe" VALUE 0x853E DAMOS_FW3 0 PER0327 0.000000 100.000000 /end CHARACTERISTIC
/begin CHARACTERISTIC SWFSRCHH "Schwelle DK-Winkel für Recovery über Gaspedal" VALUE 0x84BA DAMOS_FW1 0 PER255 0.000000 100.000000 /end CHARACTERISTIC
/begin CHARACTERISTIC SWG_NMAX "minimaler Sollwert" VALUE 0x81C4 DAMOS_FW3 0 PER0327 0.000000 100.000000 /end CHARACTERISTIC
/begin CHARACTERISTIC SWMAXN "Speicherwert NMOT max" CURVE 0x8E52 DAMOS_KL97 0 PER255 0.000000 100.000000 /begin AXIS_DESCR STD_AXIS NMOT NQ40 13 0.000000 10200.000000 /end AXIS_DESCR /end CHARACTERISTIC
/begin CHARACTERISTIC SWMSRRMP "Rampen_Delta der MSR-Rampe" VALUE 0x860E DAMOS_FW1 0 PER0128 0.000000 99.612410 EXTENDED_LIMITS 0.000000 99.612400 /end CHARACTERISTIC
/begin AXIS_PTS SWNLV08 "Stuetzstellenverteilung Nachlauf-Sollwert" 0x8EC2 SWNL DAMOS_SST97 0 PER255 8 0.000000 100.000000 /end AXIS_PTS
/begin CHARACTERISTIC SWNWSAN "Sollwertschwelle für NWS ausschalten" CURVE 0xCE42 DAMOS_KL97 0 PER255 0.000000 100.000000 /begin AXIS_DESCR STD_AXIS NMOT NQ40 8 0.000000 10200.000000 /end AXIS_DESCR /end CHARACTERISTIC
/begin CHARACTERISTIC SWNWSEN "Sollwertschwelle für NWS einschalten" CURVE 0xCE56 DAMOS_KL97 0 PER255 0.000000 100.000000 /begin AXIS_DESCR STD_AXIS NMOT NQ40 8 0.000000 10200.000000 /end AXIS_DESCR /end CHARACTERISTIC
/begin CHARACTERISTIC SWNWSKHAN "Sollwertschwelle für NWS ausschalten bei B_kh" CURVE 0xCE6A DAMOS_KL97 0 PER255 0.000000 100.000000 /begin AXIS_DESCR STD_AXIS NMOT NQ40 8 0.000000 10200.000000 /end AXIS_DESCR /end CHARACTERISTIC
/begin CHARACTERISTIC SWNWSKHEN "Sollwertschwelle für NWS einschalten bei B_kh" CURVE 0xCE7E DAMOS_KL97 0 PER255 0.000000 100.000000 /begin AXIS_DESCR STD_AXIS NMOT NQ40 8 0.000000 10200.000000 /end AXIS_DESCR /end CHARACTERISTIC
/begin CHARACTERISTIC SWPEDNOT "Pedal-Sollwert-Schwelle fuer Anfahren im 2. Gang" VALUE 0x864A DAMOS_FW3 0 PER0327 0.000000 100.000000 /end CHARACTERISTIC
/begin AXIS_PTS SWPTV16 "Stuetzstellenverteilung Maximalwert aus Pedal- u. Tempomat-Sollwert" 0x8EA4 SWPT DAMOS_SST97 0 PER255 16 0.000000 100.000000 /end AXIS_PTS
/begin CHARACTERISTIC SWSTAT "DK Aenderung / 100ms" VALUE 0x8629 DAMOS_FW1 0 PER_DKA 0.000000 100.000000 /end CHARACTERISTIC
/begin CHARACTERISTIC SWUANL "Pedal-Sollwertschwelle fuer Anschlag-Lernen" VALUE 0x8618 DAMOS_FW3 0 PER0327 0.000000 100.000000 /end CHARACTERISTIC
/begin CHARACTERISTIC SWU_NMAX "minimaler Sollwert fuer I-Setzwert" VALUE 0x81C2 DAMOS_FW3 0 PER0327 0.000000 100.000000 /end CHARACTERISTIC
/begin CHARACTERISTIC SW_N_0 "minimale Sollwertbegrenzung (NISTW = 0)" VALUE 0x8598 DAMOS_FW3 0 PER0327 0.000000 100.000000 /end CHARACTERISTIC
/begin CHARACTERISTIC SW_TEMPN "Tempomat Sollwertbegrenzung (Handschalter)" CURVE 0xC438 DAMOS_KL97 0 PER255 0.000000 100.000000 /begin AXIS_DESCR STD_AXIS NMOT NQ40 5 0.000000 10200.000000 /end AXIS_DESCR /end CHARACTERISTIC
/begin CHARACTERISTIC SW_TEMPN1 "Tempomat Sollwertbegrenzung (Automat)" CURVE 0xC446 DAMOS_KL97 0 PER255 0.000000 100.000000 /begin AXIS_DESCR STD_AXIS NMOT NQ40 5 0.000000 10200.000000 /end AXIS_DESCR /end CHARACTERISTIC
/begin CHARACTERISTIC SYNCADR1 "McMess-Synchroadresse 1" VALUE 0x8446 DAMOS_FW3 0 DEZL 0.000000 65535.000000 /end CHARACTERISTIC
/begin CHARACTERISTIC SYNCADR2 "McMess-Synchroadresse 2" VALUE 0x8448 DAMOS_FW3 0 DEZL 0.000000 65535.000000 /end CHARACTERISTIC
/begin CHARACTERISTIC SYNCADR3 "McMess-Synchroadresse 3" VALUE 0x844A DAMOS_FW3 0 DEZL 0.000000 65535.000000 /end CHARACTERISTIC
/begin CHARACTERISTIC SYNCADR4 "McMess-Synchroadresse 4" VALUE 0x844C DAMOS_FW3 0 DEZL 0.000000 65535.000000 /end CHARACTERISTIC
/begin CHARACTERISTIC SYNCADR5 "McMess-Synchroadresse 5" VALUE 0x844E DAMOS_FW3 0 DEZL 0.000000 65535.000000 /end CHARACTERISTIC
/begin CHARACTERISTIC SYNCADR6 "McMess-Synchroadresse 6" VALUE 0x8450 DAMOS_FW3 0 DEZL 0.000000 65535.000000 /end CHARACTERISTIC
/begin CHARACTERISTIC T2CANOFF "Beobachtungsphase nach CAN-Neu-Initialisierung" VALUE 0x84C6 DAMOS_FW3 0 TQ10L 0.000000 655.350000 /end CHARACTERISTIC
/begin CHARACTERISTIC TABAGUE "Automatgetriebe Getriebeuebersetzungen (1,2,3,4,5,R,R2)" VAL_BLK 0x8552 DAMOS_FWB1 0 FKT51 0.000000 4.980469 NUMBER 7 EXTENDED_LIMITS 0.000000 4.980470 /end CHARACTERISTIC
/begin CHARACTERISTIC TABGMCSD "Obere Abgastemp.schwelle für Lambdasonden-Diagnose" VALUE 0x83B0 DAMOS_FW1 0 UTABG -48.000000 972.000000 /end CHARACTERISTIC
/begin CHARACTERISTIC TABGSTG "Schwelle Kattemperatur" VALUE 0x835E DAMOS_FW1 0 UTABG -48.000000 972.000000 /end CHARACTERISTIC
/begin CHARACTERISTIC TABWM "Zahnperiodenzeit für Rückdreher beim Motorabwürgen" CURVE 0xD582 DAMOS_KL97 0 TQT1 0.000000 68.000000 /begin AXIS_DESCR STD_AXIS TMOT CMO_TMP 8 -41.000000 140.000000 /end AXIS_DESCR /end CHARACTERISTIC
/begin CHARACTERISTIC TADE "Tans-Ersatzwert bei unplausiblem Signal" VALUE 0x845F DAMOS_FW1 0 CLU_TMP -50.000000 150.000000 /end CHARACTERISTIC
/begin CHARACTERISTIC TADHMN " untere TABGM Schwelle Sondenfreigabe" VALUE 0x824E DAMOS_FW1 0 UTABG -48.000000 972.000000 /end CHARACTERISTIC
/begin CHARACTERISTIC TADHMXH " obere TABGM Schwelle Sondenfreigabe hinten" VALUE 0x8250 DAMOS_FW1 0 UTABG -48.000000 972.000000 /end CHARACTERISTIC
/begin CHARACTERISTIC TADHMXV " obere TABGM Schwelle Sondenfreigabe vorn" VALUE 0x824F DAMOS_FW1 0 UTABG -48.000000 972.000000 /end CHARACTERISTIC
/begin CHARACTERISTIC TADMM "Verzoegerungszeit nach Startende fuer Beginn der Modelltemperaturerhoehung" VALUE 0x8464 DAMOS_FW3 0 TQ100L 0.000000 6553.500000 /end CHARACTERISTIC
/begin CHARACTERISTIC TADMN "Ansauglufttemperatur, min. Schwelle" VALUE 0x845D DAMOS_FW1 0 CLU_TMP -50.000000 150.000000 /end CHARACTERISTIC
/begin CHARACTERISTIC TADMX "Ansauglufttemperatur, max. Schwelle" VALUE 0x845E DAMOS_FW1 0 CLU_TMP -50.000000 150.000000 /end CHARACTERISTIC
/begin CHARACTERISTIC TADTM "TANS-Schwelle fuer TMOT-Diagnose" VALUE 0x8466 DAMOS_FW1 0 UTMP_40 -40.000000 216.000000 /end CHARACTERISTIC
/begin CHARACTERISTIC TAGRAEB "Dauer der AGR-Änderungsbegrenzung" VALUE 0x823A DAMOS_FW3 0 TQ10L 0.000000 655.350000 /end CHARACTERISTIC
/begin CHARACTERISTIC TALUST "Zeitdauer Ausblendung der Aussetzererkennung nach Motorstart" VALUE 0x8300 DAMOS_FW3 0 TQ100L 0.000000 6553.500000 /end CHARACTERISTIC
/begin CHARACTERISTIC TAMIALU " " VALUE 0x8315 DAMOS_FW1 0 CLU_TMP -50.000000 150.000000 /end CHARACTERISTIC
/begin CHARACTERISTIC TANKL "Schwelle Tank leer erkannt" VALUE 0x82EC DAMOS_FW1 0 PER1 0.000000 255.000000 /end CHARACTERISTIC
/begin CHARACTERISTIC TANSTE "Ansauglufttemperatur Freigabeschwelle" VALUE 0x82E2 DAMOS_FW1 0 CLU_TMP -50.000000 150.000000 /end CHARACTERISTIC
/begin CHARACTERISTIC TAPPROV_NR "Homologationsnr." ASCII 0x80EA DAMOS_ASCII 0 NoCompuMethod 0.000000 0.000000 NUMBER 6 EXTENDED_LIMITS 0.000000 150.000000 /end CHARACTERISTIC
/begin CHARACTERISTIC TARA "Ansaugluftschwelle fuer LRA" VALUE 0x849D DAMOS_FW1 0 CLU_TMP -50.000000 150.000000 /end CHARACTERISTIC
/begin CHARACTERISTIC TASIG "Heilungszeit fuer Fehler Signalunterbrechung und Sonde 'fett' " VALUE 0x83B1 DAMOS_FW1 0 TQ100 0.000000 25.500000 /end CHARACTERISTIC
/begin CHARACTERISTIC TATEAD "Schwelle Tastverhältnis für Freigabe Lernen der Beladung" VALUE 0x82BA DAMOS_FW1 0 PCENT 0.000000 99.609380 EXTENDED_LIMITS 0.000000 99.609400 /end CHARACTERISTIC
/begin CHARACTERISTIC TATEPO "Tastverhaeltnisschwelle im oberen Tastverhaeltnisbereich" VALUE 0x82D0 DAMOS_FW1 0 FKT256 0.000000 0.996094 EXTENDED_LIMITS 0.000000 0.996090 /end CHARACTERISTIC
/begin CHARACTERISTIC TATEPOO "Tastverhaeltnisschwelle im obersten Tastverhaeltnisbereich" VALUE 0x82D1 DAMOS_FW1 0 FKT256 0.000000 0.996094 EXTENDED_LIMITS 0.000000 0.996090 /end CHARACTERISTIC
/begin CHARACTERISTIC TATEPU "Tastverhaeltnisschwelle im unterem Tastverhaeltnisbereich" VALUE 0x82CF DAMOS_FW1 0 FKT256 0.000000 0.996094 EXTENDED_LIMITS 0.000000 0.996090 /end CHARACTERISTIC
/begin CHARACTERISTIC TATEPUU "Tastverhaeltnisschwelle im untersten Tastverhaeltnisbereich" VALUE 0x82CE DAMOS_FW1 0 FKT256 0.000000 0.996094 EXTENDED_LIMITS 0.000000 0.996090 /end CHARACTERISTIC
/begin CHARACTERISTIC TATMSA "Abgastemperatur bei Schubabschneiden" VALUE 0x825A DAMOS_FW1 0 UTABG -48.000000 972.000000 /end CHARACTERISTIC
/begin CHARACTERISTIC TATMTP "Abgastaupunkttemperatur" VALUE 0x825B DAMOS_FW1 0 UTABG -48.000000 972.000000 /end CHARACTERISTIC
/begin CHARACTERISTIC TBLRH "Sperrzeit Regelung hinter KAT nach B_LR 0 --> 1" VALUE 0x8209 DAMOS_FW1 0 TQ100 0.000000 25.500000 /end CHARACTERISTIC
/begin CHARACTERISTIC TCANMUTE "Zeit fuer Erkennen CAN-Mute" VALUE 0x84CA DAMOS_FW3 0 TQ10L 0.000000 655.350000 /end CHARACTERISTIC
/begin CHARACTERISTIC TCANOFF "Stillephase nach CAN-BusOff" VALUE 0x84C4 DAMOS_FW3 0 TQ10L 0.000000 655.350000 /end CHARACTERISTIC
/begin CHARACTERISTIC TDALU1 " Verzögerungszeit Ausschaltsignal für Lüfterstufe 1" VALUE 0x87AA DAMOS_FW1 0 TQ10 0.000000 2.550000 /end CHARACTERISTIC
/begin CHARACTERISTIC TDDFAC "Fehlerentprellzeiten Klimadrucksensor" VALUE 0x87C2 DAMOS_FW3 0 TQ10L 0.000000 655.350000 /end CHARACTERISTIC
/begin CHARACTERISTIC TDELU2 " Verzögerungszeit Einschaltsignal für Lüfterstufe 2" VALUE 0x87AB DAMOS_FW1 0 TQ40 0.000000 10.200000 /end CHARACTERISTIC
/begin CHARACTERISTIC TDEPOEL "Fehlerentprellzeit für Oeldruckschalterdiag. " VALUE 0x8444 DAMOS_FW3 0 TQ20L 0.000000 1310.700000 /end CHARACTERISTIC
/begin CHARACTERISTIC TDFALU1 " Verzögerungszeit Ausschalten Stufe 1" VALUE 0x879F DAMOS_FW1 0 TQ20 0.000000 5.100000 /end CHARACTERISTIC
/begin CHARACTERISTIC TDFALU2 " Verzögerungszeit Ausschalten Stufe 2 " VALUE 0x87A1 DAMOS_FW1 0 TQ20 0.000000 5.100000 /end CHARACTERISTIC
/begin CHARACTERISTIC TDFELU1 " Verzögerungszeit Einschalten Stufe 1" VALUE 0x879E DAMOS_FW1 0 TQ20 0.000000 5.100000 /end CHARACTERISTIC
/begin CHARACTERISTIC TDFELU2 " Verzögerungszeit Einschalten Stufe 2" VALUE 0x87A0 DAMOS_FW1 0 TQ20 0.000000 5.100000 /end CHARACTERISTIC
/begin CHARACTERISTIC TDFRKAD "Aufregelzeit bei LRKA-Ende" VALUE 0x8571 DAMOS_FW1 0 TQ100 0.000000 25.500000 /end CHARACTERISTIC
/begin CHARACTERISTIC TDFRKAU "Aufregelzeit bei LRKA-Beginn" VALUE 0x8570 DAMOS_FW1 0 TQ100 0.000000 25.500000 /end CHARACTERISTIC
/begin CHARACTERISTIC TDKATAKT "Schwellwert Zyklus fertig wenn aktive Ueberwachungszeit > TDKATAKT" VALUE 0x839A DAMOS_FW3 0 TQ50L 0.000000 3276.750000 /end CHARACTERISTIC
/begin CHARACTERISTIC TDKATATT "Schwellwert Zyklus fertig fuer Funktionsanforderung" VALUE 0x839C DAMOS_FW3 0 TQ50L 0.000000 3276.750000 /end CHARACTERISTIC
/begin CHARACTERISTIC TDKS "Zeit fuer Diagnose KRS" VALUE 0x827A DAMOS_FW1 0 TQ200 0.000000 51.000000 /end CHARACTERISTIC
/begin CHARACTERISTIC TDKUPPL "Wartezeit nach Startende für DVKUP-Fehlereintrag" VALUE 0x8790 DAMOS_FW1 0 TQ10 0.000000 2.550000 /end CHARACTERISTIC
/begin CHARACTERISTIC TDLRPER "Einschaltverzoegerung Uebergang B_lr 0->1 fuer Freigabe Periodendauerbestimmung" VALUE 0x832A DAMOS_FW3 0 TQ10L 0.000000 655.350000 /end CHARACTERISTIC
/begin CHARACTERISTIC TDMFB " Zeit Diag. inaktiv Fehlererk. Mil-f.b. Leitung" VALUE 0x879C DAMOS_FW3 0 TQ10L 0.000000 655.350000 /end CHARACTERISTIC
/begin CHARACTERISTIC TDMLMN "Entprellzeit HFM-Fehlererkennung Minimalwert" VALUE 0x843E DAMOS_FW1 0 TQ20 0.000000 5.100000 /end CHARACTERISTIC
/begin CHARACTERISTIC TDMLMX "Entprellzeit HFM-Fehlererkennung Maximalwert" VALUE 0x843F DAMOS_FW1 0 TQ20 0.000000 5.100000 /end CHARACTERISTIC
/begin CHARACTERISTIC TDMLNF "Entprellzeit HFM-Diagnose mit i. o. -Meldung" VALUE 0x8440 DAMOS_FW1 0 TQ20 0.000000 5.100000 /end CHARACTERISTIC
/begin CHARACTERISTIC TDMLST "Entprellzeit HFM-Fehlererkennung im Start" VALUE 0x8441 DAMOS_FW1 0 TQ20 0.000000 5.100000 /end CHARACTERISTIC
/begin CHARACTERISTIC TDMM "Stufenbreite (Zeit) fuer Modelltemperaturerhoehung" VALUE 0x8469 DAMOS_FW1 0 DEZ 0.000000 256.000000 /end CHARACTERISTIC
/begin CHARACTERISTIC TDMM_Q "Quantisierung von TDMM" VALUE 0x846A DAMOS_FW1 0 TMASK10 10.240000 2621.440000 /end CHARACTERISTIC
/begin CHARACTERISTIC TDNSUB "Batterie-Erholzeit ab Start, fuer UBATT - Diagnose" VALUE 0x8452 DAMOS_FW3 0 TQ100L 0.000000 6553.500000 /end CHARACTERISTIC
/begin CHARACTERISTIC TDTA "Entprell- u. Heilungszeit" VALUE 0x845C DAMOS_FW1 0 TQ10 0.000000 2.550000 /end CHARACTERISTIC
/begin CHARACTERISTIC TDTM "Entprell- u. Heilungszeit" VALUE 0x8460 DAMOS_FW1 0 TQ10 0.000000 2.550000 /end CHARACTERISTIC
/begin CHARACTERISTIC TDUB "Entprellzeit UBATT-Diagnose" VALUE 0x8454 DAMOS_FW1 0 TQ100 0.000000 25.500000 /end CHARACTERISTIC
/begin CHARACTERISTIC TDUBMAX "Entprellzeit UBATT-Max.Fehler" VALUE 0x845A DAMOS_FW3 0 TQ100L 0.000000 6553.500000 /end CHARACTERISTIC
/begin CHARACTERISTIC TDV "Fehlererk. Tacho Zeitdauer für Abfrage" VALUE 0x87DF DAMOS_FW1 0 TQ10 0.000000 2.550000 /end CHARACTERISTIC
/begin CHARACTERISTIC TDWFSVN "Wartezeit bis Verriegeln der WFS nach KL15 aus" VALUE 0x84B4 DAMOS_FW3 0 TQ10L 0.000000 655.350000 /end CHARACTERISTIC
/begin CHARACTERISTIC TEC "Verzögerungszeit bei Kompressoreinschaltung" VALUE 0x87E0 DAMOS_FW1 0 TQ20 0.000000 5.100000 /end CHARACTERISTIC
/begin CHARACTERISTIC TEC1 "Verzögerungszeit bei Kompressorabschaltung" VALUE 0x87E1 DAMOS_FW1 0 TQ20 0.000000 5.100000 /end CHARACTERISTIC
/begin CHARACTERISTIC TEMIN "Minimalwert Einspritzung" VALUE 0x812A DAMOS_FW3 0 TEQL 0.000000 5.000000 EXTENDED_LIMITS 0.000000 174.760000 /end CHARACTERISTIC
/begin CHARACTERISTIC TEMINLR "Minimales TE für Abschaltung LR" VALUE 0x812C DAMOS_FW3 0 TEQL 0.000000 5.000000 EXTENDED_LIMITS 0.000000 174.760000 /end CHARACTERISTIC
/begin CHARACTERISTIC TEMPFELL "Pedalwertschwelle für Leerlauf-Disable-Bit bei FGR" VALUE 0x8686 DAMOS_FW3 0 UDKL 0.000000 10.112030 EXTENDED_LIMITS 0.000000 10.112000 /end CHARACTERISTIC
/begin CHARACTERISTIC TEPCL "Schwelle für Readiness-Bildung Tankentlüftungs-Diagnose" VALUE 0x8840 DAMOS_FW1 0 TQ200 0.000000 51.000000 /end CHARACTERISTIC
/begin CHARACTERISTIC TEPCLI "Zeit ab INI bis EPCL-Testansteuerung Ende" VALUE 0x8841 DAMOS_FW1 0 TQ200 0.000000 51.000000 /end CHARACTERISTIC
/begin CHARACTERISTIC TEUKGNSP "TEUKG-Schwelle fuer Nachspritzer" VALUE 0x8228 DAMOS_FW4 0 TEQ_CPL -87.381330 87.378660 EXTENDED_LIMITS -87.381300 87.378700 /end CHARACTERISTIC
/begin CHARACTERISTIC TFAULACC "FehlerHeilungszeit CAN-Node NAC faulty" VALUE 0x8500 DAMOS_FW3 0 TQ10L 0.000000 655.350000 /end CHARACTERISTIC
/begin CHARACTERISTIC TFAULASR "FehlerHeilungszeit CAN-Node NFR faulty" VALUE 0x84E4 DAMOS_FW3 0 TQ10L 0.000000 655.350000 /end CHARACTERISTIC
/begin CHARACTERISTIC TFAULBC "FehlerHeilungszeit CAN-Node NBC faulty" VALUE 0x84D6 DAMOS_FW3 0 TQ10L 0.000000 655.350000 /end CHARACTERISTIC
/begin CHARACTERISTIC TFAULEGS "FehlerHeilungszeit CAN-Node NCA/NCR faulty" VALUE 0x84F2 DAMOS_FW3 0 TQ10L 0.000000 655.350000 /end CHARACTERISTIC
/begin CHARACTERISTIC TFAULNBA "FehlerHeilungszeit CAN-Node NBA faulty" VALUE 0x850E DAMOS_FW3 0 TQ10L 0.000000 655.350000 /end CHARACTERISTIC
/begin CHARACTERISTIC TFBREMSE "Entprellzeit fuer BR oder BL" VALUE 0x873E DAMOS_FW1 0 TQ20 0.040000 0.040000 EXTENDED_LIMITS 0.000000 5.100000 /end CHARACTERISTIC
/begin CHARACTERISTIC TFDKHA "Zeit fuer Inkrementierung Delta-Hoehenadaptionsfaktor" VALUE 0x826A DAMOS_FW1 0 TQ100 0.000000 25.500000 /end CHARACTERISTIC
/begin CHARACTERISTIC TFGRFDY "Zeit fuer ausschalten von FGR" VALUE 0x84CC DAMOS_FW3 0 TQ10L 0.000000 655.350000 /end CHARACTERISTIC
/begin CHARACTERISTIC TFRA "Erkennungszeit fuer eingeschwungene Grundadaption von fra" VALUE 0x8428 DAMOS_FW3 0 TQ100L 0.000000 6553.500000 /end CHARACTERISTIC
/begin CHARACTERISTIC TFRAZ "Verweilzeit in FRA fuer Zyklusflag bei nicht eingeschw. Adaption" VALUE 0x842A DAMOS_FW3 0 TQ100L 0.000000 6553.500000 /end CHARACTERISTIC
/begin CHARACTERISTIC TFRMB "Verzoegerungszeit fuer Erkennung Mittelwert des Lambdareg. innerhalb Schwellen" VALUE 0x835F DAMOS_FW1 0 TQ100 0.000000 25.500000 /end CHARACTERISTIC
/begin CHARACTERISTIC TFTEFVA "Anfangsbegrenzungszeit der Spuelrate" VALUE 0x82BC DAMOS_FW3 0 TQ100L 0.000000 6553.500000 /end CHARACTERISTIC
/begin CHARACTERISTIC TGGLS "Zeitdauer fuer ADC nach Interrupt im Funktionsrechner (Asic)" VALUE 0x83EA DAMOS_FW1 0 TQ1 0.000000 0.255000 /end CHARACTERISTIC
/begin CHARACTERISTIC THAS "Zeit fuer schnelle Hoehenadaption" VALUE 0x8269 DAMOS_FW1 0 TQ100 0.000000 25.500000 /end CHARACTERISTIC
/begin CHARACTERISTIC THEH " Zeit fuer Sondenheizung maximal nach Start hinter Kat" VALUE 0x8245 DAMOS_FW1 0 TQ1000 0.000000 255.000000 /end CHARACTERISTIC
/begin CHARACTERISTIC THEV " Zeit fuer Sondenheizung maximal nach Start vor Kat" VALUE 0x8244 DAMOS_FW1 0 TQ1000 0.000000 255.000000 /end CHARACTERISTIC
/begin CHARACTERISTIC THHA " Auszeit fuer Reduzierung der Heizleistung hinter Kat" VALUE 0x8247 DAMOS_FW1 0 TQ10 0.000000 2.550000 /end CHARACTERISTIC
/begin CHARACTERISTIC THHAWU "Ausschaltzeit während Leistungsreduzierung Sondenheizung hinter Kat" VALUE 0x8243 DAMOS_FW1 0 TQ10 0.000000 2.550000 /end CHARACTERISTIC
/begin CHARACTERISTIC THROM "Haltezeit fuer Hauptrelais nach Zuendung aus ohne Motorlauf" VALUE 0x81CA DAMOS_FW3 0 TQ100L 0.000000 6553.500000 /end CHARACTERISTIC
/begin CHARACTERISTIC THSHKTK " Kennlinie Ausschaltdauer Sondenheizung hinter Kat Bank1" CURVE 0xB014 DAMOS_KL97 0 TQ10 0.000000 2.550000 /begin AXIS_DESCR STD_AXIS TKATM UTABG 8 -48.000000 972.000000 /end AXIS_DESCR /end CHARACTERISTIC
/begin CHARACTERISTIC THSRIH "Zeitverzoegerte Bereitschaft der Ri-Messung nach eingesch. Sondenhzg. hinter KAT" VALUE 0x83FE DAMOS_FW3 0 TQ10L 0.000000 655.350000 /end CHARACTERISTIC
/begin CHARACTERISTIC THSRIV "Zeitverzoegerte Bereitschaft der Ri-Messung nach eingesch. Sondenheizung vor KAT" VALUE 0x8400 DAMOS_FW3 0 TQ10L 0.000000 655.350000 /end CHARACTERISTIC
/begin CHARACTERISTIC THSVKTA " Kennlinie Ausschaltdauer Sondenheizung vor Kat Bank1" CURVE 0xB000 DAMOS_KL97 0 TQ10 0.000000 2.550000 /begin AXIS_DESCR STD_AXIS TABGM UTABG 8 -48.000000 972.000000 /end AXIS_DESCR /end CHARACTERISTIC
/begin CHARACTERISTIC THVA " Auszeit fuer Reduzierung der Heizleistung vor Kat" VALUE 0x8246 DAMOS_FW1 0 TQ10 0.000000 2.550000 /end CHARACTERISTIC
/begin CHARACTERISTIC THVAWU "Ausschaltzeit während Leistungsreduzierung Sondenheizung vor Kat" VALUE 0x8242 DAMOS_FW1 0 TQ10 0.000000 2.550000 /end CHARACTERISTIC
/begin CHARACTERISTIC TIP_DOWN "Tip down Verzoegerung" CURVE 0x86B6 DAMOS_FKL2 0 U_A -22.222080 22.048470
 /begin AXIS_DESCR FIX_AXIS IR0 DEZ 7 0.000000 6.000000 FIX_AXIS_PAR 0 0 7 EXTENDED_LIMITS 0.000000 256.000000 /end AXIS_DESCR
 EXTENDED_LIMITS -22.222100 22.048500 /end CHARACTERISTIC
/begin RECORD_LAYOUT DAMOS_FKL2 FNC_VALUES 1 SBYTE COLUMN_DIR DIRECT /end RECORD_LAYOUT
/begin CHARACTERISTIC TIP_UP "Tip up Beschleunigung" CURVE 0x86AF DAMOS_FKL2 0 U_A -22.222080 22.048470
 /begin AXIS_DESCR FIX_AXIS IR0 DEZ 7 0.000000 6.000000 FIX_AXIS_PAR 0 0 7 EXTENDED_LIMITS 0.000000 256.000000 /end AXIS_DESCR
 EXTENDED_LIMITS -22.222100 22.048500 /end CHARACTERISTIC
/begin CHARACTERISTIC TKATMLRH "KAT-TEMP-Schwelle fuer Regelung hinter Kat (vorlaeufig)" VALUE 0x820B DAMOS_FW1 0 UTABG -48.000000 972.000000 /end CHARACTERISTIC
/begin CHARACTERISTIC TKLWS "Standzeit Spaetwinkel der dyn. Antiruckelfkt. bei Lastwechselschlag" CURVE 0xA878 DAMOS_KL97 0 TQ10 0.000000 2.550000 /begin AXIS_DESCR STD_AXIS NMOT NQ40 6 0.000000 10200.000000 /end AXIS_DESCR /end CHARACTERISTIC
/begin CHARACTERISTIC TKOAMNN "min. Abschaltzeit des Klimakompressors" CURVE 0xC93E DAMOS_KL97 0 TQ200 0.000000 51.000000 /begin AXIS_DESCR STD_AXIS NMOT NQ40 8 0.000000 10200.000000 /end AXIS_DESCR /end CHARACTERISTIC
/begin CHARACTERISTIC TKOAMXN "max. Abschaltzeit des Klimakompressors" CURVE 0xC952 DAMOS_KL97 0 TQ200 0.000000 51.000000 /begin AXIS_DESCR STD_AXIS NMOT NQ40 8 0.000000 10200.000000 /end AXIS_DESCR /end CHARACTERISTIC
/begin CHARACTERISTIC TKOEMNN "min. Einschaltzeit des Klimakompressors" CURVE 0xC966 DAMOS_KL97 0 TQ200 0.000000 51.000000 /begin AXIS_DESCR STD_AXIS NMOT NQ40 8 0.000000 10200.000000 /end AXIS_DESCR /end CHARACTERISTIC
/begin CHARACTERISTIC TKTPVK "Abgastemperatur Kat (aus ATM) fuer TP-Ueberwachung Sonde vor Kat" VALUE 0x832C DAMOS_FW1 0 UTABG -48.000000 972.000000 /end CHARACTERISTIC
/begin CHARACTERISTIC TLDKHUB "drehzahlabh. Max.-Wert für TL-Regler-Hub" CURVE 0xC33A DAMOS_KL97 0 UWKL10 0.000000 10.069900 /begin AXIS_DESCR STD_AXIS NMOT NQ40 6 0.000000 10200.000000 /end AXIS_DESCR /end CHARACTERISTIC
/begin CHARACTERISTIC TLESZWN " Lastschwelle fuer Einspritzkorrektur bei ZW-Verstellung" CURVE 0xD36E DAMOS_KL97 0 UFUELL 0.000000 191.250000 /begin AXIS_DESCR STD_AXIS NMOT NQ40 7 0.000000 10200.000000 /end AXIS_DESCR /end CHARACTERISTIC
/begin CHARACTERISTIC TLFI "Lastschwelle Drehzahlfilter in AR-Funktion" VALUE 0x81A0 DAMOS_FW1 0 UFUELL 0.000000 191.250000 /end CHARACTERISTIC
/begin CHARACTERISTIC TLIPFIL_UM "Filterkonst. f. Lastfilter f. FU" VALUE 0x87FC DAMOS_FW1 0 UMFFTLC 0.156863 10200.000000 EXTENDED_LIMITS 0.156860 10200.000000 /end CHARACTERISTIC
/begin CHARACTERISTIC TLIPTV_UM "Verzugzeit f. Lastwert tlip_um f. FU" VALUE 0x87FD DAMOS_FW1 0 UMFTLC 0.000000 10200.000000 /end CHARACTERISTIC
/begin CHARACTERISTIC TLIP_T_UM "Max. Fehlerzeit der FU (Lastsig. aus DK und N)" VALUE 0x8804 DAMOS_FW1 0 UMFTLC 0.000000 10200.000000 /end CHARACTERISTIC
/begin CHARACTERISTIC TLKRN "Lastschwelle fuer Klopfen = aktiv" CURVE 0xB202 DAMOS_KL97 0 UFUELL 0.000000 191.250000 /begin AXIS_DESCR STD_AXIS NMOT NQ40 8 0.000000 10200.000000 /end AXIS_DESCR /end CHARACTERISTIC
/begin CHARACTERISTIC TLLASH "Verzoegerungszeit um lamlash_w zu sperren wenn lamsons_w ungleich lamlash_w ist" VALUE 0x8360 DAMOS_FW1 0 TQ100 0.000000 25.500000 /end CHARACTERISTIC
/begin CHARACTERISTIC TLLRHO "obere Lastgrenze fuer Regelung hinter KAT" VALUE 0x820E DAMOS_FW1 0 UFUELL 0.000000 191.250000 /end CHARACTERISTIC
/begin CHARACTERISTIC TLMXN "max. TL als f( NIST )" CURVE 0x90F6 DAMOS_KL97 0 UTL16K 0.000000 174.080000 /begin AXIS_DESCR STD_AXIS NMOT NQ40 8 0.000000 10200.000000 /end AXIS_DESCR /end CHARACTERISTIC
/begin CHARACTERISTIC TLMXNNW "max. TL als f( NIST ) bei B_NWS = 1" CURVE 0x91C2 DAMOS_KL97 0 UTL16K 0.000000 174.080000 /begin AXIS_DESCR STD_AXIS NMOT NQ40 8 0.000000 10200.000000 /end AXIS_DESCR /end CHARACTERISTIC
/begin CHARACTERISTIC TLNOK_UM "Mult. f. TL8 Ermittelung f. FU" VALUE 0x87FA DAMOS_FW3 0 UTL_NOK 0.000000 5624.911000 EXTENDED_LIMITS 0.000000 5624.910000 /end CHARACTERISTIC
/begin CHARACTERISTIC TLNWSAN "Lastschwelle für NWS ausschalten" CURVE 0xCE92 DAMOS_KL97 0 UFUELL 0.000000 191.250000 /begin AXIS_DESCR STD_AXIS NMOT NQ40 8 0.000000 10200.000000 /end AXIS_DESCR /end CHARACTERISTIC
/begin CHARACTERISTIC TLNWSEN "Lastschwelle für NWS einschalten" CURVE 0xCEA6 DAMOS_KL97 0 UFUELL 0.000000 191.250000 /begin AXIS_DESCR STD_AXIS NMOT NQ40 8 0.000000 10200.000000 /end AXIS_DESCR /end CHARACTERISTIC
/begin CHARACTERISTIC TLNWSKHAN "Lastschwelle für NWS ausschalten bei B_kh" CURVE 0xCEBA DAMOS_KL97 0 UFUELL 0.000000 191.250000 /begin AXIS_DESCR STD_AXIS NMOT NQ40 8 0.000000 10200.000000 /end AXIS_DESCR /end CHARACTERISTIC
/begin CHARACTERISTIC TLNWSKHEN "Lastschwelle für NWS einschalten bei B_kh" CURVE 0xCECE DAMOS_KL97 0 UFUELL 0.000000 191.250000 /begin AXIS_DESCR STD_AXIS NMOT NQ40 8 0.000000 10200.000000 /end AXIS_DESCR /end CHARACTERISTIC
/begin CHARACTERISTIC TLO2 "Grenze fuer Adaptionsbereichs-Bestimmung FRAU" VALUE 0x8215 DAMOS_FW1 0 UFUELL 0.000000 191.250000 /end CHARACTERISTIC
/begin CHARACTERISTIC TLO3 "Grenze fuer Adaptionsbereichs-Bestimmung" VALUE 0x8216 DAMOS_FW1 0 UFUELL 0.000000 191.250000 /end CHARACTERISTIC
/begin CHARACTERISTIC TLRAN "Lastschwellen fuer Abschalten LR" CURVE 0xAB92 DAMOS_KL97 0 UFUELL 0.000000 191.250000 /begin AXIS_DESCR STD_AXIS NIST NQ25 8 0.000000 6400.000000 /end AXIS_DESCR /end CHARACTERISTIC
/begin CHARACTERISTIC TLRAN1 "Lastschwellen fuer Abschalten LR (Automat)" CURVE 0xABA6 DAMOS_KL97 0 UFUELL 0.000000 191.250000 /begin AXIS_DESCR STD_AXIS NIST NQ25 8 0.000000 6400.000000 /end AXIS_DESCR /end CHARACTERISTIC
/begin CHARACTERISTIC TLRHUN "Kennlinie ueber n, untere tL Regelgrenze fuer Regler hKat" CURVE 0xAB59 DAMOS_GKL1 0 UFUELL 0.000000 191.250000
 /begin AXIS_DESCR COM_AXIS NIST NQ25 8 0.000000 0.000000 AXIS_PTS_REF NISTV08 EXTENDED_LIMITS 0.000000 6400.000000 /end AXIS_DESCR
/end CHARACTERISTIC
/begin CHARACTERISTIC TLRPR_T "Zeit fuer TL-Regelungs-Pruefung" VALUE 0x85F0 DAMOS_FW3 0 TQ100L 0.000000 6553.500000 /end CHARACTERISTIC
/begin CHARACTERISTIC TLRSA "Sperrzeit fuer Einschalten LR nach SA" VALUE 0x81E0 DAMOS_FW1 0 TQ100 0.000000 25.500000 /end CHARACTERISTIC
/begin CHARACTERISTIC TLSALN1 " " CURVE 0xB4C9 DAMOS_GKL1 0 UFUELL 0.000000 191.250000
 /begin AXIS_DESCR COM_AXIS NIST NQ25 8 0.000000 0.000000 AXIS_PTS_REF NDMDV08 EXTENDED_LIMITS 0.000000 6400.000000 /end AXIS_DESCR
/end CHARACTERISTIC
/begin CHARACTERISTIC TLSALUN "Lastschwelle zur Schuberkennung Ausblendung der Aussetzererkennung" CURVE 0xB4C1 DAMOS_GKL1 0 UFUELL 0.000000 191.250000
 /begin AXIS_DESCR COM_AXIS NIST NQ25 8 0.000000 0.000000 AXIS_PTS_REF NDMDV08 EXTENDED_LIMITS 0.000000 6400.000000 /end AXIS_DESCR
/end CHARACTERISTIC
/begin CHARACTERISTIC TLSN "Lastschwelle für Schubabschalten" VALUE 0x8122 DAMOS_FW1 0 UFUELL 0.000000 191.250000 /end CHARACTERISTIC
/begin CHARACTERISTIC TLST "Start-Lastwert pro KWU" VALUE 0x8145 DAMOS_FW1 0 UTL_ST 0.000000 348.160000 /end CHARACTERISTIC
/begin CHARACTERISTIC TLTPKTO "obere Lastschwelle fuer Periodendauer-Kurztest" VALUE 0x832D DAMOS_FW1 0 UFUELL 0.000000 191.250000 /end CHARACTERISTIC
/begin CHARACTERISTIC TLTPKTU "untere Lastschwelle fuer Periodendauer-Kurztest" VALUE 0x832E DAMOS_FW1 0 UFUELL 0.000000 191.250000 /end CHARACTERISTIC
/begin CHARACTERISTIC TLTPVKO "obere Lastschwelle fuer Periodendauerueberwachung vor Kat" VALUE 0x832F DAMOS_FW1 0 UFUELL 0.000000 191.250000 /end CHARACTERISTIC
/begin CHARACTERISTIC TLTPVKU "untere Lastschwelle fuer Periodendauerueberwachung vor Kat" VALUE 0x8330 DAMOS_FW1 0 UFUELL 0.000000 191.250000 /end CHARACTERISTIC
/begin CHARACTERISTIC TLU2 "Grenze fuer Adaptionsbereichs-Bestimmung" VALUE 0x8212 DAMOS_FW1 0 UFUELL 0.000000 191.250000 /end CHARACTERISTIC
/begin CHARACTERISTIC TLU3 "Grenze fuer Adaptionsbereichs-Bestimmung" VALUE 0x8213 DAMOS_FW1 0 UFUELL 0.000000 191.250000 /end CHARACTERISTIC
/begin CHARACTERISTIC TLU4 "Grenze fuer Adaptionsbereichs-Bestimmung FRAO" VALUE 0x8214 DAMOS_FW1 0 UFUELL 0.000000 191.250000 /end CHARACTERISTIC
/begin CHARACTERISTIC TLWNSP "TLW-Schwelle fuer Nachspritzer" VALUE 0x822A DAMOS_FW1 0 TEQ_32 0.000000 21.760000 /end CHARACTERISTIC
/begin CHARACTERISTIC TLZWB "Lastschwelle, ZwB-Bereichserkennung" VALUE 0x8179 DAMOS_FW1 0 UFUELL 0.000000 191.250000 /end CHARACTERISTIC
/begin CHARACTERISTIC TL_BO_UM "Offset f. obere Grenzwertber. TL8 f. FU" VALUE 0x8802 DAMOS_FW1 0 UFUELL 0.000000 191.250000 /end CHARACTERISTIC
/begin CHARACTERISTIC TL_BU_UM "Offset f. untere Grenzwertber. TL8 f. FU" VALUE 0x8800 DAMOS_FW1 0 UFUELL 0.000000 191.250000 /end CHARACTERISTIC
/begin CHARACTERISTIC TL_IVER "I-Verstaerkung fuer TL-Regelung" VALUE 0x85BD DAMOS_FW1 0 UTLIVER 0.000000 25600.000000 EXTENDED_LIMITS 0.000000 51000.000000 /end CHARACTERISTIC
/begin CHARACTERISTIC TL_MO_UM "Geradensteigung f. obere Grenzwertber. TL8 f. FU" VALUE 0x8801 DAMOS_FW1 0 FKT64 0.000000 3.984375 EXTENDED_LIMITS 0.000000 3.984380 /end CHARACTERISTIC
/begin CHARACTERISTIC TL_MU_UM "Geradensteigung f. untere Grenzwertber. TL8 f. FU" VALUE 0x87FF DAMOS_FW1 0 FKT64 0.000000 3.984375 EXTENDED_LIMITS 0.000000 3.984380 /end CHARACTERISTIC
/begin CHARACTERISTIC TL_M_UG "Untergrenzen-Anteil bei Teillast als f(NIST)" CURVE 0xBFB2 DAMOS_GKL1 0 UWKL10 0.000000 10.069900
 /begin AXIS_DESCR COM_AXIS NIST NQ25 9 0.000000 0.000000 AXIS_PTS_REF NISTV10 EXTENDED_LIMITS 0.000000 6400.000000 /end AXIS_DESCR
/end CHARACTERISTIC
/begin CHARACTERISTIC TL_NOK "Multiplikationskonstante fuer Lastnormierung" VALUE 0x8126 DAMOS_FW3 0 UTL_NOK 0.000000 5624.911000 EXTENDED_LIMITS 0.000000 5624.910000 /end CHARACTERISTIC
/begin CHARACTERISTIC TL_T_UM "Max. Fehlerzeit der FU (Lastsig. plaus.)" VALUE 0x8803 DAMOS_FW1 0 UMFTLC 0.000000 10200.000000 /end CHARACTERISTIC
/begin CHARACTERISTIC TMALU1 " Tmot Ausschaltschwelle Stufe 1 " VALUE 0x87A4 DAMOS_FW3 0 TMP_10B -41.000000 140.000000 /end CHARACTERISTIC
/begin CHARACTERISTIC TMALU2 " Tmot Ausschaltschwelle Stufe 2 " VALUE 0x87A8 DAMOS_FW3 0 TMP_10B -41.000000 140.000000 /end CHARACTERISTIC
/begin CHARACTERISTIC TMASKIV1 "Temp.schwelle f. Verlängerung 1. Kat Intervall" VALUE 0x847D DAMOS_FW1 0 CMO_TMP -41.000000 140.000000 /end CHARACTERISTIC
/begin CHARACTERISTIC TMATMKV "Motortemperaturschwelle verlaengerte Taupunktendezeit" VALUE 0x825D DAMOS_FW1 0 CMO_TMP -41.000000 140.000000 /end CHARACTERISTIC
/begin CHARACTERISTIC TMATMTP "Motortemperaturschwelle Taupunktpruefung" VALUE 0x825C DAMOS_FW1 0 CMO_TMP -41.000000 140.000000 /end CHARACTERISTIC
/begin CHARACTERISTIC TMAXKAT "maximale Kat-Temperatur fuer Kat-Diagnose" VALUE 0x839E DAMOS_FW1 0 UTABG -48.000000 972.000000 /end CHARACTERISTIC
/begin CHARACTERISTIC TMDMMA "Anfangstemperatur des Motortemperaturmodells" VALUE 0x846B DAMOS_FW1 0 UTMP_40 -40.000000 216.000000 /end CHARACTERISTIC
/begin CHARACTERISTIC TMDMME "Endetemperatur des Motortemperaturmodells" VALUE 0x846C DAMOS_FW1 0 UTMP_40 -40.000000 216.000000 /end CHARACTERISTIC
/begin CHARACTERISTIC TMDMN "Motortemperatur, min. Schwelle" VALUE 0x8461 DAMOS_FW1 0 UTMP_40 -40.000000 216.000000 /end CHARACTERISTIC
/begin CHARACTERISTIC TMDMX "Motortemperatur, max. Schwelle" VALUE 0x8462 DAMOS_FW1 0 UTMP_40 -40.000000 216.000000 /end CHARACTERISTIC
/begin CHARACTERISTIC TMDV "Motortemperaturschwelle für Freigabe Fz-Geschw.-Diagnose" VALUE 0x87DE DAMOS_FW1 0 CMO_TMP -41.000000 140.000000 /end CHARACTERISTIC
/begin CHARACTERISTIC TMDYNA "Tmot-Schwelle fuer Lastdynamik aktiv" VALUE 0x82B5 DAMOS_FW1 0 CMO_TMP -41.000000 140.000000 /end CHARACTERISTIC
/begin CHARACTERISTIC TMELU1 " Tmot Einschaltschwelle Stufe 1 " VALUE 0x87A2 DAMOS_FW3 0 TMP_10B -41.000000 140.000000 /end CHARACTERISTIC
/begin CHARACTERISTIC TMELU2 " Tmot Einschaltschwelle Stufe 2 " VALUE 0x87A6 DAMOS_FW3 0 TMP_10B -41.000000 140.000000 /end CHARACTERISTIC
/begin CHARACTERISTIC TMESZW " " VALUE 0x8615 DAMOS_FW1 0 CMO_TMP -41.000000 140.000000 /end CHARACTERISTIC
/begin CHARACTERISTIC TMILEI " Lampeneinzeit fuer Diagnose" VALUE 0x879A DAMOS_FW3 0 TQ10L 0.000000 655.350000 /end CHARACTERISTIC
/begin CHARACTERISTIC TMINKAT "Minimale KAT-Temperatur fuer Ueberwachung" VALUE 0x839F DAMOS_FW1 0 UTABG -48.000000 972.000000 /end CHARACTERISTIC
/begin CHARACTERISTIC TMKOAO "Abschalttemperatur Klimaanlage" VALUE 0x87E7 DAMOS_FW1 0 CMO_TMP -41.000000 140.000000 /end CHARACTERISTIC
/begin CHARACTERISTIC TMKOAU "Wiedereinschalttemperatur Klimaanlage" VALUE 0x87E6 DAMOS_FW1 0 CMO_TMP -41.000000 140.000000 /end CHARACTERISTIC
/begin CHARACTERISTIC TMKR "Temperaturschwelle fuer Klopfen plausibel" VALUE 0x8270 DAMOS_FW1 0 CMO_TMP -41.000000 140.000000 /end CHARACTERISTIC
/begin CHARACTERISTIC TMKRA "Temperaturschwelle fuer KLA-Freigabe" VALUE 0x8286 DAMOS_FW1 0 CMO_TMP -41.000000 140.000000 /end CHARACTERISTIC
/begin CHARACTERISTIC TMLF1 " Temp.schwelle für Motorlüfter" VALUE 0x87AE DAMOS_FW3 0 TMP_10B -41.000000 140.000000 /end CHARACTERISTIC
/begin CHARACTERISTIC TMLF2 " Temp.schwelle für Motorlüfter" VALUE 0x87B0 DAMOS_FW3 0 TMP_10B -41.000000 140.000000 /end CHARACTERISTIC
/begin CHARACTERISTIC TMLRLTS "LR-Freigabetemperaturschwelle bei B_LL & !B_GV " CURVE 0xAB79 DAMOS_GKL1 0 CMO_TMP -41.000000 140.000000
 /begin AXIS_DESCR COM_AXIS TMST CMO_TMP 12 0.000000 0.000000 AXIS_PTS_REF TSTMOTV08 EXTENDED_LIMITS -41.000000 140.000000 /end AXIS_DESCR
/end CHARACTERISTIC
/begin CHARACTERISTIC TMLRLTS1 "LR-Freigabetemperaturschwelle bei B_LL & B_GV " CURVE 0xAB85 DAMOS_GKL1 0 CMO_TMP -41.000000 140.000000
 /begin AXIS_DESCR COM_AXIS TMST CMO_TMP 12 0.000000 0.000000 AXIS_PTS_REF TSTMOTV08 EXTENDED_LIMITS -41.000000 140.000000 /end AXIS_DESCR
/end CHARACTERISTIC
/begin CHARACTERISTIC TMLRTS "LR-Freigabetemperaturschwelle bei !B_LL & !B_GV " CURVE 0xAB61 DAMOS_GKL1 0 CMO_TMP -41.000000 140.000000
 /begin AXIS_DESCR COM_AXIS TMST CMO_TMP 12 0.000000 0.000000 AXIS_PTS_REF TSTMOTV08 EXTENDED_LIMITS -41.000000 140.000000 /end AXIS_DESCR
/end CHARACTERISTIC
/begin CHARACTERISTIC TMLRTS1 "LR-Freigabetemperaturschwelle bei !B_LL & B_GV " CURVE 0xAB6D DAMOS_GKL1 0 CMO_TMP -41.000000 140.000000
 /begin AXIS_DESCR COM_AXIS TMST CMO_TMP 12 0.000000 0.000000 AXIS_PTS_REF TSTMOTV08 EXTENDED_LIMITS -41.000000 140.000000 /end AXIS_DESCR
/end CHARACTERISTIC
/begin CHARACTERISTIC TMNEB "Temperaturschwelle für Nebenschluss" VALUE 0x83B2 DAMOS_FW1 0 CMO_TMP -41.000000 140.000000 /end CHARACTERISTIC
/begin CHARACTERISTIC TMNKATT "minimale Kat-Temperatur fuer Ueberwachung bei Testerbetrieb" VALUE 0x83A0 DAMOS_FW1 0 UTABG -48.000000 972.000000 /end CHARACTERISTIC
/begin CHARACTERISTIC TMNWS "Motortemperaturschwelle für Nockenwellenverstellung" VALUE 0x8230 DAMOS_FW1 0 CMO_TMP -41.000000 140.000000 /end CHARACTERISTIC
/begin CHARACTERISTIC TMOHSMN " minimale Motortemperatur fuer Sondenheizung" VALUE 0x8248 DAMOS_FW1 0 CMO_TMP -41.000000 140.000000 /end CHARACTERISTIC
/begin AXIS_PTS TMOTV08 "Motortemperaturstuetzstellen" 0x8D7C TMOT DAMOS_SST97 0 CMO_TMP 12 -41.000000 140.000000 /end AXIS_PTS
/begin CHARACTERISTIC TMRAA "TMOT-Einschaltschwelle für LR-Adaption" VALUE 0x8219 DAMOS_FW1 0 CMO_TMP -41.000000 140.000000 /end CHARACTERISTIC
/begin CHARACTERISTIC TMRAO "Obere TMOT-Aussschaltschwelle für LR-Adaption" VALUE 0x821A DAMOS_FW1 0 CMO_TMP -41.000000 140.000000 /end CHARACTERISTIC
/begin CHARACTERISTIC TMSV "TMOT-Schwelle fuer Erkennung einer kalten Sonde" VALUE 0x83B3 DAMOS_FW1 0 CMO_TMP -41.000000 140.000000 /end CHARACTERISTIC
/begin CHARACTERISTIC TMSVA "TMABS(TMOT)-Schwelle fuer Erkennung einer kalten Sonde" VALUE 0x83B4 DAMOS_FW1 0 CMO_TMP -41.000000 140.000000 /end CHARACTERISTIC
/begin CHARACTERISTIC TMTE "Freigabeschwelle fuer Tankentlueftung" VALUE 0x82BB DAMOS_FW1 0 CMO_TMP -41.000000 140.000000 /end CHARACTERISTIC
/begin CHARACTERISTIC TMVDBS "Zeitdauer Entprellung der Schlechtwegerkennung" VALUE 0x82E8 DAMOS_FW3 0 TQ10L 0.000000 655.350000 /end CHARACTERISTIC
/begin CHARACTERISTIC TMVL "Temperaturschwelle fuer Vollastanreicherung Einspritzung" VALUE 0x8148 DAMOS_FW1 0 CMO_TMP -41.000000 140.000000 /end CHARACTERISTIC
/begin CHARACTERISTIC TMWALA "Motortemperaturschwelle für Ausschalten Warnlampe 'Motor zu heiß'" VALUE 0x8796 DAMOS_FW3 0 TMP_10B -41.000000 140.000000 /end CHARACTERISTIC
/begin CHARACTERISTIC TMWALE "Motortemperaturschwelle für Einschalten Warnlampe 'Motor zu heiß'" VALUE 0x8794 DAMOS_FW3 0 TMP_10B -41.000000 140.000000 /end CHARACTERISTIC
/begin CHARACTERISTIC TMWUC "Motortemperaturschwelle fuer Erfuelluung 'warm up cycle'" VALUE 0x8838 DAMOS_FW1 0 CMO_TMP -41.000000 140.000000 /end CHARACTERISTIC
/begin CHARACTERISTIC TMWUCST "max. Motortemperatur im Start fuer Erfuelluung 'warm up cycle'" VALUE 0x8839 DAMOS_FW1 0 CMO_TMP -41.000000 140.000000 /end CHARACTERISTIC
/begin CHARACTERISTIC TN1LF " Zeitschwelle für Motorlüfter" VALUE 0x87B2 DAMOS_FW1 0 TQ1000 0.000000 255.000000 /end CHARACTERISTIC
/begin CHARACTERISTIC TN2LF " Zeitschwelle für Motorlüfter" VALUE 0x87B3 DAMOS_FW1 0 TQ1000 0.000000 255.000000 /end CHARACTERISTIC
/begin CHARACTERISTIC TNACMX "max. Zeit für Drehzahl nac nach s_ko = 0" VALUE 0x87E2 DAMOS_FW1 0 TQ1000 0.000000 255.000000 /end CHARACTERISTIC
/begin CHARACTERISTIC TNALUN "Testphasenlage nach erkanntem Aussetzer" CURVE 0xB793 DAMOS_GKL1 0 DEZ 0.000000 256.000000
 /begin AXIS_DESCR COM_AXIS NIST NQ25 8 0.000000 0.000000 AXIS_PTS_REF NDMDV08 EXTENDED_LIMITS 0.000000 6400.000000 /end AXIS_DESCR
/end CHARACTERISTIC
/begin CHARACTERISTIC TNEPACLF " Zeitschwelle für Motorlüfter bei PAC-Fehler" VALUE 0x87B4 DAMOS_FW1 0 TQ1000 0.000000 255.000000 /end CHARACTERISTIC
/begin CHARACTERISTIC TNMAXAT "Zeit fuer Getriebeschutz" VALUE 0x81AE DAMOS_FW1 0 TQ80 0.000000 20.400000 /end CHARACTERISTIC
/begin CHARACTERISTIC TNMAXK "Zeit fuer Kurzzeit-Grenzdrehzahl" VALUE 0x81AD DAMOS_FW1 0 TQ80 0.000000 20.400000 /end CHARACTERISTIC
/begin CHARACTERISTIC TNMAXKE "Zeit fuer Kurzzeit-Grenzdrehzahl EGAS-Regler" VALUE 0x81B2 DAMOS_FW1 0 TQ80 0.000000 20.400000 /end CHARACTERISTIC
/begin CHARACTERISTIC TNOMACC " Fehlerentprellzeit ACC fuer Abschalten der Fktn." VALUE 0x8504 DAMOS_FW3 0 TQ10L 0.000000 655.350000 /end CHARACTERISTIC
/begin CHARACTERISTIC TNOMASR " Fehlerentprellzeit ASr fuer Abschalten der Fktn." VALUE 0x84E8 DAMOS_FW3 0 TQ10L 0.000000 655.350000 /end CHARACTERISTIC
/begin CHARACTERISTIC TNOMBC "Entprellzeit Funktionsabschaltung CAN-Node NBC" VALUE 0x84DA DAMOS_FW3 0 TQ10L 0.000000 655.350000 /end CHARACTERISTIC
/begin CHARACTERISTIC TNOMEGS " Fehlerentprellzeit EGS fuer Abschalten der Fktn." VALUE 0x84F6 DAMOS_FW3 0 TQ10L 0.000000 655.350000 /end CHARACTERISTIC
/begin CHARACTERISTIC TNOMNBA " Fehlerentprellzeit NBA fuer Abschalten der Fktn." VALUE 0x8512 DAMOS_FW3 0 TQ10L 0.000000 655.350000 /end CHARACTERISTIC
/begin CHARACTERISTIC TNSRUB "Soll-TN aus Ladebilanzregelung" CURVE 0xC454 DAMOS_KL97 0 UTNQ 352.941200 90000.000000 /begin AXIS_DESCR STD_AXIS LBZ DEZ 6 0.000000 256.000000 /end AXIS_DESCR EXTENDED_LIMITS 352.941000 90000.000000 /end CHARACTERISTIC
/begin CHARACTERISTIC TNSSA "Zeitsperre fuer SAS ab Startende" VALUE 0x8120 DAMOS_FW3 0 UTWKSL 0.000000 6553.500000 /end CHARACTERISTIC
/begin CHARACTERISTIC TNSTDN "VZ nach Start fuer Diagnose Sondennebenschluss vor Kat" VALUE 0x83B5 DAMOS_FW1 0 TQ100 0.000000 25.500000 /end CHARACTERISTIC
/begin CHARACTERISTIC TNSTKO "Unterdrückungszeit des Kompressors nach dem Start" VALUE 0x87E3 DAMOS_FW1 0 TQ1000 0.000000 255.000000 /end CHARACTERISTIC
/begin CHARACTERISTIC TNSUUK "Zeit UK-Unterdrueckung im Nachstart" VALUE 0x8226 DAMOS_FW3 0 TQ100L 0.000000 6553.500000 /end CHARACTERISTIC
/begin CHARACTERISTIC TNS_HRP "TN-Sollwert-Rampe beim Uebergang auf niedrige Soll-Drehzahl" VALUE 0x8754 DAMOS_FW1 0 UTN9 0.000000 21.250000 /end CHARACTERISTIC
/begin CHARACTERISTIC TNS_NRP "TN-Sollwert-Rampe beim Uebergang auf hohe Soll-Drehzahl" VALUE 0x8755 DAMOS_FW1 0 UTN9 0.000000 21.250000 /end CHARACTERISTIC
/begin CHARACTERISTIC TNWM "Zeitverzögerung für KF-Umschaltung bei NWS" CURVE 0xCE1A DAMOS_KL97 0 TQ10 0.000000 2.550000 /begin AXIS_DESCR STD_AXIS TMOT CMO_TMP 8 -41.000000 140.000000 /end AXIS_DESCR /end CHARACTERISTIC
/begin CHARACTERISTIC TNWSE "Leerlaufverzugszeit für NWS Umschaltung" VALUE 0x8233 DAMOS_FW1 0 TQ10 0.000000 2.550000 /end CHARACTERISTIC
/begin CHARACTERISTIC TNWSKHM "Sperrzeit NWS im Warmlauf bei KAT-Heizen" CURVE 0xCEE2 DAMOS_KL97 0 TQ1000 0.000000 255.000000 /begin AXIS_DESCR STD_AXIS TMOT CMO_TMP 8 -41.000000 140.000000 /end AXIS_DESCR /end CHARACTERISTIC
/begin CHARACTERISTIC TNWSM "Sperrzeit NWS im Warmlauf" CURVE 0xCE2E DAMOS_KL97 0 TQ1000 0.000000 255.000000 /begin AXIS_DESCR STD_AXIS TMOT CMO_TMP 8 -41.000000 140.000000 /end AXIS_DESCR /end CHARACTERISTIC
/begin CHARACTERISTIC TNWST "Anzahl Zündungen für Startzündwinkel außerhalb Start noch gültig" VALUE 0x816E DAMOS_FW1 0 DEZ 0.000000 256.000000 /end CHARACTERISTIC
/begin CHARACTERISTIC TN_FGR "Nennerzeitkonstante fuer FGR" CURVE 0x86CC DAMOS_FKL3 0 TQ1L 0.000000 65.535000
 /begin AXIS_DESCR FIX_AXIS IR0 DEZ 7 0.000000 6.000000 FIX_AXIS_PAR 0 0 7 EXTENDED_LIMITS 0.000000 256.000000 /end AXIS_DESCR
/end CHARACTERISTIC
/begin CHARACTERISTIC TN_FGR1 "Nennerzeitkonstante fuer FGR bei AT-Getr." CURVE 0x8704 DAMOS_FKL3 0 TQ1L 0.000000 65.535000
 /begin AXIS_DESCR FIX_AXIS IR0 DEZ 7 0.000000 6.000000 FIX_AXIS_PAR 0 0 7 EXTENDED_LIMITS 0.000000 256.000000 /end AXIS_DESCR
/end CHARACTERISTIC
/begin CHARACTERISTIC TPBAGR "Taktperioden für AGR-Beschleunigung" VALUE 0x8239 DAMOS_FW1 0 TQ10 0.000000 2.550000 /end CHARACTERISTIC
/begin CHARACTERISTIC TPED1 "Pedaleinstell-Überwachung, Fehlerzeit SP1S" VALUE 0x87EA DAMOS_FW1 0 TQ10 0.000000 2.550000 /end CHARACTERISTIC
/begin CHARACTERISTIC TPED2 "Pedaleinstell-Überwachung, Fehlerzeit SP2S" VALUE 0x87EB DAMOS_FW1 0 TQ10 0.000000 2.550000 /end CHARACTERISTIC
/begin CHARACTERISTIC TPKL15 "Entprellzeit fuer Klemme 15" VALUE 0x81C8 DAMOS_FW3 0 TQ100L 0.000000 6553.500000 /end CHARACTERISTIC
/begin CHARACTERISTIC TPR10V "Vorlaufzeit der Elektrokraftstoffpumpe bei stehendem Motor" VALUE 0x81CC DAMOS_FW1 0 TQ100 0.000000 25.500000 /end CHARACTERISTIC
/begin CHARACTERISTIC TPSVKMN "Unterer Grenzwert der Periodendauer von U-Sonde" VALUE 0x8488 DAMOS_FW1 0 TQ40 0.000000 10.200000 /end CHARACTERISTIC
/begin CHARACTERISTIC TPSVKMX "Oberer Grenzwert der Periodendauer von U-Sonde" VALUE 0x8489 DAMOS_FW1 0 TQ40 0.000000 10.200000 /end CHARACTERISTIC
/begin CHARACTERISTIC TP_ACC "Sendeperiode CAN-Node NAC" VALUE 0x8506 DAMOS_FW1 0 TQ10L 0.000000 655.350000 /end CHARACTERISTIC
/begin CHARACTERISTIC TP_ASR "Sendeperiode CAN-Node NFR" VALUE 0x84EA DAMOS_FW1 0 TQ10L 0.000000 655.350000 /end CHARACTERISTIC
/begin CHARACTERISTIC TP_BC "Sendeperiode CAN-Node NBC" VALUE 0x84DC DAMOS_FW1 0 TQ10L 0.000000 655.350000 /end CHARACTERISTIC
/begin CHARACTERISTIC TP_EGS "Sendeperiode CAN-Node NCA/NCR" VALUE 0x84F8 DAMOS_FW1 0 TQ10L 0.000000 655.350000 /end CHARACTERISTIC
/begin CHARACTERISTIC TP_NBA "Sendeperiode CAN-Node NBA" VALUE 0x8514 DAMOS_FW1 0 TQ10L 0.000000 655.350000 /end CHARACTERISTIC
/begin CHARACTERISTIC TRABN "Verzoegerung fuer Abschalten LR nach Last > TLRAN-Schwelle" CURVE 0xD25E DAMOS_KL97 0 TQ100 0.000000 25.500000 /begin AXIS_DESCR STD_AXIS NMOT NQ40 8 0.000000 10200.000000 /end AXIS_DESCR /end CHARACTERISTIC
/begin CHARACTERISTIC TRABN1 "Verzoegerung fuer Abschalten LR nach Last > TLRAN1-Schwelle" CURVE 0xD272 DAMOS_KL97 0 TQ100 0.000000 25.500000 /begin AXIS_DESCR STD_AXIS NMOT NQ40 8 0.000000 10200.000000 /end AXIS_DESCR /end CHARACTERISTIC
/begin CHARACTERISTIC TRADN "Untere tra-Schwelle fuer Fehlererkennung im Kraftstoffversorgungssystem " VALUE 0x842C DAMOS_FW4 0 TEQ_CPL -87.381330 87.378660 EXTENDED_LIMITS -87.381300 87.378700 /end CHARACTERISTIC
/begin CHARACTERISTIC TRADX "Obere tra-Schwelle fuer Fehlererkennung im Kraftstoffversorgungssystem" VALUE 0x842E DAMOS_FW4 0 TEQ_CPL -87.381330 87.378660 EXTENDED_LIMITS -87.381300 87.378700 /end CHARACTERISTIC
/begin CHARACTERISTIC TRAE "DELTA-tra-Schwelle fuer Erkennung der eingeschwungenen Grundadaption " VALUE 0x8430 DAMOS_FW3 0 TEQL 0.000000 174.760000 /end CHARACTERISTIC
/begin CHARACTERISTIC TRAMN "minimalwert TRA-Integrator" VALUE 0x81F2 DAMOS_FW4 0 TEQ_CPL -84.000000 0.000000 EXTENDED_LIMITS -87.381300 87.378700 /end CHARACTERISTIC
/begin CHARACTERISTIC TRAMX "maximalwert TRA-Integrator" VALUE 0x81F4 DAMOS_FW4 0 TEQ_CPL 0.000000 84.000000 EXTENDED_LIMITS -87.381300 87.378700 /end CHARACTERISTIC
/begin CHARACTERISTIC TRARN "Reduzierte untere Begrenzung des Korrekturfaktors tra " VALUE 0x8432 DAMOS_FW4 0 TEQ_CPL -87.381330 87.378660 EXTENDED_LIMITS -87.381300 87.378700 /end CHARACTERISTIC
/begin CHARACTERISTIC TRARX "Reduzierte obere Begrenzung des Korrekturfaktors tra " VALUE 0x8434 DAMOS_FW4 0 TEQ_CPL -87.381330 87.378660 EXTENDED_LIMITS -87.381300 87.378700 /end CHARACTERISTIC
/begin CHARACTERISTIC TRIAKTH "Zeitdauer fuer Ri-Messung aktuell hinter Kat" VALUE 0x8402 DAMOS_FW3 0 TQ100L 0.000000 6553.500000 /end CHARACTERISTIC
/begin CHARACTERISTIC TRIAKTV "Zeitdauer fuer Ri-Messung aktuell vor Kat" VALUE 0x8404 DAMOS_FW3 0 TQ100L 0.000000 6553.500000 /end CHARACTERISTIC
/begin CHARACTERISTIC TRIIMPH "Zeitdauer fuer Pumpimpuls fuer beide Baenke hinter KAT" VALUE 0x8406 DAMOS_FW3 0 TQ10L 0.000000 655.350000 /end CHARACTERISTIC
/begin CHARACTERISTIC TRIIMPV "Zeitdauer fuer Pumpimpuls fuer beide Baenke vor KAT" VALUE 0x8408 DAMOS_FW3 0 TQ10L 0.000000 655.350000 /end CHARACTERISTIC
/begin CHARACTERISTIC TRIPFASH "Mindestzeitdauer fuer aktive Lambdaregelung vor Kat" VALUE 0x8361 DAMOS_FW1 0 TQ100 0.000000 25.500000 /end CHARACTERISTIC
/begin CHARACTERISTIC TRSA "Sondenueberwachungszeit 'ausschalten'" VALUE 0x83B6 DAMOS_FW1 0 TQ100 0.000000 25.500000 /end CHARACTERISTIC
/begin CHARACTERISTIC TRSAH "Ueberwachungszeit Sonde 'aus' h. K." VALUE 0x83DE DAMOS_FW3 0 TQ100L 0.000000 6553.500000 /end CHARACTERISTIC
/begin CHARACTERISTIC TRSE "Sondenueberwachungszeit 'einschalten'" VALUE 0x83B7 DAMOS_FW1 0 TQ100 0.000000 25.500000 /end CHARACTERISTIC
/begin CHARACTERISTIC TSAKAMN "Mindestschubdauer fuer LRKA-Ausloesung" VALUE 0x8572 DAMOS_FW1 0 TQ100 0.000000 25.500000 /end CHARACTERISTIC
/begin CHARACTERISTIC TSALASH "Zeit nach Schub fuer Ueberpruefung Sonde hinter Kat" VALUE 0x8362 DAMOS_FW1 0 TQ100 0.000000 25.500000 /end CHARACTERISTIC
/begin CHARACTERISTIC TSFAAA "" VALUE 0x8939 DAMOS_FW1 0 DEZ 0.000000 256.000000 /end CHARACTERISTIC
/begin CHARACTERISTIC TSFACMVER "Fehlersummenzeit: Diagnose irreversible ACC abschalten" VALUE 0x8979 DAMOS_FW1 0 DEZ 0.000000 256.000000 /end CHARACTERISTIC
/begin CHARACTERISTIC TSFBL "Fehlersummenzeit: Diagnose Bremsschalter" VALUE 0x896E DAMOS_FW1 0 DEZ 0.000000 256.000000 /end CHARACTERISTIC
/begin CHARACTERISTIC TSFCACC "Fehlersummenzeit: Diagnose CAN Nachrichtenfehler ACC" VALUE 0x8975 DAMOS_FW1 0 DEZ 0.000000 256.000000 /end CHARACTERISTIC
/begin CHARACTERISTIC TSFCAN "Fehlersummenzeit: Diagnose CAN" VALUE 0x895A DAMOS_FW1 0 DEZ 0.000000 256.000000 /end CHARACTERISTIC
/begin CHARACTERISTIC TSFCASR "Fehlersummenzeit 9             ==9: Index 52" VALUE 0x8974 DAMOS_FW1 0 DEZ 0.000000 256.000000 /end CHARACTERISTIC
/begin CHARACTERISTIC TSFCBC "Fehlersummenzeit: Diagnose CAN Nachrichtenfehler BodyComputer" VALUE 0x895B DAMOS_FW1 0 DEZ 0.000000 256.000000 /end CHARACTERISTIC
/begin CHARACTERISTIC TSFCEGS "Fehlersummenzeit: Diagnose Getriebeschnittstelle ueber CAN" VALUE 0x895C DAMOS_FW1 0 DEZ 0.000000 256.000000 /end CHARACTERISTIC
/begin CHARACTERISTIC TSFCNBA "Fehlersummenzeit: Diagnose CAN Nachrichtenfehler NBA" VALUE 0x8976 DAMOS_FW1 0 DEZ 0.000000 256.000000 /end CHARACTERISTIC
/begin CHARACTERISTIC TSFDG "Fehlersummenzeit: Diagnose-Bits Drehzahlgeber" VALUE 0x893E DAMOS_FW1 0 DEZ 0.000000 256.000000 /end CHARACTERISTIC
/begin CHARACTERISTIC TSFDTV1 "Fehlersummenzeit: LR-Adaption ti-additiv, Bank1" VALUE 0x8972 DAMOS_FW1 0 DEZ 0.000000 256.000000 /end CHARACTERISTIC
/begin CHARACTERISTIC TSFDVE "Fehlersummenzeit: Diagnose-Bits DK-Steller" VALUE 0x8942 DAMOS_FW1 0 DEZ 0.000000 256.000000 /end CHARACTERISTIC
/begin CHARACTERISTIC TSFEKPE "Fehlersummenzeit: Endstufendiagnose-Bits EKP" VALUE 0x8957 DAMOS_FW1 0 DEZ 0.000000 256.000000 /end CHARACTERISTIC
/begin CHARACTERISTIC TSFEV1 "Fehlersummenzeit: Endstufendiagnose-Bits EV1" VALUE 0x894F DAMOS_FW1 0 DEZ 0.000000 256.000000 /end CHARACTERISTIC
/begin CHARACTERISTIC TSFEV2 "Fehlersummenzeit: Endstufendiagnose-Bits EV2" VALUE 0x8950 DAMOS_FW1 0 DEZ 0.000000 256.000000 /end CHARACTERISTIC
/begin CHARACTERISTIC TSFEV3 "Fehlersummenzeit: Endstufendiagnose-Bits EV3" VALUE 0x8951 DAMOS_FW1 0 DEZ 0.000000 256.000000 /end CHARACTERISTIC
/begin CHARACTERISTIC TSFEV4 "Fehlersummenzeit: Endstufendiagnose-Bits EV4" VALUE 0x8952 DAMOS_FW1 0 DEZ 0.000000 256.000000 /end CHARACTERISTIC
/begin CHARACTERISTIC TSFEV5 "Fehlersummenzeit: Endstufendiagnose-Bits EV5" VALUE 0x8953 DAMOS_FW1 0 DEZ 0.000000 256.000000 /end CHARACTERISTIC
/begin CHARACTERISTIC TSFFELA "Fehlersummenzeit: Endstufen-Diagnosebits Fehlerlampe" VALUE 0x8956 DAMOS_FW1 0 DEZ 0.000000 256.000000 /end CHARACTERISTIC
/begin CHARACTERISTIC TSFFGRE "Fehlersummenzeit: Diagnose FGR-Lampe" VALUE 0x896D DAMOS_FW1 0 DEZ 0.000000 256.000000 /end CHARACTERISTIC
/begin CHARACTERISTIC TSFFRA1 "Fehlersummenzeit 9             ==9: Index 56" VALUE 0x8971 DAMOS_FW1 0 DEZ 0.000000 256.000000 /end CHARACTERISTIC
/begin CHARACTERISTIC TSFHFM "Fehlersummenzeit: Diagnosebits Luftmassenmesser HFM" VALUE 0x893A DAMOS_FW1 0 DEZ 0.000000 256.000000 /end CHARACTERISTIC
/begin CHARACTERISTIC TSFHSH "Fehlersummenzeit: Diagnosebits Sondenheizung hinter Kat" VALUE 0x8969 DAMOS_FW1 0 DEZ 0.000000 256.000000 /end CHARACTERISTIC
/begin CHARACTERISTIC TSFHSHE "Fehlersummenzeit: Endstufen-Diagnosebits Sondenheizung hinter Kat" VALUE 0x896B DAMOS_FW1 0 DEZ 0.000000 256.000000 /end CHARACTERISTIC
/begin CHARACTERISTIC TSFHSV "Fehlersummenzeit: Endstufen-Diagnosebits Sondenheizer v.  Kat" VALUE 0x8968 DAMOS_FW1 0 DEZ 0.000000 256.000000 /end CHARACTERISTIC
/begin CHARACTERISTIC TSFHSVE "Fehlersummenzeit: Endstufen-Diagnosebits Sondenheizer v.  Kat" VALUE 0x896A DAMOS_FW1 0 DEZ 0.000000 256.000000 /end CHARACTERISTIC
/begin CHARACTERISTIC TSFIPDK "Fehlersummenzeit: Diagnose-Bits Istwertpoti" VALUE 0x8943 DAMOS_FW1 0 DEZ 0.000000 256.000000 /end CHARACTERISTIC
/begin CHARACTERISTIC TSFKAT1 "Fehlersummenzeit: Diagnose Katalysatorkonvertierung, Bank1" VALUE 0x896F DAMOS_FW1 0 DEZ 0.000000 256.000000 /end CHARACTERISTIC
/begin CHARACTERISTIC TSFKOSE "Fehlersummenzeit: Endstufen-Diagnosebits fuer Klimakompressor" VALUE 0x8955 DAMOS_FW1 0 DEZ 0.000000 256.000000 /end CHARACTERISTIC
/begin CHARACTERISTIC TSFKRHW "Fehlersummenzeit: Diagnosebits KR - HW - Test       B2_BI" VALUE 0x8949 DAMOS_FW1 0 DEZ 0.000000 256.000000 /end CHARACTERISTIC
/begin CHARACTERISTIC TSFKRS1 "Fehlersummenzeit: Diagnosebits KR - Sensor1 - Abfall" VALUE 0x894A DAMOS_FW1 0 DEZ 0.000000 256.000000 /end CHARACTERISTIC
/begin CHARACTERISTIC TSFKRS2 "Fehlersummenzeit: Diagnosebits KR - Sensor2 - Abfall" VALUE 0x894B DAMOS_FW1 0 DEZ 0.000000 256.000000 /end CHARACTERISTIC
/begin CHARACTERISTIC TSFKUPPL "Fehlersummenzeit: Diagnose EGS-SG schaltet Motronic ab" VALUE 0x8978 DAMOS_FW1 0 DEZ 0.000000 256.000000 /end CHARACTERISTIC
/begin CHARACTERISTIC TSFLASH1 "Fehlersummenzeit: Diagnose Lambdasonden-Alterung hinter Kat" VALUE 0x8967 DAMOS_FW1 0 DEZ 0.000000 256.000000 /end CHARACTERISTIC
/begin CHARACTERISTIC TSFLATP1 "Fehlersummenzeit: Diagnose Lambdasonden-Alterung TP" VALUE 0x8965 DAMOS_FW1 0 DEZ 0.000000 256.000000 /end CHARACTERISTIC
/begin CHARACTERISTIC TSFLATV1 "Fehlersummenzeit: Diagnose Lambdasonden-Alterung TV" VALUE 0x8966 DAMOS_FW1 0 DEZ 0.000000 256.000000 /end CHARACTERISTIC
/begin CHARACTERISTIC TSFLFR "Fehlersummenzeit: LFR-Diagnose" VALUE 0x8948 DAMOS_FW1 0 DEZ 0.000000 256.000000 /end CHARACTERISTIC
/begin CHARACTERISTIC TSFLSH1 "Fehlersummenzeit: Diagnose Lambdasonde hinter Kat (Index 41)" VALUE 0x8964 DAMOS_FW1 0 DEZ 0.000000 256.000000 /end CHARACTERISTIC
/begin CHARACTERISTIC TSFLSV1 "Fehlersummenzeit: Diagnosebits Lambdasondendiagn. vor Kat Bank1" VALUE 0x8963 DAMOS_FW1 0 DEZ 0.000000 256.000000 /end CHARACTERISTIC
/begin CHARACTERISTIC TSFLUES1 "Fehlersummenzeit: Endstufen-Diagnosebits fuer Luefter Stufe 1" VALUE 0x894D DAMOS_FW1 0 DEZ 0.000000 256.000000 /end CHARACTERISTIC
/begin CHARACTERISTIC TSFLUES2 "Fehlersummenzeit: Endstufen-Diagnosebits fuer Luefter Stufe 2" VALUE 0x894E DAMOS_FW1 0 DEZ 0.000000 256.000000 /end CHARACTERISTIC
/begin CHARACTERISTIC TSFMD "Fehlersummenzeit: Diagnose Aussetzererkennung gesamt" VALUE 0x895D DAMOS_FW1 0 DEZ 0.000000 256.000000 /end CHARACTERISTIC
/begin CHARACTERISTIC TSFMD1 "Fehlersummenzeit: Diagnose Aussetzererkennung Zyl. 1" VALUE 0x895E DAMOS_FW1 0 DEZ 0.000000 256.000000 /end CHARACTERISTIC
/begin CHARACTERISTIC TSFMD2 "Fehlersummenzeit: Diagnose Aussetzererkennung Zyl. 2" VALUE 0x895F DAMOS_FW1 0 DEZ 0.000000 256.000000 /end CHARACTERISTIC
/begin CHARACTERISTIC TSFMD3 "Fehlersummenzeit: Diagnose Aussetzererkennung Zyl. 3" VALUE 0x8960 DAMOS_FW1 0 DEZ 0.000000 256.000000 /end CHARACTERISTIC
/begin CHARACTERISTIC TSFMD4 "Fehlersummenzeit: Diagnose Aussetzererkennung Zyl. 4" VALUE 0x8961 DAMOS_FW1 0 DEZ 0.000000 256.000000 /end CHARACTERISTIC
/begin CHARACTERISTIC TSFMD5 "Fehlersummenzeit: Diagnose Aussetzererkennung Zyl. 5" VALUE 0x8962 DAMOS_FW1 0 DEZ 0.000000 256.000000 /end CHARACTERISTIC
/begin CHARACTERISTIC TSFMILFB "Fehlersummenzeit: Diagnose Mil fremdbestimmt" VALUE 0x8977 DAMOS_FW1 0 DEZ 0.000000 256.000000 /end CHARACTERISTIC
/begin CHARACTERISTIC TSFNWSE "Fehlersummenzeit: Endstufendiagnose-Bits NWS" VALUE 0x8959 DAMOS_FW1 0 DEZ 0.000000 256.000000 /end CHARACTERISTIC
/begin CHARACTERISTIC TSFPAC "Fehlersummenzeit: Diagnose Klimadrucksensor" VALUE 0x897A DAMOS_FW1 0 DEZ 0.000000 256.000000 /end CHARACTERISTIC
/begin CHARACTERISTIC TSFPEDST "Fehlersummenzeit: Diagnose Bits Pedalanschlag" VALUE 0x8945 DAMOS_FW1 0 DEZ 0.000000 256.000000 /end CHARACTERISTIC
/begin CHARACTERISTIC TSFPH "Fehlersummenzeit: Diagnosebits Phasensensor" VALUE 0x893F DAMOS_FW1 0 DEZ 0.000000 256.000000 /end CHARACTERISTIC
/begin CHARACTERISTIC TSFPMOEL " " VALUE 0x8941 DAMOS_FW1 0 DEZ 0.000000 256.000000 /end CHARACTERISTIC
/begin CHARACTERISTIC TSFPWG "Fehlersummenzeit: Diagnose-Bits PWG" VALUE 0x8944 DAMOS_FW1 0 DEZ 0.000000 256.000000 /end CHARACTERISTIC
/begin CHARACTERISTIC TSFRSKA "Fehlersummenzeit: Diagnose reversible Sicherheitskraftstoffabschalten" VALUE 0x8946 DAMOS_FW1 0 DEZ 0.000000 256.000000 /end CHARACTERISTIC
/begin CHARACTERISTIC TSFSKAUM "Fehlersummenzeit: Diagnose Sicherheitskraftstoffab. von Ueberwachungsfkt." VALUE 0x8947 DAMOS_FW1 0 DEZ 0.000000 256.000000 /end CHARACTERISTIC
/begin CHARACTERISTIC TSFSUE "Fehlersummenzeit: Endstufendiagnose-Bits Saugrohrumschaltung" VALUE 0x8958 DAMOS_FW1 0 DEZ 0.000000 256.000000 /end CHARACTERISTIC
/begin CHARACTERISTIC TSFSWE "Fehlersummenzeit: Schlechtwegerkennung" VALUE 0x8973 DAMOS_FW1 0 DEZ 0.000000 256.000000 /end CHARACTERISTIC
/begin CHARACTERISTIC TSFTEVE "Fehlersummenzeit: Endstufendiagnose-Bits TEV" VALUE 0x8954 DAMOS_FW1 0 DEZ 0.000000 256.000000 /end CHARACTERISTIC
/begin CHARACTERISTIC TSFTFA "Fehlersummenzeit: Diagnosebits Ansauglufttemperaturfuehler" VALUE 0x893C DAMOS_FW1 0 DEZ 0.000000 256.000000 /end CHARACTERISTIC
/begin CHARACTERISTIC TSFTFM "Fehlersummenzeit: Diagnosebits Motortemperaturfuehler" VALUE 0x893B DAMOS_FW1 0 DEZ 0.000000 256.000000 /end CHARACTERISTIC
/begin CHARACTERISTIC TSFTRA1 "Fehlersummenzeit: LR-Adaption QL-additiv, Bank1" VALUE 0x8970 DAMOS_FW1 0 DEZ 0.000000 256.000000 /end CHARACTERISTIC
/begin CHARACTERISTIC TSFUB "Fehlersummenzeit: Diagnosebits Batteriespannung" VALUE 0x8940 DAMOS_FW1 0 DEZ 0.000000 256.000000 /end CHARACTERISTIC
/begin CHARACTERISTIC TSFVFZ "Fehlersummenzeit: Diagnose Geschwindigkeitssignal" VALUE 0x893D DAMOS_FW1 0 DEZ 0.000000 256.000000 /end CHARACTERISTIC
/begin CHARACTERISTIC TSFVTSK "Fehlersummenzeit: Diagnose FGR-Bedienhebel" VALUE 0x896C DAMOS_FW1 0 DEZ 0.000000 256.000000 /end CHARACTERISTIC
/begin CHARACTERISTIC TSFWFS "Fehlersummenzeit: WFS Fehler" VALUE 0x894C DAMOS_FW1 0 DEZ 0.000000 256.000000 /end CHARACTERISTIC
/begin CHARACTERISTIC TSFZZZ "" VALUE 0x897B DAMOS_FW1 0 DEZ 0.000000 256.000000 /end CHARACTERISTIC
/begin CHARACTERISTIC TSHAS "Zeitschwelle Schubabschalten f. Umschaltung auf schnelle Hoehenadaption" VALUE 0x8268 DAMOS_FW1 0 DEZ 0.000000 256.000000 /end CHARACTERISTIC
/begin CHARACTERISTIC TSPERN "Sperrzeit P-Sprung nach Sondensprung" CURVE 0xAC8E DAMOS_KL97 0 TQ10 0.000000 2.550000 /begin AXIS_DESCR STD_AXIS MLSM MLSMQ 7 0.000000 1024.000000 /end AXIS_DESCR /end CHARACTERISTIC
/begin CHARACTERISTIC TSTEAA "Sperrzeit nach B_TE (TEA aktiv)" VALUE 0x833E DAMOS_FW1 0 TQ100 0.000000 25.500000 /end CHARACTERISTIC
/begin CHARACTERISTIC TSTFLT_T "Fehlerzeit bei Doppeltastenbetaetigung" VALUE 0x873D DAMOS_FW1 0 TQ20 0.060000 0.060000 EXTENDED_LIMITS 0.000000 5.100000 /end CHARACTERISTIC
/begin CHARACTERISTIC TSTFL_T "Entprellzeit FGR-Bedienhebel Fehler Löschen" VALUE 0x873C DAMOS_FW1 0 TQ20 0.000000 5.100000 /end CHARACTERISTIC
/begin AXIS_PTS TSTMOTV08 "Motortemperaturstuetzstellen von Tmot im Start" 0x8D8C TMST DAMOS_SST97 0 CMO_TMP 12 -41.000000 140.000000 /end AXIS_PTS
/begin CHARACTERISTIC TSVKKO "schaerfere obere Periodendauergrenze fuer Lambdasonde vor Kat" VALUE 0x8332 DAMOS_FW3 0 TQ10L 0.000000 655.350000 /end CHARACTERISTIC
/begin CHARACTERISTIC TSVKKTO "obere Periodendauergrenze fuer SVK, Kurztest" VALUE 0x8336 DAMOS_FW3 0 TQ10L 0.000000 655.350000 /end CHARACTERISTIC
/begin CHARACTERISTIC TSVKKTU "untere Periodendauergrenze fuer SVK, Kurztest" VALUE 0x8338 DAMOS_FW3 0 TQ10L 0.000000 655.350000 /end CHARACTERISTIC
/begin CHARACTERISTIC TSVKKU "schaerfere untere Periodendauergrenze fuer Lambdasonde vor Kat" VALUE 0x8334 DAMOS_FW3 0 TQ10L 0.000000 655.350000 /end CHARACTERISTIC
/begin CHARACTERISTIC TSVKO "obere Periodendauergrenze fuer die Lambdasonde vor Katalysator" VALUE 0x833A DAMOS_FW3 0 TQ10L 0.000000 655.350000 /end CHARACTERISTIC
/begin CHARACTERISTIC TSVKU "untere Periodengrenze fuer Lambdasonde vor Katalysator" VALUE 0x833C DAMOS_FW3 0 TQ10L 0.000000 655.350000 /end CHARACTERISTIC
/begin CHARACTERISTIC TTBMH "Zeit fuer theor. Sondenbereitschaft mit Heizung" VALUE 0x83B8 DAMOS_FW3 0 TQ100L 0.000000 6553.500000 /end CHARACTERISTIC
/begin CHARACTERISTIC TTE "Tankentlueftungsphase bei noch nicht eingeschwungener Gemischadaption" VALUE 0x82C2 DAMOS_FW3 0 TQ100L 0.000000 6553.500000 /end CHARACTERISTIC
/begin CHARACTERISTIC TTEAE "Tankentlueftungsphase bei eingeschwungener Gemischadaption" VALUE 0x82C0 DAMOS_FW3 0 TQ100L 0.000000 6553.500000 /end CHARACTERISTIC
/begin CHARACTERISTIC TTEAUS "Zeit nach Start bis TEB aktiv wird" VALUE 0x82DA DAMOS_FW3 0 TQ100L 0.000000 6553.500000 /end CHARACTERISTIC
/begin CHARACTERISTIC TTEGA "Gemischadaptionsphase (keine Tankentlueftung)" VALUE 0x82BE DAMOS_FW3 0 TQ100L 0.000000 6553.500000 /end CHARACTERISTIC
/begin CHARACTERISTIC TTEGAINI "Zeitdauer der ersten Gemischadaptionsphase" VALUE 0x82DC DAMOS_FW3 0 TQ100L 0.000000 6553.500000 /end CHARACTERISTIC
/begin CHARACTERISTIC TTEINI "Zeit für Tankentlueftung in erster TE-Phase" VALUE 0x82DE DAMOS_FW3 0 TQ100L 0.000000 6553.500000 /end CHARACTERISTIC
/begin CHARACTERISTIC TTEMN "Zeit für Tankentlueftungsphase minimal" VALUE 0x82E0 DAMOS_FW3 0 TQ100L 0.000000 6553.500000 /end CHARACTERISTIC
/begin CHARACTERISTIC TTLASH "Zeit fuer Verweildauer der Sonde hinter Kat unter/oberhalb des Sollwertes" VALUE 0x8364 DAMOS_FW3 0 TQ100L 0.000000 6553.500000 /end CHARACTERISTIC
/begin CHARACTERISTIC TTRA "Erkennungszeit fuer eingeschwungene Grundadaption von tra" VALUE 0x8436 DAMOS_FW3 0 TQ100L 0.000000 6553.500000 /end CHARACTERISTIC
/begin CHARACTERISTIC TTRAZ "Verweilzeit in TRA fuer Zyklusflag bei nicht eingeschw. Adaption" VALUE 0x8438 DAMOS_FW3 0 TQ100L 0.000000 6553.500000 /end CHARACTERISTIC
/begin CHARACTERISTIC TUSBELH "Zeit fuer Festhaltung der Sondenspannung nach Impulsbelastung hinter Kat" VALUE 0x83EB DAMOS_FW1 0 TQ10 0.000000 2.550000 /end CHARACTERISTIC
/begin CHARACTERISTIC TUSBELV "Zeit fuer Festhaltung der Sondenspannung nach Impulsbelastung vor Kat" VALUE 0x83EC DAMOS_FW1 0 TQ10 0.000000 2.550000 /end CHARACTERISTIC
/begin CHARACTERISTIC TUSCHUB "Verzoegerungszeit fuer Stoerspitzen bei Schubpruefung der Sonde hinter Kat" VALUE 0x8366 DAMOS_FW1 0 TQ100 0.000000 25.500000 /end CHARACTERISTIC
/begin CHARACTERISTIC TUSDU "VZ fuer Adernschlusserkenn. u. Sonde mit begrenztem Spannungshub" VALUE 0x83BA DAMOS_FW3 0 TQ100L 0.000000 6553.500000 /end CHARACTERISTIC
/begin CHARACTERISTIC TUSDUC "VZ fuer Adernschlusserkennung vor Kat" VALUE 0x83BC DAMOS_FW3 0 TQ100L 0.000000 6553.500000 /end CHARACTERISTIC
/begin CHARACTERISTIC TUSDUH "VZ fuer Adernschlusserkennung h. K." VALUE 0x83E0 DAMOS_FW3 0 TQ100L 0.000000 6553.500000 /end CHARACTERISTIC
/begin CHARACTERISTIC TUSEINH "Verzoegerungszeit fuer Einschalten der Sondenbetriebsbereitschaft hint. Kat" VALUE 0x83E2 DAMOS_FW1 0 TQ100 0.000000 25.500000 /end CHARACTERISTIC
/begin CHARACTERISTIC TUSEINV "Verzugszeit für Diagnose nach Sondenheizung ein " VALUE 0x83BE DAMOS_FW1 0 TQ100 0.000000 25.500000 /end CHARACTERISTIC
/begin CHARACTERISTIC TUSENLASH "Zeitdauer bis Sonden Mager/Fett-Erkennung erlaubt" VALUE 0x8368 DAMOS_FW3 0 TQ100L 0.000000 6553.500000 /end CHARACTERISTIC
/begin CHARACTERISTIC TUSFETT "VZ fuer Erkennung niederohmiger Nebenschluss nach Ubatt" VALUE 0x83C0 DAMOS_FW3 0 TQ100L 0.000000 6553.500000 /end CHARACTERISTIC
/begin CHARACTERISTIC TUSHSMIN "Mindestdauer fuer Steigungsmessung fuer enable Filter" VALUE 0x836A DAMOS_FW1 0 TQ100 0.000000 25.500000 /end CHARACTERISTIC
/begin CHARACTERISTIC TUSKS "VZ bei Sondenkurzschluss v. und h. Kat" VALUE 0x83C2 DAMOS_FW1 0 TQ100 0.000000 25.500000 /end CHARACTERISTIC
/begin CHARACTERISTIC TUSLASH "Testzeit fuer Dauer Anfettung/Abmagerung hinter Kat" VALUE 0x836C DAMOS_FW3 0 TQ100L 0.000000 6553.500000 /end CHARACTERISTIC
/begin CHARACTERISTIC TUSMAX "Zusaetzliche VZ fuer B_MAXFLR vor Kat" VALUE 0x83C3 DAMOS_FW1 0 TQ100 0.000000 25.500000 /end CHARACTERISTIC
/begin CHARACTERISTIC TUSPNMN "Miniamale Zeit zwischen positiver und negativer Flanke von U-Sonde" VALUE 0x848A DAMOS_FW1 0 TQ40 0.000000 10.200000 /end CHARACTERISTIC
/begin CHARACTERISTIC TUSPNMX "Maximale Zeit zwischen positiver und negativer Flanke von U-Sonde" VALUE 0x848B DAMOS_FW1 0 TQ40 0.000000 10.200000 /end CHARACTERISTIC
/begin CHARACTERISTIC TUSSA "Verzoegerungszeit nach Ueber/Unterschreitung der Regelschwelle hinter Kat" VALUE 0x836E DAMOS_FW1 0 TQ100 0.000000 25.500000 /end CHARACTERISTIC
/begin CHARACTERISTIC TVDRREC "Verzögerungszeit für Trigger der Dauerlaufmessung" VALUE 0x8CE6 DAMOS_FW3 0 TQ10L 0.000000 655.350000 /end CHARACTERISTIC
/begin CHARACTERISTIC TVESZWN " Verzugszeit fuer Einspritzkorrektur bei ZW-Verstellung" CURVE 0xD380 DAMOS_KL97 0 TQ80 0.000000 20.400000 /begin AXIS_DESCR STD_AXIS NMOT NQ40 7 0.000000 10200.000000 /end AXIS_DESCR /end CHARACTERISTIC
/begin CHARACTERISTIC TVFSAM "Zeitverz. Schalten nach P/N fuer Integratoranhebung " CURVE 0xC3E6 DAMOS_KL97 0 TQ10 0.000000 2.550000 /begin AXIS_DESCR STD_AXIS TMOT CMO_TMP 9 -41.000000 140.000000 /end AXIS_DESCR /end CHARACTERISTIC
/begin CHARACTERISTIC TVFSEM "Zeitverz. Schalten nach Drive fuer Integratoranhebung " CURVE 0xC3D0 DAMOS_KL97 0 TQ10 0.000000 2.550000 /begin AXIS_DESCR STD_AXIS TMOT CMO_TMP 9 -41.000000 140.000000 /end AXIS_DESCR /end CHARACTERISTIC
/begin CHARACTERISTIC TVFSTA "Verzoegerungszeit Ausgabe Tankzustand" VALUE 0x82ED DAMOS_FW1 0 TQ100 0.000000 25.500000 /end CHARACTERISTIC
/begin CHARACTERISTIC TVHA "Verzoegerungszeit fuer Hoehenadaption" VALUE 0x826C DAMOS_FW1 0 TQ20 0.000000 5.100000 /end CHARACTERISTIC
/begin CHARACTERISTIC TVHSREDH " Zeit fuer reduzierte Heizleistung nach Startende Sonde hinter Kat" VALUE 0x824A DAMOS_FW1 0 TQ100 0.000000 25.500000 /end CHARACTERISTIC
/begin CHARACTERISTIC TVHSREDV " Zeit fuer reduzierte Heizleistung nach Startende Sonde vor Kat" VALUE 0x8249 DAMOS_FW1 0 TQ100 0.000000 25.500000 /end CHARACTERISTIC
/begin CHARACTERISTIC TVKOE "Verzögerungsezeit für Kompressor EIN" VALUE 0x87E4 DAMOS_FW1 0 TQ200 0.000000 51.000000 /end CHARACTERISTIC
/begin CHARACTERISTIC TVKOE1 "Verzögerungszeit für Kompressor EIN" VALUE 0x87E5 DAMOS_FW1 0 TQ200 0.000000 51.000000 /end CHARACTERISTIC
/begin CHARACTERISTIC TVKUPPL "Verzoegerungszeit fuer Info Kupplungsschalter" VALUE 0x8765 DAMOS_FW1 0 TQ10 0.000000 2.550000 /end CHARACTERISTIC
/begin CHARACTERISTIC TVLRA "Verzoegerung fuer B_lra 'ein' nach B_lr 'ein'" VALUE 0x849E DAMOS_FW1 0 TQ100 0.000000 25.500000 /end CHARACTERISTIC
/begin CHARACTERISTIC TVLRHMN "untere Grenze fuer tv-Korrektur" VALUE 0x833F DAMOS_FW2 0 TQ10MSS -1.280000 1.270000 /end CHARACTERISTIC
/begin CHARACTERISTIC TVLRHMX "obere Grenze fuer tv-Korrektur" VALUE 0x8340 DAMOS_FW2 0 TQ10MSS -1.280000 1.270000 /end CHARACTERISTIC
/begin CHARACTERISTIC TVRIF "Verzögerungszeit" VALUE 0x824C DAMOS_FW1 0 TQ100 0.000000 25.500000 /end CHARACTERISTIC
/begin CHARACTERISTIC TVSAKUPN "SAS - Zeitverzögerung bei S_KUP = 1" CURVE 0x903A DAMOS_KL97 0 TQ20 0.000000 5.100000 /begin AXIS_DESCR STD_AXIS NMOT NQ40 6 0.000000 10200.000000 /end AXIS_DESCR /end CHARACTERISTIC
/begin CHARACTERISTIC TVTEV "Verzugszeit des TEV" VALUE 0x82CC DAMOS_FW3 0 TTEVQL 0.000000 349.520000 /end CHARACTERISTIC
/begin CHARACTERISTIC TVTMWAL "Verzögerungszeit nach Start bei Einschalten der TMOT-Warnlampe" VALUE 0x8792 DAMOS_FW1 0 TQ800 0.000000 204.000000 /end CHARACTERISTIC
/begin CHARACTERISTIC TVUB "EV-Spannungskorrektur" CURVE 0x8134 DAMOS_FKL1 0 UTS 0.000000 10.240000
 /begin AXIS_DESCR FIX_AXIS UBATT UBQ 17 0.000000 24.119630 FIX_AXIS_PAR 0 4 17 EXTENDED_LIMITS 0.000000 24.119600 /end AXIS_DESCR
/end CHARACTERISTIC
/begin CHARACTERISTIC TV_DKV "Entprellzeit fuer Umschaltung KFMNDKP -> KFMNDK" VALUE 0x8777 DAMOS_FW1 0 TQ10 0.000000 2.550000 /end CHARACTERISTIC
/begin CHARACTERISTIC TV_DKVP "Entprellzeit fuer Umschaltung KFMNDK -> KFMNDKP" VALUE 0x8778 DAMOS_FW1 0 TQ10 0.000000 2.550000 /end CHARACTERISTIC
/begin CHARACTERISTIC TWABW "Verbotszeit Einspritzung/Zündung bei Rückdreher" VALUE 0x8CE5 DAMOS_FW1 0 TQ10 0.000000 2.550000 /end CHARACTERISTIC
/begin CHARACTERISTIC TWBDCY "Wartezeit für Erkennung Bedingung 'driving cycle'" VALUE 0x884C DAMOS_FW3 0 TQ200L 0.000000 13107.000000 /end CHARACTERISTIC
/begin CHARACTERISTIC TWDDTV "Wartezeit fuer Ready-Flag der Delta-TV Diagnose (DLSA)" VALUE 0x8342 DAMOS_FW3 0 TQ1000L 0.000000 65535.000000 /end CHARACTERISTIC
/begin CHARACTERISTIC TWDKATST "Wartezeit nach Stopbed. fuer Filter und Integrator" VALUE 0x83A1 DAMOS_FW1 0 TQ50 0.000000 12.750000 /end CHARACTERISTIC
/begin CHARACTERISTIC TWDLSSA "Mindestpruefzeit fuer DLSSA-Extremwertbestimmung" VALUE 0x848C DAMOS_FW3 0 TQ50L 0.000000 3276.750000 /end CHARACTERISTIC
/begin CHARACTERISTIC TWFSPROH "Wiederholzeit nach Prohibit-Zustand" VALUE 0x84B6 DAMOS_FW3 0 TQ10L 0.000000 655.350000 /end CHARACTERISTIC
/begin CHARACTERISTIC TWFSVU "Wartezeit nach Unterdrehzahl bis verriegelt wird" VALUE 0x84B8 DAMOS_FW3 0 TQ10L 0.000000 655.350000 /end CHARACTERISTIC
/begin CHARACTERISTIC TWKTDLP "Wartezeit nach Parameterumschaltung in Lambdaregelung" VALUE 0x83A2 DAMOS_FW1 0 TQ50 0.000000 12.750000 /end CHARACTERISTIC
/begin CHARACTERISTIC TWLLRUB "Verzoegerung ab Startende Ladebilanzregelung LLRUB" VALUE 0x8608 DAMOS_FW3 0 TQ100L 0.000000 6553.500000 /end CHARACTERISTIC
/begin CHARACTERISTIC TWLWS "Verzugszeit Spaetwinkel der dyn. Antiruckelfkt. bei Lastwechselschlag" CURVE 0xA868 DAMOS_KL97 0 TQ10 0.000000 2.550000 /begin AXIS_DESCR STD_AXIS NMOT NQ40 6 0.000000 10200.000000 /end AXIS_DESCR /end CHARACTERISTIC
/begin CHARACTERISTIC TWNSTA "Wartezeit nach Motorstart " VALUE 0x82EE DAMOS_FW1 0 TQ1000 0.000000 255.000000 /end CHARACTERISTIC
/begin CHARACTERISTIC TWNTAL "Wartezeit bis nicht Tank leer gueltig ist " VALUE 0x82EF DAMOS_FW1 0 TQ1000 0.000000 255.000000 /end CHARACTERISTIC
/begin CHARACTERISTIC TWRBTEMN "Wartezeit für das Rücksetzen von B_temin" CURVE 0xD596 DAMOS_KL97 0 TQ100 0.000000 25.500000 /begin AXIS_DESCR STD_AXIS NMOT NQ40 4 0.000000 10200.000000 /end AXIS_DESCR /end CHARACTERISTIC
/begin CHARACTERISTIC TWSBTEMN "Wartezeit für das Setzen von B_temin" CURVE 0xD5A2 DAMOS_KL97 0 TQ100 0.000000 25.500000 /begin AXIS_DESCR STD_AXIS NMOT NQ40 4 0.000000 10200.000000 /end AXIS_DESCR /end CHARACTERISTIC
/begin CHARACTERISTIC TWVDBS "Zeitdauer Entprellung der Schlechtwegerkennung" VALUE 0x82F6 DAMOS_FW1 0 TQ100 0.000000 25.500000 /end CHARACTERISTIC
/begin CHARACTERISTIC TZTOL_UM "Toleranz zw. Zeit- und Zahnerfassung f. FU" VALUE 0x87F4 DAMOS_FW3 0 ZZEQL 0.000000 174760.000000 /end CHARACTERISTIC
/begin CHARACTERISTIC TZ_FGR "Zaehlerzeitkonstante fuer FGR" CURVE 0x86DA DAMOS_FKL3 0 TQ1L 0.000000 65.535000
 /begin AXIS_DESCR FIX_AXIS IR0 DEZ 7 0.000000 6.000000 FIX_AXIS_PAR 0 0 7 EXTENDED_LIMITS 0.000000 256.000000 /end AXIS_DESCR
/end CHARACTERISTIC
/begin CHARACTERISTIC TZ_FGR1 "Zaehlerzeitkonstante fuer FGR bei AT-Getr." CURVE 0x8712 DAMOS_FKL3 0 TQ1L 0.000000 65.535000
 /begin AXIS_DESCR FIX_AXIS IR0 DEZ 7 0.000000 6.000000 FIX_AXIS_PAR 0 0 7 EXTENDED_LIMITS 0.000000 256.000000 /end AXIS_DESCR
/end CHARACTERISTIC
/begin CHARACTERISTIC T_ACC " Entprellzeit Abschalten ACC" VALUE 0x8516 DAMOS_FW1 0 TQ10 0.000000 2.550000 /end CHARACTERISTIC
/begin CHARACTERISTIC T_ACC_AUS " Entprellzeit Abschalten ACC" VALUE 0x8517 DAMOS_FW1 0 TQ10 0.000000 2.550000 /end CHARACTERISTIC
/begin CHARACTERISTIC T_ACMVER " Entprellzeit Momentenvergleich ACC" VALUE 0x851A DAMOS_FW1 0 TQ10 0.000000 2.550000 /end CHARACTERISTIC
/begin CHARACTERISTIC T_AC_AB " Entprellzeit reversibles Abschalten " VALUE 0x8518 DAMOS_FW1 0 TQ10 0.000000 2.550000 /end CHARACTERISTIC
/begin CHARACTERISTIC T_EGSNP1 "Entprellzeit fuer CAN-Anforderung unplausibel" VALUE 0x8781 DAMOS_FW1 0 TQ10 0.000000 2.550000 /end CHARACTERISTIC
/begin CHARACTERISTIC T_EGSNP2 "Entprellzeit fuer CAN-Anforderung unplausibel (egs_tc=0)" VALUE 0x8782 DAMOS_FW1 0 TQ10 0.000000 2.550000 /end CHARACTERISTIC
/begin CHARACTERISTIC T_EGSNPH "Heilungszeit fuer CAN-Anforderung unplausibel" VALUE 0x8784 DAMOS_FW3 0 TQ10L 0.000000 655.350000 /end CHARACTERISTIC
/begin CHARACTERISTIC T_FGREN "FGR-Bedienhebel Entprellzeit für Hauptschalter" VALUE 0x8685 DAMOS_FW1 0 TQ20 0.000000 5.100000 /end CHARACTERISTIC
/begin CHARACTERISTIC T_LAMPE "Lampenansteuerungszeit nach Zündung ein für Armaturenbrettlampen" VALUE 0x8791 DAMOS_FW1 0 TQ100 0.000000 25.500000 /end CHARACTERISTIC
/begin CHARACTERISTIC T_MDACCGR "Mittelungszeit fuer mdaccgr Berechnung" VALUE 0x8614 DAMOS_FW1 0 TQ20 0.000000 5.100000 /end CHARACTERISTIC
/begin CHARACTERISTIC T_MGRD "Mittelungszeit fuer mdasrlgr Berechnung" VALUE 0x860F DAMOS_FW1 0 TQ20 0.000000 5.100000 /end CHARACTERISTIC
/begin CHARACTERISTIC T_NOMACC " Fehlerentprellzeit ACC" VALUE 0x84FC DAMOS_FW3 0 TQ10L 0.000000 655.350000 /end CHARACTERISTIC
/begin CHARACTERISTIC T_NOMASR " Fehlerentprellzeit ASR" VALUE 0x84E0 DAMOS_FW3 0 TQ10L 0.000000 655.350000 /end CHARACTERISTIC
/begin CHARACTERISTIC T_NOMBC " Fehlerentprellzeit Body Computer" VALUE 0x84D2 DAMOS_FW3 0 TQ10L 0.000000 655.350000 /end CHARACTERISTIC
/begin CHARACTERISTIC T_NOMEGS " Fehlerentprellzeit EGS" VALUE 0x84EE DAMOS_FW3 0 TQ10L 0.000000 655.350000 /end CHARACTERISTIC
/begin CHARACTERISTIC T_NOMHACC "FehlerHeilungszeit CAN-Node NAC absent" VALUE 0x84FE DAMOS_FW3 0 TQ10L 0.000000 655.350000 /end CHARACTERISTIC
/begin CHARACTERISTIC T_NOMHASR "FehlerHeilungszeit CAN-Node NFR absent" VALUE 0x84E2 DAMOS_FW3 0 TQ10L 0.000000 655.350000 /end CHARACTERISTIC
/begin CHARACTERISTIC T_NOMHBC "FehlerHeilungszeit CAN-Node NBC absent" VALUE 0x84D4 DAMOS_FW3 0 TQ10L 0.000000 655.350000 /end CHARACTERISTIC
/begin CHARACTERISTIC T_NOMHEGS "FehlerHeilungszeit CAN-Node NCA/NCR absent" VALUE 0x84F0 DAMOS_FW3 0 TQ10L 0.000000 655.350000 /end CHARACTERISTIC
/begin CHARACTERISTIC T_NOMHNBA "FehlerHeilungszeit CAN-Node NBA absent" VALUE 0x850C DAMOS_FW3 0 TQ10L 0.000000 655.350000 /end CHARACTERISTIC
/begin CHARACTERISTIC T_NOMNBA " Fehlerentprellzeit NBA" VALUE 0x850A DAMOS_FW3 0 TQ10L 0.000000 655.350000 /end CHARACTERISTIC
/begin CHARACTERISTIC T_PNAUS " Verzögerungszeit B_PN 1 ---> 0" VALUE 0x8539 DAMOS_FW1 0 TQ10 0.000000 2.550000 /end CHARACTERISTIC
/begin CHARACTERISTIC T_PNEIN " Verzögerungszeit B_PN 0 ---> 1" VALUE 0x8538 DAMOS_FW1 0 TQ10 0.000000 2.550000 /end CHARACTERISTIC
/begin CHARACTERISTIC T_SA_M " Verzoegerungszaehler fuer Flanken Absenkung" VALUE 0x851C DAMOS_FW1 0 TQ20 0.000000 5.100000 /end CHARACTERISTIC
/begin CHARACTERISTIC T_VEIN " V-Stoerimpulsunterdrueckungszeit" VALUE 0x87D8 DAMOS_FW3 0 TQ10L 0.000000 655.350000 /end CHARACTERISTIC
/begin CHARACTERISTIC T_WL_BLK " Pegeldauer bei Fehlerlampe 'Blinken' " VALUE 0x8798 DAMOS_FW1 0 TQ10 0.000000 2.550000 /end CHARACTERISTIC
/begin CHARACTERISTIC UADPACMN "untere Klimadrucksensorspannung fuer Diagnose" VALUE 0x87C5 DAMOS_FW1 0 U5V 0.000000 5.000000 /end CHARACTERISTIC
/begin CHARACTERISTIC UADPACMX "obere Klimadrucksensorspannung fuer Diagnose" VALUE 0x87C4 DAMOS_FW1 0 U5V 0.000000 5.000000 /end CHARACTERISTIC
/begin CHARACTERISTIC UANOFF "Anschlags-Offset" VALUE 0x8622 DAMOS_FW3 0 PER0327 0.000000 0.997955 EXTENDED_LIMITS 0.000000 100.000000 /end CHARACTERISTIC
/begin CHARACTERISTIC UANPIDMIN "obere Reglerschwelle Anschlag lernen" VALUE 0x8628 DAMOS_FW1 0 PER128S -100.000000 99.218750 EXTENDED_LIMITS -100.000000 99.218800 /end CHARACTERISTIC
/begin CHARACTERISTIC UAN_O_AT "obere Lufttemperaturschwelle fuer Anschlag-Lernen" VALUE 0x8627 DAMOS_FW1 0 CLU_TMP -50.000000 150.000000 /end CHARACTERISTIC
/begin CHARACTERISTIC UAN_O_MT "obere Motortemperaturschwelle fuer Anschlag-Lernen" VALUE 0x8625 DAMOS_FW1 0 CMO_TMP -41.000000 140.000000 /end CHARACTERISTIC
/begin CHARACTERISTIC UAN_U_AT "Ansauglufttemperatur, Anschlag lernen" VALUE 0x8626 DAMOS_FW1 0 CLU_TMP -50.000000 150.000000 /end CHARACTERISTIC
/begin CHARACTERISTIC UAN_U_MT "untere Motortemperaturschwelle fuer Anschlag-Lernen" VALUE 0x8624 DAMOS_FW1 0 CMO_TMP -41.000000 140.000000 /end CHARACTERISTIC
/begin CHARACTERISTIC UBDABW "UBatt-Spannung für Erkennung Starter eingerückt" VALUE 0x8CE4 DAMOS_FW1 0 UBQ 0.000000 24.119630 EXTENDED_LIMITS 0.000000 24.119600 /end CHARACTERISTIC
/begin CHARACTERISTIC UBDE "UBATT - Ersatzwert bei defektem AD-Kanal" VALUE 0x8458 DAMOS_FW1 0 UBQ 0.000000 24.119630 EXTENDED_LIMITS 0.000000 24.119600 /end CHARACTERISTIC
/begin CHARACTERISTIC UBDLS "Spannungsschwelle für Lambdasonden-Diagnose" VALUE 0x83C4 DAMOS_FW1 0 UBQ 0.000000 24.119630 EXTENDED_LIMITS 0.000000 24.119600 /end CHARACTERISTIC
/begin CHARACTERISTIC UBDLSMX "obere UBATT Schwelle Sondenfreigabe" VALUE 0x824D DAMOS_FW1 0 UBQ 0.000000 24.119630 EXTENDED_LIMITS 0.000000 24.119600 /end CHARACTERISTIC
/begin CHARACTERISTIC UBDMN1 "Batteriespanunung min. (Netz)" VALUE 0x8456 DAMOS_FW1 0 UBQ 0.000000 24.119630 EXTENDED_LIMITS 0.000000 24.119600 /end CHARACTERISTIC
/begin CHARACTERISTIC UBDMN2 "Batteriespanunung min. (ADC)" VALUE 0x8457 DAMOS_FW1 0 UBQ 0.000000 24.119630 EXTENDED_LIMITS 0.000000 24.119600 /end CHARACTERISTIC
/begin CHARACTERISTIC UBDMX "Batteriespannung maximal" VALUE 0x8455 DAMOS_FW1 0 UBQ 0.000000 24.119630 EXTENDED_LIMITS 0.000000 24.119600 /end CHARACTERISTIC
/begin CHARACTERISTIC UBHS "Batterie-Abschaltschwelle der Sondenheizung " VALUE 0x8241 DAMOS_FW1 0 UBQ 0.000000 24.119630 EXTENDED_LIMITS 0.000000 24.119600 /end CHARACTERISTIC
/begin CHARACTERISTIC UBSOLL "Batterie Sollspannung fuer Ladebilanzregelung" VALUE 0x860A DAMOS_FW1 0 UBQ 0.000000 24.119630 EXTENDED_LIMITS 0.000000 24.119600 /end CHARACTERISTIC
/begin CHARACTERISTIC UB_ACCA " CAN Überwachung UBATT Schwelle Ein ACC-Überwachung" VALUE 0x84FA DAMOS_FW1 0 UBQ 0.000000 24.119630 EXTENDED_LIMITS 0.000000 24.119600 /end CHARACTERISTIC
/begin CHARACTERISTIC UB_ACCE " CAN Überwachung UBATT Schwelle Aus ACC-Überwachung" VALUE 0x84F9 DAMOS_FW1 0 UBQ 0.000000 24.119630 EXTENDED_LIMITS 0.000000 24.119600 /end CHARACTERISTIC
/begin CHARACTERISTIC UB_ASRA " CAN Überwachung UBATT Schwelle ASR-Überwachung" VALUE 0x84DE DAMOS_FW1 0 UBQ 0.000000 24.119630 EXTENDED_LIMITS 0.000000 24.119600 /end CHARACTERISTIC
/begin CHARACTERISTIC UB_ASRE " CAN Überwachung UBATT Schwelle ASR-Überwachung" VALUE 0x84DD DAMOS_FW1 0 UBQ 0.000000 24.119630 EXTENDED_LIMITS 0.000000 24.119600 /end CHARACTERISTIC
/begin CHARACTERISTIC UB_BCA " CAN Überwachung UBATT Schwelle BC-Überwachung" VALUE 0x84D0 DAMOS_FW1 0 UBQ 0.000000 24.119630 EXTENDED_LIMITS 0.000000 24.119600 /end CHARACTERISTIC
/begin CHARACTERISTIC UB_BCE " CAN Überwachung UBATT Schwelle BC-Überwachung" VALUE 0x84CF DAMOS_FW1 0 UBQ 0.000000 24.119630 EXTENDED_LIMITS 0.000000 24.119600 /end CHARACTERISTIC
/begin CHARACTERISTIC UB_CANA "UBATT Schwelle fuer CAN-Bus Fehlererkennung aus" VALUE 0x84C3 DAMOS_FW1 0 UBQ 0.000000 24.119630 EXTENDED_LIMITS 0.000000 24.119600 /end CHARACTERISTIC
/begin CHARACTERISTIC UB_CANE "UBATT Schwelle fuer CAN-Bus Fehlererkennung ein" VALUE 0x84C2 DAMOS_FW1 0 UBQ 0.000000 24.119630 EXTENDED_LIMITS 0.000000 24.119600 /end CHARACTERISTIC
/begin CHARACTERISTIC UB_EGSA " CAN Überwachung UBATT Schwelle EGS-Überwachung" VALUE 0x84EC DAMOS_FW1 0 UBQ 0.000000 24.119630 EXTENDED_LIMITS 0.000000 24.119600 /end CHARACTERISTIC
/begin CHARACTERISTIC UB_EGSE " CAN Überwachung UBATT Schwelle EGS-Überwachung" VALUE 0x84EB DAMOS_FW1 0 UBQ 0.000000 24.119630 EXTENDED_LIMITS 0.000000 24.119600 /end CHARACTERISTIC
/begin CHARACTERISTIC UB_NBAA " CAN Überwachung UBATT Schwelle NBA-Überwachung" VALUE 0x8508 DAMOS_FW1 0 UBQ 0.000000 24.119630 EXTENDED_LIMITS 0.000000 24.119600 /end CHARACTERISTIC
/begin CHARACTERISTIC UB_NBAE " CAN Überwachung UBATT Schwelle NBA-Überwachung" VALUE 0x8507 DAMOS_FW1 0 UBQ 0.000000 24.119630 EXTENDED_LIMITS 0.000000 24.119600 /end CHARACTERISTIC
/begin CHARACTERISTIC UDKRGOFS "Schwelle fuer KR-Verstaerkergrundoffsetdiagnose" VALUE 0x8290 DAMOS_FW3 0 SENSORW 0.000000 4.999924 EXTENDED_LIMITS 0.000000 4.999920 /end CHARACTERISTIC
/begin CHARACTERISTIC UDKRNT "Schwelle fuer KR-Nulltestdiagnose" VALUE 0x8292 DAMOS_FW3 0 SENSORW 0.000000 4.999924 EXTENDED_LIMITS 0.000000 4.999920 /end CHARACTERISTIC
/begin CHARACTERISTIC UDKRTP "Schwelle fuer KR-Testimpulsdiagnose" VALUE 0x828E DAMOS_FW3 0 SENSORW 0.000000 4.999924 EXTENDED_LIMITS 0.000000 4.999920 /end CHARACTERISTIC
/begin CHARACTERISTIC UDKSNO "Obere RKRN-Schwelle fuer KRS" CURVE 0xB2C6 DAMOS_GKL1 0 SENSORB 0.000000 4.980469
 /begin AXIS_DESCR COM_AXIS NMOT NQ40 16 0.000000 0.000000 AXIS_PTS_REF SNM16KRUB EXTENDED_LIMITS 0.000000 10200.000000 /end AXIS_DESCR
 EXTENDED_LIMITS 0.000000 4.980470 /end CHARACTERISTIC
/begin CHARACTERISTIC UDKSNU "Untere RKRN-Schwelle fuer KRS" CURVE 0xB2B6 DAMOS_GKL1 0 SENSORB 0.000000 4.980469
 /begin AXIS_DESCR COM_AXIS NMOT NQ40 16 0.000000 0.000000 AXIS_PTS_REF SNM16KRUB EXTENDED_LIMITS 0.000000 10200.000000 /end AXIS_DESCR
 EXTENDED_LIMITS 0.000000 4.980470 /end CHARACTERISTIC
/begin CHARACTERISTIC UGDVER "D-Verstaerkung für Untergrenzen-D-Anteil" VALUE 0x85E9 DAMOS_FW1 0 UDVER 0.000000 0.933866 EXTENDED_LIMITS 0.000000 0.933870 /end CHARACTERISTIC
/begin CHARACTERISTIC UGDZKD "Istwert-Tiefpass-Zeitk. bei fallender Drehzahl f. Untergrenzen-D-Anteil" VALUE 0x85E8 DAMOS_FW1 0 PHI1_10 1.803000 10000.000000 /end CHARACTERISTIC
/begin CHARACTERISTIC UGDZKN "Istwert-Tiefpass-Zeitk. bei steigender Drehzahl f. Untergrenzen-D-Anteil" VALUE 0x85E7 DAMOS_FW1 0 PHI1_10 1.803000 10000.000000 /end CHARACTERISTIC
/begin CHARACTERISTIC UGOFVB_T "Untergrenzenoffset-Verbotszeit" VALUE 0x85E6 DAMOS_FW1 0 TQ10 0.000000 2.550000 /end CHARACTERISTIC
/begin CHARACTERISTIC UG_DMAX "Maximalwert für Untergrenzen-D-Anteil" VALUE 0x85EA DAMOS_FW3 0 PER0327 0.000000 100.000000 /end CHARACTERISTIC
/begin CHARACTERISTIC UG_F_OF "Offset bei Drive-Stoergroessen-Aufschaltung" VALUE 0x85AA DAMOS_FW3 0 UDKL 0.000000 10.112030 EXTENDED_LIMITS 0.000000 10.112000 /end CHARACTERISTIC
/begin CHARACTERISTIC UHSN " Nennspannung fuer die Sondenheizung" VALUE 0x824B DAMOS_FW1 0 UBQ 0.000000 24.119630 EXTENDED_LIMITS 0.000000 24.119600 /end CHARACTERISTIC
/begin CHARACTERISTIC UKSS "Startbereich 1 -> 2 Übergang nach UKSS NW-Umdrehungen" VALUE 0x8146 DAMOS_FW1 0 DEZ 0.000000 256.000000 /end CHARACTERISTIC
/begin CHARACTERISTIC USDBO "Obere Schwelle fuer Adernschluss u. defekte Sonde mit begr. Hub" VALUE 0x83D2 DAMOS_FW3 0 ULSQL 0.000000 5.000000 /end CHARACTERISTIC
/begin CHARACTERISTIC USDBU "Untere Schwelle fuer Adernschluss u. defekte Sonde mit begr. Hub" VALUE 0x83D0 DAMOS_FW3 0 ULSQL 0.000000 5.000000 /end CHARACTERISTIC
/begin CHARACTERISTIC USFHK "Sondenspannungsschwelle fuer Erkennung 'fett hinter Kat'" VALUE 0x83D4 DAMOS_FW3 0 ULSQL 0.000000 5.000000 /end CHARACTERISTIC
/begin CHARACTERISTIC USHKAMX "USHK-Schwelle fuer LRKA abbrechen" VALUE 0x8578 DAMOS_FW3 0 ULSQL 0.000000 5.000000 /end CHARACTERISTIC
/begin CHARACTERISTIC USHLEAN "Schwelle fuer Magerspannung fuer ungueltige Dynamikmessung der Sonde hinter Kat" VALUE 0x836F DAMOS_FW1 0 U0V_1V25 0.000000 1.245117 EXTENDED_LIMITS 0.000000 1.245120 /end CHARACTERISTIC
/begin CHARACTERISTIC USHRICH "Schwelle fuer Fettspannung fuer gueltige Dynamikmessung der Sonde hinter Kat" VALUE 0x8370 DAMOS_FW1 0 U0V_1V25 0.000000 1.245117 EXTENDED_LIMITS 0.000000 1.245120 /end CHARACTERISTIC
/begin CHARACTERISTIC USHSTGMX "Wert fuer maximale Steigung fuer Startwert Filter" VALUE 0x8371 DAMOS_FW1 0 SPGG_Q0P52 0.000000 132.600000 /end CHARACTERISTIC
/begin CHARACTERISTIC USHSTSOLL "Schwelle fuer zulaessige Steigung der Sondenspannung hinter Kat" VALUE 0x8372 DAMOS_FW1 0 SPGG_Q0P52 0.000000 132.600000 /end CHARACTERISTIC
/begin CHARACTERISTIC USIVMAXH "Iniwert max. So.spng. h.K. nach pwf und fcm_clear" VALUE 0x848E DAMOS_FW1 0 U0V_1V33 0.000000 1.330000 /end CHARACTERISTIC
/begin CHARACTERISTIC USIVMAXV "Iniwert max. So.spng. v.K. nach pwf und fcm_clear" VALUE 0x848F DAMOS_FW1 0 U0V_1V33 0.000000 1.330000 /end CHARACTERISTIC
/begin CHARACTERISTIC USIVMINH "Iniwert min. So.spng. h.K. nach pwf und fcm_clear" VALUE 0x8490 DAMOS_FW1 0 U0V_1V33 0.000000 1.330000 /end CHARACTERISTIC
/begin CHARACTERISTIC USIVMINV "Iniwert min. So.spng. v.K. nach pwf und fcm_clear" VALUE 0x8491 DAMOS_FW1 0 U0V_1V33 0.000000 1.330000 /end CHARACTERISTIC
/begin CHARACTERISTIC USMAX "Schwelle fuer Sondenkurzschluss nach Ubatt" VALUE 0x83CC DAMOS_FW3 0 ULSQL 0.000000 5.000000 /end CHARACTERISTIC
/begin CHARACTERISTIC USMHK "Sondenspg. h.K. ab der auf einen Fehler 'fette'-Sonde v.K. erkannt wird" VALUE 0x83D6 DAMOS_FW3 0 ULSQL 0.000000 5.000000 /end CHARACTERISTIC
/begin CHARACTERISTIC USMIN "Schwelle fuer Sondenkurzschluss nach Masse" VALUE 0x83CE DAMOS_FW3 0 ULSQL 0.000000 5.000000 /end CHARACTERISTIC
/begin CHARACTERISTIC USMNSAMN "Minimal erkannte U-Sonde fuer Signalausgabe (min. plaus. Wert)" VALUE 0x8492 DAMOS_FW1 0 U0V_1V33 0.000000 1.330000 /end CHARACTERISTIC
/begin CHARACTERISTIC USMNSAMX "Minimal erkannte U-Sonde fuer Signalausgabe (max. plaus. Wert)" VALUE 0x8493 DAMOS_FW1 0 U0V_1V33 0.000000 1.330000 /end CHARACTERISTIC
/begin CHARACTERISTIC USMNSHMN "min. erkannte So.spng. Si.ausgabe (min.plaus.Wert)" VALUE 0x8494 DAMOS_FW1 0 U0V_1V33 0.000000 1.330000 /end CHARACTERISTIC
/begin CHARACTERISTIC USMNSHMX "min. erkannte So.spng. Si.ausgabe (max.plaus.Wert)" VALUE 0x8495 DAMOS_FW1 0 U0V_1V33 0.000000 1.330000 /end CHARACTERISTIC
/begin CHARACTERISTIC USMXSAMN "Maximal erkannte U-Sonde fuer Signalausgabe (min. plaus. Wert)" VALUE 0x8496 DAMOS_FW1 0 U0V_1V33 0.000000 1.330000 /end CHARACTERISTIC
/begin CHARACTERISTIC USMXSAMX "Maximal erkannte U-Sonde fuer Signalausgabe (max. plaus. Wert)" VALUE 0x8497 DAMOS_FW1 0 U0V_1V33 0.000000 1.330000 /end CHARACTERISTIC
/begin CHARACTERISTIC USMXSHMN "max. erkannte So.spng. Si.ausgabe (min.plaus.Wert)" VALUE 0x8498 DAMOS_FW1 0 U0V_1V33 0.000000 1.330000 /end CHARACTERISTIC
/begin CHARACTERISTIC USMXSHMX "max. erkannte So.spng. Si.ausgabe (max.plaus.Wert)" VALUE 0x8499 DAMOS_FW1 0 U0V_1V33 0.000000 1.330000 /end CHARACTERISTIC
/begin CHARACTERISTIC USR "Sonden-Regelschwelle v. K." VALUE 0x83C6 DAMOS_FW3 0 ULSQL 0.000000 5.000000 /end CHARACTERISTIC
/begin CHARACTERISTIC USREF "Schwelle Sondenbetriebsbereitschaft fett v. K." VALUE 0x83C8 DAMOS_FW3 0 ULSQL 0.000000 5.000000 /end CHARACTERISTIC
/begin CHARACTERISTIC USREFH "Schwelle Sondenbetriebsbereitschaft fett hinter Kat" VALUE 0x83E4 DAMOS_FW3 0 ULSQL 0.000000 5.000000 /end CHARACTERISTIC
/begin CHARACTERISTIC USREM "Schwelle Sondenbetriebsbereitschaft mager v. K." VALUE 0x83CA DAMOS_FW3 0 ULSQL 0.000000 5.000000 /end CHARACTERISTIC
/begin CHARACTERISTIC USREMH "Schwelle Sondenbetriebsbereitschaft mager hinter Kat" VALUE 0x83E6 DAMOS_FW3 0 ULSQL 0.000000 5.000000 /end CHARACTERISTIC
/begin CHARACTERISTIC USRHKSHJ "Regelschwelle fuer LRHK, DLSSA-Ausgabe umgerechn. " VALUE 0x849A DAMOS_FW1 0 U0V_1V33 0.000000 1.330000 /end CHARACTERISTIC
/begin CHARACTERISTIC USRIMINH "Mindestspannungsschwelle fuer Ri-Messung der Sonde hinter KAT" VALUE 0x840A DAMOS_FW3 0 ULSQL 0.000000 5.000000 /end CHARACTERISTIC
/begin CHARACTERISTIC USRIMINV "Mindestspannungsschwelle fuer Ri-Messung der Sonde vor KAT" VALUE 0x840C DAMOS_FW3 0 ULSQL 0.000000 5.000000 /end CHARACTERISTIC
/begin CHARACTERISTIC USRIOH "Obere Spannungsschwelle fuer Ri-Messung der Sonde hinter KAT" VALUE 0x840E DAMOS_FW3 0 ULSQL 0.000000 5.000000 /end CHARACTERISTIC
/begin CHARACTERISTIC USRIOV "Obere Spannungsschwelle fuer Ri-Messung der Sonde vor KAT" VALUE 0x8410 DAMOS_FW3 0 ULSQL 0.000000 5.000000 /end CHARACTERISTIC
/begin CHARACTERISTIC USRIUH "Untere Spannungsschwelle fuer Ri-Messung der Sonde hinter KAT" VALUE 0x8412 DAMOS_FW3 0 ULSQL 0.000000 5.000000 /end CHARACTERISTIC
/begin CHARACTERISTIC USRIUV "Untere Spannungsschwelle fuer Ri-Messung der Sonde vor KAT" VALUE 0x8414 DAMOS_FW3 0 ULSQL 0.000000 5.000000 /end CHARACTERISTIC
/begin CHARACTERISTIC USSCHUB "Schwelle fuer Sondenspannung hinter Kat nach Schub" VALUE 0x8373 DAMOS_FW1 0 U0V_1V25 0.000000 1.245117 EXTENDED_LIMITS 0.000000 1.245120 /end CHARACTERISTIC
/begin CHARACTERISTIC UWEH "Umdrehungsschwelle, ZWB-Bereich bei hartem WE" VALUE 0x811F DAMOS_FW1 0 DEZ 1.000000 240.000000 EXTENDED_LIMITS 0.000000 256.000000 /end CHARACTERISTIC
/begin CHARACTERISTIC UWEW "Umdrehungsschwelle, ZWB-Bereich bei weichem WE" VALUE 0x811E DAMOS_FW1 0 DEZ 0.000000 240.000000 EXTENDED_LIMITS 0.000000 256.000000 /end CHARACTERISTIC
/begin CHARACTERISTIC VABSCH "Abschalt-Schwelle" CURVE 0x8740 DAMOS_FKL3 0 VQV16L 0.000000 4095.938000
 /begin AXIS_DESCR FIX_AXIS IR0 DEZ 2 0.000000 1.000000 FIX_AXIS_PAR 0 0 2 EXTENDED_LIMITS 0.000000 256.000000 /end AXIS_DESCR
 EXTENDED_LIMITS 0.000000 4095.940000 /end CHARACTERISTIC
/begin CHARACTERISTIC VANF "Geschwindigkeitsschwelle für Anfahrhilfe" VALUE 0x85ED DAMOS_FW1 0 UGESCH4 0.000000 63.750000 /end CHARACTERISTIC
/begin CHARACTERISTIC VARA "Min. Fahrzeuggeschwindigkeit fuer AR-Funktion" VALUE 0x8188 DAMOS_FW1 0 VQV 0.000000 306.000000 /end CHARACTERISTIC
/begin CHARACTERISTIC VASRM "Geschwindigkeitsschwelle für Schlechtwegerkennung" VALUE 0x82E4 DAMOS_FW3 0 VQV16L 0.000000 4095.938000 EXTENDED_LIMITS 0.000000 4095.940000 /end CHARACTERISTIC
/begin AXIS_PTS VCANV08 "VCAN-Stuetzstellenverteilung" 0x8EE6 V_CAN DAMOS_SST97 0 VQV 8 0.000000 306.000000 /end AXIS_PTS
/begin CHARACTERISTIC VC_ACC " Variantenkodierung ACC: 0=n.vh./1=vh." VALUE 0x8519 DAMOS_FW1 0 DEZ 0.000000 256.000000 /end CHARACTERISTIC
/begin CHARACTERISTIC VC_BC " Wert groesser als 0 -> BC vorhanden" VALUE 0x87D5 DAMOS_FW1 0 DEZ 0.000000 256.000000 /end CHARACTERISTIC
/begin CHARACTERISTIC VC_GETR "Variantenkodierung Getriebe 0=MT, 1=AT, 2=Selespeed" VALUE 0x8767 DAMOS_FW1 0 DEZ 0.000000 256.000000 /end CHARACTERISTIC
/begin CHARACTERISTIC VC_KUP "Variantenkodierung der Logik des Kupplungsschalters" VALUE 0x8764 DAMOS_FW1 0 DEZ 0.000000 256.000000 /end CHARACTERISTIC
/begin CHARACTERISTIC VC_SCAN ">0 SCAN-Tool Ausgabe freigegeben" VALUE 0x8849 DAMOS_FW1 0 DEZ 0.000000 256.000000 /end CHARACTERISTIC
/begin CHARACTERISTIC VC_STATC " Wert groesser als 0 -> Nachricht NCM vorhanden" VALUE 0x87D6 DAMOS_FW1 0 DEZ 0.000000 256.000000 /end CHARACTERISTIC
/begin CHARACTERISTIC VDMN "Geschwindigkeitsschwelle Diagnose" VALUE 0x87DA DAMOS_FW3 0 VQV16L 0.000000 4095.938000 EXTENDED_LIMITS 0.000000 4095.940000 /end CHARACTERISTIC
/begin CHARACTERISTIC VFZG_E "Ersatzgeschwindigkeit im Fehlerfall" VALUE 0x87D0 DAMOS_FW3 0 VQV16L 0.000000 4095.938000 EXTENDED_LIMITS 0.000000 4095.940000 /end CHARACTERISTIC
/begin CHARACTERISTIC VFZG_MAX "Max. Fahrzeugrohgeschwindigkeit, Pluasibilitätsgrenze" VALUE 0x87CC DAMOS_FW3 0 VQV16L 0.000000 4095.938000 EXTENDED_LIMITS 0.000000 4095.940000 /end CHARACTERISTIC
/begin CHARACTERISTIC VFZMN "Erkennen Fahren-Stehen" VALUE 0x87CE DAMOS_FW3 0 VQV16L 0.000000 4095.938000 EXTENDED_LIMITS 0.000000 4095.940000 /end CHARACTERISTIC
/begin CHARACTERISTIC VHA "Geschwindigkeitsschwelle fuer Hoehenadaption" VALUE 0x826E DAMOS_FW1 0 VQV 0.000000 306.000000 /end CHARACTERISTIC
/begin CHARACTERISTIC VHYST "Hysterese-Schwelle" CURVE 0x8744 DAMOS_FKL3 0 VQV16L 0.000000 4095.938000
 /begin AXIS_DESCR FIX_AXIS IR0 DEZ 2 0.000000 1.000000 FIX_AXIS_PAR 0 0 2 EXTENDED_LIMITS 0.000000 256.000000 /end AXIS_DESCR
 EXTENDED_LIMITS 0.000000 4095.940000 /end CHARACTERISTIC
/begin CHARACTERISTIC VKRIRO "Verhaeltnis IKR/RKR fuer obere ZK " VALUE 0x8278 DAMOS_FW3 0 DEZL 0.000000 65535.000000 /end CHARACTERISTIC
/begin CHARACTERISTIC VKRIRU "Verhaeltnis IKR/RKR fuer untere ZK " VALUE 0x8276 DAMOS_FW3 0 DEZL 0.000000 65535.000000 /end CHARACTERISTIC
/begin AXIS_PTS VLFRV06 "LFR-Geschwindigkeitsstuetzstellen" 0x8EB8 V_LFR DAMOS_SST97 0 UGESCH4 6 0.000000 63.750000 /end AXIS_PTS
/begin CHARACTERISTIC VMAXO "Vmax-Schwelle" CURVE 0x874C DAMOS_FKL3 0 VQV16L 0.000000 4095.938000
 /begin AXIS_DESCR FIX_AXIS IR0 DEZ 2 0.000000 1.000000 FIX_AXIS_PAR 0 0 2 EXTENDED_LIMITS 0.000000 256.000000 /end AXIS_DESCR
 EXTENDED_LIMITS 0.000000 4095.940000 /end CHARACTERISTIC
/begin CHARACTERISTIC VMAX_KF "Vorhalt-Kennfeld fuer Vmax-Begrenzung" MAP 0xC069 DAMOS_GKF1 0 PER255 0.000000 100.000000
 /begin AXIS_DESCR COM_AXIS SWNL PER255 8 0.000000 0.000000 AXIS_PTS_REF SWNLV08 EXTENDED_LIMITS 0.000000 100.000000 /end AXIS_DESCR
 /begin AXIS_DESCR COM_AXIS A_POS U_A 8 0.000000 0.000000 AXIS_PTS_REF AV08 EXTENDED_LIMITS -22.222100 22.048500 /end AXIS_DESCR
/end CHARACTERISTIC
/begin CHARACTERISTIC VMINAR "Geschwindigkeitsschwelle fuer Ausloesung dyn. Antiruckel" VALUE 0x8199 DAMOS_FW1 0 VQV 0.000000 306.000000 /end CHARACTERISTIC
/begin CHARACTERISTIC VMIN_UM " " VALUE 0x882C DAMOS_FW3 0 VQV16L 0.000000 4095.938000 EXTENDED_LIMITS 0.000000 4095.940000 /end CHARACTERISTIC
/begin CHARACTERISTIC VNMAXAT "Geschwindigkeitsschwelle bei Getriebeschutz" VALUE 0x81AB DAMOS_FW1 0 VQV 0.000000 306.000000 /end CHARACTERISTIC
/begin CHARACTERISTIC VNMAXDF "Vorwaerts-Geschwindigkeitsschwelle bei Wandler-Fliehkraftschutz" VALUE 0x81B0 DAMOS_FW1 0 VQV 0.000000 306.000000 /end CHARACTERISTIC
/begin CHARACTERISTIC VNMAXRF "Rueckwaerts-Geschwindigkeitsschwelle bei Wandler-Fliehkraftschutz" VALUE 0x81AF DAMOS_FW1 0 VQV 0.000000 306.000000 /end CHARACTERISTIC
/begin CHARACTERISTIC VNQUOT1O "Gangerkennung v/n 1.Gang oben (max. Geschwindigkeit bei n=1000 1/min)" VALUE 0x8522 DAMOS_FW3 0 UEBV_L 0.000000 249.996200 EXTENDED_LIMITS 0.000000 249.996000 /end CHARACTERISTIC
/begin CHARACTERISTIC VNQUOT1U "Gangerkennung v/n 1.Gang unten (min. Geschwindigkeit bei n=1000 1/min)" VALUE 0x8520 DAMOS_FW3 0 UEBV_L 0.000000 249.996200 EXTENDED_LIMITS 0.000000 249.996000 /end CHARACTERISTIC
/begin CHARACTERISTIC VNQUOT2O "Gangerkennung v/n 2.Gang oben (max. Geschwindigkeit bei n=1000 1/min)" VALUE 0x8526 DAMOS_FW3 0 UEBV_L 0.000000 249.996200 EXTENDED_LIMITS 0.000000 249.996000 /end CHARACTERISTIC
/begin CHARACTERISTIC VNQUOT2U "Gangerkennung v/n 2.Gang unten (min. Geschwindigkeit bei n=1000 1/min)" VALUE 0x8524 DAMOS_FW3 0 UEBV_L 0.000000 249.996200 EXTENDED_LIMITS 0.000000 249.996000 /end CHARACTERISTIC
/begin CHARACTERISTIC VNQUOT3O "Gangerkennung v/n 3.Gang oben (max. Geschwindigkeit bei n=1000 1/min)" VALUE 0x852A DAMOS_FW3 0 UEBV_L 0.000000 249.996200 EXTENDED_LIMITS 0.000000 249.996000 /end CHARACTERISTIC
/begin CHARACTERISTIC VNQUOT3U "Gangerkennung v/n 3.Gang unten (min. Geschwindigkeit bei n=1000 1/min)" VALUE 0x8528 DAMOS_FW3 0 UEBV_L 0.000000 249.996200 EXTENDED_LIMITS 0.000000 249.996000 /end CHARACTERISTIC
/begin CHARACTERISTIC VNQUOT4O "Gangerkennung v/n 4.Gang oben (max. Geschwindigkeit bei n=1000 1/min)" VALUE 0x852E DAMOS_FW3 0 UEBV_L 0.000000 249.996200 EXTENDED_LIMITS 0.000000 249.996000 /end CHARACTERISTIC
/begin CHARACTERISTIC VNQUOT4U "Gangerkennung v/n 4.Gang unten (min. Geschwindigkeit bei n=1000 1/min)" VALUE 0x852C DAMOS_FW3 0 UEBV_L 0.000000 249.996200 EXTENDED_LIMITS 0.000000 249.996000 /end CHARACTERISTIC
/begin CHARACTERISTIC VNQUOT5O "Gangerkennung v/n 5.Gang oben (max. Geschwindigkeit bei n=1000 1/min)" VALUE 0x8532 DAMOS_FW3 0 UEBV_L 0.000000 249.996200 EXTENDED_LIMITS 0.000000 249.996000 /end CHARACTERISTIC
/begin CHARACTERISTIC VNQUOT5U "Gangerkennung v/n 5.Gang unten (min. Geschwindigkeit bei n=1000 1/min)" VALUE 0x8530 DAMOS_FW3 0 UEBV_L 0.000000 249.996200 EXTENDED_LIMITS 0.000000 249.996000 /end CHARACTERISTIC
/begin CHARACTERISTIC VNQUOT6O "Gangerkennung v/n 6.Gang oben (max. Geschwindigkeit bei n=1000 1/min)" VALUE 0x8536 DAMOS_FW3 0 UEBV_L 0.000000 249.996200 EXTENDED_LIMITS 0.000000 249.996000 /end CHARACTERISTIC
/begin CHARACTERISTIC VNQUOT6U "Gangerkennung v/n 6.Gang unten (min. Geschwindigkeit bei n=1000 1/min)" VALUE 0x8534 DAMOS_FW3 0 UEBV_L 0.000000 249.996200 EXTENDED_LIMITS 0.000000 249.996000 /end CHARACTERISTIC
/begin CHARACTERISTIC VNS "Geschwindigkeitsschwelle Nachstartsolldrehzahlumschaltung" VALUE 0x8606 DAMOS_FW1 0 VQV 0.000000 306.000000 /end CHARACTERISTIC
/begin CHARACTERISTIC VOBGR "Geschwindigkeit zum Abschalten der NSOBGRON." VALUE 0x8605 DAMOS_FW1 0 VQV 0.000000 306.000000 /end CHARACTERISTIC
/begin CHARACTERISTIC VROHFIL "Geschwindigkeitserfassung, Schwelle oberhalb der Rohsignal begrenzt wird" VALUE 0x87D2 DAMOS_FW3 0 VQV16L 0.000000 4095.938000 EXTENDED_LIMITS 0.000000 4095.940000 /end CHARACTERISTIC
/begin CHARACTERISTIC VROH_OFF "Geschwindigkeitserfassung, max. Rohgeschwindigkeitsoffset" VALUE 0x87CA DAMOS_FW1 0 VQV16 0.000000 15.937500 /end CHARACTERISTIC
/begin CHARACTERISTIC VSAKT "Freigabe der Verstellung über serielle Schnittstelle" VALUE 0x84AF DAMOS_FW1 0 BOOLEAN 0.000000 1.000000 /end CHARACTERISTIC
/begin CHARACTERISTIC VVORH "Vorhalt-Schwelle" CURVE 0x8748 DAMOS_FKL3 0 VQV16L 0.000000 4095.938000
 /begin AXIS_DESCR FIX_AXIS IR0 DEZ 2 0.000000 1.000000 FIX_AXIS_PAR 0 0 2 EXTENDED_LIMITS 0.000000 256.000000 /end AXIS_DESCR
 EXTENDED_LIMITS 0.000000 4095.940000 /end CHARACTERISTIC
/begin CHARACTERISTIC VWFSMX "Wenn gesp. Geschw. größer als Schwelle Motronic freigeben" VALUE 0x84B2 DAMOS_FW3 0 VQV16L 0.000000 4095.938000 EXTENDED_LIMITS 0.000000 4095.940000 /end CHARACTERISTIC
/begin CHARACTERISTIC V_ES " Geschwindigkeitsschwelle Motor aus" VALUE 0x878D DAMOS_FW1 0 VQV 0.000000 306.000000 /end CHARACTERISTIC
/begin CHARACTERISTIC V_MIN_UM "Geschwindigkeitsschwelle f. rollendes Fahrzeug in der FU" VALUE 0x8812 DAMOS_FW3 0 VQV16 0.000000 15.937500 /end CHARACTERISTIC
/begin CHARACTERISTIC V_OFFMAX "Maximaler Offset auf Vregler" VALUE 0x867A DAMOS_FW3 0 VQV16L 0.000000 4095.938000 EXTENDED_LIMITS 0.000000 4095.940000 /end CHARACTERISTIC
/begin CHARACTERISTIC V_OFFMIN "Minimaler Offset auf Vregler" VALUE 0x8678 DAMOS_FW3 0 VQV16L 0.000000 4095.938000 EXTENDED_LIMITS 0.000000 4095.940000 /end CHARACTERISTIC
/begin CHARACTERISTIC V_ROLL "LFR-Geschwindigkeitsschwelle für Reglerparameter-Umschaltung" VALUE 0x85EC DAMOS_FW1 0 UGESCH4 0.000000 63.750000 /end CHARACTERISTIC
/begin CHARACTERISTIC V_SOLL_O "Offsetkennlinie V_regler (Parametersatz)" VALUE 0x867E DAMOS_FW3 0 VQV16L 0.000000 4095.938000 EXTENDED_LIMITS 0.000000 4095.940000 /end CHARACTERISTIC
/begin CHARACTERISTIC V_SOLL_U "Offsetkennlinie V_regler (Parametersatz)" VALUE 0x867C DAMOS_FW3 0 VQV16L 0.000000 4095.938000 EXTENDED_LIMITS 0.000000 4095.940000 /end CHARACTERISTIC
/begin CHARACTERISTIC V_TN "Hintergrund-TN-Sollwert als f(V_LFR)" CURVE 0xBEF7 DAMOS_GKL1 0 UTNQ 352.941200 90000.000000
 /begin AXIS_DESCR COM_AXIS V_LFR UGESCH4 6 0.000000 0.000000 AXIS_PTS_REF VLFRV06 EXTENDED_LIMITS 0.000000 63.750000 /end AXIS_DESCR
 EXTENDED_LIMITS 352.941000 90000.000000 /end CHARACTERISTIC
/begin CHARACTERISTIC V_TNH "Hintergrund-TN-Sollwert als f(V_LFR), Handschaltung" CURVE 0xBEFD DAMOS_GKL1 0 UTNQ 352.941200 90000.000000
 /begin AXIS_DESCR COM_AXIS V_LFR UGESCH4 6 0.000000 0.000000 AXIS_PTS_REF VLFRV06 EXTENDED_LIMITS 0.000000 63.750000 /end AXIS_DESCR
 EXTENDED_LIMITS 352.941000 90000.000000 /end CHARACTERISTIC
/begin CHARACTERISTIC WAIT_T_UM "Wartezeit f. verl. Init. u. vollst. ROM-Check in der FU" VALUE 0x8824 DAMOS_FW3 0 TQ02L 0.000000 13.107000 /end CHARACTERISTIC
/begin CHARACTERISTIC WASOLL_A "Sollbeschleunigung bei Wiederaufnahme" VALUE 0x8684 DAMOS_FW2 0 U_A -22.222080 22.048470 EXTENDED_LIMITS -22.222100 22.048500 /end CHARACTERISTIC
/begin CHARACTERISTIC WA_B_2 "Beschleunigung 2 bei WA" CURVE 0x868C DAMOS_FKL2 0 U_A -22.222080 22.048470
 /begin AXIS_DESCR FIX_AXIS IR0 DEZ 7 0.000000 6.000000 FIX_AXIS_PAR 0 0 7 EXTENDED_LIMITS 0.000000 256.000000 /end AXIS_DESCR
 EXTENDED_LIMITS -22.222100 22.048500 /end CHARACTERISTIC
/begin CHARACTERISTIC WA_B_3 "Beschleunigung 3 bei WA" CURVE 0x8693 DAMOS_FKL2 0 U_A -22.222080 22.048470
 /begin AXIS_DESCR FIX_AXIS IR0 DEZ 7 0.000000 6.000000 FIX_AXIS_PAR 0 0 7 EXTENDED_LIMITS 0.000000 256.000000 /end AXIS_DESCR
 EXTENDED_LIMITS -22.222100 22.048500 /end CHARACTERISTIC
/begin CHARACTERISTIC WA_B_4 "Beschleunigung 4 bei WA" CURVE 0x869A DAMOS_FKL2 0 U_A -22.222080 22.048470
 /begin AXIS_DESCR FIX_AXIS IR0 DEZ 7 0.000000 6.000000 FIX_AXIS_PAR 0 0 7 EXTENDED_LIMITS 0.000000 256.000000 /end AXIS_DESCR
 EXTENDED_LIMITS -22.222100 22.048500 /end CHARACTERISTIC
/begin CHARACTERISTIC WA_DV_1 "Delta V_Schwelle 1 bei WA" VALUE 0x866A DAMOS_FW3 0 VQV16L 0.000000 4095.938000 EXTENDED_LIMITS 0.000000 4095.940000 /end CHARACTERISTIC
/begin CHARACTERISTIC WA_DV_2 "Delta V_Schwelle 2 bei WA" VALUE 0x866C DAMOS_FW3 0 VQV16L 0.000000 4095.938000 EXTENDED_LIMITS 0.000000 4095.940000 /end CHARACTERISTIC
/begin CHARACTERISTIC WA_DV_3 "Delta V_Schwelle 3 bei WA" VALUE 0x866E DAMOS_FW3 0 VQV16L 0.000000 4095.938000 EXTENDED_LIMITS 0.000000 4095.940000 /end CHARACTERISTIC
/begin CHARACTERISTIC WDKARDYN "Drosselklappenschwelle fuer Ausloesung der dyn. Antiruckelfkt." CURVE 0xA6E0 DAMOS_KL97 0 UWDK 0.000000 80.599920 /begin AXIS_DESCR STD_AXIS NMOT NQ40 6 0.000000 10200.000000 /end AXIS_DESCR EXTENDED_LIMITS 0.000000 80.599900 /end CHARACTERISTIC
/begin CHARACTERISTIC WDKDE "WDKBL Ersatzwert bei Istwertpoti Fehler" VALUE 0x85DF DAMOS_FW1 0 UWDK 0.000000 80.599920 EXTENDED_LIMITS 0.000000 80.599900 /end CHARACTERISTIC
/begin CHARACTERISTIC WDKSU1N "Schwelle DK-Winkel für SU Klappe 1" CURVE 0xCE0A DAMOS_KL97 0 UWDK 0.000000 80.599920 /begin AXIS_DESCR STD_AXIS NMOT NQ40 6 0.000000 10200.000000 /end AXIS_DESCR EXTENDED_LIMITS 0.000000 80.599900 /end CHARACTERISTIC
/begin CHARACTERISTIC WDKVLN "Drehzahlabhaengige Vollastschwelle" CURVE 0xB848 DAMOS_KL97 0 UWDK 0.000000 80.599920 /begin AXIS_DESCR STD_AXIS NIST NQ25 8 0.000000 6400.000000 /end AXIS_DESCR EXTENDED_LIMITS 0.000000 80.599900 /end CHARACTERISTIC
/begin CHARACTERISTIC WDKVLN1 "Drehzahlabhaengige Vollastschwelle bei Automat" CURVE 0xB85C DAMOS_KL97 0 UWDK 0.000000 80.599920 /begin AXIS_DESCR STD_AXIS NIST NQ25 8 0.000000 6400.000000 /end AXIS_DESCR EXTENDED_LIMITS 0.000000 80.599900 /end CHARACTERISTIC
/begin CHARACTERISTIC WEEM "Vorlagerungswinkelkorrektur als f(TMOT)" CURVE 0x9DF7 DAMOS_GKL1 0 WQ720 0.000000 720.000000
 /begin AXIS_DESCR COM_AXIS TMOT CMO_TMP 12 0.000000 0.000000 AXIS_PTS_REF TMOTV08 EXTENDED_LIMITS -41.000000 140.000000 /end AXIS_DESCR
/end CHARACTERISTIC
/begin CHARACTERISTIC WEESTM "Start-Vorlagerungswinkelkorrektur als f(TMOT)" CURVE 0x9DEB DAMOS_GKL1 0 WQ720 0.000000 720.000000
 /begin AXIS_DESCR COM_AXIS TMOT CMO_TMP 12 0.000000 0.000000 AXIS_PTS_REF TMOTV08 EXTENDED_LIMITS -41.000000 140.000000 /end AXIS_DESCR
/end CHARACTERISTIC
/begin CHARACTERISTIC WEESTN "Start-Vorlagerungswinkel als f( NIST )" CURVE 0x9DE7 DAMOS_GKL1 0 WQ720 0.000000 720.000000
 /begin AXIS_DESCR COM_AXIS NIST NQ25 4 0.000000 0.000000 AXIS_PTS_REF NISTV05 EXTENDED_LIMITS 0.000000 6400.000000 /end AXIS_DESCR
/end CHARACTERISTIC
/begin CHARACTERISTIC WEESTS "Vorlagerungswinkel fuer Simultaneinspritzungen" VALUE 0x816C DAMOS_FW1 0 WQ720 0.000000 720.000000 /end CHARACTERISTIC
/begin CHARACTERISTIC WEEVLN "Vorlagerungswinkel bei Vollast als f(NIST)" CURVE 0x9E5B DAMOS_GKL1 0 WQ720 0.000000 720.000000
 /begin AXIS_DESCR COM_AXIS NIST NQ25 8 0.000000 0.000000 AXIS_PTS_REF NISTV08 EXTENDED_LIMITS 0.000000 6400.000000 /end AXIS_DESCR
/end CHARACTERISTIC
/begin CHARACTERISTIC WEOFF "Zylindereinblendungen weiches WE" CURVE 0x9BAB DAMOS_GKL1 0 DEZ 0.000000 256.000000
 /begin AXIS_DESCR COM_AXIS IR0 DEZ 8 0.000000 0.000000 AXIS_PTS_REF DUM08 EXTENDED_LIMITS 0.000000 256.000000 /end AXIS_DESCR
/end CHARACTERISTIC
/begin CHARACTERISTIC WESBM "Vorlagerungswinkel" VALUE 0x816B DAMOS_FW1 0 WQ720 0.000000 720.000000 /end CHARACTERISTIC
/begin CHARACTERISTIC WESSTO "Winkel Einspritzung Schnellstartoffset (wirkt auf WEESTS)" VALUE 0x816D DAMOS_FW1 0 WQ720 0.000000 720.000000 /end CHARACTERISTIC
/begin CHARACTERISTIC WGEXT_T "Verzoegerungszeit wgextcalc" VALUE 0x8540 DAMOS_FW1 0 TQ10 0.000000 2.550000 /end CHARACTERISTIC
/begin CHARACTERISTIC WKRDMNN "max. Abweichung (negativ) von mittlerer KR-Regeltiefe" CURVE 0xB2D6 DAMOS_GKL1 0 ZWQ 0.000000 191.250000
 /begin AXIS_DESCR COM_AXIS NMOT NQ40 16 0.000000 0.000000 AXIS_PTS_REF SNM16KRUB EXTENDED_LIMITS 0.000000 10200.000000 /end AXIS_DESCR
/end CHARACTERISTIC
/begin CHARACTERISTIC WKRDMXN "max. Abweichung (positiv) von mittlerer KR-Regeltiefe" CURVE 0xB2E6 DAMOS_GKL1 0 ZWQ 0.000000 191.250000
 /begin AXIS_DESCR COM_AXIS NMOT NQ40 16 0.000000 0.000000 AXIS_PTS_REF SNM16KRUB EXTENDED_LIMITS 0.000000 10200.000000 /end AXIS_DESCR
/end CHARACTERISTIC
/begin CHARACTERISTIC WKRLZOF " ZW-Sicherheitsoffset des gefuehrten Zylinders zum Leitzylinder" CURVE 0x829F DAMOS_FKL1 0 ZWQ 0.000000 191.250000
 /begin AXIS_DESCR FIX_AXIS ZYLNUM DEZZYL 6 0.000000 5.000000 FIX_AXIS_PAR 0 0 6 /end AXIS_DESCR
/end CHARACTERISTIC
/begin CHARACTERISTIC WKWAN "Obere Grenze fuer Drosselklappenwinkel tlw-Adaption" CURVE 0xB1A9 DAMOS_GKL1 0 UWDK 0.000000 80.599920
 /begin AXIS_DESCR COM_AXIS NIST NQ25 8 0.000000 0.000000 AXIS_PTS_REF NISTV08 EXTENDED_LIMITS 0.000000 6400.000000 /end AXIS_DESCR
 EXTENDED_LIMITS 0.000000 80.599900 /end CHARACTERISTIC
/begin CHARACTERISTIC WKWAUN "Untere Grenze fuer Drosselklappenwinkel tlw-Adaption" CURVE 0xB1A1 DAMOS_GKL1 0 UWDK 0.000000 80.599920
 /begin AXIS_DESCR COM_AXIS NIST NQ25 8 0.000000 0.000000 AXIS_PTS_REF NISTV08 EXTENDED_LIMITS 0.000000 6400.000000 /end AXIS_DESCR
 EXTENDED_LIMITS 0.000000 80.599900 /end CHARACTERISTIC
/begin CHARACTERISTIC WLLDNDN "Zuendwinkel Leerlaufeingriff neg. dN Waehlhebelstellung D" CURVE 0xA65A DAMOS_KL97 0 ZWNEG -72.000000 0.000000 /begin AXIS_DESCR STD_AXIS DN_5U NQ5 6 0.000000 1275.000000 /end AXIS_DESCR /end CHARACTERISTIC
/begin CHARACTERISTIC WLLDPDN "Zuendwinkel Leerlaufeingriff pos. dN Waehlhebelstellung D" CURVE 0xA66A DAMOS_KL97 0 ZWQ 0.000000 191.250000 /begin AXIS_DESCR STD_AXIS DN_5U NQ5 6 0.000000 1275.000000 /end AXIS_DESCR /end CHARACTERISTIC
/begin CHARACTERISTIC WLLM "Zündwinkel Warmlauf Teillastkennlinie im Leerlauf" CURVE 0x9F0F DAMOS_GKL1 0 ZWQ 0.000000 191.250000
 /begin AXIS_DESCR COM_AXIS TMOT CMO_TMP 12 0.000000 0.000000 AXIS_PTS_REF TMOTV08 EXTENDED_LIMITS -41.000000 140.000000 /end AXIS_DESCR
/end CHARACTERISTIC
/begin CHARACTERISTIC WLLNNDN "Zuendwinkel Leerlaufeingriff neg. dN Waehlhebelstellung P/N" CURVE 0xA63A DAMOS_KL97 0 ZWNEG -72.000000 0.000000 /begin AXIS_DESCR STD_AXIS DN_5U NQ5 6 0.000000 1275.000000 /end AXIS_DESCR /end CHARACTERISTIC
/begin CHARACTERISTIC WLLNPDN "Zuendwinkel Leerlaufeingriff pos. dN Waehlhebelstellung P/N" CURVE 0xA64A DAMOS_KL97 0 ZWQ 0.000000 191.250000 /begin AXIS_DESCR STD_AXIS DN_5U NQ5 6 0.000000 1275.000000 /end AXIS_DESCR /end CHARACTERISTIC
/begin CHARACTERISTIC WMAXME "Spätwinkelbegrenzung" VALUE 0x8187 DAMOS_FW1 0 ZWOF -78.000000 24.000000 /end CHARACTERISTIC
/begin CHARACTERISTIC WMAXMEN "Spätwinkelbegrenzung" CURVE 0xA5BE DAMOS_KL97 0 ZWOF -78.000000 24.000000 /begin AXIS_DESCR STD_AXIS NMOT NQ40 8 0.000000 10200.000000 /end AXIS_DESCR /end CHARACTERISTIC
/begin CHARACTERISTIC WMINME "Frühwinkelbegrenzung" VALUE 0x8186 DAMOS_FW1 0 ZWOF -78.000000 24.000000 /end CHARACTERISTIC
/begin CHARACTERISTIC WPHN "Phasengangkorrektur" CURVE 0xA5B4 DAMOS_KL97 0 ZWNEG -72.000000 0.000000 /begin AXIS_DESCR STD_AXIS NMOT NQ40 3 0.000000 10200.000000 /end AXIS_DESCR /end CHARACTERISTIC
/begin CHARACTERISTIC WSTM "Startzuendwinkel Korrekturkennlinie" CURVE 0x9E67 DAMOS_GKL1 0 ZWQ 0.000000 191.250000
 /begin AXIS_DESCR COM_AXIS TMOT CMO_TMP 12 0.000000 0.000000 AXIS_PTS_REF TMOTV08 EXTENDED_LIMITS -41.000000 140.000000 /end AXIS_DESCR
/end CHARACTERISTIC
/begin CHARACTERISTIC WSTN "Startzuendwinkel" CURVE 0x9E63 DAMOS_GKL1 0 ZWOF -78.000000 24.000000
 /begin AXIS_DESCR COM_AXIS NIST NQ25 4 0.000000 0.000000 AXIS_PTS_REF NISTV05 EXTENDED_LIMITS 0.000000 6400.000000 /end AXIS_DESCR
/end CHARACTERISTIC
/begin CHARACTERISTIC WTLM "Zündwinkel Warmlauf Teillastkennlinie" CURVE 0x9EC3 DAMOS_GKL1 0 ZWQ 0.000000 191.250000
 /begin AXIS_DESCR COM_AXIS TMOT CMO_TMP 12 0.000000 0.000000 AXIS_PTS_REF TMOTV08 EXTENDED_LIMITS -41.000000 140.000000 /end AXIS_DESCR
/end CHARACTERISTIC
/begin CHARACTERISTIC ZABNFB1 "Maske1 fuer Zylinderabschaltung im Drehzahl-Bereich NIST < NNFB1" VALUE 0x8770 DAMOS_FW1 0 DEZ 0.000000 256.000000 /end CHARACTERISTIC
/begin CHARACTERISTIC ZABNFB2 "Maske2 fuer Zylinderabschaltung im Drehzahl-Bereich NNFB1 =< NIST < NNFB2" VALUE 0x8771 DAMOS_FW1 0 DEZ 0.000000 256.000000 /end CHARACTERISTIC
/begin CHARACTERISTIC ZABNFB3 "Maske3 fuer Zylinderabschaltung im Drehzahl-Bereich NNFB2 =< NIST < NNFB3" VALUE 0x8772 DAMOS_FW1 0 DEZ 0.000000 256.000000 /end CHARACTERISTIC
/begin CHARACTERISTIC ZABNFB4 "Maske4 fuer Zylinderabschaltung im Drehzahl-Bereich NNFB3 =< NIST < NNFB4" VALUE 0x8773 DAMOS_FW1 0 DEZ 0.000000 256.000000 /end CHARACTERISTIC
/begin CHARACTERISTIC ZABNFB5 "Maske5 fuer Zylinderabschaltung im Drehzahl-Bereich NNFB4 =< NIST < NNFB5" VALUE 0x8774 DAMOS_FW1 0 DEZ 0.000000 256.000000 /end CHARACTERISTIC
/begin CHARACTERISTIC ZABNFB6 "Maske6 fuer Zylinderabschaltung im Drehzahl-Bereich NNFB5 =< NIST < NNFB6" VALUE 0x8775 DAMOS_FW1 0 DEZ 0.000000 256.000000 /end CHARACTERISTIC
/begin CHARACTERISTIC ZABNFB7 "Maske7 fuer Zylinderabschaltung im Drehzahl-Bereich NIST >= NNFB6" VALUE 0x8776 DAMOS_FW1 0 DEZ 0.000000 256.000000 /end CHARACTERISTIC
/begin CHARACTERISTIC ZASMASK " " VALUE 0x830C DAMOS_FW1 0 DEZ 0.000000 256.000000 /end CHARACTERISTIC
/begin CHARACTERISTIC ZATMAML "Zeitkonstante fuer Abgastemperaturmodell" CURVE 0xB087 DAMOS_GKL1 0 UZTABG 0.003137 204.000000
 /begin AXIS_DESCR COM_AXIS MLSM MLSMQ 6 0.000000 0.000000 AXIS_PTS_REF MLV06 EXTENDED_LIMITS 0.000000 1024.000000 /end AXIS_DESCR
/end CHARACTERISTIC
/begin CHARACTERISTIC ZATMKML "Zeitkonstante fuer Katalysatortemperaturmodell" CURVE 0xB08D DAMOS_GKL1 0 UZTKAT 0.012549 816.000000
 /begin AXIS_DESCR COM_AXIS MLSM MLSMQ 6 0.000000 0.000000 AXIS_PTS_REF MLV06 EXTENDED_LIMITS 0.000000 1024.000000 /end AXIS_DESCR
/end CHARACTERISTIC
/begin CHARACTERISTIC ZATMVFZ "Zeitkonstante fuer ATM Abkuehlung bei B_SA" CURVE 0xB0FB DAMOS_GKL1 0 UZTKAT 0.012549 816.000000
 /begin AXIS_DESCR COM_AXIS V_CAN VQV 8 0.000000 0.000000 AXIS_PTS_REF VCANV08 EXTENDED_LIMITS 0.000000 306.000000 /end AXIS_DESCR
/end CHARACTERISTIC
/begin CHARACTERISTIC ZBALM "Abregelfaktor Langzeitanteil bei BA" CURVE 0x9C87 DAMOS_GKL1 0 FKT2048 0.000000 0.124512
 /begin AXIS_DESCR COM_AXIS TMOT CMO_TMP 12 0.000000 0.000000 AXIS_PTS_REF TMOTV08 EXTENDED_LIMITS -41.000000 140.000000 /end AXIS_DESCR
 EXTENDED_LIMITS 0.000000 0.124510 /end CHARACTERISTIC
/begin CHARACTERISTIC ZBSMW "Filterfaktor Nullpktfilter Signal Beschleunigungssensor" VALUE 0x82F4 DAMOS_FW3 0 FKT65536 0.000000 1.000000 /end CHARACTERISTIC
/begin CHARACTERISTIC ZDKATAD "Filterzeitkonst. der Differenzierer fuer Signalamplitude" VALUE 0x83A3 DAMOS_FW1 0 ZQ50 0.050196 12.800000 /end CHARACTERISTIC
/begin CHARACTERISTIC ZDKATAF "Zeitkonstante Betrags-Filter fuer Signalamplitude" VALUE 0x83A4 DAMOS_FW1 0 ZQ50 0.050196 12.800000 /end CHARACTERISTIC
/begin CHARACTERISTIC ZDKHA "Zeitkonstante fuer tlw-Adaption" VALUE 0x8266 DAMOS_FW1 0 FKT256 0.000000 0.996094 EXTENDED_LIMITS 0.000000 0.996090 /end CHARACTERISTIC
/begin CHARACTERISTIC ZDKHAS "Zeitkonstante fuer schnelle tlw-Adaption nach Schub" VALUE 0x8267 DAMOS_FW1 0 FKT256 0.000000 0.996094 EXTENDED_LIMITS 0.000000 0.996090 /end CHARACTERISTIC
/begin CHARACTERISTIC ZDKTBD "Zeitkonstante der Differenzierer fuer FR-Wechselanteil" VALUE 0x83A5 DAMOS_FW1 0 ZQ50 0.050196 12.800000 /end CHARACTERISTIC
/begin CHARACTERISTIC ZDKTBF "Zeitkonstante fuer Gasvermischungsvorgang vor Kat" VALUE 0x83A6 DAMOS_FW1 0 ZQ50 0.050196 12.800000 /end CHARACTERISTIC
/begin CHARACTERISTIC ZFRIH "Abschwaechungsfaktor fuer Innenwiderstand Ri-Nernst-Filter hinter KAT" VALUE 0x8416 DAMOS_FW3 0 FKT65536 0.000000 1.000000 /end CHARACTERISTIC
/begin CHARACTERISTIC ZFRIV "Abschwaechungsfaktor fuer Innenwiderstand Ri-Nernst-Filter vor KAT" VALUE 0x8418 DAMOS_FW3 0 FKT65536 0.000000 1.000000 /end CHARACTERISTIC
/begin CHARACTERISTIC ZFTEAML "Integratorsteigerung fuer Beladungsfaktor in Tankentl." CURVE 0xB39D DAMOS_GKL1 0 TEVIQ 0.000000 3.890991
 /begin AXIS_DESCR COM_AXIS MLSM MLSMQ 6 0.000000 0.000000 AXIS_PTS_REF MLV06 EXTENDED_LIMITS 0.000000 1024.000000 /end AXIS_DESCR
 EXTENDED_LIMITS 0.000000 3.890990 /end CHARACTERISTIC
/begin CHARACTERISTIC ZFTMOT "Zeitkonstante für TMOT-Filter" VALUE 0x846D DAMOS_FW1 0 FKT256 0.000000 0.996094 EXTENDED_LIMITS 0.000000 0.996090 /end CHARACTERISTIC
/begin CHARACTERISTIC ZFTSVK "Zeitkonstante fuer Filter Periodendauer der Sonde vor Katalysator" VALUE 0x8344 DAMOS_FW1 0 FKT256 0.000000 0.996094 EXTENDED_LIMITS 0.000000 0.996090 /end CHARACTERISTIC
/begin CHARACTERISTIC ZFV "Zeitkonstante für Filterung der Gesch.signals" VALUE 0x87C9 DAMOS_FW1 0 PHI1_10 1.803000 10000.000000 /end CHARACTERISTIC
/begin CHARACTERISTIC ZKARIH " Temperatur Zeitkonstante Hinten" VALUE 0x8258 DAMOS_FW3 0 ZK100MSXSL 10.005500 6553.600000 /end CHARACTERISTIC
/begin CHARACTERISTIC ZKARIV " Temperatur Zeitkonstante Vorne" VALUE 0x8256 DAMOS_FW3 0 ZK100MSXSL 10.005500 6553.600000 /end CHARACTERISTIC
/begin CHARACTERISTIC ZKD "Istwert-Tiefpass Zeitkonstante f. fallende Drehzahl" VALUE 0x85A1 DAMOS_FW1 0 PHI1_10 1.803000 10000.000000 /end CHARACTERISTIC
/begin CHARACTERISTIC ZKDTV "Zeitkonstante DTV-Integrator ( Lambda Adaption )" VALUE 0x8211 DAMOS_FW1 0 U_ZK 1.176471 300.000000 EXTENDED_LIMITS 1.176470 300.000000 /end CHARACTERISTIC
/begin CHARACTERISTIC ZKFRAO "Zeitkonstante FRAO-Integrator ( Lambda-Adaption )" VALUE 0x8225 DAMOS_FW1 0 UZKFRA 3.212549 819.200000 EXTENDED_LIMITS 3.212550 819.200000 /end CHARACTERISTIC
/begin CHARACTERISTIC ZKFRAU "Zeitkonstante FRAU-Integrator ( Lambda-Adaption )" VALUE 0x8224 DAMOS_FW1 0 UZKFRA 3.212549 819.200000 EXTENDED_LIMITS 3.212550 819.200000 /end CHARACTERISTIC
/begin CHARACTERISTIC ZKFRM "Zeitkonstante LRA-Filter ( Mittleres FR )" VALUE 0x820F DAMOS_FW1 0 UZKFRM 0.040157 10.240000 /end CHARACTERISTIC
/begin CHARACTERISTIC ZKFUB "Filterzeitkonstante Ubatt-Filter Ladebilanzregelung" VALUE 0x860B DAMOS_FW1 0 PHI1_100 18.030000 100000.000000 /end CHARACTERISTIC
/begin CHARACTERISTIC ZKLBZNN "Zeitkonstante Ladebilanzintegrator bei negativer Ladebilanz" CURVE 0xC464 DAMOS_KL97 0 ZINT_100 0.000000 99.609380 /begin AXIS_DESCR STD_AXIS NMOT NQ40 6 0.000000 10200.000000 /end AXIS_DESCR EXTENDED_LIMITS 0.000000 99.609400 /end CHARACTERISTIC
/begin CHARACTERISTIC ZKLBZP "Zeitkonstante Ladebilanzintegrator bei positiver Ladebilanz" VALUE 0x860C DAMOS_FW1 0 ZINT_100 0.000000 99.609380 EXTENDED_LIMITS 0.000000 99.609400 /end CHARACTERISTIC
/begin CHARACTERISTIC ZKN "Istwert-Tiefpass Zeitkonstante f. steigende Drehzahl" VALUE 0x85A0 DAMOS_FW1 0 PHI1_10 1.803000 10000.000000 /end CHARACTERISTIC
/begin CHARACTERISTIC ZKPRIH " Leistungs Zeitkonstante Hinten" VALUE 0x8254 DAMOS_FW3 0 ZK100MSXSL 10.005500 6553.600000 /end CHARACTERISTIC
/begin CHARACTERISTIC ZKPRIV " Leistungs Zeitkonstante Vorne" VALUE 0x8252 DAMOS_FW3 0 ZK100MSXSL 10.005500 6553.600000 /end CHARACTERISTIC
/begin CHARACTERISTIC ZKTDRL "Zeitkonstante Tiefpass, rl-Filterung" VALUE 0x83A7 DAMOS_FW1 0 PHI1_50 9.015000 50000.000000 /end CHARACTERISTIC
/begin CHARACTERISTIC ZKTRA "Zeitkonstante TRA-Integrator bei N1/NIST = 1(Lambda-Adaption)" VALUE 0x8210 DAMOS_FW1 0 U_ZK 1.176471 300.000000 EXTENDED_LIMITS 1.176470 300.000000 /end CHARACTERISTIC
/begin CHARACTERISTIC ZLASOHML "Zeitkonstante PT1 des Pseudo-Lambda hinter Kat " CURVE 0xACBC DAMOS_KL97 0 PHI1_40 7.212000 40000.000000 /begin AXIS_DESCR STD_AXIS MLSM MLSMQ 6 0.000000 1024.000000 /end AXIS_DESCR /end CHARACTERISTIC
/begin CHARACTERISTIC ZLRHML "Gradient Lambdaregler hinter KAT" CURVE 0xAD24 DAMOS_KL97 0 ATVG 0.000000 15.360000 /begin AXIS_DESCR STD_AXIS MLSM MLSMQ 9 0.000000 1024.000000 /end AXIS_DESCR /end CHARACTERISTIC
/begin CHARACTERISTIC ZLRSYNI "Zeitkonstante I-Integrator für Synchro-Regelung LR" VALUE 0x81D7 DAMOS_FW1 0 UZK5SEC 0.020078 5.120000 /end CHARACTERISTIC
/begin CHARACTERISTIC ZNFIG_AT "gangabhängige Zeitkonst. Drehzahl-Filter bei AT" CURVE 0x8189 DAMOS_FKL1 0 PHI1_10 1.803000 10000.000000
 /begin AXIS_DESCR FIX_AXIS IR0 DEZ 8 0.000000 7.000000 FIX_AXIS_PAR 0 0 8 EXTENDED_LIMITS 0.000000 256.000000 /end AXIS_DESCR
/end CHARACTERISTIC
/begin CHARACTERISTIC ZNFIG_MT "gangabhängige Zeitkonst. Drehzahl-Filter bei MT" CURVE 0x8191 DAMOS_FKL1 0 PHI1_10 1.803000 10000.000000
 /begin AXIS_DESCR FIX_AXIS IR0 DEZ 8 0.000000 7.000000 FIX_AXIS_PAR 0 0 8 EXTENDED_LIMITS 0.000000 256.000000 /end AXIS_DESCR
/end CHARACTERISTIC
/begin CHARACTERISTIC ZQTEML "Integratorsteigung fuer Spuelrate in Tankentl." CURVE 0xB46B DAMOS_GKL1 0 TEVIQ 0.000000 3.890991
 /begin AXIS_DESCR COM_AXIS MLSM MLSMQ 6 0.000000 0.000000 AXIS_PTS_REF MLV06 EXTENDED_LIMITS 0.000000 1024.000000 /end AXIS_DESCR
 EXTENDED_LIMITS 0.000000 3.890990 /end CHARACTERISTIC
/begin CHARACTERISTIC ZTLFLFN "TLR-Filterzeitkonstante für DK-Poti Notfahren" CURVE 0xC004 DAMOS_KL97 0 PHI1_100 18.030000 100000.000000 /begin AXIS_DESCR STD_AXIS NIST NQ25 5 0.000000 6400.000000 /end AXIS_DESCR /end CHARACTERISTIC
/begin CHARACTERISTIC ZTLWFN "Filterkonstante fuer Nebenlastsignal TLW" CURVE 0x91B9 DAMOS_GKL1 0 PHI1_SY 0.000000 99.609380
 /begin AXIS_DESCR COM_AXIS NIST NQ25 8 0.000000 0.000000 AXIS_PTS_REF NISTV08 EXTENDED_LIMITS 0.000000 6400.000000 /end AXIS_DESCR
 EXTENDED_LIMITS 0.000000 99.609400 /end CHARACTERISTIC
/begin CHARACTERISTIC ZUKK "Abregelfaktor Kurzzeitanteil" VALUE 0x8156 DAMOS_FW1 0 FKT256 0.000000 0.996094 EXTENDED_LIMITS 0.000000 0.996090 /end CHARACTERISTIC
/begin CHARACTERISTIC ZUKNST "Abregelzeitkonstante ÜK-Faktor im Nachstart" VALUE 0x814E DAMOS_FW1 0 DEZ 0.000000 256.000000 /end CHARACTERISTIC
/begin CHARACTERISTIC ZUSHKAB "Filterzeitkonstante fuer Abregelung der dynamischen Sollwertanhebung in der LRHK" VALUE 0x822D DAMOS_FW1 0 PHI1_40 7.212000 40000.000000 /end CHARACTERISTIC
/begin CHARACTERISTIC ZVALM "Abregelfaktor Langzeitanteil bei VA" CURVE 0x9C7B DAMOS_GKL1 0 FKT2048 0.000000 0.124512
 /begin AXIS_DESCR COM_AXIS TMOT CMO_TMP 12 0.000000 0.000000 AXIS_PTS_REF TMOTV08 EXTENDED_LIMITS -41.000000 140.000000 /end AXIS_DESCR
 EXTENDED_LIMITS 0.000000 0.124510 /end CHARACTERISTIC
/begin CHARACTERISTIC ZWC_T_UM "Fehlerzeit der FU wenn jeder Verg. falsch ist" VALUE 0x87F8 DAMOS_FW1 0 UMFZWC 0.000000 2040.000000 /end CHARACTERISTIC
/begin CHARACTERISTIC ZYLANZ_UM "Zylinderanzahl f. FU" VALUE 0x87F9 DAMOS_FW1 0 DZZYL 0.000000 5.000000 /end CHARACTERISTIC
/begin CHARACTERISTIC ZZNWSKH "Schwelle Zündungszähler für NWS bei KAT-Heizen" VALUE 0x8236 DAMOS_FW3 0 DEZL 0.000000 65535.000000 /end CHARACTERISTIC
/begin COMPU_METHOD ATVG "  Adaptiver tv-Gradient hinter KAT" RAT_FUNC "%7.4" "ms/s" COEFFS 0 1.000000 0.000000 0 0.000000 6.000000e-02 /end COMPU_METHOD
/begin COMPU_METHOD BCD " BINARYCODEDDECIMAL " TAB_NOINTP "%6.3" "" COMPU_TAB_REF BCD /end COMPU_METHOD
/begin COMPU_METHOD BOOLEAN " Logische Zustaende" TAB_NOINTP "%3.1" "Auswahl" COMPU_TAB_REF BOOLEAN /end COMPU_METHOD
/begin COMPU_METHOD CLU_TMP "Ansaugluft-Temperatur" TAB_INTP "%7.3" "grd C" COMPU_TAB_REF CLU_TMP /end COMPU_METHOD
/begin COMPU_METHOD CMO_TMP "Motor-Temperatur (invers)" TAB_INTP "%7.3" "Grad C" COMPU_TAB_REF CMO_TMP /end COMPU_METHOD
/begin COMPU_METHOD DEZ "  Dezimalzahl in Hexzahl" RAT_FUNC "%3.0" "" COEFFS 0 1.000000 0.000000 0 0.000000 1.000000 /end COMPU_METHOD
/begin COMPU_METHOD DEZ7 "  Dezimalzahl in Hexzahl von 0-7" RAT_FUNC "%4.2" "" COEFFS 0 1.000000 0.000000 0 0.000000 1.000000 /end COMPU_METHOD
/begin COMPU_METHOD DEZL "  Dezimalzahl in 16-Bit-Hexzahl" RAT_FUNC "%5.0" "" COEFFS 0 1.000000 0.000000 0 0.000000 1.000000 /end COMPU_METHOD
/begin COMPU_METHOD DEZZYL " Zylindernummer 0 bis 5" RAT_FUNC "%4.2" "Zyl.nr." COEFFS 0 1.000000 0.000000 0 0.000000 1.000000 /end COMPU_METHOD
/begin COMPU_METHOD DIV256 "Divisionsfaktor 256" RAT_FUNC "%7.1" "Faktor" COEFFS 0 3.906200e-03 0.000000 0 0.000000 1.000000 /end COMPU_METHOD
/begin COMPU_METHOD DMMQ "Motor-Momentquantisierung (Delta) mit Offset (80h)" RAT_FUNC "%5.2" "Nm/10ms" COEFFS 0 8.000000 256.000000 0 0.000000 2.000000 /end COMPU_METHOD
/begin COMPU_METHOD DPCENT "Motor-Momentquantisierung (Delta) mit Offset (80h)" RAT_FUNC "%5.2" "%/20ms" COEFFS 0 512.000000 12800.000000 0 0.000000 100.000000 /end COMPU_METHOD
/begin COMPU_METHOD DTSEGN "Segmentwinkel/256" RAT_FUNC "%7.5" "Grad KW" COEFFS 0 256.000000 0.000000 0 0.000000 1.125000 /end COMPU_METHOD
/begin COMPU_METHOD DTSEGNL "Segmentwinkel" RAT_FUNC "%7.3" "Grad KW" COEFFS 0 1.000000 0.000000 0 0.000000 4.394500e-03 /end COMPU_METHOD
/begin COMPU_METHOD DZZYL " Zylindernummer bis  5.000" RAT_FUNC "%4.2" "Zyl.nr." COEFFS 0 1.000000 0.000000 0 0.000000 1.000000 /end COMPU_METHOD
/begin COMPU_METHOD FKT0001 "  Quantisierung mit 0.01 " RAT_FUNC "%7.5" "" COEFFS 0 1.000000 0.000000 0 0.000000 1.000000e-02 /end COMPU_METHOD
/begin COMPU_METHOD FKT128 "  Umsetzung des Intervalles [0;<2]" RAT_FUNC "%6.4" "" COEFFS 0 128.000000 0.000000 0 0.000000 1.000000 /end COMPU_METHOD
/begin COMPU_METHOD FKT2048 "  Umsetzung des Intervalles [0;<0.128]" RAT_FUNC "%6.4" "" COEFFS 0 2048.000000 0.000000 0 0.000000 1.000000 /end COMPU_METHOD
/begin COMPU_METHOD FKT256 "  Umsetzung des Intervalles [0;<1]" RAT_FUNC "%6.4" "" COEFFS 0 256.000000 0.000000 0 0.000000 1.000000 /end COMPU_METHOD
/begin COMPU_METHOD FKT51 "  Umsetzung des Intervalles [0;< 4.980]" RAT_FUNC "%7.5" "" COEFFS 0 51.200000 0.000000 0 0.000000 1.000000 /end COMPU_METHOD
/begin COMPU_METHOD FKT64 "  Umsetzung des Intervalles [0;<4]" RAT_FUNC "%6.4" "" COEFFS 0 64.000000 0.000000 0 0.000000 1.000000 /end COMPU_METHOD
/begin COMPU_METHOD FKT65536 "  Umsetzung des Intervalles [0;<1]" RAT_FUNC "%7.5" "" COEFFS 0 6.553600e+04 0.000000 0 0.000000 1.000000 /end COMPU_METHOD
/begin COMPU_METHOD MLQ360L "  Luftmassen-Durchsatz mit Faktor  360.0[g] " RAT_FUNC "%7.3" "g" COEFFS 0 360.000000 0.000000 0 0.000000 1.000000 /end COMPU_METHOD
/begin COMPU_METHOD MLSMQ "MLE mit  4.000 Kg/h quantisiert" RAT_FUNC "%7.2" "kg/h" COEFFS 0 1.000000 0.000000 0 0.000000 4.000000 /end COMPU_METHOD
/begin COMPU_METHOD MMQ "Motor-Momentquantisierung " RAT_FUNC "%5.1" "Nm" COEFFS 0 1.000000 0.000000 0 0.000000 2.000000 /end COMPU_METHOD
/begin COMPU_METHOD NGRDQ40 "  Drehzahlgradient mi 40 Upm/sec quantisiert" RAT_FUNC "%5.0" "Upm/sec" COEFFS 0 1.000000 0.000000 0 0.000000 40.000000 /end COMPU_METHOD
/begin COMPU_METHOD NQ025_W "  Drehzahlquantisierung  0.250[Upm]" RAT_FUNC "%5.0" "Upm" COEFFS 0 1.000000 0.000000 0 0.000000 2.500000e-01 /end COMPU_METHOD
/begin COMPU_METHOD NQ1_W "  Drehzahlquantisierung  1.000[Upm]" RAT_FUNC "%4.0" "Upm" COEFFS 0 1.000000 0.000000 0 0.000000 1.000000 /end COMPU_METHOD
/begin COMPU_METHOD NQ25 "  Drehzahlquantisierung  25.00[Upm]" RAT_FUNC "%4.0" "Upm" COEFFS 0 1.000000 0.000000 0 0.000000 25.000000 /end COMPU_METHOD
/begin COMPU_METHOD NQ32 "  Drehzahlquantisierung  32.00[Upm]" RAT_FUNC "%4.0" "Upm" COEFFS 0 1.000000 0.000000 0 0.000000 32.000000 /end COMPU_METHOD
/begin COMPU_METHOD NQ40 "  Drehzahlquantisierung  40.00[Upm]" RAT_FUNC "%5.0" "Upm" COEFFS 0 1.000000 0.000000 0 0.000000 40.000000 /end COMPU_METHOD
/begin COMPU_METHOD NQ5 "  Drehzahlquantisierung  5.000[Upm]" RAT_FUNC "%4.0" "Upm" COEFFS 0 1.000000 0.000000 0 0.000000 5.000000 /end COMPU_METHOD
/begin COMPU_METHOD NZZEQL "Drehzahl in [upm] als Zahnzeit in  2.667[us]" RAT_FUNC "%7.2" "upm" COEFFS 0 0.000000 60.000000 0 1.546700e-04 0.000000 /end COMPU_METHOD
/begin COMPU_METHOD PAB77 "Umrechnung des Drucksensorwertes " RAT_FUNC "%6.3" "bar" COEFFS 0 7.698000 2.356000 0 0.000000 1.000000 /end COMPU_METHOD
/begin COMPU_METHOD PCENT "  Prozent" RAT_FUNC "%5.2" "%" COEFFS 0 256.000000 0.000000 0 0.000000 100.000000 /end COMPU_METHOD
/begin COMPU_METHOD PER0128 "percent" RAT_FUNC "%7.4" "%" COEFFS 0 327.670000 0.000000 0 0.000000 128.000000 /end COMPU_METHOD
/begin COMPU_METHOD PER0327 "percent" RAT_FUNC "%7.3" "%" COEFFS 0 327.670000 0.000000 0 0.000000 1.000000 /end COMPU_METHOD
/begin COMPU_METHOD PER0327LS "Prozentumrechnung mit  327.7[%/ms] signed-word quantisiert" RAT_FUNC "%7.3" "%/10ms" COEFFS 0 327.670000 0.000000 0 0.000000 1.000000 /end COMPU_METHOD
/begin COMPU_METHOD PER1 "percent" RAT_FUNC "%7.3" "%" COEFFS 0 1.000000 0.000000 0 0.000000 1.000000 /end COMPU_METHOD
/begin COMPU_METHOD PER1023 "  Umsetzung cts in Prozent" RAT_FUNC "%6.2" "%" COEFFS 0 1023.000000 0.000000 0 0.000000 100.000000 /end COMPU_METHOD
/begin COMPU_METHOD PER128S "Prozent, 8 Bit -100..99,21 80h=0" RAT_FUNC "%7.3" "%" COEFFS 0 128.000000 12800.000000 0 0.000000 100.000000 /end COMPU_METHOD
/begin COMPU_METHOD PER255 "percent" RAT_FUNC "%7.3" "%" COEFFS 0 255.000000 0.000000 0 0.000000 100.000000 /end COMPU_METHOD
/begin COMPU_METHOD PER25T10MS "Prozentumrechnung mit  5.120[%/ms] als signed" RAT_FUNC "%7.4" "%/10ms" COEFFS 0 5.119840 0.000000 0 0.000000 1.000000 /end COMPU_METHOD
/begin COMPU_METHOD PER_DKA "percent" RAT_FUNC "%7.3" "%" COEFFS 0 215.000000 0.000000 0 0.000000 100.000000 /end COMPU_METHOD
/begin COMPU_METHOD PHI1_10 "  Filterzeitkonstante fuer Tiefpass mit einer Zeitbasis von  10.00[ms]" TAB_INTP "%7.1" "ms" COMPU_TAB_REF PHI1_10 /end COMPU_METHOD
/begin COMPU_METHOD PHI1_100 "  Filterzeitkonstante fuer Tiefpass mit einer Zeitbasis von  100.0[ms]" TAB_INTP "%6.0" "ms" COMPU_TAB_REF PHI1_100 /end COMPU_METHOD
/begin COMPU_METHOD PHI1_40 "  Filterzeitkonstante fuer Tiefpass mit einer Zeitbasis von  40.00[ms]" TAB_INTP "%7.1" "ms" COMPU_TAB_REF PHI1_40 /end COMPU_METHOD
/begin COMPU_METHOD PHI1_50 "  Filterzeitkonstante fuer Tiefpass mit einer Zeitbasis von  50.00[ms]" TAB_INTP "%7.1" "ms" COMPU_TAB_REF PHI1_50 /end COMPU_METHOD
/begin COMPU_METHOD PHI1_SY "  Zuendungsabhaengige Filterkonstante mit  0.391 %/Zuendung. quantisiert" RAT_FUNC "%7.4" "% pro Zuendung" COEFFS 0 1.000000 0.000000 0 0.000000 3.906300e-01 /end COMPU_METHOD
/begin COMPU_METHOD R_UW_Q2 " Widerstand in 16-Bit-Hexwerten " RAT_FUNC "%6.0" " Ohm " COEFFS 0 1.000000 0.000000 0 0.000000 2.000000 /end COMPU_METHOD
/begin COMPU_METHOD SENSORB "8 BIT Sensorsignal" RAT_FUNC "%7.5" "V" COEFFS 0 256.000000 0.000000 0 0.000000 5.000000 /end COMPU_METHOD
/begin COMPU_METHOD SENSORW "16 BIT Sensorsignal" RAT_FUNC "%7.5" "V" COEFFS 0 6.553600e+04 0.000000 0 0.000000 5.000000 /end COMPU_METHOD
/begin COMPU_METHOD SPGG_Q0P52 "8Bit Umsetzung des Intervalles 0..132,6 mV/ms" RAT_FUNC "%5.1" "mV/ms" COEFFS 0 1.000000 0.000000 0 0.000000 5.200000e-01 /end COMPU_METHOD
/begin COMPU_METHOD TEQL "  Quantisierung von te, 16 Bit mit  0.267E-2[ms]" RAT_FUNC "%7.3" "ms" COEFFS 0 1.000000 0.000000 0 0.000000 2.666700e-03 /end COMPU_METHOD
/begin COMPU_METHOD TEQ_12L "  Quantisierung von te, 16 Bit mit 0.0320[ms] quantisiert" RAT_FUNC "%7.2" "ms" COEFFS 0 1.000000 0.000000 0 0.000000 3.200000e-02 /end COMPU_METHOD
/begin COMPU_METHOD TEQ_32 "  Quantisierung von tlw 8 Bit mit 0.0853[ms]" RAT_FUNC "%7.4" "ms" COEFFS 0 1.000000 0.000000 0 0.000000 8.533300e-02 /end COMPU_METHOD
/begin COMPU_METHOD TEQ_CPL "  Quantisierung von te, 16 Bitmit  0.267E-2[ms]" RAT_FUNC "%9.6" "ms" COEFFS 0 1.000000 0.000000 0 0.000000 2.666666e-03 /end COMPU_METHOD
/begin COMPU_METHOD TEVIQ "  Integratorzeitkonstante in [%/s]" RAT_FUNC "%6.4" "%/s" COEFFS 0 6.553600e+04 0.000000 0 0.000000 1000.000000 /end COMPU_METHOD
/begin COMPU_METHOD TMASK10 "Zeitmaske 10ms " TAB_NOINTP "%7.2" "ms" COMPU_TAB_REF TMASK10 /end COMPU_METHOD
/begin COMPU_METHOD TMP_10B "Motor-Temperatur 10-Bit (invers)" TAB_INTP "%7.3" "grad C" COMPU_TAB_REF TMP_10B /end COMPU_METHOD
/begin COMPU_METHOD TQ02L "  Zeitquantisierung mit 0.0002[s]" RAT_FUNC "%7.4" "sec" COEFFS 0 5000.000000 0.000000 0 0.000000 1.000000 /end COMPU_METHOD
/begin COMPU_METHOD TQ1 "Zeitquantisierung mit 1 [ms]" RAT_FUNC "%5.3" "sec" COEFFS 0 1000.000000 0.000000 0 0.000000 1.000000 /end COMPU_METHOD
/begin COMPU_METHOD TQ10 "  Zeitquantisierung mit 10[ms]" RAT_FUNC "%4.2" "sec" COEFFS 0 100.000000 0.000000 0 0.000000 1.000000 /end COMPU_METHOD
/begin COMPU_METHOD TQ100 "  Zeitquantisierung mit 100[ms]" RAT_FUNC "%4.1" "sec" COEFFS 0 10.000000 0.000000 0 0.000000 1.000000 /end COMPU_METHOD
/begin COMPU_METHOD TQ1000 "  Zeitquantisierung mit 1 [s]" RAT_FUNC "%7.3" "sec" COEFFS 0 1.000000 0.000000 0 0.000000 1.000000 /end COMPU_METHOD
/begin COMPU_METHOD TQ1000L "  Zeitquantisierung mit 1000[ms]" RAT_FUNC "%5.0" "sec" COEFFS 0 1.000000 0.000000 0 0.000000 1.000000 /end COMPU_METHOD
/begin COMPU_METHOD TQ100L "  Zeitquantisierung mit 100[ms]" RAT_FUNC "%7.2" "sec" COEFFS 0 10.000000 0.000000 0 0.000000 1.000000 /end COMPU_METHOD
/begin COMPU_METHOD TQ10L "  Zeitquantisierung mit 10[ms]" RAT_FUNC "%6.2" "sec" COEFFS 0 100.000000 0.000000 0 0.000000 1.000000 /end COMPU_METHOD
/begin COMPU_METHOD TQ10MSS "  Zeitquantisierung mit 10[ms] signed" RAT_FUNC "%5.3" "sec" COEFFS 0 100.000000 0.000000 0 0.000000 1.000000 /end COMPU_METHOD
/begin COMPU_METHOD TQ12MS5L "  Zeitquantisierung mit 12.5[ms]" RAT_FUNC "%9.5" "sec" COEFFS 0 1.000000 0.000000 0 0.000000 1.250000e-02 /end COMPU_METHOD
/begin COMPU_METHOD TQ1L "  Zeitquantisierung mit 1[ms]" RAT_FUNC "%6.3" "sec" COEFFS 0 1000.000000 0.000000 0 0.000000 1.000000 /end COMPU_METHOD
/begin COMPU_METHOD TQ20 "  Zeitquantisierung mit 20[ms]" RAT_FUNC "%5.3" "sec" COEFFS 0 50.000000 0.000000 0 0.000000 1.000000 /end COMPU_METHOD
/begin COMPU_METHOD TQ200 "  Zeitquantisierung mit 200[ms]" RAT_FUNC "%5.2" "sec" COEFFS 0 5.000000 0.000000 0 0.000000 1.000000 /end COMPU_METHOD
/begin COMPU_METHOD TQ200L "  Zeitquantisierung mit 200[ms]" RAT_FUNC "%7.1" "sec" COEFFS 0 5.000000 0.000000 0 0.000000 1.000000 /end COMPU_METHOD
/begin COMPU_METHOD TQ20L "  Zeitquantisierung mit 20[ms]" RAT_FUNC "%7.2" "sec" COEFFS 0 50.000000 0.000000 0 0.000000 1.000000 /end COMPU_METHOD
/begin COMPU_METHOD TQ40 "  Zeitquantisierung mit 40[ms]" RAT_FUNC "%5.2" "sec" COEFFS 0 25.000000 0.000000 0 0.000000 1.000000 /end COMPU_METHOD
/begin COMPU_METHOD TQ50 "  Zeitquantisierung mit 50[ms]" RAT_FUNC "%6.3" "sec" COEFFS 0 20.000000 0.000000 0 0.000000 1.000000 /end COMPU_METHOD
/begin COMPU_METHOD TQ50L "  Zeitquantisierung mit 50[ms]" RAT_FUNC "%9.4" "sec" COEFFS 0 20.000000 0.000000 0 0.000000 1.000000 /end COMPU_METHOD
/begin COMPU_METHOD TQ80 "  Zeitquantisierung mit 80[ms]" RAT_FUNC "%4.1" "sec" COEFFS 0 12.500000 0.000000 0 0.000000 1.000000 /end COMPU_METHOD
/begin COMPU_METHOD TQ800 "  Zeitquantisierung mit 0.8[sec]" RAT_FUNC "%7.3" "sec" COEFFS 0 1.250000 0.000000 0 0.000000 1.000000 /end COMPU_METHOD
/begin COMPU_METHOD TQT1 "  Zeitquantisierung mit [266.666 us]" RAT_FUNC "%6.3" "ms" COEFFS 0 1.000000 0.000000 0 0.000000 2.666700e-01 /end COMPU_METHOD
/begin COMPU_METHOD TTEVQL "  Quantisierung von Timer tev 16 Bit mit  0.533E-2 [ms]" RAT_FUNC "%7.3" "ms" COEFFS 0 1.000000 0.000000 0 0.000000 5.333300e-03 /end COMPU_METHOD
/begin COMPU_METHOD U0V_0V03 "8Bit Umsetzung des Spannungsintervalles 0..0,03V" RAT_FUNC "%6.5" "V" COEFFS 0 256.000000 0.000000 0 0.000000 3.000000e-02 /end COMPU_METHOD
/begin COMPU_METHOD U0V_1V25 "8Bit Umsetzung des Spannungsintervalles 0..1,245V" RAT_FUNC "%5.3" "V" COEFFS 0 256.000000 0.000000 0 0.000000 1.250000 /end COMPU_METHOD
/begin COMPU_METHOD U0V_1V33 "8Bit Umsetzung des Spannungsintervalles 0..1,33V" RAT_FUNC "%5.3" "V" COEFFS 0 255.000000 0.000000 0 0.000000 1.330000 /end COMPU_METHOD
/begin COMPU_METHOD U5V "  Batteriespannung mit 5V quantisiert" RAT_FUNC "%5.3" "V" COEFFS 0 255.000000 0.000000 0 0.000000 5.000000 /end COMPU_METHOD
/begin COMPU_METHOD UBQ "  Batteriespannung mit 0.0942[V] quantisiert" RAT_FUNC "%5.2" "V" COEFFS 0 1.000000 0.000000 0 0.000000 9.421700e-02 /end COMPU_METHOD
/begin COMPU_METHOD UDKL "Drosselklappenwinkel" RAT_FUNC "%7.4" "grad DK" COEFFS 0 3.276800e+04 0.000000 0 0.000000 80.916000 /end COMPU_METHOD
/begin COMPU_METHOD UDVER " D-Verstaerkung " RAT_FUNC "%9.7" " " COEFFS 0 273.058320 0.000000 0 0.000000 1.000000 /end COMPU_METHOD
/begin COMPU_METHOD UEBV_L "vn-Quotient, d.h. Geschwindigkeit bei 1000 U/min" RAT_FUNC "%8.4" "1 (km/h) / (1/min)" COEFFS 0 2.621440e+05 0.000000 0 0.000000 1000.000000 /end COMPU_METHOD
/begin COMPU_METHOD UFUELL "Umrechnung fuer Fuellungsgrad" RAT_FUNC "%7.3" "%" COEFFS 0 255.000000 0.000000 0 0.000000 191.250000 /end COMPU_METHOD
/begin COMPU_METHOD UGESCH4 "Umrechnung fuer Geschwindigkeiten mit  4.000 quantisiert" RAT_FUNC "%7.4" "km/h" COEFFS 0 4.000000 0.000000 0 0.000000 1.000000 /end COMPU_METHOD
/begin COMPU_METHOD ULSQL "  Lambdasonden-Spannung ohne Offset" RAT_FUNC "%7.5" "V" COEFFS 0 13107.000000 0.000000 0 0.000000 1.000000 /end COMPU_METHOD
/begin COMPU_METHOD UMFFTLC "  Filterzeitquantisierung fuer tlipfil_um in [ms] mit tlc_anz=  1.000 " RAT_FUNC "%5.0" "ms" COEFFS 0 0.000000 10240.000000 0 1.000000 40.000000 /end COMPU_METHOD
/begin COMPU_METHOD UMFNSC " Zeitquantisierung Ueberwachung nsc in [ms] mit nsc_anz=  1.000 " RAT_FUNC "%7.0" "ms" COEFFS 0 1.000000 0.000000 0 0.000000 40.000000 /end COMPU_METHOD
/begin COMPU_METHOD UMFREAC " Zeitquantisierung Ueberwachung reac in [ms] mit reac_anz=   1.000 " RAT_FUNC "%5.0" "ms" COEFFS 0 1.000000 0.000000 0 0.000000 40.000000 /end COMPU_METHOD
/begin COMPU_METHOD UMFSPSC " Fehlerzeitquantisierung in [ms] mit spsc_anz=   1.000 " RAT_FUNC "%5.0" "ms" COEFFS 0 1.000000 0.000000 0 0.000000 40.000000 /end COMPU_METHOD
/begin COMPU_METHOD UMFTLC " Zeitquantisierung Ueberwachung tlc in [ms] mit tlc_anz=  1.000 " RAT_FUNC "%5.0" "ms" COEFFS 0 1.000000 0.000000 0 0.000000 40.000000 /end COMPU_METHOD
/begin COMPU_METHOD UMFZWC "  Zeitquantisierung fuer zwc_t_um in [ms] mit zwc_anz=  1.000 " RAT_FUNC "%4.0" "ms" COEFFS 0 5.000000 0.000000 0 0.000000 40.000000 /end COMPU_METHOD
/begin COMPU_METHOD UPVER " P-Verstaerkung " RAT_FUNC "%9.6" "1/s " COEFFS 0 699.029300 0.000000 0 0.000000 1.000000 /end COMPU_METHOD
/begin COMPU_METHOD UPVER05 " P-Verstaerkung " RAT_FUNC "%7.5" "1/s " COEFFS 0 349.515000 0.000000 0 0.000000 1.000000 /end COMPU_METHOD
/begin COMPU_METHOD UPV_VMAXL "" RAT_FUNC "%6.0" "1/km/h" COEFFS 0 1.000000 0.000000 0 0.000000 4.000000 /end COMPU_METHOD
/begin COMPU_METHOD UTABG "Abgastemperatur" RAT_FUNC "%7.3" "grad C" COEFFS 0 1.000000 48.000000 0 0.000000 4.000000 /end COMPU_METHOD
/begin COMPU_METHOD UTL16K "TL Umrechnung (High-Byte)" RAT_FUNC "%7.3" "ms/kwu" COEFFS 0 1.000000 0.000000 0 0.000000 6.826700e-01 /end COMPU_METHOD
/begin COMPU_METHOD UTLIVER " I-Verstaerkung_4" RAT_FUNC "%7.1" "1/%/s " COEFFS 0 127.500000 0.000000 0 0.000000 25500.000000 /end COMPU_METHOD
/begin COMPU_METHOD UTL_NOK "  Lastnormierung Multiplikationsfaktor     11.65   " RAT_FUNC "%6.1" "" COEFFS 0 11.650900 0.000000 0 0.000000 1.000000 /end COMPU_METHOD
/begin COMPU_METHOD UTL_ST "  Quantisierung mit  2.731[ms/kwu]" RAT_FUNC "%5.1" "ms/kwu" COEFFS 0 2.000000 0.000000 0 0.000000 2.730670 /end COMPU_METHOD
/begin COMPU_METHOD UTMP_40 "  lineare Temperatur + Offset" RAT_FUNC "%6.2" "grd C" COEFFS 0 1.000000 40.000000 0 0.000000 1.000000 /end COMPU_METHOD
/begin COMPU_METHOD UTN9 " Zeitquantisierung mit 0.0833   [ms]" RAT_FUNC "%6.3" "ms " COEFFS 0 1.000000 0.000000 0 0.000000 8.333300e-02 /end COMPU_METHOD
/begin COMPU_METHOD UTNQ " Drehzahlquantisierung mit  0.167   [Upm]" RAT_FUNC "%9.3" "Upm " COEFFS 0 0.000000 15000.000000 0 1.666667e-01 0.000000 /end COMPU_METHOD
/begin COMPU_METHOD UTS "Umrechnung fuer Spannungskorrekturfaktor" RAT_FUNC "%7.4" "ms" COEFFS 0 1.000000 0.000000 0 0.000000 4.000000e-02 /end COMPU_METHOD
/begin COMPU_METHOD UTWKSL "  Zeitquantisierung mit 0.1000[sec]" RAT_FUNC "%6.1" "sec" COEFFS 0 1.000000 0.000000 0 0.000000 1.000000e-01 /end COMPU_METHOD
/begin COMPU_METHOD UWDK "Drosselklappenwinkel" RAT_FUNC "%7.4" "grad DK" COEFFS 0 256.000000 0.000000 0 0.000000 80.916000 /end COMPU_METHOD
/begin COMPU_METHOD UWKL10 "Drosselklappenwinkel" RAT_FUNC "%7.4" "grad DK" COEFFS 0 25.323000 0.000000 0 0.000000 1.000000 /end COMPU_METHOD
/begin COMPU_METHOD UWKL15 "Drosselklappenwinkel" RAT_FUNC "%7.4" "grad DK" COEFFS 0 16.876000 0.000000 0 0.000000 1.000000 /end COMPU_METHOD
/begin COMPU_METHOD UZK5SEC "Zeitkonstante für Integrator" RAT_FUNC "%7.5" "s" COEFFS 0 0.000000 5.120000 0 1.000000 0.000000 /end COMPU_METHOD
/begin COMPU_METHOD UZKFRA "  Zeitkonstante" RAT_FUNC "%6.2" "sec" COEFFS 0 0.000000 6553.600000 0 8.000000 0.000000 /end COMPU_METHOD
/begin COMPU_METHOD UZKFRM "  Zeitkonstante" RAT_FUNC "%6.3" "sec" COEFFS 0 0.000000 1310.720000 0 128.000000 0.000000 /end COMPU_METHOD
/begin COMPU_METHOD UZTABG " Zeitkonstante Abgastemperatur " RAT_FUNC "%9.5" "s" COEFFS 0 0.000000 256.000000 0 1.250000 1.000000 /end COMPU_METHOD
/begin COMPU_METHOD UZTKAT " Zeitkonstante Kat-Temperatur " RAT_FUNC "%9.5" "s" COEFFS 0 0.000000 256.000000 0 3.125000e-01 1.000000 /end COMPU_METHOD
/begin COMPU_METHOD U_A "  Beschleunigungsumrechnung" RAT_FUNC "%6.3" "m/(s*s)" COEFFS 0 1.000000 0.000000 0 0.000000 1.736100e-01 /end COMPU_METHOD
/begin COMPU_METHOD U_ZK "  Zeitkonstante" RAT_FUNC "%6.2" "sec" COEFFS 0 0.000000 6553.600000 0 21.845300 0.000000 /end COMPU_METHOD
/begin COMPU_METHOD VQV "  Fahrgeschwindigkeit mit Faktor  0.833 [km/h]" RAT_FUNC "%5.1" "km/h" COEFFS 0 8.333300e-01 0.000000 0 0.000000 1.000000 /end COMPU_METHOD
/begin COMPU_METHOD VQV16 "  Geschwindigkeitsumrechnung mit Faktor  16.00 [km/h]" RAT_FUNC "%5.2" "km/h" COEFFS 0 16.000000 0.000000 0 0.000000 1.000000 /end COMPU_METHOD
/begin COMPU_METHOD VQV16L "  Geschwindigkeitsumrechnung mit Faktor  16.00 [km/h]" RAT_FUNC "%6.1" "km/h" COEFFS 0 16.000000 0.000000 0 0.000000 1.000000 /end COMPU_METHOD
/begin COMPU_METHOD WQ720 "  Kurbelwellenwinkel-Quantisierung mit  2.813 [grad KW] quantisiert" RAT_FUNC "%5.1" "grad KW" COEFFS 0 1.000000 0.000000 0 0.000000 2.812500 /end COMPU_METHOD
/begin COMPU_METHOD ZINT_100 "  Integratorzeitkonstante in [%/100ms]" RAT_FUNC "%6.3" "%/100ms" COEFFS 0 256.000000 0.000000 0 0.000000 100.000000 /end COMPU_METHOD
/begin COMPU_METHOD ZK100MSXSL "Zeitkonstante für DHLS" RAT_FUNC "%7.2" "s" COEFFS 0 0.000000 6.553600e+04 0 10.000000 0.000000 /end COMPU_METHOD
/begin COMPU_METHOD ZQ50 " Zeitkonstante für Tiefpass mit 50[ms]" RAT_FUNC "%6.3" "sec" COEFFS 0 0.000000 128.000000 0 10.000000 0.000000 /end COMPU_METHOD
/begin COMPU_METHOD ZWNEG "  Zuendwinkelverstellung nach frueh mit -0.750[grad KW] quantisiert" RAT_FUNC "%5.2" "grad KW" COEFFS 0 1.000000 0.000000 0 0.000000 -7.500000e-01 /end COMPU_METHOD
/begin COMPU_METHOD ZWOF "  Zuendwinkel mit Offset" RAT_FUNC "%6.3" "grad KW" COEFFS 0 1.000000 78.000000 0 0.000000 7.500000e-01 /end COMPU_METHOD
/begin COMPU_METHOD ZWQ "  Zuendwinkel ohne Offset mit  0.750[grad KW] quantisiert" RAT_FUNC "%6.2" "grad KW" COEFFS 0 1.000000 0.000000 0 0.000000 7.500000e-01 /end COMPU_METHOD
/begin COMPU_METHOD ZZEQL "Zahnzeit Erfassung in  2.667[us]" RAT_FUNC "%6.0" "us" COEFFS 0 1.000000 0.000000 0 0.000000 2.666670 /end COMPU_METHOD
/begin COMPU_METHOD NoCompuMethod "" RAT_FUNC "%4.0" "" COEFFS 0 1 0 0 0 1 /end COMPU_METHOD
/begin COMPU_TAB BCD "" TAB_NOINTP 34 0 0.000000 1 1.000000 2 2.000000 3 3.000000 4 4.000000 5 5.000000 6 6.000000 7 7.000000 8 8.000000 9 9.000000 16 10.000000 17 11.000000 18 12.000000 19 13.000000 20 14.000000 21 15.000000 22 16.000000 23 17.000000 24 18.000000 25 19.000000 32 20.000000 33 21.000000 34 22.000000 35 23.000000 36 24.000000 37 25.000000 38 26.000000 39 27.000000 40 28.000000 41 29.000000 48 30.000000 49 31.000000 152 98.000000 153 99.000000 /end COMPU_TAB
/begin COMPU_TAB BOOLEAN "" TAB_NOINTP 2 37 1.000000 218 0.000000 /end COMPU_TAB
/begin COMPU_TAB CLU_TMP "" TAB_INTP 41 3 -50.000000 4 -45.000000 5 -40.000000 7 -35.000000 10 -30.000000 13 -25.000000 16 -20.000000 21 -15.000000 26 -10.000000 32 -5.000000 38 0.000000 46 5.000000 55 10.000000 64 15.000000 74 20.000000 84 25.000000 95 30.000000 106 35.000000 117 40.000000 128 45.000000 139 50.000000 149 55.000000 158 60.000000 167 65.000000 175 70.000000 183 75.000000 190 80.000000 196 85.000000 202 90.000000 207 95.000000 212 100.000000 216 105.000000 220 110.000000 223 115.000000 226 120.000000 229 125.000000 231 130.000000 233 135.000000 235 140.000000 237 145.000000 239 150.000000 /end COMPU_TAB
/begin COMPU_TAB CMO_TMP "" TAB_INTP 21 0 -41.000000 5 -40.000000 9 -30.000000 15 -20.150000 24 -10.120000 36 -0.140000 53 9.940000 73 19.980000 84 24.980000 95 30.020000 118 39.970000 141 49.980000 162 60.000000 180 70.080000 195 80.030000 207 90.000000 217 99.960000 225 109.910000 231 120.250000 236 129.640000 255 140.000000 /end COMPU_TAB
/begin COMPU_TAB PHI1_10 "" TAB_INTP 35 0 10000.000000 1 2555.000000 2 1279.000000 3 848.300050 4 634.900020 5 506.899990 6 421.600010 7 360.600010 8 314.899990 9 279.399990 10 250.900010 11 227.700010 12 208.200000 13 191.800000 14 177.800000 15 165.599990 16 154.899990 20 122.900000 25 97.299995 30 80.200005 35 68.000000 40 58.800003 50 46.000000 60 37.400002 70 31.300001 80 26.700001 100 20.200001 120 15.800000 140 12.630000 162 10.000000 180 8.230000 200 6.580000 220 5.090000 240 3.600000 255 1.803000 /end COMPU_TAB
/begin COMPU_TAB PHI1_100 "" TAB_INTP 35 0 100000.000000 1 25550.000000 2 12790.000000 3 8483.000000 4 6349.000000 5 5069.000000 6 4216.000000 7 3606.000200 8 3149.000000 9 2794.000000 10 2509.000000 11 2277.000000 12 2082.000000 13 1918.000000 14 1778.000100 15 1656.000000 16 1549.000000 20 1229.000000 25 972.999940 30 802.000060 35 680.000000 40 588.000000 50 460.000000 60 374.000000 70 313.000000 80 267.000000 100 202.000000 120 158.000000 140 126.300000 162 100.000000 180 82.300003 200 65.800003 220 50.900002 240 36.000000 255 18.030001 /end COMPU_TAB
/begin COMPU_TAB PHI1_40 "" TAB_INTP 35 0 40000.000000 1 10220.000000 2 5116.000000 3 3393.200200 4 2539.600100 5 2027.600000 6 1686.400000 7 1442.400000 8 1259.600000 9 1117.600000 10 1003.600000 11 910.800050 12 832.799990 13 767.200010 14 711.200010 15 662.399960 16 619.599980 20 491.600010 25 389.199980 30 320.800020 35 272.000000 40 235.200010 50 184.000000 60 149.600010 70 125.200000 80 106.800000 100 80.800003 120 63.200001 140 50.520000 162 40.000000 180 32.920002 200 26.320000 220 20.360001 240 14.400001 255 7.212000 /end COMPU_TAB
/begin COMPU_TAB PHI1_50 "" TAB_INTP 35 0 50000.000000 1 12775.000000 2 6395.000000 3 4241.500000 4 3174.500000 5 2534.500000 6 2108.000000 7 1803.000100 8 1574.500000 9 1397.000000 10 1254.500000 11 1138.500000 12 1041.000000 13 959.000000 14 889.000060 15 828.000000 16 774.500000 20 614.500000 25 486.499970 30 401.000030 35 340.000000 40 294.000000 50 230.000000 60 187.000000 70 156.500000 80 133.500000 100 101.000000 120 79.000000 140 63.150002 162 50.000000 180 41.150002 200 32.900002 220 25.450001 240 18.000000 255 9.015000 /end COMPU_TAB
/begin COMPU_TAB TMASK10 "" TAB_NOINTP 9 0 10.240000 1 20.480000 3 40.960000 7 81.920000 15 163.840000 31 327.680000 63 655.360000 127 1310.720000 255 2621.440000 /end COMPU_TAB
/begin COMPU_TAB TMP_10B "" TAB_INTP 21 18 -41.000000 20 -40.000000 35 -30.000000 59 -20.000000 95 -10.000000 146 0.000000 212 10.000000 291 20.000000 335 25.000000 381 30.000000 475 40.000000 566 50.000000 649 60.000000 721 70.000000 782 80.000000 831 90.000000 870 100.000000 901 110.000000 925 120.000000 944 130.000000 965 140.000000 /end COMPU_TAB
/begin MEASUREMENT AVKATF "Amplitudenverhaeltnis laafh/laafv" UBYTE FKT256 0 0 0.000000 0.996090 ECU_ADDRESS 0x218C BIT_MASK 0xFF /end MEASUREMENT
/begin MEASUREMENT DKVRESI "Pseudosource" UBYTE PER255 0 0 0.000000 100.000000 ECU_ADDRESS 0x59D BIT_MASK 0xFF /end MEASUREMENT
/begin MEASUREMENT DN_5U "Drehzahldifferenz nist_1u-nsoll_1u in 5U/min" UBYTE NQ5 0 0 0.000000 1275.000000 ECU_ADDRESS 0x6B9 BIT_MASK 0xFF /end MEASUREMENT
/begin MEASUREMENT DZW_UM "Zuendwinkeldifferenz fuer Ueberwachung " UBYTE ZWQ 0 0 0.000000 191.250000 ECU_ADDRESS 0xE00E BIT_MASK 0xFF /end MEASUREMENT
/begin MEASUREMENT FMDIASR "Relative Momentenreduktion" UBYTE PER255 0 0 0.000000 100.000000 ECU_ADDRESS 0x572 BIT_MASK 0xFF /end MEASUREMENT
/begin MEASUREMENT FMDINDS "Relative Momentenreduktion" UBYTE PER255 0 0 0.000000 100.000000 ECU_ADDRESS 0x582 BIT_MASK 0xFF /end MEASUREMENT
/begin MEASUREMENT IDLASHKM "Lambda Regelung hinter KAT" UBYTE U0V_0V03 0 0 0.000000 0.029883 ECU_ADDRESS 0x3C5 BIT_MASK 0xFF /end MEASUREMENT
/begin MEASUREMENT IDPHLSNF "" UBYTE FKT0001 0 0 0.000000 2.560000 ECU_ADDRESS 0x6A4 BIT_MASK 0xFF /end MEASUREMENT
/begin MEASUREMENT IDWZWK "Zündwinkeldifferenz" UBYTE ZWQ 0 0 0.000000 191.250000 ECU_ADDRESS 0x58E BIT_MASK 0xFF /end MEASUREMENT
/begin MEASUREMENT IN_SRC "Pseudosource fuer KFMDNS" UBYTE NQ40 0 0 0.000000 10200.000000 ECU_ADDRESS 0x5A3 BIT_MASK 0xFF /end MEASUREMENT
/begin MEASUREMENT IPSN_UM "normiertes aktuelles Istwertsignal" UBYTE PER_DKA 0 0 0.000000 100.000000 ECU_ADDRESS 0xE00D BIT_MASK 0xFF /end MEASUREMENT
/begin MEASUREMENT IR0 "Dummy   " UBYTE DEZ 0 0 0.000000 256.000000 ECU_ADDRESS 0x289 BIT_MASK 0xFF /end MEASUREMENT
/begin MEASUREMENT IUSHKB "Lambda Regelung hinter KAT" UBYTE U0V_1V25 0 0 0.000000 1.245120 ECU_ADDRESS 0x3C4 BIT_MASK 0xFF /end MEASUREMENT
/begin MEASUREMENT MDACCGR "Aenderung Momentenanforderung ACC" UBYTE DPCENT 0 0 -25.000000 24.804700 ECU_ADDRESS 0x5CC BIT_MASK 0xFF /end MEASUREMENT
/begin MEASUREMENT MDACCKOR "Moment von ACC (Kor.)" UBYTE MMQ 0 0 0.000000 512.000000 ECU_ADDRESS 0x5CB BIT_MASK 0xFF /end MEASUREMENT
/begin MEASUREMENT MDACC_MMQ "Moment von ACC" UBYTE MMQ 0 0 0.000000 512.000000 ECU_ADDRESS 0x5D0 BIT_MASK 0xFF /end MEASUREMENT
/begin MEASUREMENT MDASRLGR "Aenderung Momentenanforderung ASR langsam" UBYTE DMMQ 0 0 -32.000000 31.750000 ECU_ADDRESS 0x569 BIT_MASK 0xFF /end MEASUREMENT
/begin MEASUREMENT MDASRLKOR "Moment von ASR (Kor.)" UBYTE MMQ 0 0 0.000000 512.000000 ECU_ADDRESS 0x568 BIT_MASK 0xFF /end MEASUREMENT
/begin MEASUREMENT MDEGSGRD "Aenderung Momentenanforderung" UBYTE DMMQ 0 0 -32.000000 31.750000 ECU_ADDRESS 0x5C2 BIT_MASK 0xFF /end MEASUREMENT
/begin MEASUREMENT MDEGSKOR "Moment von EGS (Kor.)" UBYTE MMQ 0 0 0.000000 512.000000 ECU_ADDRESS 0x5C1 BIT_MASK 0xFF /end MEASUREMENT
/begin MEASUREMENT MDEGSST "Moment von EGS bei Start Schaltphase" UBYTE MMQ 0 0 0.000000 512.000000 ECU_ADDRESS 0x5C0 BIT_MASK 0xFF /end MEASUREMENT
/begin MEASUREMENT MDMAXI "Pseudosource" UBYTE MMQ 0 0 0.000000 512.000000 ECU_ADDRESS 0x603 BIT_MASK 0xFF /end MEASUREMENT
/begin MEASUREMENT MDMSRGR "Aenderung Momentenanforderung MSR" UBYTE DMMQ 0 0 -32.000000 31.750000 ECU_ADDRESS 0x567 BIT_MASK 0xFF /end MEASUREMENT
/begin MEASUREMENT MDMSRKOR "Moment von MSR (Kor.)" UBYTE MMQ 0 0 0.000000 512.000000 ECU_ADDRESS 0x566 BIT_MASK 0xFF /end MEASUREMENT
/begin MEASUREMENT SW8X "Source von inverser Pedalkennlinie fuer FU" UBYTE PER255 0 0 0.000000 100.000000 ECU_ADDRESS 0x55C BIT_MASK 0xFF /end MEASUREMENT
/begin MEASUREMENT SWNL "Nachlauf-Sollwert-Source " UBYTE PER255 0 0 0.000000 100.000000 ECU_ADDRESS 0xF73D BIT_MASK 0xFF /end MEASUREMENT
/begin MEASUREMENT SW_ACC8 "DK-Sollwert von ACC" UBYTE PER255 0 0 0.000000 100.000000 ECU_ADDRESS 0x5D2 BIT_MASK 0xFF /end MEASUREMENT
/begin MEASUREMENT SW_EGS8 "DK-Sollwert von EGS" UBYTE PER255 0 0 0.000000 100.000000 ECU_ADDRESS 0x5AE BIT_MASK 0xFF /end MEASUREMENT
/begin MEASUREMENT TL8I "Pseudosource " UBYTE UFUELL 0 0 0.000000 191.250000 ECU_ADDRESS 0x59A BIT_MASK 0xFF /end MEASUREMENT
/begin MEASUREMENT TL8TC "Last aus Pedalposition " UBYTE UFUELL 0 0 0.000000 191.250000 ECU_ADDRESS 0x58F BIT_MASK 0xFF /end MEASUREMENT
/begin MEASUREMENT TL8_UM "normiertes Lastsignal " UBYTE UFUELL 0 0 0.000000 191.250000 ECU_ADDRESS 0xE006 BIT_MASK 0xFF /end MEASUREMENT
/begin MEASUREMENT TLR8 "Last ungefiltert" UBYTE UFUELL 0 0 0.000000 191.250000 ECU_ADDRESS 0xF74C BIT_MASK 0xFF /end MEASUREMENT
/begin MEASUREMENT TL_DK_ "DK-Source normiert mit [TEQ_32]" UBYTE TEQ_32 0 0 0.000000 21.760000 ECU_ADDRESS 0xF736 BIT_MASK 0xFF /end MEASUREMENT
/begin MEASUREMENT ZYLNUM "Zylindernummer (Dummy)" UBYTE DEZZYL 0 0 0.000000 5.000000 ECU_ADDRESS 0x294 BIT_MASK 0xFF /end MEASUREMENT
/begin MEASUREMENT ZZKHHI "Zuendungszaehlersource Highbyte " UBYTE DIV256 0 0 0.000000 65280.000000 ECU_ADDRESS 0x29B BIT_MASK 0xFF /end MEASUREMENT
/begin MEASUREMENT ABAKN_R "Interpolierter Faktor aus Kennlinie ABAKN" UBYTE FKT256 0 0 0.000000 0.996090 ECU_ADDRESS 0xF8EE BIT_MASK 0xFF /end MEASUREMENT
/begin MEASUREMENT ACCC_C_UC " DA Entprellzaehler in ACC" UBYTE DEZ 0 0 0.000000 256.000000 ECU_ADDRESS 0xE0C4 BIT_MASK 0xFF /end MEASUREMENT
/begin MEASUREMENT ACCC_C_UR " DA Entprellzaehler in ACC" UBYTE DEZ 0 0 0.000000 256.000000 ECU_ADDRESS 0xB1819 BIT_MASK 0xFF /end MEASUREMENT
/begin MEASUREMENT ACCNU_C_UC " DA Entprellzaehler in ACC" UBYTE DEZ 0 0 0.000000 256.000000 ECU_ADDRESS 0xE0C5 BIT_MASK 0xFF /end MEASUREMENT
/begin MEASUREMENT ACCNU_C_UR " DA Entprellzaehler in ACC" UBYTE DEZ 0 0 0.000000 256.000000 ECU_ADDRESS 0xB181A BIT_MASK 0xFF /end MEASUREMENT
/begin MEASUREMENT ACC_CNT " BotschaftszaehlerACC fuer UM" UBYTE DEZ 0 0 0.000000 256.000000 ECU_ADDRESS 0xB05FB BIT_MASK 0xFF /end MEASUREMENT
/begin MEASUREMENT ACC_CNT_A "alter Wert BotschaftszaehlerACC" UBYTE DEZ 0 0 0.000000 256.000000 ECU_ADDRESS 0xB05FC BIT_MASK 0xFF /end MEASUREMENT
/begin MEASUREMENT ACC_STS " ACCStatus" UBYTE DEZ 0 0 0.000000 256.000000 ECU_ADDRESS 0xB05FD BIT_MASK 0xFF /end MEASUREMENT
/begin MEASUREMENT AC_IP " Analogeingang Klimaanlage Sensor" UBYTE DEZ 0 0 0.000000 256.000000 ECU_ADDRESS 0xB213C BIT_MASK 0xFF /end MEASUREMENT
/begin MEASUREMENT ADAP_RESET " Adaptionswerte löschen " UBYTE DEZ 0 0 0.000000 256.000000 ECU_ADDRESS 0xB2941 BIT_MASK 0xFF /end MEASUREMENT
/begin MEASUREMENT ADCC_C_UR " Byte fuer DA adcc_c_um" UBYTE DEZ 0 0 0.000000 256.000000 ECU_ADDRESS 0xB17EC BIT_MASK 0xFF /end MEASUREMENT
/begin MEASUREMENT ADC_IHFM " HFM-Signal am ADC-Kanal" UWORD DEZL 0 0 0.000000 65535.000000 ECU_ADDRESS 0xF8D2 BIT_MASK 0xFFFF /end MEASUREMENT
/begin MEASUREMENT AFTLMN "Aussetzerfenster, min. Last" UBYTE UFUELL 0 0 0.000000 191.250000 ECU_ADDRESS 0xB2222 BIT_MASK 0xFF /end MEASUREMENT
/begin MEASUREMENT AFTLMX "Aussetzerfenster, max. Last" UBYTE UFUELL 0 0 0.000000 191.250000 ECU_ADDRESS 0xB2223 BIT_MASK 0xFF /end MEASUREMENT
/begin MEASUREMENT AFTTLMN "Aussetzerfenster temporaer, min. Last" UBYTE UFUELL 0 0 0.000000 191.250000 ECU_ADDRESS 0xB0A10 BIT_MASK 0xFF /end MEASUREMENT
/begin MEASUREMENT AFTTLMX "Aussetzerfenster temporaer, max. Last" UBYTE UFUELL 0 0 0.000000 191.250000 ECU_ADDRESS 0xB0A11 BIT_MASK 0xFF /end MEASUREMENT
/begin MEASUREMENT AHKAT2_U16 "DKATAW2: Zwischenwert fuer AHKAT" UWORD DEZL 0 0 0.000000 65535.000000 ECU_ADDRESS 0xB08C4 BIT_MASK 0xFFFF /end MEASUREMENT
/begin MEASUREMENT AHKATN2 "Ampl. Sondensp. kinter Kat normiert Bank2" UBYTE FKT256 0 0 0.000000 0.996090 ECU_ADDRESS 0xB0877 BIT_MASK 0xFF /end MEASUREMENT
/begin MEASUREMENT AHKAT_U16 "DKATAW1: Zwischenwert fuer AHKAT" UWORD DEZL 0 0 0.000000 65535.000000 ECU_ADDRESS 0xB08C2 BIT_MASK 0xFFFF /end MEASUREMENT
/begin MEASUREMENT AHKTKI2ULH "DKATAW2: Integrator- Zwischenwert" UWORD DEZL 0 0 0.000000 65535.000000 ECU_ADDRESS 0xB0000 BIT_MASK 0xFFFF /end MEASUREMENT
/begin MEASUREMENT AHKTKI2_W "DKATAW2: Integrator2 Output Bank2" UWORD TQ12MS5L 0 0 0.000000 819.188000 ECU_ADDRESS 0xB08A0 BIT_MASK 0xFFFF /end MEASUREMENT
/begin MEASUREMENT AHKTKI_ULH "DKATAW1: Integrator- Zwischenwert" UWORD DEZL 0 0 0.000000 65535.000000 ECU_ADDRESS 0xB0000 BIT_MASK 0xFFFF /end MEASUREMENT
/begin MEASUREMENT AHKTKI_W "DKATAW1: Integrator1 Output Bank1" UWORD TQ12MS5L 0 0 0.000000 819.188000 ECU_ADDRESS 0xB089E BIT_MASK 0xFFFF /end MEASUREMENT
/end MODULE
/end PROJECT
