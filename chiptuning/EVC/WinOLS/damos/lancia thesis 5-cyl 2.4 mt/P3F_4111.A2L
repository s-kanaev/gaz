ASAP2_VERSION 1 3
/begin PROJECT _ " [ME.ME3.1C.09.4111.DAMOS25]  DAMPAR_04"
/begin HEADER "Lancia Thesis 5-Zyl. 2,4 MT" PROJECT_NO 411.1 VERSION "P2FJGD66" /end HEADER
/begin MODULE DIM " "
/begin MOD_COMMON " " S_REC_LAYOUT DAMOS DEPOSIT ABSOLUTE BYTE_ORDER MSB_LAST /end MOD_COMMON
/begin RECORD_LAYOUT DAMOS_FW1 FNC_VALUES 1 UBYTE COLUMN_DIR DIRECT /end RECORD_LAYOUT
/begin RECORD_LAYOUT DAMOS_FW3 FNC_VALUES 1 UWORD COLUMN_DIR DIRECT /end RECORD_LAYOUT
/begin RECORD_LAYOUT DAMOS_GKL1 FNC_VALUES 1 UBYTE COLUMN_DIR DIRECT /end RECORD_LAYOUT
/begin RECORD_LAYOUT DAMOS_FW2 FNC_VALUES 1 SBYTE COLUMN_DIR DIRECT /end RECORD_LAYOUT
/begin RECORD_LAYOUT DAMOS_KL97 SRC_ADDR_X 1 UWORD NO_AXIS_PTS_X 2 UBYTE AXIS_PTS_X 3 UBYTE INDEX_INCR DIRECT FNC_VALUES 4 UBYTE COLUMN_DIR DIRECT /end RECORD_LAYOUT
/begin RECORD_LAYOUT DAMOS_FKL1 FNC_VALUES 1 UBYTE COLUMN_DIR DIRECT /end RECORD_LAYOUT
/begin RECORD_LAYOUT DAMOS_FKL3 FNC_VALUES 1 UWORD COLUMN_DIR DIRECT /end RECORD_LAYOUT
/begin RECORD_LAYOUT DAMOS_ASCII FNC_VALUES 1 UBYTE COLUMN_DIR DIRECT /end RECORD_LAYOUT
/begin RECORD_LAYOUT DAMOS_FWB3 FNC_VALUES 1 UWORD COLUMN_DIR DIRECT /end RECORD_LAYOUT
/begin CHARACTERISTIC CLAHSV "Fehlerklasse: Endstufen-Diagnosebits Sondenheizer v.  Kat" VALUE 0x889F DAMOS_FW1 0 DEZ 0.000000 256.000000 /end CHARACTERISTIC
/begin CHARACTERISTIC CLAHSVE "Fehlerklasse: Endstufen-Diagnosebits Sondenheizer v.  Kat" VALUE 0x88A1 DAMOS_FW1 0 DEZ 0.000000 256.000000 /end CHARACTERISTIC
/begin CHARACTERISTIC CLAIPDK "Fehlerklasse: Diagnose-Bits Istwertpoti" VALUE 0x887A DAMOS_FW1 0 DEZ 0.000000 256.000000 /end CHARACTERISTIC
/begin CHARACTERISTIC CLAKAT1 "Fehlerklasse: Diagnose Katalysatorkonvertierung, Bank1" VALUE 0x88A6 DAMOS_FW1 0 DEZ 0.000000 256.000000 /end CHARACTERISTIC
/begin CHARACTERISTIC CLAKOSE "Fehlerklasse: Endstufen-Diagnosebits fuer Klimakompressor" VALUE 0x888C DAMOS_FW1 0 DEZ 0.000000 256.000000 /end CHARACTERISTIC
/begin CHARACTERISTIC CLAKRHW "Fehlerklasse: Diagnosebits KR - HW - Test       B2_BI" VALUE 0x8880 DAMOS_FW1 0 DEZ 0.000000 256.000000 /end CHARACTERISTIC
/begin CHARACTERISTIC CLAKRS1 "Fehlerklasse: Diagnosebits KR - Sensor1 - Abfall" VALUE 0x8881 DAMOS_FW1 0 DEZ 0.000000 256.000000 /end CHARACTERISTIC
/begin CHARACTERISTIC CLAKRS2 "Fehlerklasse: Diagnosebits KR - Sensor2 - Abfall" VALUE 0x8882 DAMOS_FW1 0 DEZ 0.000000 256.000000 /end CHARACTERISTIC
/begin CHARACTERISTIC CLAKUPPL "Fehlerklasse: Diagnose EGS-SG schaltet Motronic ab" VALUE 0x88AF DAMOS_FW1 0 DEZ 0.000000 256.000000 /end CHARACTERISTIC
/begin CHARACTERISTIC CLALASH1 "Fehlerklasse: Diagnose Lambdasonden-Alterung hinter Kat" VALUE 0x889E DAMOS_FW1 0 DEZ 0.000000 256.000000 /end CHARACTERISTIC
/begin CHARACTERISTIC CLALATP1 "Fehlerklasse: Diagnose Lambdasonden-Alterung TP" VALUE 0x889C DAMOS_FW1 0 DEZ 0.000000 256.000000 /end CHARACTERISTIC
/begin CHARACTERISTIC CLALATV1 "Fehlerklasse: Diagnose Lambdasonden-Alterung TV" VALUE 0x889D DAMOS_FW1 0 DEZ 0.000000 256.000000 /end CHARACTERISTIC
/begin CHARACTERISTIC CLALFR "Fehlerklasse: LFR-Diagnose" VALUE 0x887F DAMOS_FW1 0 DEZ 0.000000 256.000000 /end CHARACTERISTIC
/begin CHARACTERISTIC CLALSH1 "Fehlerklasse: Diagnose vertauschte Lambdasonden vor Kat (Index 41)" VALUE 0x889B DAMOS_FW1 0 DEZ 0.000000 256.000000 /end CHARACTERISTIC
/begin CHARACTERISTIC CLALSV1 "Fehlerklasse: Diagnosebits Lambdasondendiagn. vor Kat Bank1" VALUE 0x889A DAMOS_FW1 0 DEZ 0.000000 256.000000 /end CHARACTERISTIC
/begin CHARACTERISTIC CLALUES1 "Fehlerklasse: Endstufen-Diagnosebits fuer Luefter Stufe 1" VALUE 0x8884 DAMOS_FW1 0 DEZ 0.000000 256.000000 /end CHARACTERISTIC
/begin CHARACTERISTIC CLALUES2 "Fehlerklasse: Endstufen-Diagnosebits fuer Luefter Stufe 2" VALUE 0x8885 DAMOS_FW1 0 DEZ 0.000000 256.000000 /end CHARACTERISTIC
/begin CHARACTERISTIC CLAMD "Fehlerklasse: Diagnose Aussetzererkennung gesamt" VALUE 0x8894 DAMOS_FW1 0 DEZ 0.000000 256.000000 /end CHARACTERISTIC
/begin CHARACTERISTIC CLAMD1 "Fehlerklasse: Diagnose Aussetzererkennung Zyl. 1" VALUE 0x8895 DAMOS_FW1 0 DEZ 0.000000 256.000000 /end CHARACTERISTIC
/begin CHARACTERISTIC CLAMD2 "Fehlerklasse: Diagnose Aussetzererkennung Zyl. 2" VALUE 0x8896 DAMOS_FW1 0 DEZ 0.000000 256.000000 /end CHARACTERISTIC
/begin CHARACTERISTIC CLAMD3 "Fehlerklasse: Diagnose Aussetzererkennung Zyl. 3" VALUE 0x8897 DAMOS_FW1 0 DEZ 0.000000 256.000000 /end CHARACTERISTIC
/begin CHARACTERISTIC CLAMD4 "Fehlerklasse: Diagnose Aussetzererkennung Zyl. 4" VALUE 0x8898 DAMOS_FW1 0 DEZ 0.000000 256.000000 /end CHARACTERISTIC
/begin CHARACTERISTIC CLAMD5 "Fehlerklasse: Diagnose Aussetzererkennung Zyl. 5" VALUE 0x8899 DAMOS_FW1 0 DEZ 0.000000 256.000000 /end CHARACTERISTIC
/begin CHARACTERISTIC CLAMILFB "Fehlerklasse: Diagnose Mil fremdbestimmt" VALUE 0x88AE DAMOS_FW1 0 DEZ 0.000000 256.000000 /end CHARACTERISTIC
/begin CHARACTERISTIC CLANWSE "Fehlerklasse: Endstufendiagnose-Bits NWS" VALUE 0x8890 DAMOS_FW1 0 DEZ 0.000000 256.000000 /end CHARACTERISTIC
/begin CHARACTERISTIC CLAPAC "Fehlerklasse: Diagnose Klimadrucksensor" VALUE 0x88B1 DAMOS_FW1 0 DEZ 0.000000 256.000000 /end CHARACTERISTIC
/begin CHARACTERISTIC CLAPEDST "Fehlerklasse: Diagnose Bits Pedalanschlag" VALUE 0x887C DAMOS_FW1 0 DEZ 0.000000 256.000000 /end CHARACTERISTIC
/begin CHARACTERISTIC CLAPH "Fehlerklasse: Diagnosebits Phasensensor" VALUE 0x8876 DAMOS_FW1 0 DEZ 0.000000 256.000000 /end CHARACTERISTIC
/begin CHARACTERISTIC CLAPMOEL " " VALUE 0x8878 DAMOS_FW1 0 DEZ 0.000000 256.000000 /end CHARACTERISTIC
/begin CHARACTERISTIC CLAPWG "Fehlerklasse: Diagnose-Bits PWG" VALUE 0x887B DAMOS_FW1 0 DEZ 0.000000 256.000000 /end CHARACTERISTIC
/begin CHARACTERISTIC CLARSKA "Fehlerklasse: Diagnose reversible Sicherheitskraftstoffabschalten" VALUE 0x887D DAMOS_FW1 0 DEZ 0.000000 256.000000 /end CHARACTERISTIC
/begin CHARACTERISTIC CLASKAUM "Fehlerklasse: Diagnose Sicherheitskraftstoffab. von Ueberwachungsfkt." VALUE 0x887E DAMOS_FW1 0 DEZ 0.000000 256.000000 /end CHARACTERISTIC
/begin CHARACTERISTIC CLASUE "Fehlerklasse: Endstufendiagnose-Bits Saugrohrumschaltung" VALUE 0x888F DAMOS_FW1 0 DEZ 0.000000 256.000000 /end CHARACTERISTIC
/begin CHARACTERISTIC CLASWE "Fehlerklasse: Schlechtwegerkennung" VALUE 0x88AA DAMOS_FW1 0 DEZ 0.000000 256.000000 /end CHARACTERISTIC
/begin CHARACTERISTIC CLATEVE "Fehlerklasse: Endstufendiagnose-Bits TEV" VALUE 0x888B DAMOS_FW1 0 DEZ 0.000000 256.000000 /end CHARACTERISTIC
/begin CHARACTERISTIC CLATFA "Fehlerklasse: Diagnosebits Ansauglufttemperaturfuehler" VALUE 0x8873 DAMOS_FW1 0 DEZ 0.000000 256.000000 /end CHARACTERISTIC
/begin CHARACTERISTIC CLATFM "Fehlerklasse: Diagnosebits Motortemperaturfuehler" VALUE 0x8872 DAMOS_FW1 0 DEZ 0.000000 256.000000 /end CHARACTERISTIC
/begin CHARACTERISTIC CLATRA1 "Fehlerklasse: LR-Adaption QL-additiv, Bank1" VALUE 0x88A7 DAMOS_FW1 0 DEZ 0.000000 256.000000 /end CHARACTERISTIC
/begin CHARACTERISTIC CLAUB "Fehlerklasse: Diagnosebits Batteriespannung" VALUE 0x8877 DAMOS_FW1 0 DEZ 0.000000 256.000000 /end CHARACTERISTIC
/begin CHARACTERISTIC CLAVFZ "Fehlerklasse: Diagnose Geschwindigkeitssignal" VALUE 0x8874 DAMOS_FW1 0 DEZ 0.000000 256.000000 /end CHARACTERISTIC
/begin CHARACTERISTIC CLAVTSK "Fehlerklasse: Diagnose FGR-Bedienhebel" VALUE 0x88A3 DAMOS_FW1 0 DEZ 0.000000 256.000000 /end CHARACTERISTIC
/begin CHARACTERISTIC CLAWFS "Fehlerklasse: WFS Fehler" VALUE 0x8883 DAMOS_FW1 0 DEZ 0.000000 256.000000 /end CHARACTERISTIC
/begin CHARACTERISTIC CLAZZZ "" VALUE 0x88B2 DAMOS_FW1 0 DEZ 0.000000 256.000000 /end CHARACTERISTIC
/begin CHARACTERISTIC CLRHK "Codewort fuer Lambdaregelung hinter Kat ein/aus" VALUE 0x822E DAMOS_FW1 0 DEZ 0.000000 256.000000 /end CHARACTERISTIC
/begin CHARACTERISTIC CNFNWS "Konfiguration für Nockenwellensteuerung" VALUE 0x8234 DAMOS_FW1 0 DEZ 0.000000 256.000000 /end CHARACTERISTIC
/begin CHARACTERISTIC CTSEWTM "tmot-Ersatzwertkennlinie als f(tmdmm)" CURVE 0x84A6 DAMOS_FKL1 0 CMO_TMP -41.000000 140.000000
 /begin AXIS_DESCR FIX_AXIS TMDMM UTMP_40 9 -40.000000 216.000000 FIX_AXIS_PAR 0 5 9 /end AXIS_DESCR
/end CHARACTERISTIC
/begin CHARACTERISTIC CUKWLL "Kontroll-Parameter W-Anteil der UK im Leerlauf" VALUE 0x8155 DAMOS_FW1 0 DEZ 0.000000 256.000000 /end CHARACTERISTIC
/begin CHARACTERISTIC CWABSSW "Bedingung um zu DSWEC umzuschalten " VALUE 0x82F8 DAMOS_FW1 0 DEZ 0.000000 256.000000 /end CHARACTERISTIC
/begin CHARACTERISTIC CWARGETR "Codewort fuer B_zwardy bei Automat im Tip-Modus" VALUE 0x81A3 DAMOS_FW1 0 DEZ 0.000000 256.000000 /end CHARACTERISTIC
/begin CHARACTERISTIC CWBRLS "Codewort des Bremslichtschalters" VALUE 0x8766 DAMOS_FW1 0 DEZ 0.000000 256.000000 /end CHARACTERISTIC
/begin CHARACTERISTIC CWDCAN "Error CAN-Node reversible b0:NBC b1:NFR b2:NCA/NCR b3:NAC b4:NBA" VALUE 0x84CE DAMOS_FW1 0 DEZ 0.000000 256.000000 /end CHARACTERISTIC
/begin CHARACTERISTIC CWDDSAC "Bit 0 Freigabe Klimadrucksensordiagnose" VALUE 0x87C6 DAMOS_FW1 0 DEZ 0.000000 256.000000 /end CHARACTERISTIC
/begin CHARACTERISTIC CWDLSA "Codewort fuer Einmalpruefung Alterung Sonde vor Kat fuer Applikationszwecke" VALUE 0x8324 DAMOS_FW1 0 DEZ 0.000000 256.000000 /end CHARACTERISTIC
/begin CHARACTERISTIC CWDLSAHK "Codewort fuer Einmalpruefung Alterung Sonde hinter Kat fuer Applikationszwecke" VALUE 0x8347 DAMOS_FW1 0 DEZ 0.000000 256.000000 /end CHARACTERISTIC
/begin CHARACTERISTIC CWDMDE "Codewort fuer EOBD-Appl. DMDMIL (Heilung ohne Fensterabd.)" VALUE 0x8481 DAMOS_FW1 0 DEZ 0.000000 256.000000 /end CHARACTERISTIC
/begin CHARACTERISTIC CWEPACLF " Bit 0,1 => Luefter 1,2 einschalten bei PAC-Fehler" VALUE 0x87B5 DAMOS_FW1 0 DEZ 0.000000 256.000000 /end CHARACTERISTIC
/begin CHARACTERISTIC CWERFIL "Codewort zur Auswahl Filtervar. für die Ausgabe von AS.-Fehler an das Scan Tool" VALUE 0x8848 DAMOS_FW1 0 DEZ 0.000000 256.000000 /end CHARACTERISTIC
/begin CHARACTERISTIC CWGGFST "0...Tankfüllstand via CAN; 1...Tankfüllstand analog" VALUE 0x82EA DAMOS_FW1 0 DEZ 0.000000 256.000000 /end CHARACTERISTIC
/begin CHARACTERISTIC CWHBRK "Codewort Handbremse schaltet ACC und FGR ab" VALUE 0x8515 DAMOS_FW1 0 DEZ 0.000000 256.000000 /end CHARACTERISTIC
/begin CHARACTERISTIC CWKLIMA " Klimaanlage oder Lüfter" VALUE 0x87B6 DAMOS_FW1 0 DEZ 0.000000 256.000000 /end CHARACTERISTIC
/begin CHARACTERISTIC CWKMMIL "Kilometerstand abspeichern bei MIL fremdbestimmt" VALUE 0x849C DAMOS_FW1 0 DEZ 0.000000 256.000000 /end CHARACTERISTIC
/begin CHARACTERISTIC CWKONABG "Codewort für Konfiguration Abgasbehandlung" VALUE 0x884A DAMOS_FW1 0 DEZ 0.000000 256.000000 /end CHARACTERISTIC
/begin CHARACTERISTIC CWLFRVNS "CW Nachstartsolldreh.umsch. fuer stehendes/rollendes Fzg. rev." VALUE 0x8607 DAMOS_FW1 0 DEZ 0.000000 256.000000 /end CHARACTERISTIC
/begin CHARACTERISTIC CWLFS "Umschaltung zw. Stufen- und PWM-Lüfter" VALUE 0x87B7 DAMOS_FW1 0 DEZ 0.000000 256.000000 /end CHARACTERISTIC
/begin CHARACTERISTIC CWLRSYNC "Codewort: selektiert Bank1 oder 2 als Master waehrend fr-Synchron." VALUE 0x81D6 DAMOS_FW1 0 DEZ 0.000000 256.000000 /end CHARACTERISTIC
/begin CHARACTERISTIC CWLSDGETR "Codewort Handschalter oder Automat im Tip-Modus" VALUE 0x8604 DAMOS_FW1 0 DEZ 0.000000 256.000000 /end CHARACTERISTIC
/begin CHARACTERISTIC CWOBD "Zertifikationsnachweis (fuer TC1MOD)" VALUE 0x849B DAMOS_FW1 0 DEZ 0.000000 256.000000 /end CHARACTERISTIC
/begin CHARACTERISTIC CWSWBLL "Codewort Pedalkennfeld Anfahren bei Leerlauf" VALUE 0x862D DAMOS_FW1 0 DEZ 0.000000 256.000000 /end CHARACTERISTIC
/begin CHARACTERISTIC C_KL "Pedalwert als Funktion des Pedal-Sollwertes bei Fahrprogramm City" CURVE 0xBDBB DAMOS_GKL1 0 PER255 0.000000 100.000000
 /begin AXIS_DESCR COM_AXIS SWPT PER255 16 0.000000 0.000000 AXIS_PTS_REF SWPTV16 EXTENDED_LIMITS 0.000000 100.000000 /end AXIS_DESCR
/end CHARACTERISTIC
/begin CHARACTERISTIC DBZ_MN_UM "Min. Diff. z. neuem und alten Botschaftszähler in der FU" VALUE 0x8816 DAMOS_FW1 0 DEZ 0.000000 256.000000 /end CHARACTERISTIC
/begin CHARACTERISTIC DBZ_MX_UM "Max. Diff. z. neuem und alten Botschaftszähler in der FU" VALUE 0x8817 DAMOS_FW1 0 DEZ 0.000000 256.000000 /end CHARACTERISTIC
/begin CHARACTERISTIC DELTA_FP "Delta V-Schwelle bei Ueberreiten" VALUE 0x8672 DAMOS_FW3 0 VQV16L 0.000000 4095.938000 EXTENDED_LIMITS 0.000000 4095.940000 /end CHARACTERISTIC
/begin CHARACTERISTIC DELTA_V1 "Delta V-Schwelle 1 Antischubr." VALUE 0x8674 DAMOS_FW3 0 VQV16L 0.000000 4095.938000 EXTENDED_LIMITS 0.000000 4095.940000 /end CHARACTERISTIC
/begin CHARACTERISTIC DELTA_V2 "Delta V-Schwelle 2 Antischubr." VALUE 0x8676 DAMOS_FW3 0 VQV16L 0.000000 4095.938000 EXTENDED_LIMITS 0.000000 4095.940000 /end CHARACTERISTIC
/begin CHARACTERISTIC DFDKHA "Delta Faktor Drosselklappe Hoehenadaption" VALUE 0x826B DAMOS_FW1 0 FKT2048 0.000000 0.124512 EXTENDED_LIMITS 0.000000 0.124510 /end CHARACTERISTIC
/begin CHARACTERISTIC DFH_ADMB "Geschw.-Schwelle, unterhalb der die Anfahrdrehmoment-Begr. aktiv ist" VALUE 0x85DA DAMOS_FW3 0 VQV16L 0.000000 4095.938000 EXTENDED_LIMITS 0.000000 4095.940000 /end CHARACTERISTIC
/begin CHARACTERISTIC DFPMLINE "Auswahl einer Zeile des Fehlerspeichers" VALUE 0x8CE3 DAMOS_FW1 0 DEZ 0.000000 256.000000 /end CHARACTERISTIC
/begin CHARACTERISTIC DFPSLBIT "Selektionsbits für Kennzeichnung der aktivierten Fehlerpfade" VAL_BLK 0x884E DAMOS_FWB3 0 DEZL 0.000000 65535.000000 NUMBER 16 /end CHARACTERISTIC
/begin CHARACTERISTIC DFRKAML "Delta-FR fuer LRKA" CURVE 0x8580 DAMOS_FKL1 0 FKT512 0.000000 0.500000
 /begin AXIS_DESCR FIX_AXIS MLSM MLSMQ 16 0.000000 240.000000 FIX_AXIS_PAR 0 2 16 EXTENDED_LIMITS 0.000000 1024.000000 /end AXIS_DESCR
/end CHARACTERISTIC
/begin CHARACTERISTIC DFSEFON " " CURVE 0xB765 DAMOS_GKL2 0 DTSEGN_S8 -2.250000 2.232422
 /begin AXIS_DESCR COM_AXIS NIST NQ25 6 0.000000 0.000000 AXIS_PTS_REF NFOV06 EXTENDED_LIMITS 0.000000 6400.000000 /end AXIS_DESCR
 EXTENDED_LIMITS -2.250000 2.232420 /end CHARACTERISTIC
/begin RECORD_LAYOUT DAMOS_GKL2 FNC_VALUES 1 SBYTE COLUMN_DIR DIRECT /end RECORD_LAYOUT
/begin CHARACTERISTIC DFSERES " " VALUE 0x8311 DAMOS_FW2 0 DTSEGN_S8 -2.250000 2.232422 EXTENDED_LIMITS -2.250000 2.232420 /end CHARACTERISTIC
/begin CHARACTERISTIC DIF12_LL "max. Diff. zw. SP1S,SP2S über Vollgasschw." VALUE 0x8642 DAMOS_FW3 0 PER1023 0.000000 9.286412 EXTENDED_LIMITS 0.000000 100.000000 /end CHARACTERISTIC
/begin CHARACTERISTIC DIF12_VG "max. Diff. zw. SP1S,SP2S unter Vollgasschw." VALUE 0x8644 DAMOS_FW3 0 PER1023 0.000000 24.242420 EXTENDED_LIMITS 0.000000 100.000000 /end CHARACTERISTIC
/begin CHARACTERISTIC DIF_IP12 "Max. Tol. der aufeinander umger. Werte (IP1SN-IP2SN)" VALUE 0x8650 DAMOS_FW1 0 PER255 0.000000 7.450980 EXTENDED_LIMITS 0.000000 100.000000 /end CHARACTERISTIC
/begin CHARACTERISTIC DIF_IP13 "IP13-Differenz" VALUE 0x865A DAMOS_FW1 0 PER255 5.098039 20.000000 EXTENDED_LIMITS 0.000000 100.000000 /end CHARACTERISTIC
/begin CHARACTERISTIC DIF_IP23 "IP23-Differenz" VALUE 0x8659 DAMOS_FW1 0 PER255 5.098039 20.000000 EXTENDED_LIMITS 0.000000 100.000000 /end CHARACTERISTIC
/begin CHARACTERISTIC DIF_SP1S "max. Diff. zwischen SP1S u. SP1S_ALT" VALUE 0x863C DAMOS_FW3 0 PER1023 3.128055 3.128055 EXTENDED_LIMITS 0.000000 100.000000 /end CHARACTERISTIC
/begin CHARACTERISTIC DIF_SP2S "max. Diff. zwischen SP2S u. SP2S_ALT" VALUE 0x863E DAMOS_FW3 0 PER1023 3.128055 3.128055 EXTENDED_LIMITS 0.000000 100.000000 /end CHARACTERISTIC
/begin CHARACTERISTIC DINK1 "Zuendwinkel-Aenderungssprung (ZWB=1)" VALUE 0x817A DAMOS_FW1 0 ZWQ 0.000000 191.250000 /end CHARACTERISTIC
/begin CHARACTERISTIC DINK2 "Zuendwinkel-Aenderungssprung (ZWB=2)" VALUE 0x817B DAMOS_FW1 0 ZWQ 0.000000 191.250000 /end CHARACTERISTIC
/begin CHARACTERISTIC DINK3 "Zuendwinkel-Aenderungssprung (ZWB=3)" VALUE 0x817C DAMOS_FW1 0 ZWQ 0.000000 191.250000 /end CHARACTERISTIC
/begin CHARACTERISTIC DINK4 "Zuendwinkel-Aenderungssprung (ZWB=4)" VALUE 0x817D DAMOS_FW1 0 ZWQ 0.000000 191.250000 /end CHARACTERISTIC
/begin CHARACTERISTIC DINK5 "Zuendwinkel-Aenderungssprung (ZWB=5)" VALUE 0x817E DAMOS_FW1 0 ZWQ 0.000000 191.250000 /end CHARACTERISTIC
/begin CHARACTERISTIC DINK7 "Anzahl Zuendungen fuer Aufregelung von KFZWLW" VALUE 0x819C DAMOS_FW1 0 DEZ 0.000000 256.000000 /end CHARACTERISTIC
/begin CHARACTERISTIC DINK8 "Anzahl Zuendungen fuer Abregelung von KFZWLW" VALUE 0x819E DAMOS_FW1 0 DEZ 0.000000 256.000000 /end CHARACTERISTIC
/begin CHARACTERISTIC DINK9 "zul. Zuendwinkel-Aenderungssprung fuer wgs" VALUE 0x8787 DAMOS_FW1 0 ZWQ 0.000000 191.250000 /end CHARACTERISTIC
/begin CHARACTERISTIC DISP12_T "Fehlerzeit bei SP1S-SP2S > DIFSP12" VALUE 0x8633 DAMOS_FW1 0 TQ10 0.180000 0.180000 EXTENDED_LIMITS 0.000000 2.550000 /end CHARACTERISTIC
/begin CHARACTERISTIC DKATCW "Einmaliger Lauf bzw. Initialisierung der DKAT-Funktion" VALUE 0x8383 DAMOS_FW1 0 DEZ 0.000000 256.000000 /end CHARACTERISTIC
/begin CHARACTERISTIC DKDNHUB "denormierter Drosselklappen-Hub" VALUE 0x85DC DAMOS_FW3 0 PER0327 0.000000 100.000000 /end CHARACTERISTIC
/begin CHARACTERISTIC DKMAXKL "Drosselklappenbegrenzung im DK-Poti-Notfahren als f(NIST)" CURVE 0xBFE4 DAMOS_KL97 0 PER255 0.000000 100.000000 /begin AXIS_DESCR STD_AXIS NIST NQ25 10 0.000000 6400.000000 /end AXIS_DESCR /end CHARACTERISTIC
/begin CHARACTERISTIC DKPWMLL "Leerlauf-PWM-Vorgabewert fuer Abgleich" VALUE 0x861A DAMOS_FW3 0 PER0327 0.000000 100.000000 /end CHARACTERISTIC
/begin CHARACTERISTIC DKPWMVL "Vollast-PWM-Vorgabewert fuer Abgleich" VALUE 0x861C DAMOS_FW3 0 PER0327 0.000000 100.000000 /end CHARACTERISTIC
/begin CHARACTERISTIC DKRISNT "Schwelle fuer KR-Integratorsteigungsoffsetdiagnose" VALUE 0x828C DAMOS_FW3 0 SENSORW 0.000000 4.999924 EXTENDED_LIMITS 0.000000 4.999920 /end CHARACTERISTIC
/begin CHARACTERISTIC DKVOFFTC "Offset fuer Begrenzung von sw_egs" CURVE 0xAF94 DAMOS_KL97 0 PER255 0.000000 100.000000 /begin AXIS_DESCR STD_AXIS NIST NQ25 8 0.000000 6400.000000 /end AXIS_DESCR /end CHARACTERISTIC
/begin CHARACTERISTIC DK_UG_OF "Untergrenzen-Offset bei LFR-Diagnose" VALUE 0x85E2 DAMOS_FW3 0 UDKL 0.000000 10.112030 EXTENDED_LIMITS 0.000000 10.112000 /end CHARACTERISTIC
/begin CHARACTERISTIC DLAMLASHF "Delta-Lambda-Sollwert (Fett) fuer Test Schwingungspruefung hinter Kat" VALUE 0x8348 DAMOS_FW3 0 FKT4096L 0.000000 16.000000 /end CHARACTERISTIC
/begin CHARACTERISTIC DLAMLASHM "Delta-Lambda-Sollwert (Mager) fuer Test Schwingungspruefung hinter Kat" VALUE 0x834A DAMOS_FW3 0 FKT4096L 0.000000 16.000000 /end CHARACTERISTIC
/begin CHARACTERISTIC DLRPERMN " Min-Wert für dlrper-Integrator" VALUE 0x81D8 DAMOS_FW4 0 FKT65536SL -0.500000 0.499985 EXTENDED_LIMITS -0.500000 0.499980 /end CHARACTERISTIC
/begin RECORD_LAYOUT DAMOS_FW4 FNC_VALUES 1 SWORD COLUMN_DIR DIRECT /end RECORD_LAYOUT
/begin CHARACTERISTIC DLRPERMX " Max-Wert für dlrper-Integrator" VALUE 0x81DA DAMOS_FW4 0 FKT65536SL -0.500000 0.499985 EXTENDED_LIMITS -0.500000 0.499980 /end CHARACTERISTIC
/begin CHARACTERISTIC DLUKW "Schwelle ÜK-Auslösung Drosselklappen-Speicher" VALUE 0x8152 DAMOS_FW4 0 TLQSL -1397.883000 1397.840000 EXTENDED_LIMITS -1397.880000 1397.840000 /end CHARACTERISTIC
/begin CHARACTERISTIC DLURMIN " " CURVE 0xB4A1 DAMOS_GKL2 0 LUQ_S8 -94.296300 93.559620
 /begin AXIS_DESCR COM_AXIS NIST NQ25 8 0.000000 0.000000 AXIS_PTS_REF NDMDV08 EXTENDED_LIMITS 0.000000 6400.000000 /end AXIS_DESCR
 EXTENDED_LIMITS -94.296300 93.559600 /end CHARACTERISTIC
/begin CHARACTERISTIC DMDEGS "Max. zulaessige Momentenerhoehung durch EGS" VALUE 0x8780 DAMOS_FW1 0 MMQ 0.000000 512.000000 /end CHARACTERISTIC
/begin CHARACTERISTIC DMEGSOFF "Offset fuer Berechnung mdegsbgr" VALUE 0x8786 DAMOS_FW1 0 MMQ 0.000000 512.000000 /end CHARACTERISTIC
/begin CHARACTERISTIC DMRLASH "Momentenreserve fuer Diagnose Lambdasonden-Alterungsueberwachung hinter Kat" VALUE 0x834C DAMOS_FW3 0 PCENT100L 0.000000 99.998470 EXTENDED_LIMITS 0.000000 99.998500 /end CHARACTERISTIC
/begin CHARACTERISTIC DMXRDL " " VALUE 0x830D DAMOS_FW2 0 LUQZ_S8 -18.859260 18.711920 EXTENDED_LIMITS -18.859300 18.711900 /end CHARACTERISTIC
/begin CHARACTERISTIC DMXRFL " " VALUE 0x830E DAMOS_FW2 0 LUQZ_S8 -18.859260 18.711920 EXTENDED_LIMITS -18.859300 18.711900 /end CHARACTERISTIC
/begin CHARACTERISTIC DMXRLU "Begrenzung bei max. Laufunruhe-Referenzwert-Aenderung" VALUE 0x82FE DAMOS_FW1 0 LUQ_8Z 0.000000 23.481990 EXTENDED_LIMITS 0.000000 23.482000 /end CHARACTERISTIC
/begin CHARACTERISTIC DNALUN "Delta-n fuer Ausblendung Aussetzererkennung" CURVE 0xB78B DAMOS_GKL1 0 NGRDQ40 0.000000 10200.000000
 /begin AXIS_DESCR COM_AXIS NIST NQ25 8 0.000000 0.000000 AXIS_PTS_REF NDMDV08 EXTENDED_LIMITS 0.000000 6400.000000 /end AXIS_DESCR
/end CHARACTERISTIC
/begin CHARACTERISTIC DNKRDY "Schwellwert Drehzahldifferenz  fuer Dynamikerkennung KR" VALUE 0x826F DAMOS_FW2 0 NGRDQ10OF -1270.000000 1270.000000 /end CHARACTERISTIC
/begin CHARACTERISTIC DNSAH "Anfangswert fuer zeitabhaengige Schubhysterese" VALUE 0x8117 DAMOS_FW1 0 NQ25 0.000000 6400.000000 /end CHARACTERISTIC
/begin CHARACTERISTIC DNSAL "Endwert für zeitabhängige Schubhysterese" VALUE 0x8118 DAMOS_FW1 0 NQ25 0.000000 6400.000000 /end CHARACTERISTIC
/begin CHARACTERISTIC DNUANMAX "maximaler unterer elektr. Anschlag" VALUE 0x8620 DAMOS_FW3 0 PER0327 0.000000 100.000000 /end CHARACTERISTIC
/begin CHARACTERISTIC DNUANMIN "minimaler unterer elektr. Anschlag" VALUE 0x861E DAMOS_FW3 0 PER0327 0.000000 100.000000 /end CHARACTERISTIC
/begin CHARACTERISTIC DNWEK "Drehzahlerhoehung fuer WE mit B_PN=1" VALUE 0x8116 DAMOS_FW1 0 NQ25 0.000000 6400.000000 /end CHARACTERISTIC
/begin CHARACTERISTIC DNWNS "Drehzahlhysterese für Zündwinkelkorrektur im Nachstart" VALUE 0x816F DAMOS_FW1 0 NQ5 0.000000 1275.000000 /end CHARACTERISTIC
/begin CHARACTERISTIC DNZB "Solldrehzahlabstand, ZWB-Bereichserkennung" VALUE 0x8178 DAMOS_FW1 0 NQ5 0.000000 1275.000000 /end CHARACTERISTIC
/begin CHARACTERISTIC DP_ABR3 "Dashpot-Abregelung 3" VALUE 0x85D2 DAMOS_FW1 0 UDKL 0.000000 0.629687 EXTENDED_LIMITS 0.000000 10.112000 /end CHARACTERISTIC
/begin CHARACTERISTIC DR10V_T "Drivewechsel-Verzoegerungszeit" VALUE 0x85AC DAMOS_FW1 0 TQ10 0.000000 2.550000 /end CHARACTERISTIC
/begin CHARACTERISTIC DRISIGH "Diagnoseschwelle Ri-Sonde fuer Signalunterbrechung hinter Kat" VALUE 0x83DA DAMOS_FW3 0 R_UW_Q2 0.000000 131070.000000 /end CHARACTERISTIC
/begin CHARACTERISTIC DRISIGV "Diagnoseschwelle Ri-Sonde fuer Signalunterbrechung vor Kat" VALUE 0x83AC DAMOS_FW3 0 R_UW_Q2 0.000000 131070.000000 /end CHARACTERISTIC
/begin CHARACTERISTIC DRLKTDP "Schwelle fuer Lastaenderung in Kat-Diagnose" VALUE 0x8384 DAMOS_FW1 0 UFUELL 0.000000 191.250000 /end CHARACTERISTIC
/begin CHARACTERISTIC DRLKTDPT "Schwelle fuer Lastaenderung in Kat-Diagnose bei Testeransteuerung" VALUE 0x8385 DAMOS_FW1 0 UFUELL 0.000000 191.250000 /end CHARACTERISTIC
/begin CHARACTERISTIC DRMX "obere Plausibilitätsschwelle für Raddrehzahl" VALUE 0x82E6 DAMOS_FW3 0 VQV16L 0.000000 4095.938000 EXTENDED_LIMITS 0.000000 4095.940000 /end CHARACTERISTIC
/begin CHARACTERISTIC DRSGA_T "Drive-Stoergroessen-Aufschaltzeit" VALUE 0x85AD DAMOS_FW1 0 TQ10 0.000000 2.550000 /end CHARACTERISTIC
/begin CHARACTERISTIC DSPULS "Wegstrecke für einen Tachoimpuls" VALUE 0x87C7 DAMOS_FW1 0 SQLEN 0.000000 510.000000 /end CHARACTERISTIC
/begin CHARACTERISTIC DSWDPA "Dashpot-Änderungs-Kennfeld für Automatik" MAP 0xC109 DAMOS_GKF1 0 PER511 0.000000 50.000000
 /begin AXIS_DESCR COM_AXIS SWRES PER255 8 0.000000 0.000000 AXIS_PTS_REF SWREV08 EXTENDED_LIMITS 0.000000 100.000000 /end AXIS_DESCR
 /begin AXIS_DESCR COM_AXIS NIST NQ25 8 0.000000 0.000000 AXIS_PTS_REF NISTV08 EXTENDED_LIMITS 0.000000 6400.000000 /end AXIS_DESCR
/end CHARACTERISTIC
/begin RECORD_LAYOUT DAMOS_GKF1 FNC_VALUES 1 UBYTE COLUMN_DIR DIRECT /end RECORD_LAYOUT
/begin CHARACTERISTIC DSWDPM "Dashpot-Änderungs-Kennfeld für Manuell" MAP 0xC189 DAMOS_GKF1 0 PER511 0.000000 50.000000
 /begin AXIS_DESCR COM_AXIS SWRES PER255 8 0.000000 0.000000 AXIS_PTS_REF SWREV08 EXTENDED_LIMITS 0.000000 100.000000 /end AXIS_DESCR
 /begin AXIS_DESCR COM_AXIS NIST NQ25 8 0.000000 0.000000 AXIS_PTS_REF NISTV08 EXTENDED_LIMITS 0.000000 6400.000000 /end AXIS_DESCR
/end CHARACTERISTIC
/begin CHARACTERISTIC DSWLSD1M "Lastschlagdämpfungs-Änderung für Manuell Gang 0/1" MAP 0xC1C9 DAMOS_GKF1 0 PER511 0.000000 50.000000
 /begin AXIS_DESCR COM_AXIS SWRES PER255 8 0.000000 0.000000 AXIS_PTS_REF SWREV08 EXTENDED_LIMITS 0.000000 100.000000 /end AXIS_DESCR
 /begin AXIS_DESCR COM_AXIS NIST NQ25 8 0.000000 0.000000 AXIS_PTS_REF NISTV08 EXTENDED_LIMITS 0.000000 6400.000000 /end AXIS_DESCR
/end CHARACTERISTIC
/begin CHARACTERISTIC DSWLSD2M "Lastschlagdämpfungs-Änderung für Manuell Gang 2" MAP 0xC209 DAMOS_GKF1 0 PER511 0.000000 50.000000
 /begin AXIS_DESCR COM_AXIS SWRES PER255 8 0.000000 0.000000 AXIS_PTS_REF SWREV08 EXTENDED_LIMITS 0.000000 100.000000 /end AXIS_DESCR
 /begin AXIS_DESCR COM_AXIS NIST NQ25 8 0.000000 0.000000 AXIS_PTS_REF NISTV08 EXTENDED_LIMITS 0.000000 6400.000000 /end AXIS_DESCR
/end CHARACTERISTIC
/begin CHARACTERISTIC DSWLSD3M "Lastschlagdämpfungs-Änderung für Manuell Gang 3" MAP 0xC249 DAMOS_GKF1 0 PER511 0.000000 50.000000
 /begin AXIS_DESCR COM_AXIS SWRES PER255 8 0.000000 0.000000 AXIS_PTS_REF SWREV08 EXTENDED_LIMITS 0.000000 100.000000 /end AXIS_DESCR
 /begin AXIS_DESCR COM_AXIS NIST NQ25 8 0.000000 0.000000 AXIS_PTS_REF NISTV08 EXTENDED_LIMITS 0.000000 6400.000000 /end AXIS_DESCR
/end CHARACTERISTIC
/begin CHARACTERISTIC DSWLSD4M "Lastschlagdämpfungs-Änderung für Manuell Gang 4" MAP 0xC289 DAMOS_GKF1 0 PER511 0.000000 50.000000
 /begin AXIS_DESCR COM_AXIS SWRES PER255 8 0.000000 0.000000 AXIS_PTS_REF SWREV08 EXTENDED_LIMITS 0.000000 100.000000 /end AXIS_DESCR
 /begin AXIS_DESCR COM_AXIS NIST NQ25 8 0.000000 0.000000 AXIS_PTS_REF NISTV08 EXTENDED_LIMITS 0.000000 6400.000000 /end AXIS_DESCR
/end CHARACTERISTIC
/begin CHARACTERISTIC DSWLSD5M "Lastschlagdämpfungs-Änderung für Manuell Gang 5" MAP 0xC2C9 DAMOS_GKF1 0 PER511 0.000000 50.000000
 /begin AXIS_DESCR COM_AXIS SWRES PER255 8 0.000000 0.000000 AXIS_PTS_REF SWREV08 EXTENDED_LIMITS 0.000000 100.000000 /end AXIS_DESCR
 /begin AXIS_DESCR COM_AXIS NIST NQ25 8 0.000000 0.000000 AXIS_PTS_REF NISTV08 EXTENDED_LIMITS 0.000000 6400.000000 /end AXIS_DESCR
/end CHARACTERISTIC
/begin CHARACTERISTIC DSWLSDA "Lastschlagdämpfungs-Änderungs-Kennfeld für Automatik" MAP 0xC149 DAMOS_GKF1 0 PER511 0.000000 50.000000
 /begin AXIS_DESCR COM_AXIS SWRES PER255 8 0.000000 0.000000 AXIS_PTS_REF SWREV08 EXTENDED_LIMITS 0.000000 100.000000 /end AXIS_DESCR
 /begin AXIS_DESCR COM_AXIS NIST NQ25 8 0.000000 0.000000 AXIS_PTS_REF NISTV08 EXTENDED_LIMITS 0.000000 6400.000000 /end AXIS_DESCR
/end CHARACTERISTIC
/begin CHARACTERISTIC DTAAGAB "delta AGR-Tastverhältnis bei Abregelung" VALUE 0x823E DAMOS_FW1 0 PCENT 0.000000 99.609380 EXTENDED_LIMITS 0.000000 99.609400 /end CHARACTERISTIC
/begin CHARACTERISTIC DTAAGKF "delta AGR-Tastverhältnis beim Übergang ins Kennfeld" VALUE 0x823C DAMOS_FW1 0 PCENT 0.000000 99.609380 EXTENDED_LIMITS 0.000000 99.609400 /end CHARACTERISTIC
/begin CHARACTERISTIC DTADTM "max. neg. Abweichung der Motor-Temp. zur Ansaugl.-Temp." VALUE 0x8467 DAMOS_FW1 0 DEZ 0.000000 256.000000 /end CHARACTERISTIC
/begin CHARACTERISTIC DTIABS "Mindestmenge fuer 1. Nachspritzer" VALUE 0x8168 DAMOS_FW3 0 TEQL 0.000000 174.760000 /end CHARACTERISTIC
/begin CHARACTERISTIC DTIREL "Mindestprozentanteil fuer 2. Nachspritzer" VALUE 0x816A DAMOS_FW1 0 PCENT 0.000000 99.609380 EXTENDED_LIMITS 0.000000 99.609400 /end CHARACTERISTIC
/begin CHARACTERISTIC DTKH "Betrag Differenztemperatur (tans-tmst) für Katheizen. 255°C schaltet Funktion au" VALUE 0x8172 DAMOS_FW1 0 UTMP_00 0.000000 256.000000 /end CHARACTERISTIC
/begin CHARACTERISTIC DTLAGR "Lastwertänderungsschwelle für AGR-Beschleunigungsfaktor" VALUE 0x8238 DAMOS_FW1 0 TEQ_32 0.000000 21.760000 /end CHARACTERISTIC
/begin CHARACTERISTIC DTLALUN "Delta TL8 fuer Ausblendung Aussetzererkennung" CURVE 0xB79B DAMOS_GKL1 0 UFUELL 0.000000 191.250000
 /begin AXIS_DESCR COM_AXIS TL8 UFUELL 8 0.000000 0.000000 AXIS_PTS_REF TLDMDV08 EXTENDED_LIMITS 0.000000 191.250000 /end AXIS_DESCR
/end CHARACTERISTIC
/begin CHARACTERISTIC DTLFU "Hysterese für Laständerung bei Umschaltung Tl-Filterkonst." VALUE 0x8128 DAMOS_FW1 0 UFUELL 0.000000 191.250000 /end CHARACTERISTIC
/begin CHARACTERISTIC DTLWE "WE-Lasthysterese " VALUE 0x811A DAMOS_FW1 0 UFUELL 0.000000 191.250000 /end CHARACTERISTIC
/begin CHARACTERISTIC DTMDMA "Abstand Modelltemperatur zur gemessenen Motortemperatur" VALUE 0x8463 DAMOS_FW1 0 DEZ 0.000000 256.000000 /end CHARACTERISTIC
/begin CHARACTERISTIC DTMDMM "Steigung des Temperaturmodells pro TDMM*TDMM_Q" VALUE 0x8468 DAMOS_FW1 0 DEZ 0.000000 256.000000 /end CHARACTERISTIC
/begin CHARACTERISTIC DTMR "Hysterese fuer LR-Temperatur-Einschaltschwelle" VALUE 0x8208 DAMOS_FW1 0 DEZ 0.000000 256.000000 /end CHARACTERISTIC
/begin CHARACTERISTIC DTPAGAB "AGR-Taktperioden zwischen TV-Änderungen beim Abregeln" VALUE 0x823F DAMOS_FW1 0 TQ10 0.000000 2.550000 /end CHARACTERISTIC
/begin CHARACTERISTIC DTPAGKF "AGR-Taktperioden zwischen TV-Änderungen beim Übergang ins Kennfeld" VALUE 0x823D DAMOS_FW1 0 TQ10 0.000000 2.550000 /end CHARACTERISTIC
/begin CHARACTERISTIC DTSA "DTSA-Rampensteigung" VALUE 0x8119 DAMOS_FW1 0 NGRDQ25 0.000000 6375.000000 /end CHARACTERISTIC
/begin CHARACTERISTIC DTVDN "Untere dtv-Schwelle fuer Fehlererkennung im Kraftstoffversorgungssystem " VALUE 0x841A DAMOS_FW4 0 TEQ_CPL -87.381330 87.378660 EXTENDED_LIMITS -87.381300 87.378700 /end CHARACTERISTIC
/begin CHARACTERISTIC DTVDX "Obere dtv-Schwelle fuer Fehlererkennung im Kraftstoffversorgungssystem " VALUE 0x841C DAMOS_FW4 0 TEQ_CPL -87.381330 87.378660 EXTENDED_LIMITS -87.381300 87.378700 /end CHARACTERISTIC
/begin CHARACTERISTIC DTVMN "minimalwert DTV-Integrator" VALUE 0x81F6 DAMOS_FW4 0 TEQ_CPL -84.000000 0.000000 EXTENDED_LIMITS -87.381300 87.378700 /end CHARACTERISTIC
/begin CHARACTERISTIC DTVMX "maximalwert DTV-Integrator" VALUE 0x81F8 DAMOS_FW4 0 TEQ_CPL 0.000000 84.000000 EXTENDED_LIMITS -87.381300 87.378700 /end CHARACTERISTIC
/begin CHARACTERISTIC DUKK "Schwelle für Kurzzeitanteil" VALUE 0x8150 DAMOS_FW4 0 TEQ_12LCPL -1048.576000 1048.544000 EXTENDED_LIMITS -1048.580000 1048.540000 /end CHARACTERISTIC
/begin CHARACTERISTIC DUKW "Delta TLW-Schwelle fuer DK-Uebergangskompensation" VALUE 0x814A DAMOS_FW3 0 TEQL 0.000000 87.378660 EXTENDED_LIMITS 0.000000 174.760000 /end CHARACTERISTIC
/begin AXIS_PTS DUM04 "Dummystuetzstellen" 0x8E7C IR0 DAMOS_SST97 0 DEZ 4 0.000000 256.000000 /end AXIS_PTS
/begin RECORD_LAYOUT DAMOS_SST97 SRC_ADDR_X 1 UWORD NO_AXIS_PTS_X 2 UBYTE AXIS_PTS_X 3 UBYTE INDEX_INCR DIRECT /end RECORD_LAYOUT
/begin AXIS_PTS DUM08 "Dummystuetzstellen" 0x8E84 IR0 DAMOS_SST97 0 DEZ 8 0.000000 256.000000 /end AXIS_PTS
/begin AXIS_PTS DUM16 "Dummystuetzstellen" 0x8E90 IR0 DAMOS_SST97 0 DEZ 16 0.000000 256.000000 /end AXIS_PTS
/begin CHARACTERISTIC DUSHKAAB "Startwert fuer dynamische Sollwertanhebung in der LRHK" VALUE 0x822C DAMOS_FW1 0 U0V_1V25 0.000000 1.245117 EXTENDED_LIMITS 0.000000 1.245120 /end CHARACTERISTIC
/begin CHARACTERISTIC DUSRIH "Delta Sondensp. hinter Kat zwischen Neu- und Altwert im Raster fuer Ri-Messung" VALUE 0x83EE DAMOS_FW3 0 ULSQL 0.000000 5.000000 /end CHARACTERISTIC
/begin CHARACTERISTIC DUSRIV "Delta Sondenspannung vor Kat zwischen Neu- und Altwert im Raster fuer Ri-Messung" VALUE 0x83F0 DAMOS_FW3 0 ULSQL 0.000000 5.000000 /end CHARACTERISTIC
/begin CHARACTERISTIC DUSSPH "Delta Sondensp. hinter Kat zwischen Neu- und 2 Altwerten fuer Sondensprungmsg." VALUE 0x83F2 DAMOS_FW3 0 ULSQL 0.000000 5.000000 /end CHARACTERISTIC
/begin CHARACTERISTIC DUSSPV "Delta Sondensp. vor Kat zwischen Neu- und 2 Altwerten fuer Sondensprungmessung" VALUE 0x83F4 DAMOS_FW3 0 ULSQL 0.000000 5.000000 /end CHARACTERISTIC
/begin CHARACTERISTIC DVER "D-Verstaerkung" VALUE 0x85A2 DAMOS_FW1 0 UDVER 0.000000 0.465102 EXTENDED_LIMITS 0.000000 0.933870 /end CHARACTERISTIC
/begin CHARACTERISTIC DVERH "D-Verstaerkung bei Handschaltung" VALUE 0x85A3 DAMOS_FW1 0 UDVER 0.000000 0.465102 EXTENDED_LIMITS 0.000000 0.933870 /end CHARACTERISTIC
/begin CHARACTERISTIC DVERNEG "D-Verstaerkungs-Kennlinie für LFR4-Handschalter" CURVE 0xC0F1 DAMOS_GKL1 0 UDVER 0.000000 0.933866
 /begin AXIS_DESCR COM_AXIS NDIF NQ5 8 0.000000 0.000000 AXIS_PTS_REF NDIFV08 EXTENDED_LIMITS 0.000000 1275.000000 /end AXIS_DESCR
 EXTENDED_LIMITS 0.000000 0.933870 /end CHARACTERISTIC
/begin CHARACTERISTIC DVTIPUD "Delta V bei Schalter Tip up/down" VALUE 0x8688 DAMOS_FW3 0 VQV16L 0.000000 4095.938000 EXTENDED_LIMITS 0.000000 4095.940000 /end CHARACTERISTIC
/begin CHARACTERISTIC DWANDN "AR-Zuendwinkelkorrektur nach frueh, Aquidistante Abstaende   25.00/1/min" CURVE 0xA6C8 DAMOS_GKL1 0 ZWNEG -72.000000 0.000000
 /begin AXIS_DESCR COM_AXIS IR0 DEZ 4 0.000000 0.000000 AXIS_PTS_REF DUM04 EXTENDED_LIMITS 0.000000 256.000000 /end AXIS_DESCR
/end CHARACTERISTIC
/begin CHARACTERISTIC DWAPDN "AR-Zuendwinkelkorrektur nach spaet, Aquidistante Abstaende   25.00/1/min" CURVE 0xA6CC DAMOS_GKL1 0 ZWQ 0.000000 191.250000
 /begin AXIS_DESCR COM_AXIS IR0 DEZ 4 0.000000 0.000000 AXIS_PTS_REF DUM04 EXTENDED_LIMITS 0.000000 256.000000 /end AXIS_DESCR
/end CHARACTERISTIC
/begin CHARACTERISTIC DWDKLRKA "obere Schwelle delta Drosselklappenwinkel Kat ausraeumen" VALUE 0x856B DAMOS_FW2 0 UDWDK -40.458000 40.141920 EXTENDED_LIMITS -40.458000 40.141900 /end CHARACTERISTIC
/begin CHARACTERISTIC DWDKSU "Hysterese DK-Winkel für SU" VALUE 0x81CD DAMOS_FW1 0 UWDK 0.000000 80.599920 EXTENDED_LIMITS 0.000000 80.599900 /end CHARACTERISTIC
/begin CHARACTERISTIC DWNSDN "Zuendwinkel Nachstarteingriff, Aquidistante Abstaende   80.00/1/min" CURVE 0x9E73 DAMOS_GKL1 0 ZWQ 0.000000 191.250000
 /begin AXIS_DESCR COM_AXIS IR0 DEZ 16 0.000000 0.000000 AXIS_PTS_REF DUM16 EXTENDED_LIMITS 0.000000 256.000000 /end AXIS_DESCR
/end CHARACTERISTIC
/begin CHARACTERISTIC DYADMX "Max. Wert des add. Dynamikvorhaltes" VALUE 0x82B4 DAMOS_FW1 0 ZWQ 0.000000 191.250000 /end CHARACTERISTIC
/begin CHARACTERISTIC DYESN "Dynamikvorhalt Erkennungsschwelle" CURVE 0xD3CE DAMOS_KL98 0 UDWDK -40.458000 40.141920 /begin AXIS_DESCR STD_AXIS NMOT NQ40 8 0.000000 10200.000000 /end AXIS_DESCR EXTENDED_LIMITS -40.458000 40.141900 /end CHARACTERISTIC
/begin RECORD_LAYOUT DAMOS_KL98 SRC_ADDR_X 1 UWORD NO_AXIS_PTS_X 2 UBYTE AXIS_PTS_X 3 UBYTE INDEX_INCR DIRECT FNC_VALUES 4 SBYTE COLUMN_DIR DIRECT /end RECORD_LAYOUT
/begin CHARACTERISTIC DYVT "Dynamik Sperrzeit fuer KR-Adaption" VALUE 0x8296 DAMOS_FW3 0 TQ10L 0.000000 655.350000 /end CHARACTERISTIC
/begin CHARACTERISTIC DZUE1 "Zuendungen bis zum naechsten ZW-Sprung (ZWB=1)" VALUE 0x817F DAMOS_FW1 0 UDEC 1.000000 255.000000 /end CHARACTERISTIC
/begin CHARACTERISTIC DZUE2 "Zuendungen bis zum naechsten ZW-Sprung (ZWB=2)" VALUE 0x8180 DAMOS_FW1 0 UDEC 1.000000 255.000000 /end CHARACTERISTIC
/begin CHARACTERISTIC DZUE3 "Zuendungen bis zum naechsten ZW-Sprung (ZWB=3)" VALUE 0x8181 DAMOS_FW1 0 UDEC 1.000000 255.000000 /end CHARACTERISTIC
/begin CHARACTERISTIC DZUE4 "Zuendungen bis zum naechsten ZW-Sprung (ZWB=4)" VALUE 0x8182 DAMOS_FW1 0 UDEC 1.000000 255.000000 /end CHARACTERISTIC
/begin CHARACTERISTIC DZUE5 "Zuendungen bis zum naechsten ZW-Sprung (ZWB=5)" VALUE 0x8183 DAMOS_FW1 0 UDEC 1.000000 255.000000 /end CHARACTERISTIC
/begin CHARACTERISTIC DZUE7 "Zuendwinkelsteps fuer Aufregelung von KFZWLW" VALUE 0x819D DAMOS_FW1 0 DEZ 0.000000 256.000000 /end CHARACTERISTIC
/begin CHARACTERISTIC DZUE8 "Zuendwinkelsteps fuer Abregelung von KFZWLW" VALUE 0x819F DAMOS_FW1 0 DEZ 0.000000 256.000000 /end CHARACTERISTIC
/begin CHARACTERISTIC DZUE9 "Zuendungen bis zum naechsten ZW-Sprung " VALUE 0x8788 DAMOS_FW1 0 DEZ 0.000000 256.000000 /end CHARACTERISTIC
/begin CHARACTERISTIC DZWENH "Zuendwinkel-Spaetverstellung hartes Wiedereinsetzen" VALUE 0x8184 DAMOS_FW1 0 ZWQ 0.000000 191.250000 /end CHARACTERISTIC
/begin CHARACTERISTIC DZWENW "Zuendwinkel-Spaetverstellung weiches Wiedereinsetzen" VALUE 0x8185 DAMOS_FW1 0 ZWQ 0.000000 191.250000 /end CHARACTERISTIC
/begin AXIS_PTS DZWV08_UM "SST fuer mist-FU" 0x8F5A DZW_UM DAMOS_SST97 0 ZWQ 8 0.000000 191.250000 /end AXIS_PTS
/begin CHARACTERISTIC DZZKH "Inkremente für Zündungszähler KAT-Heizung" VALUE 0x8174 DAMOS_FW3 0 DEZL 0.000000 65535.000000 /end CHARACTERISTIC
/begin CHARACTERISTIC DZZKH1 "Inkremente für Zündungszähler KAT-Heizung, Variante 1" VALUE 0x8176 DAMOS_FW3 0 DEZL 0.000000 65535.000000 /end CHARACTERISTIC
/begin CHARACTERISTIC D_KL "Pedalwert als Funktion des Pedal-Sollwertes bei Getriebestellung D" CURVE 0xBB65 DAMOS_GKL1 0 PER255 0.000000 100.000000
 /begin AXIS_DESCR COM_AXIS SWPT PER255 16 0.000000 0.000000 AXIS_PTS_REF SWPTV16 EXTENDED_LIMITS 0.000000 100.000000 /end AXIS_DESCR
/end CHARACTERISTIC
/begin CHARACTERISTIC FABSALU "Abregelfaktor Beschl.signal bei Schlechtwegerk." VALUE 0x82FA DAMOS_FW3 0 BSCHL_25L 0.000000 25.003810 EXTENDED_LIMITS 0.000000 25.003800 /end CHARACTERISTIC
/begin CHARACTERISTIC FAGRM "Faktor für Abgasrückführung" CURVE 0xCF98 DAMOS_KL97 0 FKT256 0.000000 0.996094 /begin AXIS_DESCR STD_AXIS TMOT CMO_TMP 6 -41.000000 140.000000 /end AXIS_DESCR EXTENDED_LIMITS 0.000000 0.996090 /end CHARACTERISTIC
/begin CHARACTERISTIC FALRKTD "Verstaerkungsfaktor fuer Amplitude des Lambdareglers" VALUE 0x8386 DAMOS_FW1 0 FKT32 0.000000 7.968750 /end CHARACTERISTIC
/begin CHARACTERISTIC FALRKTT "Verstaerkungsfaktor fuer Amplitude des Lambdareglers bei Testbetrieb" VALUE 0x8387 DAMOS_FW1 0 FKT32 0.000000 7.968750 /end CHARACTERISTIC
/begin CHARACTERISTIC FANS "Ansaugluftkorrektur Nebenlastsignal" CURVE 0xAD6F DAMOS_GKL1 0 FKT128 0.000000 1.992188
 /begin AXIS_DESCR COM_AXIS TANS CLU_TMP 8 0.000000 0.000000 AXIS_PTS_REF TANSV08 EXTENDED_LIMITS -50.000000 150.000000 /end AXIS_DESCR
 EXTENDED_LIMITS 0.000000 1.992190 /end CHARACTERISTIC
/begin CHARACTERISTIC FARDYM "Wichtung des AR-Zuedwinkeleingriffes" CURVE 0xA736 DAMOS_KL97 0 FKT256 0.000000 0.996094 /begin AXIS_DESCR STD_AXIS TMOT CMO_TMP 6 -41.000000 140.000000 /end AXIS_DESCR EXTENDED_LIMITS 0.000000 0.996090 /end CHARACTERISTIC
/begin CHARACTERISTIC FASKIV1 "Faktor f. Verlängerung 1. Kat Intervall" VALUE 0x847E DAMOS_FW1 0 DEZ 0.000000 256.000000 /end CHARACTERISTIC
/begin CHARACTERISTIC FATMRWZ "Faktor fuer die Aufteilung TABGM-/Rohrwand fuer B_SA" VALUE 0x825E DAMOS_FW1 0 FKT256 0.000000 0.996094 EXTENDED_LIMITS 0.000000 0.996090 /end CHARACTERISTIC
/begin CHARACTERISTIC FA_CALID "FIAT Calibration ID" ASCII 0x8103 DAMOS_ASCII 0 NoCompuMethod 0.000000 0.000000 NUMBER 16 EXTENDED_LIMITS 0.000000 0.996090 /end CHARACTERISTIC
/begin CHARACTERISTIC FBAGR "Beschleunigungsfaktor für AGR" VALUE 0x8240 DAMOS_FW1 0 FKT256 0.000000 0.996094 EXTENDED_LIMITS 0.000000 0.996090 /end CHARACTERISTIC
/begin CHARACTERISTIC FBAWM "Faktor Beschleunigungsanreicherung Motortemperatur DK-Anteil" CURVE 0x9CA3 DAMOS_GKL1 0 FKT16 0.000000 15.937500
 /begin AXIS_DESCR COM_AXIS TMOT CMO_TMP 12 0.000000 0.000000 AXIS_PTS_REF TMOTV08 EXTENDED_LIMITS -41.000000 140.000000 /end AXIS_DESCR
/end CHARACTERISTIC
/begin CHARACTERISTIC FBAWN "Faktor Beschleunigungsanreicherung DK-Anteil" CURVE 0x9C93 DAMOS_GKL1 0 FKT32 0.000000 7.968750
 /begin AXIS_DESCR COM_AXIS NIST NQ25 8 0.000000 0.000000 AXIS_PTS_REF NISTV08 EXTENDED_LIMITS 0.000000 6400.000000 /end AXIS_DESCR
/end CHARACTERISTIC
/begin CHARACTERISTIC FDDKHAO "Obere Plausibilitaetsgrenze Faktor Hoehenadaption" VALUE 0x8263 DAMOS_FW1 0 FKT128 0.000000 1.992188 EXTENDED_LIMITS 0.000000 1.992190 /end CHARACTERISTIC
/begin CHARACTERISTIC FDDKHAU "Untere Plausibilitiaetsgrenze Faktor Hoehenadaption" VALUE 0x8262 DAMOS_FW1 0 FKT128 0.000000 1.992188 EXTENDED_LIMITS 0.000000 1.992190 /end CHARACTERISTIC
/begin CHARACTERISTIC FDKHAKHO "Hoehenadaptionsschwelle fuer KAT-Heizung" VALUE 0x8170 DAMOS_FW1 0 FKT128 0.000000 1.992188 EXTENDED_LIMITS 0.000000 1.992190 /end CHARACTERISTIC
/begin CHARACTERISTIC FDKHAO "Oberer Grenzwert Faktor Hoehenadaption" VALUE 0x8265 DAMOS_FW1 0 FKT128 0.000000 1.992188 EXTENDED_LIMITS 0.000000 1.992190 /end CHARACTERISTIC
/begin CHARACTERISTIC FDKHAU "Unterer Grenzwert Faktor Hoehenadaption" VALUE 0x8264 DAMOS_FW1 0 FKT128 0.000000 1.992188 EXTENDED_LIMITS 0.000000 1.992190 /end CHARACTERISTIC
/begin AXIS_PTS FDKHAV08 "Hoehenabhg. DK-Adaptionsfaktor-Stuetzstellen" 0x8EDA FDKHA DAMOS_SST97 0 FKT128 8 0.000000 1.992188 EXTENDED_LIMITS 0.000000 1.992190 /end AXIS_PTS
/begin CHARACTERISTIC FDKHE "" VALUE 0x826D DAMOS_FW1 0 FKT128 0.000000 1.992188 EXTENDED_LIMITS 0.000000 1.992190 /end CHARACTERISTIC
/begin CHARACTERISTIC FFTAAA "" VAL_BLK 0x88B3 DAMOS_FWB1 0 DEZ 0.000000 256.000000 NUMBER 2 /end CHARACTERISTIC
/begin RECORD_LAYOUT DAMOS_FWB1 FNC_VALUES 1 UBYTE COLUMN_DIR DIRECT /end RECORD_LAYOUT
/begin CHARACTERISTIC FFTACMVER "Freeze Frame: Diagnose irreversible ACC abschalten" VAL_BLK 0x8933 DAMOS_FWB1 0 DEZ 0.000000 256.000000 NUMBER 2 /end CHARACTERISTIC
/begin CHARACTERISTIC FFTBL "Freeze Frame Tabelle: Diagnose Bremsschalter" VAL_BLK 0x891D DAMOS_FWB1 0 DEZ 0.000000 256.000000 NUMBER 2 /end CHARACTERISTIC
/begin CHARACTERISTIC FFTCACC "Freeze Frame: Diagnose CAN Nachrichtenfehler ACC" VAL_BLK 0x892B DAMOS_FWB1 0 DEZ 0.000000 256.000000 NUMBER 2 /end CHARACTERISTIC
/begin CHARACTERISTIC FFTCAN "Freeze Frame Tabelle: Diagnose CAN" VAL_BLK 0x88F5 DAMOS_FWB1 0 DEZ 0.000000 256.000000 NUMBER 2 /end CHARACTERISTIC
/begin CHARACTERISTIC FFTCASR "Freeze Frame Tabelle 9                 ==9: Index 52" VAL_BLK 0x8929 DAMOS_FWB1 0 DEZ 0.000000 256.000000 NUMBER 2 /end CHARACTERISTIC
/begin CHARACTERISTIC FFTCBC "Freeze Frame: Diagnose CAN Nachrichtenfehler BodyComputer" VAL_BLK 0x88F7 DAMOS_FWB1 0 DEZ 0.000000 256.000000 NUMBER 2 /end CHARACTERISTIC
/begin CHARACTERISTIC FFTCEGS "Freeze Frame Tabelle: Diagnose Getriebeschnittstelle ueber CAN" VAL_BLK 0x88F9 DAMOS_FWB1 0 DEZ 0.000000 256.000000 NUMBER 2 /end CHARACTERISTIC
/begin CHARACTERISTIC FFTCNBA "Freeze Frame: Diagnose CAN Nachrichtenfehler NBA" VAL_BLK 0x892D DAMOS_FWB1 0 DEZ 0.000000 256.000000 NUMBER 2 /end CHARACTERISTIC
/begin CHARACTERISTIC FFTDG "Freeze Frame Tabelle: Diagnose-Bits Drehzahlgeber" VAL_BLK 0x88BD DAMOS_FWB1 0 DEZ 0.000000 256.000000 NUMBER 2 /end CHARACTERISTIC
/begin CHARACTERISTIC FFTDTV1 "Freeze Frame Tabelle: LR-Adaption ti-additiv, Bank1" VAL_BLK 0x8925 DAMOS_FWB1 0 DEZ 0.000000 256.000000 NUMBER 2 /end CHARACTERISTIC
/begin CHARACTERISTIC FFTDVE "Freeze Frame Tabelle: Diagnose-Bits DK-Steller" VAL_BLK 0x88C5 DAMOS_FWB1 0 DEZ 0.000000 256.000000 NUMBER 2 /end CHARACTERISTIC
/begin CHARACTERISTIC FFTEKPE "Freeze Frame Tabelle: Endstufendiagnose-Bits EKP" VAL_BLK 0x88EF DAMOS_FWB1 0 DEZ 0.000000 256.000000 NUMBER 2 /end CHARACTERISTIC
/begin CHARACTERISTIC FFTEV1 "Freeze Frame Tabelle: Endstufendiagnose-Bits EV1" VAL_BLK 0x88DF DAMOS_FWB1 0 DEZ 0.000000 256.000000 NUMBER 2 /end CHARACTERISTIC
/begin CHARACTERISTIC FFTEV2 "Freeze Frame Tabelle: Endstufendiagnose-Bits EV2" VAL_BLK 0x88E1 DAMOS_FWB1 0 DEZ 0.000000 256.000000 NUMBER 2 /end CHARACTERISTIC
/begin CHARACTERISTIC FFTEV3 "Freeze Frame Tabelle: Endstufendiagnose-Bits EV3" VAL_BLK 0x88E3 DAMOS_FWB1 0 DEZ 0.000000 256.000000 NUMBER 2 /end CHARACTERISTIC
/begin CHARACTERISTIC FFTEV4 "Freeze Frame Tabelle: Endstufendiagnose-Bits EV4" VAL_BLK 0x88E5 DAMOS_FWB1 0 DEZ 0.000000 256.000000 NUMBER 2 /end CHARACTERISTIC
/begin CHARACTERISTIC FFTEV5 "Freeze Frame Tabelle: Endstufendiagnose-Bits EV5" VAL_BLK 0x88E7 DAMOS_FWB1 0 DEZ 0.000000 256.000000 NUMBER 2 /end CHARACTERISTIC
/begin CHARACTERISTIC FFTFELA "Freeze Frame Tabelle: Endstufen-Diagnosebits Fehlerlampe" VAL_BLK 0x88ED DAMOS_FWB1 0 DEZ 0.000000 256.000000 NUMBER 2 /end CHARACTERISTIC
/begin CHARACTERISTIC FFTFGRE "Freeze Frame Tabelle: Diagnose FGR-Lampe" VAL_BLK 0x891B DAMOS_FWB1 0 DEZ 0.000000 256.000000 NUMBER 2 /end CHARACTERISTIC
/begin CHARACTERISTIC FFTFRA1 "Freeze Frame Tabelle 9                 ==9: Index 56" VAL_BLK 0x8923 DAMOS_FWB1 0 DEZ 0.000000 256.000000 NUMBER 2 /end CHARACTERISTIC
/begin CHARACTERISTIC FFTHFM "Freeze Frame Tabelle: Diagnosebits Luftmassenmesser HFM" VAL_BLK 0x88B5 DAMOS_FWB1 0 DEZ 0.000000 256.000000 NUMBER 2 /end CHARACTERISTIC
/begin CHARACTERISTIC FFTHSH "Freeze Frame Tabelle: Diagnosebits Sondenheizung vor Kat Bank1" VAL_BLK 0x8913 DAMOS_FWB1 0 DEZ 0.000000 256.000000 NUMBER 2 /end CHARACTERISTIC
/begin CHARACTERISTIC FFTHSHE "Freeze Frame Tabelle: Endstufen-Diagnosebits Sondenheizung hinter Kat" VAL_BLK 0x8917 DAMOS_FWB1 0 DEZ 0.000000 256.000000 NUMBER 2 /end CHARACTERISTIC
/begin CHARACTERISTIC FFTHSV "Freeze Frame Tabelle: Endstufen-Diagnosebits Sondenheizer v.  Kat" VAL_BLK 0x8911 DAMOS_FWB1 0 DEZ 0.000000 256.000000 NUMBER 2 /end CHARACTERISTIC
/begin CHARACTERISTIC FFTHSVE "Freeze Frame Tabelle: Endstufen-Diagnosebits Sondenheizer v.  Kat" VAL_BLK 0x8915 DAMOS_FWB1 0 DEZ 0.000000 256.000000 NUMBER 2 /end CHARACTERISTIC
/begin CHARACTERISTIC FFTIPDK "Freeze Frame Tabelle: Diagnose-Bits Istwertpoti" VAL_BLK 0x88C7 DAMOS_FWB1 0 DEZ 0.000000 256.000000 NUMBER 2 /end CHARACTERISTIC
/begin CHARACTERISTIC FFTKAT1 "Freeze Frame Tabelle: Diagnose Katalysatorkonvertierung, Bank1" VAL_BLK 0x891F DAMOS_FWB1 0 DEZ 0.000000 256.000000 NUMBER 2 /end CHARACTERISTIC
/begin CHARACTERISTIC FFTKOSE "Freeze Frame Tabelle: Endstufen-Diagnosebits fuer Klimakompressor" VAL_BLK 0x88EB DAMOS_FWB1 0 DEZ 0.000000 256.000000 NUMBER 2 /end CHARACTERISTIC
/begin CHARACTERISTIC FFTKRHW "Freeze Frame Tabelle: Diagnosebits KR - HW - Test       B2_BI" VAL_BLK 0x88D3 DAMOS_FWB1 0 DEZ 0.000000 256.000000 NUMBER 2 /end CHARACTERISTIC
/begin CHARACTERISTIC FFTKRS1 "Freeze Frame Tabelle: Diagnosebits KR - Sensor1 - Abfall" VAL_BLK 0x88D5 DAMOS_FWB1 0 DEZ 0.000000 256.000000 NUMBER 2 /end CHARACTERISTIC
/begin CHARACTERISTIC FFTKRS2 "Freeze Frame Tabelle: Diagnosebits KR - Sensor2 - Abfall" VAL_BLK 0x88D7 DAMOS_FWB1 0 DEZ 0.000000 256.000000 NUMBER 2 /end CHARACTERISTIC
/begin CHARACTERISTIC FFTKUPPL "Freeze Frame: Diagnose EGS_SG schaltet Motronic ab" VAL_BLK 0x8931 DAMOS_FWB1 0 DEZ 0.000000 256.000000 NUMBER 2 /end CHARACTERISTIC
/begin CHARACTERISTIC FFTLASH1 "Freeze Frame Tabelle: Diagnose Lambdasonden-Alterung hinter Kat" VAL_BLK 0x890F DAMOS_FWB1 0 DEZ 0.000000 256.000000 NUMBER 2 /end CHARACTERISTIC
/begin CHARACTERISTIC FFTLATP1 "Freeze Frame Tabelle: Diagnose Lambdasonden-Alterung TP" VAL_BLK 0x890B DAMOS_FWB1 0 DEZ 0.000000 256.000000 NUMBER 2 /end CHARACTERISTIC
/begin CHARACTERISTIC FFTLATV1 "Freeze Frame Tabelle: Diagnose Lambdasonden-Alterung TV" VAL_BLK 0x890D DAMOS_FWB1 0 DEZ 0.000000 256.000000 NUMBER 2 /end CHARACTERISTIC
/begin CHARACTERISTIC FFTLFR "Freeze Frame Tabelle: LFR-Diagnose" VAL_BLK 0x88D1 DAMOS_FWB1 0 DEZ 0.000000 256.000000 NUMBER 2 /end CHARACTERISTIC
/begin CHARACTERISTIC FFTLSH1 "Freeze Frame Tabelle: Diagnose Lambdasonde hinter Kat (Index 41)" VAL_BLK 0x8909 DAMOS_FWB1 0 DEZ 0.000000 256.000000 NUMBER 2 /end CHARACTERISTIC
/begin CHARACTERISTIC FFTLSV1 "Freeze Frame Tabelle: Diagnosebits Lambdasondendiagn. vor Kat Bank1" VAL_BLK 0x8907 DAMOS_FWB1 0 DEZ 0.000000 256.000000 NUMBER 2 /end CHARACTERISTIC
/begin CHARACTERISTIC FFTLUES1 "Freeze Frame Tabelle: Endstufen-Diagnosebits fuer Luefter Stufe 1" VAL_BLK 0x88DB DAMOS_FWB1 0 DEZ 0.000000 256.000000 NUMBER 2 /end CHARACTERISTIC
/begin CHARACTERISTIC FFTLUES2 "Freeze Frame Tabelle: Endstufen-Diagnosebits fuer Luefter Stufe 2" VAL_BLK 0x88DD DAMOS_FWB1 0 DEZ 0.000000 256.000000 NUMBER 2 /end CHARACTERISTIC
/begin CHARACTERISTIC FFTMD "Freeze Frame Tabelle: Diagnose Aussetzererkennung gesamt " VAL_BLK 0x88FB DAMOS_FWB1 0 DEZ 0.000000 256.000000 NUMBER 2 /end CHARACTERISTIC
/begin CHARACTERISTIC FFTMD1 "Freeze Frame Tabelle: Diagnose Aussetzererkennung Zyl. 1 " VAL_BLK 0x88FD DAMOS_FWB1 0 DEZ 0.000000 256.000000 NUMBER 2 /end CHARACTERISTIC
/begin CHARACTERISTIC FFTMD2 "Freeze Frame Tabelle: Diagnose Aussetzererkennung Zyl. 2 " VAL_BLK 0x88FF DAMOS_FWB1 0 DEZ 0.000000 256.000000 NUMBER 2 /end CHARACTERISTIC
/begin CHARACTERISTIC FFTMD3 "Freeze Frame Tabelle: Diagnose Aussetzererkennung Zyl. 3 " VAL_BLK 0x8901 DAMOS_FWB1 0 DEZ 0.000000 256.000000 NUMBER 2 /end CHARACTERISTIC
/begin CHARACTERISTIC FFTMD4 "Freeze Frame Tabelle: Diagnose Aussetzererkennung Zyl. 4 " VAL_BLK 0x8903 DAMOS_FWB1 0 DEZ 0.000000 256.000000 NUMBER 2 /end CHARACTERISTIC
/begin CHARACTERISTIC FFTMD5 "Freeze Frame Tabelle: Diagnose Aussetzererkennung Zyl. 5 " VAL_BLK 0x8905 DAMOS_FWB1 0 DEZ 0.000000 256.000000 NUMBER 2 /end CHARACTERISTIC
/begin CHARACTERISTIC FFTMILFB "Freeze Frame: Diagnose Mil fremdbestimmt" VAL_BLK 0x892F DAMOS_FWB1 0 DEZ 0.000000 256.000000 NUMBER 2 /end CHARACTERISTIC
/begin CHARACTERISTIC FFTNWSE "Freeze Frame Tabelle: Endstufendiagnose-Bits NWS" VAL_BLK 0x88F3 DAMOS_FWB1 0 DEZ 0.000000 256.000000 NUMBER 2 /end CHARACTERISTIC
/begin CHARACTERISTIC FFTPAC "Freeze Frame: Diagnose Klimadrucksensor" VAL_BLK 0x8935 DAMOS_FWB1 0 DEZ 0.000000 256.000000 NUMBER 2 /end CHARACTERISTIC
/begin CHARACTERISTIC FFTPEDST "Freeze Frame Tabelle: Diagnose Bits Pedalanschlag" VAL_BLK 0x88CB DAMOS_FWB1 0 DEZ 0.000000 256.000000 NUMBER 2 /end CHARACTERISTIC
/begin CHARACTERISTIC FFTPH "Freeze Frame Tabelle: Diagnosebits Phasensensor" VAL_BLK 0x88BF DAMOS_FWB1 0 DEZ 0.000000 256.000000 NUMBER 2 /end CHARACTERISTIC
/begin CHARACTERISTIC FFTPMOEL " " VAL_BLK 0x88C3 DAMOS_FWB1 0 DEZ 0.000000 256.000000 NUMBER 2 /end CHARACTERISTIC
/begin CHARACTERISTIC FFTPWG "Freeze Frame Tabelle: Diagnose-Bits PWG" VAL_BLK 0x88C9 DAMOS_FWB1 0 DEZ 0.000000 256.000000 NUMBER 2 /end CHARACTERISTIC
/begin CHARACTERISTIC FFTRSKA "Freeze Frame Tabelle: Diagnose reversible Sicherheitskraftstoffabschalten" VAL_BLK 0x88CD DAMOS_FWB1 0 DEZ 0.000000 256.000000 NUMBER 2 /end CHARACTERISTIC
/begin CHARACTERISTIC FFTSKAUM "Freeze Frame Tabelle: Diagnose Sicherheitskraftstoffab. von Ueberwachungsfkt." VAL_BLK 0x88CF DAMOS_FWB1 0 DEZ 0.000000 256.000000 NUMBER 2 /end CHARACTERISTIC
/begin CHARACTERISTIC FFTSUE "Freeze Frame Tabelle: Endstufendiagnose-Bits Saugrohrumschaltung" VAL_BLK 0x88F1 DAMOS_FWB1 0 DEZ 0.000000 256.000000 NUMBER 2 /end CHARACTERISTIC
/begin CHARACTERISTIC FFTSWE "Freeze Frame Tabelle: Schlechtwegerkennung" VAL_BLK 0x8927 DAMOS_FWB1 0 DEZ 0.000000 256.000000 NUMBER 2 /end CHARACTERISTIC
/begin CHARACTERISTIC FFTTEVE "Freeze Frame Tabelle: Endstufendiagnose-Bits TEV" VAL_BLK 0x88E9 DAMOS_FWB1 0 DEZ 0.000000 256.000000 NUMBER 2 /end CHARACTERISTIC
/begin CHARACTERISTIC FFTTFA "Freeze Frame Tabelle: Diagnosebits Ansauglufttemperaturfuehler" VAL_BLK 0x88B9 DAMOS_FWB1 0 DEZ 0.000000 256.000000 NUMBER 2 /end CHARACTERISTIC
/begin CHARACTERISTIC FFTTFM "Freeze Frame Tabelle: Diagnosebits Motortemperaturfuehler" VAL_BLK 0x88B7 DAMOS_FWB1 0 DEZ 0.000000 256.000000 NUMBER 2 /end CHARACTERISTIC
/begin CHARACTERISTIC FFTTRA1 "Freeze Frame Tabelle: LR-Adaption QL-additiv, Bank1" VAL_BLK 0x8921 DAMOS_FWB1 0 DEZ 0.000000 256.000000 NUMBER 2 /end CHARACTERISTIC
/begin CHARACTERISTIC FFTUB "Freeze Frame Tabelle: Diagnosebits Batteriespannung" VAL_BLK 0x88C1 DAMOS_FWB1 0 DEZ 0.000000 256.000000 NUMBER 2 /end CHARACTERISTIC
/begin CHARACTERISTIC FFTVFZ "Freeze Frame Tabelle: Diagnose Geschwindigkeitssignal" VAL_BLK 0x88BB DAMOS_FWB1 0 DEZ 0.000000 256.000000 NUMBER 2 /end CHARACTERISTIC
/begin CHARACTERISTIC FFTVTSK "Freeze Frame Tabelle: Diagnose FGR-Bedienhebel" VAL_BLK 0x8919 DAMOS_FWB1 0 DEZ 0.000000 256.000000 NUMBER 2 /end CHARACTERISTIC
/begin CHARACTERISTIC FFTWFS "Freeze Frame Tabelle: WFS Fehler" VAL_BLK 0x88D9 DAMOS_FWB1 0 DEZ 0.000000 256.000000 NUMBER 2 /end CHARACTERISTIC
/begin CHARACTERISTIC FFTZZZ "" VAL_BLK 0x8937 DAMOS_FWB1 0 DEZ 0.000000 256.000000 NUMBER 2 /end CHARACTERISTIC
/begin CHARACTERISTIC FGAT0 "ti-Grundanpassungsfaktor" VALUE 0x8129 DAMOS_FW1 0 FKT128 0.000000 1.992188 EXTENDED_LIMITS 0.000000 1.992190 /end CHARACTERISTIC
/begin CHARACTERISTIC FGRENABLE "FGR enable, grundsätzlich vorhanden bei diesem Fahrzg." VALUE 0x8768 DAMOS_FW1 0 DEZ 0.000000 256.000000 /end CHARACTERISTIC
/begin CHARACTERISTIC FGR_VAUS "min. zulaessige FGR-Geschw. Ausschaltkrit." VALUE 0x8662 DAMOS_FW3 0 VQV16L 20.000000 4095.938000 EXTENDED_LIMITS 0.000000 4095.940000 /end CHARACTERISTIC
/begin CHARACTERISTIC FGR_VMAX "Tempomat Maximalgeschwindigkeit " VALUE 0x868A DAMOS_FW3 0 VQV16L 0.000000 4095.938000 EXTENDED_LIMITS 0.000000 4095.940000 /end CHARACTERISTIC
/begin CHARACTERISTIC FGR_VMIN "minimale zulaesige FGR-Geschwindigkeit" VALUE 0x8660 DAMOS_FW3 0 VQV16L 0.000000 4095.938000 EXTENDED_LIMITS 0.000000 4095.940000 /end CHARACTERISTIC
/begin CHARACTERISTIC FIAMALU "Anhebungsfaktor fuer Filter Mehrfachaussetzererkennung" VALUE 0x8309 DAMOS_FW1 0 FKT64 0.000000 3.984375 EXTENDED_LIMITS 0.000000 3.984380 /end CHARACTERISTIC
/begin CHARACTERISTIC FIAT_BYTES "Fiat Bytes" CURVE 0x80F0 DAMOS_FKL1 0 DEZ 0.000000 256.000000
 /begin AXIS_DESCR FIX_AXIS IR0 DEZ 5 0.000000 4.000000 FIX_AXIS_PAR 0 0 5 EXTENDED_LIMITS 0.000000 256.000000 /end AXIS_DESCR
/end CHARACTERISTIC
/begin CHARACTERISTIC FIAT_HW_NR "FIAT Bestell-Nr." ASCII 0x80C6 DAMOS_ASCII 0 NoCompuMethod 0.000000 0.000000 NUMBER 11 EXTENDED_LIMITS 0.000000 256.000000 /end CHARACTERISTIC
/begin CHARACTERISTIC FIBSALU "Filterfaktor Beschl.signal bei Schlechtwegerk." VALUE 0x82FC DAMOS_FW3 0 FKT65536 0.000000 1.000000 /end CHARACTERISTIC
/begin CHARACTERISTIC FIMALU "Filterfaktor Mehrfachaussetzererkennung" VALUE 0x8308 DAMOS_FW1 0 FKT256 0.000000 0.996094 EXTENDED_LIMITS 0.000000 0.996090 /end CHARACTERISTIC
/begin CHARACTERISTIC FIMHU "Einspritzfaktor hartes Wiedereinsetzen, Aquidistante Abstaende/ 1.000  NWU" CURVE 0x9B93 DAMOS_GKL1 0 FKT128 0.000000 1.992188
 /begin AXIS_DESCR COM_AXIS IR0 DEZ 16 0.000000 0.000000 AXIS_PTS_REF DUM16 EXTENDED_LIMITS 0.000000 256.000000 /end AXIS_DESCR
 EXTENDED_LIMITS 0.000000 1.992190 /end CHARACTERISTIC
/begin CHARACTERISTIC FIMWU "Einspritzfaktor weiches Wiedereinsetzen, Aquidistante Abstaende/ 1.000  NWU" CURVE 0x9B83 DAMOS_GKL1 0 FKT128 0.000000 1.992188
 /begin AXIS_DESCR COM_AXIS IR0 DEZ 16 0.000000 0.000000 AXIS_PTS_REF DUM16 EXTENDED_LIMITS 0.000000 256.000000 /end AXIS_DESCR
 EXTENDED_LIMITS 0.000000 1.992190 /end CHARACTERISTIC
/begin CHARACTERISTIC FKELDY " Korrekturfaktor fuer Klopferkennungsschwelle bei Lastdynamik" VALUE 0x82B1 DAMOS_FW1 0 FKT64 0.000000 3.984375 EXTENDED_LIMITS 0.000000 3.984380 /end CHARACTERISTIC
/begin CHARACTERISTIC FKELDYA " Korekturfaktor fuer Klopferkennungsschwelle bei Lastdynamik" VALUE 0x82B3 DAMOS_FW1 0 FKT64 0.000000 3.984375 EXTENDED_LIMITS 0.000000 3.984380 /end CHARACTERISTIC
/begin CHARACTERISTIC FKHM "Warmlauffaktor bei Katheizen in Teillast" CURVE 0x9788 DAMOS_KL97 0 FKT128 0.000000 1.992188 /begin AXIS_DESCR STD_AXIS TMOT CMO_TMP 6 -41.000000 140.000000 /end AXIS_DESCR EXTENDED_LIMITS 0.000000 1.992190 /end CHARACTERISTIC
/begin CHARACTERISTIC FKSHA "Einspritzfaktor FKSHA als f(FDKHA)" CURVE 0x947D DAMOS_GKL1 0 FKT256 0.000000 0.996094
 /begin AXIS_DESCR COM_AXIS FDKHA FKT128 8 0.000000 0.000000 AXIS_PTS_REF FDKHAV08 EXTENDED_LIMITS 0.000000 1.992190 /end AXIS_DESCR
 EXTENDED_LIMITS 0.000000 0.996090 /end CHARACTERISTIC
/begin CHARACTERISTIC FLFO " " VALUE 0x831E DAMOS_FW4 0 FKT32768_S -1.000000 0.999969 EXTENDED_LIMITS -1.000000 0.999970 /end CHARACTERISTIC
/begin CHARACTERISTIC FLKHM "Warmlauffaktor bei Katheizen in Leerlauf" CURVE 0x9798 DAMOS_KL97 0 FKT128 0.000000 1.992188 /begin AXIS_DESCR STD_AXIS TMOT CMO_TMP 6 -41.000000 140.000000 /end AXIS_DESCR EXTENDED_LIMITS 0.000000 1.992190 /end CHARACTERISTIC
/begin CHARACTERISTIC FLKHM1 "Warmlauffaktor bei Katheizen in Leerlauf bei Automat" CURVE 0x97F4 DAMOS_KL97 0 FKT128 0.000000 1.992188 /begin AXIS_DESCR STD_AXIS TMOT CMO_TMP 6 -41.000000 140.000000 /end AXIS_DESCR EXTENDED_LIMITS 0.000000 1.992190 /end CHARACTERISTIC
/begin CHARACTERISTIC FLURKDN " " VALUE 0x8305 DAMOS_FW1 0 FKT64 0.000000 3.984375 EXTENDED_LIMITS 0.000000 3.984380 /end CHARACTERISTIC
/begin CHARACTERISTIC FLURKDX " " VALUE 0x8306 DAMOS_FW1 0 FKT64 0.000000 3.984375 EXTENDED_LIMITS 0.000000 3.984380 /end CHARACTERISTIC
/begin CHARACTERISTIC FLUTN " " CURVE 0xB71D DAMOS_GKL1 0 PHI1_SY 0.000000 99.609380
 /begin AXIS_DESCR COM_AXIS NIST NQ25 8 0.000000 0.000000 AXIS_PTS_REF NDMDV08 EXTENDED_LIMITS 0.000000 6400.000000 /end AXIS_DESCR
 EXTENDED_LIMITS 0.000000 99.609400 /end CHARACTERISTIC
/begin CHARACTERISTIC FLUV1 "Schalter der Modifikation 1 der Laufunruhe-Berechnung" VALUE 0x830A DAMOS_FW1 0 DEZ 0.000000 256.000000 /end CHARACTERISTIC
/begin CHARACTERISTIC FLUV2 "Schalter der Modifikation 2 der Laufunruhe-Berechnung" VALUE 0x830B DAMOS_FW1 0 DEZ 0.000000 256.000000 /end CHARACTERISTIC
/begin CHARACTERISTIC FMFKR "Bandmittenfreq. x,x,x,x,BF3,BF2,BF1,BF0 " VALUE 0x82B0 DAMOS_FW1 0 DEZ 0.000000 256.000000 /end CHARACTERISTIC
/begin CHARACTERISTIC FMLUB "Faktor für Ubatt" CURVE 0xCF8A DAMOS_KL97 0 FKT256_1 1.000000 2.000000
 /begin AXIS_DESCR STD_AXIS UBATT UBQ 5 0.000000 24.119630 EXTENDED_LIMITS 0.000000 24.119600 /end AXIS_DESCR
/end CHARACTERISTIC
/begin CHARACTERISTIC FMLVFZ "Faktor für Fahrzeuggeschw." CURVE 0xCF7A DAMOS_KL97 0 FKT256 0.000000 0.996094 /begin AXIS_DESCR STD_AXIS VFZG VQV 6 0.000000 306.000000 /end AXIS_DESCR EXTENDED_LIMITS 0.000000 0.996090 /end CHARACTERISTIC
/begin CHARACTERISTIC FPR_AT "Ansauglufttemperaturschwelle fuer Federpruefung" VALUE 0x84BC DAMOS_FW1 0 CLU_TMP -50.000000 150.000000 /end CHARACTERISTIC
/begin CHARACTERISTIC FPR_MT "Motortemperaturschwelle fuer Federpruefung" VALUE 0x84BB DAMOS_FW1 0 CMO_TMP -41.000000 140.000000 /end CHARACTERISTIC
/begin CHARACTERISTIC FRADN "Untere fra-Schwelle fuer Fehlererkennung im Kraftstoffversorgungssystem " VALUE 0x841E DAMOS_FW3 0 FPC50L 0.500000 1.499985 EXTENDED_LIMITS 0.500000 1.499980 /end CHARACTERISTIC
/begin CHARACTERISTIC FRADX "Obere fra-Schwelle fuer Fehlererkennung im Kraftstoffversorgungssystem " VALUE 0x8420 DAMOS_FW3 0 FPC50L 0.500000 1.499985 EXTENDED_LIMITS 0.500000 1.499980 /end CHARACTERISTIC
/begin CHARACTERISTIC FRAE "DELTA-fra-Schwelle fuer Erkennung der eingeschwungenen Grundadaption " VALUE 0x8422 DAMOS_FW3 0 FKT65536 0.000000 1.000000 /end CHARACTERISTIC
/begin CHARACTERISTIC FRALLM "Gemischfaktor im Leerlauf unterhalb Drehzahlschwelle und Lambdaregelung inaktiv" CURVE 0x9B72 DAMOS_KL97 0 FKT128 0.000000 1.992188 /begin AXIS_DESCR STD_AXIS TMOT CMO_TMP 7 -41.000000 140.000000 /end AXIS_DESCR EXTENDED_LIMITS 0.000000 1.992190 /end CHARACTERISTIC
/begin CHARACTERISTIC FRAOMN "Minimalwert FRAO-Integrator" VALUE 0x8220 DAMOS_FW3 0 FPC50L 0.500000 1.499985 EXTENDED_LIMITS 0.500000 1.499980 /end CHARACTERISTIC
/begin CHARACTERISTIC FRAOMX "Maximalwert FRAO-Integrator" VALUE 0x8222 DAMOS_FW3 0 FPC50L 0.500000 1.499985 EXTENDED_LIMITS 0.500000 1.499980 /end CHARACTERISTIC
/begin CHARACTERISTIC FRARN "Reduzierte untere Begrenzung des Korrekturfaktors fra " VALUE 0x8424 DAMOS_FW3 0 FPC50L 0.500000 1.499985 EXTENDED_LIMITS 0.500000 1.499980 /end CHARACTERISTIC
/begin CHARACTERISTIC FRARX "Reduzierte obere Begrenzung des Korrekturfaktors fra " VALUE 0x8426 DAMOS_FW3 0 FPC50L 0.500000 1.499985 EXTENDED_LIMITS 0.500000 1.499980 /end CHARACTERISTIC
/begin CHARACTERISTIC FRAUMN "Minimalwert FRAU-Integrator" VALUE 0x821C DAMOS_FW3 0 FPC50L 0.500000 1.499985 EXTENDED_LIMITS 0.500000 1.499980 /end CHARACTERISTIC
/begin CHARACTERISTIC FRAUMX "Maximalwert FRAU-Integrator" VALUE 0x821E DAMOS_FW3 0 FPC50L 0.500000 1.499985 EXTENDED_LIMITS 0.500000 1.499980 /end CHARACTERISTIC
/begin CHARACTERISTIC FRINOF "Faktor fuer Bewertung alter Ri-Wert ohne Filter" VALUE 0x83ED DAMOS_FW1 0 FKT16 0.000000 15.937500 /end CHARACTERISTIC
/begin CHARACTERISTIC FRMAX "Integratormaximalwert" VALUE 0x81DE DAMOS_FW3 0 FPC50L 0.500000 1.499985 EXTENDED_LIMITS 0.500000 1.499980 /end CHARACTERISTIC
/begin CHARACTERISTIC FRMIN "Integratorminimalwert" VALUE 0x81DC DAMOS_FW3 0 FPC50L 0.500000 1.499985 EXTENDED_LIMITS 0.500000 1.499980 /end CHARACTERISTIC
/begin CHARACTERISTIC FRMIN1 "untere FR-Begrenzung im Temperaturbereich 1" VALUE 0x81D0 DAMOS_FW3 0 FPC50L 0.500000 1.499985 EXTENDED_LIMITS 0.500000 1.499980 /end CHARACTERISTIC
/begin CHARACTERISTIC FRMIN2 "untere FR-Begrenzung im Temperaturbereich 2" VALUE 0x81D2 DAMOS_FW3 0 FPC50L 0.500000 1.499985 EXTENDED_LIMITS 0.500000 1.499980 /end CHARACTERISTIC
/begin CHARACTERISTIC FRMINTS1 "Temperaturschwelle 1 fuer frmin-Bildung" VALUE 0x81D4 DAMOS_FW1 0 CMO_TMP -41.000000 140.000000 /end CHARACTERISTIC
/begin CHARACTERISTIC FRMINTS2 "Temperaturschwelle 2 fuer frmin-Bildung" VALUE 0x81D5 DAMOS_FW1 0 CMO_TMP -41.000000 140.000000 /end CHARACTERISTIC
/begin CHARACTERISTIC FRMLASHO "obere Schwelle fuer Mittelwert des Lambdaregelfaktors" VALUE 0x834E DAMOS_FW3 0 FPC50L 0.500000 1.499985 EXTENDED_LIMITS 0.500000 1.499980 /end CHARACTERISTIC
/begin CHARACTERISTIC FRMLASHU "untere Schwelle fuer Mittelwert des Lambdaregelfaktors" VALUE 0x8350 DAMOS_FW3 0 FPC50L 0.500000 1.499985 EXTENDED_LIMITS 0.500000 1.499980 /end CHARACTERISTIC
/begin CHARACTERISTIC FRTEO "Obere Lambdaregelschwelle fuer Grenzwertregelung Tankentl." VALUE 0x82C6 DAMOS_FW3 0 FPC50L 0.500000 1.499985 EXTENDED_LIMITS 0.500000 1.499980 /end CHARACTERISTIC
/begin CHARACTERISTIC FRTEU "Untere Lambdaregelschwelle fuer Grenzwertregelung Tankentl." VALUE 0x82C4 DAMOS_FW3 0 FPC50L 0.500000 1.499985 EXTENDED_LIMITS 0.500000 1.499980 /end CHARACTERISTIC
/begin CHARACTERISTIC FS1FO " " VALUE 0x831A DAMOS_FW4 0 FKT32768_S -1.000000 0.999969 EXTENDED_LIMITS -1.000000 0.999970 /end CHARACTERISTIC
/begin CHARACTERISTIC FS2FO " " VALUE 0x831C DAMOS_FW4 0 FKT32768_S -1.000000 0.999969 EXTENDED_LIMITS -1.000000 0.999970 /end CHARACTERISTIC
/begin CHARACTERISTIC FSAOFFM "Integratoranhebung beim Schalten nach P/N " CURVE 0xC412 DAMOS_KL97 0 PER6SP 0.000000 6.225776 /begin AXIS_DESCR STD_AXIS TMOT CMO_TMP 9 -41.000000 140.000000 /end AXIS_DESCR EXTENDED_LIMITS 0.000000 6.225780 /end CHARACTERISTIC
/begin CHARACTERISTIC FSEOFFM "Integratoranhebung beim Schalten nach Drive " CURVE 0xC3FC DAMOS_KL97 0 PER6SP 0.000000 6.225776 /begin AXIS_DESCR STD_AXIS TMOT CMO_TMP 9 -41.000000 140.000000 /end AXIS_DESCR EXTENDED_LIMITS 0.000000 6.225780 /end CHARACTERISTIC
/begin CHARACTERISTIC FSTRES "Tank leer - Schwelle" VALUE 0x82EB DAMOS_FW1 0 U5V 0.000000 5.000000 /end CHARACTERISTIC
/begin CHARACTERISTIC FSWALUV "KL Erkennungsschwelle Schlechtwegerkennung" CURVE 0xD572 DAMOS_KL97 0 BSCHL_25 0.000000 25.000000 /begin AXIS_DESCR STD_AXIS V_CAN VQV 6 0.000000 306.000000 /end AXIS_DESCR /end CHARACTERISTIC
/begin CHARACTERISTIC FTEADAB "Schwelle Beladung für Abbruch TE-Phase" VALUE 0x82D2 DAMOS_FW3 0 SIG32L -32.000000 31.999020 EXTENDED_LIMITS -32.000000 31.999000 /end CHARACTERISTIC
/begin CHARACTERISTIC FTEADINI "Initialisierung Beladungsfaktor" VALUE 0x82D4 DAMOS_FW3 0 SIG32L -32.000000 31.999020 EXTENDED_LIMITS -32.000000 31.999000 /end CHARACTERISTIC
/begin CHARACTERISTIC FTEADMN "Maximalwert der Beladung des AKF" VALUE 0x82D6 DAMOS_FW3 0 SIG32L -32.000000 31.999020 EXTENDED_LIMITS -32.000000 31.999000 /end CHARACTERISTIC
/begin CHARACTERISTIC FTEADMX "Maximalwert der Beladung des AKF" VALUE 0x82D8 DAMOS_FW3 0 SIG32L -32.000000 31.999020 EXTENDED_LIMITS -32.000000 31.999000 /end CHARACTERISTIC
/begin CHARACTERISTIC FTEFHB "Schwelle der Spuelrate fuer hohe Beladung" VALUE 0x82C8 DAMOS_FW3 0 FKT512L 0.000000 128.000000 /end CHARACTERISTIC
/begin CHARACTERISTIC FTEFVAA "Anfangsbegrenzung der Spuelrate" VALUE 0x82B8 DAMOS_FW1 0 FKT512 0.000000 0.500000 /end CHARACTERISTIC
/begin CHARACTERISTIC FTEHB "Schwelle des Tankentlueftungsfaktors fuer hohe Beladung" VALUE 0x82CA DAMOS_FW3 0 SIG32L -32.000000 31.999020 EXTENDED_LIMITS -32.000000 31.999000 /end CHARACTERISTIC
/begin CHARACTERISTIC FUKNSTM "Startwert Faktor ÜK im Nachstart" CURVE 0x9CBB DAMOS_GKL1 0 FKT64 0.000000 3.984375
 /begin AXIS_DESCR COM_AXIS TMOT CMO_TMP 12 0.000000 0.000000 AXIS_PTS_REF TMOTV08 EXTENDED_LIMITS -41.000000 140.000000 /end AXIS_DESCR
 EXTENDED_LIMITS 0.000000 3.984380 /end CHARACTERISTIC
/begin CHARACTERISTIC FUZNSM "Nachstart-Filterzeitkonstanten-Umschaltschwelle" CURVE 0x96E4 DAMOS_GKL1 0 FKT128 0.000000 1.992188
 /begin AXIS_DESCR COM_AXIS TMOT CMO_TMP 12 0.000000 0.000000 AXIS_PTS_REF TMOTV08 EXTENDED_LIMITS -41.000000 140.000000 /end AXIS_DESCR
 EXTENDED_LIMITS 0.000000 1.992190 /end CHARACTERISTIC
/begin CHARACTERISTIC FVANST "Gewichtungsfaktor VA im Nachstart" VALUE 0x8154 DAMOS_FW1 0 FKT128 0.000000 1.992188 EXTENDED_LIMITS 0.000000 1.992190 /end CHARACTERISTIC
/begin CHARACTERISTIC FVAWM "Faktor Verzoegerungsabmagerung Motortemperatur DK-Anteil" CURVE 0x9CAF DAMOS_GKL1 0 FKT16 0.000000 15.937500
 /begin AXIS_DESCR COM_AXIS TMOT CMO_TMP 12 0.000000 0.000000 AXIS_PTS_REF TMOTV08 EXTENDED_LIMITS -41.000000 140.000000 /end AXIS_DESCR
/end CHARACTERISTIC
/begin CHARACTERISTIC FVAWN "Faktor Verzoegerungsabmagerung DK-Anteil" CURVE 0x9C9B DAMOS_GKL1 0 FKT32 0.000000 7.968750
 /begin AXIS_DESCR COM_AXIS NIST NQ25 8 0.000000 0.000000 AXIS_PTS_REF NISTV08 EXTENDED_LIMITS 0.000000 6400.000000 /end AXIS_DESCR
/end CHARACTERISTIC
/begin CHARACTERISTIC FWANSTL "Faktor fuer Zuendwinkelkorrektur durch Ansaugluft" CURVE 0xA5D1 DAMOS_GKL1 0 FKT256 0.000000 0.996094
 /begin AXIS_DESCR COM_AXIS TL8 UFUELL 8 0.000000 0.000000 AXIS_PTS_REF TL8V08 EXTENDED_LIMITS 0.000000 191.250000 /end AXIS_DESCR
 EXTENDED_LIMITS 0.000000 0.996090 /end CHARACTERISTIC
/begin CHARACTERISTIC FWMRED "Maske für Ein-/Ausschalten Momentenreduktion" VALUE 0x8789 DAMOS_FW1 0 DEZ 0.000000 256.000000 /end CHARACTERISTIC
/begin CHARACTERISTIC FWMRED1 "Maske für Ein-/Ausschalten Momentenreduktion" VALUE 0x878A DAMOS_FW1 0 DEZ 0.000000 256.000000 /end CHARACTERISTIC
/begin CHARACTERISTIC FWMREDACC " Unterfunktionen in ACC ein-/ausschaltbar" VALUE 0x851B DAMOS_FW1 0 DEZ 0.000000 256.000000 /end CHARACTERISTIC
/begin CHARACTERISTIC FWMREDASR "Maske für Ein-/Ausschalten Momentenreduktion ASR" VALUE 0x878B DAMOS_FW1 0 DEZ 0.000000 256.000000 /end CHARACTERISTIC
/begin CHARACTERISTIC FWMREDMSR "MSR-Maske" VALUE 0x8610 DAMOS_FW1 0 DEZ 0.000000 256.000000 /end CHARACTERISTIC
/begin CHARACTERISTIC FWMREDNCA "Maske für Konfiguration NCA" VALUE 0x8542 DAMOS_FW1 0 DEZ 0.000000 256.000000 /end CHARACTERISTIC
/begin CHARACTERISTIC FZNS "Nachstart: Wichtungsfaktor für Zeitkonstante" VALUE 0x8147 DAMOS_FW1 0 K16 0.062745 16.000000 /end CHARACTERISTIC
/begin CHARACTERISTIC FZQTE "Faktor Absteuerung Spuelrate bei Ausschalten Tankentlueftung" VALUE 0x82B9 DAMOS_FW1 0 FKT16 0.000000 15.937500 /end CHARACTERISTIC
/begin CHARACTERISTIC F_M_UG "Untergrenzen-Anteil bei Fahrt als f(NIST)" CURVE 0xBFA9 DAMOS_GKL1 0 UWKL10 0.000000 10.069900
 /begin AXIS_DESCR COM_AXIS NIST NQ25 9 0.000000 0.000000 AXIS_PTS_REF NISTV10 EXTENDED_LIMITS 0.000000 6400.000000 /end AXIS_DESCR
/end CHARACTERISTIC
/begin CHARACTERISTIC GBDKD1 "DKBVF Reduzierrampendelta 1 f. beschleunigte Vorbeifahrt" VALUE 0x8562 DAMOS_FW3 0 UDKL 0.000000 10.112030 EXTENDED_LIMITS 0.000000 10.112000 /end CHARACTERISTIC
/begin CHARACTERISTIC GBDKD2 "DKBVF Reduzierrampendelta 2 f. beschleunigte Vorbeifahrt" VALUE 0x8564 DAMOS_FW3 0 UDKL 0.000000 10.112030 EXTENDED_LIMITS 0.000000 10.112000 /end CHARACTERISTIC
/begin CHARACTERISTIC GBDKRUE "DKBVF DK_Rücksprung f. beschleunigte Vorbeifahrt" VALUE 0x8560 DAMOS_FW3 0 UDKL 0.000000 10.112030 EXTENDED_LIMITS 0.000000 10.112000 /end CHARACTERISTIC
/begin CHARACTERISTIC GBNO "DKBVF obere Drehzahlschwelle f. beschleunigte Vorbeifahrt" VALUE 0x855B DAMOS_FW1 0 NQ25 0.000000 6400.000000 /end CHARACTERISTIC
/begin CHARACTERISTIC GBNU "DKBVF untere Drehzahlschwelle f. beschleunigte Vorbeifahrt" VALUE 0x855A DAMOS_FW1 0 NQ25 0.000000 6400.000000 /end CHARACTERISTIC
/begin CHARACTERISTIC GBPEDGR "DKBVF Schwelle Pedalwertgradient f. beschleunigte Vorbeifahrt" VALUE 0x8566 DAMOS_FW4 0 PER0327LS -100.003000 100.000000 /end CHARACTERISTIC
/begin CHARACTERISTIC GBTDKR "DKBVF Zeitdauer nach Rücksprung f. beschleunigte Vorbeifahrt" VALUE 0x8569 DAMOS_FW1 0 TQ100 0.000000 25.500000 /end CHARACTERISTIC
/begin CHARACTERISTIC GBTMOT "DKBVF Motortemperaturschwelle f. beschleunigte Vorbeifahrt" VALUE 0x855C DAMOS_FW1 0 CMO_TMP -41.000000 140.000000 /end CHARACTERISTIC
/begin CHARACTERISTIC GBTVST "DKBVF Wartezeit f. beschleunigte Vorbeifahrt" VALUE 0x8568 DAMOS_FW1 0 TQ100 0.000000 25.500000 /end CHARACTERISTIC
/begin CHARACTERISTIC GBVAR "DKBVF Variantenauswahl f. beschleunigte Vorbeifahrt" VALUE 0x856A DAMOS_FW1 0 DEZ 0.000000 256.000000 /end CHARACTERISTIC
/begin CHARACTERISTIC GBVO "DKBVF obere Geschwindigkeitsschwelle f. beschleunigte Vorbeifahrt" VALUE 0x855E DAMOS_FW1 0 VQV 0.000000 306.000000 /end CHARACTERISTIC
/begin CHARACTERISTIC GBVU "DKBVF untere Geschwindigkeitsschwelle f. beschleunigte Vorbeifahrt" VALUE 0x855D DAMOS_FW1 0 VQV 0.000000 306.000000 /end CHARACTERISTIC
/begin CHARACTERISTIC GR_ABW "Grossignal-Abweichung Sollwert - Istwert" VALUE 0x862B DAMOS_FW1 0 PER_DKA 0.000000 100.000000 /end CHARACTERISTIC
/begin CHARACTERISTIC HGUE5 "Handschaltgetriebe Getriebeuebersetzung 5" VALUE 0x8559 DAMOS_FW1 0 FKT51 0.000000 4.980469 EXTENDED_LIMITS 0.000000 4.980470 /end CHARACTERISTIC
/begin CHARACTERISTIC HYSTERESE "Pedalhysterese" VALUE 0x8596 DAMOS_FW3 0 PER0327 0.000000 100.000000 /end CHARACTERISTIC
/begin CHARACTERISTIC ILMLKAX "Schwelle ILMLKA-Fettflaeche uer LRKA" VALUE 0x8576 DAMOS_FW3 0 MLQP512L 0.000000 12799.800000 /end CHARACTERISTIC
/begin CHARACTERISTIC ILMLKAXD "Schwelle Fettflaeche Kat-Ausraeumen nach DSLS" VALUE 0x856C DAMOS_FW3 0 MLQP512L 0.000000 12799.800000 /end CHARACTERISTIC
/begin CHARACTERISTIC ILMLKAXS "Schwelle Fettflaeche Kat-Ausraeumen nach SLS" VALUE 0x856E DAMOS_FW3 0 MLQP512L 0.000000 12799.800000 /end CHARACTERISTIC
/begin CHARACTERISTIC ILRSLAB "Integratorsteigung bei Ende Diagnose SL-System" VALUE 0x81E2 DAMOS_FW1 0 FRIQ 0.000000 0.778198 EXTENDED_LIMITS 0.000000 0.778200 /end CHARACTERISTIC
/begin CHARACTERISTIC ILRSLAU "Integratorsteigung bei Start Diagnose SL-System" VALUE 0x81E1 DAMOS_FW1 0 FRIQ 0.000000 0.778198 EXTENDED_LIMITS 0.000000 0.778200 /end CHARACTERISTIC
/begin CHARACTERISTIC IMLATMU "ATM - Luftmassen-Schwellwert - unterhalb wird kleinere Luftmasse integriert" VALUE 0x8260 DAMOS_FW3 0 MLQ010L 0.000000 6553.500000 /end CHARACTERISTIC
/begin CHARACTERISTIC IMLFLL "Faktor fuer geringere Luftmassenwerte zur Integr. im Leerlauf oder kleiner LM" VALUE 0x825F DAMOS_FW1 0 FKT256 0.000000 0.996094 EXTENDED_LIMITS 0.000000 0.996090 /end CHARACTERISTIC
/begin CHARACTERISTIC IMLKAMN "Schwelle fuer IMLKA Mindestdauer LRKA" VALUE 0x8574 DAMOS_FW3 0 MLQ256L 0.000000 255.996100 EXTENDED_LIMITS 0.000000 255.996000 /end CHARACTERISTIC
/begin CHARACTERISTIC IN_FAK "NMAX Faktor fuer den n-Gradienten" VALUE 0x81BA DAMOS_FW3 0 FKT64L 0.000000 1023.984000 EXTENDED_LIMITS 0.000000 1023.980000 /end CHARACTERISTIC
/begin CHARACTERISTIC IP123DIF_T "IP123-Differenz-Fehlerzeit" VALUE 0x8658 DAMOS_FW1 0 TQ10 0.000000 0.280000 EXTENDED_LIMITS 0.000000 2.550000 /end CHARACTERISTIC
/begin CHARACTERISTIC IP12DIF_T "IP12-Differenz-Fehlerzeit" VALUE 0x8655 DAMOS_FW1 0 TQ10 0.000000 0.140000 EXTENDED_LIMITS 0.000000 2.550000 /end CHARACTERISTIC
/begin CHARACTERISTIC IP13DIF_T "IP13-Differenz-Fehlerzeit" VALUE 0x8656 DAMOS_FW1 0 TQ10 0.000000 0.140000 EXTENDED_LIMITS 0.000000 2.550000 /end CHARACTERISTIC
/begin CHARACTERISTIC IP1A_MN_UM "Minimalwert DK-Poti unterer Anschlag f. FU" VALUE 0x8806 DAMOS_FW1 0 PER255 0.000000 100.000000 /end CHARACTERISTIC
/begin CHARACTERISTIC IP1BER_T "IP1-Bereichs-Fehlerzeit" VALUE 0x8651 DAMOS_FW1 0 TQ10 0.000000 0.140000 EXTENDED_LIMITS 0.000000 2.550000 /end CHARACTERISTIC
/begin CHARACTERISTIC IP1SEL_T "IP1-Auswahl-Verzoegerungszeit" VALUE 0x8653 DAMOS_FW1 0 TQ10 0.000000 0.140000 EXTENDED_LIMITS 0.000000 2.550000 /end CHARACTERISTIC
/begin CHARACTERISTIC IP1SILL "Idealer Leerlauf-Istwert fuer Abgleich" VALUE 0x8616 DAMOS_FW1 0 PER255 0.000000 100.000000 /end CHARACTERISTIC
/begin CHARACTERISTIC IP1SIVL "Idealer Vollast-Istwert fuer Abgleich" VALUE 0x8617 DAMOS_FW1 0 PER255 0.000000 100.000000 /end CHARACTERISTIC
/begin CHARACTERISTIC IP1SLL_E " IP1SN Ersatzwert bis zur ersten Leerlauf Bedingung" VALUE 0x853B DAMOS_FW1 0 PER_DKA 0.000000 100.000000 /end CHARACTERISTIC
/begin CHARACTERISTIC IP1SMAX "Maximaler IP1S" VALUE 0x864C DAMOS_FW1 0 PER255 0.000000 96.862750 EXTENDED_LIMITS 0.000000 100.000000 /end CHARACTERISTIC
/begin CHARACTERISTIC IP1SMIN "Minimaler IP1S" VALUE 0x864F DAMOS_FW1 0 PER255 5.490196 100.000000 EXTENDED_LIMITS 0.000000 100.000000 /end CHARACTERISTIC
/begin CHARACTERISTIC IP1SNIVL " Idealer Vollast normierter Istwert für Abgleich" VALUE 0x853A DAMOS_FW1 0 PER_DKA 0.000000 100.000000 /end CHARACTERISTIC
/begin CHARACTERISTIC IP23DIF_T "IP23-Differenz-Fehlerzeit" VALUE 0x8657 DAMOS_FW1 0 TQ10 0.000000 0.140000 EXTENDED_LIMITS 0.000000 2.550000 /end CHARACTERISTIC
/begin CHARACTERISTIC IP2A_MX_UM "Maximalwert DK-Poti unterer Anschlag f. FU" VALUE 0x8807 DAMOS_FW1 0 PER255 0.000000 100.000000 /end CHARACTERISTIC
/begin CHARACTERISTIC IP2BER_T "IP2-Bereichs-Fehlerzeit" VALUE 0x8652 DAMOS_FW1 0 TQ10 0.000000 0.140000 EXTENDED_LIMITS 0.000000 2.550000 /end CHARACTERISTIC
/begin CHARACTERISTIC IP2SEL_T "IP2-Auswahl-Verzoegerungszeit" VALUE 0x8654 DAMOS_FW1 0 TQ10 0.000000 0.140000 EXTENDED_LIMITS 0.000000 2.550000 /end CHARACTERISTIC
/begin CHARACTERISTIC IP2SMAX "Maximaler IP2S" VALUE 0x864E DAMOS_FW1 0 PER255 80.000000 98.039220 EXTENDED_LIMITS 0.000000 100.000000 /end CHARACTERISTIC
/begin CHARACTERISTIC IP2SMIN "Minimaler IP2S" VALUE 0x864D DAMOS_FW1 0 PER255 3.529412 100.000000 EXTENDED_LIMITS 0.000000 100.000000 /end CHARACTERISTIC
/begin CHARACTERISTIC IPA_T_UM "Max. Fehlerzeit der FU " VALUE 0x8805 DAMOS_FW1 0 UMFTLC 0.000000 10200.000000 /end CHARACTERISTIC
/begin CHARACTERISTIC IPDIFKL "Tol. fuer Erk. des defek. Poti's als f(NIST)" CURVE 0xBFFB DAMOS_GKL1 0 PER255 0.000000 10.588230
 /begin AXIS_DESCR COM_AXIS NIST NQ25 8 0.000000 0.000000 AXIS_PTS_REF NISTV08 EXTENDED_LIMITS 0.000000 6400.000000 /end AXIS_DESCR
 EXTENDED_LIMITS 0.000000 100.000000 /end CHARACTERISTIC
/begin CHARACTERISTIC IPSNHUB "Istwertpoti-Hub" VALUE 0x85DE DAMOS_FW1 0 PER255 0.000000 100.000000 /end CHARACTERISTIC
/begin CHARACTERISTIC IPSNNOT "Notluft-Querschnitt bei Lageregler-Uberwachung" VALUE 0x85E0 DAMOS_FW1 0 PER255 0.000000 12.941180 EXTENDED_LIMITS 0.000000 100.000000 /end CHARACTERISTIC
/begin AXIS_PTS IPSNV08_UM "SST fuer tlc-FU" 0x8F1E IPSN_UM DAMOS_SST97 0 PER_DKA 8 0.000000 100.000000 /end AXIS_PTS
/begin CHARACTERISTIC IVERNEG "negative I-Verstaerkung als f(NIST)" CURVE 0xC0CB DAMOS_GKL1 0 UIVERH 0.000000 36.479160
 /begin AXIS_DESCR COM_AXIS NIST NQ25 9 0.000000 0.000000 AXIS_PTS_REF NISTV10 EXTENDED_LIMITS 0.000000 6400.000000 /end AXIS_DESCR
 EXTENDED_LIMITS 0.000000 36.479200 /end CHARACTERISTIC
/begin CHARACTERISTIC IVERNEGH "negative I-Verstaerkung als f(NIST), Handschaltung" CURVE 0xC0D4 DAMOS_GKL1 0 UIVERH 0.000000 36.479160
 /begin AXIS_DESCR COM_AXIS NIST NQ25 9 0.000000 0.000000 AXIS_PTS_REF NISTV10 EXTENDED_LIMITS 0.000000 6400.000000 /end AXIS_DESCR
 EXTENDED_LIMITS 0.000000 36.479200 /end CHARACTERISTIC
/begin CHARACTERISTIC IVERPOS "positive I-Verstaerkung als f(NIST)" CURVE 0xC0B9 DAMOS_GKL1 0 UIVERH 0.000000 36.479160
 /begin AXIS_DESCR COM_AXIS NIST NQ25 9 0.000000 0.000000 AXIS_PTS_REF NISTV10 EXTENDED_LIMITS 0.000000 6400.000000 /end AXIS_DESCR
 EXTENDED_LIMITS 0.000000 36.479200 /end CHARACTERISTIC
/begin CHARACTERISTIC IVERPOSH "positive I-Verstaerkung als f(NIST), Handschaltung" CURVE 0xC0C2 DAMOS_GKL1 0 UIVERH 0.000000 36.479160
 /begin AXIS_DESCR COM_AXIS NIST NQ25 9 0.000000 0.000000 AXIS_PTS_REF NISTV10 EXTENDED_LIMITS 0.000000 6400.000000 /end AXIS_DESCR
 EXTENDED_LIMITS 0.000000 36.479200 /end CHARACTERISTIC
/begin CHARACTERISTIC IV_ADMB "I-Verstaerkung fuer Anfahrdrehmoment-Begrenzung" VALUE 0x875C DAMOS_FW1 0 UIV_512 0.000000 0.500000 /end CHARACTERISTIC
/begin CHARACTERISTIC IV_LWB "I-Verstaerkung fuer Lastwert-Begrenzung" VALUE 0x8760 DAMOS_FW3 0 UIVLWB_512 0.000000 128.000000 /end CHARACTERISTIC
/begin CHARACTERISTIC IV_VMAX "I-Verstaerkung fuer Vmax-Begrenzung" VALUE 0x8752 DAMOS_FW3 0 UIV_VMAXL 0.000000 262140.000000 /end CHARACTERISTIC
/begin CHARACTERISTIC I_KL "Pedalwert als Funktion des Pedalsollwerts fuer FU" CURVE 0xBDCC DAMOS_KL97 0 PER255 0.000000 100.000000 /begin AXIS_DESCR STD_AXIS SW8X PER255 16 0.000000 100.000000 /end AXIS_DESCR /end CHARACTERISTIC
/begin CHARACTERISTIC I_NDIFMX "NMAX Begrenzung der nRegeldifferenz fuer Berechnung I-Anteil" VALUE 0x81B8 DAMOS_FW3 0 NQ025 0.000000 12000.000000 /end CHARACTERISTIC
/begin CHARACTERISTIC KAMFZ "Beginn DASE-Segment bzg. auf tr-Marke" VALUE 0x8317 DAMOS_FW1 0 TR_DSHK -42.000000 66.000000 /end CHARACTERISTIC
/begin CHARACTERISTIC KATBFML "Filterzeitkonstante Signaldaempfung Katbelastung" CURVE 0xB7A3 DAMOS_GKL1 0 ZQ50 0.050196 12.800000
 /begin AXIS_DESCR COM_AXIS MLSM MLSMQ 6 0.000000 0.000000 AXIS_PTS_REF MLKV06 EXTENDED_LIMITS 0.000000 1024.000000 /end AXIS_DESCR
/end CHARACTERISTIC
/begin CHARACTERISTIC KATBFMN "Schwellwert fuer kleine Katalysatorbelastung" VALUE 0x8388 DAMOS_FW1 0 FKT256 0.000000 0.996094 EXTENDED_LIMITS 0.000000 0.996090 /end CHARACTERISTIC
/begin CHARACTERISTIC KATBFMNT "Schwellwert fuer kleine Katalysatorbelastung bei Testeransteuerung" VALUE 0x8389 DAMOS_FW1 0 FKT256 0.000000 0.996094 EXTENDED_LIMITS 0.000000 0.996090 /end CHARACTERISTIC
/begin CHARACTERISTIC KATBFN "normierter Mittelwert der Sondenamplitude" VALUE 0x838A DAMOS_FW1 0 FKT256 0.000000 0.996094 EXTENDED_LIMITS 0.000000 0.996090 /end CHARACTERISTIC
/begin CHARACTERISTIC KATBFNM "Normierungsfaktor multiplikativ fuer Katbelastung" VALUE 0x838B DAMOS_FW1 0 U0V_1V33 0.000000 1.330000 /end CHARACTERISTIC
/begin CHARACTERISTIC KATBFNP "Normierungsfaktor additiv fuer Katbelastung" VALUE 0x838C DAMOS_FW1 0 U0V_1V33 0.000000 1.330000 /end CHARACTERISTIC
/begin CHARACTERISTIC KATBFSX "maximale Integrationsschwelle fuer Stopbedingung" VALUE 0x838D DAMOS_FW2 0 FKT128_S -1.000000 1.000000 /end CHARACTERISTIC
/begin CHARACTERISTIC KATBFXM "maximale Katbelastungsschwelle fuer Stopbedingung" CURVE 0xB7A9 DAMOS_GKL1 0 FREQ_128 0.000000 127.500000
 /begin AXIS_DESCR COM_AXIS MLSM MLSMQ 6 0.000000 0.000000 AXIS_PTS_REF MLKV06 EXTENDED_LIMITS 0.000000 1024.000000 /end AXIS_DESCR
/end CHARACTERISTIC
/begin CHARACTERISTIC KATBSG "Kat-Speichergroesse fuer Katbelastung" VALUE 0x838E DAMOS_FW1 0 MLQ0MG868 0.000000 221.354200 EXTENDED_LIMITS 0.000000 221.354000 /end CHARACTERISTIC
/begin CHARACTERISTIC KATBSH "Offset fuer LR leicht im fetten Bereich" VALUE 0x8390 DAMOS_FW3 0 MLQ0MG868L 0.000000 56888.020000 EXTENDED_LIMITS 0.000000 56888.000000 /end CHARACTERISTIC
/begin CHARACTERISTIC KATWGT "Grenztemperaturkennlinie über Spitzenluftmasse" CURVE 0x8543 DAMOS_FKL1 0 AG_TMP 354.000000 1101.000000
 /begin AXIS_DESCR FIX_AXIS MLSP MLSMQ 8 0.000000 28.000000 FIX_AXIS_PAR 0 0 8 EXTENDED_LIMITS 0.000000 1024.000000 /end AXIS_DESCR
/end CHARACTERISTIC
/begin CHARACTERISTIC KATW_D "Abregelinkrement der Spitzenluftmasse für KAT-Temperaturwarnanzeige" VALUE 0x854F DAMOS_FW1 0 DEZ 0.000000 256.000000 /end CHARACTERISTIC
/begin CHARACTERISTIC KATW_OG "Abgastemperaturobergrenze für KAT-Temperaturwarnanzeige" VALUE 0x854B DAMOS_FW1 0 AG_TMP 354.000000 1101.000000 /end CHARACTERISTIC
/begin CHARACTERISTIC KATW_TM "Abregelraster der Spitzenluftmasse für KAT-Temperaturwarnanzeige" VALUE 0x854E DAMOS_FW1 0 TQ100 0.000000 25.500000 /end CHARACTERISTIC
/begin CHARACTERISTIC KATW_UG "Abgastemperaturuntergrenze für KAT-Temperaturwarnanzeige" VALUE 0x854C DAMOS_FW1 0 AG_TMP 354.000000 1101.000000 /end CHARACTERISTIC
/begin CHARACTERISTIC KATW_V "Geschwindigkeitsschwelle für KAT-Temperaturwarnanzeige" VALUE 0x854D DAMOS_FW1 0 UGESCH12 0.000000 212.500000 /end CHARACTERISTIC
/begin CHARACTERISTIC KDLAHKIF "Bewertungsfaktor fuer I-Anteil LRHK und lamsolh<1" CURVE 0xACF4 DAMOS_KL97 0 FKT128 0.000000 1.992188 /begin AXIS_DESCR STD_AXIS IDLASHKM U0V_0V03 6 0.000000 0.029883 /end AXIS_DESCR EXTENDED_LIMITS 0.000000 1.992190 /end CHARACTERISTIC
/begin CHARACTERISTIC KDLAHKIM "Bewertungsfaktor fuer I-Anteil LRHK und lamsolh>1" CURVE 0xACE4 DAMOS_KL97 0 FKT128 0.000000 1.992188 /begin AXIS_DESCR STD_AXIS IDLASHKM U0V_0V03 6 0.000000 0.029883 /end AXIS_DESCR EXTENDED_LIMITS 0.000000 1.992190 /end CHARACTERISTIC
/begin CHARACTERISTIC KDLAHKPF "Bewertungsfaktor fuer P-Anteil LRHK und lamsolh<1" CURVE 0xAD14 DAMOS_KL97 0 FKT128 0.000000 1.992188 /begin AXIS_DESCR STD_AXIS IDLASHKM U0V_0V03 6 0.000000 0.029883 /end AXIS_DESCR EXTENDED_LIMITS 0.000000 1.992190 /end CHARACTERISTIC
/begin CHARACTERISTIC KDLAHKPM "Bewertungsfaktor fuer P-Anteil LRHK und lamsolh>1" CURVE 0xAD04 DAMOS_KL97 0 FKT128 0.000000 1.992188 /begin AXIS_DESCR STD_AXIS IDLASHKM U0V_0V03 6 0.000000 0.029883 /end AXIS_DESCR EXTENDED_LIMITS 0.000000 1.992190 /end CHARACTERISTIC
/begin CHARACTERISTIC KEF1N "Klopferkennungsfaktor 1" CURVE 0xB2F6 DAMOS_KL97 0 FKT32 0.000000 7.968750 /begin AXIS_DESCR STD_AXIS NMOT NQ40 14 0.000000 10200.000000 /end AXIS_DESCR /end CHARACTERISTIC
/begin CHARACTERISTIC KEF2N "Klopferkennungsfaktor 2" CURVE 0xB316 DAMOS_KL97 0 FKT32 0.000000 7.968750 /begin AXIS_DESCR STD_AXIS NMOT NQ40 14 0.000000 10200.000000 /end AXIS_DESCR /end CHARACTERISTIC
/begin CHARACTERISTIC KEF3N "Klopferkennungsfaktor 3" CURVE 0xB336 DAMOS_KL97 0 FKT32 0.000000 7.968750 /begin AXIS_DESCR STD_AXIS NMOT NQ40 14 0.000000 10200.000000 /end AXIS_DESCR /end CHARACTERISTIC
/begin CHARACTERISTIC KEF4N "Klopferkennungsfaktor 4" CURVE 0xB356 DAMOS_KL97 0 FKT32 0.000000 7.968750 /begin AXIS_DESCR STD_AXIS NMOT NQ40 14 0.000000 10200.000000 /end AXIS_DESCR /end CHARACTERISTIC
/begin CHARACTERISTIC KEF5N "Klopferkennungsfaktor 5" CURVE 0xB376 DAMOS_KL97 0 FKT32 0.000000 7.968750 /begin AXIS_DESCR STD_AXIS NMOT NQ40 14 0.000000 10200.000000 /end AXIS_DESCR /end CHARACTERISTIC
/begin CHARACTERISTIC KEF6N "Klopferkennungsfaktor 6" CURVE 0xB396 DAMOS_KL97 0 FKT32 0.000000 7.968750 /begin AXIS_DESCR STD_AXIS NMOT NQ40 2 0.000000 10200.000000 /end AXIS_DESCR /end CHARACTERISTIC
/begin CHARACTERISTIC KEFNDY " Korrekturfaktor fuer Klopferkennungsschwelle bei Drehzahldynamik" VALUE 0x82B2 DAMOS_FW1 0 FKT64 0.000000 3.984375 EXTENDED_LIMITS 0.000000 3.984380 /end CHARACTERISTIC
/begin CHARACTERISTIC KEMLN "Klopfregel., Messf.laenge " CURVE 0xB216 DAMOS_KL97 0 ZWQ 6.000000 102.000000 /begin AXIS_DESCR STD_AXIS NMOT NQ40 16 0.000000 10200.000000 /end AXIS_DESCR EXTENDED_LIMITS 0.000000 191.250000 /end CHARACTERISTIC
/begin CHARACTERISTIC KEMR "Minimaler Referenzpegel" VALUE 0x8274 DAMOS_FW3 0 SENSORW 0.000000 4.999924 EXTENDED_LIMITS 0.000000 4.999920 /end CHARACTERISTIC
/begin CHARACTERISTIC KFABAK "Aufteilungsfaktor Wandfilm bei BA" MAP 0x9BBB DAMOS_GKF1 0 FKT256 0.000000 0.996094
 /begin AXIS_DESCR COM_AXIS NIST NQ25 8 0.000000 0.000000 AXIS_PTS_REF NISTV08 EXTENDED_LIMITS 0.000000 6400.000000 /end AXIS_DESCR
 /begin AXIS_DESCR COM_AXIS TMOT CMO_TMP 12 0.000000 0.000000 AXIS_PTS_REF TMOTV08 EXTENDED_LIMITS -41.000000 140.000000 /end AXIS_DESCR
 EXTENDED_LIMITS 0.000000 0.996090 /end CHARACTERISTIC
/begin CHARACTERISTIC KFAGR "Kennfeld für Abgasrückführung" MAP 0xCFA8 DAMOS_KF289 0 PCENT 0.000000 99.609380 /begin AXIS_DESCR STD_AXIS NMOT NQ40 2 0.000000 10200.000000 /end AXIS_DESCR /begin AXIS_DESCR STD_AXIS TL8 UFUELL 2 0.000000 191.250000 /end AXIS_DESCR EXTENDED_LIMITS 0.000000 99.609400 /end CHARACTERISTIC
/begin RECORD_LAYOUT DAMOS_KF289 SRC_ADDR_X 1 UWORD NO_AXIS_PTS_X 2 UBYTE AXIS_PTS_X 3 UBYTE INDEX_INCR DIRECT SRC_ADDR_Y 4 UWORD NO_AXIS_PTS_Y 5 UBYTE AXIS_PTS_Y 6 UBYTE INDEX_INCR DIRECT FNC_VALUES 7 UBYTE COLUMN_DIR DIRECT /end RECORD_LAYOUT
/begin CHARACTERISTIC KFAMALU "KF-Absenkungsfaktor für LUR-Wert bei Mehrfachaussetzern" MAP 0xB65D DAMOS_GKF1 0 FKT256 0.000000 0.996094
 /begin AXIS_DESCR COM_AXIS TL8 UFUELL 8 0.000000 0.000000 AXIS_PTS_REF TLDMDV08 EXTENDED_LIMITS 0.000000 191.250000 /end AXIS_DESCR
 /begin AXIS_DESCR COM_AXIS NIST NQ25 8 0.000000 0.000000 AXIS_PTS_REF NDMDV08 EXTENDED_LIMITS 0.000000 6400.000000 /end AXIS_DESCR
 EXTENDED_LIMITS 0.000000 0.996090 /end CHARACTERISTIC
/begin CHARACTERISTIC KFARTLN "max. Spaetwinkel der dyn. Antiruckelfkt." MAP 0xA7C2 DAMOS_KF289 0 ZWQ 0.000000 191.250000 /begin AXIS_DESCR STD_AXIS NMOT NQ40 8 0.000000 10200.000000 /end AXIS_DESCR /begin AXIS_DESCR STD_AXIS TL8 UFUELL 8 0.000000 191.250000 /end AXIS_DESCR /end CHARACTERISTIC
/begin CHARACTERISTIC KFATMMLN "stationaere Abgastemperatur abh. vom Luftdurchsatz und Drehzahl" MAP 0xB104 DAMOS_KF289 0 UTABG -48.000000 972.000000 /begin AXIS_DESCR STD_AXIS NMOT NQ40 8 0.000000 10200.000000 /end AXIS_DESCR /begin AXIS_DESCR STD_AXIS MLSM MLSMQ 8 0.000000 1024.000000 /end AXIS_DESCR /end CHARACTERISTIC
/begin CHARACTERISTIC KFATMMLV "Offset auf die Abgastemp. abh. vom Luftdurchsatz und Fahrzeuggeschw." MAP 0xB15C DAMOS_KF289 0 UTABGR 0.000000 1020.000000 /begin AXIS_DESCR STD_AXIS VFZG VQV 6 0.000000 306.000000 /end AXIS_DESCR /begin AXIS_DESCR STD_AXIS MLSM MLSMQ 8 0.000000 1024.000000 /end AXIS_DESCR /end CHARACTERISTIC
/begin CHARACTERISTIC KFATMZW "Kennfeld Abgastemperatur-Korrektur = f(Zuendwinkelverst.)" MAP 0xB0C4 DAMOS_KF289 0 UTABGR 0.000000 1020.000000 /begin AXIS_DESCR STD_AXIS MLSM MLSMQ 6 0.000000 1024.000000 /end AXIS_DESCR /begin AXIS_DESCR STD_AXIS DZWSPAET ZWQ 6 0.000000 191.250000 /end AXIS_DESCR /end CHARACTERISTIC
/begin CHARACTERISTIC KFAVAK "Aufteilungsfaktor Wandfilm bei VA" MAP 0x9C1B DAMOS_GKF1 0 FKT256 0.000000 0.996094
 /begin AXIS_DESCR COM_AXIS NIST NQ25 8 0.000000 0.000000 AXIS_PTS_REF NISTV08 EXTENDED_LIMITS 0.000000 6400.000000 /end AXIS_DESCR
 /begin AXIS_DESCR COM_AXIS TMOT CMO_TMP 12 0.000000 0.000000 AXIS_PTS_REF TMOTV08 EXTENDED_LIMITS -41.000000 140.000000 /end AXIS_DESCR
 EXTENDED_LIMITS 0.000000 0.996090 /end CHARACTERISTIC
/begin CHARACTERISTIC KFBAKL "Faktor Beschleunigungsanreicherung Motortemperatur/ f(NIST)+f(TMOT)" MAP 0x9CC7 DAMOS_GKF1 0 FKT16 0.000000 15.937500
 /begin AXIS_DESCR COM_AXIS NIST NQ25 8 0.000000 0.000000 AXIS_PTS_REF NISTV08 EXTENDED_LIMITS 0.000000 6400.000000 /end AXIS_DESCR
 /begin AXIS_DESCR COM_AXIS TMOT CMO_TMP 12 0.000000 0.000000 AXIS_PTS_REF TMOTV08 EXTENDED_LIMITS -41.000000 140.000000 /end AXIS_DESCR
/end CHARACTERISTIC
/begin CHARACTERISTIC KFCFO " " MAP 0xB76B DAMOS_GKF1 0 DEZ 0.000000 256.000000
 /begin AXIS_DESCR COM_AXIS TL8 UFUELL 3 0.000000 0.000000 AXIS_PTS_REF TLFOV03 EXTENDED_LIMITS 0.000000 191.250000 /end AXIS_DESCR
 /begin AXIS_DESCR COM_AXIS NIST NQ25 6 0.000000 0.000000 AXIS_PTS_REF NFOV06 EXTENDED_LIMITS 0.000000 6400.000000 /end AXIS_DESCR
/end CHARACTERISTIC
/begin CHARACTERISTIC KFDLUR " " MAP 0xB69D DAMOS_GKF2 0 LUQ_S8 -94.296300 93.559620
 /begin AXIS_DESCR COM_AXIS TL8 UFUELL 8 0.000000 0.000000 AXIS_PTS_REF TLDMDV08 EXTENDED_LIMITS 0.000000 191.250000 /end AXIS_DESCR
 /begin AXIS_DESCR COM_AXIS NIST NQ25 8 0.000000 0.000000 AXIS_PTS_REF NDMDV08 EXTENDED_LIMITS 0.000000 6400.000000 /end AXIS_DESCR
 EXTENDED_LIMITS -94.296300 93.559600 /end CHARACTERISTIC
/begin RECORD_LAYOUT DAMOS_GKF2 FNC_VALUES 1 SBYTE COLUMN_DIR DIRECT /end RECORD_LAYOUT
/begin CHARACTERISTIC KFDR "Einspritzkorrektur Referenzdruck Druckregler" MAP 0xCFB8 DAMOS_KF289 0 FKT256 0.000000 0.996094 /begin AXIS_DESCR STD_AXIS NMOT NQ40 16 0.000000 10200.000000 /end AXIS_DESCR
 /begin AXIS_DESCR STD_AXIS WDKBL UWDK 16 0.000000 80.599920 EXTENDED_LIMITS 0.000000 80.599900 /end AXIS_DESCR
 EXTENDED_LIMITS 0.000000 0.996090 /end CHARACTERISTIC
/begin CHARACTERISTIC KFDRNW "Einspritzkorrektur Referenzdruck Druckregler für NWS" MAP 0xD0E0 DAMOS_KF289 0 FKT256 0.000000 0.996094 /begin AXIS_DESCR STD_AXIS NMOT NQ40 16 0.000000 10200.000000 /end AXIS_DESCR
 /begin AXIS_DESCR STD_AXIS WDKBL UWDK 16 0.000000 80.599920 EXTENDED_LIMITS 0.000000 80.599900 /end AXIS_DESCR
 EXTENDED_LIMITS 0.000000 0.996090 /end CHARACTERISTIC
/begin CHARACTERISTIC KFDWDKOA "Schwelle delta-wdk zur Klimakompressorabschaltung" MAP 0xC97A DAMOS_KF290 0 UDWDK 0.000000 40.141920 /begin AXIS_DESCR STD_AXIS NMOT NQ40 6 0.000000 10200.000000 /end AXIS_DESCR /begin AXIS_DESCR STD_AXIS V_CAN VQV 6 0.000000 306.000000 /end AXIS_DESCR EXTENDED_LIMITS -40.458000 40.141900 /end CHARACTERISTIC
/begin RECORD_LAYOUT DAMOS_KF290 SRC_ADDR_X 1 UWORD NO_AXIS_PTS_X 2 UBYTE AXIS_PTS_X 3 UBYTE INDEX_INCR DIRECT SRC_ADDR_Y 4 UWORD NO_AXIS_PTS_Y 5 UBYTE AXIS_PTS_Y 6 UBYTE INDEX_INCR DIRECT FNC_VALUES 7 SBYTE COLUMN_DIR DIRECT /end RECORD_LAYOUT
/begin CHARACTERISTIC KFDZO "Zuendwinkel f. symmetrischen Doppelzuendungsoffset" MAP 0xA887 DAMOS_GKF1 0 ZWQ 0.000000 191.250000
 /begin AXIS_DESCR COM_AXIS TL8 UFUELL 8 0.000000 0.000000 AXIS_PTS_REF TL8V08 EXTENDED_LIMITS 0.000000 191.250000 /end AXIS_DESCR
 /begin AXIS_DESCR COM_AXIS NIST NQ25 8 0.000000 0.000000 AXIS_PTS_REF NISTV08 EXTENDED_LIMITS 0.000000 6400.000000 /end AXIS_DESCR
/end CHARACTERISTIC
/begin CHARACTERISTIC KFDZWES " Delta-ZW-Grenzkennfeld fuer Einspr. bei ZW-Eingriff" MAP 0xD2F2 DAMOS_KF289 0 ZWQ 0.000000 191.250000 /begin AXIS_DESCR STD_AXIS NMOT NQ40 7 0.000000 10200.000000 /end AXIS_DESCR /begin AXIS_DESCR STD_AXIS TL8 UFUELL 6 0.000000 191.250000 /end AXIS_DESCR /end CHARACTERISTIC
/begin CHARACTERISTIC KFDZWFMD "Delta-Zündwinkel als f(ZW-Wirkungsgrad,TL8Z) " MAP 0xC480 DAMOS_KF289 0 ZWQ 0.000000 191.250000 /begin AXIS_DESCR STD_AXIS TL8Z UFUELL 6 0.000000 191.250000 /end AXIS_DESCR /begin AXIS_DESCR STD_AXIS FMDINDS PER255 12 0.000000 100.000000 /end AXIS_DESCR /end CHARACTERISTIC
/begin CHARACTERISTIC KFDZWFMDI "Delta-Zündwinkel als f(TL8,ZW-Wirkungsgrad) " MAP 0xBAE4 DAMOS_KF289 0 ZWQ 0.000000 191.250000 /begin AXIS_DESCR STD_AXIS TL8 UFUELL 6 0.000000 191.250000 /end AXIS_DESCR /begin AXIS_DESCR STD_AXIS FMDIASR PER255 12 0.000000 100.000000 /end AXIS_DESCR /end CHARACTERISTIC
/begin CHARACTERISTIC KFESDWM " Faktor Einspritzung bei Zuendwinkelverstellung" MAP 0xD286 DAMOS_KF289 0 FKT256 0.000000 0.996094 /begin AXIS_DESCR STD_AXIS NMOT NQ40 7 0.000000 10200.000000 /end AXIS_DESCR /begin AXIS_DESCR STD_AXIS DZWM ZWQ 5 0.000000 191.250000 /end AXIS_DESCR EXTENDED_LIMITS 0.000000 0.996090 /end CHARACTERISTIC
/begin CHARACTERISTIC KFESDWZ " Faktor Einspritzung bei Zuendwinkelverstellung" MAP 0xD2BC DAMOS_KF289 0 FKT256 0.000000 0.996094 /begin AXIS_DESCR STD_AXIS NMOT NQ40 7 0.000000 10200.000000 /end AXIS_DESCR /begin AXIS_DESCR STD_AXIS DZWZ ZWQ 5 0.000000 191.250000 /end AXIS_DESCR EXTENDED_LIMITS 0.000000 0.996090 /end CHARACTERISTIC
/begin CHARACTERISTIC KFESZW " Wichtungsfaktor Einspritzkorrektur bei ZW-Verstellung" MAP 0xD330 DAMOS_KF289 0 FKT256 0.000000 0.996094 /begin AXIS_DESCR STD_AXIS NMOT NQ40 7 0.000000 10200.000000 /end AXIS_DESCR /begin AXIS_DESCR STD_AXIS TL8 UFUELL 6 0.000000 191.250000 /end AXIS_DESCR EXTENDED_LIMITS 0.000000 0.996090 /end CHARACTERISTIC
/begin CHARACTERISTIC KFFKSU "Kaltstart-Abregelfkt. ueber Anzahl NW-Umdrng. u. TMOT" MAP 0x94DC DAMOS_KF289 0 FKT256 0.000000 0.996094 /begin AXIS_DESCR STD_AXIS UNW DEZ 16 0.000000 256.000000 /end AXIS_DESCR /begin AXIS_DESCR STD_AXIS TMOT CMO_TMP 5 -41.000000 140.000000 /end AXIS_DESCR EXTENDED_LIMITS 0.000000 0.996090 /end CHARACTERISTIC
/begin CHARACTERISTIC KFFLURM " " MAP 0xB725 DAMOS_GKF1 0 FKT128 0.000000 1.992188
 /begin AXIS_DESCR COM_AXIS TL8 UFUELL 8 0.000000 0.000000 AXIS_PTS_REF TLDMDV08 EXTENDED_LIMITS 0.000000 191.250000 /end AXIS_DESCR
 /begin AXIS_DESCR COM_AXIS NIST NQ25 8 0.000000 0.000000 AXIS_PTS_REF NDMDV08 EXTENDED_LIMITS 0.000000 6400.000000 /end AXIS_DESCR
 EXTENDED_LIMITS 0.000000 1.992190 /end CHARACTERISTIC
/begin CHARACTERISTIC KFFMDDZW "Zündwinkelwirkungsgrad als f (Delta ZW,TL8Z) " MAP 0xC622 DAMOS_KF289 0 FKT256 0.000000 0.996094 /begin AXIS_DESCR STD_AXIS TL8Z UFUELL 6 0.000000 191.250000 /end AXIS_DESCR /begin AXIS_DESCR STD_AXIS IDWZWK ZWQ 12 0.000000 191.250000 /end AXIS_DESCR EXTENDED_LIMITS 0.000000 0.996090 /end CHARACTERISTIC
/begin CHARACTERISTIC KFFNS "Nachstartfaktor Anreicherungskennfeld" MAP 0x95A8 DAMOS_KF289 0 FKT128 0.000000 1.992188 /begin AXIS_DESCR STD_AXIS TMOT CMO_TMP 12 -41.000000 140.000000 /end AXIS_DESCR /begin AXIS_DESCR STD_AXIS TANS CLU_TMP 5 -50.000000 150.000000 /end AXIS_DESCR EXTENDED_LIMITS 0.000000 1.992190 /end CHARACTERISTIC
/begin CHARACTERISTIC KFFNS1 "Nachstartfaktor Anreicherungskennfeld (Automat)" MAP 0x9650 DAMOS_KF289 0 FKT128 0.000000 1.992188 /begin AXIS_DESCR STD_AXIS TMOT CMO_TMP 12 -41.000000 140.000000 /end AXIS_DESCR /begin AXIS_DESCR STD_AXIS TANS CLU_TMP 5 -50.000000 150.000000 /end AXIS_DESCR EXTENDED_LIMITS 0.000000 1.992190 /end CHARACTERISTIC
/begin CHARACTERISTIC KFFTEAX "Maximale Spuelrate in Tankentl." MAP 0xB471 DAMOS_GKF1 0 FKT512 0.000000 0.500000
 /begin AXIS_DESCR COM_AXIS MLSM MLSMQ 6 0.000000 0.000000 AXIS_PTS_REF MLV06 EXTENDED_LIMITS 0.000000 1024.000000 /end AXIS_DESCR
 /begin AXIS_DESCR COM_AXIS TANS CLU_TMP 8 0.000000 0.000000 AXIS_PTS_REF TANSV08 EXTENDED_LIMITS -50.000000 150.000000 /end AXIS_DESCR
/end CHARACTERISTIC
/begin CHARACTERISTIC KFFTV "Gewichtung fuer TV-Verschiebung" MAP 0xA989 DAMOS_GKF1 0 FKT128 0.000000 1.992188
 /begin AXIS_DESCR COM_AXIS TL8 UFUELL 8 0.000000 0.000000 AXIS_PTS_REF TL8V08 EXTENDED_LIMITS 0.000000 191.250000 /end AXIS_DESCR
 /begin AXIS_DESCR COM_AXIS NIST NQ25 8 0.000000 0.000000 AXIS_PTS_REF NISTV09 EXTENDED_LIMITS 0.000000 6400.000000 /end AXIS_DESCR
 EXTENDED_LIMITS 0.000000 1.992190 /end CHARACTERISTIC
/begin CHARACTERISTIC KFFWKH "Zuendwinkel KAT-Heizung Gewichtung Kennfeld " MAP 0xA1B8 DAMOS_KF289 0 FKT256 0.000000 0.996094 /begin AXIS_DESCR STD_AXIS TMOT CMO_TMP 6 -41.000000 140.000000 /end AXIS_DESCR /begin AXIS_DESCR STD_AXIS TANS CLU_TMP 6 -50.000000 150.000000 /end AXIS_DESCR EXTENDED_LIMITS 0.000000 0.996090 /end CHARACTERISTIC
/begin CHARACTERISTIC KFFWLW "Warmlauffaktor Last/Drehzahlkorrektur Leerlauf" MAP 0x9804 DAMOS_KF289 0 FKT256 0.000000 0.996094 /begin AXIS_DESCR STD_AXIS TL8 UFUELL 8 0.000000 191.250000 /end AXIS_DESCR /begin AXIS_DESCR STD_AXIS NMOT NQ40 8 0.000000 10200.000000 /end AXIS_DESCR EXTENDED_LIMITS 0.000000 0.996090 /end CHARACTERISTIC
/begin CHARACTERISTIC KFGEZS0 "Zylinderindividuelle Einspritzzeit Zylinder 1 mit nicht aktiver NWV" MAP 0x9D88 DAMOS_KF289 0 FAKTCIFI 0.750000 1.250000 /begin AXIS_DESCR STD_AXIS NMOT NQ40 2 0.000000 10200.000000 /end AXIS_DESCR /begin AXIS_DESCR STD_AXIS TL8 UFUELL 2 0.000000 191.250000 /end AXIS_DESCR /end CHARACTERISTIC
/begin CHARACTERISTIC KFGEZS1 "Zylinderindividuelle Einspritzzeit Zylinder 2 mit nicht aktiver NWV" MAP 0x9D98 DAMOS_KF289 0 FAKTCIFI 0.750000 1.250000 /begin AXIS_DESCR STD_AXIS NMOT NQ40 2 0.000000 10200.000000 /end AXIS_DESCR /begin AXIS_DESCR STD_AXIS TL8 UFUELL 2 0.000000 191.250000 /end AXIS_DESCR /end CHARACTERISTIC
/begin CHARACTERISTIC KFGEZS2 "Zylinderindividuelle Einspritzzeit Zylinder 3 mit nicht aktiver NWV" MAP 0x9DA8 DAMOS_KF289 0 FAKTCIFI 0.750000 1.250000 /begin AXIS_DESCR STD_AXIS NMOT NQ40 2 0.000000 10200.000000 /end AXIS_DESCR /begin AXIS_DESCR STD_AXIS TL8 UFUELL 2 0.000000 191.250000 /end AXIS_DESCR /end CHARACTERISTIC
/begin CHARACTERISTIC KFGEZS3 "Zylinderindividuelle Einspritzzeit Zylinder 4 mit nicht aktiver NWV" MAP 0x9DB8 DAMOS_KF289 0 FAKTCIFI 0.750000 1.250000 /begin AXIS_DESCR STD_AXIS NMOT NQ40 2 0.000000 10200.000000 /end AXIS_DESCR /begin AXIS_DESCR STD_AXIS TL8 UFUELL 2 0.000000 191.250000 /end AXIS_DESCR /end CHARACTERISTIC
/begin CHARACTERISTIC KFGEZS4 "Zylinderindividuelle Einspritzzeit Zylinder 5 mit nicht aktiver NWV" MAP 0x9DC8 DAMOS_KF289 0 FAKTCIFI 0.750000 1.250000 /begin AXIS_DESCR STD_AXIS NMOT NQ40 2 0.000000 10200.000000 /end AXIS_DESCR /begin AXIS_DESCR STD_AXIS TL8 UFUELL 2 0.000000 191.250000 /end AXIS_DESCR /end CHARACTERISTIC
/begin CHARACTERISTIC KFGEZS5 "Zylinderindividuelle Einspritzzeit Zylinder 6 mit nicht aktiver NWV" MAP 0x9DD8 DAMOS_KF289 0 FAKTCIFI 0.750000 1.250000 /begin AXIS_DESCR STD_AXIS NMOT NQ40 2 0.000000 10200.000000 /end AXIS_DESCR /begin AXIS_DESCR STD_AXIS TL8 UFUELL 2 0.000000 191.250000 /end AXIS_DESCR /end CHARACTERISTIC
/begin CHARACTERISTIC KFIP3S "IP3S-Kennfeld für DK-Poti Notfahren" MAP 0xC012 DAMOS_KF289 0 PER_DKA 0.000000 100.000000 /begin AXIS_DESCR STD_AXIS TL_DK_ TEQ_32 8 0.000000 21.760000 /end AXIS_DESCR /begin AXIS_DESCR STD_AXIS NIST NQ25 8 0.000000 6400.000000 /end AXIS_DESCR /end CHARACTERISTIC
/begin CHARACTERISTIC KFKABMT "Multiplikationsfaktor fuer Kat-Belastungssignal" MAP 0xB7BA DAMOS_KF289 0 FKT128 0.000000 1.992188 /begin AXIS_DESCR STD_AXIS MLSM MLSMQ 7 0.000000 1024.000000 /end AXIS_DESCR /begin AXIS_DESCR STD_AXIS TKATM UTABG 7 -48.000000 972.000000 /end AXIS_DESCR EXTENDED_LIMITS 0.000000 1.992190 /end CHARACTERISTIC
/begin CHARACTERISTIC KFKHAL "ZW KAT-Heizung Gewichtg. LL-KF" MAP 0x9F1C DAMOS_KF289 0 FKT256 0.000000 0.996094 /begin AXIS_DESCR STD_AXIS TMST CMO_TMP 8 -41.000000 140.000000 /end AXIS_DESCR /begin AXIS_DESCR STD_AXIS ZZKHHI DIV256 8 0.000000 65280.000000 /end AXIS_DESCR EXTENDED_LIMITS 0.000000 0.996090 /end CHARACTERISTIC
/begin CHARACTERISTIC KFKHAL1 "ZW KAT-Heizung Gewichtg. LL-KF, Variante 1" MAP 0x9F74 DAMOS_KF289 0 FKT256 0.000000 0.996094 /begin AXIS_DESCR STD_AXIS TMST CMO_TMP 8 -41.000000 140.000000 /end AXIS_DESCR /begin AXIS_DESCR STD_AXIS ZZKHHI DIV256 8 0.000000 65280.000000 /end AXIS_DESCR EXTENDED_LIMITS 0.000000 0.996090 /end CHARACTERISTIC
/begin CHARACTERISTIC KFKHAT "Zuendwinkel KAT-Heizung Gewichtung TL-KF" MAP 0xA108 DAMOS_KF289 0 FKT256 0.000000 0.996094 /begin AXIS_DESCR STD_AXIS TMST CMO_TMP 8 -41.000000 140.000000 /end AXIS_DESCR /begin AXIS_DESCR STD_AXIS ZZKHHI DIV256 8 0.000000 65280.000000 /end AXIS_DESCR EXTENDED_LIMITS 0.000000 0.996090 /end CHARACTERISTIC
/begin CHARACTERISTIC KFKHAT1 "Zuendwinkel KAT-Heizung Gewichtg. TL-KF, Variante 1" MAP 0xA160 DAMOS_KF289 0 FKT256 0.000000 0.996094 /begin AXIS_DESCR STD_AXIS TMST CMO_TMP 8 -41.000000 140.000000 /end AXIS_DESCR /begin AXIS_DESCR STD_AXIS ZZKHHI DIV256 8 0.000000 65280.000000 /end AXIS_DESCR EXTENDED_LIMITS 0.000000 0.996090 /end CHARACTERISTIC
/begin CHARACTERISTIC KFKSF "Motortemperaturabhängiger Startfaktor" MAP 0x9486 DAMOS_KF289 0 FKT16 0.000000 15.937500 /begin AXIS_DESCR STD_AXIS TANS CLU_TMP 5 -50.000000 150.000000 /end AXIS_DESCR /begin AXIS_DESCR STD_AXIS TMOT CMO_TMP 10 -41.000000 140.000000 /end AXIS_DESCR /end CHARACTERISTIC
/begin CHARACTERISTIC KFKSWF "Kennfeld fuer KAT.-Schutz-Wichtungsfaktor" MAP 0xB807 DAMOS_GKF1 0 DEZ 0.000000 256.000000
 /begin AXIS_DESCR COM_AXIS TL8 UFUELL 8 0.000000 0.000000 AXIS_PTS_REF TLDMDV08 EXTENDED_LIMITS 0.000000 191.250000 /end AXIS_DESCR
 /begin AXIS_DESCR COM_AXIS NIST NQ25 8 0.000000 0.000000 AXIS_PTS_REF NDMDV08 EXTENDED_LIMITS 0.000000 6400.000000 /end AXIS_DESCR
/end CHARACTERISTIC
/begin CHARACTERISTIC KFLF " Lambdakennfeld Teillast" MAP 0x9910 DAMOS_KF289 0 FKT128 0.000000 1.992188 /begin AXIS_DESCR STD_AXIS TL8 UFUELL 16 0.000000 191.250000 /end AXIS_DESCR /begin AXIS_DESCR STD_AXIS NMOT NQ40 16 0.000000 10200.000000 /end AXIS_DESCR EXTENDED_LIMITS 0.000000 1.992190 /end CHARACTERISTIC
/begin CHARACTERISTIC KFLF1 " Lambdakennfeld Teillast 1" MAP 0x9A38 DAMOS_KF289 0 FKT128 0.000000 1.992188 /begin AXIS_DESCR STD_AXIS TL8 UFUELL 16 0.000000 191.250000 /end AXIS_DESCR /begin AXIS_DESCR STD_AXIS NMOT NQ40 16 0.000000 10200.000000 /end AXIS_DESCR EXTENDED_LIMITS 0.000000 1.992190 /end CHARACTERISTIC
/begin CHARACTERISTIC KFLFREQAC "Faktor für Klimaanlage" MAP 0xCF06 DAMOS_KF289 0 PCENT 0.000000 99.609380
 /begin AXIS_DESCR STD_AXIS PAC PAB77 8 -0.306054 32.819430 EXTENDED_LIMITS -0.306050 32.819400 /end AXIS_DESCR
 /begin AXIS_DESCR STD_AXIS VFZG VQV 8 0.000000 306.000000 /end AXIS_DESCR
 EXTENDED_LIMITS 0.000000 99.609400 /end CHARACTERISTIC
/begin CHARACTERISTIC KFLFV " Lambdakennfeld bei Vollast" MAP 0x98B4 DAMOS_KF289 0 FKT128 0.000000 1.992188 /begin AXIS_DESCR STD_AXIS TL8 UFUELL 4 0.000000 191.250000 /end AXIS_DESCR /begin AXIS_DESCR STD_AXIS NMOT NQ40 16 0.000000 10200.000000 /end AXIS_DESCR EXTENDED_LIMITS 0.000000 1.992190 /end CHARACTERISTIC
/begin CHARACTERISTIC KFLRSYNI "I-Verstärkung für Synchro-Regelung LR" CURVE 0xACAE DAMOS_KL97 0 FKT1024 0.000000 0.249023 /begin AXIS_DESCR STD_AXIS NMOT NQ40 5 0.000000 10200.000000 /end AXIS_DESCR EXTENDED_LIMITS 0.000000 0.249020 /end CHARACTERISTIC
/begin CHARACTERISTIC KFLRSYNP "P-Verstärkung für Synchro-Regelung LR" CURVE 0xACA0 DAMOS_KL97 0 FKT1024 0.000000 0.249023 /begin AXIS_DESCR STD_AXIS NMOT NQ40 5 0.000000 10200.000000 /end AXIS_DESCR EXTENDED_LIMITS 0.000000 0.249020 /end CHARACTERISTIC
/begin CHARACTERISTIC KFLRVBA "Verbotszeit für LR bei BA" MAP 0xAC24 DAMOS_KF289 0 TQ100 0.000000 25.500000 /begin AXIS_DESCR STD_AXIS NIST NQ25 8 0.000000 6400.000000 /end AXIS_DESCR /begin AXIS_DESCR STD_AXIS TMOT CMO_TMP 10 -41.000000 140.000000 /end AXIS_DESCR /end CHARACTERISTIC
/begin CHARACTERISTIC KFLRVVA "Verbotszeit für LR bei VA" MAP 0xABBA DAMOS_KF289 0 TQ100 0.000000 25.500000 /begin AXIS_DESCR STD_AXIS NIST NQ25 8 0.000000 6400.000000 /end AXIS_DESCR /begin AXIS_DESCR STD_AXIS TMOT CMO_TMP 10 -41.000000 140.000000 /end AXIS_DESCR /end CHARACTERISTIC
/begin CHARACTERISTIC KFLUAR " " MAP 0xB6DD DAMOS_GKF1 0 LUQ 0.000000 187.855900
 /begin AXIS_DESCR COM_AXIS TL8 UFUELL 8 0.000000 0.000000 AXIS_PTS_REF TLDMDV08 EXTENDED_LIMITS 0.000000 191.250000 /end AXIS_DESCR
 /begin AXIS_DESCR COM_AXIS NIST NQ25 8 0.000000 0.000000 AXIS_PTS_REF NDMDV08 EXTENDED_LIMITS 0.000000 6400.000000 /end AXIS_DESCR
 EXTENDED_LIMITS 0.000000 187.856000 /end CHARACTERISTIC
/begin CHARACTERISTIC KFLURB "Kennfeld fuer Laufunruhe-Referenz-Basiswert" MAP 0xB4D1 DAMOS_GKF2 0 LUQ_S8 -94.296300 93.559620
 /begin AXIS_DESCR COM_AXIS TL8 UFUELL 8 0.000000 0.000000 AXIS_PTS_REF TLDMDV08 EXTENDED_LIMITS 0.000000 191.250000 /end AXIS_DESCR
 /begin AXIS_DESCR COM_AXIS NIST NQ25 8 0.000000 0.000000 AXIS_PTS_REF NDMDV08 EXTENDED_LIMITS 0.000000 6400.000000 /end AXIS_DESCR
 EXTENDED_LIMITS -94.296300 93.559600 /end CHARACTERISTIC
/begin CHARACTERISTIC KFLURB1 "Kennfeld fuer Laufunruhe-Referenz-Basiswert" MAP 0xB511 DAMOS_GKF2 0 LUQ_S8 -94.296300 93.559620
 /begin AXIS_DESCR COM_AXIS TL8 UFUELL 8 0.000000 0.000000 AXIS_PTS_REF TLDMDV08 EXTENDED_LIMITS 0.000000 191.250000 /end AXIS_DESCR
 /begin AXIS_DESCR COM_AXIS NIST NQ25 8 0.000000 0.000000 AXIS_PTS_REF NDMDV08 EXTENDED_LIMITS 0.000000 6400.000000 /end AXIS_DESCR
 EXTENDED_LIMITS -94.296300 93.559600 /end CHARACTERISTIC
/begin CHARACTERISTIC KFLURB2 "Kennfeld fuer Laufunruhe-Referenz-Basiswert" MAP 0xB551 DAMOS_GKF2 0 LUQ_S8 -94.296300 93.559620
 /begin AXIS_DESCR COM_AXIS TL8 UFUELL 8 0.000000 0.000000 AXIS_PTS_REF TLDMDV08 EXTENDED_LIMITS 0.000000 191.250000 /end AXIS_DESCR
 /begin AXIS_DESCR COM_AXIS NIST NQ25 8 0.000000 0.000000 AXIS_PTS_REF NDMDV08 EXTENDED_LIMITS 0.000000 6400.000000 /end AXIS_DESCR
 EXTENDED_LIMITS -94.296300 93.559600 /end CHARACTERISTIC
/begin CHARACTERISTIC KFLURB3 "Kennfeld fuer Laufunruhe-Referenz-Basiswert" MAP 0xB591 DAMOS_GKF2 0 LUQ_S8 -94.296300 93.559620
 /begin AXIS_DESCR COM_AXIS TL8 UFUELL 8 0.000000 0.000000 AXIS_PTS_REF TLDMDV08 EXTENDED_LIMITS 0.000000 191.250000 /end AXIS_DESCR
 /begin AXIS_DESCR COM_AXIS NIST NQ25 8 0.000000 0.000000 AXIS_PTS_REF NDMDV08 EXTENDED_LIMITS 0.000000 6400.000000 /end AXIS_DESCR
 EXTENDED_LIMITS -94.296300 93.559600 /end CHARACTERISTIC
/begin CHARACTERISTIC KFLURB4 "Kennfeld fuer Laufunruhe-Referenz-Basiswert" MAP 0xB5D1 DAMOS_GKF2 0 LUQ_S8 -94.296300 93.559620
 /begin AXIS_DESCR COM_AXIS TL8 UFUELL 8 0.000000 0.000000 AXIS_PTS_REF TLDMDV08 EXTENDED_LIMITS 0.000000 191.250000 /end AXIS_DESCR
 /begin AXIS_DESCR COM_AXIS NIST NQ25 8 0.000000 0.000000 AXIS_PTS_REF NDMDV08 EXTENDED_LIMITS 0.000000 6400.000000 /end AXIS_DESCR
 EXTENDED_LIMITS -94.296300 93.559600 /end CHARACTERISTIC
/begin CHARACTERISTIC KFLURB5 "Kennfeld fuer Laufunruhe-Referenz-Basiswert" MAP 0xB611 DAMOS_GKF2 0 LUQ_S8 -94.296300 93.559620
 /begin AXIS_DESCR COM_AXIS TL8 UFUELL 8 0.000000 0.000000 AXIS_PTS_REF TLDMDV08 EXTENDED_LIMITS 0.000000 191.250000 /end AXIS_DESCR
 /begin AXIS_DESCR COM_AXIS NIST NQ25 8 0.000000 0.000000 AXIS_PTS_REF NDMDV08 EXTENDED_LIMITS 0.000000 6400.000000 /end AXIS_DESCR
 EXTENDED_LIMITS -94.296300 93.559600 /end CHARACTERISTIC
/begin CHARACTERISTIC KFMAKR "Klopfregel., Messf.beginn bzg. OT " MAP 0xB23A DAMOS_KF289 0 ZWQ 0.000000 60.000000 /begin AXIS_DESCR STD_AXIS NMOT NQ40 16 0.000000 10200.000000 /end AXIS_DESCR /begin AXIS_DESCR STD_AXIS TL8 UFUELL 5 0.000000 191.250000 /end AXIS_DESCR EXTENDED_LIMITS 0.000000 191.250000 /end CHARACTERISTIC
/begin CHARACTERISTIC KFMDACCGR " KF Korrekturfaktor Momentenanforderung ACC" MAP 0xCD6C DAMOS_KF289 0 F256OFF 0.500000 1.500000 /begin AXIS_DESCR STD_AXIS NIST NQ25 6 0.000000 6400.000000 /end AXIS_DESCR
 /begin AXIS_DESCR STD_AXIS MDACCGR DPCENT 8 -25.000000 24.804690 EXTENDED_LIMITS -25.000000 24.804700 /end AXIS_DESCR
/end CHARACTERISTIC
/begin CHARACTERISTIC KFMDASRLGR " KF Korrekturfaktor Momentenanforderung ASR langsam" MAP 0xB8B6 DAMOS_KF289 0 F256OFF 0.500000 1.500000 /begin AXIS_DESCR STD_AXIS NIST NQ25 6 0.000000 6400.000000 /end AXIS_DESCR /begin AXIS_DESCR STD_AXIS MDASRLGR DMMQ 8 -32.000000 31.750000 /end AXIS_DESCR /end CHARACTERISTIC
/begin CHARACTERISTIC KFMDGR " KF Korrekturfaktor Momentenanforderung EGS" MAP 0xCB60 DAMOS_KF289 0 F256OFF 0.500000 1.500000 /begin AXIS_DESCR STD_AXIS NIST NQ25 8 0.000000 6400.000000 /end AXIS_DESCR /begin AXIS_DESCR STD_AXIS MDEGSGRD DMMQ 9 -32.000000 31.750000 /end AXIS_DESCR /end CHARACTERISTIC
/begin CHARACTERISTIC KFMDHN " KF Korrekturfaktor Momentenanforderung EGS" MAP 0xCA22 DAMOS_KF289 0 F256OFF 0.500000 1.500000 /begin AXIS_DESCR STD_AXIS NIST NQ25 6 0.000000 6400.000000 /end AXIS_DESCR
 /begin AXIS_DESCR STD_AXIS FDKHA FKT128 6 0.000000 1.992188 EXTENDED_LIMITS 0.000000 1.992190 /end AXIS_DESCR
/end CHARACTERISTIC
/begin CHARACTERISTIC KFMDMAXDKN "Begrenzung Sollwert DK für Wandlerschutz" MAP 0xCC40 DAMOS_KF289 0 PER255 0.000000 100.000000 /begin AXIS_DESCR STD_AXIS NIST NQ25 6 0.000000 6400.000000 /end AXIS_DESCR /begin AXIS_DESCR STD_AXIS MDMAXI MMQ 6 0.000000 512.000000 /end AXIS_DESCR /end CHARACTERISTIC
/begin CHARACTERISTIC KFMDMSRGR " KF Korrekturfaktor Momentenanforderung MSR" MAP 0xB870 DAMOS_KF289 0 F256OFF 0.500000 1.500000 /begin AXIS_DESCR STD_AXIS NIST NQ25 6 0.000000 6400.000000 /end AXIS_DESCR /begin AXIS_DESCR STD_AXIS MDMSRGR DMMQ 8 -32.000000 31.750000 /end AXIS_DESCR /end CHARACTERISTIC
/begin CHARACTERISTIC KFMDNOKN "indiziertes Motormoment" MAP 0xC694 DAMOS_KF289 0 MMQ 0.000000 512.000000 /begin AXIS_DESCR STD_AXIS NMOT NQ40 13 0.000000 10200.000000 /end AXIS_DESCR /begin AXIS_DESCR STD_AXIS TL8I UFUELL 13 0.000000 191.250000 /end AXIS_DESCR /end CHARACTERISTIC
/begin CHARACTERISTIC KFMDOFAC "OFFSET KF fuer ACC-Momentenvergleich" MAP 0xC8E6 DAMOS_KF289 0 MMQ 0.000000 512.000000 /begin AXIS_DESCR STD_AXIS NIST NQ25 8 0.000000 6400.000000 /end AXIS_DESCR /begin AXIS_DESCR STD_AXIS MDACC_MMQ MMQ 8 0.000000 512.000000 /end AXIS_DESCR /end CHARACTERISTIC
/begin CHARACTERISTIC KFMDSN "Verlustmomente des Motors" MAP 0xC5D6 DAMOS_KF289 0 MMQ 0.000000 512.000000 /begin AXIS_DESCR STD_AXIS IN_SRC NQ40 9 0.000000 10200.000000 /end AXIS_DESCR /begin AXIS_DESCR STD_AXIS TMOT CMO_TMP 6 -41.000000 140.000000 /end AXIS_DESCR /end CHARACTERISTIC
/begin CHARACTERISTIC KFMI_UM "KF opt. indiziertes Moment in der mist-FU" MAP 0xD4F1 DAMOS_GKF1 0 MMQ 0.000000 512.000000
 /begin AXIS_DESCR COM_AXIS TL8_UM UFUELL 8 0.000000 0.000000 AXIS_PTS_REF TL8V08_UM EXTENDED_LIMITS 0.000000 191.250000 /end AXIS_DESCR
 /begin AXIS_DESCR COM_AXIS NIST_UM NQ25 8 0.000000 0.000000 AXIS_PTS_REF NMV08_UM EXTENDED_LIMITS 0.000000 6400.000000 /end AXIS_DESCR
/end CHARACTERISTIC
/begin CHARACTERISTIC KFMNDK " Sollwert DK für Momentenanforderung EGS" MAP 0xCA6C DAMOS_KF289 0 PER255 0.000000 100.000000 /begin AXIS_DESCR STD_AXIS NMOT NQ40 13 0.000000 10200.000000 /end AXIS_DESCR /begin AXIS_DESCR STD_AXIS MDEGSKOR MMQ 16 0.000000 512.000000 /end AXIS_DESCR /end CHARACTERISTIC
/begin CHARACTERISTIC KFMNDKACC " Sollwert DK für Momentenanforderung ACC" MAP 0xCC78 DAMOS_KF289 0 PER255 0.000000 100.000000 /begin AXIS_DESCR STD_AXIS NMOT NQ40 13 0.000000 10200.000000 /end AXIS_DESCR /begin AXIS_DESCR STD_AXIS MDACCKOR MMQ 16 0.000000 512.000000 /end AXIS_DESCR /end CHARACTERISTIC
/begin CHARACTERISTIC KFMNDKASR " Sollwert DK für Momentenanforderung ASR" MAP 0xB9F0 DAMOS_KF289 0 PER255 0.000000 100.000000 /begin AXIS_DESCR STD_AXIS NMOT NQ40 13 0.000000 10200.000000 /end AXIS_DESCR /begin AXIS_DESCR STD_AXIS MDASRLKOR MMQ 16 0.000000 512.000000 /end AXIS_DESCR /end CHARACTERISTIC
/begin CHARACTERISTIC KFMNDKMSR " Sollwert DK für Momentenanforderung MSR" MAP 0xB8FC DAMOS_KF289 0 PER255 0.000000 100.000000 /begin AXIS_DESCR STD_AXIS NMOT NQ40 13 0.000000 10200.000000 /end AXIS_DESCR /begin AXIS_DESCR STD_AXIS MDMSRKOR MMQ 16 0.000000 512.000000 /end AXIS_DESCR /end CHARACTERISTIC
/begin CHARACTERISTIC KFMNDKP " Sollwert DK für Momentenanforderung EGS" MAP 0xAEA0 DAMOS_KF289 0 PER255 0.000000 100.000000 /begin AXIS_DESCR STD_AXIS NMOT NQ40 13 0.000000 10200.000000 /end AXIS_DESCR /begin AXIS_DESCR STD_AXIS MDEGSKOR MMQ 16 0.000000 512.000000 /end AXIS_DESCR /end CHARACTERISTIC
/begin CHARACTERISTIC KFMNHMAX "maximales Motormoment" MAP 0xC828 DAMOS_KF289 0 MMQ 0.000000 512.000000 /begin AXIS_DESCR STD_AXIS NMOT NQ40 13 0.000000 10200.000000 /end AXIS_DESCR
 /begin AXIS_DESCR STD_AXIS FDKHA FKT128 6 0.000000 1.992188 EXTENDED_LIMITS 0.000000 1.992190 /end AXIS_DESCR
/end CHARACTERISTIC
/begin CHARACTERISTIC KFMNOKTC "indiziertes Motormoment während Selespeed Eingriff" MAP 0xC75E DAMOS_KF289 0 MMQ 0.000000 512.000000 /begin AXIS_DESCR STD_AXIS NMOT NQ40 13 0.000000 10200.000000 /end AXIS_DESCR /begin AXIS_DESCR STD_AXIS TL8TC UFUELL 13 0.000000 191.250000 /end AXIS_DESCR /end CHARACTERISTIC
/begin CHARACTERISTIC KFMZB_UM "KF zul. indiziertes Pedalmoment im Betrieb in der mzul-FU" MAP 0xD471 DAMOS_GKF1 0 MMQ 0.000000 512.000000
 /begin AXIS_DESCR COM_AXIS SPSNMAX_UM DEZ 8 0.000000 0.000000 AXIS_PTS_REF SPSMV08_UM EXTENDED_LIMITS 0.000000 256.000000 /end AXIS_DESCR
 /begin AXIS_DESCR COM_AXIS NIST_UM NQ25 8 0.000000 0.000000 AXIS_PTS_REF NMV08_UM EXTENDED_LIMITS 0.000000 6400.000000 /end AXIS_DESCR
/end CHARACTERISTIC
/begin CHARACTERISTIC KFMZOF_UM "KF zul. indiziertes Offsetmoment in der mzul-FU" MAP 0xD4B1 DAMOS_GKF1 0 MMQ 0.000000 512.000000
 /begin AXIS_DESCR COM_AXIS MZ_UM MMQ 8 0.000000 0.000000 AXIS_PTS_REF MDV08_UM EXTENDED_LIMITS 0.000000 512.000000 /end AXIS_DESCR
 /begin AXIS_DESCR COM_AXIS NIST_UM NQ25 8 0.000000 0.000000 AXIS_PTS_REF NMV08_UM EXTENDED_LIMITS 0.000000 6400.000000 /end AXIS_DESCR
/end CHARACTERISTIC
/begin CHARACTERISTIC KFMZS_UM "KF zul. indiziertes Pedalmoment im Start in der mzul-FU" MAP 0xD431 DAMOS_GKF1 0 MMQ 0.000000 512.000000
 /begin AXIS_DESCR COM_AXIS SPSNMAX_UM DEZ 8 0.000000 0.000000 AXIS_PTS_REF SPSMV08_UM EXTENDED_LIMITS 0.000000 256.000000 /end AXIS_DESCR
 /begin AXIS_DESCR COM_AXIS NIST_UM NQ25 8 0.000000 0.000000 AXIS_PTS_REF NMV08_UM EXTENDED_LIMITS 0.000000 6400.000000 /end AXIS_DESCR
/end CHARACTERISTIC
/begin CHARACTERISTIC KFNGRD " KF Korrekturfaktor Momentenanforderung EGS" MAP 0xCBC0 DAMOS_KF289 0 F256OFF 0.500000 1.500000 /begin AXIS_DESCR STD_AXIS NIST NQ25 8 0.000000 6400.000000 /end AXIS_DESCR /begin AXIS_DESCR STD_AXIS NGRTN NGRDQ50S 9 -6400.000000 6350.000000 /end AXIS_DESCR /end CHARACTERISTIC
/begin CHARACTERISTIC KFNSLN "Nachstartfaktor Anhebungskennfeld" MAP 0x96A4 DAMOS_GKF1 0 FKT128 0.000000 1.992188
 /begin AXIS_DESCR COM_AXIS TL8 UFUELL 8 0.000000 0.000000 AXIS_PTS_REF TL8V08 EXTENDED_LIMITS 0.000000 191.250000 /end AXIS_DESCR
 /begin AXIS_DESCR COM_AXIS NIST NQ25 8 0.000000 0.000000 AXIS_PTS_REF NISTV09 EXTENDED_LIMITS 0.000000 6400.000000 /end AXIS_DESCR
 EXTENDED_LIMITS 0.000000 1.992190 /end CHARACTERISTIC
/begin CHARACTERISTIC KFNWE "Wiedereinsetzdrehzahl" MAP 0x8F9E DAMOS_KF289 0 NQ25 0.000000 6400.000000 /begin AXIS_DESCR STD_AXIS TMOT CMO_TMP 7 -41.000000 140.000000 /end AXIS_DESCR /begin AXIS_DESCR STD_AXIS GANG_I DEZ7 8 0.000000 7.000000 /end AXIS_DESCR /end CHARACTERISTIC
/begin CHARACTERISTIC KFNWE1 "Wiedereinsetzdrehzahl Variante" MAP 0x8FEC DAMOS_KF289 0 NQ25 0.000000 6400.000000 /begin AXIS_DESCR STD_AXIS TMOT CMO_TMP 7 -41.000000 140.000000 /end AXIS_DESCR /begin AXIS_DESCR STD_AXIS GANG_I DEZ7 8 0.000000 7.000000 /end AXIS_DESCR /end CHARACTERISTIC
/begin CHARACTERISTIC KFPEDRSW "Pedalkennfeld Getriebestellung R" MAP 0xBB76 DAMOS_KF289 0 PER255 0.000000 100.000000 /begin AXIS_DESCR STD_AXIS SWPT PER255 16 0.000000 100.000000 /end AXIS_DESCR /begin AXIS_DESCR STD_AXIS NIST NQ25 6 0.000000 6400.000000 /end AXIS_DESCR /end CHARACTERISTIC
/begin CHARACTERISTIC KFPEDSW "Pedalkennfeld" MAP 0xBBF4 DAMOS_KF289 0 PER255 0.000000 100.000000 /begin AXIS_DESCR STD_AXIS SWPT PER255 16 0.000000 100.000000 /end AXIS_DESCR /begin AXIS_DESCR STD_AXIS NIST NQ25 12 0.000000 6400.000000 /end AXIS_DESCR /end CHARACTERISTIC
/begin CHARACTERISTIC KFPEDSWA "Pedalkennfeld fuer Automatik-Modus" MAP 0xBCD8 DAMOS_KF289 0 PER255 0.000000 100.000000 /begin AXIS_DESCR STD_AXIS SWPT PER255 16 0.000000 100.000000 /end AXIS_DESCR /begin AXIS_DESCR STD_AXIS NIST NQ25 12 0.000000 6400.000000 /end AXIS_DESCR /end CHARACTERISTIC
/begin CHARACTERISTIC KFPEDSWD "Pedalkennfeld fuer Anfahren (egs_anf=1)" MAP 0xBDF0 DAMOS_KF289 0 PER255 0.000000 100.000000 /begin AXIS_DESCR STD_AXIS SWPT PER255 16 0.000000 100.000000 /end AXIS_DESCR /begin AXIS_DESCR STD_AXIS NIST NQ25 12 0.000000 6400.000000 /end AXIS_DESCR /end CHARACTERISTIC
/begin CHARACTERISTIC KFPUN "HFM-Rueckstroemungskorrektur" MAP 0x931E DAMOS_KF289 0 F256OF2 0.250000 1.246094
 /begin AXIS_DESCR STD_AXIS WDKBL UWDK 12 0.000000 80.599920 EXTENDED_LIMITS 0.000000 80.599900 /end AXIS_DESCR
 /begin AXIS_DESCR STD_AXIS NMOT NQ40 12 0.000000 10200.000000 /end AXIS_DESCR
 EXTENDED_LIMITS 0.250000 1.246090 /end CHARACTERISTIC
/begin CHARACTERISTIC KFPUNNW "HFM-Rueckstroemungskorrektur bei NW geschaltet" MAP 0x93CE DAMOS_KF289 0 F256OF2 0.250000 1.246094
 /begin AXIS_DESCR STD_AXIS WDKBL UWDK 12 0.000000 80.599920 EXTENDED_LIMITS 0.000000 80.599900 /end AXIS_DESCR
 /begin AXIS_DESCR STD_AXIS NMOT NQ40 12 0.000000 10200.000000 /end AXIS_DESCR
 EXTENDED_LIMITS 0.250000 1.246090 /end CHARACTERISTIC
/begin CHARACTERISTIC KFREDV " Einschaltbedingung Momentenanforderung" MAP 0xC890 DAMOS_KF289 0 MMQ 0.000000 512.000000 /begin AXIS_DESCR STD_AXIS NIST NQ25 6 0.000000 6400.000000 /end AXIS_DESCR /begin AXIS_DESCR STD_AXIS MDEGSST MMQ 8 0.000000 512.000000 /end AXIS_DESCR /end CHARACTERISTIC
/begin CHARACTERISTIC KFRI "Lambdaregelung-Integrator" MAP 0xA9CA DAMOS_KF289 0 FRIQ 0.000000 0.778198 /begin AXIS_DESCR STD_AXIS TL8 UFUELL 10 0.000000 191.250000 /end AXIS_DESCR /begin AXIS_DESCR STD_AXIS NMOT NQ40 10 0.000000 10200.000000 /end AXIS_DESCR EXTENDED_LIMITS 0.000000 0.778200 /end CHARACTERISTIC
/begin CHARACTERISTIC KFRINH "Kennfeld Hinten" MAP 0xB062 DAMOS_KF289 0 R_UB_Q32 0.000000 8160.000000 /begin AXIS_DESCR STD_AXIS TKATMFH UTABG 5 -48.000000 972.000000 /end AXIS_DESCR /begin AXIS_DESCR STD_AXIS IDPHLSNF FKT0001 3 0.000000 2.560000 /end AXIS_DESCR /end CHARACTERISTIC
/begin CHARACTERISTIC KFRINV "Kennfeld Vorne" MAP 0xB044 DAMOS_KF289 0 R_UB_Q32 0.000000 8160.000000 /begin AXIS_DESCR STD_AXIS TABGMFH UTABG 5 -48.000000 972.000000 /end AXIS_DESCR /begin AXIS_DESCR STD_AXIS IDPHLSNF FKT0001 3 0.000000 2.560000 /end AXIS_DESCR /end CHARACTERISTIC
/begin CHARACTERISTIC KFRP "Lambdaregelung-Proportionalanteil" MAP 0xAA4A DAMOS_KF289 0 FKT2048 0.000000 0.124512 /begin AXIS_DESCR STD_AXIS TL8 UFUELL 10 0.000000 191.250000 /end AXIS_DESCR /begin AXIS_DESCR STD_AXIS NMOT NQ40 10 0.000000 10200.000000 /end AXIS_DESCR EXTENDED_LIMITS 0.000000 0.124510 /end CHARACTERISTIC
/begin CHARACTERISTIC KFRTV "Lambdaregelung Reglerumschaltverzoegerung" MAP 0xAACA DAMOS_KF289 0 TQ10OF -1.280000 1.270000 /begin AXIS_DESCR STD_AXIS TL8 UFUELL 10 0.000000 191.250000 /end AXIS_DESCR /begin AXIS_DESCR STD_AXIS NMOT NQ40 10 0.000000 10200.000000 /end AXIS_DESCR /end CHARACTERISTIC
/begin CHARACTERISTIC KFRTV2 "Lambdaregelung Reglerumschaltverzoegerung, Bank2 " MAP 0xAB4A DAMOS_KF289 0 TQ10OF -1.280000 1.270000 /begin AXIS_DESCR STD_AXIS TL8 UFUELL 2 0.000000 191.250000 /end AXIS_DESCR /begin AXIS_DESCR STD_AXIS NMOT NQ40 2 0.000000 10200.000000 /end AXIS_DESCR /end CHARACTERISTIC
/begin CHARACTERISTIC KFSZT "Schließzeitkennfeld" MAP 0xA8C8 DAMOS_KF289 0 TSZ 0.000000 21.705600
 /begin AXIS_DESCR STD_AXIS UBATT UBQ 8 0.000000 24.119630 EXTENDED_LIMITS 0.000000 24.119600 /end AXIS_DESCR
 /begin AXIS_DESCR STD_AXIS TMOT CMO_TMP 12 -41.000000 140.000000 /end AXIS_DESCR
/end CHARACTERISTIC
/begin CHARACTERISTIC KFTDARNG "Dauer des dyn. Antiruckel Zuendwinkeleingriffs" MAP 0xA6F0 DAMOS_KF289 0 TQ20 0.000000 5.100000 /begin AXIS_DESCR STD_AXIS GANG DEZ7 8 0.000000 7.000000 /end AXIS_DESCR /begin AXIS_DESCR STD_AXIS NMOT NQ40 6 0.000000 10200.000000 /end AXIS_DESCR /end CHARACTERISTIC
/begin CHARACTERISTIC KFTEBL "Kennfeld Tastverhältnis Tankentlüftungsventil" MAP 0xB3E3 DAMOS_GKF1 0 PCENT 0.000000 99.609380
 /begin AXIS_DESCR COM_AXIS WDKBL UWDK 8 0.000000 0.000000 AXIS_PTS_REF WDKV08 EXTENDED_LIMITS 0.000000 80.599900 /end AXIS_DESCR
 /begin AXIS_DESCR COM_AXIS NIST NQ25 8 0.000000 0.000000 AXIS_PTS_REF NISTV08 EXTENDED_LIMITS 0.000000 6400.000000 /end AXIS_DESCR
 EXTENDED_LIMITS 0.000000 99.609400 /end CHARACTERISTIC
/begin CHARACTERISTIC KFTEFMA "Sollkraftstoffrate in Tankentl." MAP 0xB3A3 DAMOS_GKF1 0 FKT512 0.000000 0.500000
 /begin AXIS_DESCR COM_AXIS TL8 UFUELL 8 0.000000 0.000000 AXIS_PTS_REF TL8V08 EXTENDED_LIMITS 0.000000 191.250000 /end AXIS_DESCR
 /begin AXIS_DESCR COM_AXIS NIST NQ25 8 0.000000 0.000000 AXIS_PTS_REF NISTV08 EXTENDED_LIMITS 0.000000 6400.000000 /end AXIS_DESCR
/end CHARACTERISTIC
/begin CHARACTERISTIC KFTHFM "KFTHFM HFM-Korrektur als f (MLSM 8 aequidistante SSt,  128.0  Kg/SSt)" MAP 0x92DD DAMOS_GKF1 0 F256OFF 0.500000 1.500000
 /begin AXIS_DESCR COM_AXIS IR0 DEZ 8 0.000000 0.000000 AXIS_PTS_REF DUM08 EXTENDED_LIMITS 0.000000 256.000000 /end AXIS_DESCR
 /begin AXIS_DESCR COM_AXIS TANS CLU_TMP 8 0.000000 0.000000 AXIS_PTS_REF TANSV08 EXTENDED_LIMITS -50.000000 150.000000 /end AXIS_DESCR
/end CHARACTERISTIC
/begin CHARACTERISTIC KFTLIP_UM "KF Lastsignal aus DK und Drehzahl in der tlc-FU" MAP 0xD3F1 DAMOS_GKF1 0 UF 0.000000 191.250000
 /begin AXIS_DESCR COM_AXIS IPSN_UM PER_DKA 8 0.000000 0.000000 AXIS_PTS_REF IPSNV08_UM EXTENDED_LIMITS 0.000000 100.000000 /end AXIS_DESCR
 /begin AXIS_DESCR COM_AXIS NIST_UM NQ25 8 0.000000 0.000000 AXIS_PTS_REF NIPV08_UM EXTENDED_LIMITS 0.000000 6400.000000 /end AXIS_DESCR
/end CHARACTERISTIC
/begin CHARACTERISTIC KFTLSTA "Lastwert für Start" MAP 0xD208 DAMOS_KF289 0 UFUELL 0.000000 191.250000 /begin AXIS_DESCR STD_AXIS TMOT CMO_TMP 9 -41.000000 140.000000 /end AXIS_DESCR
 /begin AXIS_DESCR STD_AXIS FDKHA FKT128 7 0.000000 1.992188 EXTENDED_LIMITS 0.000000 1.992190 /end AXIS_DESCR
/end CHARACTERISTIC
/begin CHARACTERISTIC KFTLW "Kennfeld fuer tl-Berechnung aus Drosselklappenwinkel" MAP 0xAD78 DAMOS_KF289 0 TEQ_32 0.000000 21.760000
 /begin AXIS_DESCR STD_AXIS WDKBL UWDK 16 0.000000 80.599920 EXTENDED_LIMITS 0.000000 80.599900 /end AXIS_DESCR
 /begin AXIS_DESCR STD_AXIS NMOT NQ40 16 0.000000 10200.000000 /end AXIS_DESCR
/end CHARACTERISTIC
/begin CHARACTERISTIC KFTLWTC "Kennfeld fuer ideale tl-Berechnung aus Drosselklappenwinkel" MAP 0xC4E2 DAMOS_KF289 0 TEQ_32 0.000000 21.760000 /begin AXIS_DESCR STD_AXIS DKVRESI PER255 16 0.000000 100.000000 /end AXIS_DESCR /begin AXIS_DESCR STD_AXIS NMOT NQ40 13 0.000000 10200.000000 /end AXIS_DESCR /end CHARACTERISTIC
/begin CHARACTERISTIC KFTPKOR "Korrekturkennfeld fuer gemessene Periodendauer TP" MAP 0x8DEC DAMOS_KF289 0 FKT128 0.000000 1.992188 /begin AXIS_DESCR STD_AXIS TL8 UFUELL 8 0.000000 191.250000 /end AXIS_DESCR /begin AXIS_DESCR STD_AXIS NMOT NQ40 8 0.000000 10200.000000 /end AXIS_DESCR EXTENDED_LIMITS 0.000000 1.992190 /end CHARACTERISTIC
/begin CHARACTERISTIC KFTVSAAC "SAS - Zeitverzögerung bei b_koe = 1" MAP 0x904A DAMOS_KF289 0 TQ20 0.000000 5.100000 /begin AXIS_DESCR STD_AXIS NIST NQ25 6 0.000000 6400.000000 /end AXIS_DESCR /begin AXIS_DESCR STD_AXIS GANG_I DEZ7 8 0.000000 7.000000 /end AXIS_DESCR /end CHARACTERISTIC
/begin CHARACTERISTIC KFTVSAN "SAS - Zeitverzögerung" MAP 0x9090 DAMOS_KF289 0 TQ20 0.000000 5.100000 /begin AXIS_DESCR STD_AXIS NIST NQ25 6 0.000000 6400.000000 /end AXIS_DESCR /begin AXIS_DESCR STD_AXIS GANG_I DEZ7 8 0.000000 7.000000 /end AXIS_DESCR /end CHARACTERISTIC
/begin CHARACTERISTIC KFUSRHK "Sondenspannungssollwert fuer Regelung hinter Kat" MAP 0xA944 DAMOS_KF289 0 U0V_1V25 0.000000 1.245117 /begin AXIS_DESCR STD_AXIS TL8 UFUELL 7 0.000000 191.250000 /end AXIS_DESCR /begin AXIS_DESCR STD_AXIS NMOT NQ40 7 0.000000 10200.000000 /end AXIS_DESCR EXTENDED_LIMITS 0.000000 1.245120 /end CHARACTERISTIC
/begin CHARACTERISTIC KFVAKL "Faktor Verzoegerungsabmagerung Motortemperatur/ f(NIST)+f(TMOT)" MAP 0x9D27 DAMOS_GKF1 0 FKT16 0.000000 15.937500
 /begin AXIS_DESCR COM_AXIS NIST NQ25 8 0.000000 0.000000 AXIS_PTS_REF NISTV08 EXTENDED_LIMITS 0.000000 6400.000000 /end AXIS_DESCR
 /begin AXIS_DESCR COM_AXIS TMOT CMO_TMP 12 0.000000 0.000000 AXIS_PTS_REF TMOTV08 EXTENDED_LIMITS -41.000000 140.000000 /end AXIS_DESCR
/end CHARACTERISTIC
/begin CHARACTERISTIC KFVOBL "Kennfeld für Massenstrom durch TEV" MAP 0xB423 DAMOS_GKF1 0 MLQ010 0.000000 25.500000
 /begin AXIS_DESCR COM_AXIS WDKBL UWDK 8 0.000000 0.000000 AXIS_PTS_REF WDKV08 EXTENDED_LIMITS 0.000000 80.599900 /end AXIS_DESCR
 /begin AXIS_DESCR COM_AXIS NIST NQ25 8 0.000000 0.000000 AXIS_PTS_REF NISTV08 EXTENDED_LIMITS 0.000000 6400.000000 /end AXIS_DESCR
/end CHARACTERISTIC
/begin CHARACTERISTIC KFWARNDG "Wichtung des AR-Zuendwinkeleingriffs ueber delta N und Ganginfo" MAP 0xA746 DAMOS_KF289 0 FKT128S -1.000000 1.000000 /begin AXIS_DESCR STD_AXIS NGRTN NGRDQ50S 12 -6400.000000 6350.000000 /end AXIS_DESCR /begin AXIS_DESCR STD_AXIS GANG DEZ7 8 0.000000 7.000000 /end AXIS_DESCR /end CHARACTERISTIC
/begin CHARACTERISTIC KFWDKOA "Schwelle wdkbl zur Klimakompressorabschaltung" MAP 0xC9B2 DAMOS_KF289 0 UWDK 0.000000 80.599920 /begin AXIS_DESCR STD_AXIS NMOT NQ40 6 0.000000 10200.000000 /end AXIS_DESCR /begin AXIS_DESCR STD_AXIS V_CAN VQV 6 0.000000 306.000000 /end AXIS_DESCR EXTENDED_LIMITS 0.000000 80.599900 /end CHARACTERISTIC
/begin CHARACTERISTIC KFWDKOE "Schwelle wdkbl zur Klimakompressorzuschaltung" MAP 0xC9EA DAMOS_KF289 0 UWDK 0.000000 80.599920 /begin AXIS_DESCR STD_AXIS NMOT NQ40 6 0.000000 10200.000000 /end AXIS_DESCR /begin AXIS_DESCR STD_AXIS V_CAN VQV 6 0.000000 306.000000 /end AXIS_DESCR EXTENDED_LIMITS 0.000000 80.599900 /end CHARACTERISTIC
/begin CHARACTERISTIC KFWEE "Vorlagerungswinkel als f(NIST) und f(TL8)" MAP 0x9E04 DAMOS_KF289 0 WQ720 0.000000 720.000000 /begin AXIS_DESCR STD_AXIS TL8 UFUELL 8 0.000000 191.250000 /end AXIS_DESCR /begin AXIS_DESCR STD_AXIS NIST NQ25 8 0.000000 6400.000000 /end AXIS_DESCR /end CHARACTERISTIC
/begin CHARACTERISTIC KFWKHL "Zuendwinkel KAT-Heizung Leerlauf" MAP 0x9FCC DAMOS_KF289 0 ZWQ 0.000000 191.250000 /begin AXIS_DESCR STD_AXIS TL8 UFUELL 6 0.000000 191.250000 /end AXIS_DESCR /begin AXIS_DESCR STD_AXIS NMOT NQ40 8 0.000000 10200.000000 /end AXIS_DESCR /end CHARACTERISTIC
/begin CHARACTERISTIC KFWKHL1 "Zuendwinkel KAT-Heizung Leerlauf Variante 1" MAP 0xA012 DAMOS_KF289 0 ZWQ 0.000000 191.250000 /begin AXIS_DESCR STD_AXIS TL8 UFUELL 6 0.000000 191.250000 /end AXIS_DESCR /begin AXIS_DESCR STD_AXIS NMOT NQ40 8 0.000000 10200.000000 /end AXIS_DESCR /end CHARACTERISTIC
/begin CHARACTERISTIC KFWKHT "Zuendwinkel KAT-Heizung Teillast" MAP 0xA058 DAMOS_KF289 0 ZWQ 0.000000 191.250000 /begin AXIS_DESCR STD_AXIS TL8Z UFUELL 8 0.000000 191.250000 /end AXIS_DESCR /begin AXIS_DESCR STD_AXIS NMOT NQ40 8 0.000000 10200.000000 /end AXIS_DESCR /end CHARACTERISTIC
/begin CHARACTERISTIC KFWKHT1 "Zuendwinkel KAT-Heizung Teillast Variante 1" MAP 0xA0B0 DAMOS_KF289 0 ZWQ 0.000000 191.250000 /begin AXIS_DESCR STD_AXIS TL8Z UFUELL 8 0.000000 191.250000 /end AXIS_DESCR /begin AXIS_DESCR STD_AXIS NMOT NQ40 8 0.000000 10200.000000 /end AXIS_DESCR /end CHARACTERISTIC
/begin CHARACTERISTIC KFWKS "KR-Sicherheitsspaetverstellung" MAP 0xB1CA DAMOS_KF289 0 ZWQ 0.000000 191.250000 /begin AXIS_DESCR STD_AXIS NMOT NQ40 6 0.000000 10200.000000 /end AXIS_DESCR /begin AXIS_DESCR STD_AXIS TL8 UFUELL 6 0.000000 191.250000 /end AXIS_DESCR /end CHARACTERISTIC
/begin CHARACTERISTIC KFWL "Kennfeldwarmlauffaktor Last/Drehzahlkorrektur Teillast/Vollast" MAP 0x985C DAMOS_KF289 0 FKT256 0.000000 0.996094 /begin AXIS_DESCR STD_AXIS TL8 UFUELL 8 0.000000 191.250000 /end AXIS_DESCR /begin AXIS_DESCR STD_AXIS NMOT NQ40 8 0.000000 10200.000000 /end AXIS_DESCR EXTENDED_LIMITS 0.000000 0.996090 /end CHARACTERISTIC
/begin CHARACTERISTIC KFWLL "Basiszündwinkelkennfeld im Leerlauf" MAP 0xA518 DAMOS_KF289 0 ZWOF -78.000000 24.000000 /begin AXIS_DESCR STD_AXIS TL8 UFUELL 7 0.000000 191.250000 /end AXIS_DESCR /begin AXIS_DESCR STD_AXIS NMOT NQ40 8 0.000000 10200.000000 /end AXIS_DESCR /end CHARACTERISTIC
/begin CHARACTERISTIC KFWLL1 "Basiszündwinkelkennfeld im Leerlauf bei eingelegtem Gang" MAP 0xA566 DAMOS_KF289 0 ZWOF -78.000000 24.000000 /begin AXIS_DESCR STD_AXIS TL8 UFUELL 7 0.000000 191.250000 /end AXIS_DESCR /begin AXIS_DESCR STD_AXIS NMOT NQ40 8 0.000000 10200.000000 /end AXIS_DESCR /end CHARACTERISTIC
/begin CHARACTERISTIC KFWLLL "Kennfeldwarmlauffaktor im Leerlauf" MAP 0x973C DAMOS_KF289 0 FKT256 0.000000 0.996094 /begin AXIS_DESCR STD_AXIS TMOT CMO_TMP 9 -41.000000 140.000000 /end AXIS_DESCR /begin AXIS_DESCR STD_AXIS NMOT NQ40 6 0.000000 10200.000000 /end AXIS_DESCR EXTENDED_LIMITS 0.000000 0.996090 /end CHARACTERISTIC
/begin CHARACTERISTIC KFWLLL1 "Kennfeldwarmlauffaktor im Leerlauf bei Automat" MAP 0x97A8 DAMOS_KF289 0 FKT256 0.000000 0.996094 /begin AXIS_DESCR STD_AXIS TMOT CMO_TMP 9 -41.000000 140.000000 /end AXIS_DESCR /begin AXIS_DESCR STD_AXIS NMOT NQ40 6 0.000000 10200.000000 /end AXIS_DESCR EXTENDED_LIMITS 0.000000 0.996090 /end CHARACTERISTIC
/begin CHARACTERISTIC KFWLLNPDN "Zuendwinkel Leerlaufeingriff bei getretener Kupplung" MAP 0xA67A DAMOS_KF289 0 ZWQ 0.000000 191.250000 /begin AXIS_DESCR STD_AXIS NIST NQ25 8 0.000000 6400.000000 /end AXIS_DESCR /begin AXIS_DESCR STD_AXIS TMOT CMO_TMP 7 -41.000000 140.000000 /end AXIS_DESCR /end CHARACTERISTIC
/begin CHARACTERISTIC KFWLLW "Zuendwinkel Warmlauf Gewichtungskennfeld im Leerlauf" MAP 0x9ECF DAMOS_GKF1 0 FKT256 0.000000 0.996094
 /begin AXIS_DESCR COM_AXIS TL8 UFUELL 8 0.000000 0.000000 AXIS_PTS_REF TL8V08 EXTENDED_LIMITS 0.000000 191.250000 /end AXIS_DESCR
 /begin AXIS_DESCR COM_AXIS NIST NQ25 8 0.000000 0.000000 AXIS_PTS_REF NISTV08 EXTENDED_LIMITS 0.000000 6400.000000 /end AXIS_DESCR
 EXTENDED_LIMITS 0.000000 0.996090 /end CHARACTERISTIC
/begin CHARACTERISTIC KFWLM "Kennfeldwarmlauffaktor Teillast/Vollast" MAP 0x96F0 DAMOS_KF289 0 FKT128 0.000000 1.992188 /begin AXIS_DESCR STD_AXIS TMOT CMO_TMP 9 -41.000000 140.000000 /end AXIS_DESCR /begin AXIS_DESCR STD_AXIS TL8 UFUELL 6 0.000000 191.250000 /end AXIS_DESCR EXTENDED_LIMITS 0.000000 1.992190 /end CHARACTERISTIC
/begin CHARACTERISTIC KFWLW "Zuendwinkel Warmlauf Gewichtungskennfeld" MAP 0x9E83 DAMOS_GKF1 0 FKT256 0.000000 0.996094
 /begin AXIS_DESCR COM_AXIS TL8 UFUELL 8 0.000000 0.000000 AXIS_PTS_REF TL8V08 EXTENDED_LIMITS 0.000000 191.250000 /end AXIS_DESCR
 /begin AXIS_DESCR COM_AXIS NIST NQ25 8 0.000000 0.000000 AXIS_PTS_REF NISTV08 EXTENDED_LIMITS 0.000000 6400.000000 /end AXIS_DESCR
 EXTENDED_LIMITS 0.000000 0.996090 /end CHARACTERISTIC
/begin CHARACTERISTIC KFZNS "Nachstart-Zeitkonstante für TP1" MAP 0x9554 DAMOS_KF289 0 K409Q 1.606274 409.600000 /begin AXIS_DESCR STD_AXIS TMOT CMO_TMP 12 -41.000000 140.000000 /end AXIS_DESCR /begin AXIS_DESCR STD_AXIS TANS CLU_TMP 5 -50.000000 150.000000 /end AXIS_DESCR EXTENDED_LIMITS 1.606270 409.600000 /end CHARACTERISTIC
/begin CHARACTERISTIC KFZNS1 "Nachstart-Zeitkonstante für TP1 (Automat)" MAP 0x95FC DAMOS_KF289 0 K409Q 1.606274 409.600000 /begin AXIS_DESCR STD_AXIS TMOT CMO_TMP 12 -41.000000 140.000000 /end AXIS_DESCR /begin AXIS_DESCR STD_AXIS TANS CLU_TMP 5 -50.000000 150.000000 /end AXIS_DESCR EXTENDED_LIMITS 1.606270 409.600000 /end CHARACTERISTIC
/begin CHARACTERISTIC KFZSWACC " Zeitkonstante fuer SW_ACC Filter" MAP 0xCDB2 DAMOS_KF289 0 K10Q 0.010039 2.560000 /begin AXIS_DESCR STD_AXIS NIST NQ25 8 0.000000 6400.000000 /end AXIS_DESCR /begin AXIS_DESCR STD_AXIS SW_ACC8 PER255 8 0.000000 100.000000 /end AXIS_DESCR /end CHARACTERISTIC
/begin CHARACTERISTIC KFZSWEGS " Zeitkonstante fuer SW_EGS Filter" MAP 0xAFA8 DAMOS_KF289 0 K10Q 0.010039 2.560000 /begin AXIS_DESCR STD_AXIS NIST NQ25 8 0.000000 6400.000000 /end AXIS_DESCR /begin AXIS_DESCR STD_AXIS SW_EGS8 PER255 8 0.000000 100.000000 /end AXIS_DESCR /end CHARACTERISTIC
/begin CHARACTERISTIC KFZTL "Zeitkonstante tL-Filter " MAP 0x910A DAMOS_KF289 0 PHI1_SY 0.000000 99.609380 /begin AXIS_DESCR STD_AXIS TLR8 UFUELL 8 0.000000 191.250000 /end AXIS_DESCR /begin AXIS_DESCR STD_AXIS NMOT NQ40 8 0.000000 10200.000000 /end AXIS_DESCR EXTENDED_LIMITS 0.000000 99.609400 /end CHARACTERISTIC
/begin CHARACTERISTIC KFZTLM "Zeitkonstante tLM-Filter " MAP 0x922E DAMOS_KF289 0 PHI1_SY 0.000000 99.609380 /begin AXIS_DESCR STD_AXIS TLR8 UFUELL 8 0.000000 191.250000 /end AXIS_DESCR /begin AXIS_DESCR STD_AXIS NMOT NQ40 8 0.000000 10200.000000 /end AXIS_DESCR EXTENDED_LIMITS 0.000000 99.609400 /end CHARACTERISTIC
/begin CHARACTERISTIC KFZTLMN "Zeitkonstante tLM-Filter (b_tlfu = 1) " MAP 0x9286 DAMOS_KF289 0 PHI1_SY 0.000000 99.609380 /begin AXIS_DESCR STD_AXIS TLR8 UFUELL 8 0.000000 191.250000 /end AXIS_DESCR /begin AXIS_DESCR STD_AXIS NMOT NQ40 8 0.000000 10200.000000 /end AXIS_DESCR EXTENDED_LIMITS 0.000000 99.609400 /end CHARACTERISTIC
/begin CHARACTERISTIC KFZTLN "Zeitkonstante tL-Filter bei neg. Laständ." MAP 0x9162 DAMOS_KF289 0 PHI1_SY 0.000000 99.609380 /begin AXIS_DESCR STD_AXIS TLR8 UFUELL 8 0.000000 191.250000 /end AXIS_DESCR /begin AXIS_DESCR STD_AXIS NMOT NQ40 8 0.000000 10200.000000 /end AXIS_DESCR EXTENDED_LIMITS 0.000000 99.609400 /end CHARACTERISTIC
/begin CHARACTERISTIC KFZTLZ "Zeitkonstante tLZ-Filter " MAP 0x91D6 DAMOS_KF289 0 PHI1_SY 0.000000 99.609380 /begin AXIS_DESCR STD_AXIS TLR8 UFUELL 8 0.000000 191.250000 /end AXIS_DESCR /begin AXIS_DESCR STD_AXIS NMOT NQ40 8 0.000000 10200.000000 /end AXIS_DESCR EXTENDED_LIMITS 0.000000 99.609400 /end CHARACTERISTIC
/begin CHARACTERISTIC KFZW "Basiszuendwinkel Teillastkennfeld" MAP 0xA1F0 DAMOS_KF289 0 ZWOF -78.000000 24.000000 /begin AXIS_DESCR STD_AXIS TL8Z UFUELL 16 0.000000 191.250000 /end AXIS_DESCR /begin AXIS_DESCR STD_AXIS NMOT NQ40 16 0.000000 10200.000000 /end AXIS_DESCR /end CHARACTERISTIC
/begin CHARACTERISTIC KFZWLW "add. Spaetwinkel der dyn. Antiruckelfkt. bei Lastwechselschlag" MAP 0xA81A DAMOS_KF289 0 ZWQ 0.000000 191.250000 /begin AXIS_DESCR STD_AXIS NMOT NQ40 7 0.000000 10200.000000 /end AXIS_DESCR /begin AXIS_DESCR STD_AXIS GANG DEZ7 8 0.000000 7.000000 /end AXIS_DESCR /end CHARACTERISTIC
/begin CHARACTERISTIC KFZWNW "Basiszuendwinkel Teillastkennfeld für NWS" MAP 0xA384 DAMOS_KF289 0 ZWOF -78.000000 24.000000 /begin AXIS_DESCR STD_AXIS TL8Z UFUELL 16 0.000000 191.250000 /end AXIS_DESCR /begin AXIS_DESCR STD_AXIS NMOT NQ40 16 0.000000 10200.000000 /end AXIS_DESCR /end CHARACTERISTIC
/begin CHARACTERISTIC KFZWTMA "Zuendwinkelkorrektur durch Ansaugluft- und Motortemperatur" MAP 0xA5D9 DAMOS_GKF1 0 ZWQ 0.000000 191.250000
 /begin AXIS_DESCR COM_AXIS TMOT CMO_TMP 12 0.000000 0.000000 AXIS_PTS_REF TMOTV08 EXTENDED_LIMITS -41.000000 140.000000 /end AXIS_DESCR
 /begin AXIS_DESCR COM_AXIS TANS CLU_TMP 8 0.000000 0.000000 AXIS_PTS_REF TANSV08 EXTENDED_LIMITS -50.000000 150.000000 /end AXIS_DESCR
/end CHARACTERISTIC
/begin CHARACTERISTIC KFZWV "Basiszuendwinkel Vollastkennfeld" MAP 0xA318 DAMOS_KF289 0 ZWOF -78.000000 24.000000 /begin AXIS_DESCR STD_AXIS TL8Z UFUELL 5 0.000000 191.250000 /end AXIS_DESCR /begin AXIS_DESCR STD_AXIS NMOT NQ40 16 0.000000 10200.000000 /end AXIS_DESCR /end CHARACTERISTIC
/begin CHARACTERISTIC KFZWVNW "Basiszündwinkel Vollastkennfeld für NWS" MAP 0xA4AC DAMOS_KF289 0 ZWOF -78.000000 24.000000 /begin AXIS_DESCR STD_AXIS TL8Z UFUELL 5 0.000000 191.250000 /end AXIS_DESCR /begin AXIS_DESCR STD_AXIS NMOT NQ40 16 0.000000 10200.000000 /end AXIS_DESCR /end CHARACTERISTIC
/begin CHARACTERISTIC KFZW_UM "KF theor. optimaler Zündwinkel in der mist-FU" MAP 0xD531 DAMOS_GKF1 0 ZWOF -78.000000 24.000000
 /begin AXIS_DESCR COM_AXIS TL8_UM UFUELL 8 0.000000 0.000000 AXIS_PTS_REF TL8V08_UM EXTENDED_LIMITS 0.000000 191.250000 /end AXIS_DESCR
 /begin AXIS_DESCR COM_AXIS NIST_UM NQ25 8 0.000000 0.000000 AXIS_PTS_REF NZWV08_UM EXTENDED_LIMITS 0.000000 6400.000000 /end AXIS_DESCR
/end CHARACTERISTIC
/begin CHARACTERISTIC KHFM "Grundanpassungsfaktor zu Lastberechnung bei HFM-Syst." VALUE 0x8124 DAMOS_FW3 0 UTWKSSL 0.000000 6553.500000 /end CHARACTERISTIC
/begin CHARACTERISTIC KHOFF "LFR5 Katheizen aktiv, Offset auf Regler" CURVE 0xC36C DAMOS_KL97 0 UDKL8 0.000000 5.037495 /begin AXIS_DESCR STD_AXIS WKH ZWQ 6 0.000000 191.250000 /end AXIS_DESCR EXTENDED_LIMITS 0.000000 5.037500 /end CHARACTERISTIC
/begin CHARACTERISTIC KH_UG "LFR5 Katheizen aktiv, Anteil auf Untergrenze" CURVE 0xC428 DAMOS_KL97 0 UWKL10 0.000000 10.069900 /begin AXIS_DESCR STD_AXIS WKH ZWQ 6 0.000000 191.250000 /end AXIS_DESCR /end CHARACTERISTIC
/begin CHARACTERISTIC KLDNNWSM "Drehzahlschwelle der NWS für XNSOLST" CURVE 0xCEF6 DAMOS_KL97 0 NQ40 0.000000 10200.000000 /begin AXIS_DESCR STD_AXIS TMOT CMO_TMP 6 -41.000000 140.000000 /end AXIS_DESCR /end CHARACTERISTIC
/begin CHARACTERISTIC KLETAZW_UM "Zündwinkelwirkungsgrad als Diff.aus opt. und ausgegebenen Winkel" CURVE 0xD3E1 DAMOS_GKL1 0 PER255 0.000000 100.000000
 /begin AXIS_DESCR COM_AXIS DZW_UM ZWQ 8 0.000000 0.000000 AXIS_PTS_REF DZWV08_UM EXTENDED_LIMITS 0.000000 191.250000 /end AXIS_DESCR
/end CHARACTERISTIC
/begin CHARACTERISTIC KLFRINH " Verstärkungsfaktor Hinten" CURVE 0xB036 DAMOS_KL97 0 FKT16 0.000000 15.937500 /begin AXIS_DESCR STD_AXIS TKATMFH UTABG 5 -48.000000 972.000000 /end AXIS_DESCR /end CHARACTERISTIC
/begin CHARACTERISTIC KLFRINV " Verstärkungsfaktor Vorne" CURVE 0xB028 DAMOS_KL97 0 FKT16 0.000000 15.937500 /begin AXIS_DESCR STD_AXIS TABGMFH UTABG 5 -48.000000 972.000000 /end AXIS_DESCR /end CHARACTERISTIC
/begin CHARACTERISTIC KLIMLAB "Schwelle integr. Luftm. f. Taupunktendeerkennung v. Kat als f(Starttemp.)" CURVE 0xB093 DAMOS_GKL1 0 MLQ002 0.000000 5.100000
 /begin AXIS_DESCR COM_AXIS TMST CMO_TMP 12 0.000000 0.000000 AXIS_PTS_REF TSTMOTV08 EXTENDED_LIMITS -41.000000 140.000000 /end AXIS_DESCR
/end CHARACTERISTIC
/begin CHARACTERISTIC KLIMLAW "Schwelle int. Luftm. Taupunktende v. Kat (Wiederholst.) als f(Starttemp.)" CURVE 0xB09F DAMOS_GKL1 0 MLQ002 0.000000 5.100000
 /begin AXIS_DESCR COM_AXIS TMST CMO_TMP 12 0.000000 0.000000 AXIS_PTS_REF TSTMOTV08 EXTENDED_LIMITS -41.000000 140.000000 /end AXIS_DESCR
/end CHARACTERISTIC
/begin CHARACTERISTIC KLIMLKAT "KL Schwelle integr. Luftmass f. Taupunktendeerkennung hi. Kat" CURVE 0xB0AB DAMOS_GKL1 0 MLQ002 0.000000 5.100000
 /begin AXIS_DESCR COM_AXIS TMST CMO_TMP 12 0.000000 0.000000 AXIS_PTS_REF TSTMOTV08 EXTENDED_LIMITS -41.000000 140.000000 /end AXIS_DESCR
/end CHARACTERISTIC
/begin CHARACTERISTIC KLIMLKATW "KL Schwelle integr. Luftmasse f. verglaengerte Taup.endeerk. hi. Kat" CURVE 0xB0B7 DAMOS_GKL1 0 MLQ002 0.000000 5.100000
 /begin AXIS_DESCR COM_AXIS TMST CMO_TMP 12 0.000000 0.000000 AXIS_PTS_REF TSTMOTV08 EXTENDED_LIMITS -41.000000 140.000000 /end AXIS_DESCR
/end CHARACTERISTIC
/begin CHARACTERISTIC KLNPED_UM "Pedalsoll. abh. Maximaldrehzahl in der DK-Antriebsersatzfkt." CURVE 0xD3E9 DAMOS_GKL1 0 NQ25 0.000000 6400.000000
 /begin AXIS_DESCR COM_AXIS SPSN_UM DEZ 8 0.000000 0.000000 AXIS_PTS_REF NPEDV08_UM EXTENDED_LIMITS 0.000000 256.000000 /end AXIS_DESCR
/end CHARACTERISTIC
/begin CHARACTERISTIC KLOFBW_T "Klimaoffset-Bewertungszeit" VALUE 0x85EE DAMOS_FW3 0 TQ100L 0.000000 6553.500000 /end CHARACTERISTIC
/begin CHARACTERISTIC KLOFVB_T "Klimaoffset-Vebotszeit" VALUE 0x85B2 DAMOS_FW1 0 TQ10 0.000000 2.550000 /end CHARACTERISTIC
/begin CHARACTERISTIC KLTLSLFR "drehzahlabh. TL-Sollwert in LFR5" CURVE 0xC34A DAMOS_KL97 0 UFUELL 0.000000 191.250000 /begin AXIS_DESCR STD_AXIS NMOT NQ40 8 0.000000 10200.000000 /end AXIS_DESCR /end CHARACTERISTIC
/begin CHARACTERISTIC KLWF "Kraftstoffwandfilmkennlinie aequidistante Abstaende = 16.0% Last" CURVE 0x8157 DAMOS_FKL1 0 TEQ_768 0.000000 522.240100
 /begin AXIS_DESCR FIX_AXIS IR0 DEZ 17 0.000000 16.000000 FIX_AXIS_PAR 0 0 17 EXTENDED_LIMITS 0.000000 256.000000 /end AXIS_DESCR
 EXTENDED_LIMITS 0.000000 522.240000 /end CHARACTERISTIC
/begin CHARACTERISTIC KL_ABW "Abweichung Sollwert - Istwert" VALUE 0x862A DAMOS_FW1 0 PER_DKA 0.000000 100.000000 /end CHARACTERISTIC
/begin CHARACTERISTIC KMXSTG "Filterkonstante fuer Filter max. Steigung fuer sonde hinter Kat" VALUE 0x8352 DAMOS_FW1 0 FKT256 0.000000 0.996094 EXTENDED_LIMITS 0.000000 0.996090 /end CHARACTERISTIC
/begin CHARACTERISTIC KOEOFF "LFR5 Klimakompressor ein, Offset auf Regler" CURVE 0xC35E DAMOS_KL97 0 UDKL8 0.000000 5.037495 /begin AXIS_DESCR STD_AXIS NIST NQ25 5 0.000000 6400.000000 /end AXIS_DESCR EXTENDED_LIMITS 0.000000 5.037500 /end CHARACTERISTIC
/begin CHARACTERISTIC KOE_UG "LFR5 Klimakompressor ein, Anteil auf Untergrenze" CURVE 0xC30A DAMOS_KL97 0 UWKL10 0.000000 10.069900 /begin AXIS_DESCR STD_AXIS NMOT NQ40 6 0.000000 10200.000000 /end AXIS_DESCR /end CHARACTERISTIC
/begin CHARACTERISTIC KORR_B_T "Zeit bis Korrektur von V_soll nach Beschleunigung" VALUE 0x8666 DAMOS_FW1 0 TQ100 0.000000 25.500000 /end CHARACTERISTIC
/begin CHARACTERISTIC KORR_V_T "Zeit bis Korrektur von V_soll nach Verzoegerung" VALUE 0x8667 DAMOS_FW1 0 TQ100 0.000000 25.500000 /end CHARACTERISTIC
/begin CHARACTERISTIC KORTATE "Korrekuturkennlinie für Tastverhältnis TEV" CURVE 0xB463 DAMOS_GKL1 0 PCENT 0.000000 99.609380
 /begin AXIS_DESCR COM_AXIS TATE PCENT 8 0.000000 0.000000 AXIS_PTS_REF TATEV08 EXTENDED_LIMITS 0.000000 99.609400 /end AXIS_DESCR
 EXTENDED_LIMITS 0.000000 99.609400 /end CHARACTERISTIC
/begin CHARACTERISTIC KRAL1 "Lastschwelle 1 fuer KR-Adaption" VALUE 0x8283 DAMOS_FW1 0 UFUELL 0.000000 191.250000 /end CHARACTERISTIC
/begin CHARACTERISTIC KRAL2 "Lastschwelle 2 fuer KR-Adaption" VALUE 0x8284 DAMOS_FW1 0 UFUELL 0.000000 191.250000 /end CHARACTERISTIC
/begin CHARACTERISTIC KRALH "Lasthysterese fuer KRALX" VALUE 0x8285 DAMOS_FW1 0 UFUELL 0.000000 191.250000 /end CHARACTERISTIC
/begin CHARACTERISTIC KRAN1 "Drehzahlbereichsschwelle 1 fuer KR-Adaption" VALUE 0x827E DAMOS_FW1 0 NQ25 0.000000 6400.000000 /end CHARACTERISTIC
/begin CHARACTERISTIC KRAN2 "Drehzahlbereichsschwelle 2 fuer KR-Adaption" VALUE 0x827F DAMOS_FW1 0 NQ25 0.000000 6400.000000 /end CHARACTERISTIC
/begin CHARACTERISTIC KRAN3 "Drehzahlbereichsschwelle 3 fuer KR-Adaption" VALUE 0x8280 DAMOS_FW1 0 NQ25 0.000000 6400.000000 /end CHARACTERISTIC
/begin CHARACTERISTIC KRAN4 "Drehzahlbereichsschwelle 4 fuer KR-Adaption" VALUE 0x8281 DAMOS_FW1 0 NQ25 0.000000 6400.000000 /end CHARACTERISTIC
/begin CHARACTERISTIC KRANH "Drehzahlhysterese fuer KRANX" VALUE 0x8282 DAMOS_FW1 0 NQ25 0.000000 6400.000000 /end CHARACTERISTIC
/begin CHARACTERISTIC KRAP "KR-Aplikations-Switch : 0/1 = KRA-KF-Init im URINIT/URINIT + INIT" VALUE 0x828B DAMOS_FW1 0 UKRAP 0.000000 0.000000 /end CHARACTERISTIC
/begin CHARACTERISTIC KRFHT "KR-HW-Test Fehlerzaehlerschwelle" VALUE 0x8294 DAMOS_FW1 0 DEZ 0.000000 256.000000 /end CHARACTERISTIC
/begin CHARACTERISTIC KRFK "Spaetverstellung pro Klopfer" VALUE 0x8271 DAMOS_FW1 0 ZWQ 0.000000 191.250000 /end CHARACTERISTIC
/begin CHARACTERISTIC KRFKN "Spaetverstellung pro Klopfereignis" CURVE 0xD392 DAMOS_KL97 0 ZWQ 0.000000 191.250000 /begin AXIS_DESCR STD_AXIS NMOT NQ40 8 0.000000 10200.000000 /end AXIS_DESCR /end CHARACTERISTIC
/begin CHARACTERISTIC KRFTP2 "Filterkonstante Drehzahldynamik " VALUE 0x82B7 DAMOS_FW1 0 DEZ 0.000000 256.000000 /end CHARACTERISTIC
/begin CHARACTERISTIC KRFTP3 "Filterkonstante Lastdynamik " VALUE 0x82B6 DAMOS_FW1 0 DEZ 0.000000 256.000000 /end CHARACTERISTIC
/begin CHARACTERISTIC KRIMX "Klopferkennung Absolutschwelle" VALUE 0x827C DAMOS_FW3 0 SENSORW 0.000000 4.999924 EXTENDED_LIMITS 0.000000 4.999920 /end CHARACTERISTIC
/begin CHARACTERISTIC KRMXN "Klopfregeltiefenbegrenzung" CURVE 0xB1B2 DAMOS_KL97 0 ZWQ 0.000000 191.250000 /begin AXIS_DESCR STD_AXIS NMOT NQ40 10 0.000000 10200.000000 /end AXIS_DESCR /end CHARACTERISTIC
/begin CHARACTERISTIC KRNLZ "Drehzahlschwelle oberhalb der Führung durch Leitzylinder aktiv" VALUE 0x8298 DAMOS_FW1 0 NQ40 0.000000 10200.000000 /end CHARACTERISTIC
/begin CHARACTERISTIC KRNLZ1 "Drehzahlschwelle oberhalb der Führung durch Leitzylinder1 aktiv" VALUE 0x82A5 DAMOS_FW1 0 NQ40 0.000000 10200.000000 /end CHARACTERISTIC
/begin CHARACTERISTIC KRTIS "Minimale KRINT-Schwelle fuer KR-Test-Impulspruefung" VALUE 0x8288 DAMOS_FW3 0 SENSORW 0.000000 4.999924 EXTENDED_LIMITS 0.000000 4.999920 /end CHARACTERISTIC
/begin CHARACTERISTIC KRVFN "Klopfabregelwerte Stufenbreite = f(N)" CURVE 0xB2A6 DAMOS_GKL1 0 DEZ 0.000000 256.000000
 /begin AXIS_DESCR COM_AXIS NMOT NQ40 16 0.000000 0.000000 AXIS_PTS_REF SNM16KRUB EXTENDED_LIMITS 0.000000 10200.000000 /end AXIS_DESCR
/end CHARACTERISTIC
/begin CHARACTERISTIC KTL8_UG "Untergrenzen-Anteil bei Klimakompressorbetrieb als f(TL8)" CURVE 0xBF98 DAMOS_GKL1 0 UWKL10 0.000000 10.069900
 /begin AXIS_DESCR COM_AXIS TL8 UFUELL 8 0.000000 0.000000 AXIS_PTS_REF TL8V08 EXTENDED_LIMITS 0.000000 191.250000 /end AXIS_DESCR
/end CHARACTERISTIC
/begin CHARACTERISTIC KVACAL "Umrechnungsfaktor Ti-Integrator fuer Ausgabe ueber CAN" VALUE 0x8550 DAMOS_FW3 0 DEZL 0.000000 65535.000000 /end CHARACTERISTIC
/begin CHARACTERISTIC KWFSE "FALSE = Sperren der WFS in Applikationsphase " VALUE 0x84B0 DAMOS_FW1 0 DEZ 0.000000 256.000000 /end CHARACTERISTIC
/begin CHARACTERISTIC KWFSOPT "FALSE = Immobilizer ist optional" VALUE 0x84B1 DAMOS_FW1 0 DEZ 0.000000 256.000000 /end CHARACTERISTIC
/begin CHARACTERISTIC K_FGR "Verstaerkung fuer FGR" CURVE 0x86E8 DAMOS_FKL3 0 DEZL 0.000000 65535.000000
 /begin AXIS_DESCR FIX_AXIS IR0 DEZ 7 0.000000 6.000000 FIX_AXIS_PAR 0 0 7 EXTENDED_LIMITS 0.000000 256.000000 /end AXIS_DESCR
/end CHARACTERISTIC
/begin CHARACTERISTIC K_FGR1 "Verstaerkung fuer FGR bei AT-Getr." CURVE 0x8720 DAMOS_FKL3 0 DEZL 0.000000 65535.000000
 /begin AXIS_DESCR FIX_AXIS IR0 DEZ 7 0.000000 6.000000 FIX_AXIS_PAR 0 0 7 EXTENDED_LIMITS 0.000000 256.000000 /end AXIS_DESCR
/end CHARACTERISTIC
/begin CHARACTERISTIC K_ICALC "NMAX Faktor des I-Reglers" VALUE 0x81BE DAMOS_FW3 0 FKT4096L 0.000000 16.000000 /end CHARACTERISTIC
/begin CHARACTERISTIC K_ISET "NMAX Startfaktor des I-Reglers" VALUE 0x81BC DAMOS_FW3 0 FKT64L 0.000000 1023.984000 EXTENDED_LIMITS 0.000000 1023.980000 /end CHARACTERISTIC
/begin CHARACTERISTIC K_PCALC "NMAX Faktor des P-Reglers" VALUE 0x81C0 DAMOS_FW3 0 FKT4096L 0.000000 16.000000 /end CHARACTERISTIC
/begin CHARACTERISTIC K_R_FGR "Verstaerkung fuer FGR" CURVE 0x86F6 DAMOS_FKL3 0 DEZL 0.000000 65535.000000
 /begin AXIS_DESCR FIX_AXIS IR0 DEZ 7 0.000000 6.000000 FIX_AXIS_PAR 0 0 7 EXTENDED_LIMITS 0.000000 256.000000 /end AXIS_DESCR
/end CHARACTERISTIC
/begin CHARACTERISTIC K_R_FGR1 "Verstaerkung fuer FGR bei AT-Getr." CURVE 0x872E DAMOS_FKL3 0 DEZL 0.000000 65535.000000
 /begin AXIS_DESCR FIX_AXIS IR0 DEZ 7 0.000000 6.000000 FIX_AXIS_PAR 0 0 7 EXTENDED_LIMITS 0.000000 256.000000 /end AXIS_DESCR
/end CHARACTERISTIC
/begin CHARACTERISTIC LAGE_F_T "Fehlerzeit bei Pruefung DK-Lage" VALUE 0x862C DAMOS_FW1 0 TQ100 0.000000 25.500000 /end CHARACTERISTIC
/begin CHARACTERISTIC LALIUSH "Lambdalinearisierung Sonde hinter Kat" CURVE 0xACCC DAMOS_KL97 0 FKT_LAMBDA 0.970000 1.029766
 /begin AXIS_DESCR STD_AXIS IUSHKB U0V_1V25 10 0.000000 1.245117 EXTENDED_LIMITS 0.000000 1.245120 /end AXIS_DESCR
 EXTENDED_LIMITS 0.970000 1.029770 /end CHARACTERISTIC
/begin CHARACTERISTIC LAMLGF " " VALUE 0x8353 DAMOS_FW1 0 FKT128 0.000000 1.992188 EXTENDED_LIMITS 0.000000 1.992190 /end CHARACTERISTIC
/begin CHARACTERISTIC LAMLGMTM "Laufgrenze mager" CURVE 0x8E44 DAMOS_KL97 0 FKT128 0.000000 1.992188 /begin AXIS_DESCR STD_AXIS TMOT CMO_TMP 5 -41.000000 140.000000 /end AXIS_DESCR EXTENDED_LIMITS 0.000000 1.992190 /end CHARACTERISTIC
/begin CHARACTERISTIC LFREQAF " Soll-Lüfterleistung im Nachlauf" VALUE 0x87B8 DAMOS_FW1 0 PCENT 0.000000 99.609380 EXTENDED_LIMITS 0.000000 99.609400 /end CHARACTERISTIC
/begin CHARACTERISTIC LFREQAF2 " Soll-Lüfterleistung im Nachlauf Stufe 2" VALUE 0x87B9 DAMOS_FW1 0 PCENT 0.000000 99.609380 EXTENDED_LIMITS 0.000000 99.609400 /end CHARACTERISTIC
/begin CHARACTERISTIC LFREQTMOT "Luefterleistung TMOT-abhaengig" CURVE 0xCF5E DAMOS_KL97 0 PCENT 0.000000 99.609380 /begin AXIS_DESCR STD_AXIS TMOT_L TMP_79_140 6 77.700000 140.000000 /end AXIS_DESCR EXTENDED_LIMITS 0.000000 99.609400 /end CHARACTERISTIC
/begin CHARACTERISTIC LL01V_T "Lastwechsel-Verzoegerungszeit" VALUE 0x85AE DAMOS_FW1 0 TQ10 0.000000 2.550000 /end CHARACTERISTIC
/begin CHARACTERISTIC LLP_T "Leerlauf-Phasen-Zeit" VALUE 0x85E4 DAMOS_FW3 0 TQ100L 0.000000 6553.500000 /end CHARACTERISTIC
/begin CHARACTERISTIC LLR_OG_T "Fehlerzeit fuer Leerlauf-Regler an der Obergrenze" VALUE 0x85B4 DAMOS_FW1 0 TQ100 0.000000 25.500000 /end CHARACTERISTIC
/begin CHARACTERISTIC LLR_UG_T "Fehlerzeit fuer Leerlauf-Regler an der Untergrenze" VALUE 0x85B3 DAMOS_FW1 0 TQ100 0.000000 25.500000 /end CHARACTERISTIC
/begin CHARACTERISTIC LSDKUP_T "LSD-Sperrzeit nach Kupplungswechsel B_KUP 1->0" VALUE 0x8600 DAMOS_FW1 0 TQ10 0.000000 2.550000 /end CHARACTERISTIC
/begin CHARACTERISTIC LSDPCOD "Codierung für Lastschlagdämpfung und Dashpot-Funktion" VALUE 0x85F6 DAMOS_FW1 0 DEZ 0.000000 256.000000 /end CHARACTERISTIC
/begin CHARACTERISTIC LUE2CNF " Variante fuer 1 oder 2 stufigen Motorlüfter" VALUE 0x87AC DAMOS_FW1 0 DEZ 0.000000 256.000000 /end CHARACTERISTIC
/begin CHARACTERISTIC LUES1OFF "LFR5 Motorlüfter1 ein, Offset auf Regler" VALUE 0x85F8 DAMOS_FW3 0 UDKL 0.000000 10.112030 EXTENDED_LIMITS 0.000000 10.112000 /end CHARACTERISTIC
/begin CHARACTERISTIC LUES1_UG "LFR5 Motorlüfter1 ein, Anteil auf Untergrenze" VALUE 0x85FC DAMOS_FW3 0 UDKL 0.000000 10.112030 EXTENDED_LIMITS 0.000000 10.112000 /end CHARACTERISTIC
/begin CHARACTERISTIC LUES2OFF "LFR5 Motorlüfter2 ein, Offset auf Regler" VALUE 0x85FA DAMOS_FW3 0 UDKL 0.000000 10.112030 EXTENDED_LIMITS 0.000000 10.112000 /end CHARACTERISTIC
/begin CHARACTERISTIC LUES2_UG "LFR5 Motorlüfter2 ein, Anteil auf Untergrenze" VALUE 0x85FE DAMOS_FW3 0 UDKL 0.000000 10.112030 EXTENDED_LIMITS 0.000000 10.112000 /end CHARACTERISTIC
/begin CHARACTERISTIC LURFOST " " VALUE 0x830F DAMOS_FW2 0 LUQ_S8 -94.296300 93.559620 EXTENDED_LIMITS -94.296300 93.559600 /end CHARACTERISTIC
/begin CHARACTERISTIC LURKTM "Tmot-abhaengiger Laufunruhe-Referenz-Korrekturwert" CURVE 0xB651 DAMOS_GKL2 0 LUQ_S8 -94.296300 93.559620
 /begin AXIS_DESCR COM_AXIS TMOT CMO_TMP 12 0.000000 0.000000 AXIS_PTS_REF TMOTV08 EXTENDED_LIMITS -41.000000 140.000000 /end AXIS_DESCR
 EXTENDED_LIMITS -94.296300 93.559600 /end CHARACTERISTIC
/begin CHARACTERISTIC LURMIN1 " " CURVE 0xB4A9 DAMOS_GKL2 0 LUQ_S8 -94.296300 93.559620
 /begin AXIS_DESCR COM_AXIS NIST NQ25 8 0.000000 0.000000 AXIS_PTS_REF NDMDV08 EXTENDED_LIMITS 0.000000 6400.000000 /end AXIS_DESCR
 EXTENDED_LIMITS -94.296300 93.559600 /end CHARACTERISTIC
/begin CHARACTERISTIC LURMIN2 " " CURVE 0xB4B1 DAMOS_GKL2 0 LUQ_S8 -94.296300 93.559620
 /begin AXIS_DESCR COM_AXIS NIST NQ25 8 0.000000 0.000000 AXIS_PTS_REF NDMDV08 EXTENDED_LIMITS 0.000000 6400.000000 /end AXIS_DESCR
 EXTENDED_LIMITS -94.296300 93.559600 /end CHARACTERISTIC
/begin CHARACTERISTIC LURMIN3 " " CURVE 0xB4B9 DAMOS_GKL2 0 LUQ_S8 -94.296300 93.559620
 /begin AXIS_DESCR COM_AXIS NIST NQ25 8 0.000000 0.000000 AXIS_PTS_REF NDMDV08 EXTENDED_LIMITS 0.000000 6400.000000 /end AXIS_DESCR
 EXTENDED_LIMITS -94.296300 93.559600 /end CHARACTERISTIC
/begin CHARACTERISTIC LU_UG "Untergrenzen-Anteil als f(TANS)" CURVE 0xBF90 DAMOS_GKL1 0 UWKL10 0.000000 10.069900
 /begin AXIS_DESCR COM_AXIS TANS CLU_TMP 8 0.000000 0.000000 AXIS_PTS_REF TANSV08 EXTENDED_LIMITS -50.000000 150.000000 /end AXIS_DESCR
/end CHARACTERISTIC
/begin CHARACTERISTIC LWB_KL "TL-Sollwert fuer Lastwert-Begrenzung als f(NIST)" CURVE 0xBFDB DAMOS_GKL1 0 UFUELL 0.000000 191.250000
 /begin AXIS_DESCR COM_AXIS NIST NQ25 8 0.000000 0.000000 AXIS_PTS_REF NISTV08 EXTENDED_LIMITS 0.000000 6400.000000 /end AXIS_DESCR
/end CHARACTERISTIC
/begin CHARACTERISTIC LWB_RP "Rampen-Delta fuer Sollwert Lastwert-Begrenzung" VALUE 0x875E DAMOS_FW3 0 PER0327 0.000000 100.000000 /end CHARACTERISTIC
/begin CHARACTERISTIC LZAGSV_T "Verzoegerungszeit fuer Langzeitadaptions-Grundwert-Speicherung" VALUE 0x85B7 DAMOS_FW1 0 TQ100 0.000000 25.500000 /end CHARACTERISTIC
/begin CHARACTERISTIC LZAVB_T "Langzeit-Adaptions-Verbotzeit" VALUE 0x85C4 DAMOS_FW3 0 TQ100L 0.000000 6553.500000 /end CHARACTERISTIC
/begin CHARACTERISTIC LZA_GINI "Urstartwert von LZA_GW" VALUE 0x85D4 DAMOS_FW3 0 UDKL 0.000000 10.112030 EXTENDED_LIMITS 0.000000 10.112000 /end CHARACTERISTIC
/begin CHARACTERISTIC LZA_GMAX "Maximalwert fuer Langzeit-Adaptions-Grundwert" VALUE 0x85CA DAMOS_FW3 0 UDKL 1.009968 2.498993 EXTENDED_LIMITS 0.000000 10.112000 /end CHARACTERISTIC
/begin CHARACTERISTIC LZA_N_OF "Offset zur Vermeidung des LZA-Grundwertes" VALUE 0x85D0 DAMOS_FW3 0 UDKL 0.000000 10.112030 EXTENDED_LIMITS 0.000000 10.112000 /end CHARACTERISTIC
/begin CHARACTERISTIC LZA_O_AT "obere Ansuglufttemperaturschwelle fuer Langzeit-Adaption" VALUE 0x85BB DAMOS_FW1 0 CLU_TMP -50.000000 150.000000 /end CHARACTERISTIC
/begin CHARACTERISTIC LZA_O_MT "obere Temperaturschwelle fuer Langzeit-Adaption" VALUE 0x85B9 DAMOS_FW1 0 CMO_TMP -41.000000 140.000000 /end CHARACTERISTIC
/begin CHARACTERISTIC LZA_P_OF "Offset zur Erhoehung des LZA-Grundwertes" VALUE 0x85CE DAMOS_FW3 0 UDKL 0.000000 10.112030 EXTENDED_LIMITS 0.000000 10.112000 /end CHARACTERISTIC
/begin CHARACTERISTIC LZA_U_AT "untere Ansuglufttemperaturschwelle fuer Langzeit-Adaption" VALUE 0x85BA DAMOS_FW1 0 CLU_TMP -50.000000 150.000000 /end CHARACTERISTIC
/begin CHARACTERISTIC LZA_U_MT "untere Motortemperaturschwelle fuer Langzeitadaption" VALUE 0x85B8 DAMOS_FW1 0 CMO_TMP -41.000000 140.000000 /end CHARACTERISTIC
/begin CHARACTERISTIC LZFUER "Führungszylindermatrix " CURVE 0x8299 DAMOS_FKL1 0 DEZ 0.000000 256.000000
 /begin AXIS_DESCR FIX_AXIS ZYLNUM DEZZYL 6 0.000000 5.000000 FIX_AXIS_PAR 0 0 6 /end AXIS_DESCR
/end CHARACTERISTIC
/begin CHARACTERISTIC LZFUER1 "Führungszylindermatrix1 " CURVE 0x82A6 DAMOS_FKL1 0 DEZ 0.000000 256.000000
 /begin AXIS_DESCR FIX_AXIS ZYLNUM DEZZYL 6 0.000000 5.000000 FIX_AXIS_PAR 0 0 6 /end AXIS_DESCR
/end CHARACTERISTIC
/begin CHARACTERISTIC MDANS " Korekturfaktor Momentenanforderung EGS" CURVE 0xCA5A DAMOS_KL97 0 F256OFF 0.500000 1.500000 /begin AXIS_DESCR STD_AXIS TANS CLU_TMP 7 -50.000000 150.000000 /end AXIS_DESCR /end CHARACTERISTIC
/begin CHARACTERISTIC MDEGS_T "Überwachungszeit der Momentenreduktion für EGS " VALUE 0x853C DAMOS_FW3 0 TQ10L 0.000000 655.350000 /end CHARACTERISTIC
/begin CHARACTERISTIC MDEGTC_T "Ueberwachungszeit bei Anforderung Torque Constant" VALUE 0x877E DAMOS_FW3 0 TQ10 0.000000 2.550000 /end CHARACTERISTIC
/begin CHARACTERISTIC MDEGTD_T "Ueberwachungszeit bei Anforderung Torque Decrease" VALUE 0x877C DAMOS_FW3 0 TQ10 0.000000 2.550000 /end CHARACTERISTIC
/begin CHARACTERISTIC MDEGTU_T "Ueberwachungszeit bei Anforderung Torque Increase" VALUE 0x877A DAMOS_FW3 0 TQ10 0.000000 2.550000 /end CHARACTERISTIC
/begin CHARACTERISTIC MDMAXRECN "Ersatzwert fuer mdmax im Fehlerfall" CURVE 0xCC30 DAMOS_KL97 0 MMQ 0.000000 512.000000 /begin AXIS_DESCR STD_AXIS NIST NQ25 6 0.000000 6400.000000 /end AXIS_DESCR /end CHARACTERISTIC
/begin CHARACTERISTIC MDMSRKL "Kennlinie fuer max. Begrenzung von MDMSR" CURVE 0xBB46 DAMOS_KL97 0 MMQ 0.000000 512.000000 /begin AXIS_DESCR STD_AXIS NIST NQ25 6 0.000000 6400.000000 /end AXIS_DESCR /end CHARACTERISTIC
/begin CHARACTERISTIC MDNOKHA " Normierungsfaktor fuer indiziertes Motormoment" CURVE 0xC684 DAMOS_KL97 0 F256OFF 0.500000 1.500000
 /begin AXIS_DESCR STD_AXIS FDKHA FKT128 6 0.000000 1.992188 EXTENDED_LIMITS 0.000000 1.992190 /end AXIS_DESCR
/end CHARACTERISTIC
/begin CHARACTERISTIC MDNORM "normiertes Moment" VALUE 0x84C1 DAMOS_FW1 0 MMQ_NORM 0.000000 2550.000000 /end CHARACTERISTIC
/begin CHARACTERISTIC MDREDMN " Minimale Momenteninduktion fuer Ausblendung" CURVE 0xC8D6 DAMOS_KL97 0 MMQ 0.000000 512.000000 /begin AXIS_DESCR STD_AXIS NIST NQ25 6 0.000000 6400.000000 /end AXIS_DESCR /end CHARACTERISTIC
/begin CHARACTERISTIC MDUPNCAKL "Begrenzung Momentenerhoehung NCA" CURVE 0xCC20 DAMOS_KL97 0 MMQ 0.000000 512.000000 /begin AXIS_DESCR STD_AXIS NIST NQ25 6 0.000000 6400.000000 /end AXIS_DESCR /end CHARACTERISTIC
/begin AXIS_PTS MDV08_UM "SST fuer Offset-Moment in der FU" 0x8F7E MZ_UM DAMOS_SST97 0 MMQ 8 0.000000 512.000000 /end AXIS_PTS
/begin CHARACTERISTIC MD_AC "Motormomentenbedarf bei eingeschaltetem Kompressor" VALUE 0x87E8 DAMOS_FW1 0 MMQ 0.000000 512.000000 /end CHARACTERISTIC
/begin CHARACTERISTIC MILANTI "Mil ist bei ti-Abschaltung an, auch im 1.dcy" VALUE 0x847F DAMOS_FW1 0 DEZ 0.000000 256.000000 /end CHARACTERISTIC
/begin CHARACTERISTIC MLDMNW "HFM - Fehlererkennung Minimalwert" VALUE 0x843A DAMOS_FW3 0 MLQ010L 0.000000 6553.500000 /end CHARACTERISTIC
/begin CHARACTERISTIC MLDMXN "Kennlinie HFM-Fehlererkennung, Maxwert, Drehzahlabhaengig" CURVE 0xB7FF DAMOS_GKL1 0 MLQ5 0.000000 1280.000000
 /begin AXIS_DESCR COM_AXIS NIST NQ25 8 0.000000 0.000000 AXIS_PTS_REF NISTV08 EXTENDED_LIMITS 0.000000 6400.000000 /end AXIS_DESCR
/end CHARACTERISTIC
/begin AXIS_PTS MLKV06 "Luftmassenstuetzstellen f. DKAT" 0x8DDA MLSM DAMOS_SST97 0 MLSMQ 6 0.000000 1024.000000 /end AXIS_PTS
/begin CHARACTERISTIC MLLASH "Luftmassenschwelle fuer Schwingungspruefung hinter Kat" VALUE 0x8354 DAMOS_FW3 0 MLQ01L 0.000000 6553.500000 /end CHARACTERISTIC
/begin CHARACTERISTIC MLLRH "Intergrierte Luftmasse nach SAS ,ab der Regelung hinter Kat freigegeben" VALUE 0x820A DAMOS_FW1 0 MLQ100 0.000000 2.538678 EXTENDED_LIMITS 0.000000 2.538680 /end CHARACTERISTIC
/begin CHARACTERISTIC MLMAX "Spitzenluftdurchsatz des Motors" VALUE 0x886E DAMOS_FW3 0 MLQ01L 0.000000 6553.500000 /end CHARACTERISTIC
/begin CHARACTERISTIC MLO1 "Obere Luftmengenschwelle (Bereich 1)" VALUE 0x81FA DAMOS_FW3 0 MLQ010L 0.000000 6553.500000 /end CHARACTERISTIC
/begin CHARACTERISTIC MLO2 "Obere Luftmengenschwelle (FRAU)" VALUE 0x81FC DAMOS_FW3 0 MLQ010L 0.000000 6553.500000 /end CHARACTERISTIC
/begin CHARACTERISTIC MLO3 "Obere Luftmengenschwelle (Bereich 3)" VALUE 0x81FE DAMOS_FW3 0 MLQ010L 0.000000 6553.500000 /end CHARACTERISTIC
/begin CHARACTERISTIC MLOSTEST "obere Luftmassenschwelle fuer Testbeginn Schwingungspruefung hinter Kat" VALUE 0x8356 DAMOS_FW3 0 MLQ01L 0.000000 6553.500000 /end CHARACTERISTIC
/begin CHARACTERISTIC MLRO "Obere Luftmengenschwelle für FRA-Interpolation" VALUE 0x8206 DAMOS_FW3 0 MLQ010L 0.000000 6553.500000 /end CHARACTERISTIC
/begin CHARACTERISTIC MLRU "Untere Luftmengenschwelle für FRA-Interpolation" VALUE 0x8204 DAMOS_FW3 0 MLQ010L 0.000000 6553.500000 /end CHARACTERISTIC
/begin CHARACTERISTIC MLU2 "Untere Luftmengenschwelle (FRAU)" VALUE 0x8200 DAMOS_FW3 0 MLQ010L 0.000000 6553.500000 /end CHARACTERISTIC
/begin CHARACTERISTIC MLU4 "Untere Luftmengenschwelle (FRAO)" VALUE 0x8202 DAMOS_FW3 0 MLQ010L 0.000000 6553.500000 /end CHARACTERISTIC
/begin CHARACTERISTIC MLUSSTG "Luftmassenschwelle fuer Dynamikpruefung hinter Kat" VALUE 0x8358 DAMOS_FW3 0 MLQ01L 0.000000 6553.500000 /end CHARACTERISTIC
/begin CHARACTERISTIC MLUSTEST "untere Luftmassenschwelle fuer Testbeginn Schwingungspruefung hinter Kat" VALUE 0x835A DAMOS_FW3 0 MLQ01L 0.000000 6553.500000 /end CHARACTERISTIC
/begin AXIS_PTS MLV06 "Luftmassenstuetzstellen" 0x8DBC MLSM DAMOS_SST97 0 MLSMQ 6 0.000000 1024.000000 /end AXIS_PTS
/begin CHARACTERISTIC MSRC_T_UM "Fehlerzeit fuer MSR-Ueberwachung der FU" VALUE 0x882F DAMOS_FW1 0 TQ40 0.000000 10.200000 /end CHARACTERISTIC
/begin CHARACTERISTIC MSRNU_T_UM "Fehlerzeit fuer MSR-Ueberwachung der FU" VALUE 0x8830 DAMOS_FW1 0 TQ40 0.000000 10.200000 /end CHARACTERISTIC
/begin CHARACTERISTIC MVER_T_UM "Max. Fehlerzeit in der mver-FU" VALUE 0x881A DAMOS_FW1 0 UMFMVER 0.000000 10200.000000 /end CHARACTERISTIC
/begin CHARACTERISTIC MZFFIL_UM "Filterkonst. f. zulässiges Moment in der FU" VALUE 0x8818 DAMOS_FW1 0 UMFMZF 0.000000 10200.000000 /end CHARACTERISTIC
/begin CHARACTERISTIC MZFTV_UM "Verzugszeit f. zulässiges Moment mz_um in der FU" VALUE 0x8819 DAMOS_FW1 0 UMFMZF 0.000000 10200.000000 /end CHARACTERISTIC
/begin CHARACTERISTIC NAA "Drehzahluntergrenze fuer AR-Funktion" VALUE 0x81A1 DAMOS_FW1 0 NQ25 0.000000 6400.000000 /end CHARACTERISTIC
/begin CHARACTERISTIC NCANOFF "Anzahl CAN-BusOff bis Fehlereintrag E_CAN" VALUE 0x84C8 DAMOS_FW1 0 DEZ 0.000000 256.000000 /end CHARACTERISTIC
/begin CHARACTERISTIC NC_T_UM "Max. Fehlerzeit der FU" VALUE 0x87F2 DAMOS_FW1 0 TQ40 0.000000 10.200000 /end CHARACTERISTIC
/begin CHARACTERISTIC NDFI "Drehzahlobergrenze fuer AR-Funktion" VALUE 0x81A2 DAMOS_FW1 0 NQ25 0.000000 6400.000000 /end CHARACTERISTIC
/begin AXIS_PTS NDIFV08 "Drehzahldifferenzbetrags-Stützstellenverteilung" 0x8EF2 NDIF DAMOS_SST97 0 NQ5 8 0.000000 1275.000000 /end AXIS_PTS
/begin CHARACTERISTIC NDIF_UM "Erlaubte Drehzahldif. f. FU" VALUE 0x87F0 DAMOS_FW1 0 NQ25 0.000000 6400.000000 /end CHARACTERISTIC
/begin CHARACTERISTIC NDKS "Unter der N-Schwelle keine KL-Sensorueberpruefung" VALUE 0x8272 DAMOS_FW1 0 NQ25 0.000000 6400.000000 /end CHARACTERISTIC
/begin CHARACTERISTIC NDKTSO "obere Drehzahlgrenze fuer DKAT aktiv" VALUE 0x8392 DAMOS_FW1 0 NQ25 0.000000 6400.000000 /end CHARACTERISTIC
/begin CHARACTERISTIC NDKTSOT "obere Drehzahlgrenze fuer Funktionsanforderung" VALUE 0x8393 DAMOS_FW1 0 NQ25 0.000000 6400.000000 /end CHARACTERISTIC
/begin CHARACTERISTIC NDKTSU "untere Drehzahlgrenze fuer DKAT aktiv" VALUE 0x8394 DAMOS_FW1 0 NQ25 0.000000 6400.000000 /end CHARACTERISTIC
/begin CHARACTERISTIC NDKTSUT "untere Drehzahlgrenze fuer Funktionsanforderung" VALUE 0x8395 DAMOS_FW1 0 NQ25 0.000000 6400.000000 /end CHARACTERISTIC
/begin CHARACTERISTIC NDLMMN "Drehzahlschwelle fuer Diagnose HFM, Minimalwert" VALUE 0x843C DAMOS_FW1 0 NQ25 0.000000 6400.000000 /end CHARACTERISTIC
/begin AXIS_PTS NDMDV08 "Drehzahlstuetzstellen f. DMD" 0x8CFC NIST DAMOS_SST97 0 NQ25 8 0.000000 6400.000000 /end AXIS_PTS
/begin CHARACTERISTIC NDMLST "HFM - Fehlererkennung Drehzahlschwelle Start" VALUE 0x843D DAMOS_FW1 0 NQ25 0.000000 6400.000000 /end CHARACTERISTIC
/begin CHARACTERISTIC NDV "Fehlererkennung Tachosignal / Drehzahlschwelle minimal" VALUE 0x87DC DAMOS_FW1 0 NQ40 0.000000 10200.000000 /end CHARACTERISTIC
/begin CHARACTERISTIC NDVO "Fehlererkennung Fz-Geschwindigkeit, obere Drehzahlgrenze" VALUE 0x87DD DAMOS_FW1 0 NQ40 0.000000 10200.000000 /end CHARACTERISTIC
/begin CHARACTERISTIC NFAULACC "Anzahl Botschaftsunterbrechungen bis CAN-Node NAC faulty" VALUE 0x8502 DAMOS_FW1 0 DEZ 0.000000 256.000000 /end CHARACTERISTIC
/begin CHARACTERISTIC NFAULASR "Anzahl Botschaftsunterbrechungen bis CAN-Node NFR faulty" VALUE 0x84E6 DAMOS_FW1 0 DEZ 0.000000 256.000000 /end CHARACTERISTIC
/begin CHARACTERISTIC NFAULBC "Anzahl Botschaftsunterbrechungen bis CAN-Node NBC faulty" VALUE 0x84D8 DAMOS_FW1 0 DEZ 0.000000 256.000000 /end CHARACTERISTIC
/begin CHARACTERISTIC NFAULEGS "Anzahl Botschaftsunterbrechungen bis CAN-Node NCA/NCR faulty" VALUE 0x84F4 DAMOS_FW1 0 DEZ 0.000000 256.000000 /end CHARACTERISTIC
/begin CHARACTERISTIC NFAULNBA "Anzahl Botschaftsunterbrechungen bis CAN-Node NBA faulty" VALUE 0x8510 DAMOS_FW1 0 DEZ 0.000000 256.000000 /end CHARACTERISTIC
/begin CHARACTERISTIC NFLUV "Umschaltung Medial-/Mittelwertverfahren" VALUE 0x8316 DAMOS_FW1 0 NQ40 0.000000 10200.000000 /end CHARACTERISTIC
/begin AXIS_PTS NFOV06 "Drehzahlstuezstellen" 0x8CEC NIST DAMOS_SST97 0 NQ25 6 0.000000 6400.000000 /end AXIS_PTS
/begin AXIS_PTS NIPV08_UM "SST fuer tlc-FU" 0x8F4E NIST_UM DAMOS_SST97 0 NQ25 8 0.000000 6400.000000 /end AXIS_PTS
/begin AXIS_PTS NISTV08 "Drehzahlstützstellenverteilung" 0x8D44 NIST DAMOS_SST97 0 NQ25 8 0.000000 6400.000000 /end AXIS_PTS
/begin AXIS_PTS NISTV09 "Drehzahlstützstellenverteilung" 0x8D50 NIST DAMOS_SST97 0 NQ25 8 0.000000 6400.000000 /end AXIS_PTS
/begin AXIS_PTS NISTV10 "Drehzahlstuetzstellenverteilung" 0x8D5C NIST DAMOS_SST97 0 NQ25 9 0.000000 6400.000000 /end AXIS_PTS
/begin AXIS_PTS NMV08_UM "SST fuer eins-FU" 0x8F36 NIST_UM DAMOS_SST97 0 NQ25 8 0.000000 6400.000000 /end AXIS_PTS
/begin AXIS_PTS NPEDV08_UM "SST fuer reac-FU" 0x8F66 SPSN_UM DAMOS_SST97 0 DEZ 8 0.000000 256.000000 /end AXIS_PTS
/begin AXIS_PTS NZWV08_UM "SST fuer eins-FU" 0x8F42 NIST_UM DAMOS_SST97 0 NQ25 8 0.000000 6400.000000 /end AXIS_PTS
/begin AXIS_PTS SNM16KRUB "Stuetzstellenverteilung Klopfregelung" 0x8F8A NMOT DAMOS_SST97 0 NQ40 16 0.000000 10200.000000 /end AXIS_PTS
/begin AXIS_PTS SPSMV08_UM "SST fuer Offset-Moment in der FU" 0x8F72 SPSNMAX_UM DAMOS_SST97 0 DEZ 8 0.000000 256.000000 /end AXIS_PTS
/begin AXIS_PTS SWPTV16 "Stuetzstellenverteilung Maximalwert aus Pedal- u. Tempomat-Sollwert" 0x8EA4 SWPT DAMOS_SST97 0 PER255 16 0.000000 100.000000 /end AXIS_PTS
/begin AXIS_PTS SWREV08 "Stuetzstellenverteilung resultierender Sollwert" 0x8EFE SWRES DAMOS_SST97 0 PER255 8 0.000000 100.000000 /end AXIS_PTS
/begin AXIS_PTS TANSV08 "Stuetzstellenverteilung Lufttemperatur" 0x8DA4 TANS DAMOS_SST97 0 CLU_TMP 8 -50.000000 150.000000 /end AXIS_PTS
/begin AXIS_PTS TATEV08 "Stuetzstellenverteilung: Tastverhaeltnis Tankentlueftung" 0x8E70 TATE DAMOS_SST97 0 PCENT 8 0.000000 99.609380 EXTENDED_LIMITS 0.000000 99.609400 /end AXIS_PTS
/begin AXIS_PTS TL8V08 "Laststuetzstellen" 0x8D14 TL8 DAMOS_SST97 0 UFUELL 8 0.000000 191.250000 /end AXIS_PTS
/begin AXIS_PTS TL8V08_UM "SST fuer eins-FU" 0x8F2A TL8_UM DAMOS_SST97 0 UFUELL 8 0.000000 191.250000 /end AXIS_PTS
/begin AXIS_PTS TLDMDV08 "Laststuetzstellen f. DMD" 0x8D08 TL8 DAMOS_SST97 0 UFUELL 8 0.000000 191.250000 /end AXIS_PTS
/begin AXIS_PTS TLFOV03 "Laststuezstellen" 0x8CF6 TL8 DAMOS_SST97 0 UFUELL 3 0.000000 191.250000 /end AXIS_PTS
/begin AXIS_PTS TMOTV08 "Motortemperaturstuetzstellen" 0x8D7C TMOT DAMOS_SST97 0 CMO_TMP 12 -41.000000 140.000000 /end AXIS_PTS
/begin AXIS_PTS TSTMOTV08 "Motortemperaturstuetzstellen von Tmot im Start" 0x8D8C TMST DAMOS_SST97 0 CMO_TMP 12 -41.000000 140.000000 /end AXIS_PTS
/begin AXIS_PTS WDKV08 "Winkelstützstellenverteilung" 0x8DB0 WDKBL DAMOS_SST97 0 UWDK 8 0.000000 80.599920 EXTENDED_LIMITS 0.000000 80.599900 /end AXIS_PTS
/begin COMPU_METHOD AG_TMP "Abgas-Temperatur" TAB_INTP "%7.2" "Grad C" COMPU_TAB_REF AG_TMP /end COMPU_METHOD
/begin COMPU_METHOD BSCHL_25 "Darstellung 0 bis 25 " RAT_FUNC "%5.2" "g" COEFFS 0 102.000000 0.000000 0 0.000000 10.000000 /end COMPU_METHOD
/begin COMPU_METHOD BSCHL_25L "Darstellung 0 bis 25 " RAT_FUNC "%5.2" "g" COEFFS 0 2621.000000 0.000000 0 0.000000 1.000000 /end COMPU_METHOD
/begin COMPU_METHOD CLU_TMP "Ansaugluft-Temperatur" TAB_INTP "%7.3" "grd C" COMPU_TAB_REF CLU_TMP /end COMPU_METHOD
/begin COMPU_METHOD CMO_TMP "Motor-Temperatur (invers)" TAB_INTP "%7.3" "Grad C" COMPU_TAB_REF CMO_TMP /end COMPU_METHOD
/begin COMPU_METHOD DEZ "  Dezimalzahl in Hexzahl" RAT_FUNC "%3.0" "" COEFFS 0 1.000000 0.000000 0 0.000000 1.000000 /end COMPU_METHOD
/begin COMPU_METHOD DEZ7 "  Dezimalzahl in Hexzahl von 0-7" RAT_FUNC "%4.2" "" COEFFS 0 1.000000 0.000000 0 0.000000 1.000000 /end COMPU_METHOD
/begin COMPU_METHOD DEZL "  Dezimalzahl in 16-Bit-Hexzahl" RAT_FUNC "%5.0" "" COEFFS 0 1.000000 0.000000 0 0.000000 1.000000 /end COMPU_METHOD
/begin COMPU_METHOD DEZZYL " Zylindernummer 0 bis 5" RAT_FUNC "%4.2" "Zyl.nr." COEFFS 0 1.000000 0.000000 0 0.000000 1.000000 /end COMPU_METHOD
/begin COMPU_METHOD DIV256 "Divisionsfaktor 256" RAT_FUNC "%7.1" "Faktor" COEFFS 0 3.906200e-03 0.000000 0 0.000000 1.000000 /end COMPU_METHOD
/begin COMPU_METHOD DMMQ "Motor-Momentquantisierung (Delta) mit Offset (80h)" RAT_FUNC "%5.2" "Nm/10ms" COEFFS 0 8.000000 256.000000 0 0.000000 2.000000 /end COMPU_METHOD
/begin COMPU_METHOD DPCENT "Motor-Momentquantisierung (Delta) mit Offset (80h)" RAT_FUNC "%5.2" "%/20ms" COEFFS 0 512.000000 12800.000000 0 0.000000 100.000000 /end COMPU_METHOD
/begin COMPU_METHOD DTSEGN_S8 "Segmentwinkel (vorzeichenbehaftet)" RAT_FUNC "%7.5" "Grad KW" COEFFS 0 1.000000 0.000000 0 0.000000 1.757800e-02 /end COMPU_METHOD
/begin COMPU_METHOD F256OF2 "Korrekturfaktor 256 mit Offset 0.25" RAT_FUNC "%7.5" "Faktor" COEFFS 0 256.000000 -64.000000 0 0.000000 1.000000 /end COMPU_METHOD
/begin COMPU_METHOD F256OFF "Korrekturfaktor 256 mit Offset 0.5" RAT_FUNC "%7.5" "Faktor" COEFFS 0 256.000000 -128.000000 0 0.000000 1.000000 /end COMPU_METHOD
/begin COMPU_METHOD FAKTCIFI "  Korrekturfaktor fuer CIFI" RAT_FUNC "%9.7" "" COEFFS 0 512.000000 -384.000000 0 0.000000 1.000000 /end COMPU_METHOD
/begin COMPU_METHOD FKT0001 "  Quantisierung mit 0.01 " RAT_FUNC "%7.5" "" COEFFS 0 1.000000 0.000000 0 0.000000 1.000000e-02 /end COMPU_METHOD
/begin COMPU_METHOD FKT1024 "  Umsetzung des Intervalles [0;<0.249]" RAT_FUNC "%6.4" "" COEFFS 0 1024.000000 0.000000 0 0.000000 1.000000 /end COMPU_METHOD
/begin COMPU_METHOD FKT128 "  Umsetzung des Intervalles [0;<2]" RAT_FUNC "%6.4" "" COEFFS 0 128.000000 0.000000 0 0.000000 1.000000 /end COMPU_METHOD
/begin COMPU_METHOD FKT128S "Darstellung -1.0 bis 1.0 " RAT_FUNC "%5.3" "" COEFFS 0 127.000000 128.000000 0 0.000000 1.000000 /end COMPU_METHOD
/begin COMPU_METHOD FKT128_S " Umsetzung des Intervalles [-1;1] fuer signed byte" RAT_FUNC "%8.6" "" COEFFS 0 127.000000 0.000000 0 0.000000 1.000000 /end COMPU_METHOD
/begin COMPU_METHOD FKT16 "  Umsetzung des Intervalles [0;<16]" RAT_FUNC "%6.3" "" COEFFS 0 16.000000 0.000000 0 0.000000 1.000000 /end COMPU_METHOD
/begin COMPU_METHOD FKT2048 "  Umsetzung des Intervalles [0;<0.128]" RAT_FUNC "%6.4" "" COEFFS 0 2048.000000 0.000000 0 0.000000 1.000000 /end COMPU_METHOD
/begin COMPU_METHOD FKT256 "  Umsetzung des Intervalles [0;<1]" RAT_FUNC "%6.4" "" COEFFS 0 256.000000 0.000000 0 0.000000 1.000000 /end COMPU_METHOD
/begin COMPU_METHOD FKT256_1 "  Umsetzung des Intervalles [1;<2]" RAT_FUNC "%6.4" "" COEFFS 0 255.000000 -255.000000 0 0.000000 1.000000 /end COMPU_METHOD
/begin COMPU_METHOD FKT32 "  Umsetzung des Intervalles [0;<8]" RAT_FUNC "%6.4" "" COEFFS 0 32.000000 0.000000 0 0.000000 1.000000 /end COMPU_METHOD
/begin COMPU_METHOD FKT32768_S "  Umsetzung des Intervalles [-1;<1]" RAT_FUNC "%9.7" "Faktor +/-1" COEFFS 0 3.276800e+04 0.000000 0 0.000000 1.000000 /end COMPU_METHOD
/begin COMPU_METHOD FKT4096L "  Umsetzung des Intervalles [0-16]" RAT_FUNC "%6.3" "" COEFFS 0 4096.000000 0.000000 0 0.000000 1.000000 /end COMPU_METHOD
/begin COMPU_METHOD FKT51 "  Umsetzung des Intervalles [0;< 4.980]" RAT_FUNC "%7.5" "" COEFFS 0 51.200000 0.000000 0 0.000000 1.000000 /end COMPU_METHOD
/begin COMPU_METHOD FKT512 "  Umsetzung des Intervalles [0;<0.5]" RAT_FUNC "%6.4" "" COEFFS 0 512.000000 0.000000 0 0.000000 1.000000 /end COMPU_METHOD
/begin COMPU_METHOD FKT512L "  Umsetzung des Intervalles [0;< 512.0]" RAT_FUNC "%8.4" "" COEFFS 0 512.000000 0.000000 0 0.000000 1.000000 /end COMPU_METHOD
/begin COMPU_METHOD FKT64 "  Umsetzung des Intervalles [0;<4]" RAT_FUNC "%6.4" "" COEFFS 0 64.000000 0.000000 0 0.000000 1.000000 /end COMPU_METHOD
/begin COMPU_METHOD FKT64L "  Umsetzung des Intervalles [0;<1024]" RAT_FUNC "%6.1" "" COEFFS 0 64.000000 0.000000 0 0.000000 1.000000 /end COMPU_METHOD
/begin COMPU_METHOD FKT65536 "  Umsetzung des Intervalles [0;<1]" RAT_FUNC "%7.5" "" COEFFS 0 6.553600e+04 0.000000 0 0.000000 1.000000 /end COMPU_METHOD
/begin COMPU_METHOD FKT65536SL "  Umsetzung des Intervalles [-0,5;<0,5] 16Bit kompl." RAT_FUNC "%8.6" "" COEFFS 0 6.553600e+04 0.000000 0 0.000000 1.000000 /end COMPU_METHOD
/begin COMPU_METHOD FKT_LAMBDA "8-Bit Umsetzung des Lambdaintervalles 0,97 .. 1,0298" RAT_FUNC "%6.4" "" COEFFS 0 256.000000 -248.320000 0 0.000000 6.000000e-02 /end COMPU_METHOD
/begin COMPU_METHOD FPC50L "  Korrekturfaktor fuer Aenderung um 50 [%] , 16 Bit" RAT_FUNC "%8.6" "" COEFFS 0 6.553600e+04 -3.276800e+04 0 0.000000 1.000000 /end COMPU_METHOD
/begin COMPU_METHOD FREQ_128 "Darstellung 0 ... 127,5 1/s " RAT_FUNC "%6.2" "1/s" COEFFS 0 2.000000 0.000000 0 0.000000 1.000000 /end COMPU_METHOD
/begin COMPU_METHOD FRIQ "  LRA - Faktoraenderung, Integrator" RAT_FUNC "%6.4" "1/sec" COEFFS 0 327.680000 0.000000 0 0.000000 1.000000 /end COMPU_METHOD
/begin COMPU_METHOD K10Q " FAKTOR  (10ms)256/PHYS" RAT_FUNC "%5.3" "sec" COEFFS 0 0.000000 2.560000 0 1.000000 0.000000 /end COMPU_METHOD
/begin COMPU_METHOD K16 " FAKTOR Q * 1/PHYS" RAT_FUNC "%5.2" "" COEFFS 0 0.000000 16.000000 0 1.000000 0.000000 /end COMPU_METHOD
/begin COMPU_METHOD K409Q " FAKTOR     409.6    /PHYS" RAT_FUNC "%5.1" "sec" COEFFS 0 0.000000 409.600000 0 1.000000 0.000000 /end COMPU_METHOD
/begin COMPU_METHOD LUQ "  Laufunruhe" RAT_FUNC "%7.3" "(Umdr./sec)^2" COEFFS 0 1.000000 0.000000 0 0.000000 7.366900e-01 /end COMPU_METHOD
/begin COMPU_METHOD LUQZ_S8 "  Laufunruhe pro Zündung (vorzeichenbehaftet)" RAT_FUNC "%7.4" "(Umdr./sec)^2/Zündun" COEFFS 0 1.000000 0.000000 0 0.000000 1.473400e-01 /end COMPU_METHOD
/begin COMPU_METHOD LUQ_8Z "  Laufunruhe pro Zündung" RAT_FUNC "%7.4" "(Umdr./sec)^2/Zündun" COEFFS 0 1.000000 0.000000 0 0.000000 9.208600e-02 /end COMPU_METHOD
/begin COMPU_METHOD LUQ_S8 "  Laufunruhe (vorzeichenbehaftet)" RAT_FUNC "%7.4" "(Umdr./sec)^2" COEFFS 0 1.000000 0.000000 0 0.000000 7.366900e-01 /end COMPU_METHOD
/begin COMPU_METHOD MLQ002 "  Luftmasse mit 0.0200[kg] quantisiert" RAT_FUNC "%5.3" "kg" COEFFS 0 1.000000 0.000000 0 0.000000 2.000000e-02 /end COMPU_METHOD
/begin COMPU_METHOD MLQ010 "  Luftmassen-Durchsatz mit 0.1000[kg/h] quantisiert " RAT_FUNC "%7.4" "kg/h" COEFFS 0 1.000000 0.000000 0 0.000000 1.000000e-01 /end COMPU_METHOD
/begin COMPU_METHOD MLQ010L "  Luftmassen-Durchsatz, 16 Bit mit 0.1000[kg/h] quantisiert" RAT_FUNC "%7.2" "kg/h" COEFFS 0 1.000000 0.000000 0 0.000000 1.000000e-01 /end COMPU_METHOD
/begin COMPU_METHOD MLQ01L "  Luftmassen-Durchsatz, 16 Bit mit 0.1[kg/h] quantisiert" RAT_FUNC "%7.2" "kg/h" COEFFS 0 10.000000 0.000000 0 0.000000 1.000000 /end COMPU_METHOD
/begin COMPU_METHOD MLQ0MG868 "Luftmasse mit 0.868 [mg] quantisiert" RAT_FUNC "%9.5" "mg" COEFFS 0 230.400000 0.000000 0 0.000000 200.000000 /end COMPU_METHOD
/begin COMPU_METHOD MLQ0MG868L "Luftmasse mit 0.868 [mg] quantisiert" RAT_FUNC "%9.3" "mg/s" COEFFS 0 230.400000 0.000000 0 0.000000 200.000000 /end COMPU_METHOD
/begin COMPU_METHOD MLQ100 "  Luftmassen-Durchsatz mit  0.996E-2[kg] quantisiert" RAT_FUNC "%5.3" "kg" COEFFS 0 1.000000 0.000000 0 0.000000 9.955600e-03 /end COMPU_METHOD
/begin COMPU_METHOD MLQ256L "  Luftmassen-Durchsatz mit Faktor  256.0[g] " RAT_FUNC "%7.3" "g" COEFFS 0 256.000000 0.000000 0 0.000000 1.000000 /end COMPU_METHOD
/begin COMPU_METHOD MLQ5 "MLE mit 5 Kg/h quantisiert" RAT_FUNC "%7.2" "kg/h" COEFFS 0 1.000000 0.000000 0 0.000000 5.000000 /end COMPU_METHOD
/begin COMPU_METHOD MLQP512L "  Luftmassen-Durchsatz mit Faktor  5.120[g%] " RAT_FUNC "%7.1" "g%" COEFFS 0 5.120000 0.000000 0 0.000000 1.000000 /end COMPU_METHOD
/begin COMPU_METHOD MLSMQ "MLE mit  4.000 Kg/h quantisiert" RAT_FUNC "%7.2" "kg/h" COEFFS 0 1.000000 0.000000 0 0.000000 4.000000 /end COMPU_METHOD
/begin COMPU_METHOD MMQ "Motor-Momentquantisierung " RAT_FUNC "%5.1" "Nm" COEFFS 0 1.000000 0.000000 0 0.000000 2.000000 /end COMPU_METHOD
/begin COMPU_METHOD MMQ_NORM "Normiertes Motormoment " RAT_FUNC "%4.0" "Nm" COEFFS 0 1.000000 0.000000 0 0.000000 10.000000 /end COMPU_METHOD
/begin COMPU_METHOD NGRDQ10OF "  Drehzahlgradient" RAT_FUNC "%6.1" "Upm/sec" COEFFS 0 1.000000 0.000000 0 0.000000 10.000000 /end COMPU_METHOD
/begin COMPU_METHOD NGRDQ25 "  Drehzahlgradient mi 25 Upm/sec quantisiert" RAT_FUNC "%6.1" "Upm/sec" COEFFS 0 1.000000 0.000000 0 0.000000 25.000000 /end COMPU_METHOD
/begin COMPU_METHOD NGRDQ40 "  Drehzahlgradient mi 40 Upm/sec quantisiert" RAT_FUNC "%5.0" "Upm/sec" COEFFS 0 1.000000 0.000000 0 0.000000 40.000000 /end COMPU_METHOD
/begin COMPU_METHOD NGRDQ50S "  Drehzahlgradient mit 50 Upm/sec quantisiert (signed)" RAT_FUNC "%6.1" "Upm/sec" COEFFS 0 1.000000 6400.000000 0 0.000000 50.000000 /end COMPU_METHOD
/begin COMPU_METHOD NQ025 "  Drehzahlquantisierung  0.250[Upm]" RAT_FUNC "%5.0" "Upm" COEFFS 0 1.000000 0.000000 0 0.000000 2.500000e-01 /end COMPU_METHOD
/begin COMPU_METHOD NQ25 "  Drehzahlquantisierung  25.00[Upm]" RAT_FUNC "%4.0" "Upm" COEFFS 0 1.000000 0.000000 0 0.000000 25.000000 /end COMPU_METHOD
/begin COMPU_METHOD NQ40 "  Drehzahlquantisierung  40.00[Upm]" RAT_FUNC "%5.0" "Upm" COEFFS 0 1.000000 0.000000 0 0.000000 40.000000 /end COMPU_METHOD
/begin COMPU_METHOD NQ5 "  Drehzahlquantisierung  5.000[Upm]" RAT_FUNC "%4.0" "Upm" COEFFS 0 1.000000 0.000000 0 0.000000 5.000000 /end COMPU_METHOD
/begin COMPU_METHOD PAB77 "Umrechnung des Drucksensorwertes " RAT_FUNC "%6.3" "bar" COEFFS 0 7.698000 2.356000 0 0.000000 1.000000 /end COMPU_METHOD
/begin COMPU_METHOD PCENT "  Prozent" RAT_FUNC "%5.2" "%" COEFFS 0 256.000000 0.000000 0 0.000000 100.000000 /end COMPU_METHOD
/begin COMPU_METHOD PCENT100L "  Prozent" RAT_FUNC "%7.4" "%" COEFFS 0 6.553600e+04 0.000000 0 0.000000 100.000000 /end COMPU_METHOD
/begin COMPU_METHOD PER0327 "percent" RAT_FUNC "%7.3" "%" COEFFS 0 327.670000 0.000000 0 0.000000 1.000000 /end COMPU_METHOD
/begin COMPU_METHOD PER0327LS "Prozentumrechnung mit  327.7[%/ms] signed-word quantisiert" RAT_FUNC "%7.3" "%/10ms" COEFFS 0 327.670000 0.000000 0 0.000000 1.000000 /end COMPU_METHOD
/begin COMPU_METHOD PER1023 "  Umsetzung cts in Prozent" RAT_FUNC "%6.2" "%" COEFFS 0 1023.000000 0.000000 0 0.000000 100.000000 /end COMPU_METHOD
/begin COMPU_METHOD PER255 "percent" RAT_FUNC "%7.3" "%" COEFFS 0 255.000000 0.000000 0 0.000000 100.000000 /end COMPU_METHOD
/begin COMPU_METHOD PER511 "percent 50% = 0FFh" RAT_FUNC "%6.3" "%" COEFFS 0 510.000000 0.000000 0 0.000000 100.000000 /end COMPU_METHOD
/begin COMPU_METHOD PER6SP "percent, max 6.23, signed, positiv" RAT_FUNC "%7.5" "%" COEFFS 0 40.958800 0.000000 0 0.000000 1.000000 /end COMPU_METHOD
/begin COMPU_METHOD PER_DKA "percent" RAT_FUNC "%7.3" "%" COEFFS 0 215.000000 0.000000 0 0.000000 100.000000 /end COMPU_METHOD
/begin COMPU_METHOD PHI1_SY "  Zuendungsabhaengige Filterkonstante mit  0.391 %/Zuendung. quantisiert" RAT_FUNC "%7.4" "% pro Zuendung" COEFFS 0 1.000000 0.000000 0 0.000000 3.906300e-01 /end COMPU_METHOD
/begin COMPU_METHOD R_UB_Q32 " " RAT_FUNC "%7.2" "Ohm" COEFFS 0 1.000000 0.000000 0 0.000000 32.000000 /end COMPU_METHOD
/begin COMPU_METHOD R_UW_Q2 " Widerstand in 16-Bit-Hexwerten " RAT_FUNC "%6.0" " Ohm " COEFFS 0 1.000000 0.000000 0 0.000000 2.000000 /end COMPU_METHOD
/begin COMPU_METHOD SENSORW "16 BIT Sensorsignal" RAT_FUNC "%7.5" "V" COEFFS 0 6.553600e+04 0.000000 0 0.000000 5.000000 /end COMPU_METHOD
/begin COMPU_METHOD SIG32L "  Umsetzung des Intervalles [- 32.00;< 32.00]" RAT_FUNC "%6.3" "" COEFFS 0 3.276800e+04 1.048576e+06 0 0.000000 32.000000 /end COMPU_METHOD
/begin COMPU_METHOD SQLEN " Strecke mit  2.000 Quantisierung" RAT_FUNC "%7.3" "mm" COEFFS 0 1.000000 0.000000 0 0.000000 2.000000 /end COMPU_METHOD
/begin COMPU_METHOD TEQL "  Quantisierung von te, 16 Bit mit  0.267E-2[ms]" RAT_FUNC "%7.3" "ms" COEFFS 0 1.000000 0.000000 0 0.000000 2.666700e-03 /end COMPU_METHOD
/begin COMPU_METHOD TEQ_12LCPL "  Quantisierung von te, 16 Bit" RAT_FUNC "%7.2" "ms" COEFFS 0 1.000000 0.000000 0 0.000000 3.200000e-02 /end COMPU_METHOD
/begin COMPU_METHOD TEQ_32 "  Quantisierung von tlw 8 Bit mit 0.0853[ms]" RAT_FUNC "%7.4" "ms" COEFFS 0 1.000000 0.000000 0 0.000000 8.533300e-02 /end COMPU_METHOD
/begin COMPU_METHOD TEQ_768 "  Quantisierung von tlw 8 Bit mit  2.048[ms]" RAT_FUNC "%7.3" "ms" COEFFS 0 1.000000 0.000000 0 0.000000 2.048000 /end COMPU_METHOD
/begin COMPU_METHOD TEQ_CPL "  Quantisierung von te, 16 Bitmit  0.267E-2[ms]" RAT_FUNC "%9.6" "ms" COEFFS 0 1.000000 0.000000 0 0.000000 2.666666e-03 /end COMPU_METHOD
/begin COMPU_METHOD TLQSL "'Luftfuellung, signed, 16 bit" RAT_FUNC "%6.1" "ms/Umdr." COEFFS 0 1.000000 0.000000 0 0.000000 4.266000e-02 /end COMPU_METHOD
/begin COMPU_METHOD TMP_79_140 "Temperaturquantisierung mit 0.24 [°C] und Offset +79°C" TAB_INTP "%7.3" "grad C" COMPU_TAB_REF TMP_79_140 /end COMPU_METHOD
/begin COMPU_METHOD TQ10 "  Zeitquantisierung mit 10[ms]" RAT_FUNC "%4.2" "sec" COEFFS 0 100.000000 0.000000 0 0.000000 1.000000 /end COMPU_METHOD
/begin COMPU_METHOD TQ100 "  Zeitquantisierung mit 100[ms]" RAT_FUNC "%4.1" "sec" COEFFS 0 10.000000 0.000000 0 0.000000 1.000000 /end COMPU_METHOD
/begin COMPU_METHOD TQ100L "  Zeitquantisierung mit 100[ms]" RAT_FUNC "%7.2" "sec" COEFFS 0 10.000000 0.000000 0 0.000000 1.000000 /end COMPU_METHOD
/begin COMPU_METHOD TQ10L "  Zeitquantisierung mit 10[ms]" RAT_FUNC "%6.2" "sec" COEFFS 0 100.000000 0.000000 0 0.000000 1.000000 /end COMPU_METHOD
/begin COMPU_METHOD TQ10OF "  Zeitquantisierung mit 10[ms], Offset: 80[hex]" RAT_FUNC "%5.3" "sec" COEFFS 0 1.000000 1.280000 0 0.000000 1.000000e-02 /end COMPU_METHOD
/begin COMPU_METHOD TQ20 "  Zeitquantisierung mit 20[ms]" RAT_FUNC "%5.3" "sec" COEFFS 0 50.000000 0.000000 0 0.000000 1.000000 /end COMPU_METHOD
/begin COMPU_METHOD TQ40 "  Zeitquantisierung mit 40[ms]" RAT_FUNC "%5.2" "sec" COEFFS 0 25.000000 0.000000 0 0.000000 1.000000 /end COMPU_METHOD
/begin COMPU_METHOD TR_DSHK "Zahnmarke fuer Segmentzeiterfassung DASE" RAT_FUNC "%4.1" "6 grad KW" COEFFS 0 -1.000000 78.000000 0 0.000000 6.000000 /end COMPU_METHOD
/begin COMPU_METHOD TSZ "Schliesszeitquantisierung mit     0.0851[ms]" RAT_FUNC "%7.4" "ms" COEFFS 0 11.748100 0.000000 0 0.000000 1.000000 /end COMPU_METHOD
/begin COMPU_METHOD U0V_0V03 "8Bit Umsetzung des Spannungsintervalles 0..0,03V" RAT_FUNC "%6.5" "V" COEFFS 0 256.000000 0.000000 0 0.000000 3.000000e-02 /end COMPU_METHOD
/begin COMPU_METHOD U0V_1V25 "8Bit Umsetzung des Spannungsintervalles 0..1,245V" RAT_FUNC "%5.3" "V" COEFFS 0 256.000000 0.000000 0 0.000000 1.250000 /end COMPU_METHOD
/begin COMPU_METHOD U0V_1V33 "8Bit Umsetzung des Spannungsintervalles 0..1,33V" RAT_FUNC "%5.3" "V" COEFFS 0 255.000000 0.000000 0 0.000000 1.330000 /end COMPU_METHOD
/begin COMPU_METHOD U5V "  Batteriespannung mit 5V quantisiert" RAT_FUNC "%5.3" "V" COEFFS 0 255.000000 0.000000 0 0.000000 5.000000 /end COMPU_METHOD
/begin COMPU_METHOD UBQ "  Batteriespannung mit 0.0942[V] quantisiert" RAT_FUNC "%5.2" "V" COEFFS 0 1.000000 0.000000 0 0.000000 9.421700e-02 /end COMPU_METHOD
/begin COMPU_METHOD UDEC " INT = Phys - 1" RAT_FUNC "%6.2" " " COEFFS 0 1.000000 -1.000000 0 0.000000 1.000000 /end COMPU_METHOD
/begin COMPU_METHOD UDKL "Drosselklappenwinkel" RAT_FUNC "%7.4" "grad DK" COEFFS 0 3.276800e+04 0.000000 0 0.000000 80.916000 /end COMPU_METHOD
/begin COMPU_METHOD UDKL8 "Drosselklappenwinkel" RAT_FUNC "%7.5" "grad DK" COEFFS 0 128.000000 0.000000 0 0.000000 2.528630 /end COMPU_METHOD
/begin COMPU_METHOD UDVER " D-Verstaerkung " RAT_FUNC "%9.7" " " COEFFS 0 273.058320 0.000000 0 0.000000 1.000000 /end COMPU_METHOD
/begin COMPU_METHOD UDWDK "Drosselklappenwinkeländerung" RAT_FUNC "%7.4" "grad DK/20ms" COEFFS 0 256.000000 0.000000 0 0.000000 80.916000 /end COMPU_METHOD
/begin COMPU_METHOD UF "Umrechnung fuer Fuellungsgrad" RAT_FUNC "%7.3" "%" COEFFS 0 255.000000 0.000000 0 0.000000 191.250000 /end COMPU_METHOD
/begin COMPU_METHOD UFUELL "Umrechnung fuer Fuellungsgrad" RAT_FUNC "%7.3" "%" COEFFS 0 255.000000 0.000000 0 0.000000 191.250000 /end COMPU_METHOD
/begin COMPU_METHOD UGESCH12 "Umrechnung fuer Geschwindigkeiten mit  1.200 quantisiert" RAT_FUNC "%7.3" "km/h" COEFFS 0 1.200000 0.000000 0 0.000000 1.000000 /end COMPU_METHOD
/begin COMPU_METHOD UIVERH " I-Verstaerkung " RAT_FUNC "%9.6" "1/s/s " COEFFS 0 6.990293 0.000000 0 0.000000 1.000000 /end COMPU_METHOD
/begin COMPU_METHOD UIVLWB_512 "  Umrechnung Verstaerkung" RAT_FUNC "%6.2" "1/%/100ms" COEFFS 0 512.000000 0.000000 0 0.000000 1.000000 /end COMPU_METHOD
/begin COMPU_METHOD UIV_512 "  Umrechnung Verstaerkung" RAT_FUNC "%6.4" "1/%/10ms" COEFFS 0 512.000000 0.000000 0 0.000000 1.000000 /end COMPU_METHOD
/begin COMPU_METHOD UIV_VMAXL "" RAT_FUNC "%6.0" "1/km/h/s" COEFFS 0 1.000000 0.000000 0 0.000000 4.000000 /end COMPU_METHOD
/begin COMPU_METHOD UKRAP "" TAB_NOINTP "%7.4" "" COMPU_TAB_REF UKRAP /end COMPU_METHOD
/begin COMPU_METHOD ULSQL "  Lambdasonden-Spannung ohne Offset" RAT_FUNC "%7.5" "V" COEFFS 0 13107.000000 0.000000 0 0.000000 1.000000 /end COMPU_METHOD
/begin COMPU_METHOD UMFMVER " Zeitquantisierung Ueberwachung mver in [ms] mit mver_anz=   1.000 " RAT_FUNC "%5.0" "ms" COEFFS 0 1.000000 0.000000 0 0.000000 40.000000 /end COMPU_METHOD
/begin COMPU_METHOD UMFMZF " Zeitquantisierung Ueberwachung mzf in [ms] mit mzf_anz=  1.000 " RAT_FUNC "%5.0" "ms" COEFFS 0 1.000000 0.000000 0 0.000000 40.000000 /end COMPU_METHOD
/begin COMPU_METHOD UMFTLC " Zeitquantisierung Ueberwachung tlc in [ms] mit tlc_anz=  1.000 " RAT_FUNC "%5.0" "ms" COEFFS 0 1.000000 0.000000 0 0.000000 40.000000 /end COMPU_METHOD
/begin COMPU_METHOD UTABG "Abgastemperatur" RAT_FUNC "%7.3" "grad C" COEFFS 0 1.000000 48.000000 0 0.000000 4.000000 /end COMPU_METHOD
/begin COMPU_METHOD UTABGR "Abgastemperatur relativ" RAT_FUNC "%7.2" "grad C" COEFFS 0 1.000000 0.000000 0 0.000000 4.000000 /end COMPU_METHOD
/begin COMPU_METHOD UTMP_00 "  lineare Temperatur" RAT_FUNC "%6.2" "grd C" COEFFS 0 1.000000 0.000000 0 0.000000 1.000000 /end COMPU_METHOD
/begin COMPU_METHOD UTMP_40 "  lineare Temperatur + Offset" RAT_FUNC "%6.2" "grd C" COEFFS 0 1.000000 40.000000 0 0.000000 1.000000 /end COMPU_METHOD
/begin COMPU_METHOD UTWKSSL "  Steuergeraetekonstante" RAT_FUNC "%6.1" "kg/h" COEFFS 0 1.000000 0.000000 0 0.000000 1.000000e-01 /end COMPU_METHOD
/begin COMPU_METHOD UWDK "Drosselklappenwinkel" RAT_FUNC "%7.4" "grad DK" COEFFS 0 256.000000 0.000000 0 0.000000 80.916000 /end COMPU_METHOD
/begin COMPU_METHOD UWKL10 "Drosselklappenwinkel" RAT_FUNC "%7.4" "grad DK" COEFFS 0 25.323000 0.000000 0 0.000000 1.000000 /end COMPU_METHOD
/begin COMPU_METHOD VQV "  Fahrgeschwindigkeit mit Faktor  0.833 [km/h]" RAT_FUNC "%5.1" "km/h" COEFFS 0 8.333300e-01 0.000000 0 0.000000 1.000000 /end COMPU_METHOD
/begin COMPU_METHOD VQV16L "  Geschwindigkeitsumrechnung mit Faktor  16.00 [km/h]" RAT_FUNC "%6.1" "km/h" COEFFS 0 16.000000 0.000000 0 0.000000 1.000000 /end COMPU_METHOD
/begin COMPU_METHOD WQ720 "  Kurbelwellenwinkel-Quantisierung mit  2.813 [grad KW] quantisiert" RAT_FUNC "%5.1" "grad KW" COEFFS 0 1.000000 0.000000 0 0.000000 2.812500 /end COMPU_METHOD
/begin COMPU_METHOD ZQ50 " Zeitkonstante für Tiefpass mit 50[ms]" RAT_FUNC "%6.3" "sec" COEFFS 0 0.000000 128.000000 0 10.000000 0.000000 /end COMPU_METHOD
/begin COMPU_METHOD ZWNEG "  Zuendwinkelverstellung nach frueh mit -0.750[grad KW] quantisiert" RAT_FUNC "%5.2" "grad KW" COEFFS 0 1.000000 0.000000 0 0.000000 -7.500000e-01 /end COMPU_METHOD
/begin COMPU_METHOD ZWOF "  Zuendwinkel mit Offset" RAT_FUNC "%6.3" "grad KW" COEFFS 0 1.000000 78.000000 0 0.000000 7.500000e-01 /end COMPU_METHOD
/begin COMPU_METHOD ZWQ "  Zuendwinkel ohne Offset mit  0.750[grad KW] quantisiert" RAT_FUNC "%6.2" "grad KW" COEFFS 0 1.000000 0.000000 0 0.000000 7.500000e-01 /end COMPU_METHOD
/begin COMPU_METHOD NoCompuMethod "" RAT_FUNC "%4.0" "" COEFFS 0 1 0 0 0 1 /end COMPU_METHOD
/begin COMPU_TAB AG_TMP "" TAB_INTP 29 0 354.000000 5 370.000000 13 400.000000 18 420.000000 26 450.000000 31 470.000000 39 500.000000 43 520.000000 51 550.000000 55 570.000000 62 600.000000 66 620.000000 72 650.000000 77 670.000000 83 700.000000 87 720.000000 92 750.000000 96 770.000000 102 800.000000 105 820.000000 111 850.000000 114 870.000000 119 900.000000 122 920.000000 127 950.000000 130 970.000000 135 1050.000000 136 1100.000000 255 1101.000000 /end COMPU_TAB
/begin COMPU_TAB CLU_TMP "" TAB_INTP 41 3 -50.000000 4 -45.000000 5 -40.000000 7 -35.000000 10 -30.000000 13 -25.000000 16 -20.000000 21 -15.000000 26 -10.000000 32 -5.000000 38 0.000000 46 5.000000 55 10.000000 64 15.000000 74 20.000000 84 25.000000 95 30.000000 106 35.000000 117 40.000000 128 45.000000 139 50.000000 149 55.000000 158 60.000000 167 65.000000 175 70.000000 183 75.000000 190 80.000000 196 85.000000 202 90.000000 207 95.000000 212 100.000000 216 105.000000 220 110.000000 223 115.000000 226 120.000000 229 125.000000 231 130.000000 233 135.000000 235 140.000000 237 145.000000 239 150.000000 /end COMPU_TAB
/begin COMPU_TAB CMO_TMP "" TAB_INTP 21 0 -41.000000 5 -40.000000 9 -30.000000 15 -20.150000 24 -10.120000 36 -0.140000 53 9.940000 73 19.980000 84 24.980000 95 30.020000 118 39.970000 141 49.980000 162 60.000000 180 70.080000 195 80.030000 207 90.000000 217 99.960000 225 109.910000 231 120.250000 236 129.640000 255 140.000000 /end COMPU_TAB
/begin COMPU_TAB TMP_79_140 "" TAB_INTP 8 0 77.700000 14 80.000000 63 90.000000 102 100.000000 133 110.000000 157 120.000000 176 130.000000 197 140.000000 /end COMPU_TAB
/begin COMPU_TAB UKRAP "" TAB_NOINTP 1 0 0.000000 /end COMPU_TAB
/end MODULE
/end PROJECT
