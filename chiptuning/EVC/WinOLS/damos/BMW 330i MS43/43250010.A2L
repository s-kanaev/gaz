ASAP2_VERSION 1 2
/begin PROJECT Z432 "430"
/begin HEADER "" VERSION "056.03" PROJECT_NO Z430 /end HEADER
/begin MODULE BMW-EASY ""
/begin MOD_COMMON "common attributes" DEPOSIT ABSOLUT BYTE_ORDER BIG_ENDIAN /end MOD_COMMON
/begin CHARACTERISTIC ip_isapwm_dri__tco "IP_ISAPWM_DRI" CURVE 0x7a18a a_3 10 LINEAR______0_000000__0H___399_9 0.0 399.9938
 /begin AXIS_DESCR COM_AXIS tco LINEAR_______48_000000__0H___142 6 -48.0 142.5 AXIS_PTS_REF ldpm_tco_4 MAX_GRAD 100 MONOTONY MON_INCREASE /end AXIS_DESCR
/end CHARACTERISTIC
/begin CHARACTERISTIC ip_isapwm_dri_acin__tco "IP_ISAPWM_DRI_ACIN" CURVE 0x7a196 a_3 10 LINEAR______0_000000__0H___399_9 0.0 399.9938
 /begin AXIS_DESCR COM_AXIS tco LINEAR_______48_000000__0H___142 6 -48.0 142.5 AXIS_PTS_REF ldpm_tco_4 MAX_GRAD 100 MONOTONY MON_INCREASE /end AXIS_DESCR
/end CHARACTERISTIC
/begin CHARACTERISTIC ip_isapwm_dri_lgrd_dec__tco "IP_ISAPWM_DRI_LGRD_DEC" CURVE 0x7a20a a_3 10 LINEAR______0_006100__1H___24_49 0.0061 24.9938
 /begin AXIS_DESCR COM_AXIS tco LINEAR_______48_000000__0H___142 6 -48.0 142.5 AXIS_PTS_REF ldpm_tco_4 MAX_GRAD 100 MONOTONY MON_INCREASE /end AXIS_DESCR
/end CHARACTERISTIC
/begin CHARACTERISTIC ip_isapwm_dri_lgrd_inc__tco "IP_ISAPWM_DRI_LGRD_INC" CURVE 0x7a216 a_3 10 LINEAR______0_006100__1H___24_99 0.0061 24.9938
 /begin AXIS_DESCR COM_AXIS tco LINEAR_______48_000000__0H___142 6 -48.0 142.5 AXIS_PTS_REF ldpm_tco_4 MAX_GRAD 100 MONOTONY MON_INCREASE /end AXIS_DESCR
/end CHARACTERISTIC
/begin CHARACTERISTIC ip_isapwm_ecf_add__ecfpwm "IP_ISAPWM_ECF_ADD" CURVE 0x7a222 a_3 100 LINEAR______0_000000__0H___399_9 0.0 399.9938
 /begin AXIS_DESCR COM_AXIS ecfpwm_ecf LINEAR______0_000000__0H___99_60 6 0.0 99.609375 AXIS_PTS_REF ldp_ecfpwm_ecf__isapwm_ecf_add MAX_GRAD 100 MONOTONY MON_INCREASE /end AXIS_DESCR
/end CHARACTERISTIC
/begin CHARACTERISTIC ip_isapwm_hpa__n_32 "IP_ISAPWM_HPA" CURVE 0x7a22e a_3 100 LINEAR______0_000000__0H___399_9 0.0 399.9938
 /begin AXIS_DESCR COM_AXIS n_32 LINEAR______0_000000__0H___8160_ 4 0.0 8160.0 AXIS_PTS_REF ldp_n_32__isapwm_hpa MAX_GRAD 100 MONOTONY MON_INCREASE /end AXIS_DESCR
 FUNCTION_LIST Z1S1 /end CHARACTERISTIC
/begin CHARACTERISTIC ip_isapwm_ini_i_st__tco "IP_ISAPWM_INI_I_ST" CURVE 0x7a236 a_3 10 LINEAR_______50_000000__0H___440 -50.0 49.998471
 /begin AXIS_DESCR COM_AXIS tco LINEAR_______48_000000__0H___142 8 -48.0 142.5 AXIS_PTS_REF ldpm_tco_3 MAX_GRAD 100 MONOTONY MON_INCREASE /end AXIS_DESCR
/end CHARACTERISTIC
/begin CHARACTERISTIC ip_isapwm_n_sp_min__n__sp_dif_vb "IP_ISAPWM_N_SP_MIN" MAP 0x7a246 a_50 10 LINEAR______0_006100__1H___24_49 0.0061 24.9938
 /begin AXIS_DESCR COM_AXIS n_sp_dif_vb LINEAR______0_000000__0H___1000_ 4 0.0 1000.0 AXIS_PTS_REF ldp_n_sp_dif__isapwm_n_sp_min MAX_GRAD 3 /end AXIS_DESCR
 /begin AXIS_DESCR COM_AXIS n LINEAR______0_000000__0H___8160_ 4 0.0 8160.0 AXIS_PTS_REF ldp_n_32__isapwm_n_sp_min MAX_GRAD 25 /end AXIS_DESCR
/end CHARACTERISTIC
/begin CHARACTERISTIC ip_isapwm_neg_i_is__n_dif_kor "IP_ISAPWM_NEG_I_IS" CURVE 0x7a266 a_24 1 LINEAR_______50_000000__0H___440 -50.0 49.998471
 /begin AXIS_DESCR COM_AXIS n_dif_cor LINEAR_______1024_000000__7C00H_ 8 -1024.0 1016.0 AXIS_PTS_REF ldpm_n_dif_cor_2 MAX_GRAD 100 MONOTONY MON_INCREASE /end AXIS_DESCR
/end CHARACTERISTIC
/begin CHARACTERISTIC ip_isapwm_p_is__n_dif_cor "IP_ISAPWM_P_IS" CURVE 0x776b8 a_7 10 LINEAR_______50_000000__0H___49_ -50.0 49.6094
 /begin AXIS_DESCR COM_AXIS n_dif_cor LINEAR_______1024_000000__7C00H_ 12 -1024.0 1016.0 AXIS_PTS_REF ldp_n_dif_cor__isapwm_p_is MAX_GRAD 100 MONOTONY MON_INCREASE /end AXIS_DESCR
/end CHARACTERISTIC
/begin CHARACTERISTIC ip_isapwm_pos_i_is__n_dif_cor "IP_ISAPWM_POS_I_IS" CURVE 0x7a276 a_24 1 LINEAR_______50_000000__0H___440 -50.0 49.998471
 /begin AXIS_DESCR COM_AXIS n_dif_cor LINEAR_______1024_000000__7C00H_ 8 -1024.0 1016.0 AXIS_PTS_REF ldpm_n_dif_cor_2 MAX_GRAD 100 MONOTONY MON_INCREASE /end AXIS_DESCR
/end CHARACTERISTIC
/begin CHARACTERISTIC ip_isapwm_pvs__pvs__n "IP_ISAPWM_PVS" MAP 0x7a286 a_36 100 LINEAR______0_000000__0H___99_99 0.0 99.998474
 /begin AXIS_DESCR COM_AXIS n LINEAR______0_000000__0H___8160_ 12 0.0 8160.0 AXIS_PTS_REF ldpm_n_32_3 MAX_GRAD 100 MONOTONY MON_INCREASE /end AXIS_DESCR
 /begin AXIS_DESCR COM_AXIS dummy_b LINEAR______0_000000__0H___119_8 12 0.0 119.8828 AXIS_PTS_REF ldpm_pvs_2 MAX_GRAD 100 MONOTONY MON_INCREASE /end AXIS_DESCR
/end CHARACTERISTIC
/begin CHARACTERISTIC ip_isapwm_sap__n "IP_ISAPWM_SAP" CURVE 0x7a3c6 a_3 15 LINEAR______0_000000__0H___399_9 0.0 399.9938
 /begin AXIS_DESCR COM_AXIS n LINEAR______0_000000__0H___8160_ 4 0.0 8160.0 AXIS_PTS_REF ldpm_n_32_11 MAX_GRAD 100 MONOTONY MON_INCREASE /end AXIS_DESCR
/end CHARACTERISTIC
/begin CHARACTERISTIC ip_isapwm_sap_tra__n "IP_ISAPWM_SAP_TRA" CURVE 0x7a3ce a_3 15 LINEAR_______200_000000__0H___19 -200.0 199.9938
 /begin AXIS_DESCR COM_AXIS n LINEAR______0_000000__0H___8160_ 4 0.0 8160.0 AXIS_PTS_REF ldpm_n_32_11 MAX_GRAD 100 MONOTONY MON_INCREASE /end AXIS_DESCR
/end CHARACTERISTIC
/begin CHARACTERISTIC ip_isapwm_sp_st__tco__n "IP_ISAPWM_SP_ST" MAP 0x7a406 a_50 100 LINEAR______0_000000__0H___99_99 0.0 99.998474
 /begin AXIS_DESCR COM_AXIS n LINEAR______0_000000__0H___81612 4 0.0 8160.0 AXIS_PTS_REF ldpm_n_22 MAX_GRAD 100 MONOTONY MON_INCREASE /end AXIS_DESCR
 /begin AXIS_DESCR COM_AXIS tco LINEAR_______48_000000__0H___142 8 -48.0 142.5 AXIS_PTS_REF ldpm_tco_3 MAX_GRAD 100 MONOTONY MON_INCREASE /end AXIS_DESCR
/end CHARACTERISTIC
/begin CHARACTERISTIC ip_isapwm_st__tco__n "IP_ISAPWM_ST" MAP 0x7a446 a_50 10 LINEAR______0_000000__0H___399_9 0.0 399.9938
 /begin AXIS_DESCR COM_AXIS n LINEAR______0_000000__0H___81612 4 0.0 8160.0 AXIS_PTS_REF ldpm_n_22 MAX_GRAD 100 MONOTONY MON_INCREASE /end AXIS_DESCR
 /begin AXIS_DESCR COM_AXIS tco LINEAR_______48_000000__0H___142 8 -48.0 142.5 AXIS_PTS_REF ldpm_tco_3 MAX_GRAD 100 MONOTONY MON_INCREASE /end AXIS_DESCR
/end CHARACTERISTIC
/begin CHARACTERISTIC ip_isapwm_tco_fac_is__tco "IP_ISAPWM_TCO_FAC_IS" CURVE 0x776c4 a_1 20 LINEAR______0_000000__0H___1_992 0.0 1.9921875
 /begin AXIS_DESCR COM_AXIS tco LINEAR_______48_000000__0H___142 4 -48.0 142.5 AXIS_PTS_REF ldpm_tco_8 MAX_GRAD 100 MONOTONY MON_INCREASE /end AXIS_DESCR
/end CHARACTERISTIC
/begin CHARACTERISTIC ip_isapwm_tia_add__tia "IP_ISAPWM_TIA_ADD" CURVE 0x7a486 a_3 16 LINEAR_______200_000000__0H___19 -200.0 199.9938
 /begin AXIS_DESCR COM_AXIS tia LINEAR_______48_000000__0H___142 4 -48.0 142.5 AXIS_PTS_REF ldp_tia__isapwm_tia_add MAX_GRAD 26 MONOTONY MON_INCREASE /end AXIS_DESCR
/end CHARACTERISTIC
/begin CHARACTERISTIC ip_isapwm_tia_fac__tia "IP_ISAPWM_TIA_FAC" CURVE 0x7a48e a_3 10 LINEAR______0_000000__0H___1_999 0.0 1.99997
 /begin AXIS_DESCR COM_AXIS tia LINEAR_______48_000000__0H___142 6 -48.0 142.5 AXIS_PTS_REF ldpm_tia_1 MAX_GRAD 100 MONOTONY MON_INCREASE /end AXIS_DESCR
/end CHARACTERISTIC
/begin CHARACTERISTIC ip_isapwm_toil_add__toil "IP_ISAPWM_TOIL_ADD" CURVE 0x7a49a a_3 100 LINEAR_______200_000000__0H___19 -200.0 199.9938
 /begin AXIS_DESCR COM_AXIS toil LINEAR_______48_000000__0H___155 6 -48.0 155.0 AXIS_PTS_REF ldp_toil__isapwm_toil_add MAX_GRAD 100 MONOTONY MON_INCREASE /end AXIS_DESCR
/end CHARACTERISTIC
/begin CHARACTERISTIC ip_isapwm_vo_add__tco__vo "IP_ISAPWM_VO_ADD" MAP 0x7a4a6 a_50 100 LINEAR_______200_000000__0H___19 -200.0 199.9938
 /begin AXIS_DESCR COM_AXIS vo LINEAR______0_000000__0H___120_0 8 0.0 120.0 AXIS_PTS_REF ldpm_vo_2 MAX_GRAD 100 MONOTONY MON_INCREASE /end AXIS_DESCR
 /begin AXIS_DESCR COM_AXIS tco LINEAR_______48_000000__0H___142 8 -48.0 142.5 AXIS_PTS_REF ldpm_tco_16 MAX_GRAD 100 MONOTONY MON_INCREASE /end AXIS_DESCR
/end CHARACTERISTIC
/begin CHARACTERISTIC ip_isapwm_vs_at__vs__n_dif "IP_ISAPWM_VS_AT" MAP 0x7a526 a_50 100 LINEAR______0_000000__0H____200_ -200.0 0.0
 /begin AXIS_DESCR COM_AXIS n_dif LINEAR_______32768_000000__0H___ 4 -32768.0 32767.0 AXIS_PTS_REF ldp_n_dif__isapwm_vs_at MAX_GRAD 100 MONOTONY MON_INCREASE /end AXIS_DESCR
 /begin AXIS_DESCR COM_AXIS vs LINEAR______0_000000__0H___25511 4 0.0 255.0 AXIS_PTS_REF ldp_vs__isapwm_vs_at MAX_GRAD 100 MONOTONY MON_INCREASE /end AXIS_DESCR
/end CHARACTERISTIC
/begin CHARACTERISTIC ip_isapwm_vs_fil_amt__vs__n_dif "IP_ISAPWM_VS_FIL_AMT" MAP 0x7a546 a_28 100 LINEAR_______200_000000__0H___19 -200.0 199.9938
 /begin AXIS_DESCR COM_AXIS n_dif LINEAR_______32768_000000__0H___ 4 -32768.0 32767.0 AXIS_PTS_REF ldp_n_dif__isapwm_vs_fil_amt MAX_GRAD 100 MONOTONY MON_INCREASE /end AXIS_DESCR
 /begin AXIS_DESCR COM_AXIS vs_fil LINEAR______0_000000__0H___51151 4 0.0 511.99218 AXIS_PTS_REF ldp_vs_fil__isapwm_vs_fil_amt MAX_GRAD 100 MONOTONY MON_INCREASE /end AXIS_DESCR
 FUNCTION_LIST Z1S1 /end CHARACTERISTIC
/begin CHARACTERISTIC ip_ivvthpwm__tmag__vb "IP_IVVTHPWM" MAP 0x776c8 a_6 100 LINEAR______0_000000__0H___99_60 0.0 99.609375
 /begin AXIS_DESCR COM_AXIS vb LINEAR______0_000000__0H___26_00 4 0.0 26.0 AXIS_PTS_REF ldp_vb__ivvthpwm MAX_GRAD 100 MONOTONY MON_INCREASE /end AXIS_DESCR
 /begin AXIS_DESCR COM_AXIS tmag LINEAR_______48_000000__0H___155 6 -48.0 155.0 AXIS_PTS_REF ldpm_tmag_1 MAX_GRAD 100 MONOTONY MON_INCREASE /end AXIS_DESCR
/end CHARACTERISTIC
/begin CHARACTERISTIC ip_lam_cp__n__maf_cor "IP_LAM_CP" MAP 0x7a566 a_9 2 LINEAR______0_000015__1H___0_250 1.53e-005 0.25
 /begin AXIS_DESCR COM_AXIS maf_cor LINEAR______0_000000__0H___1389_ 12 0.0 1389.0 AXIS_PTS_REF ldpm_maf_add_cor_1 MAX_GRAD 100 MONOTONY MON_INCREASE /end AXIS_DESCR
 /begin AXIS_DESCR COM_AXIS n LINEAR______0_000000__0H___8160_ 10 0.0 8160.0 AXIS_PTS_REF ldpm_n_32_7 MAX_GRAD 100 MONOTONY MON_INCREASE /end AXIS_DESCR
/end CHARACTERISTIC
/begin CHARACTERISTIC ip_lam_dif_max_cp__n__maf "IP_LAM_DIF_MAX_CP" MAP 0x7a656 a_9 100 LINEAR______1_000000__28FH___31_ 1.0 31.25
 /begin AXIS_DESCR COM_AXIS maf LINEAR______0_000000__0H___1389_ 5 0.0 1389.0 AXIS_PTS_REF ldp_maf__lam_dif_max_cp MAX_GRAD 100 MONOTONY MON_INCREASE /end AXIS_DESCR
 /begin AXIS_DESCR COM_AXIS n_32 LINEAR______0_000000__0H___8160_ 5 0.0 8160.0 AXIS_PTS_REF ldp_n_32__lam_dif_max_cp MAX_GRAD 100 MONOTONY MON_INCREASE /end AXIS_DESCR
/end CHARACTERISTIC
/begin CHARACTERISTIC ip_lam_i_1__n__maf "IP_LAM_I_1" MAP 0x776e0 a_39 5 LINEAR______0_000000__0H___0_496 0.0 0.49608999
 /begin AXIS_DESCR COM_AXIS maf LINEAR______0_000000__0H___1389_ 8 0.0 1389.0 AXIS_PTS_REF ldpm_maf_4 MAX_GRAD 100 MONOTONY MON_INCREASE /end AXIS_DESCR
 /begin AXIS_DESCR COM_AXIS n LINEAR______0_000000__0H___81612 8 0.0 8160.0 AXIS_PTS_REF ldpm_n_7 MAX_GRAD 100 MONOTONY MON_INCREASE /end AXIS_DESCR
/end CHARACTERISTIC
/begin CHARACTERISTIC ip_lam_i_2__n__maf "IP_LAM_I_2" MAP 0x77720 a_39 5 LINEAR______0_000000__0H___0_496 0.0 0.49608999
 /begin AXIS_DESCR COM_AXIS maf LINEAR______0_000000__0H___1389_ 8 0.0 1389.0 AXIS_PTS_REF ldpm_maf_4 MAX_GRAD 100 MONOTONY MON_INCREASE /end AXIS_DESCR
 /begin AXIS_DESCR COM_AXIS n LINEAR______0_000000__0H___81612 8 0.0 8160.0 AXIS_PTS_REF ldpm_n_7 MAX_GRAD 100 MONOTONY MON_INCREASE /end AXIS_DESCR
/end CHARACTERISTIC
/begin CHARACTERISTIC ip_lam_i_is_1__n__maf "IP_LAM_I_IS_1" MAP 0x77760 a_39 5 LINEAR______0_000000__0H___0_496 0.0 0.49608999
 /begin AXIS_DESCR COM_AXIS maf LINEAR______0_000000__0H___1389_ 2 0.0 1389.0 AXIS_PTS_REF ldpm_maf_20 MAX_GRAD 100 MONOTONY MON_INCREASE /end AXIS_DESCR
 /begin AXIS_DESCR COM_AXIS n LINEAR______0_000000__0H___81612 2 0.0 8160.0 AXIS_PTS_REF ldpm_n_20 MAX_GRAD 100 MONOTONY MON_INCREASE /end AXIS_DESCR
/end CHARACTERISTIC
/begin CHARACTERISTIC ip_lam_i_is_2__n__maf "IP_LAM_I_IS_2" MAP 0x77764 a_39 5 LINEAR______0_000000__0H___0_496 0.0 0.49608999
 /begin AXIS_DESCR COM_AXIS maf LINEAR______0_000000__0H___1389_ 2 0.0 1389.0 AXIS_PTS_REF ldpm_maf_20 MAX_GRAD 100 MONOTONY MON_INCREASE /end AXIS_DESCR
 /begin AXIS_DESCR COM_AXIS n LINEAR______0_000000__0H___81612 2 0.0 8160.0 AXIS_PTS_REF ldpm_n_20 MAX_GRAD 100 MONOTONY MON_INCREASE /end AXIS_DESCR
/end CHARACTERISTIC
/begin CHARACTERISTIC ip_lam_neg_p__n__maf "IP_LAM_NEG_P" MAP 0x77768 a_39 10 LINEAR______0_000000__0H___0_496 0.0 0.49608999
 /begin AXIS_DESCR COM_AXIS maf LINEAR______0_000000__0H___1389_ 8 0.0 1389.0 AXIS_PTS_REF ldpm_maf_4 MAX_GRAD 100 MONOTONY MON_INCREASE /end AXIS_DESCR
 /begin AXIS_DESCR COM_AXIS n LINEAR______0_000000__0H___81612 8 0.0 8160.0 AXIS_PTS_REF ldpm_n_7 MAX_GRAD 100 MONOTONY MON_INCREASE /end AXIS_DESCR
/end CHARACTERISTIC
/begin CHARACTERISTIC ip_lam_neg_p_is__n__maf "IP_LAM_NEG_P_IS" MAP 0x777a8 a_39 10 LINEAR______0_000000__0H___0_496 0.0 0.49608999
 /begin AXIS_DESCR COM_AXIS maf LINEAR______0_000000__0H___1389_ 2 0.0 1389.0 AXIS_PTS_REF ldpm_maf_20 MAX_GRAD 100 MONOTONY MON_INCREASE /end AXIS_DESCR
 /begin AXIS_DESCR COM_AXIS n LINEAR______0_000000__0H___81612 2 0.0 8160.0 AXIS_PTS_REF ldpm_n_20 MAX_GRAD 100 MONOTONY MON_INCREASE /end AXIS_DESCR
/end CHARACTERISTIC
/begin CHARACTERISTIC ip_lam_pos_p__n__maf "IP_LAM_POS_P" MAP 0x777ac a_39 10 LINEAR______0_000000__0H___0_496 0.0 0.49608999
 /begin AXIS_DESCR COM_AXIS maf LINEAR______0_000000__0H___1389_ 8 0.0 1389.0 AXIS_PTS_REF ldpm_maf_4 MAX_GRAD 100 MONOTONY MON_INCREASE /end AXIS_DESCR
 /begin AXIS_DESCR COM_AXIS n LINEAR______0_000000__0H___81612 8 0.0 8160.0 AXIS_PTS_REF ldpm_n_7 MAX_GRAD 100 MONOTONY MON_INCREASE /end AXIS_DESCR
/end CHARACTERISTIC
/begin CHARACTERISTIC ip_lam_pos_p_is__n__maf "IP_LAM_POS_P_IS" MAP 0x777ec a_39 10 LINEAR______0_000000__0H___0_496 0.0 0.49608999
 /begin AXIS_DESCR COM_AXIS maf LINEAR______0_000000__0H___1389_ 2 0.0 1389.0 AXIS_PTS_REF ldpm_maf_20 MAX_GRAD 100 MONOTONY MON_INCREASE /end AXIS_DESCR
 /begin AXIS_DESCR COM_AXIS n LINEAR______0_000000__0H___81612 2 0.0 8160.0 AXIS_PTS_REF ldpm_n_20 MAX_GRAD 100 MONOTONY MON_INCREASE /end AXIS_DESCR
/end CHARACTERISTIC
/begin CHARACTERISTIC ip_lam_tra_lgrd__maf_kgh "IP_LAM_TRA_LGRD" CURVE 0x7a688 a_24 1 LINEAR______0_000015__1H___0_250 1.53e-005 0.25
 /begin AXIS_DESCR COM_AXIS maf_kgh LINEAR______0_000000__0H___16383 8 0.0 16383.75 AXIS_PTS_REF ldpm_maf_kgh_1 MAX_GRAD 100 MONOTONY MON_INCREASE /end AXIS_DESCR
/end CHARACTERISTIC
/begin CHARACTERISTIC ip_lamb_ch_max_sa__tco "IP_LAMB_CH_MAX_SA" CURVE 0x7a698 a_3 10 LINEAR______0_000000__0H___1_952 0.0 1.99997
 /begin AXIS_DESCR COM_AXIS tco LINEAR_______48_000000__0H___142 8 -48.0 142.5 AXIS_PTS_REF ldpm_tco_2 MAX_GRAD 100 MONOTONY MON_INCREASE /end AXIS_DESCR
/end CHARACTERISTIC
/begin CHARACTERISTIC ip_lamb_ch_min_sa__tco "IP_LAMB_CH_MIN_SA" CURVE 0x7a6a8 a_3 10 LINEAR______0_000000__0H___1_952 0.0 1.99997
 /begin AXIS_DESCR COM_AXIS tco LINEAR_______48_000000__0H___142 8 -48.0 142.5 AXIS_PTS_REF ldpm_tco_2 MAX_GRAD 100 MONOTONY MON_INCREASE /end AXIS_DESCR
/end CHARACTERISTIC
/begin CHARACTERISTIC ip_lamb_up_cat_sa__maf_cyl__teg "IP_LAMP_UP_CAT_SA" MAP 0x7a6b8 a_28 100 LINEAR______0_000000__0H___1_999 0.0 1.99997
 /begin AXIS_DESCR COM_AXIS maf_cyl LINEAR______0_000000__0H___16383 8 0.0 16383.75 AXIS_PTS_REF ldp_maf_cyl__lamp_up_cat_sa MAX_GRAD 100 MONOTONY MON_INCREASE /end AXIS_DESCR
 /begin AXIS_DESCR COM_AXIS teg LINEAR______0_000000__0H___10253 8 0.0 1023.9844 AXIS_PTS_REF ldp_teg__lamp_up_cat_sa MAX_GRAD 100 MONOTONY MON_INCREASE /end AXIS_DESCR
/end CHARACTERISTIC
/begin CHARACTERISTIC ip_lshpwm__temp_mmv_sub_ex_x_i "IP_LSHPWM" CURVE 0x777f0 a_7 100 LINEAR______0_000000__0H___99_60 0.0 99.609375
 /begin AXIS_DESCR COM_AXIS dummy_w LINEAR_______33_000000__0H___989 6 -33.0 989.9844 AXIS_PTS_REF ldp_temp_mmv_sub_ex_x_i__lshpwm MAX_GRAD 100 MONOTONY MON_INCREASE /end AXIS_DESCR
/end CHARACTERISTIC
/begin CHARACTERISTIC ip_maf_1_diag__n__tps_av "IP_MAF_1_DIAG" MAP 0x7a738 a_50 5 LINEAR______0_000000__0H___13818 0.0 1389.0
 /begin AXIS_DESCR COM_AXIS dummy_b LINEAR______0_000000__0H___119_9 16 0.0 119.99817 AXIS_PTS_REF ldp_tps_av__maf_1_diag MAX_GRAD 100 MONOTONY MON_INCREASE /end AXIS_DESCR
 /begin AXIS_DESCR COM_AXIS n LINEAR______0_000000__0H___8160_ 16 0.0 8160.0 AXIS_PTS_REF ldpm_n_32_6 MAX_GRAD 100 MONOTONY MON_INCREASE /end AXIS_DESCR
/end CHARACTERISTIC
/begin CHARACTERISTIC ip_maf_2_diag__n "IP_MAF_2_DIAG" CURVE 0x777f6 a_1 10 LINEAR______0_000000__0H___1389_ 0.0 1389.0
 /begin AXIS_DESCR COM_AXIS n LINEAR______0_000000__0H___8160_ 6 0.0 8160.0 AXIS_PTS_REF ldp_n_32__maf_2_diag MAX_GRAD 100 MONOTONY MON_INCREASE /end AXIS_DESCR
/end CHARACTERISTIC
/begin CHARACTERISTIC ip_maf_add_tia_fac__tia "IP_MAF_ADD_TIA_FAC" CURVE 0x777fc a_1 100 LINEAR______0_000000__0H___1_992 0.0 1.9921875
 /begin AXIS_DESCR COM_AXIS tia LINEAR_______48_000000__0H___142 6 -48.0 142.5 AXIS_PTS_REF ldpm_tia_1 MAX_GRAD 100 MONOTONY MON_INCREASE /end AXIS_DESCR
/end CHARACTERISTIC
/begin CHARACTERISTIC ip_maf_dif_max_er__maf "IP_MAF_DIF_MAX_ER" CURVE 0x7a938 a_3 5 LINEAR______0_000000__0H___13818 0.0 1389.0
 /begin AXIS_DESCR COM_AXIS maf LINEAR______0_000000__0H___1389_ 6 0.0 1389.0 AXIS_PTS_REF ldp_maf__maf_dif_max_er MAX_GRAD 100 MONOTONY MON_INCREASE /end AXIS_DESCR
/end CHARACTERISTIC
/begin CHARACTERISTIC ip_maf_dly_ad_max__n "IP_MAF_DLY_AD_MAX" CURVE 0x7a944 a_3 100 LINEAR______0_000000__0H___13818 0.0 1389.0
 /begin AXIS_DESCR COM_AXIS n_32 LINEAR______0_000000__0H___8160_ 6 0.0 8160.0 AXIS_PTS_REF ldpm_n_32_21 MAX_GRAD 100 MONOTONY MON_INCREASE /end AXIS_DESCR
/end CHARACTERISTIC
/begin CHARACTERISTIC ip_maf_dly_ad_min__n "IP_MAF_DLY_AD_MIN" CURVE 0x7a950 a_3 100 LINEAR______0_000000__0H___13818 0.0 1389.0
 /begin AXIS_DESCR COM_AXIS n_32 LINEAR______0_000000__0H___8160_ 6 0.0 8160.0 AXIS_PTS_REF ldpm_n_32_21 MAX_GRAD 100 MONOTONY MON_INCREASE /end AXIS_DESCR
/end CHARACTERISTIC
/begin CHARACTERISTIC ip_maf_ign_crlc__n__maf_mes "IP_MAF_IGN_CRLC" MAP 0x77802 a_6 100 LINEAR______0_000000__0H___0_996 0.0 0.99609375
 /begin AXIS_DESCR COM_AXIS maf_mes LINEAR______0_000000__0H___1389_ 6 0.0 1389.0 AXIS_PTS_REF ldp_maf_mes__maf_ign_crlc MAX_GRAD 15 MONOTONY MON_INCREASE /end AXIS_DESCR
 /begin AXIS_DESCR COM_AXIS n_32 LINEAR______0_000000__0H___8160_ 6 0.0 8160.0 AXIS_PTS_REF ldp_n_32__maf_ign_crlc MAX_GRAD 100 MONOTONY MON_INCREASE /end AXIS_DESCR
/end CHARACTERISTIC
/begin CHARACTERISTIC ip_maf_int_dly_puc_max__maf_int "IP_MAF_INT_DLY_PUC_MAX" CURVE 0x7a95c a_24 100 LINEAR______0_000000__0H___1820_ 0.0 1820.42
 /begin AXIS_DESCR COM_AXIS dummy_b LINEAR______0_000000__0H___1820_ 6 0.0 1820.42 AXIS_PTS_REF ldp_maf_int_puc__maf_int_dly_puc MAX_GRAD 100 MONOTONY MON_INCREASE /end AXIS_DESCR
/end CHARACTERISTIC
/begin CHARACTERISTIC ip_maf_int_temp_down__toil_st "IP_MAF_INT_TEMP_DOWN" CURVE 0x7a968 a_3 100 LINEAR______0_000000__0H___36400 0.0 36400.0
 /begin AXIS_DESCR COM_AXIS toil_st LINEAR_______48_000000__0H___155 8 -48.0 155.0 AXIS_PTS_REF ldp_toil_st__maf_int_temp_down MAX_GRAD 100 MONOTONY MON_INCREASE /end AXIS_DESCR
 FUNCTION_LIST ETM /end CHARACTERISTIC
/begin CHARACTERISTIC ip_maf_kgh_max_diag_sa__fac_amp "IP_MAF_KGH_MAX_DIAG_SA" CURVE 0x7a978 a_24 10 LINEAR______0_000000__0H___16383 0.0 16383.75
 /begin AXIS_DESCR COM_AXIS fac_amp LINEAR______0_000000__0H___2_054 6 0.0 2.0 AXIS_PTS_REF ldpm_fac_amp_1 MAX_GRAD 10 MONOTONY MON_INCREASE /end AXIS_DESCR
/end CHARACTERISTIC
/begin CHARACTERISTIC ip_maf_lam_cat_max__n "IP_MAF_LAM_CAT_MAX" CURVE 0x7a984 a_3 100 LINEAR______0_000000__0H___13818 0.0 1389.0
 /begin AXIS_DESCR COM_AXIS n_32 LINEAR______0_000000__0H___8160_ 6 0.0 8160.0 AXIS_PTS_REF ldpm_n_32_29 MAX_GRAD 100 MONOTONY MON_INCREASE /end AXIS_DESCR
/end CHARACTERISTIC
/begin CHARACTERISTIC ip_maf_lam_cat_min__n "IP_MAF_LAM_CAT_MIN" CURVE 0x7a990 a_3 100 LINEAR______0_000000__0H___13818 0.0 1389.0
 /begin AXIS_DESCR COM_AXIS n_32 LINEAR______0_000000__0H___8160_ 6 0.0 8160.0 AXIS_PTS_REF ldpm_n_32_29 MAX_GRAD 100 MONOTONY MON_INCREASE /end AXIS_DESCR
/end CHARACTERISTIC
/begin CHARACTERISTIC ip_maf_lam_dly_i_max__n "IP_MAF_LAM_DLY_I_MAX" CURVE 0x7a99c a_3 100 LINEAR______0_000000__0H___13818 0.0 1389.0
 /begin AXIS_DESCR COM_AXIS n_32 LINEAR______0_000000__0H___8160_ 6 0.0 8160.0 AXIS_PTS_REF ldpm_n_32_21 MAX_GRAD 100 MONOTONY MON_INCREASE /end AXIS_DESCR
/end CHARACTERISTIC
/begin CHARACTERISTIC ip_maf_lam_dly_i_min__n "IP_MAF_LAM_DLY_I_MIN" CURVE 0x7a9a8 a_3 100 LINEAR______0_000000__0H___13818 0.0 1389.0
 /begin AXIS_DESCR COM_AXIS n_32 LINEAR______0_000000__0H___8160_ 6 0.0 8160.0 AXIS_PTS_REF ldpm_n_32_21 MAX_GRAD 100 MONOTONY MON_INCREASE /end AXIS_DESCR
/end CHARACTERISTIC
/begin CHARACTERISTIC ip_maf_max_cyl_lam__n "IP_MAF_MAX_CYL_LAM" CURVE 0x77826 a_7 100 LINEAR______0_000000__0H___1389_ 0.0 1389.0
 /begin AXIS_DESCR COM_AXIS n LINEAR______0_000000__0H___81612 6 0.0 8160.0 AXIS_PTS_REF ldpm_n_15 MAX_GRAD 100 MONOTONY MON_INCREASE /end AXIS_DESCR
 FUNCTION_LIST CSCM /end CHARACTERISTIC
/begin CHARACTERISTIC ip_maf_max_cyl_lam_ad__n "IP_MAF_MAX_CYL_LAM_AD" CURVE 0x7782c a_7 100 LINEAR______0_000000__0H___1389_ 0.0 1389.0
 /begin AXIS_DESCR COM_AXIS n LINEAR______0_000000__0H___81612 6 0.0 8160.0 AXIS_PTS_REF ldpm_n_15 MAX_GRAD 100 MONOTONY MON_INCREASE /end AXIS_DESCR
 FUNCTION_LIST CSCM /end CHARACTERISTIC
/begin CHARACTERISTIC ip_maf_max_diag_sa__n "IP_MAF_MAX_DIAG_SA" CURVE 0x77832 a_1 10 LINEAR______0_000000__0H___1389_ 0.0 1389.0
 /begin AXIS_DESCR COM_AXIS n_32 LINEAR______0_000000__0H___8160_ 8 0.0 8160.0 AXIS_PTS_REF ldp_n_32__maf_max_diag_sa MAX_GRAD 100 MONOTONY MON_INCREASE /end AXIS_DESCR
/end CHARACTERISTIC
/begin CHARACTERISTIC ip_maf_max_isa__pq_turb_sys "IP_MAF_MAX_ISA" CURVE 0x7a9b4 a_3 100 LINEAR______0_000000__0H___16383 0.0 16383.75
 /begin AXIS_DESCR COM_AXIS pq_turb_sys LINEAR______0_000000__0H___0_996 6 0.0 0.99609375 AXIS_PTS_REF ldpm_pq_turb_sys_1 MAX_GRAD 100 MONOTONY MON_INCREASE /end AXIS_DESCR
/end CHARACTERISTIC
/begin CHARACTERISTIC ip_maf_max_isa_mon "IP_MAF_MAX_ISA_MON" CURVE 0x7e8d2 a_3 100 LINEAR______0_000000__0H___16383 0.0 16383.75
 /begin AXIS_DESCR COM_AXIS pq_turb_sys LINEAR______0_000000__0H___0_996 6 0.0 0.99609375 AXIS_PTS_REF ldp_pq_turb_sys_mon__fac_pq_isa MAX_GRAD 100 MONOTONY MON_INCREASE /end AXIS_DESCR
/end CHARACTERISTIC
/begin CHARACTERISTIC ip_maf_min_cop__n__iga_dif "IP_MAF_MIN_COP" MAP 0x7783a a_6 10 LINEAR______0_000000__0H___1389_ 0.0 1389.0
 /begin AXIS_DESCR COM_AXIS dummy_b LINEAR______0_000000__0H___95_22 6 0.0 95.625 AXIS_PTS_REF ldp_iga_dif__maf_min_cop MAX_GRAD 100 MONOTONY MON_INCREASE /end AXIS_DESCR
 /begin AXIS_DESCR COM_AXIS n LINEAR______0_000000__0H___8160_ 10 0.0 8160.0 AXIS_PTS_REF ldpm_n_32_4 MAX_GRAD 100 MONOTONY MON_INCREASE /end AXIS_DESCR
/end CHARACTERISTIC
/begin CHARACTERISTIC ip_maf_min_cop_ron__n__iga_dif "IP_MAF_MIN_COP_RON" MAP 0x77876 a_6 10 LINEAR______0_000000__0H___1389_ 0.0 1389.0
 /begin AXIS_DESCR COM_AXIS dummy_b LINEAR______0_000000__0H___95_22 6 0.0 95.625 AXIS_PTS_REF ldp_iga_dif__maf_min_cop_ron MAX_GRAD 100 MONOTONY MON_INCREASE /end AXIS_DESCR
 /begin AXIS_DESCR COM_AXIS n LINEAR______0_000000__0H___8160_ 10 0.0 8160.0 AXIS_PTS_REF ldpm_n_32_4 MAX_GRAD 100 MONOTONY MON_INCREASE /end AXIS_DESCR
/end CHARACTERISTIC
/begin CHARACTERISTIC ip_maf_min_cyl_lam__n "IP_MAF_MIN_CYL_LAM" CURVE 0x778b2 a_7 100 LINEAR______0_000000__0H___1389_ 0.0 1389.0
 /begin AXIS_DESCR COM_AXIS n LINEAR______0_000000__0H___81612 6 0.0 8160.0 AXIS_PTS_REF ldpm_n_15 MAX_GRAD 100 MONOTONY MON_INCREASE /end AXIS_DESCR
 FUNCTION_LIST CSCM /end CHARACTERISTIC
/begin CHARACTERISTIC ip_maf_min_cyl_lam_ad__n "IP_MAF_MIN_CYL_LAM_AD" CURVE 0x778b8 a_7 100 LINEAR______0_000000__0H___1389_ 0.0 1389.0
 /begin AXIS_DESCR COM_AXIS n LINEAR______0_000000__0H___81612 6 0.0 8160.0 AXIS_PTS_REF ldpm_n_15 MAX_GRAD 100 MONOTONY MON_INCREASE /end AXIS_DESCR
 FUNCTION_LIST CSCM /end CHARACTERISTIC
/begin CHARACTERISTIC ip_maf_min_diag_sa__fac_amp "IP_MAF_MIN_DIAG_SA" CURVE 0x778be a_7 10 LINEAR______0_000000__0H___1389_ 0.0 1389.0
 /begin AXIS_DESCR COM_AXIS fac_amp LINEAR______0_000000__0H___2_054 6 0.0 2.0 AXIS_PTS_REF ldpm_fac_amp_1 MAX_GRAD 10 MONOTONY MON_INCREASE /end AXIS_DESCR
/end CHARACTERISTIC
/begin CHARACTERISTIC ip_maf_min_er__n_32 "IP_MAF_MIN_ER" CURVE 0x778c4 a_1 5 LINEAR______0_000000__0H___1389_ 0.0 1389.0
 /begin AXIS_DESCR COM_AXIS n LINEAR______0_000000__0H___8160_ 6 0.0 8160.0 AXIS_PTS_REF ldp_n_32__maf_min_er MAX_GRAD 100 MONOTONY MON_INCREASE /end AXIS_DESCR
/end CHARACTERISTIC
/begin CHARACTERISTIC ip_maf_min_knk__n__tco "IP_MAF_MIN_KNK" MAP 0x778ca a_6 100 LINEAR______0_000000__0H___1389_ 0.0 1389.0
 /begin AXIS_DESCR COM_AXIS tco LINEAR_______48_000000__0H___142 4 -48.0 142.5 AXIS_PTS_REF ldpm_tco_24 MAX_GRAD 100 MONOTONY MON_INCREASE /end AXIS_DESCR
 /begin AXIS_DESCR COM_AXIS n LINEAR______0_000000__0H___8160_ 8 0.0 8160.0 AXIS_PTS_REF ldpm_n_32_12 MAX_GRAD 100 MONOTONY MON_INCREASE /end AXIS_DESCR
/end CHARACTERISTIC
/begin CHARACTERISTIC ip_maf_min_knk_ron__n__tco "IP_MAF_MIN_KNK_RON" MAP 0x778ea a_6 100 LINEAR______0_000000__0H___1389_ 0.0 1389.0
 /begin AXIS_DESCR COM_AXIS tco LINEAR_______48_000000__0H___142 4 -48.0 142.5 AXIS_PTS_REF ldpm_tco_24 MAX_GRAD 100 MONOTONY MON_INCREASE /end AXIS_DESCR
 /begin AXIS_DESCR COM_AXIS n LINEAR______0_000000__0H___8160_ 8 0.0 8160.0 AXIS_PTS_REF ldpm_n_32_12 MAX_GRAD 100 MONOTONY MON_INCREASE /end AXIS_DESCR
/end CHARACTERISTIC
/begin CHARACTERISTIC ip_maf_mmv_pu__n "IP_MAF_MMV_PU" CURVE 0x7790a a_1 14 LINEAR______0_000000__0H___1389_ 0.0 1389.0
 /begin AXIS_DESCR COM_AXIS n LINEAR______0_000000__0H___8160_ 6 0.0 8160.0 AXIS_PTS_REF ldp_n_32__maf_mmv_pu MAX_GRAD 100 MONOTONY MON_INCREASE /end AXIS_DESCR
/end CHARACTERISTIC
/begin CHARACTERISTIC ip_maf_sub_mmv_thd_mon "IP_MAF_SUB_MMV_THD_MON" CURVE 0x7e77a a_1 10 LINEAR______0_000000__0H___1389_ 0.0 1389.0
 /begin AXIS_DESCR COM_AXIS dummy_b LINEAR______0_000000__0H___1389_ 2 0.0 1389.0 AXIS_PTS_REF ldp_maf_sub__maf_sub_mmv_thd_mon MAX_GRAD 100 MONOTONY MON_INCREASE /end AXIS_DESCR
/end CHARACTERISTIC
/begin CHARACTERISTIC ip_maf_sub_mon "IP_MAF_SUB_MON" MAP 0x7e77c a_6 10 LINEAR______0_000000__0H___1389_ 0.0 1389.0
 /begin AXIS_DESCR COM_AXIS tps_av_mon LINEAR______0_000000__0H___11942 8 0.0 119.53125 AXIS_PTS_REF ldp_tps_av_mon__maf_sub_mon MAX_GRAD 100 MONOTONY MON_INCREASE /end AXIS_DESCR
 /begin AXIS_DESCR COM_AXIS maf_sub_mon LINEAR______0_000000__0H___8160_ 8 0.0 8160.0 AXIS_PTS_REF ldp_n_32_mon__maf_sub_mon MAX_GRAD 100 MONOTONY MON_INCREASE /end AXIS_DESCR
/end CHARACTERISTIC
/begin CHARACTERISTIC ip_maf_tco_cor__tco "IP_MAF_TCO_COR" CURVE 0x77910 a_1 100 LINEAR______0_000000__0H___1_992 0.0 1.9921875
 /begin AXIS_DESCR COM_AXIS tco LINEAR_______48_000000__0H___142 8 -48.0 142.5 AXIS_PTS_REF ldpm_tco_10 MAX_GRAD 100 MONOTONY MON_INCREASE /end AXIS_DESCR
/end CHARACTERISTIC
/begin CHARACTERISTIC ip_maf_ti_ad_max__n "IP_MAF_TI_AD_MAX" CURVE 0x77918 a_1 100 LINEAR______0_000000__0H___1389_ 0.0 1389.0
 /begin AXIS_DESCR COM_AXIS n_32 LINEAR______0_000000__0H___8160_ 6 0.0 8160.0 AXIS_PTS_REF ldpm_n_32_30 MAX_GRAD 100 MONOTONY MON_INCREASE /end AXIS_DESCR
/end CHARACTERISTIC
/begin CHARACTERISTIC ip_maf_ti_ad_min__n "IP_MAF_TI_AD_MIN" CURVE 0x7791e a_1 100 LINEAR______0_000000__0H___1389_ 0.0 1389.0
 /begin AXIS_DESCR COM_AXIS n_32 LINEAR______0_000000__0H___8160_ 6 0.0 8160.0 AXIS_PTS_REF ldpm_n_32_30 MAX_GRAD 100 MONOTONY MON_INCREASE /end AXIS_DESCR
/end CHARACTERISTIC
/begin CHARACTERISTIC ip_maf_vo_1__map__n "IP_MAF_VO_1" MAP 0x7a9c0 a_36 100 LINEAR______0_000000__0H___13818 0.0 1389.0
 /begin AXIS_DESCR COM_AXIS n LINEAR______0_000000__0H___8160_ 12 0.0 8160.0 AXIS_PTS_REF ldpm_n_32_10 MAX_GRAD 100 MONOTONY MON_INCREASE /end AXIS_DESCR
 /begin AXIS_DESCR COM_AXIS map LINEAR______0_000000__0H___5434_ 8 0.0 5434.2598 AXIS_PTS_REF ldpm_map_1 MAX_GRAD 100 MONOTONY MON_INCREASE /end AXIS_DESCR
/end CHARACTERISTIC
/begin CHARACTERISTIC ip_maf_vo_2__map__n "IP_MAF_VO_2" MAP 0x7aa80 a_36 100 LINEAR______0_000000__0H___13818 0.0 1389.0
 /begin AXIS_DESCR COM_AXIS n LINEAR______0_000000__0H___8160_ 12 0.0 8160.0 AXIS_PTS_REF ldpm_n_32_10 MAX_GRAD 100 MONOTONY MON_INCREASE /end AXIS_DESCR
 /begin AXIS_DESCR COM_AXIS map LINEAR______0_000000__0H___5434_ 8 0.0 5434.2598 AXIS_PTS_REF ldpm_map_1 MAX_GRAD 100 MONOTONY MON_INCREASE /end AXIS_DESCR
/end CHARACTERISTIC
/begin CHARACTERISTIC ip_maf_vo_3__map__n "IP_MAF_VO_3" MAP 0x7ab40 a_36 100 LINEAR______0_000000__0H___13818 0.0 1389.0
 /begin AXIS_DESCR COM_AXIS n LINEAR______0_000000__0H___8160_ 12 0.0 8160.0 AXIS_PTS_REF ldpm_n_32_10 MAX_GRAD 100 MONOTONY MON_INCREASE /end AXIS_DESCR
 /begin AXIS_DESCR COM_AXIS map LINEAR______0_000000__0H___5434_ 8 0.0 5434.2598 AXIS_PTS_REF ldpm_map_1 MAX_GRAD 100 MONOTONY MON_INCREASE /end AXIS_DESCR
/end CHARACTERISTIC
/begin CHARACTERISTIC ip_maf_vo_4__map__n "IP_MAF_VO_4" MAP 0x7ac00 a_36 100 LINEAR______0_000000__0H___13818 0.0 1389.0
 /begin AXIS_DESCR COM_AXIS n LINEAR______0_000000__0H___8160_ 12 0.0 8160.0 AXIS_PTS_REF ldpm_n_32_10 MAX_GRAD 100 MONOTONY MON_INCREASE /end AXIS_DESCR
 /begin AXIS_DESCR COM_AXIS map LINEAR______0_000000__0H___5434_ 8 0.0 5434.2598 AXIS_PTS_REF ldpm_map_1 MAX_GRAD 100 MONOTONY MON_INCREASE /end AXIS_DESCR
/end CHARACTERISTIC
/begin CHARACTERISTIC ip_maf_vo_5__map__n "IP_MAF_VO_5" MAP 0x7acc0 a_36 100 LINEAR______0_000000__0H___13818 0.0 1389.0
 /begin AXIS_DESCR COM_AXIS n LINEAR______0_000000__0H___8160_ 12 0.0 8160.0 AXIS_PTS_REF ldpm_n_32_10 MAX_GRAD 100 MONOTONY MON_INCREASE /end AXIS_DESCR
 /begin AXIS_DESCR COM_AXIS map LINEAR______0_000000__0H___5434_ 8 0.0 5434.2598 AXIS_PTS_REF ldpm_map_1 MAX_GRAD 100 MONOTONY MON_INCREASE /end AXIS_DESCR
/end CHARACTERISTIC
/begin CHARACTERISTIC ip_maf_vo_6__map__n "IP_MAF_VO_6" MAP 0x7ad80 a_36 100 LINEAR______0_000000__0H___13818 0.0 1389.0
 /begin AXIS_DESCR COM_AXIS n LINEAR______0_000000__0H___8160_ 12 0.0 8160.0 AXIS_PTS_REF ldpm_n_32_10 MAX_GRAD 100 MONOTONY MON_INCREASE /end AXIS_DESCR
 /begin AXIS_DESCR COM_AXIS map LINEAR______0_000000__0H___5434_ 8 0.0 5434.2598 AXIS_PTS_REF ldpm_map_1 MAX_GRAD 100 MONOTONY MON_INCREASE /end AXIS_DESCR
/end CHARACTERISTIC
/begin CHARACTERISTIC ip_maf_vo_7__map__n "IP_MAF_VO_7" MAP 0x7ae40 a_36 100 LINEAR______0_000000__0H___13818 0.0 1389.0
 /begin AXIS_DESCR COM_AXIS n LINEAR______0_000000__0H___8160_ 12 0.0 8160.0 AXIS_PTS_REF ldpm_n_32_10 MAX_GRAD 100 MONOTONY MON_INCREASE /end AXIS_DESCR
 /begin AXIS_DESCR COM_AXIS map LINEAR______0_000000__0H___5434_ 8 0.0 5434.2598 AXIS_PTS_REF ldpm_map_1 MAX_GRAD 100 MONOTONY MON_INCREASE /end AXIS_DESCR
/end CHARACTERISTIC
/begin CHARACTERISTIC ip_maf_vo_8__map__n "IP_MAF_VO_8" MAP 0x7af00 a_36 100 LINEAR______0_000000__0H___13818 0.0 1389.0
 /begin AXIS_DESCR COM_AXIS n LINEAR______0_000000__0H___8160_ 12 0.0 8160.0 AXIS_PTS_REF ldpm_n_32_10 MAX_GRAD 100 MONOTONY MON_INCREASE /end AXIS_DESCR
 /begin AXIS_DESCR COM_AXIS map LINEAR______0_000000__0H___5434_ 8 0.0 5434.2598 AXIS_PTS_REF ldpm_map_1 MAX_GRAD 100 MONOTONY MON_INCREASE /end AXIS_DESCR
/end CHARACTERISTIC
/begin CHARACTERISTIC ip_map_grd_max_pos_er__map "IP_MAP_GRD_MAX_POS_ER" CURVE 0x7afc0 a_24 100 LINEAR______0_000000__0H___54355 0.0 5434.1768
 /begin AXIS_DESCR COM_AXIS map LINEAR______0_000000__0H___5434_ 6 0.0 5434.2598 AXIS_PTS_REF ldp_map__map_grd_max_pos_er MAX_GRAD 100 MONOTONY MON_INCREASE /end AXIS_DESCR
/end CHARACTERISTIC
/begin CHARACTERISTIC ip_map_grd_min_neg_er__map "IP_MAP_GRD_MIN_NEG_ER" CURVE 0x7afcc a_24 100 LINEAR_______5434_259766__8000H_ -5434.2598 -0.165843
 /begin AXIS_DESCR COM_AXIS map LINEAR______0_000000__0H___5434_ 6 0.0 5434.2598 AXIS_PTS_REF ldp_map__map_grd_min_neg_er MAX_GRAD 100 MONOTONY MON_INCREASE /end AXIS_DESCR
/end CHARACTERISTIC
/begin CHARACTERISTIC ip_map_ini_ast__tco "IP_MAP_INI_AST" CURVE 0x7afd8 a_3 100 LINEAR______0_000000__0H___5434_ 0.0 5434.2598
 /begin AXIS_DESCR COM_AXIS tco LINEAR_______48_000000__0H___142 4 -48.0 142.5 AXIS_PTS_REF ldp_tco__map_ini_ast MAX_GRAD 100 MONOTONY MON_INCREASE /end AXIS_DESCR
/end CHARACTERISTIC
/begin CHARACTERISTIC ip_mis_a_fac__n__maf "IP_MIS_A_FAC" MAP 0x77924 a_6 5 LINEAR______0_000000__0H___10056 0.0 100.0
 /begin AXIS_DESCR COM_AXIS maf LINEAR______0_000000__0H___1389_ 6 0.0 1389.0 AXIS_PTS_REF ldp_maf__mis_a_fac MAX_GRAD 100 MONOTONY MON_INCREASE /end AXIS_DESCR
 /begin AXIS_DESCR COM_AXIS n LINEAR______0_000000__0H___8160_ 6 0.0 8160.0 AXIS_PTS_REF ldp_n_32__mis_a_fac MAX_GRAD 100 MONOTONY MON_INCREASE /end AXIS_DESCR
/end CHARACTERISTIC
/begin CHARACTERISTIC ip_mis_fac_thd_iv_er__n_32 "IP_MIS_FAC_THD_IV_ER" CURVE 0x7afe0 a_3 100 LINEAR______0_000000__0H___0_999 0.0 0.99998474
 /begin AXIS_DESCR COM_AXIS n_32 LINEAR______0_000000__0H___8160_ 6 0.0 8160.0 AXIS_PTS_REF ldp_n_32__mis_fac_thd_iv_er MAX_GRAD 100 MONOTONY MON_INCREASE /end AXIS_DESCR
/end CHARACTERISTIC
/begin CHARACTERISTIC ip_mtcpwm_add__tps_sp_lih_dif "IP_MTCPWM_ADD" CURVE 0x7afec a_24 100 LINEAR_______100_000000__0H___99 -100.0 99.996948
 /begin AXIS_DESCR COM_AXIS tps_sp_lih_dif LINEAR_______119_500000__0H___11 12 -119.5 119.5 AXIS_PTS_REF ldp_tps_sp_lih_dif__mtcpwm_add MAX_GRAD 100 MONOTONY MON_INCREASE /end AXIS_DESCR
/end CHARACTERISTIC
/begin CHARACTERISTIC ip_mtcpwm_add_neg__tps_lih_dif "IP_MTCPWM_ADD_NEG" CURVE 0x7b004 a_24 100 LINEAR_______100_000000__0H___99 -100.0 99.996948
 /begin AXIS_DESCR COM_AXIS tps_lih_dif LINEAR_______119_500000__0H___11 12 -119.5 119.5 AXIS_PTS_REF ldpm_tps_lih_dif_mtcpwm_add MAX_GRAD 100 MONOTONY MON_INCREASE /end AXIS_DESCR
/end CHARACTERISTIC
/begin CHARACTERISTIC ip_mtcpwm_d__tps_dif_grd "IP_MTCPWM_D" CURVE 0x7b01c a_24 100 LINEAR_______400_000000__0H___39 -400.0 399.98779
 /begin AXIS_DESCR COM_AXIS tps_dif_grd LINEAR_______119_500000__0H___11 8 -119.5 119.5 AXIS_PTS_REF ldp_tps_dif_grd_mtcpwm_d MAX_GRAD 100 MONOTONY MON_INCREASE /end AXIS_DESCR
/end CHARACTERISTIC
/begin CHARACTERISTIC ip_mtcpwm_i__tps_dif "IP_MTCPWM_I" CURVE 0x7b02c a_24 100 LINEAR_______100_000000__0H___57 -100.0 99.996948
 /begin AXIS_DESCR COM_AXIS tps_dif LINEAR_______119_500000__0H___11 8 -119.5 119.5 AXIS_PTS_REF ldp_tps_dif_mtcpwm_i MAX_GRAD 100 MONOTONY MON_INCREASE /end AXIS_DESCR
/end CHARACTERISTIC
/begin CHARACTERISTIC ip_mtcpwm_i_fac__tps_av_lih_dif "IP_MTCPWM_I_FAC" CURVE 0x77948 a_7 100 LINEAR______0_000000__0H___7_935 0.0 7.9679999
 /begin AXIS_DESCR COM_AXIS tps_av_lih_dif LINEAR_______119_500000__0H___11 8 -119.5 119.5 AXIS_PTS_REF ldp_tps_av_lih_dif__mtcpwm_i_fac MAX_GRAD 100 MONOTONY MON_INCREASE /end AXIS_DESCR
/end CHARACTERISTIC
/begin CHARACTERISTIC ip_mtcpwm_p__tps_dif "IP_MTCPWM_P" CURVE 0x7b03c a_24 100 LINEAR_______400_000000__0H___39 -400.0 399.98779
 /begin AXIS_DESCR COM_AXIS tps_dif LINEAR_______119_500000__0H___58 8 -119.5 119.5 AXIS_PTS_REF ldp_tps_dif_mtcpwm_p MAX_GRAD 100 MONOTONY MON_INCREASE /end AXIS_DESCR
/end CHARACTERISTIC
/begin CHARACTERISTIC ip_mtcpwm_vb_fac__vb "IP_MTCPWM_VB_FAC" CURVE 0x77950 a_1 100 LINEAR______0_000000__0H___1_992 0.0 1.9921875
 /begin AXIS_DESCR COM_AXIS vb LINEAR______0_000000__0H___26_00 8 0.0 26.0 AXIS_PTS_REF ldp_vb_mtcpwm_vb_fac MAX_GRAD 100 MONOTONY MON_INCREASE /end AXIS_DESCR
/end CHARACTERISTIC
/begin CHARACTERISTIC ip_n_ecf__tco_ex "IP_N_ECF" CURVE 0x77958 a_1 100 LINEAR______0_000000__0H___15_94 0.0 15.94
 /begin AXIS_DESCR COM_AXIS tco_ex LINEAR_______48_000000__0H___142 6 -48.0 142.5 AXIS_PTS_REF ldp_tco_ex__n_ecf MAX_GRAD 100 MONOTONY MON_INCREASE /end AXIS_DESCR
/end CHARACTERISTIC
/begin CHARACTERISTIC ip_n_ecf_temp_cat__temp_cat "IP_N_ECF_TEMP_CAT" CURVE 0x7795e a_1 100 LINEAR______0_000000__0H___15_94 0.0 15.94
 /begin AXIS_DESCR COM_AXIS temp_mmv_sub_cat LINEAR_______33_000000__0H___987 6 -33.0 987.0 AXIS_PTS_REF ldpm_temp_mmv_sub_cat_1 MAX_GRAD 100 MONOTONY MON_INCREASE /end AXIS_DESCR
/end CHARACTERISTIC
/begin CHARACTERISTIC ip_n_ecf_vs_cor__vs "IP_N_ECF_VS_COR" CURVE 0x77964 a_1 100 LINEAR______0_000000__0H___0_996 0.0 0.99609375
 /begin AXIS_DESCR COM_AXIS vs LINEAR______0_000000__0H___25511 5 0.0 255.0 AXIS_PTS_REF ldp_vs__n_ecf_vs_cor MAX_GRAD 100 MONOTONY MON_INCREASE /end AXIS_DESCR
/end CHARACTERISTIC
/begin CHARACTERISTIC ip_n_max_diag__pvs_av "IP_N_MAX_DIAG" CURVE 0x77969 a_1 10 LINEAR______0_000000__0H___8160_ 0.0 8160.0
 /begin AXIS_DESCR COM_AXIS pvs_av LINEAR______0_000000__0H___11913 3 0.0 119.5 AXIS_PTS_REF ldpm_pvs_av_3 MAX_GRAD 100 MONOTONY MON_INCREASE /end AXIS_DESCR
/end CHARACTERISTIC
/begin CHARACTERISTIC ip_n_max_inf__tco "IP_N_MAX_INF" CURVE 0x7796c a_1 100 LINEAR______0_000000__0H___8160_ 0.0 8160.0
 /begin AXIS_DESCR COM_AXIS tco LINEAR_______48_000000__0H___142 3 -48.0 142.5 AXIS_PTS_REF ldp_tco__n_max_inf MAX_GRAD 100 MONOTONY MON_INCREASE /end AXIS_DESCR
/end CHARACTERISTIC
/begin CHARACTERISTIC ip_n_max_mtc_cur_off__pvs_av "IP_N_MAX_MTC_CUR_OFF" CURVE 0x7796f a_7 100 LINEAR______0_000000__0H___8160_ 0.0 8160.0
 /begin AXIS_DESCR COM_AXIS pvs_av LINEAR______0_000000__0H___119_9 2 0.0 119.99817 AXIS_PTS_REF ldp_pvs_av__n_max_mtc_cur_off MAX_GRAD 100 MONOTONY MON_INCREASE /end AXIS_DESCR
/end CHARACTERISTIC
/begin CHARACTERISTIC ip_n_max_tol_st__tco "IP_N_MAX_TOL_ST" CURVE 0x77971 a_1 10 LINEAR______0_000000__0H___8160_ 0.0 8160.0
 /begin AXIS_DESCR COM_AXIS tco LINEAR_______48_000000__0H___142 4 -48.0 142.5 AXIS_PTS_REF ldpm_tco_8 MAX_GRAD 100 MONOTONY MON_INCREASE /end AXIS_DESCR
/end CHARACTERISTIC
/begin CHARACTERISTIC ip_n_min_accin_puc__tco "IP_N_MIN_ACCIN_PUC" CURVE 0x77975 a_1 100 LINEAR______0_000000__0H___8160_ 0.0 8160.0
 /begin AXIS_DESCR COM_AXIS tco LINEAR_______48_000000__0H___142 6 -48.0 142.5 AXIS_PTS_REF ldpm_tco_4 MAX_GRAD 100 MONOTONY MON_INCREASE /end AXIS_DESCR
/end CHARACTERISTIC
/begin CHARACTERISTIC ip_n_min_diag_sa__fac_amp "IP_N_MIN_DIAG_SA" CURVE 0x7797b a_7 10 LINEAR______0_000000__0H___8160_ 0.0 8160.0
 /begin AXIS_DESCR COM_AXIS fac_amp LINEAR______0_000000__0H___2_054 6 0.0 2.0 AXIS_PTS_REF ldpm_fac_amp_1 MAX_GRAD 10 MONOTONY MON_INCREASE /end AXIS_DESCR
/end CHARACTERISTIC
/begin CHARACTERISTIC ip_n_min_dif_er__tco__cycnr "IP_N_MIN_DIF_ER__TCO__CYCNR" MAP 0x7b04c a_9 100 LINEAR______0_000000__0H___81612 0.0 8160.0
 /begin AXIS_DESCR COM_AXIS dummy_b LINEAR______0_000000__0H___255_4 8 0.0 255.0 AXIS_PTS_REF ldp_cycnr__n_min_dif_er MAX_GRAD 100 MONOTONY MON_INCREASE /end AXIS_DESCR
 /begin AXIS_DESCR COM_AXIS tco LINEAR_______48_000000__0H___142 8 -48.0 142.5 AXIS_PTS_REF ldp_tco__n_min_dif_er MAX_GRAD 100 MONOTONY MON_INCREASE /end AXIS_DESCR
/end CHARACTERISTIC
/begin CHARACTERISTIC ip_n_min_puc__tco "IP_N_MIN_PUC" CURVE 0x77981 a_1 100 LINEAR______0_000000__0H___8160_ 0.0 8160.0
 /begin AXIS_DESCR COM_AXIS tco LINEAR_______48_000000__0H___142 6 -48.0 142.5 AXIS_PTS_REF ldpm_tco_4 MAX_GRAD 100 MONOTONY MON_INCREASE /end AXIS_DESCR
/end CHARACTERISTIC
/begin CHARACTERISTIC ip_n_perc_ecf__n_ecf_cor_fil "IP_N_PERC_ECF" CURVE 0x77987 a_1 100 LINEAR______0_000000__0H___99_60 0.0 99.609375
 /begin AXIS_DESCR COM_AXIS n_ecf_cor_fil LINEAR______0_000000__0H___15_94 6 0.0 15.94 AXIS_PTS_REF ldp_n_ecf_cor_fil__n_perc_ecf MAX_GRAD 100 MONOTONY MON_INCREASE /end AXIS_DESCR
/end CHARACTERISTIC
/begin CHARACTERISTIC ip_n_sp_add_ch_2__tco_st__km_ctr "IP_N_SP_ADD_CH_2" MAP 0x7b0cc a_50 100 LINEAR______0_000000__0H___10059 0.0 1000.0
 /begin AXIS_DESCR COM_AXIS km_ctr LINEAR______0_000000__0H___65534 4 0.0 655340.0 AXIS_PTS_REF ldpm_km_ctr_1 MAX_GRAD 100 MONOTONY MON_INCREASE /end AXIS_DESCR
 /begin AXIS_DESCR COM_AXIS tco_st LINEAR_______48_000000__0H___142 8 -48.0 142.5 AXIS_PTS_REF ldpm_tco_st_3 MAX_GRAD 100 MONOTONY MON_INCREASE /end AXIS_DESCR
/end CHARACTERISTIC
/begin CHARACTERISTIC ip_n_sp_add_cs__toil "IP_N_SP_ADD_CS" CURVE 0x7b118 a_3 100 LINEAR______0_000000__0H___10059 0.0 1000.0
 /begin AXIS_DESCR COM_AXIS toil LINEAR_______48_000000__0H___155 6 -48.0 155.0 AXIS_PTS_REF ldpm_toil_6 MAX_GRAD 100 MONOTONY MON_INCREASE /end AXIS_DESCR
/end CHARACTERISTIC
/begin CHARACTERISTIC ip_n_sp_add_cs_amt__toil "IP_N_SP_ADD_CS_AMT" CURVE 0x7b124 a_3 100 LINEAR______0_000000__0H___10059 0.0 1000.0
 /begin AXIS_DESCR COM_AXIS toil LINEAR_______48_000000__0H___155 6 -48.0 155.0 AXIS_PTS_REF ldpm_toil_6 MAX_GRAD 100 MONOTONY MON_INCREASE /end AXIS_DESCR
/end CHARACTERISTIC
/begin CHARACTERISTIC ip_n_sp_add_heat__tco "IP_N_SP_ADD_HEAT" CURVE 0x7b130 a_3 100 LINEAR______0_000000__0H___1000_ 0.0 1000.0
 /begin AXIS_DESCR COM_AXIS tco LINEAR_______48_000000__0H___142 6 -48.0 142.5 AXIS_PTS_REF ldpm_tco_4 MAX_GRAD 100 MONOTONY MON_INCREASE /end AXIS_DESCR
/end CHARACTERISTIC
/begin CHARACTERISTIC ip_n_sp_add_pste__ang_pste__toil "IP_N_SP_ADD_PSTE" MAP 0x7b13c a_36 100 LINEAR______0_000000__0H___10059 0.0 1000.0
 /begin AXIS_DESCR COM_AXIS toil LINEAR_______48_000000__0H___155 4 -48.0 155.0 AXIS_PTS_REF ldp_toil__n_sp_add_pste MAX_GRAD 100 MONOTONY MON_INCREASE /end AXIS_DESCR
 /begin AXIS_DESCR COM_AXIS ang_pste LINEAR_______1439_956055__0H___1 6 -1439.9561 1439.9121 AXIS_PTS_REF ldp_ang_pste__n_sp_add_pste MAX_GRAD 100 MONOTONY MON_INCREASE /end AXIS_DESCR
/end CHARACTERISTIC
/begin CHARACTERISTIC ip_n_sp_is__tco "IP_N_SP_IS" CURVE 0x7b16c a_3 3 LINEAR______0_000000__0H___81605 0.0 8160.0
 /begin AXIS_DESCR COM_AXIS tco LINEAR_______48_000000__0H___142 6 -48.0 142.5 AXIS_PTS_REF ldpm_tco_4 MAX_GRAD 100 MONOTONY MON_INCREASE /end AXIS_DESCR
/end CHARACTERISTIC
/begin CHARACTERISTIC ip_n_sp_lgrd_ch_2__tco "IP_N_SP_LGRD_CH_2" CURVE 0x7798d a_1 10 LINEAR______0_031250__1H___7_968 0.03125 7.96875
 /begin AXIS_DESCR COM_AXIS tco LINEAR_______48_000000__0H___142 8 -48.0 142.5 AXIS_PTS_REF ldp_tco__n_sp_lgrd_ch_2 MAX_GRAD 100 MONOTONY MON_INCREASE /end AXIS_DESCR
/end CHARACTERISTIC
/begin CHARACTERISTIC ip_n_vim_tia__tia "IP_N_VIM_TIA" CURVE 0x7b178 a_3 10 LINEAR_______1024_000000__0H___1 -1024.0 1024.0
 /begin AXIS_DESCR COM_AXIS tia LINEAR_______48_000000__0H___142 8 -48.0 142.5 AXIS_PTS_REF ldp_tia__n_vim_tia MAX_GRAD 100 MONOTONY MON_INCREASE /end AXIS_DESCR
/end CHARACTERISTIC
/begin CHARACTERISTIC ip_nl_sp__n "IP_NL_SP" CURVE 0x77995 a_1 5 LINEAR______0_000000__0H___5_100 0.0 5.0999999
 /begin AXIS_DESCR COM_AXIS n LINEAR______0_000000__0H___8160_ 8 0.0 8160.0 AXIS_PTS_REF ldpm_n_32_12 MAX_GRAD 100 MONOTONY MON_INCREASE /end AXIS_DESCR
/end CHARACTERISTIC
/begin CHARACTERISTIC ip_nr_ip_maf__vo "IP_NR_IP_MAF" CURVE 0x7b188 a_24 100 LINEAR______1_000000__100H___8_0 1.0 8.0
 /begin AXIS_DESCR COM_AXIS vo LINEAR______0_000000__0H___120_0 8 0.0 120.0 AXIS_PTS_REF ldp_vo__nr_ip_maf MAX_GRAD 100 MONOTONY MON_INCREASE /end AXIS_DESCR
/end CHARACTERISTIC
/begin CHARACTERISTIC ip_nr_ti_cop__iga_dif "IP_NR_TI_COP" CURVE 0x7b198 a_3 10 LINEAR______1_000000__100H___5_0 1.0 5.0
 /begin AXIS_DESCR COM_AXIS dummy_b LINEAR______0_000000__0H___95_22 5 0.0 95.625 AXIS_PTS_REF ldp_iga_dif__nr_ti_cop MAX_GRAD 100 MONOTONY MON_INCREASE /end AXIS_DESCR
/end CHARACTERISTIC
/begin CHARACTERISTIC ip_o2_cat_1__vls_down_1 "IP_O2_CAT_1" CURVE 0x7799d a_1 100 LINEAR______0_000000__0H___0_996 0.0 0.99609375
 /begin AXIS_DESCR COM_AXIS dummy_b LINEAR______0_000000__0H___1_275 6 0.0 1.275 AXIS_PTS_REF ldpm_vls_down_1 MAX_GRAD 100 MONOTONY MON_INCREASE /end AXIS_DESCR
/end CHARACTERISTIC
/begin CHARACTERISTIC ip_o2_cat_2__vls_down_2 "IP_O2_CAT_2" CURVE 0x779a3 a_1 100 LINEAR______0_000000__0H___0_996 0.0 0.99609375
 /begin AXIS_DESCR COM_AXIS dummy_b LINEAR______0_000000__0H___1_275 6 0.0 1.275 AXIS_PTS_REF ldpm_vls_down_1 MAX_GRAD 100 MONOTONY MON_INCREASE /end AXIS_DESCR
/end CHARACTERISTIC
/begin CHARACTERISTIC ip_pgas_h "IP_PGAS_H" CURVE 0x779af a_1 100 LINEAR______0_000000__0H___21675 0.0 216750.0
 /begin AXIS_DESCR COM_AXIS dummy_b LINEAR______0_000000__0H___4_980 8 0.0 4.9804688 AXIS_PTS_REF ldp_v_pgas_h__pgas_h MAX_GRAD 100 MONOTONY MON_INCREASE /end AXIS_DESCR
 FUNCTION_LIST CNG /end CHARACTERISTIC
/begin CHARACTERISTIC ip_pgas_l "PGAS_L" CURVE 0x7b1a2 a_24 100 LINEAR______0_000000__0H___16338 0.0 16383.75
 /begin AXIS_DESCR COM_AXIS dummy_w LINEAR______0_000000__0H___4_995 8 0.0 4.9951172 AXIS_PTS_REF ldp_v_pgas_l__pgas_l MAX_GRAD 100 MONOTONY MON_INCREASE /end AXIS_DESCR
 FUNCTION_LIST CNG /end CHARACTERISTIC
/begin CHARACTERISTIC ip_pow_loss_ecf__ecfpwm_ecf "IP_POW_LOSS_ECF" CURVE 0x779b7 a_1 100 LINEAR______0_000000__0H___5100_ 0.0 5100.0
 /begin AXIS_DESCR COM_AXIS ecfpwm_ecf LINEAR______0_000000__0H___99_60 6 0.0 99.609375 AXIS_PTS_REF ldp_ecfpwm_ecf__pow_loss_ecf MAX_GRAD 100 MONOTONY MON_INCREASE /end AXIS_DESCR
/end CHARACTERISTIC
/begin CHARACTERISTIC ip_pq_main_col_tq__n__tps_sum "IP_PQ_MAIN_COL_TQ" MAP 0x779bd a_31 100 LINEAR______0_000000__0H___0_996 0.0 0.99609375
 /begin AXIS_DESCR COM_AXIS dummy_b LINEAR______0_000000__0H___119_9 8 0.0 119.99817 AXIS_PTS_REF ldp_mtc_sum__pq_main_col_tq MAX_GRAD 100 MONOTONY MON_INCREASE /end AXIS_DESCR
 /begin AXIS_DESCR COM_AXIS n_32 LINEAR______0_000000__0H___8160_ 8 0.0 8160.0 AXIS_PTS_REF ldp_n_32__pq_main_col_tq MAX_GRAD 100 MONOTONY MON_INCREASE /end AXIS_DESCR
/end CHARACTERISTIC
/begin CHARACTERISTIC ip_pq_main_col_tq_mon "IP_PQ_MAIN_COL_TQ_MON" MAP 0x7e7bc a_6 100 LINEAR______0_000000__0H___0_996 0.0 0.99609375
 /begin AXIS_DESCR COM_AXIS dummy_b LINEAR______0_000000__0H___11942 8 0.0 119.53125 AXIS_PTS_REF ldp_tps_sum_av_mon__pq_main_col MAX_GRAD 100 MONOTONY MON_INCREASE /end AXIS_DESCR
 /begin AXIS_DESCR COM_AXIS n_32 LINEAR______0_000000__0H___8160_ 8 0.0 8160.0 AXIS_PTS_REF ldp_n_32_mon__pq_main_col_tq MAX_GRAD 100 MONOTONY MON_INCREASE /end AXIS_DESCR
/end CHARACTERISTIC
/begin CHARACTERISTIC ip_pvs_add_fac_low_n__toil "IP_PVS_ADD_FAC_LOW_N" CURVE 0x779fd a_1 100 LINEAR______0_000000__0H___0_996 0.0 0.99609375
 /begin AXIS_DESCR COM_AXIS toil LINEAR_______48_000000__0H___155 4 -48.0 155.0 AXIS_PTS_REF ldp_toil__pvs_add_fac_low_n MAX_GRAD 100 MONOTONY MON_INCREASE /end AXIS_DESCR
 FUNCTION_LIST Z10I /end CHARACTERISTIC
/begin CHARACTERISTIC ip_pvs_av_lih_max__n "IP_PVS_AV_LIH_MAX" CURVE 0x7b1b2 a_3 100 LINEAR______0_000000__0H___119_9 0.0 119.99817
 /begin AXIS_DESCR COM_AXIS n_32 LINEAR______0_000000__0H___8160_ 6 0.0 8160.0 AXIS_PTS_REF ldp_n_32__pvs_av_lih_max MAX_GRAD 100 MONOTONY MON_INCREASE /end AXIS_DESCR
/end CHARACTERISTIC
/begin CHARACTERISTIC ip_pvs_cor_max_rpl_0__npvscor "IP_PVS_COR_MAX_RPL_0" MAP 0x7b1be a_28 100 LINEAR______0_000000__0H___119_9 0.0 119.99817
 /begin AXIS_DESCR COM_AXIS pvs_cor LINEAR______0_000000__0H___11960 6 0.0 119.9982 AXIS_PTS_REF ldpm_pvs_cor_3 MAX_GRAD 100 MONOTONY MON_INCREASE /end AXIS_DESCR
 /begin AXIS_DESCR COM_AXIS n LINEAR______0_000000__0H___81612 6 0.0 8160.0 AXIS_PTS_REF ldpm_n_23 MAX_GRAD 100 MONOTONY MON_INCREASE /end AXIS_DESCR
/end CHARACTERISTIC
/begin CHARACTERISTIC ip_pvs_cor_max_rpl_1__npvscor "IP_PVS_COR_MAX_RPL_1" MAP 0x7b206 a_28 100 LINEAR______0_000000__0H___119_9 0.0 119.99817
 /begin AXIS_DESCR COM_AXIS pvs_cor LINEAR______0_000000__0H___11960 6 0.0 119.9982 AXIS_PTS_REF ldpm_pvs_cor_3 MAX_GRAD 100 MONOTONY MON_INCREASE /end AXIS_DESCR
 /begin AXIS_DESCR COM_AXIS n LINEAR______0_000000__0H___81612 6 0.0 8160.0 AXIS_PTS_REF ldpm_n_23 MAX_GRAD 100 MONOTONY MON_INCREASE /end AXIS_DESCR
/end CHARACTERISTIC
/begin CHARACTERISTIC ip_pvs_cor_max_rpl_2__npvscor "IP_PVS_COR_MAX_RPL_2" MAP 0x7b24e a_28 100 LINEAR______0_000000__0H___119_9 0.0 119.99817
 /begin AXIS_DESCR COM_AXIS pvs_cor LINEAR______0_000000__0H___11960 6 0.0 119.9982 AXIS_PTS_REF ldpm_pvs_cor_3 MAX_GRAD 100 MONOTONY MON_INCREASE /end AXIS_DESCR
 /begin AXIS_DESCR COM_AXIS n LINEAR______0_000000__0H___81612 6 0.0 8160.0 AXIS_PTS_REF ldpm_n_23 MAX_GRAD 100 MONOTONY MON_INCREASE /end AXIS_DESCR
/end CHARACTERISTIC
/begin CHARACTERISTIC ip_pvs_cor_max_rpl_3__npvscor "IP_PVS_COR_MAX_RPL_3" MAP 0x7b296 a_28 100 LINEAR______0_000000__0H___119_9 0.0 119.99817
 /begin AXIS_DESCR COM_AXIS pvs_cor LINEAR______0_000000__0H___11960 6 0.0 119.9982 AXIS_PTS_REF ldpm_pvs_cor_3 MAX_GRAD 100 MONOTONY MON_INCREASE /end AXIS_DESCR
 /begin AXIS_DESCR COM_AXIS n LINEAR______0_000000__0H___81612 6 0.0 8160.0 AXIS_PTS_REF ldpm_n_23 MAX_GRAD 100 MONOTONY MON_INCREASE /end AXIS_DESCR
/end CHARACTERISTIC
/begin CHARACTERISTIC ip_pvs_cor_max_rpl_4__npvscor "IP_PVS_COR_MAX_RPL_4" MAP 0x7b2de a_28 100 LINEAR______0_000000__0H___119_9 0.0 119.99817
 /begin AXIS_DESCR COM_AXIS pvs_cor LINEAR______0_000000__0H___11960 6 0.0 119.9982 AXIS_PTS_REF ldpm_pvs_cor_3 MAX_GRAD 100 MONOTONY MON_INCREASE /end AXIS_DESCR
 /begin AXIS_DESCR COM_AXIS n LINEAR______0_000000__0H___81612 6 0.0 8160.0 AXIS_PTS_REF ldpm_n_23 MAX_GRAD 100 MONOTONY MON_INCREASE /end AXIS_DESCR
/end CHARACTERISTIC
/begin CHARACTERISTIC ip_pvs_cor_max_rpl_5__npvscor "IP_PVS_COR_MAX_RPL_5" MAP 0x7b326 a_28 100 LINEAR______0_000000__0H___119_9 0.0 119.99817
 /begin AXIS_DESCR COM_AXIS pvs_cor LINEAR______0_000000__0H___11960 6 0.0 119.9982 AXIS_PTS_REF ldpm_pvs_cor_3 MAX_GRAD 100 MONOTONY MON_INCREASE /end AXIS_DESCR
 /begin AXIS_DESCR COM_AXIS n LINEAR______0_000000__0H___81612 6 0.0 8160.0 AXIS_PTS_REF ldpm_n_23 MAX_GRAD 100 MONOTONY MON_INCREASE /end AXIS_DESCR
/end CHARACTERISTIC
/begin CHARACTERISTIC ip_pvs_cor_rpl_lgrd_0__npvscor "IP_PVS_COR_RPL_LGRD_0" MAP 0x7b36e a_28 100 LINEAR______0_000000__0H___11961 0.0 119.99817
 /begin AXIS_DESCR COM_AXIS pvs_cor LINEAR______0_000000__0H___119_9 6 0.0 119.99817 AXIS_PTS_REF ldpm_pvs_cor_2 MAX_GRAD 100 MONOTONY MON_INCREASE /end AXIS_DESCR
 /begin AXIS_DESCR COM_AXIS n LINEAR______0_000000__0H___81612 6 0.0 8160.0 AXIS_PTS_REF ldpm_n_18 MAX_GRAD 100 MONOTONY MON_INCREASE /end AXIS_DESCR
/end CHARACTERISTIC
/begin CHARACTERISTIC ip_pvs_cor_rpl_lgrd_1__npvscor "IP_PVS_COR_RPL_LGRD_1" MAP 0x7b3b6 a_28 100 LINEAR______0_000000__0H___11961 0.0 119.99817
 /begin AXIS_DESCR COM_AXIS pvs_cor LINEAR______0_000000__0H___119_9 6 0.0 119.99817 AXIS_PTS_REF ldpm_pvs_cor_2 MAX_GRAD 100 MONOTONY MON_INCREASE /end AXIS_DESCR
 /begin AXIS_DESCR COM_AXIS n LINEAR______0_000000__0H___81612 6 0.0 8160.0 AXIS_PTS_REF ldpm_n_18 MAX_GRAD 100 MONOTONY MON_INCREASE /end AXIS_DESCR
/end CHARACTERISTIC
/begin CHARACTERISTIC ip_pvs_cor_rpl_lgrd_2__npvscor "IP_PVS_COR_RPL_LGRD_2" MAP 0x7b3fe a_28 100 LINEAR______0_000000__0H___11961 0.0 119.99817
 /begin AXIS_DESCR COM_AXIS pvs_cor LINEAR______0_000000__0H___119_9 6 0.0 119.99817 AXIS_PTS_REF ldpm_pvs_cor_2 MAX_GRAD 100 MONOTONY MON_INCREASE /end AXIS_DESCR
 /begin AXIS_DESCR COM_AXIS n LINEAR______0_000000__0H___81612 6 0.0 8160.0 AXIS_PTS_REF ldpm_n_18 MAX_GRAD 100 MONOTONY MON_INCREASE /end AXIS_DESCR
/end CHARACTERISTIC
/begin CHARACTERISTIC ip_pvs_cor_rpl_lgrd_3__npvscor "IP_PVS_COR_RPL_LGRD_3" MAP 0x7b446 a_28 100 LINEAR______0_000000__0H___11961 0.0 119.99817
 /begin AXIS_DESCR COM_AXIS pvs_cor LINEAR______0_000000__0H___119_9 6 0.0 119.99817 AXIS_PTS_REF ldpm_pvs_cor_2 MAX_GRAD 100 MONOTONY MON_INCREASE /end AXIS_DESCR
 /begin AXIS_DESCR COM_AXIS n LINEAR______0_000000__0H___81612 6 0.0 8160.0 AXIS_PTS_REF ldpm_n_18 MAX_GRAD 100 MONOTONY MON_INCREASE /end AXIS_DESCR
/end CHARACTERISTIC
/begin CHARACTERISTIC ip_pvs_cor_rpl_lgrd_4__npvscor "IP_PVS_COR_RPL_LGRD_4" MAP 0x7b48e a_28 100 LINEAR______0_000000__0H___11961 0.0 119.99817
 /begin AXIS_DESCR COM_AXIS pvs_cor LINEAR______0_000000__0H___119_9 6 0.0 119.99817 AXIS_PTS_REF ldpm_pvs_cor_2 MAX_GRAD 100 MONOTONY MON_INCREASE /end AXIS_DESCR
 /begin AXIS_DESCR COM_AXIS n LINEAR______0_000000__0H___81612 6 0.0 8160.0 AXIS_PTS_REF ldpm_n_18 MAX_GRAD 100 MONOTONY MON_INCREASE /end AXIS_DESCR
/end CHARACTERISTIC
/begin CHARACTERISTIC ip_pvs_cor_rpl_lgrd_5__npvscor "IP_PVS_COR_RPL_LGRD_5" MAP 0x7b4d6 a_28 100 LINEAR______0_000000__0H___11961 0.0 119.99817
 /begin AXIS_DESCR COM_AXIS pvs_cor LINEAR______0_000000__0H___119_9 6 0.0 119.99817 AXIS_PTS_REF ldpm_pvs_cor_2 MAX_GRAD 100 MONOTONY MON_INCREASE /end AXIS_DESCR
 /begin AXIS_DESCR COM_AXIS n LINEAR______0_000000__0H___81612 6 0.0 8160.0 AXIS_PTS_REF ldpm_n_18 MAX_GRAD 100 MONOTONY MON_INCREASE /end AXIS_DESCR
/end CHARACTERISTIC
/begin CHARACTERISTIC ip_pvs_dec_cru__n_32 "IP_PVS_DEC_CRU" CURVE 0x7b51e a_3 10 LINEAR______0_000000__0H___119_9 0.0 119.99817
 /begin AXIS_DESCR COM_AXIS n_32 LINEAR______0_000000__0H___8160_ 5 0.0 8160.0 AXIS_PTS_REF ldp_n_32 MAX_GRAD 100 MONOTONY MON_INCREASE /end AXIS_DESCR
/end CHARACTERISTIC
/begin CHARACTERISTIC ip_pvs_dif_cr_neg__pvs_max__n "IP_PVS_DIF_CR_NEG" MAP 0x77a01 a_39 100 LINEAR______0_000000__0H___0_498 0.0 0.49805
 /begin AXIS_DESCR COM_AXIS n_32 LINEAR______0_000000__0H___8160_ 8 0.0 8160.0 AXIS_PTS_REF ldpm_n_32_25 MAX_GRAD 100 MONOTONY MON_INCREASE /end AXIS_DESCR
 /begin AXIS_DESCR COM_AXIS pvs_max LINEAR______0_000000__0H___119_9 12 0.0 119.99817 AXIS_PTS_REF ldpm_pvs_max_1 MAX_GRAD 100 MONOTONY MON_INCREASE /end AXIS_DESCR
/end CHARACTERISTIC
/begin CHARACTERISTIC ip_pvs_dif_neg_fac__pvs_max__n "IP_PVS_DIF_NEG_FAC" MAP 0x77a61 a_39 100 LINEAR______0_000000__0H___15_62 0.0 15.94
 /begin AXIS_DESCR COM_AXIS n_32 LINEAR______0_000000__0H___8160_ 8 0.0 8160.0 AXIS_PTS_REF ldpm_n_32_25 MAX_GRAD 100 MONOTONY MON_INCREASE /end AXIS_DESCR
 /begin AXIS_DESCR COM_AXIS pvs_max LINEAR______0_000000__0H___119_9 12 0.0 119.99817 AXIS_PTS_REF ldpm_pvs_max_1 MAX_GRAD 100 MONOTONY MON_INCREASE /end AXIS_DESCR
/end CHARACTERISTIC
/begin CHARACTERISTIC ip_pvs_fac_cs__n_dif__pvs_av "IP_PVS_FAC_CS" MAP 0x77ac1 a_17 100 LINEAR______0_000000__0H___0_996 0.0 0.99609375
 /begin AXIS_DESCR COM_AXIS pvs_av LINEAR______0_000000__0H___119_9 2 0.0 119.99817 AXIS_PTS_REF ldp_pvs_av__pvs_fac_cs MAX_GRAD 100 MONOTONY MON_INCREASE /end AXIS_DESCR
 /begin AXIS_DESCR COM_AXIS n_dif LINEAR_______32768_000000__0H___ 6 -32768.0 32767.0 AXIS_PTS_REF ldp_n_dif__pvs_fac_cs MAX_GRAD 100 MONOTONY MON_INCREASE /end AXIS_DESCR
/end CHARACTERISTIC
/begin CHARACTERISTIC ip_pvs_fac_cs_ssg__n_dif__pvs_av "IP_PVS_FAC_CS_SSG" MAP 0x77acd a_17 100 LINEAR______0_000000__0H___0_996 0.0 0.99609375
 /begin AXIS_DESCR COM_AXIS pvs_av LINEAR______0_000000__0H___119_9 2 0.0 119.99817 AXIS_PTS_REF ldp_pvs_av__pvs_fac_cs_ssg MAX_GRAD 100 MONOTONY MON_INCREASE /end AXIS_DESCR
 /begin AXIS_DESCR COM_AXIS n_dif LINEAR_______32768_000000__0H___ 6 -32768.0 32767.0 AXIS_PTS_REF ldp_n_dif__pvs_fac_cs_ssg MAX_GRAD 100 MONOTONY MON_INCREASE /end AXIS_DESCR
 FUNCTION_LIST Z1S1 /end CHARACTERISTIC
/begin CHARACTERISTIC ip_pvs_fac_gen_at__vs_fil__n_vs "IP_PVS_FAC_GEN_AT" MAP 0x77ad9 a_17 100 LINEAR______0_000000__0H___0_996 0.0 0.99609375
 /begin AXIS_DESCR COM_AXIS dummy_w LINEAR______0_000000__0H___81608 4 0.0 8160.0 AXIS_PTS_REF ldp_n_vs__pvs_fac_gen_at MAX_GRAD 100 MONOTONY MON_INCREASE /end AXIS_DESCR
 /begin AXIS_DESCR COM_AXIS vs_fil LINEAR______0_000000__0H___51151 4 0.0 511.99218 AXIS_PTS_REF ldp_vs_fil__pvs_fac_gen_at MAX_GRAD 100 MONOTONY MON_INCREASE /end AXIS_DESCR
/end CHARACTERISTIC
/begin CHARACTERISTIC ip_pvs_fac_gen_mt__vs_fil__n_vs "IP_PVS_FAC_GEN_MT" MAP 0x77ae9 a_17 100 LINEAR______0_000000__0H___0_996 0.0 0.99609375
 /begin AXIS_DESCR COM_AXIS dummy_w LINEAR______0_000000__0H___81608 4 0.0 8160.0 AXIS_PTS_REF ldp_n_vs__pvs_fac_gen_mt MAX_GRAD 100 MONOTONY MON_INCREASE /end AXIS_DESCR
 /begin AXIS_DESCR COM_AXIS vs_fil LINEAR______0_000000__0H___51151 4 0.0 511.99218 AXIS_PTS_REF ldp_vs_fil__pvs_fac_gen_mt MAX_GRAD 100 MONOTONY MON_INCREASE /end AXIS_DESCR
/end CHARACTERISTIC
/begin CHARACTERISTIC ip_pvs_fac_gen_ssg__vs_fil__n_vs "IP_PVS_FAC_GEN_SSG" MAP 0x77af9 a_17 100 LINEAR______0_000000__0H___0_996 0.0 0.99609375
 /begin AXIS_DESCR COM_AXIS dummy_w LINEAR______0_000000__0H___81608 4 0.0 8160.0 AXIS_PTS_REF ldp_n_vs__pvs_fac_gen_ssg MAX_GRAD 100 MONOTONY MON_INCREASE /end AXIS_DESCR
 /begin AXIS_DESCR COM_AXIS vs_fil LINEAR______0_000000__0H___51151 4 0.0 511.99218 AXIS_PTS_REF ldp_vs_fil__pvs_fac_gen_ssg MAX_GRAD 100 MONOTONY MON_INCREASE /end AXIS_DESCR
/end CHARACTERISTIC
/begin CHARACTERISTIC ip_pvs_fac_shift__vs_fil__pvs_av "IP_PVS_FAC_SHIFT" MAP 0x77b09 a_17 100 LINEAR______0_000000__0H___0_996 0.0 0.99609375
 /begin AXIS_DESCR COM_AXIS pvs_av LINEAR______0_000000__0H___119_9 4 0.0 119.99817 AXIS_PTS_REF ldp_pvs_av__pvs_fac_shift MAX_GRAD 100 MONOTONY MON_INCREASE /end AXIS_DESCR
 /begin AXIS_DESCR COM_AXIS vs_fil LINEAR______0_000000__0H___51151 4 0.0 511.99218 AXIS_PTS_REF ldp_vs_fil__pvs_fac_shift MAX_GRAD 100 MONOTONY MON_INCREASE /end AXIS_DESCR
/end CHARACTERISTIC
/begin CHARACTERISTIC ip_pvs_grd_max_neg_er__pvs_max "IP_PVS_GRD_MAX_NEG_ER" CURVE 0x77b29 a_1 5 LINEAR______0_000000__0H___2988_ 0.0 2988.0
 /begin AXIS_DESCR COM_AXIS pvs_max LINEAR______0_000000__0H___11942 6 0.0 119.53125 AXIS_PTS_REF ldpm_pvs_max_2 MAX_GRAD 100 MONOTONY MON_INCREASE /end AXIS_DESCR
/end CHARACTERISTIC
/begin CHARACTERISTIC ip_pvs_grd_max_pos_er__pvs_max "IP_PVS_GRD_MAX_POS_ER" CURVE 0x77b2f a_1 5 LINEAR______0_000000__0H___2988_ 0.0 2988.0
 /begin AXIS_DESCR COM_AXIS pvs_max LINEAR______0_000000__0H___11942 6 0.0 119.53125 AXIS_PTS_REF ldpm_pvs_max_2 MAX_GRAD 100 MONOTONY MON_INCREASE /end AXIS_DESCR
/end CHARACTERISTIC
/begin CHARACTERISTIC ip_pvs_isa_isapwm__isapwm "IP_PVS_ISA_ISAPWM" CURVE 0x7b528 a_24 100 LINEAR______0_000000__0H___102_0 0.0 102.0
 /begin AXIS_DESCR COM_AXIS isapwm_load_tot LINEAR______0_000000__0H___399_9 12 0.0 399.9938 AXIS_PTS_REF ldp_isapwm__pvs_isa_isapwm MAX_GRAD 100 MONOTONY MON_INCREASE /end AXIS_DESCR
/end CHARACTERISTIC
/begin CHARACTERISTIC ip_pvs_lgrd_asr__pvs_driv "IP_PVS_LGRD_ASR" CURVE 0x7b540 a_24 100 LINEAR______0_000000__0H___11960 0.0 119.9982
 /begin AXIS_DESCR COM_AXIS pvs_driv LINEAR______0_000000__0H___11960 4 0.0 119.9982 AXIS_PTS_REF ldp_pvs_driv__pvs_lgrd_asr MAX_GRAD 100 MONOTONY MON_INCREASE /end AXIS_DESCR
/end CHARACTERISTIC
/begin CHARACTERISTIC ip_pvs_max_cru__vs_fil "IP_PVS_MAX_CRU" CURVE 0x7b548 a_24 100 LINEAR______0_000000__0H___119_9 0.0 119.99817
 /begin AXIS_DESCR COM_AXIS vs_fil LINEAR______0_000000__0H___51151 4 0.0 511.99218 AXIS_PTS_REF ldp_vs_fil__pvs_max_cru MAX_GRAD 100 MONOTONY MON_INCREASE /end AXIS_DESCR
/end CHARACTERISTIC
/begin CHARACTERISTIC ip_pvs_min_at_1_ef__n_32 "IP_PVS_MIN_AT_1_EF" CURVE 0x77b35 a_1 100 LINEAR______0_000000__0H___11942 0.0 119.53125
 /begin AXIS_DESCR COM_AXIS n_32 LINEAR______0_000000__0H___8160_ 5 0.0 8160.0 AXIS_PTS_REF ldpm_n_32_27 MAX_GRAD 100 MONOTONY MON_INCREASE /end AXIS_DESCR
/end CHARACTERISTIC
/begin CHARACTERISTIC ip_pvs_min_at_2_ef__n_32 "IP_PVS_MIN_AT_2_EF" CURVE 0x77b3a a_1 100 LINEAR______0_000000__0H___11942 0.0 119.53125
 /begin AXIS_DESCR COM_AXIS n_32 LINEAR______0_000000__0H___8160_ 5 0.0 8160.0 AXIS_PTS_REF ldpm_n_32_27 MAX_GRAD 100 MONOTONY MON_INCREASE /end AXIS_DESCR
/end CHARACTERISTIC
/begin CHARACTERISTIC ip_pvs_min_at_3_ef__n_32 "IP_PVS_MIN_AT_3_EF" CURVE 0x77b3f a_1 100 LINEAR______0_000000__0H___11942 0.0 119.53125
 /begin AXIS_DESCR COM_AXIS n_32 LINEAR______0_000000__0H___8160_ 5 0.0 8160.0 AXIS_PTS_REF ldpm_n_32_27 MAX_GRAD 100 MONOTONY MON_INCREASE /end AXIS_DESCR
/end CHARACTERISTIC
/begin CHARACTERISTIC ip_pvs_min_at_4_ef__n_32 "IP_PVS_MIN_AT_4_EF" CURVE 0x77b44 a_1 100 LINEAR______0_000000__0H___11942 0.0 119.53125
 /begin AXIS_DESCR COM_AXIS n_32 LINEAR______0_000000__0H___8160_ 5 0.0 8160.0 AXIS_PTS_REF ldpm_n_32_27 MAX_GRAD 100 MONOTONY MON_INCREASE /end AXIS_DESCR
/end CHARACTERISTIC
/begin CHARACTERISTIC ip_pvs_min_at_5_ef__n_32 "IP_PVS_MIN_AT_5_EF" CURVE 0x77b49 a_1 100 LINEAR______0_000000__0H___11942 0.0 119.53125
 /begin AXIS_DESCR COM_AXIS n_32 LINEAR______0_000000__0H___8160_ 5 0.0 8160.0 AXIS_PTS_REF ldpm_n_32_27 MAX_GRAD 100 MONOTONY MON_INCREASE /end AXIS_DESCR
/end CHARACTERISTIC
/begin CHARACTERISTIC ip_pvs_min_mt_1_ef__n_32 "IP_PVS_MIN_MT_1_EF" CURVE 0x77b4e a_1 100 LINEAR______0_000000__0H___11942 0.0 119.53125
 /begin AXIS_DESCR COM_AXIS n_32 LINEAR______0_000000__0H___8160_ 5 0.0 8160.0 AXIS_PTS_REF ldpm_n_32_27 MAX_GRAD 100 MONOTONY MON_INCREASE /end AXIS_DESCR
/end CHARACTERISTIC
/begin CHARACTERISTIC ip_pvs_min_mt_2_ef__n_32 "IP_PVS_MIN_MT_2_EF" CURVE 0x77b53 a_1 100 LINEAR______0_000000__0H___11942 0.0 119.53125
 /begin AXIS_DESCR COM_AXIS n_32 LINEAR______0_000000__0H___8160_ 5 0.0 8160.0 AXIS_PTS_REF ldpm_n_32_27 MAX_GRAD 100 MONOTONY MON_INCREASE /end AXIS_DESCR
/end CHARACTERISTIC
/begin CHARACTERISTIC ip_pvs_min_mt_3_ef__n_32 "IP_PVS_MIN_MT_3_EF" CURVE 0x77b58 a_1 100 LINEAR______0_000000__0H___11942 0.0 119.53125
 /begin AXIS_DESCR COM_AXIS n_32 LINEAR______0_000000__0H___8160_ 5 0.0 8160.0 AXIS_PTS_REF ldpm_n_32_27 MAX_GRAD 100 MONOTONY MON_INCREASE /end AXIS_DESCR
/end CHARACTERISTIC
/begin CHARACTERISTIC ip_pvs_min_mt_4_ef__n_32 "IP_PVS_MIN_MT_4_EF" CURVE 0x77b5d a_1 100 LINEAR______0_000000__0H___11942 0.0 119.53125
 /begin AXIS_DESCR COM_AXIS n_32 LINEAR______0_000000__0H___8160_ 5 0.0 8160.0 AXIS_PTS_REF ldpm_n_32_27 MAX_GRAD 100 MONOTONY MON_INCREASE /end AXIS_DESCR
/end CHARACTERISTIC
/begin CHARACTERISTIC ip_pvs_min_mt_5_ef__n_32 "IP_PVS_MIN_MT_5_EF" CURVE 0x77b62 a_1 100 LINEAR______0_000000__0H___11942 0.0 119.53125
 /begin AXIS_DESCR COM_AXIS n_32 LINEAR______0_000000__0H___8160_ 5 0.0 8160.0 AXIS_PTS_REF ldpm_n_32_27 MAX_GRAD 100 MONOTONY MON_INCREASE /end AXIS_DESCR
/end CHARACTERISTIC
/begin CHARACTERISTIC ip_pvs_min_set_cru__vs_sp_cru "IP_PVS_MIN_SET_CRU" CURVE 0x7b550 a_24 100 LINEAR______0_000000__0H___119_9 0.0 119.99817
 /begin AXIS_DESCR COM_AXIS vs_sp_cru LINEAR______0_000000__0H___51151 5 0.0 511.99218 AXIS_PTS_REF ldpm_vs_sp_cru_1 MAX_GRAD 100 MONOTONY MON_INCREASE /end AXIS_DESCR
/end CHARACTERISTIC
/begin CHARACTERISTIC ip_pvs_ratio_hys__v_pvs_min "IP_PVS_RATIO_HYS" CURVE 0x7b55a a_24 100 LINEAR______0_000000__0H___4_995 0.0 4.9951172
 /begin AXIS_DESCR COM_AXIS dummy_w LINEAR______0_000000__0H___4_995 6 0.0 4.9951172 AXIS_PTS_REF ldp_v_pvs_min__pvs_ratio_hys MAX_GRAD 100 MONOTONY MON_INCREASE /end AXIS_DESCR
/end CHARACTERISTIC
/begin CHARACTERISTIC ip_pvs_ratio_hys_mon "IP_PVS_RATIO_HYS_MON" CURVE 0x7e7fc a_1 100 LINEAR______0_000000__0H___99_60 0.0 99.609375
 /begin AXIS_DESCR COM_AXIS dummy_b LINEAR______0_000000__0H___99_60 6 0.0 99.609375 AXIS_PTS_REF ldp_pv_av_min__pvs_ratio_hys_mon MAX_GRAD 100 MONOTONY MON_INCREASE /end AXIS_DESCR
/end CHARACTERISTIC
/begin CHARACTERISTIC ip_pvs_tqi__n__tqi "IP_PVS_TQI" MAP 0x7b566 a_50 100 LINEAR______0_000000__0H___119_8 0.0 119.8828
 /begin AXIS_DESCR COM_AXIS dummy_b LINEAR______0_000000__0H___1023_ 12 0.0 1023.0 AXIS_PTS_REF ldpm_tqi_1 MAX_GRAD 100 MONOTONY MON_INCREASE /end AXIS_DESCR
 /begin AXIS_DESCR COM_AXIS n_32 LINEAR______0_000000__0H___8160_ 12 0.0 8160.0 AXIS_PTS_REF ldpm_n_32_14 MAX_GRAD 100 MONOTONY MON_INCREASE /end AXIS_DESCR
/end CHARACTERISTIC
/begin CHARACTERISTIC ip_rest__t_es "IP_REST" CURVE 0x77b67 a_7 100 LINEAR______0_000000__0H___0_996 0.0 0.99609375
 /begin AXIS_DESCR COM_AXIS t_es LINEAR______0_000000__0H___65563 8 0.0 65535.0 AXIS_PTS_REF ldp_t_es__rest MAX_GRAD 100 MONOTONY MON_INCREASE /end AXIS_DESCR
/end CHARACTERISTIC
/begin CHARACTERISTIC ip_saf_cor_amp__amp "IP_SAF_COR_AMP" CURVE 0x77b6f a_7 100 LINEAR______0_000000__0H___0_996 0.0 0.99609375
 /begin AXIS_DESCR COM_AXIS amp_longvwordC1D LINEAR______0_000000__0H___5434_ 8 0.0 5434.2598 AXIS_PTS_REF ldp_amp__saf_cor_amp MAX_GRAD 100 MONOTONY MON_INCREASE /end AXIS_DESCR
/end CHARACTERISTIC
/begin CHARACTERISTIC ip_saf_cor_tam__tam "IP_SAF_COR_TAM" CURVE 0x77b77 a_1 100 LINEAR______0_000000__0H___0_996 0.0 0.99609375
 /begin AXIS_DESCR COM_AXIS tam LINEAR_______128_000000__0H___64 8 -128.0 127.0 AXIS_PTS_REF ldp_tam__saf_cor_tam MAX_GRAD 100 MONOTONY MON_INCREASE /end AXIS_DESCR
/end CHARACTERISTIC
/begin CHARACTERISTIC ip_saf_cor_vb__vb "IP_SAF_COR_VB" CURVE 0x7b686 a_3 100 LINEAR______0_000000__0H___10265 0.0 1023.9844
 /begin AXIS_DESCR COM_AXIS vb LINEAR______0_000000__0H___26_00 8 0.0 26.0 AXIS_PTS_REF ldp_vb__saf_cor_vb MAX_GRAD 100 MONOTONY MON_INCREASE /end AXIS_DESCR
/end CHARACTERISTIC
/begin CHARACTERISTIC ip_saf_mdl__maf_cyl "IP_SAF_MDL" CURVE 0x7b696 a_24 100 LINEAR______0_000000__0H___10265 0.0 1023.9844
 /begin AXIS_DESCR COM_AXIS maf_cyl LINEAR______0_000000__0H___16383 8 0.0 16383.75 AXIS_PTS_REF ldp_maf_cyl__saf_mdl MAX_GRAD 100 MONOTONY MON_INCREASE /end AXIS_DESCR
/end CHARACTERISTIC
/begin CHARACTERISTIC ip_sap_dly_2__n "IP_SAP_DLY_2" CURVE 0x7b6a6 a_3 1 LINEAR______0_010000__1H___655_3 0.01 655.34998
 /begin AXIS_DESCR COM_AXIS n LINEAR______0_000000__0H___8160_ 3 0.0 8160.0 AXIS_PTS_REF ldpm_n_32_15 MAX_GRAD 100 MONOTONY MON_INCREASE /end AXIS_DESCR
/end CHARACTERISTIC
/begin CHARACTERISTIC ip_sap_dly_3__n "IP_SAP_DLY_3" CURVE 0x7b6ac a_3 1 LINEAR______0_010000__1H___655_3 0.01 655.34998
 /begin AXIS_DESCR COM_AXIS n LINEAR______0_000000__0H___8160_ 3 0.0 8160.0 AXIS_PTS_REF ldpm_n_32_15 MAX_GRAD 100 MONOTONY MON_INCREASE /end AXIS_DESCR
/end CHARACTERISTIC
/begin CHARACTERISTIC ip_soi_st__n__ti "IP_SOI_ST" MAP 0x77b7f a_17 10 LINEAR_______180_000000__0H___50 -180.0 504.0
 /begin AXIS_DESCR COM_AXIS ti_tot LINEAR______0_000000__0H___349_5 4 0.0 349.52 AXIS_PTS_REF ldp_ti__soi_st MAX_GRAD 100 MONOTONY MON_INCREASE /end AXIS_DESCR
 /begin AXIS_DESCR COM_AXIS n LINEAR______0_000000__0H___81612 4 0.0 8160.0 AXIS_PTS_REF ldp_n__soi_st MAX_GRAD 100 MONOTONY MON_INCREASE /end AXIS_DESCR
/end CHARACTERISTIC
/begin CHARACTERISTIC ip_soi_tco_1_is__n__ti "IP_SOI_TCO_1_IS" MAP 0x77b8f a_17 10 LINEAR_______180_000000__0H___50 -180.0 504.0
 /begin AXIS_DESCR COM_AXIS ti_tot LINEAR______0_000000__0H___349_5 6 0.0 349.52 AXIS_PTS_REF ldpm_ti_tot_2 MAX_GRAD 100 MONOTONY MON_INCREASE /end AXIS_DESCR
 /begin AXIS_DESCR COM_AXIS n LINEAR______0_000000__0H___81612 6 0.0 8160.0 AXIS_PTS_REF ldpm_n_2 MAX_GRAD 100 MONOTONY MON_INCREASE /end AXIS_DESCR
/end CHARACTERISTIC
/begin CHARACTERISTIC ip_soi_tco_1_pl__n__ti "IP_SOI_TCO_1_PL" MAP 0x77bb3 a_17 10 LINEAR_______180_000000__0H___50 -180.0 504.0
 /begin AXIS_DESCR COM_AXIS ti_tot LINEAR______0_000000__0H___349_5 10 0.0 349.52 AXIS_PTS_REF ldpm_ti_tot_1 MAX_GRAD 100 MONOTONY MON_INCREASE /end AXIS_DESCR
 /begin AXIS_DESCR COM_AXIS n LINEAR______0_000000__0H___81612 8 0.0 8160.0 AXIS_PTS_REF ldpm_n_1 MAX_GRAD 100 MONOTONY MON_INCREASE /end AXIS_DESCR
/end CHARACTERISTIC
/begin CHARACTERISTIC ip_soi_tco_2_is__n__ti "IP_SOI_TCO_2_IS" MAP 0x77c03 a_17 10 LINEAR_______180_000000__0H___50 -180.0 504.0
 /begin AXIS_DESCR COM_AXIS ti_tot LINEAR______0_000000__0H___349_5 6 0.0 349.52 AXIS_PTS_REF ldpm_ti_tot_2 MAX_GRAD 100 MONOTONY MON_INCREASE /end AXIS_DESCR
 /begin AXIS_DESCR COM_AXIS n LINEAR______0_000000__0H___81612 6 0.0 8160.0 AXIS_PTS_REF ldpm_n_2 MAX_GRAD 100 MONOTONY MON_INCREASE /end AXIS_DESCR
/end CHARACTERISTIC
/begin CHARACTERISTIC ip_soi_tco_2_pl__n__ti "IP_SOI_TCO_2_PL" MAP 0x77c27 a_17 10 LINEAR_______180_000000__0H___50 -180.0 504.0
 /begin AXIS_DESCR COM_AXIS ti_tot LINEAR______0_000000__0H___349_5 10 0.0 349.52 AXIS_PTS_REF ldpm_ti_tot_1 MAX_GRAD 100 MONOTONY MON_INCREASE /end AXIS_DESCR
 /begin AXIS_DESCR COM_AXIS n LINEAR______0_000000__0H___81612 8 0.0 8160.0 AXIS_PTS_REF ldpm_n_1 MAX_GRAD 100 MONOTONY MON_INCREASE /end AXIS_DESCR
/end CHARACTERISTIC
/begin CHARACTERISTIC ip_sum_ign_mpl_st__tco "IP_SUM_IGN_MPL_ST" CURVE 0x77c77 a_1 10 LINEAR______0_000000__0H___255_0 0.0 255.0
 /begin AXIS_DESCR COM_AXIS tco LINEAR_______48_000000__0H___142 8 -48.0 142.5 AXIS_PTS_REF ldpm_tco_3 MAX_GRAD 100 MONOTONY MON_INCREASE /end AXIS_DESCR
/end CHARACTERISTIC
/begin CHARACTERISTIC ip_t_ast_swi_wup__km_ctr "IP_T_AST_SWI_WUP" CURVE 0x7b6b2 a_24 100 LINEAR______0_000000__0H___6553_ 0.0 6553.5
 /begin AXIS_DESCR COM_AXIS km_ctr LINEAR______0_000000__0H___65534 4 0.0 655340.0 AXIS_PTS_REF ldpm_km_ctr_1 MAX_GRAD 100 MONOTONY MON_INCREASE /end AXIS_DESCR
/end CHARACTERISTIC
/begin CHARACTERISTIC ip_t_ch_2__tco_st__km_ctr "IP_T_CH_2" MAP 0x7b6ba a_50 10 LINEAR______0_000000__0H___6553_ 0.0 6553.5
 /begin AXIS_DESCR COM_AXIS km_ctr LINEAR______0_000000__0H___65534 4 0.0 655340.0 AXIS_PTS_REF ldpm_km_ctr_1 MAX_GRAD 100 MONOTONY MON_INCREASE /end AXIS_DESCR
 /begin AXIS_DESCR COM_AXIS tco_st LINEAR_______48_000000__0H___142 8 -48.0 142.5 AXIS_PTS_REF ldpm_tco_st_2 MAX_GRAD 100 MONOTONY MON_INCREASE /end AXIS_DESCR
/end CHARACTERISTIC
/begin CHARACTERISTIC ip_t_ch_2_n_sp__tco_st__km_ctr "IP_T_CH_2_N_SP" MAP 0x7b6fa a_50 100 LINEAR______0_000000__0H___6553_ 0.0 6553.5
 /begin AXIS_DESCR COM_AXIS km_ctr LINEAR______0_000000__0H___65534 4 0.0 655340.0 AXIS_PTS_REF ldpm_km_ctr_1 MAX_GRAD 100 MONOTONY MON_INCREASE /end AXIS_DESCR
 /begin AXIS_DESCR COM_AXIS tco_st LINEAR_______48_000000__0H___142 8 -48.0 142.5 AXIS_PTS_REF ldpm_tco_st_2 MAX_GRAD 100 MONOTONY MON_INCREASE /end AXIS_DESCR
/end CHARACTERISTIC
/begin CHARACTERISTIC ip_t_ch_dew_max__tco_st "IP_T_CH_DEW_MAX" CURVE 0x7b73a a_3 100 LINEAR______0_000000__0H___6553_ 0.0 6553.5
 /begin AXIS_DESCR COM_AXIS tco_st LINEAR_______48_000000__0H___142 5 -48.0 142.5 AXIS_PTS_REF ldp_tco_st__t_ch_dew_max MAX_GRAD 100 MONOTONY MON_INCREASE /end AXIS_DESCR
/end CHARACTERISTIC
/begin CHARACTERISTIC ip_t_ch_puc_deacc__iga_cat "IP_T_CH_PUC_DEACC" CURVE 0x7b744 a_3 100 LINEAR_______5_592320__0H___5_59 -5.59232 5.592149
 /begin AXIS_DESCR COM_AXIS iga_ch_ofsvbyteC1D LINEAR_______48_000000__0H___041 4 -48.0 0.0 AXIS_PTS_REF ldp_iga_cat__t_ch_puc_deacc MAX_GRAD 100 MONOTONY MON_INCREASE /end AXIS_DESCR
/end CHARACTERISTIC
/begin CHARACTERISTIC ip_t_ch_ti__tco_st__km_ctr "IP_T_CH_TI" MAP 0x7b74c a_50 10 LINEAR______0_000000__0H___6553_ 0.0 6553.5
 /begin AXIS_DESCR COM_AXIS km_ctr LINEAR______0_000000__0H___65534 4 0.0 655340.0 AXIS_PTS_REF ldpm_km_ctr_1 MAX_GRAD 100 MONOTONY MON_INCREASE /end AXIS_DESCR
 /begin AXIS_DESCR COM_AXIS tco_st LINEAR_______48_000000__0H___142 8 -48.0 142.5 AXIS_PTS_REF ldpm_tco_st_5 MAX_GRAD 100 MONOTONY MON_INCREASE /end AXIS_DESCR
/end CHARACTERISTIC
/begin CHARACTERISTIC ip_t_ctl_ivvt_ex__camdifex__dly "IP_T_CTL_IVVT_EX" MAP 0x77cdf a_6 100 LINEAR______0_000000__0H___159_3 0.0 159.375
 /begin AXIS_DESCR COM_AXIS dummy_b LINEAR______0_000000__0H___2550_ 6 0.0 2550.0 AXIS_PTS_REF ldpm_dly_ivvt_y_1 MAX_GRAD 100 MONOTONY MON_INCREASE /end AXIS_DESCR
 /begin AXIS_DESCR COM_AXIS dummy_b LINEAR______0_000000__0H___48_00 8 0.0 48.0 AXIS_PTS_REF ldpm_cam_dif_ctl_x_1 MAX_GRAD 100 MONOTONY MON_INCREASE /end AXIS_DESCR
/end CHARACTERISTIC
/begin CHARACTERISTIC ip_t_ctl_ivvt_in__camdifin__dly "IP_T_CTL_IVVT_IN" MAP 0x77d0f a_6 100 LINEAR______0_000000__0H___159_3 0.0 159.375
 /begin AXIS_DESCR COM_AXIS dummy_b LINEAR______0_000000__0H___2550_ 6 0.0 2550.0 AXIS_PTS_REF ldpm_dly_ivvt_y_1 MAX_GRAD 100 MONOTONY MON_INCREASE /end AXIS_DESCR
 /begin AXIS_DESCR COM_AXIS dummy_b LINEAR______0_000000__0H___48_00 8 0.0 48.0 AXIS_PTS_REF ldpm_cam_dif_ctl_x_1 MAX_GRAD 100 MONOTONY MON_INCREASE /end AXIS_DESCR
/end CHARACTERISTIC
/begin CHARACTERISTIC ip_t_dly_add_ivvt_adc_ex__toil "IP_T_DLY_ADD_IVVT_ADC_EX" CURVE 0x77d9f a_1 100 LINEAR______0_000000__0H___159_3 0.0 159.375
 /begin AXIS_DESCR COM_AXIS toil LINEAR_______48_000000__0H___155 8 -48.0 155.0 AXIS_PTS_REF ldpm_toil_2 MAX_GRAD 100 MONOTONY MON_INCREASE /end AXIS_DESCR
/end CHARACTERISTIC
/begin CHARACTERISTIC ip_t_dly_add_ivvt_adc_in__toil "IP_T_DLY_ADD_IVVT_ADC_IN" CURVE 0x77da7 a_1 100 LINEAR______0_000000__0H___159_3 0.0 159.375
 /begin AXIS_DESCR COM_AXIS toil LINEAR_______48_000000__0H___155 8 -48.0 155.0 AXIS_PTS_REF ldpm_toil_2 MAX_GRAD 100 MONOTONY MON_INCREASE /end AXIS_DESCR
/end CHARACTERISTIC
/begin CHARACTERISTIC ip_t_dly_add_ivvt_ex__toil "IP_T_DLY_ADD_IVVT_EX" CURVE 0x77daf a_1 100 LINEAR______0_000000__0H___159_3 0.0 159.375
 /begin AXIS_DESCR COM_AXIS toil LINEAR_______48_000000__0H___155 8 -48.0 155.0 AXIS_PTS_REF ldpm_toil_2 MAX_GRAD 100 MONOTONY MON_INCREASE /end AXIS_DESCR
/end CHARACTERISTIC
/begin CHARACTERISTIC ip_t_dly_add_ivvt_in__toil "IP_T_DLY_ADD_IVVT_IN" CURVE 0x77db7 a_1 100 LINEAR______0_000000__0H___159_3 0.0 159.375
 /begin AXIS_DESCR COM_AXIS toil LINEAR_______48_000000__0H___155 8 -48.0 155.0 AXIS_PTS_REF ldpm_toil_2 MAX_GRAD 100 MONOTONY MON_INCREASE /end AXIS_DESCR
/end CHARACTERISTIC
/begin CHARACTERISTIC ip_t_dly_add_ivvt_rtd_ex__toil "IP_T_DLY_ADD_IVVT_RTD_EX" CURVE 0x77dbf a_1 100 LINEAR______0_000000__0H___159_3 0.0 159.375
 /begin AXIS_DESCR COM_AXIS toil LINEAR_______48_000000__0H___155 8 -48.0 155.0 AXIS_PTS_REF ldpm_toil_2 MAX_GRAD 100 MONOTONY MON_INCREASE /end AXIS_DESCR
/end CHARACTERISTIC
/begin CHARACTERISTIC ip_t_dly_add_ivvt_rtd_in__toil "IP_T_DLY_ADD_IVVT_RTD_IN" CURVE 0x77dc7 a_1 100 LINEAR______0_000000__0H___159_3 0.0 159.375
 /begin AXIS_DESCR COM_AXIS toil LINEAR_______48_000000__0H___155 8 -48.0 155.0 AXIS_PTS_REF ldpm_toil_2 MAX_GRAD 100 MONOTONY MON_INCREASE /end AXIS_DESCR
/end CHARACTERISTIC
/begin CHARACTERISTIC ip_t_dly_hst__maf_kgh "IP_T_DLY_HST" CURVE 0x7b80c a_24 100 LINEAR_______1_279900__0H___1_27 -1.2799 1.2798
 /begin AXIS_DESCR COM_AXIS maf_kgh LINEAR______0_000000__0H___16383 8 0.0 16383.75 AXIS_PTS_REF ldpm_maf_kgh_6 MAX_GRAD 100 MONOTONY MON_INCREASE /end AXIS_DESCR
/end CHARACTERISTIC
/begin CHARACTERISTIC ip_t_dly_i__vls_dif_dly_i "IP_T_DLY_I" CURVE 0x7b81c a_3 100 LINEAR_______640_020000__0H___63 -640.02 639.98
 /begin AXIS_DESCR COM_AXIS dummy_b LINEAR_______0_637500__0H___0_63 12 -0.6375 0.6375 AXIS_PTS_REF ldpm_vls_dif_dly_i_1 MAX_GRAD 100 MONOTONY MON_INCREASE /end AXIS_DESCR
/end CHARACTERISTIC
/begin CHARACTERISTIC ip_t_dly_p__vls_dif_dly_i "IP_T_DLY_P" CURVE 0x7b834 a_3 100 LINEAR_______640_020000__0H___63 -640.02 639.98
 /begin AXIS_DESCR COM_AXIS dummy_b LINEAR_______0_637500__0H___0_63 12 -0.6375 0.6375 AXIS_PTS_REF ldpm_vls_dif_dly_i_1 MAX_GRAD 100 MONOTONY MON_INCREASE /end AXIS_DESCR
/end CHARACTERISTIC
/begin CHARACTERISTIC ip_t_dly_puc__maf_kgh "IP_T_DLY_PUC" CURVE 0x7b84c a_24 100 LINEAR_______1_279900__0H___1_66 -1.2799 1.2798
 /begin AXIS_DESCR COM_AXIS maf_kgh LINEAR______0_000000__0H___16383 8 0.0 16383.75 AXIS_PTS_REF ldpm_maf_kgh_6 MAX_GRAD 100 MONOTONY MON_INCREASE /end AXIS_DESCR
/end CHARACTERISTIC
/begin CHARACTERISTIC ip_t_dly_sap__maf_kgh "IP_T_DLY_SAP" CURVE 0x7b85c a_24 100 LINEAR_______1_279900__0H___1_27 -1.2799 1.2798
 /begin AXIS_DESCR COM_AXIS maf_kgh LINEAR______0_000000__0H___16383 8 0.0 16383.75 AXIS_PTS_REF ldpm_maf_kgh_6 MAX_GRAD 100 MONOTONY MON_INCREASE /end AXIS_DESCR
/end CHARACTERISTIC
/begin CHARACTERISTIC ip_t_dly_tco_1_1__n__maf "IP_T_DLY_TCO_1_1" MAP 0x7b86c a_36 100 LINEAR_______1_279900__0H___1_66 -1.2799 1.2798
 /begin AXIS_DESCR COM_AXIS maf LINEAR______0_000000__0H___1389_ 8 0.0 1389.0 AXIS_PTS_REF ldpm_maf_4 MAX_GRAD 100 MONOTONY MON_INCREASE /end AXIS_DESCR
 /begin AXIS_DESCR COM_AXIS n LINEAR______0_000000__0H___81612 8 0.0 8160.0 AXIS_PTS_REF ldpm_n_7 MAX_GRAD 100 MONOTONY MON_INCREASE /end AXIS_DESCR
/end CHARACTERISTIC
/begin CHARACTERISTIC ip_t_dly_tco_1_2__n__maf "IP_T_DLY_TCO_1_2" MAP 0x7b8ec a_36 100 LINEAR_______1_279900__0H___1_66 -1.2799 1.2798
 /begin AXIS_DESCR COM_AXIS maf LINEAR______0_000000__0H___1389_ 8 0.0 1389.0 AXIS_PTS_REF ldpm_maf_4 MAX_GRAD 100 MONOTONY MON_INCREASE /end AXIS_DESCR
 /begin AXIS_DESCR COM_AXIS n LINEAR______0_000000__0H___81612 8 0.0 8160.0 AXIS_PTS_REF ldpm_n_7 MAX_GRAD 100 MONOTONY MON_INCREASE /end AXIS_DESCR
/end CHARACTERISTIC
/begin CHARACTERISTIC ip_t_dly_tco_1_is_1__n__maf "IP_T_DLY_TCO_1_IS_1" MAP 0x7b96c a_36 100 LINEAR_______1_279900__0H___1_66 -1.2799 1.2798
 /begin AXIS_DESCR COM_AXIS maf LINEAR______0_000000__0H___1389_ 2 0.0 1389.0 AXIS_PTS_REF ldpm_maf_20 MAX_GRAD 100 MONOTONY MON_INCREASE /end AXIS_DESCR
 /begin AXIS_DESCR COM_AXIS n LINEAR______0_000000__0H___81612 2 0.0 8160.0 AXIS_PTS_REF ldpm_n_20 MAX_GRAD 100 MONOTONY MON_INCREASE /end AXIS_DESCR
/end CHARACTERISTIC
/begin CHARACTERISTIC ip_t_dly_tco_1_is_2__n__maf "IP_T_DLY_TCO_1_IS_2" MAP 0x7b974 a_36 100 LINEAR_______1_279900__0H___1_66 -1.2799 1.2798
 /begin AXIS_DESCR COM_AXIS maf LINEAR______0_000000__0H___1389_ 2 0.0 1389.0 AXIS_PTS_REF ldpm_maf_20 MAX_GRAD 100 MONOTONY MON_INCREASE /end AXIS_DESCR
 /begin AXIS_DESCR COM_AXIS n LINEAR______0_000000__0H___81612 2 0.0 8160.0 AXIS_PTS_REF ldpm_n_20 MAX_GRAD 100 MONOTONY MON_INCREASE /end AXIS_DESCR
/end CHARACTERISTIC
/begin CHARACTERISTIC ip_t_dly_tco_2_1__n__maf "IP_T_DLY_TCO_2_1" MAP 0x7b97c a_36 100 LINEAR_______1_279900__0H___1_66 -1.2799 1.2798
 /begin AXIS_DESCR COM_AXIS maf LINEAR______0_000000__0H___1389_ 8 0.0 1389.0 AXIS_PTS_REF ldpm_maf_4 MAX_GRAD 100 MONOTONY MON_INCREASE /end AXIS_DESCR
 /begin AXIS_DESCR COM_AXIS n LINEAR______0_000000__0H___81612 8 0.0 8160.0 AXIS_PTS_REF ldpm_n_7 MAX_GRAD 100 MONOTONY MON_INCREASE /end AXIS_DESCR
/end CHARACTERISTIC
/begin CHARACTERISTIC ip_t_dly_tco_2_2__n__maf "IP_T_DLY_TCO_2_2" MAP 0x7b9fc a_36 100 LINEAR_______1_279900__0H___1_66 -1.2799 1.2798
 /begin AXIS_DESCR COM_AXIS maf LINEAR______0_000000__0H___1389_ 8 0.0 1389.0 AXIS_PTS_REF ldpm_maf_4 MAX_GRAD 100 MONOTONY MON_INCREASE /end AXIS_DESCR
 /begin AXIS_DESCR COM_AXIS n LINEAR______0_000000__0H___81612 8 0.0 8160.0 AXIS_PTS_REF ldpm_n_7 MAX_GRAD 100 MONOTONY MON_INCREASE /end AXIS_DESCR
/end CHARACTERISTIC
/begin CHARACTERISTIC ip_t_dly_tco_2_is_1__n__maf "IP_T_DLY_TCO_2_IS_1" MAP 0x7ba7c a_36 100 LINEAR_______1_279900__0H___1_66 -1.2799 1.2798
 /begin AXIS_DESCR COM_AXIS maf LINEAR______0_000000__0H___1389_ 2 0.0 1389.0 AXIS_PTS_REF ldpm_maf_20 MAX_GRAD 100 MONOTONY MON_INCREASE /end AXIS_DESCR
 /begin AXIS_DESCR COM_AXIS n LINEAR______0_000000__0H___81612 2 0.0 8160.0 AXIS_PTS_REF ldpm_n_20 MAX_GRAD 100 MONOTONY MON_INCREASE /end AXIS_DESCR
/end CHARACTERISTIC
/begin CHARACTERISTIC ip_t_dly_tco_2_is_2__n__maf "IP_T_DLY_TCO_2_IS_2" MAP 0x7ba84 a_36 100 LINEAR_______1_279900__0H___1_66 -1.2799 1.2798
 /begin AXIS_DESCR COM_AXIS maf LINEAR______0_000000__0H___1389_ 2 0.0 1389.0 AXIS_PTS_REF ldpm_maf_20 MAX_GRAD 100 MONOTONY MON_INCREASE /end AXIS_DESCR
 /begin AXIS_DESCR COM_AXIS n LINEAR______0_000000__0H___81612 2 0.0 8160.0 AXIS_PTS_REF ldpm_n_20 MAX_GRAD 100 MONOTONY MON_INCREASE /end AXIS_DESCR
/end CHARACTERISTIC
/begin CHARACTERISTIC ip_t_fac_adc_ivvt_ex__n__toil "IP_T_FAC_ADC_IVVT_EX" MAP 0x7ba8c a_9 100 LINEAR______0_000000__0H___639_9 0.0 639.99
 /begin AXIS_DESCR COM_AXIS toil LINEAR_______48_000000__0H___155 8 -48.0 155.0 AXIS_PTS_REF ldpm_toil_2 MAX_GRAD 100 MONOTONY MON_INCREASE /end AXIS_DESCR
 /begin AXIS_DESCR COM_AXIS n LINEAR______0_000000__0H___8160_ 8 0.0 8160.0 AXIS_PTS_REF ldpm_n_32_24 MAX_GRAD 100 MONOTONY MON_INCREASE /end AXIS_DESCR
/end CHARACTERISTIC
/begin CHARACTERISTIC ip_t_fac_adc_ivvt_in__n__toil "IP_T_FAC_ADC_IVVT_IN" MAP 0x7bb0c a_9 100 LINEAR______0_000000__0H___639_9 0.0 639.99
 /begin AXIS_DESCR COM_AXIS toil LINEAR_______48_000000__0H___155 8 -48.0 155.0 AXIS_PTS_REF ldpm_toil_2 MAX_GRAD 100 MONOTONY MON_INCREASE /end AXIS_DESCR
 /begin AXIS_DESCR COM_AXIS n LINEAR______0_000000__0H___8160_ 8 0.0 8160.0 AXIS_PTS_REF ldpm_n_32_24 MAX_GRAD 100 MONOTONY MON_INCREASE /end AXIS_DESCR
/end CHARACTERISTIC
/begin CHARACTERISTIC ip_t_fac_rtd_ivvt_ex__n__toil "IP_T_FAC_RTD_IVVT_EX" MAP 0x7bb8c a_9 100 LINEAR______0_000000__0H___639_9 0.0 639.99
 /begin AXIS_DESCR COM_AXIS toil LINEAR_______48_000000__0H___155 8 -48.0 155.0 AXIS_PTS_REF ldpm_toil_2 MAX_GRAD 100 MONOTONY MON_INCREASE /end AXIS_DESCR
 /begin AXIS_DESCR COM_AXIS n LINEAR______0_000000__0H___8160_ 8 0.0 8160.0 AXIS_PTS_REF ldpm_n_32_24 MAX_GRAD 100 MONOTONY MON_INCREASE /end AXIS_DESCR
/end CHARACTERISTIC
/begin CHARACTERISTIC ip_t_fac_rtd_ivvt_in__n__toil "IP_T_FAC_RTD_IVVT_IN" MAP 0x7bc0c a_9 100 LINEAR______0_000000__0H___639_9 0.0 639.99
 /begin AXIS_DESCR COM_AXIS toil LINEAR_______48_000000__0H___155 8 -48.0 155.0 AXIS_PTS_REF ldpm_toil_2 MAX_GRAD 100 MONOTONY MON_INCREASE /end AXIS_DESCR
 /begin AXIS_DESCR COM_AXIS n LINEAR______0_000000__0H___8160_ 8 0.0 8160.0 AXIS_PTS_REF ldpm_n_32_24 MAX_GRAD 100 MONOTONY MON_INCREASE /end AXIS_DESCR
/end CHARACTERISTIC
/begin CHARACTERISTIC ip_t_iga_ch__tco_st__km_ctr "IP_T_IGA_CH" MAP 0x7bc8c a_50 10 LINEAR______0_000000__0H___6553_ 0.0 6553.5
 /begin AXIS_DESCR COM_AXIS km_ctr LINEAR______0_000000__0H___65534 4 0.0 655340.0 AXIS_PTS_REF ldpm_km_ctr_1 MAX_GRAD 100 MONOTONY MON_INCREASE /end AXIS_DESCR
 /begin AXIS_DESCR COM_AXIS tco_st LINEAR_______48_000000__0H___142 8 -48.0 142.5 AXIS_PTS_REF ldpm_tco_st_2 MAX_GRAD 100 MONOTONY MON_INCREASE /end AXIS_DESCR
/end CHARACTERISTIC
/begin CHARACTERISTIC ip_t_n_sp_add_cs_pas__tco_st "IP_T_N_SP_ADD_CS_PAS" CURVE 0x77dcf a_1 100 LINEAR______0_000000__0H___816_0 0.0 816.0
 /begin AXIS_DESCR COM_AXIS tco_st LINEAR_______48_000000__0H___142 8 -48.0 142.5 AXIS_PTS_REF ldpm_tco_st_2 MAX_GRAD 100 MONOTONY MON_INCREASE /end AXIS_DESCR
/end CHARACTERISTIC
/begin CHARACTERISTIC ip_t_on_dew_down__tam_dew "IP_T_ON_DEW_DOWN" CURVE 0x77dd7 a_1 100 LINEAR______0_000000__0H___0_967 0.0 0.99609375
 /begin AXIS_DESCR COM_AXIS tam_dew LINEAR_______128_000000__0H___12 6 -128.0 127.0 AXIS_PTS_REF ldp_tam_dew_down__t_on_dew_down MAX_GRAD 100 MONOTONY MON_INCREASE /end AXIS_DESCR
 FUNCTION_LIST DPM /end CHARACTERISTIC
/begin CHARACTERISTIC ip_t_on_dew_up__tam_dew "IP_T_ON_DEW_UP" CURVE 0x77ddd a_1 100 LINEAR______0_000000__0H___0_967 0.0 0.99609375
 /begin AXIS_DESCR COM_AXIS tam_dew LINEAR_______128_000000__0H___12 6 -128.0 127.0 AXIS_PTS_REF ldp_tam_dew_up__t_on_dew_up MAX_GRAD 100 MONOTONY MON_INCREASE /end AXIS_DESCR
 FUNCTION_LIST DPM /end CHARACTERISTIC
/begin CHARACTERISTIC ip_t_peak_expv "T_PEAK_EXPV" MAP 0x77de3 a_6 100 LINEAR______0_000000__0H___20_40 0.0 20.4
 /begin AXIS_DESCR COM_AXIS dummy_b LINEAR_______48_000000__0H___143 10 -48.0 143.25 AXIS_PTS_REF ldpm_tgas_l MAX_GRAD 100 MONOTONY MON_INCREASE /end AXIS_DESCR
 /begin AXIS_DESCR COM_AXIS vb LINEAR______0_000000__0H___26_00 8 0.0 26.0 AXIS_PTS_REF ldpm_vb_1 MAX_GRAD 100 MONOTONY MON_INCREASE /end AXIS_DESCR
 FUNCTION_LIST CNG /end CHARACTERISTIC
/begin CHARACTERISTIC ip_t_peak_iv_gas_ti "T_PEAK_IV_GAS_TI" MAP 0x78000 a_6 100 LINEAR______0_000000__0H___20_40 0.0 20.4
 /begin AXIS_DESCR COM_AXIS dummy_b LINEAR_______48_000000__0H___143 10 -48.0 143.25 AXIS_PTS_REF ldpm_tgas_l MAX_GRAD 100 MONOTONY MON_INCREASE /end AXIS_DESCR
 /begin AXIS_DESCR COM_AXIS vb LINEAR______0_000000__0H___26_00 8 0.0 26.0 AXIS_PTS_REF ldpm_vb_1 MAX_GRAD 100 MONOTONY MON_INCREASE /end AXIS_DESCR
 FUNCTION_LIST CNG /end CHARACTERISTIC
/begin CHARACTERISTIC ip_t_puc_deacc__n__maf_mmv "IP_T_PUC_DEACC" MAP 0x7bd4c a_28 100 LINEAR______0_000000__0H___11_18 0.0 11.18464
 /begin AXIS_DESCR COM_AXIS maf_mmv LINEAR______0_000000__0H___13818 4 0.0 1389.0 AXIS_PTS_REF ldp_maf_mmv__t_puc_deacc MAX_GRAD 100 MONOTONY MON_INCREASE /end AXIS_DESCR
 /begin AXIS_DESCR COM_AXIS n LINEAR______0_000000__0H___81612 6 0.0 8160.0 AXIS_PTS_REF ldpm_n_8 MAX_GRAD 100 MONOTONY MON_INCREASE /end AXIS_DESCR
/end CHARACTERISTIC
/begin CHARACTERISTIC ip_t_puc_deacc_1__n__maf_mmv "IP_T_PUC_DEACC_1" MAP 0x7bd7c a_28 100 LINEAR______0_000000__0H___11_18 0.0 11.18464
 /begin AXIS_DESCR COM_AXIS maf_mmv LINEAR______0_000000__0H___13818 4 0.0 1389.0 AXIS_PTS_REF ldp_maf_mmv__t_puc_deacc_1 MAX_GRAD 100 MONOTONY MON_INCREASE /end AXIS_DESCR
 /begin AXIS_DESCR COM_AXIS n LINEAR______0_000000__0H___81612 6 0.0 8160.0 AXIS_PTS_REF ldpm_n_8 MAX_GRAD 100 MONOTONY MON_INCREASE /end AXIS_DESCR
/end CHARACTERISTIC
/begin CHARACTERISTIC ip_t_puc_deacc_2__n__maf_mmv "IP_T_PUC_DEACC_2" MAP 0x7bdac a_28 100 LINEAR______0_000000__0H___11_18 0.0 11.18464
 /begin AXIS_DESCR COM_AXIS maf_mmv LINEAR______0_000000__0H___13818 4 0.0 1389.0 AXIS_PTS_REF ldp_maf_mmv__t_puc_deacc_2 MAX_GRAD 100 MONOTONY MON_INCREASE /end AXIS_DESCR
 /begin AXIS_DESCR COM_AXIS n LINEAR______0_000000__0H___81612 6 0.0 8160.0 AXIS_PTS_REF ldpm_n_8 MAX_GRAD 100 MONOTONY MON_INCREASE /end AXIS_DESCR
/end CHARACTERISTIC
/begin CHARACTERISTIC ip_t_puc_deacc_3__n__maf_mmv "IP_T_PUC_DEACC_3" MAP 0x7bddc a_28 100 LINEAR______0_000000__0H___11_18 0.0 11.18464
 /begin AXIS_DESCR COM_AXIS maf_mmv LINEAR______0_000000__0H___13818 4 0.0 1389.0 AXIS_PTS_REF ldp_maf_mmv__t_puc_deacc_3 MAX_GRAD 100 MONOTONY MON_INCREASE /end AXIS_DESCR
 /begin AXIS_DESCR COM_AXIS n LINEAR______0_000000__0H___81612 6 0.0 8160.0 AXIS_PTS_REF ldpm_n_8 MAX_GRAD 100 MONOTONY MON_INCREASE /end AXIS_DESCR
/end CHARACTERISTIC
/begin CHARACTERISTIC ip_t_puc_deacc_4__n__maf_mmv "IP_T_PUC_DEACC_4" MAP 0x7be0c a_28 100 LINEAR______0_000000__0H___11_18 0.0 11.18464
 /begin AXIS_DESCR COM_AXIS maf_mmv LINEAR______0_000000__0H___13818 4 0.0 1389.0 AXIS_PTS_REF ldp_maf_mmv__t_puc_deacc_4 MAX_GRAD 100 MONOTONY MON_INCREASE /end AXIS_DESCR
 /begin AXIS_DESCR COM_AXIS n LINEAR______0_000000__0H___81612 6 0.0 8160.0 AXIS_PTS_REF ldpm_n_8 MAX_GRAD 100 MONOTONY MON_INCREASE /end AXIS_DESCR
/end CHARACTERISTIC
/begin CHARACTERISTIC ip_t_puc_deacc_5__n__maf_mmv "IP_T_PUC_DEACC_5" MAP 0x7be3c a_28 100 LINEAR______0_000000__0H___11_18 0.0 11.18464
 /begin AXIS_DESCR COM_AXIS maf_mmv LINEAR______0_000000__0H___13818 4 0.0 1389.0 AXIS_PTS_REF ldp_maf_mmv__t_puc_deacc_5 MAX_GRAD 100 MONOTONY MON_INCREASE /end AXIS_DESCR
 /begin AXIS_DESCR COM_AXIS n LINEAR______0_000000__0H___81612 6 0.0 8160.0 AXIS_PTS_REF ldpm_n_8 MAX_GRAD 100 MONOTONY MON_INCREASE /end AXIS_DESCR
/end CHARACTERISTIC
/begin CHARACTERISTIC ip_t_pvs_cor_rpl_0__npvscor "IP_T_PVS_COR_RPL_0" MAP 0x7be6c a_28 100 LINEAR______0_000000__0H___655_3 0.0 655.35
 /begin AXIS_DESCR COM_AXIS pvs_cor LINEAR______0_000000__0H___11960 6 0.0 119.9982 AXIS_PTS_REF ldpm_pvs_cor_1 MAX_GRAD 100 MONOTONY MON_INCREASE /end AXIS_DESCR
 /begin AXIS_DESCR COM_AXIS n LINEAR______0_000000__0H___81612 6 0.0 8160.0 AXIS_PTS_REF ldpm_n_16 MAX_GRAD 100 MONOTONY MON_INCREASE /end AXIS_DESCR
/end CHARACTERISTIC
/begin CHARACTERISTIC ip_t_pvs_cor_rpl_1__npvscor "IP_T_PVS_COR_RPL_1" MAP 0x7beb4 a_28 100 LINEAR______0_000000__0H___655_3 0.0 655.35
 /begin AXIS_DESCR COM_AXIS pvs_cor LINEAR______0_000000__0H___11960 6 0.0 119.9982 AXIS_PTS_REF ldpm_pvs_cor_1 MAX_GRAD 100 MONOTONY MON_INCREASE /end AXIS_DESCR
 /begin AXIS_DESCR COM_AXIS n LINEAR______0_000000__0H___81612 6 0.0 8160.0 AXIS_PTS_REF ldpm_n_16 MAX_GRAD 100 MONOTONY MON_INCREASE /end AXIS_DESCR
/end CHARACTERISTIC
/begin CHARACTERISTIC ip_t_pvs_cor_rpl_2__npvscor "IP_T_PVS_COR_RPL_2" MAP 0x7c000 a_28 100 LINEAR______0_000000__0H___655_3 0.0 655.35
 /begin AXIS_DESCR COM_AXIS pvs_cor LINEAR______0_000000__0H___11960 6 0.0 119.9982 AXIS_PTS_REF ldpm_pvs_cor_1 MAX_GRAD 100 MONOTONY MON_INCREASE /end AXIS_DESCR
 /begin AXIS_DESCR COM_AXIS n LINEAR______0_000000__0H___81612 6 0.0 8160.0 AXIS_PTS_REF ldpm_n_16 MAX_GRAD 100 MONOTONY MON_INCREASE /end AXIS_DESCR
/end CHARACTERISTIC
/begin CHARACTERISTIC ip_t_pvs_cor_rpl_3__npvscor "IP_T_PVS_COR_RPL_3" MAP 0x7c048 a_28 100 LINEAR______0_000000__0H___655_3 0.0 655.35
 /begin AXIS_DESCR COM_AXIS pvs_cor LINEAR______0_000000__0H___11960 6 0.0 119.9982 AXIS_PTS_REF ldpm_pvs_cor_1 MAX_GRAD 100 MONOTONY MON_INCREASE /end AXIS_DESCR
 /begin AXIS_DESCR COM_AXIS n LINEAR______0_000000__0H___81612 6 0.0 8160.0 AXIS_PTS_REF ldpm_n_16 MAX_GRAD 100 MONOTONY MON_INCREASE /end AXIS_DESCR
/end CHARACTERISTIC
/begin CHARACTERISTIC ip_t_pvs_cor_rpl_4__npvscor "IP_T_PVS_COR_RPL_4" MAP 0x7c090 a_28 100 LINEAR______0_000000__0H___655_3 0.0 655.35
 /begin AXIS_DESCR COM_AXIS pvs_cor LINEAR______0_000000__0H___11960 6 0.0 119.9982 AXIS_PTS_REF ldpm_pvs_cor_1 MAX_GRAD 100 MONOTONY MON_INCREASE /end AXIS_DESCR
 /begin AXIS_DESCR COM_AXIS n LINEAR______0_000000__0H___81612 6 0.0 8160.0 AXIS_PTS_REF ldpm_n_16 MAX_GRAD 100 MONOTONY MON_INCREASE /end AXIS_DESCR
/end CHARACTERISTIC
/begin CHARACTERISTIC ip_t_pvs_cor_rpl_5__npvscor "IP_T_PVS_COR_RPL_5" MAP 0x7c0d8 a_28 100 LINEAR______0_000000__0H___655_3 0.0 655.35
 /begin AXIS_DESCR COM_AXIS pvs_cor LINEAR______0_000000__0H___11960 6 0.0 119.9982 AXIS_PTS_REF ldpm_pvs_cor_1 MAX_GRAD 100 MONOTONY MON_INCREASE /end AXIS_DESCR
 /begin AXIS_DESCR COM_AXIS n LINEAR______0_000000__0H___81612 6 0.0 8160.0 AXIS_PTS_REF ldpm_n_16 MAX_GRAD 100 MONOTONY MON_INCREASE /end AXIS_DESCR
/end CHARACTERISTIC
/begin CHARACTERISTIC ip_t_rough_leak_test__ftl "IP_T_ROUGH_LEAK_TEST" CURVE 0x7c120 a_3 10 LINEAR______0_000000__0H___6553_ 0.0 6553.5
 /begin AXIS_DESCR COM_AXIS ftl LINEAR______0_000000__0H___126_0 5 0.0 126.0 AXIS_PTS_REF ldp_ftl__t_rough_leak_test MAX_GRAD 100 MONOTONY MON_INCREASE /end AXIS_DESCR
 FUNCTION_LIST DMTL /end CHARACTERISTIC
/begin CHARACTERISTIC ip_t_rough_leak_test_heat__ftl "IP_T_ROUGH_LEAK_TEST_HEAT" CURVE 0x7c12a a_3 10 LINEAR______0_000000__0H___6553_ 0.0 6553.5
 /begin AXIS_DESCR COM_AXIS ftl LINEAR______0_000000__0H___126_0 5 0.0 126.0 AXIS_PTS_REF ldp_ftl__t_rough_leak_test MAX_GRAD 100 MONOTONY MON_INCREASE /end AXIS_DESCR
 FUNCTION_LIST DMTL /end CHARACTERISTIC
/begin CHARACTERISTIC ip_t_rst_cru__vs_sp_cru "IP_T_RST_CRU" CURVE 0x7c134 a_24 10 LINEAR______0_000000__0H___408_0 0.0 408.0
 /begin AXIS_DESCR COM_AXIS vs_sp_cru LINEAR______0_000000__0H___51151 5 0.0 511.99218 AXIS_PTS_REF ldpm_vs_sp_cru_1 MAX_GRAD 100 MONOTONY MON_INCREASE /end AXIS_DESCR
/end CHARACTERISTIC
/begin CHARACTERISTIC ip_t_sap_off__tco_st__km_ctr "IP_T_SAP_OFF" MAP 0x7c13e a_50 10 LINEAR______0_100000__1H___6553_ 0.1 6553.5
 /begin AXIS_DESCR COM_AXIS km_ctr LINEAR______0_000000__0H___65534 4 0.0 655340.0 AXIS_PTS_REF ldpm_km_ctr_1 MAX_GRAD 100 MONOTONY MON_INCREASE /end AXIS_DESCR
 /begin AXIS_DESCR COM_AXIS tco_st LINEAR_______48_000000__0H___142 8 -48.0 142.5 AXIS_PTS_REF ldpm_tco_st_7 MAX_GRAD 100 MONOTONY MON_INCREASE /end AXIS_DESCR
/end CHARACTERISTIC
/begin CHARACTERISTIC ip_t_sav_off__tco_st__km_ctr "IP_T_SAV_OFF" MAP 0x7c17e a_50 10 LINEAR______0_100000__1H___6553_ 0.1 6553.5
 /begin AXIS_DESCR COM_AXIS km_ctr LINEAR______0_000000__0H___65534 4 0.0 655340.0 AXIS_PTS_REF ldpm_km_ctr_1 MAX_GRAD 100 MONOTONY MON_INCREASE /end AXIS_DESCR
 /begin AXIS_DESCR COM_AXIS tco_st LINEAR_______48_000000__0H___142 8 -48.0 142.5 AXIS_PTS_REF ldpm_tco_st_7 MAX_GRAD 100 MONOTONY MON_INCREASE /end AXIS_DESCR
/end CHARACTERISTIC
/begin CHARACTERISTIC ip_t_seg_grd_end_aj__n "IP_T_SEG_GRD_END_AJ" CURVE 0x7c1be a_24 100 LINEAR_______0_125000__0H___0_12 -0.125 0.124996
 /begin AXIS_DESCR COM_AXIS n LINEAR______0_000000__0H___81612 10 0.0 8160.0 AXIS_PTS_REF ldpm_n_3 MAX_GRAD 100 MONOTONY MON_INCREASE /end AXIS_DESCR
/end CHARACTERISTIC
/begin CHARACTERISTIC ip_t_seg_grd_st_1_aj__n__maf "IP_T_SEG_GRD_ST_1_AJ" MAP 0x7c1d2 a_36 100 LINEAR_______0_125000__0H___0_00 -0.125 0.0
 /begin AXIS_DESCR COM_AXIS maf LINEAR______0_000000__0H___1389_ 3 0.0 1389.0 AXIS_PTS_REF ldpm_maf_12 MAX_GRAD 100 MONOTONY MON_INCREASE /end AXIS_DESCR
 /begin AXIS_DESCR COM_AXIS n LINEAR______0_000000__0H___81612 10 0.0 8160.0 AXIS_PTS_REF ldpm_n_3 MAX_GRAD 100 MONOTONY MON_INCREASE /end AXIS_DESCR
/end CHARACTERISTIC
/begin CHARACTERISTIC ip_t_seg_grd_st_2_aj__n__maf "IP_T_SEG_GRD_ST_2_AJ" MAP 0x7c20e a_36 100 LINEAR_______0_125000__0H___0_00 -0.125 0.0
 /begin AXIS_DESCR COM_AXIS maf LINEAR______0_000000__0H___1389_ 3 0.0 1389.0 AXIS_PTS_REF ldpm_maf_12 MAX_GRAD 100 MONOTONY MON_INCREASE /end AXIS_DESCR
 /begin AXIS_DESCR COM_AXIS n LINEAR______0_000000__0H___81612 10 0.0 8160.0 AXIS_PTS_REF ldpm_n_3 MAX_GRAD 100 MONOTONY MON_INCREASE /end AXIS_DESCR
/end CHARACTERISTIC
/begin CHARACTERISTIC ip_t_small_leak_test__ftl "IP_T_SMALL_LEAK_TEST" CURVE 0x7c24a a_3 10 LINEAR______0_000000__0H___6553_ 0.0 6553.5
 /begin AXIS_DESCR COM_AXIS ftl LINEAR______0_000000__0H___126_0 5 0.0 126.0 AXIS_PTS_REF ldp_ftl__t_small_leak_test MAX_GRAD 100 MONOTONY MON_INCREASE /end AXIS_DESCR
 FUNCTION_LIST DMTL /end CHARACTERISTIC
/begin CHARACTERISTIC ip_t_sum_min_ivvt_ex__toil "IP_T_SUM_MIN_IVVT_EX" CURVE 0x78062 a_1 100 LINEAR______5_000000__8H___159_3 5.0 159.375
 /begin AXIS_DESCR COM_AXIS toil LINEAR_______48_000000__0H___155 2 -48.0 155.0 AXIS_PTS_REF ldpm_toil_1 MAX_GRAD 100 MONOTONY MON_INCREASE /end AXIS_DESCR
/end CHARACTERISTIC
/begin CHARACTERISTIC ip_t_sum_min_ivvt_in__toil "IP_T_SUM_MIN_IVVT_IN" CURVE 0x78064 a_1 100 LINEAR______5_000000__8H___159_3 5.0 159.375
 /begin AXIS_DESCR COM_AXIS toil LINEAR_______48_000000__0H___155 2 -48.0 155.0 AXIS_PTS_REF ldpm_toil_1 MAX_GRAD 100 MONOTONY MON_INCREASE /end AXIS_DESCR
/end CHARACTERISTIC
/begin CHARACTERISTIC ip_t_vls_cyc_afl_max__n__maf "IP_T_VLS_CYC_AFL_MAX" MAP 0x78078 a_31 100 LINEAR______0_000000__0H___51068 0.0 5100.0
 /begin AXIS_DESCR COM_AXIS maf LINEAR______0_000000__0H___13818 8 0.0 1389.0 AXIS_PTS_REF ldpm_maf_13 MAX_GRAD 100 MONOTONY MON_INCREASE /end AXIS_DESCR
 /begin AXIS_DESCR COM_AXIS n LINEAR______0_000000__0H___8160_ 8 0.0 8160.0 AXIS_PTS_REF ldpm_n_32_1 MAX_GRAD 100 MONOTONY MON_INCREASE /end AXIS_DESCR
/end CHARACTERISTIC
/begin CHARACTERISTIC ip_t_vls_cyc_afr_max__n__maf "IP_T_VLS_CYC_AFR_MAX" MAP 0x780b8 a_31 100 LINEAR______0_000000__0H___51068 0.0 5100.0
 /begin AXIS_DESCR COM_AXIS maf LINEAR______0_000000__0H___13818 8 0.0 1389.0 AXIS_PTS_REF ldpm_maf_13 MAX_GRAD 100 MONOTONY MON_INCREASE /end AXIS_DESCR
 /begin AXIS_DESCR COM_AXIS n LINEAR______0_000000__0H___8160_ 8 0.0 8160.0 AXIS_PTS_REF ldpm_n_32_1 MAX_GRAD 100 MONOTONY MON_INCREASE /end AXIS_DESCR
/end CHARACTERISTIC
/begin CHARACTERISTIC ip_t_vls_cycnr_afl_max__n__maf "IP_T_VLS_CYCNR_AFL_MAX" MAP 0x780f8 a_31 100 LINEAR______0_000000__0H___2550_ 0.0 2550.0
 /begin AXIS_DESCR COM_AXIS maf LINEAR______0_000000__0H___13818 8 0.0 1389.0 AXIS_PTS_REF ldpm_maf_13 MAX_GRAD 100 MONOTONY MON_INCREASE /end AXIS_DESCR
 /begin AXIS_DESCR COM_AXIS n LINEAR______0_000000__0H___8160_ 8 0.0 8160.0 AXIS_PTS_REF ldpm_n_32_1 MAX_GRAD 100 MONOTONY MON_INCREASE /end AXIS_DESCR
/end CHARACTERISTIC
/begin CHARACTERISTIC ip_t_vls_cycnr_afr_max__n__maf "IP_T_VLS_CYCNR_AFR_MAX" MAP 0x78138 a_31 100 LINEAR______0_000000__0H___2550_ 0.0 2550.0
 /begin AXIS_DESCR COM_AXIS maf LINEAR______0_000000__0H___13818 8 0.0 1389.0 AXIS_PTS_REF ldpm_maf_13 MAX_GRAD 100 MONOTONY MON_INCREASE /end AXIS_DESCR
 /begin AXIS_DESCR COM_AXIS n LINEAR______0_000000__0H___8160_ 8 0.0 8160.0 AXIS_PTS_REF ldpm_n_32_1 MAX_GRAD 100 MONOTONY MON_INCREASE /end AXIS_DESCR
/end CHARACTERISTIC
/begin CHARACTERISTIC ip_tco_raw__v_tco "IP_TCO_RAW" CURVE 0x78178 a_7 15 LINEAR_______48_000000__0H___142 -48.0 142.5
 /begin AXIS_DESCR COM_AXIS dummy_b LINEAR______0_078000__10H___4_99 16 0.078 4.995 AXIS_PTS_REF ldp_v_tco__tco MAX_GRAD 100 MONOTONY MON_INCREASE /end AXIS_DESCR
/end CHARACTERISTIC
/begin CHARACTERISTIC ip_tco_sub_inc__maf_kgh "IP_TCO_SUB_INC" CURVE 0x78188 a_7 20 LINEAR______0_750000__1H___190_5 0.75 190.5
 /begin AXIS_DESCR COM_AXIS maf_kgh LINEAR______0_250000__1H___16383 4 0.25 16383.75 AXIS_PTS_REF ldp_maf_kgh__tco_sub_inc MAX_GRAD 100 MONOTONY MON_INCREASE /end AXIS_DESCR
/end CHARACTERISTIC
/begin CHARACTERISTIC ip_td_300__vb "IP_TD_300" CURVE 0x7c374 a_3 100 LINEAR______0_000000__0H___66_66 0.0 66.666666
 /begin AXIS_DESCR COM_AXIS vb LINEAR______0_000000__0H___26_00 8 0.0 26.0 AXIS_PTS_REF ldpm_vb_1 MAX_GRAD 100 MONOTONY MON_INCREASE /end AXIS_DESCR
/end CHARACTERISTIC
/begin CHARACTERISTIC ip_td_ign_mpl_300__vb "IP_TD_IGN_MPL_300" CURVE 0x7c384 a_3 100 LINEAR______0_000000__0H___30_00 0.0 30.0
 /begin AXIS_DESCR COM_AXIS vb LINEAR______0_000000__0H___26_00 8 0.0 26.0 AXIS_PTS_REF ldpm_vb_1 MAX_GRAD 100 MONOTONY MON_INCREASE /end AXIS_DESCR
/end CHARACTERISTIC
/begin CHARACTERISTIC ip_td_ign_mpl_pc__vb "IP_TD_IGN_MPL_PC" CURVE 0x7c394 a_3 100 LINEAR______0_000000__0H___30_00 0.0 30.0
 /begin AXIS_DESCR COM_AXIS vb LINEAR______0_000000__0H___26_00 8 0.0 26.0 AXIS_PTS_REF ldpm_vb_1 MAX_GRAD 100 MONOTONY MON_INCREASE /end AXIS_DESCR
/end CHARACTERISTIC
/begin CHARACTERISTIC ip_td_pc__vb "IP_TD_PC" CURVE 0x7c3a4 a_3 100 LINEAR______0_000000__0H___66_66 0.0 66.666666
 /begin AXIS_DESCR COM_AXIS vb LINEAR______0_000000__0H___26_00 8 0.0 26.0 AXIS_PTS_REF ldpm_vb_1 MAX_GRAD 100 MONOTONY MON_INCREASE /end AXIS_DESCR
/end CHARACTERISTIC
/begin CHARACTERISTIC ip_teg__v_teg "IP_TEG" CURVE 0x7c3b4 a_24 100 LINEAR______0_000000__0H___10253 0.0 1023.9844
 /begin AXIS_DESCR COM_AXIS dummy_w LINEAR______0_000000__0H___4_995 16 0.0 4.9951172 AXIS_PTS_REF ldp_v_teg__ip_teg MAX_GRAD 100 MONOTONY MON_INCREASE /end AXIS_DESCR
/end CHARACTERISTIC
/begin CHARACTERISTIC ip_temp_exoth__tempmmvexupi "IP_TEMP_EXOTH" CURVE 0x7818c a_7 100 LINEAR______0_000000__0H___7_968 0.0 7.96875
 /begin AXIS_DESCR COM_AXIS dummy_w LINEAR_______33_000000__0H___989 8 -33.0 989.9844 AXIS_PTS_REF ldpm_temp_mmv_sub_ex_up_i_2 MAX_GRAD 100 MONOTONY MON_INCREASE /end AXIS_DESCR
 FUNCTION_LIST ETM /end CHARACTERISTIC
/begin CHARACTERISTIC ip_temp_fac_ex_down__tes__tam "IP_TEMP_FAC_EX_DOWN" MAP 0x78194 a_39 100 LINEAR______0_000000__0H___0_996 0.0 0.99609375
 /begin AXIS_DESCR COM_AXIS tam_dew LINEAR_______128_000000__0H___12 6 -128.0 127.0 AXIS_PTS_REF ldpm_tam_dew_1 MAX_GRAD 100 MONOTONY MON_INCREASE /end AXIS_DESCR
 /begin AXIS_DESCR COM_AXIS t_es_dew LINEAR______0_000000__0H___65563 8 0.0 65535.0 AXIS_PTS_REF ldpm_t_es_dew_1 MAX_GRAD 100 MONOTONY MON_INCREASE /end AXIS_DESCR
 FUNCTION_LIST ETM /end CHARACTERISTIC
/begin CHARACTERISTIC ip_temp_fac_ex_up__tes__tam "IP_TEMP_FAC_EX_UP" MAP 0x781c4 a_39 100 LINEAR______0_000000__0H___0_996 0.0 0.99609375
 /begin AXIS_DESCR COM_AXIS tam_dew LINEAR_______128_000000__0H___12 6 -128.0 127.0 AXIS_PTS_REF ldpm_tam_dew_1 MAX_GRAD 100 MONOTONY MON_INCREASE /end AXIS_DESCR
 /begin AXIS_DESCR COM_AXIS t_es_dew LINEAR______0_000000__0H___65563 8 0.0 65535.0 AXIS_PTS_REF ldpm_t_es_dew_1 MAX_GRAD 100 MONOTONY MON_INCREASE /end AXIS_DESCR
 FUNCTION_LIST ETM /end CHARACTERISTIC
/begin CHARACTERISTIC ip_temp_fac_maf_fac_ti_dif__maf "IP_TEMP_FAC_MAF_FAC_TI_DIF" CURVE 0x781f4 a_7 100 LINEAR______0_000000__0H___1_992 0.0 1.9921875
 /begin AXIS_DESCR COM_AXIS maf LINEAR______0_000000__0H___13818 8 0.0 1389.0 AXIS_PTS_REF ldpm_maf_17 MAX_GRAD 100 MONOTONY MON_INCREASE /end AXIS_DESCR
 FUNCTION_LIST ETM /end CHARACTERISTIC
/begin CHARACTERISTIC ip_temp_fac_maf_iga_dif__maf "IP_TEMP_FAC_MAF_IGA_DIF" CURVE 0x781fc a_7 100 LINEAR______0_000000__0H___1_992 0.0 1.9921875
 /begin AXIS_DESCR COM_AXIS maf LINEAR______0_000000__0H___13818 8 0.0 1389.0 AXIS_PTS_REF ldpm_maf_17 MAX_GRAD 100 MONOTONY MON_INCREASE /end AXIS_DESCR
 FUNCTION_LIST ETM /end CHARACTERISTIC
/begin CHARACTERISTIC ip_temp_fac_maf_vs__maf "IP_TEMP_FAC_MAF_VS" CURVE 0x78204 a_7 100 LINEAR______0_000000__0H___1_992 0.0 1.9921875
 /begin AXIS_DESCR COM_AXIS maf LINEAR______0_000000__0H___13818 8 0.0 1389.0 AXIS_PTS_REF ldpm_maf_17 MAX_GRAD 100 MONOTONY MON_INCREASE /end AXIS_DESCR
 FUNCTION_LIST ETM /end CHARACTERISTIC
/begin CHARACTERISTIC ip_temp_fac_tam__tempmmvsubexxi "IP_TEMP_FAC_TAM" CURVE 0x7820c a_7 100 LINEAR______0_000000__0H___0_996 0.0 0.99609375
 /begin AXIS_DESCR COM_AXIS dummy_w LINEAR_______33_000000__0H___989 8 -33.0 989.9844 AXIS_PTS_REF ldp_temp_mmv_sub_ex_x_i_1 MAX_GRAD 100 MONOTONY MON_INCREASE /end AXIS_DESCR
 FUNCTION_LIST ETM /end CHARACTERISTIC
/begin CHARACTERISTIC ip_temp_fac_tco__tco__toil "IP_TEMP_FAC_TCO__TCO__TOIL" MAP 0x78214 a_6 100 LINEAR______0_000000__0H___1_992 0.0 1.9921875
 /begin AXIS_DESCR COM_AXIS toil LINEAR_______48_000000__0H___155 8 -48.0 155.0 AXIS_PTS_REF ldpm_toil_5 MAX_GRAD 100 MONOTONY MON_INCREASE /end AXIS_DESCR
 /begin AXIS_DESCR COM_AXIS tco LINEAR_______48_000000__0H___142 6 -48.0 142.5 AXIS_PTS_REF ldpm_tco_23 MAX_GRAD 100 MONOTONY MON_INCREASE /end AXIS_DESCR
 FUNCTION_LIST ETM /end CHARACTERISTIC
/begin CHARACTERISTIC ip_temp_fac_wall_down__tes__tam "IP_TEMP_FAC_WALL_DOWN" MAP 0x7824c a_39 100 LINEAR______0_000000__0H___0_996 0.0 0.99609375
 /begin AXIS_DESCR COM_AXIS tam_dew LINEAR_______128_000000__0H___12 6 -128.0 127.0 AXIS_PTS_REF ldpm_tam_dew_1 MAX_GRAD 100 MONOTONY MON_INCREASE /end AXIS_DESCR
 /begin AXIS_DESCR COM_AXIS t_es_dew LINEAR______0_000000__0H___65563 8 0.0 65535.0 AXIS_PTS_REF ldpm_t_es_dew_1 MAX_GRAD 100 MONOTONY MON_INCREASE /end AXIS_DESCR
 FUNCTION_LIST DPM /end CHARACTERISTIC
/begin CHARACTERISTIC ip_temp_fac_wall_up__tes__tam "IP_TEMP_FAC_WALL_UP" MAP 0x7827c a_39 100 LINEAR______0_000000__0H___0_996 0.0 0.99609375
 /begin AXIS_DESCR COM_AXIS tam_dew LINEAR_______128_000000__0H___12 6 -128.0 127.0 AXIS_PTS_REF ldpm_tam_dew_1 MAX_GRAD 100 MONOTONY MON_INCREASE /end AXIS_DESCR
 /begin AXIS_DESCR COM_AXIS t_es_dew LINEAR______0_000000__0H___65563 8 0.0 65535.0 AXIS_PTS_REF ldpm_t_es_dew_1 MAX_GRAD 100 MONOTONY MON_INCREASE /end AXIS_DESCR
 FUNCTION_LIST DPM /end CHARACTERISTIC
/begin CHARACTERISTIC ip_temp_iga_dif_up__n__iga_dif_i "IP_TEMP_IGA_DIF_UP" MAP 0x7c524 a_36 100 LINEAR______0_000000__0H___10253 0.0 1023.9844
 /begin AXIS_DESCR COM_AXIS dummy_b LINEAR______0_000000__0H___95_22 6 0.0 95.625 AXIS_PTS_REF ldpm_iga_dif_1 MAX_GRAD 100 MONOTONY MON_INCREASE /end AXIS_DESCR
 /begin AXIS_DESCR COM_AXIS n LINEAR______0_000000__0H___81612 8 0.0 8160.0 AXIS_PTS_REF ldpm_n_17 MAX_GRAD 100 MONOTONY MON_INCREASE /end AXIS_DESCR
 FUNCTION_LIST ETM /end CHARACTERISTIC
/begin CHARACTERISTIC ip_temp_sap_up__saf_kgh__maf_kgh "IP_TEMP_SAP_UP" MAP 0x7c584 a_28 100 LINEAR_______1023_984375__FFFFH_ -1023.9847 0.0
 /begin AXIS_DESCR COM_AXIS maf_kgh LINEAR______0_000000__0H___16383 6 0.0 16383.75 AXIS_PTS_REF ldpm_maf_kgh_18 MAX_GRAD 100 MONOTONY MON_INCREASE /end AXIS_DESCR
 /begin AXIS_DESCR COM_AXIS saf_kgh LINEAR______0_000000__0H___10269 6 0.0 1023.9844 AXIS_PTS_REF ldp_saf_kgh__temp_sap_up MAX_GRAD 100 MONOTONY MON_INCREASE /end AXIS_DESCR
 FUNCTION_LIST ETM /end CHARACTERISTIC
/begin CHARACTERISTIC ip_temp_sp_tco__n__maf "IP_TEMP_SP_TCO" MAP 0x782ac a_17 100 LINEAR_______48_000000__0H___142 -48.0 142.5
 /begin AXIS_DESCR COM_AXIS maf LINEAR______0_000000__0H___13818 8 0.0 1389.0 AXIS_PTS_REF ldpm_maf_17 MAX_GRAD 100 MONOTONY MON_INCREASE /end AXIS_DESCR
 /begin AXIS_DESCR COM_AXIS n LINEAR______0_000000__0H___81612 8 0.0 8160.0 AXIS_PTS_REF ldpm_n_17 MAX_GRAD 100 MONOTONY MON_INCREASE /end AXIS_DESCR
 FUNCTION_LIST ETM /end CHARACTERISTIC
/begin CHARACTERISTIC ip_temp_sp_toil__n__maf "IP_TEMP_SP_TOIL" MAP 0x782ec a_17 100 LINEAR_______48_000000__0H___155 -48.0 155.0
 /begin AXIS_DESCR COM_AXIS maf LINEAR______0_000000__0H___13818 8 0.0 1389.0 AXIS_PTS_REF ldpm_maf_17 MAX_GRAD 100 MONOTONY MON_INCREASE /end AXIS_DESCR
 /begin AXIS_DESCR COM_AXIS n LINEAR______0_000000__0H___81612 8 0.0 8160.0 AXIS_PTS_REF ldpm_n_17 MAX_GRAD 100 MONOTONY MON_INCREASE /end AXIS_DESCR
 FUNCTION_LIST ETM /end CHARACTERISTIC
/begin CHARACTERISTIC ip_temp_sub_cat_min_cop__iga_dif "IP_TEMP_SUB_CAT_MIN_COP" CURVE 0x7832c a_1 100 LINEAR_______33_000000__0H___987 -33.0 987.0
 /begin AXIS_DESCR COM_AXIS dummy_b LINEAR______0_000000__0H___95_22 4 0.0 95.625 AXIS_PTS_REF ldp_iga_dif__tmpsubcatmincop MAX_GRAD 100 MONOTONY MON_INCREASE /end AXIS_DESCR
/end CHARACTERISTIC
/begin CHARACTERISTIC ip_temp_sub_ecf_ini__tco__tam "IP_TEMP_SUB_ECF_INI" MAP 0x78334 a_6 100 LINEAR_______33_000000__0H___987 -33.0 987.0
 /begin AXIS_DESCR COM_AXIS tam LINEAR_______128_000000__0H___12 6 -128.0 127.0 AXIS_PTS_REF ldp_tam__temp_sub_ecf_ini MAX_GRAD 100 MONOTONY MON_INCREASE /end AXIS_DESCR
 /begin AXIS_DESCR COM_AXIS tco LINEAR_______48_000000__0H___142 6 -48.0 142.5 AXIS_PTS_REF ldp_tco__temp_sub_ecf_ini MAX_GRAD 100 MONOTONY MON_INCREASE /end AXIS_DESCR
/end CHARACTERISTIC
/begin CHARACTERISTIC ip_temp_sub_ivvt_fl_up_1__n "IP_TEMP_SUB_IVVT_FL_UP_1" CURVE 0x7c5cc a_24 100 LINEAR_______33_000000__0H___989 -33.0 989.9844
 /begin AXIS_DESCR COM_AXIS n LINEAR______0_000000__0H___81612 16 0.0 8160.0 AXIS_PTS_REF ldpm_n_11 MAX_GRAD 100 MONOTONY MON_INCREASE /end AXIS_DESCR
 FUNCTION_LIST ETM /end CHARACTERISTIC
/begin CHARACTERISTIC ip_temp_sub_ivvt_fl_up_2__n "IP_TEMP_SUB_IVVT_FL_UP_2" CURVE 0x7c5ec a_24 100 LINEAR_______33_000000__0H___989 -33.0 989.9844
 /begin AXIS_DESCR COM_AXIS n LINEAR______0_000000__0H___81612 16 0.0 8160.0 AXIS_PTS_REF ldpm_n_11 MAX_GRAD 100 MONOTONY MON_INCREASE /end AXIS_DESCR
 FUNCTION_LIST ETM /end CHARACTERISTIC
/begin CHARACTERISTIC ip_temp_sub_puc_up_1__maf_kgh "IP_TEMP_SUB_PUC_UP_1" CURVE 0x7c60c a_24 100 LINEAR_______33_000000__0H___989 -33.0 989.9844
 /begin AXIS_DESCR COM_AXIS maf_kgh LINEAR______0_000000__0H___16383 8 0.0 16383.75 AXIS_PTS_REF ldpm_maf_kgh_17 MAX_GRAD 100 MONOTONY MON_INCREASE /end AXIS_DESCR
 FUNCTION_LIST ETM /end CHARACTERISTIC
/begin CHARACTERISTIC ip_temp_sub_puc_up_2__maf_kgh "IP_TEMP_SUB_PUC_UP_2" CURVE 0x7c61c a_24 100 LINEAR_______33_000000__0H___989 -33.0 989.9844
 /begin AXIS_DESCR COM_AXIS maf_kgh LINEAR______0_000000__0H___16383 8 0.0 16383.75 AXIS_PTS_REF ldpm_maf_kgh_17 MAX_GRAD 100 MONOTONY MON_INCREASE /end AXIS_DESCR
 FUNCTION_LIST ETM /end CHARACTERISTIC
/begin CHARACTERISTIC ip_temp_sub_up_1__n__maf "IP_TEMP_SUB_UP_1" MAP 0x7c62c a_28 100 LINEAR_______33_000000__0H___989 -33.0 989.9844
 /begin AXIS_DESCR COM_AXIS maf LINEAR______0_000000__0H___13818 8 0.0 1389.0 AXIS_PTS_REF ldpm_maf_17 MAX_GRAD 100 MONOTONY MON_INCREASE /end AXIS_DESCR
 /begin AXIS_DESCR COM_AXIS n LINEAR______0_000000__0H___81612 8 0.0 8160.0 AXIS_PTS_REF ldpm_n_17 MAX_GRAD 100 MONOTONY MON_INCREASE /end AXIS_DESCR
 FUNCTION_LIST ETM /end CHARACTERISTIC
/begin CHARACTERISTIC ip_temp_sub_up_2__n__maf "IP_TEMP_SUB_UP_2" MAP 0x7c6ac a_28 100 LINEAR_______33_000000__0H___989 -33.0 989.9844
 /begin AXIS_DESCR COM_AXIS maf LINEAR______0_000000__0H___13818 8 0.0 1389.0 AXIS_PTS_REF ldpm_maf_17 MAX_GRAD 100 MONOTONY MON_INCREASE /end AXIS_DESCR
 /begin AXIS_DESCR COM_AXIS n LINEAR______0_000000__0H___81612 8 0.0 8160.0 AXIS_PTS_REF ldpm_n_17 MAX_GRAD 100 MONOTONY MON_INCREASE /end AXIS_DESCR
 FUNCTION_LIST ETM /end CHARACTERISTIC
/begin CHARACTERISTIC ip_temp_sub_vs_up_1__n__vs "IP_TEMP_SUB_VS_UP_1" MAP 0x7c72c a_36 100 LINEAR_______512_000000__0H___51 -512.0 511.98438
 /begin AXIS_DESCR COM_AXIS vs LINEAR______0_000000__0H___25511 6 0.0 255.0 AXIS_PTS_REF ldpm_vs_17 MAX_GRAD 100 MONOTONY MON_INCREASE /end AXIS_DESCR
 /begin AXIS_DESCR COM_AXIS n LINEAR______0_000000__0H___81612 8 0.0 8160.0 AXIS_PTS_REF ldpm_n_17 MAX_GRAD 100 MONOTONY MON_INCREASE /end AXIS_DESCR
 FUNCTION_LIST ETM /end CHARACTERISTIC
/begin CHARACTERISTIC ip_temp_sub_vs_up_2__n__vs "IP_TEMP_SUB_VS_UP_2" MAP 0x7c78c a_36 100 LINEAR_______512_000000__0H___51 -512.0 511.98438
 /begin AXIS_DESCR COM_AXIS vs LINEAR______0_000000__0H___25511 6 0.0 255.0 AXIS_PTS_REF ldpm_vs_17 MAX_GRAD 100 MONOTONY MON_INCREASE /end AXIS_DESCR
 /begin AXIS_DESCR COM_AXIS n LINEAR______0_000000__0H___81612 8 0.0 8160.0 AXIS_PTS_REF ldpm_n_17 MAX_GRAD 100 MONOTONY MON_INCREASE /end AXIS_DESCR
 FUNCTION_LIST ETM /end CHARACTERISTIC
/begin CHARACTERISTIC ip_temp_sub_wall_ivvt_fl_up_1__n "IP_TEMP_SUB_WALL_IVVT_FL_UP_1" CURVE 0x7c7ec a_24 100 LINEAR_______33_000000__0H___989 -33.0 989.9844
 /begin AXIS_DESCR COM_AXIS n LINEAR______0_000000__0H___81612 16 0.0 8160.0 AXIS_PTS_REF ldpm_n_11 MAX_GRAD 100 MONOTONY MON_INCREASE /end AXIS_DESCR
 FUNCTION_LIST ETM /end CHARACTERISTIC
/begin CHARACTERISTIC ip_temp_sub_wall_ivvt_fl_up_2__n "IP_TEMP_SUB_WALL_IVVT_FL_UP_2" CURVE 0x7c80c a_24 100 LINEAR_______33_000000__0H___989 -33.0 989.9844
 /begin AXIS_DESCR COM_AXIS n LINEAR______0_000000__0H___81612 16 0.0 8160.0 AXIS_PTS_REF ldpm_n_11 MAX_GRAD 100 MONOTONY MON_INCREASE /end AXIS_DESCR
 FUNCTION_LIST ETM /end CHARACTERISTIC
/begin CHARACTERISTIC ip_temp_sub_wall_up_1__n__maf "IP_TEMP_SUB_WALL_UP_1" MAP 0x7c84c a_28 100 LINEAR_______33_000000__0H___989 -33.0 989.9844
 /begin AXIS_DESCR COM_AXIS maf LINEAR______0_000000__0H___13818 8 0.0 1389.0 AXIS_PTS_REF ldpm_maf_17 MAX_GRAD 100 MONOTONY MON_INCREASE /end AXIS_DESCR
 /begin AXIS_DESCR COM_AXIS n LINEAR______0_000000__0H___81612 8 0.0 8160.0 AXIS_PTS_REF ldpm_n_17 MAX_GRAD 100 MONOTONY MON_INCREASE /end AXIS_DESCR
 FUNCTION_LIST ETM /end CHARACTERISTIC
/begin CHARACTERISTIC ip_temp_sub_wall_up_2__n__maf "IP_TEMP_SUB_WALL_UP_2" MAP 0x7c8cc a_28 100 LINEAR_______33_000000__0H___989 -33.0 989.9844
 /begin AXIS_DESCR COM_AXIS maf LINEAR______0_000000__0H___13818 8 0.0 1389.0 AXIS_PTS_REF ldpm_maf_17 MAX_GRAD 100 MONOTONY MON_INCREASE /end AXIS_DESCR
 /begin AXIS_DESCR COM_AXIS n LINEAR______0_000000__0H___81612 8 0.0 8160.0 AXIS_PTS_REF ldpm_n_17 MAX_GRAD 100 MONOTONY MON_INCREASE /end AXIS_DESCR
 FUNCTION_LIST ETM /end CHARACTERISTIC
/begin CHARACTERISTIC ip_temp_sub_wall_vs_up_1__n__vs "IP_TEMP_SUB_WALL_VS_UP_1" MAP 0x7c94c a_36 100 LINEAR_______512_000000__0H___51 -512.0 511.98438
 /begin AXIS_DESCR COM_AXIS vs LINEAR______0_000000__0H___25511 6 0.0 255.0 AXIS_PTS_REF ldpm_vs_17 MAX_GRAD 100 MONOTONY MON_INCREASE /end AXIS_DESCR
 /begin AXIS_DESCR COM_AXIS n LINEAR______0_000000__0H___81612 8 0.0 8160.0 AXIS_PTS_REF ldpm_n_17 MAX_GRAD 100 MONOTONY MON_INCREASE /end AXIS_DESCR
 FUNCTION_LIST ETM /end CHARACTERISTIC
/begin CHARACTERISTIC ip_temp_sub_wall_vs_up_2__n__vs "IP_TEMP_SUB_WALL_VS_UP_2" MAP 0x7c9ac a_36 100 LINEAR_______512_000000__0H___51 -512.0 511.98438
 /begin AXIS_DESCR COM_AXIS vs LINEAR______0_000000__0H___25511 6 0.0 255.0 AXIS_PTS_REF ldpm_vs_17 MAX_GRAD 100 MONOTONY MON_INCREASE /end AXIS_DESCR
 /begin AXIS_DESCR COM_AXIS n LINEAR______0_000000__0H___81612 8 0.0 8160.0 AXIS_PTS_REF ldpm_n_17 MAX_GRAD 100 MONOTONY MON_INCREASE /end AXIS_DESCR
 FUNCTION_LIST ETM /end CHARACTERISTIC
/begin CHARACTERISTIC ip_temp_wall_exoth__tmpmmvexupi "IP_TEMP_WALL_EXOTH" CURVE 0x78358 a_7 100 LINEAR______0_000000__0H___7_968 0.0 7.96875
 /begin AXIS_DESCR COM_AXIS dummy_w LINEAR_______33_000000__0H___989 8 -33.0 989.9844 AXIS_PTS_REF ldpm_temp_mmv_sub_ex_up_i_2 MAX_GRAD 100 MONOTONY MON_INCREASE /end AXIS_DESCR
 FUNCTION_LIST ETM /end CHARACTERISTIC
/begin CHARACTERISTIC ip_temp_wall_fac_maf_vs__maf "IP_TEMP_WALL_FAC_MAF_VS" CURVE 0x78370 a_7 100 LINEAR______0_000000__0H___1_992 0.0 1.9921875
 /begin AXIS_DESCR COM_AXIS maf LINEAR______0_000000__0H___13818 8 0.0 1389.0 AXIS_PTS_REF ldpm_maf_17 MAX_GRAD 100 MONOTONY MON_INCREASE /end AXIS_DESCR
 FUNCTION_LIST ETM /end CHARACTERISTIC
/begin CHARACTERISTIC ip_temp_wall_fac_tam__tempmmvxi "IP_TEMP_WALL_FAC_TAM" CURVE 0x78378 a_7 100 LINEAR______0_000000__0H___0_996 0.0 0.99609375
 /begin AXIS_DESCR COM_AXIS dummy_w LINEAR_______33_000000__0H___989 8 -33.0 989.9844 AXIS_PTS_REF ldp_temp_mmv_sub_wall_x_i_1 MAX_GRAD 100 MONOTONY MON_INCREASE /end AXIS_DESCR
 FUNCTION_LIST ETM /end CHARACTERISTIC
/begin CHARACTERISTIC ip_temp_wall_fac_tco__tco__toil "IP_TEMP_WALL_FAC_TCO_TCO_TOIL" MAP 0x78380 a_6 100 LINEAR______0_000000__0H___1_992 0.0 1.9921875
 /begin AXIS_DESCR COM_AXIS toil LINEAR_______48_000000__0H___155 8 -48.0 155.0 AXIS_PTS_REF ldpm_toil_5 MAX_GRAD 100 MONOTONY MON_INCREASE /end AXIS_DESCR
 /begin AXIS_DESCR COM_AXIS tco LINEAR_______48_000000__0H___142 6 -48.0 142.5 AXIS_PTS_REF ldpm_tco_23 MAX_GRAD 100 MONOTONY MON_INCREASE /end AXIS_DESCR
 FUNCTION_LIST ETM /end CHARACTERISTIC
/begin CHARACTERISTIC ip_tgas_l "TGAS_L" CURVE 0x783b8 a_1 100 LINEAR_______48_000000__0H___143 -48.0 143.25
 /begin AXIS_DESCR COM_AXIS dummy_b LINEAR______0_000000__0H___4_980 10 0.0 4.9804688 AXIS_PTS_REF ldp_v_tgas_l__tgas_l MAX_GRAD 100 MONOTONY MON_INCREASE /end AXIS_DESCR
 FUNCTION_LIST CNG /end CHARACTERISTIC
/begin CHARACTERISTIC ip_tgas_pcd "IP_TGAS_PCD" CURVE 0x783c2 a_1 100 LINEAR_______48_000000__0H___170 -48.0 143.25
 /begin AXIS_DESCR COM_AXIS dummy_b LINEAR______0_000000__0H___4_980 10 0.0 4.9804688 AXIS_PTS_REF ldp_v_tgas_pcd__tgas_pcd MAX_GRAD 100 MONOTONY MON_INCREASE /end AXIS_DESCR
 FUNCTION_LIST CNG /end CHARACTERISTIC
/begin CHARACTERISTIC ip_thd_at_er__n_32__maf "IP_THD_AT_ER" MAP 0x7cc04 a_50 5 LINEAR_______1_000000__1H____218 -21844.0 -1.0
 /begin AXIS_DESCR COM_AXIS maf LINEAR______0_000000__0H___13818 6 0.0 1389.0 AXIS_PTS_REF ldpm_maf_2 MAX_GRAD 100 MONOTONY MON_INCREASE /end AXIS_DESCR
 /begin AXIS_DESCR COM_AXIS n LINEAR______0_000000__0H___8160_ 12 0.0 8160.0 AXIS_PTS_REF ldp_n_32__thd_at_er MAX_GRAD 100 MONOTONY MON_INCREASE /end AXIS_DESCR
/end CHARACTERISTIC
/begin CHARACTERISTIC ip_thd_er_is__n__maf "IP_THD_ER_IS" MAP 0x7cc94 a_28 5 LINEAR_______1_000000__1H____218 -21844.0 -1.0
 /begin AXIS_DESCR COM_AXIS maf LINEAR______0_000000__0H___13818 6 0.0 1389.0 AXIS_PTS_REF ldp_maf__thd_er_is MAX_GRAD 100 MONOTONY MON_INCREASE /end AXIS_DESCR
 /begin AXIS_DESCR COM_AXIS n LINEAR______0_000000__0H___81612 4 0.0 8160.0 AXIS_PTS_REF ldp_n__thd_er_is MAX_GRAD 100 MONOTONY MON_INCREASE /end AXIS_DESCR
/end CHARACTERISTIC
/begin CHARACTERISTIC ip_thd_er_is_diag__n__maf "IP_THD_ER_IS_DIAG" MAP 0x7ccc4 a_36 5 LINEAR_______1_000000__1H____218 -21844.0 -1.0
 /begin AXIS_DESCR COM_AXIS maf LINEAR______0_000000__0H___1389_ 4 0.0 1389.0 AXIS_PTS_REF ldp_maf__thd_er_is_diag MAX_GRAD 7 MONOTONY MON_INCREASE /end AXIS_DESCR
 /begin AXIS_DESCR COM_AXIS n LINEAR______0_000000__0H___81612 4 0.0 8160.0 AXIS_PTS_REF ldp_n__thd_er_is_diag MAX_GRAD 12 MONOTONY MON_INCREASE /end AXIS_DESCR
/end CHARACTERISTIC
/begin CHARACTERISTIC ip_thd_mt_er__n_32__maf "IP_THD_MT_ER" MAP 0x7cce4 a_50 5 LINEAR_______1_000000__1H____218 -21844.0 -1.0
 /begin AXIS_DESCR COM_AXIS maf LINEAR______0_000000__0H___13818 6 0.0 1389.0 AXIS_PTS_REF ldpm_maf_2 MAX_GRAD 100 MONOTONY MON_INCREASE /end AXIS_DESCR
 /begin AXIS_DESCR COM_AXIS n LINEAR______0_000000__0H___8160_ 12 0.0 8160.0 AXIS_PTS_REF ldp_n_32__thd_mt_er MAX_GRAD 100 MONOTONY MON_INCREASE /end AXIS_DESCR
/end CHARACTERISTIC
/begin CHARACTERISTIC ip_ti_ad_add_fac__tco__ti_ad_add "IP_TI_AD_ADD_FAC" MAP 0x783cc a_31 20 LINEAR______0_000000__0H___0_996 0.0 0.99609375
 /begin AXIS_DESCR COM_AXIS dummy_b LINEAR_______4_995000__7C57H___5 5 -4.9949999 5.0 AXIS_PTS_REF ldp_ti_ad_add_mmv MAX_GRAD 100 MONOTONY MON_INCREASE /end AXIS_DESCR
 /begin AXIS_DESCR COM_AXIS tco LINEAR_______48_000000__0H___142 5 -48.0 142.5 AXIS_PTS_REF ldpm_tco_9 MAX_GRAD 100 MONOTONY MON_INCREASE /end AXIS_DESCR
/end CHARACTERISTIC
/begin CHARACTERISTIC ip_ti_ad_cyl__vls_dif_val "IP_TI_AD_CYL" CURVE 0x7cd74 a_24 100 LINEAR_______50_000000__0H___440 -50.0 49.998471
 /begin AXIS_DESCR COM_AXIS dummy_w LINEAR_______0_637500__0H___0_71 8 -0.6375 0.6375 AXIS_PTS_REF ldp_vls_dif_val__ti_ad_cyl MAX_GRAD 100 MONOTONY MON_INCREASE /end AXIS_DESCR
 FUNCTION_LIST CSCM /end CHARACTERISTIC
/begin CHARACTERISTIC ip_ti_ad_fac_fac__tco__ti_ad_fac "IP_TI_AD_FAC_FAC" MAP 0x783e5 a_31 20 LINEAR______0_000000__0H___0_996 0.0 0.99609375
 /begin AXIS_DESCR COM_AXIS dummy_b LINEAR_______31_250000__3000H___ 5 -31.25 31.25 AXIS_PTS_REF ldp_ti_ad_fac_mmv MAX_GRAD 100 MONOTONY MON_INCREASE /end AXIS_DESCR
 /begin AXIS_DESCR COM_AXIS tco LINEAR_______48_000000__0H___142 5 -48.0 142.5 AXIS_PTS_REF ldpm_tco_9 MAX_GRAD 100 MONOTONY MON_INCREASE /end AXIS_DESCR
/end CHARACTERISTIC
/begin CHARACTERISTIC ip_ti_add_cop_step_2__n__maf "IP_TI_ADD_COP_STEP_2" MAP 0x783fe a_6 10 LINEAR______0_000000__0H___0_996 0.0 0.99609375
 /begin AXIS_DESCR COM_AXIS maf LINEAR______0_000000__0H___1389_ 8 0.0 1389.0 AXIS_PTS_REF ldpm_maf_11 MAX_GRAD 100 MONOTONY MON_INCREASE /end AXIS_DESCR
 /begin AXIS_DESCR COM_AXIS n LINEAR______0_000000__0H___8160_ 10 0.0 8160.0 AXIS_PTS_REF ldpm_n_32_4 MAX_GRAD 100 MONOTONY MON_INCREASE /end AXIS_DESCR
/end CHARACTERISTIC
/begin CHARACTERISTIC ip_ti_add_dly__vb "IP_TI_ADD_DLY" CURVE 0x7844e a_1 10 LINEAR______0_000000__0H___10_88 0.0 10.88
 /begin AXIS_DESCR COM_AXIS vb LINEAR______0_000000__0H___26_00 8 0.0 26.0 AXIS_PTS_REF ldpm_vb_1 MAX_GRAD 100 MONOTONY MON_INCREASE /end AXIS_DESCR
/end CHARACTERISTIC
/begin CHARACTERISTIC ip_ti_add_dly_cng "TI_ADD_DLY_CNG" MAP 0x7cd84 a_9 100 LINEAR______0_000000__0H___349_5 0.0 349.52
 /begin AXIS_DESCR COM_AXIS dummy_b LINEAR_______48_000000__0H___143 10 -48.0 143.25 AXIS_PTS_REF ldpm_tgas_l MAX_GRAD 100 MONOTONY MON_INCREASE /end AXIS_DESCR
 /begin AXIS_DESCR COM_AXIS vb LINEAR______0_000000__0H___26_00 8 0.0 26.0 AXIS_PTS_REF ldpm_vb_1 MAX_GRAD 100 MONOTONY MON_INCREASE /end AXIS_DESCR
 FUNCTION_LIST CNG /end CHARACTERISTIC
/begin CHARACTERISTIC ip_ti_amp_cor__fac_amp "IP_TI_AMP_COR" CURVE 0x7ce24 a_3 100 LINEAR______0_000000__0H___2_054 0.0 2.0
 /begin AXIS_DESCR COM_AXIS fac_amp LINEAR______0_000000__0H___2_043 6 0.0 2.0 AXIS_PTS_REF ldp_fac_amp__ti_amp_cor MAX_GRAD 100 MONOTONY MON_INCREASE /end AXIS_DESCR
/end CHARACTERISTIC
/begin CHARACTERISTIC ip_ti_cast__tia__tco "IP_TI_CAST" MAP 0x78456 a_6 10 LINEAR______0_000000__0H___3_984 0.0 3.984375
 /begin AXIS_DESCR COM_AXIS tco LINEAR_______48_000000__0H___142 8 -48.0 142.5 AXIS_PTS_REF ldpm_tco_3 MAX_GRAD 100 MONOTONY MON_INCREASE /end AXIS_DESCR
 /begin AXIS_DESCR COM_AXIS tia LINEAR_______48_000000__0H___142 2 -48.0 142.5 AXIS_PTS_REF ldp_tia__ti_cast MAX_GRAD 100 MONOTONY MON_INCREASE /end AXIS_DESCR
/end CHARACTERISTIC
/begin CHARACTERISTIC ip_ti_cast_rest__tco "IP_TI_CAST_REST" CURVE 0x78466 a_1 10 LINEAR______0_500000__80H___0_99 0.5 0.99610001
 /begin AXIS_DESCR COM_AXIS tco LINEAR_______48_000000__0H___142 8 -48.0 142.5 AXIS_PTS_REF ldpm_tco_3 MAX_GRAD 100 MONOTONY MON_INCREASE /end AXIS_DESCR
/end CHARACTERISTIC
/begin CHARACTERISTIC ip_ti_cat_var__n__maf "IP_TI_CAT_VAR" MAP 0x7ce30 a_9 10 LINEAR______0_000000__0H___0_972 0.0 0.9961
 /begin AXIS_DESCR COM_AXIS maf LINEAR______0_000000__0H___1389_ 6 0.0 1389.0 AXIS_PTS_REF ldp_maf__ti_cat_var MAX_GRAD 100 MONOTONY MON_INCREASE /end AXIS_DESCR
 /begin AXIS_DESCR COM_AXIS n LINEAR______0_000000__0H___8160_ 6 0.0 8160.0 AXIS_PTS_REF ldp_n_32__ti_cat_var MAX_GRAD 100 MONOTONY MON_INCREASE /end AXIS_DESCR
/end CHARACTERISTIC
/begin CHARACTERISTIC ip_ti_ch__n__maf "IP_TI_CH__N" MAP 0x7846e a_6 15 LINEAR______0_000000__0H___0_996 0.0 0.99609375
 /begin AXIS_DESCR COM_AXIS maf LINEAR______0_000000__0H___1389_ 8 0.0 1389.0 AXIS_PTS_REF ldpm_maf_9 MAX_GRAD 100 MONOTONY MON_INCREASE /end AXIS_DESCR
 /begin AXIS_DESCR COM_AXIS n LINEAR______0_000000__0H___8160_ 8 0.0 8160.0 AXIS_PTS_REF ldpm_n_32_20 MAX_GRAD 100 MONOTONY MON_INCREASE /end AXIS_DESCR
/end CHARACTERISTIC
/begin CHARACTERISTIC ip_ti_cop_nr_1_1__n__maf "IP_TI_COP_NR_1_1" MAP 0x784ae a_6 10 LINEAR______0_000000__0H___0_996 0.0 0.99609375
 /begin AXIS_DESCR COM_AXIS maf LINEAR______0_000000__0H___1389_ 8 0.0 1389.0 AXIS_PTS_REF ldpm_maf_11 MAX_GRAD 100 MONOTONY MON_INCREASE /end AXIS_DESCR
 /begin AXIS_DESCR COM_AXIS n LINEAR______0_000000__0H___8160_ 10 0.0 8160.0 AXIS_PTS_REF ldpm_n_32_4 MAX_GRAD 100 MONOTONY MON_INCREASE /end AXIS_DESCR
/end CHARACTERISTIC
/begin CHARACTERISTIC ip_ti_cop_nr_1_2__n__maf "IP_TI_COP_NR_1_2" MAP 0x784fe a_6 10 LINEAR______0_000000__0H___0_996 0.0 0.99609375
 /begin AXIS_DESCR COM_AXIS maf LINEAR______0_000000__0H___1389_ 8 0.0 1389.0 AXIS_PTS_REF ldpm_maf_11 MAX_GRAD 100 MONOTONY MON_INCREASE /end AXIS_DESCR
 /begin AXIS_DESCR COM_AXIS n LINEAR______0_000000__0H___8160_ 10 0.0 8160.0 AXIS_PTS_REF ldpm_n_32_4 MAX_GRAD 100 MONOTONY MON_INCREASE /end AXIS_DESCR
/end CHARACTERISTIC
/begin CHARACTERISTIC ip_ti_cop_nr_2_1__n__maf "IP_TI_COP_NR_2_1" MAP 0x7854e a_6 10 LINEAR______0_000000__0H___0_996 0.0 0.99609375
 /begin AXIS_DESCR COM_AXIS maf LINEAR______0_000000__0H___1389_ 8 0.0 1389.0 AXIS_PTS_REF ldpm_maf_11 MAX_GRAD 100 MONOTONY MON_INCREASE /end AXIS_DESCR
 /begin AXIS_DESCR COM_AXIS n LINEAR______0_000000__0H___8160_ 10 0.0 8160.0 AXIS_PTS_REF ldpm_n_32_4 MAX_GRAD 100 MONOTONY MON_INCREASE /end AXIS_DESCR
/end CHARACTERISTIC
/begin CHARACTERISTIC ip_ti_cop_nr_2_2__n__maf "IP_TI_COP_NR_2_2" MAP 0x7859e a_6 10 LINEAR______0_000000__0H___0_996 0.0 0.99609375
 /begin AXIS_DESCR COM_AXIS maf LINEAR______0_000000__0H___1389_ 8 0.0 1389.0 AXIS_PTS_REF ldpm_maf_11 MAX_GRAD 100 MONOTONY MON_INCREASE /end AXIS_DESCR
 /begin AXIS_DESCR COM_AXIS n LINEAR______0_000000__0H___8160_ 10 0.0 8160.0 AXIS_PTS_REF ldpm_n_32_4 MAX_GRAD 100 MONOTONY MON_INCREASE /end AXIS_DESCR
/end CHARACTERISTIC
/begin CHARACTERISTIC ip_ti_cop_nr_3_1__n__maf "IP_TI_COP_NR_3_1" MAP 0x785ee a_6 10 LINEAR______0_000000__0H___0_996 0.0 0.99609375
 /begin AXIS_DESCR COM_AXIS maf LINEAR______0_000000__0H___1389_ 8 0.0 1389.0 AXIS_PTS_REF ldpm_maf_11 MAX_GRAD 100 MONOTONY MON_INCREASE /end AXIS_DESCR
 /begin AXIS_DESCR COM_AXIS n LINEAR______0_000000__0H___8160_ 10 0.0 8160.0 AXIS_PTS_REF ldpm_n_32_4 MAX_GRAD 100 MONOTONY MON_INCREASE /end AXIS_DESCR
/end CHARACTERISTIC
/begin CHARACTERISTIC ip_ti_cop_nr_3_2__n__maf "IP_TI_COP_NR_3_2" MAP 0x7863e a_6 10 LINEAR______0_000000__0H___0_996 0.0 0.99609375
 /begin AXIS_DESCR COM_AXIS maf LINEAR______0_000000__0H___1389_ 8 0.0 1389.0 AXIS_PTS_REF ldpm_maf_11 MAX_GRAD 100 MONOTONY MON_INCREASE /end AXIS_DESCR
 /begin AXIS_DESCR COM_AXIS n LINEAR______0_000000__0H___8160_ 10 0.0 8160.0 AXIS_PTS_REF ldpm_n_32_4 MAX_GRAD 100 MONOTONY MON_INCREASE /end AXIS_DESCR
/end CHARACTERISTIC
/begin CHARACTERISTIC ip_ti_cop_nr_4_1__n__maf "IP_TI_COP_NR_4_1" MAP 0x7868e a_6 10 LINEAR______0_000000__0H___0_996 0.0 0.99609375
 /begin AXIS_DESCR COM_AXIS maf LINEAR______0_000000__0H___1389_ 8 0.0 1389.0 AXIS_PTS_REF ldpm_maf_11 MAX_GRAD 100 MONOTONY MON_INCREASE /end AXIS_DESCR
 /begin AXIS_DESCR COM_AXIS n LINEAR______0_000000__0H___8160_ 10 0.0 8160.0 AXIS_PTS_REF ldpm_n_32_4 MAX_GRAD 100 MONOTONY MON_INCREASE /end AXIS_DESCR
/end CHARACTERISTIC
/begin CHARACTERISTIC ip_ti_cop_nr_4_2__n__maf "IP_TI_COP_NR_4_2" MAP 0x786de a_6 10 LINEAR______0_000000__0H___0_996 0.0 0.99609375
 /begin AXIS_DESCR COM_AXIS maf LINEAR______0_000000__0H___1389_ 8 0.0 1389.0 AXIS_PTS_REF ldpm_maf_11 MAX_GRAD 100 MONOTONY MON_INCREASE /end AXIS_DESCR
 /begin AXIS_DESCR COM_AXIS n LINEAR______0_000000__0H___8160_ 10 0.0 8160.0 AXIS_PTS_REF ldpm_n_32_4 MAX_GRAD 100 MONOTONY MON_INCREASE /end AXIS_DESCR
/end CHARACTERISTIC
/begin CHARACTERISTIC ip_ti_cop_nr_5_1__n__maf "IP_TI_COP_NR_5_1" MAP 0x7872e a_6 10 LINEAR______0_000000__0H___0_996 0.0 0.99609375
 /begin AXIS_DESCR COM_AXIS maf LINEAR______0_000000__0H___1389_ 8 0.0 1389.0 AXIS_PTS_REF ldpm_maf_11 MAX_GRAD 100 MONOTONY MON_INCREASE /end AXIS_DESCR
 /begin AXIS_DESCR COM_AXIS n LINEAR______0_000000__0H___8160_ 10 0.0 8160.0 AXIS_PTS_REF ldpm_n_32_4 MAX_GRAD 100 MONOTONY MON_INCREASE /end AXIS_DESCR
/end CHARACTERISTIC
/begin CHARACTERISTIC ip_ti_cop_nr_5_2__n__maf "IP_TI_COP_NR_5_2" MAP 0x7877e a_6 10 LINEAR______0_000000__0H___0_996 0.0 0.99609375
 /begin AXIS_DESCR COM_AXIS maf LINEAR______0_000000__0H___1389_ 8 0.0 1389.0 AXIS_PTS_REF ldpm_maf_11 MAX_GRAD 100 MONOTONY MON_INCREASE /end AXIS_DESCR
 /begin AXIS_DESCR COM_AXIS n LINEAR______0_000000__0H___8160_ 10 0.0 8160.0 AXIS_PTS_REF ldpm_n_32_4 MAX_GRAD 100 MONOTONY MON_INCREASE /end AXIS_DESCR
/end CHARACTERISTIC
/begin CHARACTERISTIC ip_ti_cr_cast__cyc__tco "IP_TI_CR_CAST" MAP 0x787ce a_39 20 LINEAR______0_000000__0H___0_996 0.0 0.99609375
 /begin AXIS_DESCR COM_AXIS tco LINEAR_______48_000000__0H___142 8 -48.0 142.5 AXIS_PTS_REF ldpm_tco_3 MAX_GRAD 100 MONOTONY MON_INCREASE /end AXIS_DESCR
 /begin AXIS_DESCR COM_AXIS dummy_b LINEAR______0_000000__0H___65573 6 0.0 65535.0 AXIS_PTS_REF ldp_cyc__ti_cr_cast MAX_GRAD 100 MONOTONY MON_INCREASE /end AXIS_DESCR
/end CHARACTERISTIC
/begin CHARACTERISTIC ip_ti_cr_cst__cyc__tco "IP_TI_CR_CST" MAP 0x787fe a_39 20 LINEAR______0_000000__0H___0_996 0.0 0.99609375
 /begin AXIS_DESCR COM_AXIS tco LINEAR_______48_000000__0H___142 8 -48.0 142.5 AXIS_PTS_REF ldpm_tco_3 MAX_GRAD 100 MONOTONY MON_INCREASE /end AXIS_DESCR
 /begin AXIS_DESCR COM_AXIS dummy_b LINEAR______0_000000__0H___65573 4 0.0 65535.0 AXIS_PTS_REF ldp_cyc__ti_cr_cst MAX_GRAD 100 MONOTONY MON_INCREASE /end AXIS_DESCR
/end CHARACTERISTIC
/begin CHARACTERISTIC ip_ti_cr_neg_fast_wf__n "IP_TI_CR_NEG_FAST_WF" CURVE 0x7881e a_1 100 LINEAR______0_000000__0H___0_498 0.0 0.49805
 /begin AXIS_DESCR COM_AXIS n LINEAR______0_000000__0H___8160_ 8 0.0 8160.0 AXIS_PTS_REF ldpm_n_32_9 MAX_GRAD 100 MONOTONY MON_INCREASE /end AXIS_DESCR
/end CHARACTERISTIC
/begin CHARACTERISTIC ip_ti_cr_pos_fast_wf__n "IP_TI_CR_POS_FAST_WF" CURVE 0x78826 a_1 100 LINEAR______0_000000__0H___0_498 0.0 0.49805
 /begin AXIS_DESCR COM_AXIS n LINEAR______0_000000__0H___8160_ 8 0.0 8160.0 AXIS_PTS_REF ldpm_n_32_9 MAX_GRAD 100 MONOTONY MON_INCREASE /end AXIS_DESCR
/end CHARACTERISTIC
/begin CHARACTERISTIC ip_ti_cst__n__tco "IP_TI_CST" MAP 0x7ce78 a_36 10 LINEAR______0_000000__0H___349_5 0.0 349.52
 /begin AXIS_DESCR COM_AXIS tco LINEAR_______48_000000__0H___142 8 -48.0 142.5 AXIS_PTS_REF ldpm_tco_3 MAX_GRAD 100 MONOTONY MON_INCREASE /end AXIS_DESCR
 /begin AXIS_DESCR COM_AXIS n LINEAR______0_000000__0H___81612 3 0.0 8160.0 AXIS_PTS_REF ldpm_n_6 MAX_GRAD 100 MONOTONY MON_INCREASE /end AXIS_DESCR
/end CHARACTERISTIC
/begin CHARACTERISTIC ip_ti_cst_amp_cor__fac_amp "IP_TI_CST_AMP_COR" CURVE 0x7882e a_1 100 LINEAR______0_000000__0H___1_992 0.0 1.9921875
 /begin AXIS_DESCR COM_AXIS fac_amp LINEAR______0_000000__0H___1_992 6 0.0 1.9921875 AXIS_PTS_REF ldp_fac_amp__ti_cst_amp_cor MAX_GRAD 100 MONOTONY MON_INCREASE /end AXIS_DESCR
/end CHARACTERISTIC
/begin CHARACTERISTIC ip_ti_cyl__vls_dif_val "IP_TI_CYL" CURVE 0x7cea8 a_24 100 LINEAR_______50_000000__0H___440 -50.0 49.998471
 /begin AXIS_DESCR COM_AXIS dummy_w LINEAR_______0_637500__0H___0_71 6 -0.6375 0.6375 AXIS_PTS_REF ldp_vls_dif_val__ti_cyl MAX_GRAD 100 MONOTONY MON_INCREASE /end AXIS_DESCR
 FUNCTION_LIST CSCM /end CHARACTERISTIC
/begin CHARACTERISTIC ip_ti_fac_ch_at__tco__t_ast "IP_TI_FAC_CH_AT" MAP 0x7ceb4 a_50 10 LINEAR______0_500000__0H___1_500 0.5 1.5
 /begin AXIS_DESCR COM_AXIS t_ast LINEAR______0_000000__0H___6553_ 8 0.0 6553.5 AXIS_PTS_REF ldpm_t_ast_4 MAX_GRAD 100 MONOTONY MON_INCREASE /end AXIS_DESCR
 /begin AXIS_DESCR COM_AXIS tco LINEAR_______48_000000__0H___142 8 -48.0 142.5 AXIS_PTS_REF ldpm_tco_7 MAX_GRAD 100 MONOTONY MON_INCREASE /end AXIS_DESCR
/end CHARACTERISTIC
/begin CHARACTERISTIC ip_ti_fac_ch_mt__tco__t_ast "IP_TI_FAC_CH_MT" MAP 0x7cf34 a_50 10 LINEAR______0_500000__0H___1_500 0.5 1.5
 /begin AXIS_DESCR COM_AXIS t_ast LINEAR______0_000000__0H___6553_ 8 0.0 6553.5 AXIS_PTS_REF ldpm_t_ast_4 MAX_GRAD 100 MONOTONY MON_INCREASE /end AXIS_DESCR
 /begin AXIS_DESCR COM_AXIS tco LINEAR_______48_000000__0H___142 8 -48.0 142.5 AXIS_PTS_REF ldpm_tco_7 MAX_GRAD 100 MONOTONY MON_INCREASE /end AXIS_DESCR
/end CHARACTERISTIC
/begin CHARACTERISTIC ip_ti_fac_fast_wf__maf__n "IP_TI_FAC_FAST_WF" MAP 0x78834 a_6 100 LINEAR______0_000000__0H___1_992 0.0 1.9921875
 /begin AXIS_DESCR COM_AXIS n LINEAR______0_000000__0H___8160_ 8 0.0 8160.0 AXIS_PTS_REF ldpm_n_32_9 MAX_GRAD 100 MONOTONY MON_INCREASE /end AXIS_DESCR
 /begin AXIS_DESCR COM_AXIS maf LINEAR______0_000000__0H___1389_ 8 0.0 1389.0 AXIS_PTS_REF ldpm_maf_7 MAX_GRAD 100 MONOTONY MON_INCREASE /end AXIS_DESCR
/end CHARACTERISTIC
/begin CHARACTERISTIC ip_ti_fac_n_maf__n__maf "IP_TI_FAC_N_MAF" MAP 0x78874 a_6 100 LINEAR______0_000000__0H___0_996 0.0 0.99609375
 /begin AXIS_DESCR COM_AXIS maf LINEAR______0_000000__0H___1389_ 8 0.0 1389.0 AXIS_PTS_REF ldp_maf__ti_fac_n_maf MAX_GRAD 100 MONOTONY MON_INCREASE /end AXIS_DESCR
 /begin AXIS_DESCR COM_AXIS n_32 LINEAR______0_000000__0H___8160_ 8 0.0 8160.0 AXIS_PTS_REF ldp_n_32__ti_fac_n_maf MAX_GRAD 100 MONOTONY MON_INCREASE /end AXIS_DESCR
/end CHARACTERISTIC
/begin CHARACTERISTIC ip_ti_fac_neg_fast_wf__maf__n "IP_TI_FAC_NEG_FAST_WF" MAP 0x788b4 a_6 100 LINEAR______0_000000__0H___1_992 0.0 1.9921875
 /begin AXIS_DESCR COM_AXIS n LINEAR______0_000000__0H___8160_ 8 0.0 8160.0 AXIS_PTS_REF ldpm_n_32_9 MAX_GRAD 100 MONOTONY MON_INCREASE /end AXIS_DESCR
 /begin AXIS_DESCR COM_AXIS maf LINEAR______0_000000__0H___1389_ 8 0.0 1389.0 AXIS_PTS_REF ldpm_maf_7 MAX_GRAD 100 MONOTONY MON_INCREASE /end AXIS_DESCR
/end CHARACTERISTIC
/begin CHARACTERISTIC ip_ti_fac_neg_slow_wf__maf__n "IP_TI_FAC_NEG_SLOW_WF" MAP 0x788f4 a_6 100 LINEAR______0_000000__0H___1_992 0.0 1.9921875
 /begin AXIS_DESCR COM_AXIS n LINEAR______0_000000__0H___8160_ 8 0.0 8160.0 AXIS_PTS_REF ldpm_n_32_9 MAX_GRAD 100 MONOTONY MON_INCREASE /end AXIS_DESCR
 /begin AXIS_DESCR COM_AXIS maf LINEAR______0_000000__0H___1389_ 8 0.0 1389.0 AXIS_PTS_REF ldpm_maf_7 MAX_GRAD 100 MONOTONY MON_INCREASE /end AXIS_DESCR
/end CHARACTERISTIC
/begin CHARACTERISTIC ip_ti_fac_sawup_at__tco__t_ast "IP_TI_FAC_SAWUP_AT" MAP 0x7cfb4 a_50 40 LINEAR______0_500000__0H___1_500 0.5 1.5
 /begin AXIS_DESCR COM_AXIS t_ast LINEAR______0_000000__0H___6553_ 8 0.0 6553.5 AXIS_PTS_REF ldpm_t_ast_3 MAX_GRAD 100 MONOTONY MON_INCREASE /end AXIS_DESCR
 /begin AXIS_DESCR COM_AXIS tco LINEAR_______48_000000__0H___142 8 -48.0 142.5 AXIS_PTS_REF ldpm_tco_1 MAX_GRAD 100 MONOTONY MON_INCREASE /end AXIS_DESCR
/end CHARACTERISTIC
/begin CHARACTERISTIC ip_ti_fac_sawup_mt__tco__t_ast "IP_TI_FAC_SAWUP_MT" MAP 0x7d034 a_50 40 LINEAR______0_500000__0H___1_500 0.5 1.5
 /begin AXIS_DESCR COM_AXIS t_ast LINEAR______0_000000__0H___6553_ 8 0.0 6553.5 AXIS_PTS_REF ldpm_t_ast_3 MAX_GRAD 100 MONOTONY MON_INCREASE /end AXIS_DESCR
 /begin AXIS_DESCR COM_AXIS tco LINEAR_______48_000000__0H___142 8 -48.0 142.5 AXIS_PTS_REF ldpm_tco_1 MAX_GRAD 100 MONOTONY MON_INCREASE /end AXIS_DESCR
/end CHARACTERISTIC
/begin CHARACTERISTIC ip_ti_fac_slow_wf__maf__n "IP_TI_FAC_SLOW_WF" MAP 0x78934 a_6 100 LINEAR______0_000000__0H___1_992 0.0 1.9921875
 /begin AXIS_DESCR COM_AXIS n LINEAR______0_000000__0H___8160_ 8 0.0 8160.0 AXIS_PTS_REF ldpm_n_32_9 MAX_GRAD 100 MONOTONY MON_INCREASE /end AXIS_DESCR
 /begin AXIS_DESCR COM_AXIS maf LINEAR______0_000000__0H___1389_ 8 0.0 1389.0 AXIS_PTS_REF ldpm_maf_7 MAX_GRAD 100 MONOTONY MON_INCREASE /end AXIS_DESCR
/end CHARACTERISTIC
/begin CHARACTERISTIC ip_ti_fac_tco__tco "IP_TI_FAC_TCO" CURVE 0x78974 a_1 100 LINEAR______0_000000__0H___0_996 0.0 0.99609375
 /begin AXIS_DESCR COM_AXIS tco LINEAR_______48_000000__0H___142 3 -48.0 142.5 AXIS_PTS_REF ldp_tco__ti_fac_tco MAX_GRAD 100 MONOTONY MON_INCREASE /end AXIS_DESCR
/end CHARACTERISTIC
/begin CHARACTERISTIC ip_ti_fac_tia_toil__tia__toil "IP_TI_FAC_TIA_TOIL" MAP 0x78977 a_6 100 LINEAR______0_000000__0H___1_992 0.0 1.9921875
 /begin AXIS_DESCR COM_AXIS toil LINEAR_______48_000000__0H___155 6 -48.0 155.0 AXIS_PTS_REF ldp_toil__ti_fac_tia_toil MAX_GRAD 100 MONOTONY MON_INCREASE /end AXIS_DESCR
 /begin AXIS_DESCR COM_AXIS tia LINEAR_______48_000000__0H___142 6 -48.0 142.5 AXIS_PTS_REF ldp_tia__ti_fac_tia_toil MAX_GRAD 100 MONOTONY MON_INCREASE /end AXIS_DESCR
/end CHARACTERISTIC
/begin CHARACTERISTIC ip_ti_fast_wf_thd_min__tco "IP_TI_FAST_WF_THD_MIN" CURVE 0x7d0b4 a_3 100 LINEAR______0_000000__0H___349_5 0.0 349.52
 /begin AXIS_DESCR COM_AXIS tco LINEAR_______48_000000__0H___142 4 -48.0 142.5 AXIS_PTS_REF ldpm_tco_18 MAX_GRAD 100 MONOTONY MON_INCREASE /end AXIS_DESCR
/end CHARACTERISTIC
/begin CHARACTERISTIC ip_ti_fl__n "IP_TI_FL" CURVE 0x7899b a_7 100 LINEAR_______0_500000__0H___0_49 -0.5 0.49599999
 /begin AXIS_DESCR COM_AXIS n LINEAR______0_000000__0H___81612 16 0.0 8160.0 AXIS_PTS_REF ldpm_n_11 MAX_GRAD 100 MONOTONY MON_INCREASE /end AXIS_DESCR
/end CHARACTERISTIC
/begin CHARACTERISTIC ip_ti_inc_cop__iga_dif__t "IP_TI_INC_COP" MAP 0x789ab a_6 100 LINEAR______0_000488__1H___0_124 0.000488 0.12451
 /begin AXIS_DESCR COM_AXIS dummy_b LINEAR______0_000000__0H___25514 4 0.0 255.0 AXIS_PTS_REF ldp_t__ti_inc_cop MAX_GRAD 100 MONOTONY MON_INCREASE /end AXIS_DESCR
 /begin AXIS_DESCR COM_AXIS dummy_b LINEAR______0_000000__0H___95_22 4 0.0 95.625 AXIS_PTS_REF ldp_iga_dif__ti_inc_cop MAX_GRAD 100 MONOTONY MON_INCREASE /end AXIS_DESCR
/end CHARACTERISTIC
/begin CHARACTERISTIC ip_ti_is__n_dif_cor "IP_TI_IS" CURVE 0x789bb a_7 10 LINEAR_______0_500000__0H___0_49 -0.5 0.49599999
 /begin AXIS_DESCR COM_AXIS n_dif_cor LINEAR_______1024_000000__7C00H_ 6 -1024.0 1016.0 AXIS_PTS_REF ldp_n_dif_cor__ti_is MAX_GRAD 100 MONOTONY MON_INCREASE /end AXIS_DESCR
/end CHARACTERISTIC
/begin CHARACTERISTIC ip_ti_lgrd_ast__tco "IP_TI_LGRD_AST" CURVE 0x7d0bc a_3 10 LINEAR______0_053333__AH___21_84 0.053333333 21.845333
 /begin AXIS_DESCR COM_AXIS tco LINEAR_______48_000000__0H___142 8 -48.0 142.5 AXIS_PTS_REF ldpm_tco_3 MAX_GRAD 100 MONOTONY MON_INCREASE /end AXIS_DESCR
/end CHARACTERISTIC
/begin CHARACTERISTIC ip_ti_pvs__pvs__n "IP_TI_PVS" MAP 0x789c1 a_6 100 LINEAR______0_000000__0H___32_76 0.0 32.7675
 /begin AXIS_DESCR COM_AXIS n LINEAR______0_000000__0H___8160_ 8 0.0 8160.0 AXIS_PTS_REF ldpm_n_32_9 MAX_GRAD 100 MONOTONY MON_INCREASE /end AXIS_DESCR
 /begin AXIS_DESCR COM_AXIS thr LINEAR______0_000000__0H___11913 12 0.0 119.5 AXIS_PTS_REF ldpm_pvs_4 MAX_GRAD 100 MONOTONY MON_INCREASE /end AXIS_DESCR
/end CHARACTERISTIC
/begin CHARACTERISTIC ip_ti_pvs_cr_ae__n "IP_TI_PVS_CR_AE" CURVE 0x78a21 a_1 100 LINEAR______0_000000__0H___0_996 0.0 0.99609375
 /begin AXIS_DESCR COM_AXIS n LINEAR______0_000000__0H___8160_ 8 0.0 8160.0 AXIS_PTS_REF ldpm_n_32_9 MAX_GRAD 100 MONOTONY MON_INCREASE /end AXIS_DESCR
/end CHARACTERISTIC
/begin CHARACTERISTIC ip_ti_pvs_cr_pur__n "IP_TI_PVS_CR_PUR" CURVE 0x78a29 a_1 100 LINEAR______0_000000__0H___0_996 0.0 0.99609375
 /begin AXIS_DESCR COM_AXIS n LINEAR______0_000000__0H___8160_ 8 0.0 8160.0 AXIS_PTS_REF ldpm_n_32_9 MAX_GRAD 100 MONOTONY MON_INCREASE /end AXIS_DESCR
/end CHARACTERISTIC
/begin CHARACTERISTIC ip_ti_pvs_tco_fac__tco "IP_TI_PVS_TCO_FAC" CURVE 0x78a31 a_1 100 LINEAR______0_000000__0H___7_935 0.0 7.9679999
 /begin AXIS_DESCR COM_AXIS tco LINEAR_______48_000000__0H___142 8 -48.0 142.5 AXIS_PTS_REF ldpm_tco_10 MAX_GRAD 100 MONOTONY MON_INCREASE /end AXIS_DESCR
/end CHARACTERISTIC
/begin CHARACTERISTIC ip_ti_pvs_vo_fac__vo "IP_TI_PVS_VO_FAC" CURVE 0x78a39 a_7 100 LINEAR______0_000000__0H___1_992 0.0 1.9921875
 /begin AXIS_DESCR COM_AXIS vo LINEAR______0_000000__0H___120_0 8 0.0 120.0 AXIS_PTS_REF ldpm_vo_1 MAX_GRAD 100 MONOTONY MON_INCREASE /end AXIS_DESCR
/end CHARACTERISTIC
/begin AXIS_PTS ldpm_temp_mmv_sub_cat_1 "TEMP_MMV_SUB_CAT" 0x74041 temp_mmv_sub_cat a_742 100 LINEAR_______33_000000__0H___987 6 -33.0 987.0 /end AXIS_PTS
/begin AXIS_PTS ldpm_tmag_1 "TMAG" 0x745d9 tmag a_742 100 LINEAR_______48_000000__0H___155 6 -48.0 155.0 /end AXIS_PTS
/begin AXIS_PTS ldpm_n_11 "N" 0x74b0e n a_743 100 LINEAR______0_000000__0H___81612 16 0.0 8160.0 /end AXIS_PTS
/begin AXIS_PTS ldpm_tco_st_2 "TCO_ST" 0x74162 tco_st a_742 15 LINEAR_______48_000000__0H___142 8 -48.0 142.5 /end AXIS_PTS
/begin AXIS_PTS ldpm_tco_st_5 "TCO_ST" 0x7416b tco_st a_742 15 LINEAR_______48_000000__0H___142 8 -48.0 142.5 /end AXIS_PTS
/begin AXIS_PTS ldpm_tco_4 "TCO" 0x741f0 tco a_742 15 LINEAR_______48_000000__0H___142 6 -48.0 142.5 /end AXIS_PTS
/begin AXIS_PTS ldpm_n_32_7 "N" 0x7424a n a_742 10 LINEAR______0_000000__0H___8160_ 10 0.0 8160.0 /end AXIS_PTS
/begin AXIS_PTS ldpm_maf_add_cor_1 "MAF_COR" 0x74262 maf_cor a_742 10 LINEAR______0_000000__0H___1389_ 12 0.0 1389.0 /end AXIS_PTS
/begin AXIS_PTS ldpm_vb_1 "VB" 0x7426f vb a_742 12 LINEAR______0_000000__0H___26_00 8 0.0 26.0 /end AXIS_PTS
/begin AXIS_PTS ldpm_maf_kgh_17 "MAF_KGH" 0x74c10 maf_kgh a_743 10 LINEAR______0_000000__0H___16383 8 0.0 16383.75 FUNCTION_LIST ETM /end AXIS_PTS
/begin AXIS_PTS ldpm_maf_17 "MAF" 0x74c34 maf a_743 10 LINEAR______0_000000__0H___13818 8 0.0 1389.0 /end AXIS_PTS
/begin AXIS_PTS ldpm_n_17 "N" 0x74c22 n a_743 10 LINEAR______0_000000__0H___81612 8 0.0 8160.0 FUNCTION_LIST ETM /end AXIS_PTS
/begin AXIS_PTS ldpm_maf_kgh_18 "MAF_KGH" 0x74c46 maf_kgh a_743 10 LINEAR______0_000000__0H___16383 6 0.0 16383.75 FUNCTION_LIST ETM /end AXIS_PTS
/begin AXIS_PTS ldpm_toil_2 "TOIL" 0x742c4 toil a_742 100 LINEAR_______48_000000__0H___155 8 -48.0 155.0 /end AXIS_PTS
/begin AXIS_PTS ldpm_n_32_24 "N" 0x742bb n a_742 100 LINEAR______0_000000__0H___8160_ 8 0.0 8160.0 /end AXIS_PTS
/begin AXIS_PTS ldpm_tco_3 "TCO" 0x74308 tco a_742 15 LINEAR_______48_000000__0H___142 8 -48.0 142.5 /end AXIS_PTS
/begin AXIS_PTS ldpm_maf_kgh_1 "MAF_KGH" 0x74d38 maf_kgh a_743 10 LINEAR______0_000000__0H___16383 8 0.0 16383.75 /end AXIS_PTS
/begin AXIS_PTS ldpm_maf_4 "MAF" 0x7438a maf a_742 5 LINEAR______0_000000__0H___1389_ 8 0.0 1389.0 /end AXIS_PTS
/begin AXIS_PTS ldpm_n_7 "N" 0x74daa n a_743 10 LINEAR______0_000000__0H___81612 8 0.0 8160.0 /end AXIS_PTS
/begin AXIS_PTS ldpm_tgas_l "TGAS_L" 0x743ce dummy_b a_742 100 LINEAR_______48_000000__0H___143 10 -48.0 143.25 FUNCTION_LIST CNG /end AXIS_PTS
/begin AXIS_PTS ldpm_n_32_12 "N" 0x7444b n a_742 20 LINEAR______0_000000__0H___8160_ 8 0.0 8160.0 /end AXIS_PTS
/begin AXIS_PTS ldpm_n_8 "N" 0x74ec0 n a_743 10 LINEAR______0_000000__0H___81612 6 0.0 8160.0 /end AXIS_PTS
/begin AXIS_PTS ldpm_toil_6 "TOIL" 0x7449b toil a_742 100 LINEAR_______48_000000__0H___155 6 -48.0 155.0 FUNCTION_LIST ETM /end AXIS_PTS
/begin AXIS_PTS ldpm_tco_8 "TCO" 0x744a9 tco a_742 15 LINEAR_______48_000000__0H___142 4 -48.0 142.5 /end AXIS_PTS
/begin AXIS_PTS ldpm_n_6 "N" 0x74fd6 n a_743 10 LINEAR______0_000000__0H___81612 3 0.0 8160.0 /end AXIS_PTS
/begin AXIS_PTS ldpm_n_2 "N" 0x74fde n a_743 100 LINEAR______0_000000__0H___81612 6 0.0 8160.0 /end AXIS_PTS
/begin AXIS_PTS ldpm_pq_turb_sys_1 "PQ_TURB_SYS" 0x74547 pq_turb_sys a_742 100 LINEAR______0_000000__0H___0_996 6 0.0 0.99609375 /end AXIS_PTS
/begin AXIS_PTS ldp_ecfpwm_ecf__isapwm_ecf_add "ECFPWM_ECF" 0x74582 ecfpwm_ecf a_742 100 LINEAR______0_000000__0H___99_60 6 0.0 99.609375 /end AXIS_PTS
/begin AXIS_PTS ldp_n_32__isapwm_hpa "N_32" 0x74589 n_32 a_742 100 LINEAR______0_000000__0H___8160_ 4 0.0 8160.0 FUNCTION_LIST Z1S1 /end AXIS_PTS
/begin AXIS_PTS ldp_n_sp_dif__isapwm_n_sp_min "SP_DIF_VB" 0x75088 n_sp_dif_vb a_743 2 LINEAR______0_000000__0H___1000_ 4 0.0 1000.0 /end AXIS_PTS
/begin AXIS_PTS ldp_n_32__isapwm_n_sp_min "N" 0x74595 n a_742 12 LINEAR______0_000000__0H___8160_ 4 0.0 8160.0 /end AXIS_PTS
/begin AXIS_PTS ldpm_n_dif_cor_2 "N_DIF_COR" 0x75092 n_dif_cor a_743 5 LINEAR_______1024_000000__7C00H_ 8 -1024.0 1016.0 /end AXIS_PTS
/begin AXIS_PTS ldp_n_dif_cor__isapwm_p_is "N_DIF_COR" 0x750a4 n_dif_cor a_743 5 LINEAR_______1024_000000__7C00H_ 12 -1024.0 1016.0 /end AXIS_PTS
/begin AXIS_PTS ldpm_n_32_3 "N" 0x7459a n a_742 100 LINEAR______0_000000__0H___8160_ 12 0.0 8160.0 /end AXIS_PTS
/begin AXIS_PTS ldpm_pvs_2 "PVS" 0x750be dummy_b a_743 100 LINEAR______0_000000__0H___119_8 12 0.0 119.8828 /end AXIS_PTS
/begin AXIS_PTS ldpm_n_32_11 "N" 0x745ac n a_742 12 LINEAR______0_000000__0H___8160_ 4 0.0 8160.0 /end AXIS_PTS
/begin AXIS_PTS ldpm_n_22 "N" 0x750e2 n a_743 10 LINEAR______0_000000__0H___81612 4 0.0 8160.0 /end AXIS_PTS
/begin AXIS_PTS ldp_tia__isapwm_tia_add "TIA" 0x745b8 tia a_742 16 LINEAR_______48_000000__0H___142 4 -48.0 142.5 /end AXIS_PTS
/begin AXIS_PTS ldpm_tia_1 "TIA" 0x745bd tia a_742 15 LINEAR_______48_000000__0H___142 6 -48.0 142.5 /end AXIS_PTS
/begin AXIS_PTS ldp_toil__isapwm_toil_add "TOIL" 0x745c4 toil a_742 100 LINEAR_______48_000000__0H___155 6 -48.0 155.0 /end AXIS_PTS
/begin AXIS_PTS ldpm_vo_2 "VO" 0x750ec vo a_743 100 LINEAR______0_000000__0H___120_0 8 0.0 120.0 /end AXIS_PTS
/begin AXIS_PTS ldpm_tco_16 "TCO" 0x745cb tco a_742 100 LINEAR_______48_000000__0H___142 8 -48.0 142.5 /end AXIS_PTS
/begin AXIS_PTS ldp_n_dif__isapwm_vs_at "N_DIF" 0x750fe n_dif a_743 5 LINEAR_______32768_000000__0H___ 4 -32768.0 32767.0 /end AXIS_PTS
/begin AXIS_PTS ldp_vs__isapwm_vs_at "VS" 0x745d4 vs a_742 100 LINEAR______0_000000__0H___25511 4 0.0 255.0 /end AXIS_PTS
/begin AXIS_PTS ldp_n_dif__isapwm_vs_fil_amt "N_DIF" 0x75112 n_dif a_743 100 LINEAR_______32768_000000__0H___ 4 -32768.0 32767.0 FUNCTION_LIST Z1S1 /end AXIS_PTS
/begin AXIS_PTS ldp_vs_fil__isapwm_vs_fil_amt "VS_FIL" 0x75108 vs_fil a_743 100 LINEAR______0_000000__0H___51151 4 0.0 511.99218 FUNCTION_LIST Z1S1 /end AXIS_PTS
/begin AXIS_PTS ldp_vb__ivvthpwm "VB" 0x745e0 vb a_742 100 LINEAR______0_000000__0H___26_00 4 0.0 26.0 /end AXIS_PTS
/begin AXIS_PTS ldp_maf__lam_dif_max_cp "MAF" 0x745eb maf a_742 100 LINEAR______0_000000__0H___1389_ 5 0.0 1389.0 /end AXIS_PTS
/begin AXIS_PTS ldp_n_32__lam_dif_max_cp "N" 0x745e5 n_32 a_742 100 LINEAR______0_000000__0H___8160_ 5 0.0 8160.0 /end AXIS_PTS
/begin AXIS_PTS ldpm_maf_20 "MAF" 0x745f1 maf a_742 100 LINEAR______0_000000__0H___1389_ 2 0.0 1389.0 /end AXIS_PTS
/begin AXIS_PTS ldpm_n_20 "N" 0x7511c n a_743 100 LINEAR______0_000000__0H___81612 2 0.0 8160.0 /end AXIS_PTS
/begin AXIS_PTS ldpm_tco_2 "TCO" 0x745f4 tco a_742 15 LINEAR_______48_000000__0H___142 8 -48.0 142.5 /end AXIS_PTS
/begin AXIS_PTS ldp_maf_cyl__lamp_up_cat_sa "MAF_CYL" 0x75134 maf_cyl a_743 10 LINEAR______0_000000__0H___16383 8 0.0 16383.75 /end AXIS_PTS
/begin AXIS_PTS ldp_teg__lamp_up_cat_sa "TEG" 0x75122 teg a_743 10 LINEAR______0_000000__0H___10253 8 0.0 1023.9844 /end AXIS_PTS
/begin AXIS_PTS ldp_temp_mmv_sub_ex_x_i__lshpwm "TEMP_MMV_SUB_EX_X_I" 0x75146 dummy_w a_743 100 LINEAR_______33_000000__0H___989 6 -33.0 989.9844 /end AXIS_PTS
/begin AXIS_PTS ldp_tps_av__maf_1_diag "TPS_AV" 0x75154 dummy_b a_743 10 LINEAR______0_000000__0H___119_9 16 0.0 119.99817 /end AXIS_PTS
/begin AXIS_PTS ldpm_n_32_6 "N" 0x745fd n a_742 100 LINEAR______0_000000__0H___8160_ 16 0.0 8160.0 /end AXIS_PTS
/begin AXIS_PTS ldp_n_32__maf_2_diag "N" 0x7460e n a_742 10 LINEAR______0_000000__0H___8160_ 6 0.0 8160.0 /end AXIS_PTS
/begin AXIS_PTS ldp_maf__maf_dif_max_er "MAF" 0x74615 maf a_742 100 LINEAR______0_000000__0H___1389_ 6 0.0 1389.0 /end AXIS_PTS
/begin AXIS_PTS ldpm_n_32_21 "N" 0x7461c n_32 a_742 100 LINEAR______0_000000__0H___8160_ 6 0.0 8160.0 /end AXIS_PTS
/begin AXIS_PTS ldp_maf_mes__maf_ign_crlc "MAF_MES" 0x7462a maf_mes a_742 10 LINEAR______0_000000__0H___1389_ 6 0.0 1389.0 /end AXIS_PTS
/begin AXIS_PTS ldp_n_32__maf_ign_crlc "N" 0x74623 n_32 a_742 10 LINEAR______0_000000__0H___8160_ 6 0.0 8160.0 /end AXIS_PTS
/begin AXIS_PTS ldp_maf_int_puc__maf_int_dly_puc "MAF_INT_PUC" 0x75176 dummy_b a_743 100 LINEAR______0_000000__0H___1820_ 6 0.0 1820.42 /end AXIS_PTS
/begin AXIS_PTS ldp_toil_st__maf_int_temp_down "TOIL_ST" 0x74631 toil_st a_742 100 LINEAR_______48_000000__0H___155 8 -48.0 155.0 FUNCTION_LIST ETM /end AXIS_PTS
/begin AXIS_PTS ldpm_fac_amp_1 "FAC_AMP" 0x75184 fac_amp a_743 5 LINEAR______0_000000__0H___2_054 6 0.0 2.0 /end AXIS_PTS
/begin AXIS_PTS ldpm_n_32_29 "N" 0x7463a n_32 a_742 10 LINEAR______0_000000__0H___8160_ 6 0.0 8160.0 /end AXIS_PTS
/begin AXIS_PTS ldpm_n_15 "N" 0x75192 n a_743 100 LINEAR______0_000000__0H___81612 6 0.0 8160.0 FUNCTION_LIST CSCM /end AXIS_PTS
/begin AXIS_PTS ldp_n_32__maf_max_diag_sa "N" 0x74641 n_32 a_742 100 LINEAR______0_000000__0H___8160_ 8 0.0 8160.0 /end AXIS_PTS
/begin AXIS_PTS ldp_pq_turb_sys_mon__fac_pq_isa "PQ_TURB_SYS" 0x7e681 pq_turb_sys a_742 100 LINEAR______0_000000__0H___0_996 6 0.0 0.99609375 /end AXIS_PTS
/begin AXIS_PTS ldp_iga_dif__maf_min_cop "IGA_DIF" 0x74655 dummy_b a_742 100 LINEAR______0_000000__0H___95_22 6 0.0 95.625 /end AXIS_PTS
/begin AXIS_PTS ldpm_n_32_4 "N" 0x7464a n a_742 10 LINEAR______0_000000__0H___8160_ 10 0.0 8160.0 /end AXIS_PTS
/begin AXIS_PTS ldp_iga_dif__maf_min_cop_ron "IGA_DIF" 0x7465c dummy_b a_742 100 LINEAR______0_000000__0H___95_22 6 0.0 95.625 /end AXIS_PTS
/begin AXIS_PTS ldp_n_32__maf_min_er "N" 0x74663 n a_742 5 LINEAR______0_000000__0H___8160_ 6 0.0 8160.0 /end AXIS_PTS
/begin AXIS_PTS ldpm_tco_24 "TCO" 0x7466a tco a_742 15 LINEAR_______48_000000__0H___142 4 -48.0 142.5 /end AXIS_PTS
/begin AXIS_PTS ldp_n_32__maf_mmv_pu "N" 0x7466f n a_742 12 LINEAR______0_000000__0H___8160_ 6 0.0 8160.0 /end AXIS_PTS
/begin AXIS_PTS ldp_maf_sub__maf_sub_mmv_thd_mon "MAF_SUB" 0x7e688 dummy_b a_742 100 LINEAR______0_000000__0H___1389_ 2 0.0 1389.0 /end AXIS_PTS
/begin AXIS_PTS ldp_tps_av_mon__maf_sub_mon "TPS_AV_MON" 0x7e694 tps_av_mon a_742 10 LINEAR______0_000000__0H___11942 8 0.0 119.53125 /end AXIS_PTS
/begin AXIS_PTS ldp_n_32_mon__maf_sub_mon "MAF_SUB_MON" 0x7e68b maf_sub_mon a_742 100 LINEAR______0_000000__0H___8160_ 8 0.0 8160.0 /end AXIS_PTS
/begin AXIS_PTS ldpm_tco_10 "TCO" 0x74676 tco a_742 15 LINEAR_______48_000000__0H___142 8 -48.0 142.5 /end AXIS_PTS
/begin AXIS_PTS ldpm_n_32_30 "N" 0x7467f n_32 a_742 100 LINEAR______0_000000__0H___8160_ 6 0.0 8160.0 /end AXIS_PTS
/begin AXIS_PTS ldpm_n_32_10 "N" 0x74686 n a_742 100 LINEAR______0_000000__0H___8160_ 12 0.0 8160.0 /end AXIS_PTS
/begin AXIS_PTS ldpm_map_1 "MAP" 0x751a0 map a_743 100 LINEAR______0_000000__0H___5434_ 8 0.0 5434.2598 /end AXIS_PTS
/begin AXIS_PTS ldp_map__map_grd_max_pos_er "MAP" 0x751b2 map a_743 100 LINEAR______0_000000__0H___5434_ 6 0.0 5434.2598 /end AXIS_PTS
/begin AXIS_PTS ldp_map__map_grd_min_neg_er "MAP" 0x751c0 map a_743 100 LINEAR______0_000000__0H___5434_ 6 0.0 5434.2598 /end AXIS_PTS
/begin AXIS_PTS ldp_tco__map_ini_ast "TCO" 0x74693 tco a_742 100 LINEAR_______48_000000__0H___142 4 -48.0 142.5 /end AXIS_PTS
/begin AXIS_PTS ldp_maf__mis_a_fac "MAF" 0x7469f maf a_742 10 LINEAR______0_000000__0H___1389_ 6 0.0 1389.0 /end AXIS_PTS
/begin AXIS_PTS ldp_n_32__mis_a_fac "N" 0x74698 n a_742 5 LINEAR______0_000000__0H___8160_ 6 0.0 8160.0 /end AXIS_PTS
/begin AXIS_PTS ldp_n_32__mis_fac_thd_iv_er "N" 0x746a6 n_32 a_742 100 LINEAR______0_000000__0H___8160_ 6 0.0 8160.0 /end AXIS_PTS
/begin AXIS_PTS ldp_tps_sp_lih_dif__mtcpwm_add "TPS_SP_LIH_DIF" 0x751ce tps_sp_lih_dif a_743 100 LINEAR_______119_500000__0H___11 12 -119.5 119.5 /end AXIS_PTS
/begin AXIS_PTS ldpm_tps_lih_dif_mtcpwm_add "TPS_LIH_DIF" 0x751e8 tps_lih_dif a_743 100 LINEAR_______119_500000__0H___11 12 -119.5 119.5 /end AXIS_PTS
/begin AXIS_PTS ldp_tps_dif_grd_mtcpwm_d "TPS_DIF_GRD" 0x75202 tps_dif_grd a_743 100 LINEAR_______119_500000__0H___11 8 -119.5 119.5 /end AXIS_PTS
/begin AXIS_PTS ldp_tps_dif_mtcpwm_i "TPS_DIF" 0x75214 tps_dif a_743 100 LINEAR_______119_500000__0H___11 8 -119.5 119.5 /end AXIS_PTS
/begin AXIS_PTS ldp_tps_av_lih_dif__mtcpwm_i_fac "TPS_AV_LIH_DIF" 0x75226 tps_av_lih_dif a_743 100 LINEAR_______119_500000__0H___11 8 -119.5 119.5 /end AXIS_PTS
/begin AXIS_PTS ldp_tps_dif_mtcpwm_p "TPS_DIF" 0x75238 tps_dif a_743 100 LINEAR_______119_500000__0H___58 8 -119.5 119.5 /end AXIS_PTS
/begin AXIS_PTS ldp_vb_mtcpwm_vb_fac "VB" 0x746ad vb a_742 100 LINEAR______0_000000__0H___26_00 8 0.0 26.0 /end AXIS_PTS
/begin AXIS_PTS ldp_tco_ex__n_ecf "TCO_EX" 0x746b6 tco_ex a_742 15 LINEAR_______48_000000__0H___142 6 -48.0 142.5 /end AXIS_PTS
/begin AXIS_PTS ldp_vs__n_ecf_vs_cor "VS" 0x746bd vs a_742 100 LINEAR______0_000000__0H___25511 5 0.0 255.0 /end AXIS_PTS
/begin AXIS_PTS ldpm_pvs_av_3 "PVS_AV" 0x746c3 pvs_av a_742 10 LINEAR______0_000000__0H___11913 3 0.0 119.5 /end AXIS_PTS
/begin AXIS_PTS ldp_tco__n_max_inf "TCO" 0x746c7 tco a_742 100 LINEAR_______48_000000__0H___142 3 -48.0 142.5 /end AXIS_PTS
/begin AXIS_PTS ldp_pvs_av__n_max_mtc_cur_off "PVS_AV" 0x7524a pvs_av a_743 10 LINEAR______0_000000__0H___119_9 2 0.0 119.99817 /end AXIS_PTS
/begin AXIS_PTS ldp_cycnr__n_min_dif_er "CYCNR" 0x746d4 dummy_b a_742 100 LINEAR______0_000000__0H___255_4 8 0.0 255.0 /end AXIS_PTS
/begin AXIS_PTS ldp_tco__n_min_dif_er "TCO" 0x746cb tco a_742 100 LINEAR_______48_000000__0H___142 8 -48.0 142.5 /end AXIS_PTS
/begin AXIS_PTS ldp_n_ecf_cor_fil__n_perc_ecf "N_ECF_COR_FIL" 0x746dd n_ecf_cor_fil a_742 10 LINEAR______0_000000__0H___15_94 6 0.0 15.94 /end AXIS_PTS
/begin AXIS_PTS ldpm_km_ctr_1 "KM_CTR" 0x74b90 km_ctr a_743 100 LINEAR______0_000000__0H___65534 4 0.0 655340.0 /end AXIS_PTS
/begin AXIS_PTS ldpm_tco_st_3 "TCO_ST" 0x742cd tco_st a_742 100 LINEAR_______48_000000__0H___142 8 -48.0 142.5 /end AXIS_PTS
/begin AXIS_PTS ldp_toil__n_sp_add_pste "TOIL" 0x746e4 toil a_742 100 LINEAR_______48_000000__0H___155 4 -48.0 155.0 /end AXIS_PTS
/begin AXIS_PTS ldp_ang_pste__n_sp_add_pste "ANG_PSTE" 0x75250 ang_pste a_743 100 LINEAR_______1439_956055__0H___1 6 -1439.9561 1439.9121 /end AXIS_PTS
/begin AXIS_PTS ldp_tco__n_sp_lgrd_ch_2 "TCO" 0x746e9 tco a_742 15 LINEAR_______48_000000__0H___142 8 -48.0 142.5 /end AXIS_PTS
/begin AXIS_PTS ldp_tia__n_vim_tia "TIA" 0x746f2 tia a_742 15 LINEAR_______48_000000__0H___142 8 -48.0 142.5 /end AXIS_PTS
/begin AXIS_PTS ldp_vo__nr_ip_maf "VO" 0x7525e vo a_743 100 LINEAR______0_000000__0H___120_0 8 0.0 120.0 /end AXIS_PTS
/begin AXIS_PTS ldp_iga_dif__nr_ti_cop "IGA_DIF" 0x746fb dummy_b a_742 100 LINEAR______0_000000__0H___95_22 5 0.0 95.625 /end AXIS_PTS
/begin AXIS_PTS ldpm_vls_down_1 "ULS_KAT" 0x74701 dummy_b a_742 10 LINEAR______0_000000__0H___1_275 6 0.0 1.275 /end AXIS_PTS
/begin AXIS_PTS ldp_v_pgas_h__pgas_h "V_PGAS_H" 0x74708 dummy_b a_742 100 LINEAR______0_000000__0H___4_980 8 0.0 4.9804688 FUNCTION_LIST CNG /end AXIS_PTS
/begin AXIS_PTS ldp_v_pgas_l__pgas_l "V_PGAS_L" 0x7527e dummy_w a_743 100 LINEAR______0_000000__0H___4_995 8 0.0 4.9951172 FUNCTION_LIST CNG /end AXIS_PTS
/begin AXIS_PTS ldp_ecfpwm_ecf__pow_loss_ecf "ECFPWM_ECF" 0x74711 ecfpwm_ecf a_742 100 LINEAR______0_000000__0H___99_60 6 0.0 99.609375 /end AXIS_PTS
/begin AXIS_PTS ldp_mtc_sum__pq_main_col_tq "TPS_SUM" 0x75290 dummy_b a_743 100 LINEAR______0_000000__0H___119_9 8 0.0 119.99817 /end AXIS_PTS
/begin AXIS_PTS ldp_n_32__pq_main_col_tq "N" 0x74718 n_32 a_742 10 LINEAR______0_000000__0H___8160_ 8 0.0 8160.0 /end AXIS_PTS
/begin AXIS_PTS ldp_tps_sum_av_mon__pq_main_col "TPS_SUM_AV_MON" 0x7e6a6 dummy_b a_742 100 LINEAR______0_000000__0H___11942 8 0.0 119.53125 /end AXIS_PTS
/begin AXIS_PTS ldp_n_32_mon__pq_main_col_tq "N" 0x7e69d n_32 a_742 10 LINEAR______0_000000__0H___8160_ 8 0.0 8160.0 /end AXIS_PTS
/begin AXIS_PTS ldp_toil__pvs_add_fac_low_n "TOIL" 0x74721 toil a_742 100 LINEAR_______48_000000__0H___155 4 -48.0 155.0 FUNCTION_LIST Z10I /end AXIS_PTS
/begin AXIS_PTS ldp_n_32__pvs_av_lih_max "N" 0x74726 n_32 a_742 100 LINEAR______0_000000__0H___8160_ 6 0.0 8160.0 /end AXIS_PTS
/begin AXIS_PTS ldpm_pvs_cor_3 "PVS_COR" 0x752b0 pvs_cor a_743 100 LINEAR______0_000000__0H___11960 6 0.0 119.9982 /end AXIS_PTS
/begin AXIS_PTS ldpm_n_23 "N" 0x752a2 n a_743 100 LINEAR______0_000000__0H___81612 6 0.0 8160.0 /end AXIS_PTS
/begin AXIS_PTS ldpm_pvs_cor_2 "PVS_COR" 0x752cc pvs_cor a_743 100 LINEAR______0_000000__0H___119_9 6 0.0 119.99817 /end AXIS_PTS
/begin AXIS_PTS ldpm_n_18 "N" 0x752be n a_743 100 LINEAR______0_000000__0H___81612 6 0.0 8160.0 /end AXIS_PTS
/begin AXIS_PTS ldp_n_32 "N_32" 0x7472d n_32 a_742 100 LINEAR______0_000000__0H___8160_ 5 0.0 8160.0 /end AXIS_PTS
/begin AXIS_PTS ldpm_n_32_25 "N" 0x74733 n_32 a_742 100 LINEAR______0_000000__0H___8160_ 8 0.0 8160.0 /end AXIS_PTS
/begin AXIS_PTS ldpm_pvs_max_1 "PVS_MAX" 0x752da pvs_max a_743 100 LINEAR______0_000000__0H___119_9 12 0.0 119.99817 /end AXIS_PTS
/begin AXIS_PTS ldp_pvs_av__pvs_fac_cs "PVS_AV" 0x75302 pvs_av a_743 5 LINEAR______0_000000__0H___119_9 2 0.0 119.99817 /end AXIS_PTS
/begin AXIS_PTS ldp_n_dif__pvs_fac_cs "N_DIF" 0x752f4 n_dif a_743 100 LINEAR_______32768_000000__0H___ 6 -32768.0 32767.0 /end AXIS_PTS
/begin AXIS_PTS ldp_pvs_av__pvs_fac_cs_ssg "PVS_AV" 0x75316 pvs_av a_743 5 LINEAR______0_000000__0H___119_9 2 0.0 119.99817 FUNCTION_LIST Z1S1 /end AXIS_PTS
/begin AXIS_PTS ldp_n_dif__pvs_fac_cs_ssg "N_DIF" 0x75308 n_dif a_743 100 LINEAR_______32768_000000__0H___ 6 -32768.0 32767.0 FUNCTION_LIST Z1S1 /end AXIS_PTS
/begin AXIS_PTS ldp_n_vs__pvs_fac_gen_at "N_VS" 0x75326 dummy_w a_743 10 LINEAR______0_000000__0H___81608 4 0.0 8160.0 /end AXIS_PTS
/begin AXIS_PTS ldp_vs_fil__pvs_fac_gen_at "VS_FIL" 0x7531c vs_fil a_743 100 LINEAR______0_000000__0H___51151 4 0.0 511.99218 /end AXIS_PTS
/begin AXIS_PTS ldp_n_vs__pvs_fac_gen_mt "N_VS" 0x7533a dummy_w a_743 10 LINEAR______0_000000__0H___81608 4 0.0 8160.0 /end AXIS_PTS
/begin AXIS_PTS ldp_vs_fil__pvs_fac_gen_mt "VS_FIL" 0x75330 vs_fil a_743 100 LINEAR______0_000000__0H___51151 4 0.0 511.99218 /end AXIS_PTS
/begin AXIS_PTS ldp_n_vs__pvs_fac_gen_ssg "N_VS" 0x7534e dummy_w a_743 10 LINEAR______0_000000__0H___81608 4 0.0 8160.0 FUNCTION_LIST Z1S1 /end AXIS_PTS
/begin AXIS_PTS ldp_vs_fil__pvs_fac_gen_ssg "VS_FIL" 0x75344 vs_fil a_743 100 LINEAR______0_000000__0H___51151 4 0.0 511.99218 FUNCTION_LIST Z1S1 /end AXIS_PTS
/begin AXIS_PTS ldp_pvs_av__pvs_fac_shift "PVS_AV" 0x75362 pvs_av a_743 10 LINEAR______0_000000__0H___119_9 4 0.0 119.99817 /end AXIS_PTS
/begin AXIS_PTS ldp_vs_fil__pvs_fac_shift "VS_FIL" 0x75358 vs_fil a_743 100 LINEAR______0_000000__0H___51151 4 0.0 511.99218 /end AXIS_PTS
/begin AXIS_PTS ldpm_pvs_max_2 "PVS_MAX" 0x7473c pvs_max a_742 100 LINEAR______0_000000__0H___11942 6 0.0 119.53125 /end AXIS_PTS
/begin AXIS_PTS ldp_isapwm__pvs_isa_isapwm "ISAPWM_LOAD_TOT" 0x75380 isapwm_load_tot a_743 100 LINEAR______0_000000__0H___399_9 12 0.0 399.9938 /end AXIS_PTS
/begin AXIS_PTS ldp_pvs_driv__pvs_lgrd_asr "PVS_DRIV" 0x7539a pvs_driv a_743 100 LINEAR______0_000000__0H___11960 4 0.0 119.9982 /end AXIS_PTS
/begin AXIS_PTS ldp_vs_fil__pvs_max_cru "VS_FIL" 0x753a4 vs_fil a_743 100 LINEAR______0_000000__0H___51151 4 0.0 511.99218 /end AXIS_PTS
/begin AXIS_PTS ldpm_n_32_27 "N" 0x74743 n_32 a_742 100 LINEAR______0_000000__0H___8160_ 5 0.0 8160.0 /end AXIS_PTS
/begin AXIS_PTS ldpm_vs_sp_cru_1 "VS_SP_CRU" 0x74e32 vs_sp_cru a_743 100 LINEAR______0_000000__0H___51151 5 0.0 511.99218 /end AXIS_PTS
/begin AXIS_PTS ldp_v_pvs_min__pvs_ratio_hys "V_PVS_MIN" 0x753ae dummy_w a_743 100 LINEAR______0_000000__0H___4_995 6 0.0 4.9951172 /end AXIS_PTS
/begin AXIS_PTS ldp_pv_av_min__pvs_ratio_hys_mon "PV_AV_MIN" 0x7e6af dummy_b a_742 100 LINEAR______0_000000__0H___99_60 6 0.0 99.609375 /end AXIS_PTS
/begin AXIS_PTS ldpm_tqi_1 "TQI" 0x753bc dummy_b a_743 100 LINEAR______0_000000__0H___1023_ 12 0.0 1023.0 /end AXIS_PTS
/begin AXIS_PTS ldpm_n_32_14 "N" 0x74749 n_32 a_742 100 LINEAR______0_000000__0H___8160_ 12 0.0 8160.0 /end AXIS_PTS
/begin AXIS_PTS ldp_t_es__rest "T_ES" 0x753d6 t_es a_743 100 LINEAR______0_000000__0H___65563 8 0.0 65535.0 /end AXIS_PTS
/begin AXIS_PTS ldp_amp__saf_cor_amp "AMP" 0x753e8 amp_longvwordC1D a_743 100 LINEAR______0_000000__0H___5434_ 8 0.0 5434.2598 /end AXIS_PTS
/begin AXIS_PTS ldp_tam__saf_cor_tam "TAM" 0x74756 tam a_742 100 LINEAR_______128_000000__0H___64 8 -128.0 127.0 /end AXIS_PTS
/begin AXIS_PTS ldp_vb__saf_cor_vb "VB" 0x7475f vb a_742 100 LINEAR______0_000000__0H___26_00 8 0.0 26.0 /end AXIS_PTS
/begin AXIS_PTS ldp_maf_cyl__saf_mdl "MAF_CYL" 0x753fa maf_cyl a_743 10 LINEAR______0_000000__0H___16383 8 0.0 16383.75 /end AXIS_PTS
/begin AXIS_PTS ldpm_n_32_15 "N" 0x74768 n a_742 12 LINEAR______0_000000__0H___8160_ 3 0.0 8160.0 /end AXIS_PTS
/begin AXIS_PTS ldp_ti__soi_st "TI" 0x75416 ti_tot a_743 10 LINEAR______0_000000__0H___349_5 4 0.0 349.52 /end AXIS_PTS
/begin AXIS_PTS ldp_n__soi_st "N" 0x7540c n a_743 5 LINEAR______0_000000__0H___81612 4 0.0 8160.0 /end AXIS_PTS
/begin AXIS_PTS ldpm_ti_tot_2 "TI" 0x75420 ti_tot a_743 100 LINEAR______0_000000__0H___349_5 6 0.0 349.52 /end AXIS_PTS
/begin AXIS_PTS ldpm_ti_tot_1 "TI+TI_ADD_TOTZ" 0x75440 ti_tot a_743 10 LINEAR______0_000000__0H___349_5 10 0.0 349.52 /end AXIS_PTS
/begin AXIS_PTS ldpm_n_1 "N" 0x7542e n a_743 100 LINEAR______0_000000__0H___81612 8 0.0 8160.0 /end AXIS_PTS
/begin AXIS_PTS ldp_tco_st__t_ch_dew_max "TCO_ST" 0x7476c tco_st a_742 100 LINEAR_______48_000000__0H___142 5 -48.0 142.5 /end AXIS_PTS
/begin AXIS_PTS ldp_iga_cat__t_ch_puc_deacc "ZWDIFKAT" 0x74772 iga_ch_ofsvbyteC1D a_742 10 LINEAR_______48_000000__0H___041 4 -48.0 0.0 /end AXIS_PTS
/begin AXIS_PTS ldpm_dly_ivvt_y_1 "TOTZ_VANOS_Y" 0x74780 dummy_b a_742 100 LINEAR______0_000000__0H___2550_ 6 0.0 2550.0 /end AXIS_PTS
/begin AXIS_PTS ldpm_cam_dif_ctl_x_1 "NW_DIF_REG_X" 0x74777 dummy_b a_742 100 LINEAR______0_000000__0H___48_00 8 0.0 48.0 /end AXIS_PTS
/begin AXIS_PTS ldpm_maf_kgh_6 "MAF_KGH" 0x75456 maf_kgh a_743 100 LINEAR______0_000000__0H___16383 8 0.0 16383.75 /end AXIS_PTS
/begin AXIS_PTS ldpm_vls_dif_dly_i_1 "ULS_DIF_ZV" 0x74790 dummy_b a_742 100 LINEAR_______0_637500__0H___0_63 12 -0.6375 0.6375 /end AXIS_PTS
/begin AXIS_PTS ldp_tam_dew_down__t_on_dew_down "TAM_DEW_DOWN" 0x747a6 tam_dew a_742 100 LINEAR_______128_000000__0H___12 6 -128.0 127.0 FUNCTION_LIST DPM /end AXIS_PTS
/begin AXIS_PTS ldp_tam_dew_up__t_on_dew_up "TAM_DEW_UP" 0x747ad tam_dew a_742 100 LINEAR_______128_000000__0H___12 6 -128.0 127.0 FUNCTION_LIST DPM /end AXIS_PTS
/begin AXIS_PTS ldp_maf_mmv__t_puc_deacc "MAF_MMV" 0x75468 maf_mmv a_743 10 LINEAR______0_000000__0H___13818 4 0.0 1389.0 /end AXIS_PTS
/begin AXIS_PTS ldp_maf_mmv__t_puc_deacc_1 "MAF_MMV" 0x75472 maf_mmv a_743 10 LINEAR______0_000000__0H___13818 4 0.0 1389.0 /end AXIS_PTS
/begin AXIS_PTS ldp_maf_mmv__t_puc_deacc_2 "MAF_MMV" 0x7547c maf_mmv a_743 10 LINEAR______0_000000__0H___13818 4 0.0 1389.0 /end AXIS_PTS
/begin AXIS_PTS ldp_maf_mmv__t_puc_deacc_3 "MAF_MMV" 0x75486 maf_mmv a_743 10 LINEAR______0_000000__0H___13818 4 0.0 1389.0 /end AXIS_PTS
/begin AXIS_PTS ldp_maf_mmv__t_puc_deacc_4 "MAF_MMV" 0x75490 maf_mmv a_743 10 LINEAR______0_000000__0H___13818 4 0.0 1389.0 /end AXIS_PTS
/begin AXIS_PTS ldp_maf_mmv__t_puc_deacc_5 "MAF_MMV" 0x7549a maf_mmv a_743 10 LINEAR______0_000000__0H___13818 4 0.0 1389.0 /end AXIS_PTS
/begin AXIS_PTS ldpm_pvs_cor_1 "PVS_COR" 0x754b2 pvs_cor a_743 100 LINEAR______0_000000__0H___11960 6 0.0 119.9982 /end AXIS_PTS
/begin AXIS_PTS ldpm_n_16 "N" 0x754a4 n a_743 100 LINEAR______0_000000__0H___81612 6 0.0 8160.0 /end AXIS_PTS
/begin AXIS_PTS ldp_ftl__t_rough_leak_test "FTL" 0x747b4 ftl a_742 100 LINEAR______0_000000__0H___126_0 5 0.0 126.0 FUNCTION_LIST DMTL /end AXIS_PTS
/begin AXIS_PTS ldpm_tco_st_7 "TCO_ST" 0x7479d tco_st a_742 15 LINEAR_______48_000000__0H___142 8 -48.0 142.5 /end AXIS_PTS
/begin AXIS_PTS ldpm_n_3 "N" 0x754c0 n a_743 100 LINEAR______0_000000__0H___81612 10 0.0 8160.0 /end AXIS_PTS
/begin AXIS_PTS ldpm_maf_12 "MAF" 0x747ba maf a_742 5 LINEAR______0_000000__0H___1389_ 3 0.0 1389.0 /end AXIS_PTS
/begin AXIS_PTS ldp_ftl__t_small_leak_test "FTL" 0x747be ftl a_742 100 LINEAR______0_000000__0H___126_0 5 0.0 126.0 FUNCTION_LIST DMTL /end AXIS_PTS
/begin AXIS_PTS ldpm_toil_1 "TOIL" 0x747cc toil a_742 100 LINEAR_______48_000000__0H___155 2 -48.0 155.0 /end AXIS_PTS
/begin AXIS_PTS ldpm_maf_13 "MAF" 0x754ee maf a_743 5 LINEAR______0_000000__0H___13818 8 0.0 1389.0 /end AXIS_PTS
/begin AXIS_PTS ldpm_n_32_1 "N" 0x747cf n a_742 10 LINEAR______0_000000__0H___8160_ 8 0.0 8160.0 /end AXIS_PTS
/begin AXIS_PTS ldp_v_tco__tco "V_TCO" 0x75500 dummy_b a_743 90 LINEAR______0_078000__10H___4_99 16 0.078 4.995 /end AXIS_PTS
/begin AXIS_PTS ldp_maf_kgh__tco_sub_inc "MAF_KGH" 0x75522 maf_kgh a_743 5 LINEAR______0_250000__1H___16383 4 0.25 16383.75 /end AXIS_PTS
/begin AXIS_PTS ldp_v_teg__ip_teg "V_TEG" 0x7552c dummy_w a_743 100 LINEAR______0_000000__0H___4_995 16 0.0 4.9951172 /end AXIS_PTS
/begin AXIS_PTS ldpm_temp_mmv_sub_ex_up_i_2 "TEMP_MMV_SUB_EX_UP_I" 0x7554e dummy_w a_743 100 LINEAR_______33_000000__0H___989 8 -33.0 989.9844 FUNCTION_LIST ETM /end AXIS_PTS
/begin AXIS_PTS ldpm_tam_dew_1 "TAM_DEW" 0x747e6 tam_dew a_742 100 LINEAR_______128_000000__0H___12 6 -128.0 127.0 FUNCTION_LIST DPM /end AXIS_PTS
/begin AXIS_PTS ldpm_t_es_dew_1 "T_ES_DEW" 0x75560 t_es_dew a_743 100 LINEAR______0_000000__0H___65563 8 0.0 65535.0 FUNCTION_LIST DPM /end AXIS_PTS
/begin AXIS_PTS ldp_temp_mmv_sub_ex_x_i_1 "TEMP_MMV_SUB_EX_X_I_1" 0x75572 dummy_w a_743 100 LINEAR_______33_000000__0H___989 8 -33.0 989.9844 /end AXIS_PTS
/begin AXIS_PTS ldpm_toil_5 "TOIL" 0x747f4 toil a_742 100 LINEAR_______48_000000__0H___155 8 -48.0 155.0 FUNCTION_LIST ETM /end AXIS_PTS
/begin AXIS_PTS ldpm_tco_23 "TCO_23" 0x747ed tco a_742 10 LINEAR_______48_000000__0H___142 6 -48.0 142.5 FUNCTION_LIST ETM /end AXIS_PTS
/begin AXIS_PTS ldpm_iga_dif_1 "IGA_DIF" 0x7480a dummy_b a_742 100 LINEAR______0_000000__0H___95_22 6 0.0 95.625 /end AXIS_PTS
/begin AXIS_PTS ldp_saf_kgh__temp_sap_up "SAF_KGH" 0x75584 saf_kgh a_743 100 LINEAR______0_000000__0H___10269 6 0.0 1023.9844 FUNCTION_LIST ETM /end AXIS_PTS
/begin AXIS_PTS ldp_iga_dif__tmpsubcatmincop "IGA_DIF" 0x74811 dummy_b a_742 20 LINEAR______0_000000__0H___95_22 4 0.0 95.625 /end AXIS_PTS
/begin AXIS_PTS ldp_tam__temp_sub_ecf_ini "TAM" 0x74822 tam a_742 100 LINEAR_______128_000000__0H___12 6 -128.0 127.0 /end AXIS_PTS
/begin AXIS_PTS ldp_tco__temp_sub_ecf_ini "TCO" 0x7481b tco a_742 100 LINEAR_______48_000000__0H___142 6 -48.0 142.5 /end AXIS_PTS
/begin AXIS_PTS ldpm_vs_17 "VS" 0x74829 vs a_742 10 LINEAR______0_000000__0H___25511 6 0.0 255.0 FUNCTION_LIST ETM /end AXIS_PTS
/begin AXIS_PTS ldp_temp_mmv_sub_wall_x_i_1 "TEMP_MMV_SUB_WALL_X_I_1" 0x75592 dummy_w a_743 100 LINEAR_______33_000000__0H___989 8 -33.0 989.9844 FUNCTION_LIST ETM /end AXIS_PTS
/begin AXIS_PTS ldp_v_tgas_l__tgas_l "V_TGAS_L" 0x74830 dummy_b a_742 100 LINEAR______0_000000__0H___4_980 10 0.0 4.9804688 FUNCTION_LIST CNG /end AXIS_PTS
/begin AXIS_PTS ldp_v_tgas_pcd__tgas_pcd "V_TGAS_PCD" 0x7483b dummy_b a_742 100 LINEAR______0_000000__0H___4_980 10 0.0 4.9804688 FUNCTION_LIST CNG /end AXIS_PTS
/begin AXIS_PTS ldpm_maf_2 "MAF" 0x755a4 maf a_743 5 LINEAR______0_000000__0H___13818 6 0.0 1389.0 /end AXIS_PTS
/begin AXIS_PTS ldp_n_32__thd_at_er "N" 0x74846 n a_742 5 LINEAR______0_000000__0H___8160_ 12 0.0 8160.0 /end AXIS_PTS
/begin AXIS_PTS ldp_maf__thd_er_is "MAF" 0x755bc maf a_743 100 LINEAR______0_000000__0H___13818 6 0.0 1389.0 /end AXIS_PTS
/begin AXIS_PTS ldp_n__thd_er_is "N" 0x755b2 n a_743 100 LINEAR______0_000000__0H___81612 4 0.0 8160.0 /end AXIS_PTS
/begin AXIS_PTS ldp_maf__thd_er_is_diag "MAF" 0x74853 maf a_742 7 LINEAR______0_000000__0H___1389_ 4 0.0 1389.0 /end AXIS_PTS
/begin AXIS_PTS ldp_n__thd_er_is_diag "N" 0x755ca n a_743 12 LINEAR______0_000000__0H___81612 4 0.0 8160.0 /end AXIS_PTS
/begin AXIS_PTS ldp_n_32__thd_mt_er "N" 0x74858 n a_742 5 LINEAR______0_000000__0H___8160_ 12 0.0 8160.0 /end AXIS_PTS
/begin AXIS_PTS ldp_ti_ad_add_mmv "TI_AD_ADD_GMW" 0x755d4 dummy_b a_743 20 LINEAR_______4_995000__7C57H___5 5 -4.9949999 5.0 /end AXIS_PTS
/begin AXIS_PTS ldpm_tco_9 "TCO" 0x74865 tco a_742 14 LINEAR_______48_000000__0H___142 5 -48.0 142.5 /end AXIS_PTS
/begin AXIS_PTS ldp_vls_dif_val__ti_ad_cyl "VLS_DIF_VAL" 0x755e0 dummy_w a_743 10 LINEAR_______0_637500__0H___0_71 8 -0.6375 0.6375 FUNCTION_LIST CSCM /end AXIS_PTS
/begin AXIS_PTS ldp_ti_ad_fac_mmv "TI_AD_FAK_GMW" 0x755f2 dummy_b a_743 20 LINEAR_______31_250000__3000H___ 5 -31.25 31.25 /end AXIS_PTS
/begin AXIS_PTS ldpm_maf_11 "MAF" 0x7486b maf a_742 10 LINEAR______0_000000__0H___1389_ 8 0.0 1389.0 /end AXIS_PTS
/begin AXIS_PTS ldp_fac_amp__ti_amp_cor "FAC_AMP" 0x74874 fac_amp a_742 100 LINEAR______0_000000__0H___2_043 6 0.0 2.0 /end AXIS_PTS
/begin AXIS_PTS ldp_tia__ti_cast "TIA" 0x7487b tia a_742 15 LINEAR_______48_000000__0H___142 2 -48.0 142.5 /end AXIS_PTS
/begin AXIS_PTS ldp_maf__ti_cat_var "MAF" 0x74885 maf a_742 15 LINEAR______0_000000__0H___1389_ 6 0.0 1389.0 /end AXIS_PTS
/begin AXIS_PTS ldp_n_32__ti_cat_var "N" 0x7487e n a_742 13 LINEAR______0_000000__0H___8160_ 6 0.0 8160.0 /end AXIS_PTS
/begin AXIS_PTS ldpm_maf_9 "MAF" 0x74895 maf a_742 5 LINEAR______0_000000__0H___1389_ 8 0.0 1389.0 /end AXIS_PTS
/begin AXIS_PTS ldpm_n_32_20 "N" 0x7488c n a_742 10 LINEAR______0_000000__0H___8160_ 8 0.0 8160.0 /end AXIS_PTS
/begin AXIS_PTS ldp_cyc__ti_cr_cast "CYC" 0x755fe dummy_b a_743 1 LINEAR______0_000000__0H___65573 6 0.0 65535.0 /end AXIS_PTS
/begin AXIS_PTS ldp_cyc__ti_cr_cst "CYC" 0x7560c dummy_b a_743 100 LINEAR______0_000000__0H___65573 4 0.0 65535.0 /end AXIS_PTS
/begin AXIS_PTS ldpm_n_32_9 "N" 0x7489e n a_742 100 LINEAR______0_000000__0H___8160_ 8 0.0 8160.0 /end AXIS_PTS
/begin AXIS_PTS ldp_fac_amp__ti_cst_amp_cor "FAC_AMP" 0x748a7 fac_amp a_742 100 LINEAR______0_000000__0H___1_992 6 0.0 1.9921875 /end AXIS_PTS
/begin AXIS_PTS ldp_vls_dif_val__ti_cyl "VLS_DIF_VAL" 0x75616 dummy_w a_743 10 LINEAR_______0_637500__0H___0_71 6 -0.6375 0.6375 FUNCTION_LIST CSCM /end AXIS_PTS
/begin AXIS_PTS ldpm_t_ast_4 "T_AST" 0x75624 t_ast a_743 100 LINEAR______0_000000__0H___6553_ 8 0.0 6553.5 /end AXIS_PTS
/begin AXIS_PTS ldpm_tco_7 "TCO" 0x748ae tco a_742 15 LINEAR_______48_000000__0H___142 8 -48.0 142.5 /end AXIS_PTS
/begin AXIS_PTS ldpm_maf_7 "MAF" 0x748b7 maf a_742 5 LINEAR______0_000000__0H___1389_ 8 0.0 1389.0 /end AXIS_PTS
/begin AXIS_PTS ldp_maf__ti_fac_n_maf "MAF" 0x748c9 maf a_742 100 LINEAR______0_000000__0H___1389_ 8 0.0 1389.0 /end AXIS_PTS
/begin AXIS_PTS ldp_n_32__ti_fac_n_maf "N_32" 0x748c0 n_32 a_742 10 LINEAR______0_000000__0H___8160_ 8 0.0 8160.0 /end AXIS_PTS
/begin AXIS_PTS ldpm_t_ast_3 "T_AST" 0x75636 t_ast a_743 100 LINEAR______0_000000__0H___6553_ 8 0.0 6553.5 /end AXIS_PTS
/begin AXIS_PTS ldpm_tco_1 "TCO" 0x748d2 tco a_742 15 LINEAR_______48_000000__0H___142 8 -48.0 142.5 /end AXIS_PTS
/begin AXIS_PTS ldp_tco__ti_fac_tco "TCO" 0x748db tco a_742 100 LINEAR_______48_000000__0H___142 3 -48.0 142.5 /end AXIS_PTS
/begin AXIS_PTS ldp_toil__ti_fac_tia_toil "TOIL" 0x748e6 toil a_742 100 LINEAR_______48_000000__0H___155 6 -48.0 155.0 /end AXIS_PTS
/begin AXIS_PTS ldp_tia__ti_fac_tia_toil "TIA" 0x748df tia a_742 100 LINEAR_______48_000000__0H___142 6 -48.0 142.5 /end AXIS_PTS
/begin AXIS_PTS ldpm_tco_18 "TCO" 0x748ed tco a_742 100 LINEAR_______48_000000__0H___142 4 -48.0 142.5 /end AXIS_PTS
/begin AXIS_PTS ldp_t__ti_inc_cop "TIME" 0x748f7 dummy_b a_742 100 LINEAR______0_000000__0H___25514 4 0.0 255.0 /end AXIS_PTS
/begin AXIS_PTS ldp_iga_dif__ti_inc_cop "IGA_DIF" 0x748f2 dummy_b a_742 100 LINEAR______0_000000__0H___95_22 4 0.0 95.625 /end AXIS_PTS
/begin AXIS_PTS ldp_n_dif_cor__ti_is "N_DIF_COR" 0x75648 n_dif_cor a_743 5 LINEAR_______1024_000000__7C00H_ 6 -1024.0 1016.0 /end AXIS_PTS
/begin AXIS_PTS ldpm_pvs_4 "THR" 0x748fc thr a_742 30 LINEAR______0_000000__0H___11913 12 0.0 119.5 /end AXIS_PTS
/begin AXIS_PTS ldpm_vo_1 "VO" 0x75656 vo a_743 100 LINEAR______0_000000__0H___120_0 8 0.0 120.0 /end AXIS_PTS
/begin COMPU_METHOD LINEAR______0_000000__0H___255_0 "" FORM "%3.0" "-" FORMULA "1.0*X" FORMULA_INV "1.0*X" /end COMPU_METHOD
/begin COMPU_METHOD LINEAR______0_000000__0H___8160_ "" FORM "%4.0" "rpm" FORMULA "32.0*X" FORMULA_INV "0.03125*X" /end COMPU_METHOD
/begin COMPU_METHOD LINEAR______0_000000__0H___0_996 "" FORM "%5.3" "-" FORMULA "0.00390625*X" FORMULA_INV "256.0*X" /end COMPU_METHOD
/begin COMPU_METHOD LINEAR______0_000000__0H___255_4 "" FORM "%3.0" "*seg" FORMULA "1.0*X" FORMULA_INV "1.0*X" /end COMPU_METHOD
/begin COMPU_METHOD LINEAR_______48_000000__0H___155 "" FORM "%5.1" "°C" FORMULA "0.79607843*X-48.0" FORMULA_INV "1.2561576*X+60.295567" /end COMPU_METHOD
/begin COMPU_METHOD LINEAR______0_000000__0H___81605 "" FORM "%4.0" "rpm" FORMULA "0.25*X" FORMULA_INV "4.0*X" /end COMPU_METHOD
/begin COMPU_METHOD LINEAR______0_000000__0H___26_00 "" FORM "%4.1" "V" FORMULA "0.10196078*X" FORMULA_INV "9.8076923*X" /end COMPU_METHOD
/begin COMPU_METHOD LINEAR______0_000000__0H___99_60 "" FORM "%4.1" "%" FORMULA "0.390625*X" FORMULA_INV "2.56*X" /end COMPU_METHOD
/begin COMPU_METHOD LINEAR_______33_000000__0H___987 "" FORM "%3.0" "°C" FORMULA "4.0*X-33.0" FORMULA_INV "0.25*X+8.25" /end COMPU_METHOD
/begin COMPU_METHOD LINEAR_______48_000000__0H___142 "" FORM "%5.1" "°C" FORMULA "0.75*X-48.0" FORMULA_INV "1.3333333*X+64.0" /end COMPU_METHOD
/begin COMPU_METHOD LINEAR______0_000000__0H___65534 "" FORM "%6.0" "km" FORMULA "10.0*X" FORMULA_INV "0.1*X" /end COMPU_METHOD
/begin COMPU_METHOD LINEAR______0_000000__0H___1_992 "" FORM "%5.3" "-" FORMULA "0.0078125*X" FORMULA_INV "128.0*X" /end COMPU_METHOD
/begin COMPU_METHOD LINEAR______0_000000__0H___81608 "" FORM "%4.0" "rpm/(km/h)" FORMULA "1.0*X" FORMULA_INV "1.0*X" /end COMPU_METHOD
/begin COMPU_METHOD LINEAR______0_000000__0H___399_9 "" FORM "%7.3" "%" FORMULA "0.0061035142*X" FORMULA_INV "163.84004*X" /end COMPU_METHOD
/begin COMPU_METHOD LINEAR_______50_000000__0H___49_ "" FORM "%5.1" "%" FORMULA "0.3906251*X-50.0" FORMULA_INV "2.5599994*X+127.99997" /end COMPU_METHOD
/begin COMPU_METHOD LINEAR______0_000000__0H___1389_ "" FORM "%4.0" "mg/stk" FORMULA "5.4470588*X" FORMULA_INV "0.18358531*X" /end COMPU_METHOD
/begin COMPU_METHOD LINEAR______0_000000__0H___15_94 "" FORM "%5.2" "-" FORMULA "0.062509802*X" FORMULA_INV "15.997491*X" /end COMPU_METHOD
/begin COMPU_METHOD LINEAR______0_000000__0H___25511 "" FORM "%3.0" "km/h" FORMULA "1.0*X" FORMULA_INV "1.0*X" /end COMPU_METHOD
/begin COMPU_METHOD LINEAR______0_000000__0H___81612 "" FORM "%4.0" "rpm" FORMULA "1.0*X" FORMULA_INV "1.0*X" /end COMPU_METHOD
/begin COMPU_METHOD LINEAR______0_000000__0H___11913 "" FORM "%5.1" "°TPS" FORMULA "0.46862745*X" FORMULA_INV "2.1338912*X" /end COMPU_METHOD
/begin COMPU_METHOD LINEAR______0_000000__0H___2988_ "" FORM "%4.0" "°TPS/s" FORMULA "11.717647*X" FORMULA_INV "0.085341365*X" /end COMPU_METHOD
/begin COMPU_METHOD LINEAR______0_000000__0H___6553_ "" FORM "%6.1" "s" FORMULA "0.1*X" FORMULA_INV "10.0*X" /end COMPU_METHOD
/begin COMPU_METHOD LINEAR______0_000000__0H___349_5 "" FORM "%7.3" "ms" FORMULA "0.0053333333*X" FORMULA_INV "187.5*X" /end COMPU_METHOD
/begin COMPU_METHOD LINEAR______0_000000__0H___25514 "" FORM "%3.0" "s" FORMULA "1.0*X" FORMULA_INV "1.0*X" /end COMPU_METHOD
/begin COMPU_METHOD LINEAR______0_100000__1H___6553_ "" FORM "%6.1" "0.1s" FORMULA "0.1*X+1.3877788e-017" FORMULA_INV "10.0*X-1.3877788e-016" /end COMPU_METHOD
/begin COMPU_METHOD LINEAR_______5_592320__0H___5_59 "" FORM "%7.4" "s" FORMULA "0.00017066406*X-5.59232" FORMULA_INV "5859.4646*X+32768.001" /end COMPU_METHOD
/begin COMPU_METHOD LINEAR_______128_000000__0H___12 "" FORM "%4.0" "°C" FORMULA "1.0*X-128.0" FORMULA_INV "1.0*X+128.0" /end COMPU_METHOD
/begin COMPU_METHOD LINEAR______0_000000__0H___3_984 "" FORM "%4.2" "-" FORMULA "0.015625*X" FORMULA_INV "64.0*X" /end COMPU_METHOD
/begin COMPU_METHOD LINEAR______0_000000__0H___13818 "" FORM "%5.1" "mg/stk" FORMULA "0.021194781*X" FORMULA_INV "47.181425*X" /end COMPU_METHOD
/begin COMPU_METHOD LINEAR______0_000000__0H___16383 "" FORM "%8.2" "kg/h" FORMULA "0.25*X" FORMULA_INV "4.0*X" /end COMPU_METHOD
/begin COMPU_METHOD LINEAR______0_010000__1H___655_3 "" FORM "%6.2" "s" FORMULA "0.0099999996*X+3.7247841e-010" FORMULA_INV "100.0*X-3.7247842e-008" /end COMPU_METHOD
/begin COMPU_METHOD LINEAR______0_000000__0H___1000_ "" FORM "%7.2" "rpm" FORMULA "0.25*X" FORMULA_INV "4.0*X" /end COMPU_METHOD
/begin COMPU_METHOD LINEAR______0_000000__0H___95_22 "" FORM "%5.2" "°CRK" FORMULA "0.375*X" FORMULA_INV "2.6666667*X" /end COMPU_METHOD
/begin COMPU_METHOD LINEAR______0_000000__0H___5434_ "" FORM "%7.2" "hPa" FORMULA "0.082921489*X" FORMULA_INV "12.0596*X" /end COMPU_METHOD
/begin COMPU_METHOD LINEAR______0_000000__0H___4_995 "" FORM "%5.3" "V" FORMULA "0.0048828125*X" FORMULA_INV "204.8*X" /end COMPU_METHOD
/begin COMPU_METHOD LINEAR______0_000000__0H___0_999 "" FORM "%7.5" "-" FORMULA "1.5258789e-005*X" FORMULA_INV "65536.0*X" /end COMPU_METHOD
/begin COMPU_METHOD LINEAR______0_000000__0H___7_968 "" FORM "%5.3" "-" FORMULA "0.03125*X" FORMULA_INV "32.0*X" /end COMPU_METHOD
/begin COMPU_METHOD LINEAR_______33_000000__0H___989 "" FORM "%6.2" "°C" FORMULA "0.015609741*X-33.0" FORMULA_INV "64.06256*X+2114.0645" /end COMPU_METHOD
/begin COMPU_METHOD LINEAR______0_000000__0H___2550_ "" FORM "%4.0" "ms" FORMULA "10.0*X" FORMULA_INV "0.1*X" /end COMPU_METHOD
/begin COMPU_METHOD LINEAR_______32768_000000__0H___ "" FORM "%6.0" "rpm" FORMULA "1.0*X-32768.0" FORMULA_INV "1.0*X+32768.0" /end COMPU_METHOD
/begin COMPU_METHOD LINEAR______0_000000__0H___7_935 "" FORM "%4.2" "-" FORMULA "0.031247059*X" FORMULA_INV "32.003012*X" /end COMPU_METHOD
/begin COMPU_METHOD LINEAR______0_000000__0H___1_999 "" FORM "%7.5" "-" FORMULA "3.0517585e-005*X" FORMULA_INV "32767.992*X" /end COMPU_METHOD
/begin COMPU_METHOD LINEAR______0_000000__0H___16338 "" FORM "%8.2" "hPa" FORMULA "0.25*X" FORMULA_INV "4.0*X" /end COMPU_METHOD
/begin COMPU_METHOD LINEAR______0_000000__0H___99_99 "" FORM "%6.3" "%" FORMULA "0.0015258789*X" FORMULA_INV "655.36*X" /end COMPU_METHOD
/begin COMPU_METHOD LINEAR______0_000000__0H___119_8 "" FORM "%7.3" "°TPS" FORMULA "0.0018310545*X" FORMULA_INV "546.13339*X" /end COMPU_METHOD
/begin COMPU_METHOD LINEAR_______50_000000__0H___440 "" FORM "%7.3" "%" FORMULA "0.0015258789*X-50.0" FORMULA_INV "655.36002*X+32768.001" /end COMPU_METHOD
/begin COMPU_METHOD LINEAR_______48_000000__0H___143 "" FORM "%5.1" "°C" FORMULA "0.75*X-48.0" FORMULA_INV "1.3333333*X+64.0" /end COMPU_METHOD
/begin COMPU_METHOD LINEAR_______48_000000__0H___041 "" FORM "%5.1" "°CRK" FORMULA "0.375*X-48.0" FORMULA_INV "2.6666667*X+128.0" /end COMPU_METHOD
/begin COMPU_METHOD LINEAR______0_000000__0H___119_9 "" FORM "%7.3" "°TPS" FORMULA "0.0018310547*X" FORMULA_INV "546.13333*X" /end COMPU_METHOD
/begin COMPU_METHOD LINEAR______0_000000__0H___11942 "" FORM "%5.1" "°TPS" FORMULA "0.46875*X" FORMULA_INV "2.1333333*X" /end COMPU_METHOD
/begin COMPU_METHOD LINEAR______0_000000__0H___2_043 "" FORM "%5.3" "-" FORMULA "0.0078431373*X" FORMULA_INV "127.5*X" /end COMPU_METHOD
/begin COMPU_METHOD LINEAR______0_000000__0H___1023_ "" FORM "%4.0" "Nm" FORMULA "1.0*X" FORMULA_INV "1.0*X" /end COMPU_METHOD
/begin COMPU_METHOD LINEAR_______1439_956055__0H___1 "" FORM "%8.1" "°pste" FORMULA "0.043943971*X-1439.9561" FORMULA_INV "22.75625*X+32768.0" /end COMPU_METHOD
/begin COMPU_METHOD LINEAR_______1024_000000__7C00H_ "" FORM "%5.0" "-" FORMULA "1.0*X-32768.0" FORMULA_INV "1.0*X+32768.0" /end COMPU_METHOD
/begin COMPU_METHOD LINEAR_______200_000000__0H___19 "" FORM "%8.4" "%" FORMULA "0.0061035142*X-200.0" FORMULA_INV "163.84004*X+32768.008" /end COMPU_METHOD
/begin COMPU_METHOD LINEAR______0_006100__1H___24_99 "" FORM "%6.3" "%/10ms" FORMULA "0.0061034929*X-3.4929165e-006" FORMULA_INV "163.84061*X+0.00057228156" /end COMPU_METHOD
/begin COMPU_METHOD LINEAR______0_006100__1H___24_49 "" FORM "%6.3" "%" FORMULA "0.0061034929*X-3.4929165e-006" FORMULA_INV "163.84061*X+0.00057228156" /end COMPU_METHOD
/begin COMPU_METHOD LINEAR______0_000000__0H___120_0 "" FORM "%5.1" "°CRK" FORMULA "0.375*X" FORMULA_INV "2.6666667*X" /end COMPU_METHOD
/begin COMPU_METHOD LINEAR______0_000000__0H____200_ "" FORM "%8.3" "%" FORMULA "-0.0061035156*X" FORMULA_INV "-163.84*X" /end COMPU_METHOD
/begin COMPU_METHOD LINEAR______0_000000__0H___51151 "" FORM "%7.3" "km/h" FORMULA "0.0078124999*X" FORMULA_INV "128.0*X" /end COMPU_METHOD
/begin COMPU_METHOD LINEAR______0_000015__1H___0_250 "" FORM "%8.6" "-" FORMULA "1.5258787e-005*X+4.1213453e-008" FORMULA_INV "65536.011*X-0.0027009653" /end COMPU_METHOD
/begin COMPU_METHOD LINEAR______1_000000__28FH___31_ "" FORM "%6.3" "%" FORMULA "0.0015258512*X+0.00056746532" FORMULA_INV "655.3719*X-0.37190083" /end COMPU_METHOD
/begin COMPU_METHOD LINEAR______0_000000__0H___0_496 "" FORM "%5.3" "-" FORMULA "0.0039062204*X" FORMULA_INV "256.00194*X" /end COMPU_METHOD
/begin COMPU_METHOD LINEAR______0_000000__0H___1_952 "" FORM "%5.3" "-" FORMULA "3.0517585e-005*X" FORMULA_INV "32767.992*X" /end COMPU_METHOD
/begin COMPU_METHOD LINEAR______0_000000__0H___10253 "" FORM "%7.2" "°C" FORMULA "0.015625*X" FORMULA_INV "64.0*X" /end COMPU_METHOD
/begin COMPU_METHOD LINEAR______0_000000__0H___1820_ "" FORM "%7.2" "g" FORMULA "0.027777829*X" FORMULA_INV "35.999934*X" /end COMPU_METHOD
/begin COMPU_METHOD LINEAR______0_000000__0H___36400 "" FORM "%7.1" "g" FORMULA "0.5554284*X" FORMULA_INV "1.8004121*X" /end COMPU_METHOD
/begin COMPU_METHOD LINEAR______0_000000__0H___2_054 "" FORM "%7.5" "-" FORMULA "3.0518044e-005*X" FORMULA_INV "32767.5*X" /end COMPU_METHOD
/begin COMPU_METHOD LINEAR______0_000000__0H___54355 "" FORM "%7.1" "hPa/4*seg" FORMULA "0.16584298*X" FORMULA_INV "6.0298001*X" /end COMPU_METHOD
/begin COMPU_METHOD LINEAR_______5434_259766__8000H_ "" FORM "%7.1" "hPa/4*seg" FORMULA "0.16584045*X-10868.52" FORMULA_INV "6.0298921*X+65536.0" /end COMPU_METHOD
/begin COMPU_METHOD LINEAR______0_000000__0H___10056 "" FORM "%3.0" "-" FORMULA "1.0*X" FORMULA_INV "1.0*X" /end COMPU_METHOD
/begin COMPU_METHOD LINEAR_______100_000000__0H___99 "" FORM "%6.3" "%" FORMULA "0.0030517578*X-100.0" FORMULA_INV "327.68*X+32768.0" /end COMPU_METHOD
/begin COMPU_METHOD LINEAR_______119_500000__0H___11 "" FORM "%8.3" "°TPS" FORMULA "0.0072941464*X-119.5" FORMULA_INV "137.09623*X+16383.0" /end COMPU_METHOD
/begin COMPU_METHOD LINEAR_______400_000000__0H___39 "" FORM "%7.3" "%" FORMULA "0.012207031*X-400.0" FORMULA_INV "81.92*X+32768.0" /end COMPU_METHOD
/begin COMPU_METHOD LINEAR_______100_000000__0H___57 "" FORM "%6.3" "%/5ms" FORMULA "0.0030517578*X-100.0" FORMULA_INV "327.68*X+32768.0" /end COMPU_METHOD
/begin COMPU_METHOD LINEAR_______119_500000__0H___58 "" FORM "%6.3" "°TPS" FORMULA "0.0072941464*X-119.5" FORMULA_INV "137.09623*X+16383.0" /end COMPU_METHOD
/begin COMPU_METHOD LINEAR______0_000000__0H___10059 "" FORM "%7.2" "rpm" FORMULA "0.03125*X" FORMULA_INV "32.0*X" /end COMPU_METHOD
/begin COMPU_METHOD LINEAR______0_031250__1H___7_968 "" FORM "%5.3" "rpm/100ms" FORMULA "0.03125*X" FORMULA_INV "32.0*X" /end COMPU_METHOD
/begin COMPU_METHOD LINEAR_______1024_000000__0H___1 "" FORM "%5.0" "rpm" FORMULA "1.0*X-1024.0" FORMULA_INV "1.0*X+1024.0" /end COMPU_METHOD
/begin COMPU_METHOD LINEAR______0_000000__0H___5_100 "" FORM "%4.2" "V" FORMULA "0.02*X" FORMULA_INV "50.000001*X" /end COMPU_METHOD
/begin COMPU_METHOD LINEAR______1_000000__100H___8_0 "" FORM "%5.3" "-" FORMULA "0.00390625*X" FORMULA_INV "256.0*X" /end COMPU_METHOD
/begin COMPU_METHOD LINEAR______1_000000__100H___5_0 "" FORM "%5.3" "-" FORMULA "0.00390625*X" FORMULA_INV "256.0*X" /end COMPU_METHOD
/begin COMPU_METHOD LINEAR______0_000000__0H___1_275 "" FORM "%5.3" "V" FORMULA "0.005*X" FORMULA_INV "200.0*X" /end COMPU_METHOD
/begin COMPU_METHOD LINEAR______0_000000__0H___21675 "" FORM "%6.0" "hPa" FORMULA "850.0*X" FORMULA_INV "0.0011764706*X" /end COMPU_METHOD
/begin COMPU_METHOD LINEAR______0_000000__0H___4_980 "" FORM "%5.3" "V" FORMULA "0.01953125*X" FORMULA_INV "51.2*X" /end COMPU_METHOD
/begin COMPU_METHOD LINEAR______0_000000__0H___5100_ "" FORM "%4.0" "W" FORMULA "20.0*X" FORMULA_INV "0.05*X" /end COMPU_METHOD
/begin COMPU_METHOD LINEAR______0_000000__0H___11960 "" FORM "%7.3" "°PVS" FORMULA "0.0018310552*X" FORMULA_INV "546.13319*X" /end COMPU_METHOD
/begin COMPU_METHOD LINEAR______0_000000__0H___11961 "" FORM "%7.3" "°TPS/10ms" FORMULA "0.0018310547*X" FORMULA_INV "546.13333*X" /end COMPU_METHOD
/begin COMPU_METHOD LINEAR______0_000000__0H___0_498 "" FORM "%5.3" "-" FORMULA "0.0019531373*X" FORMULA_INV "511.99679*X" /end COMPU_METHOD
/begin COMPU_METHOD LINEAR______0_000000__0H___15_62 "" FORM "%5.2" "°TPS" FORMULA "0.062509802*X" FORMULA_INV "15.997491*X" /end COMPU_METHOD
/begin COMPU_METHOD LINEAR______0_000000__0H___102_0 "" FORM "%7.3" "-" FORMULA "0.0018252094*X" FORMULA_INV "547.88235*X" /end COMPU_METHOD
/begin COMPU_METHOD LINEAR______0_000000__0H___65563 "" FORM "%5.0" "min" FORMULA "1.0*X" FORMULA_INV "1.0*X" /end COMPU_METHOD
/begin COMPU_METHOD LINEAR_______128_000000__0H___64 "" FORM "%6.1" "°C" FORMULA "1.0*X-128.0" FORMULA_INV "1.0*X+128.0" /end COMPU_METHOD
/begin COMPU_METHOD LINEAR______0_000000__0H___10265 "" FORM "%7.5" "kg/h" FORMULA "0.015625*X" FORMULA_INV "64.0*X" /end COMPU_METHOD
/begin COMPU_METHOD LINEAR_______180_000000__0H___50 "" FORM "%4.0" "°CRK" FORMULA "6.0*X-180.0" FORMULA_INV "0.16666667*X+30.0" /end COMPU_METHOD
/begin COMPU_METHOD LINEAR______0_000000__0H___159_3 "" FORM "%5.1" "ms" FORMULA "0.625*X" FORMULA_INV "1.6*X" /end COMPU_METHOD
/begin COMPU_METHOD LINEAR______0_000000__0H___48_00 "" FORM "%5.2" "°CRK" FORMULA "0.375*X" FORMULA_INV "2.6666667*X" /end COMPU_METHOD
/begin COMPU_METHOD LINEAR_______1_279900__0H___1_27 "" FORM "%7.5" "s" FORMULA "7.8120613e-005*X-1.2799" FORMULA_INV "12800.719*X+16383.64" /end COMPU_METHOD
/begin COMPU_METHOD LINEAR_______640_020000__0H___63 "" FORM "%7.2" "ms" FORMULA "0.019531548*X-640.02" FORMULA_INV "51.199219*X+32768.524" /end COMPU_METHOD
/begin COMPU_METHOD LINEAR_______0_637500__0H___0_63 "" FORM "%5.3" "ms" FORMULA "0.005*X-0.6375" FORMULA_INV "200.0*X+127.5" /end COMPU_METHOD
/begin COMPU_METHOD LINEAR_______1_279900__0H___1_66 "" FORM "%8.5" "s" FORMULA "7.8120613e-005*X-1.2799" FORMULA_INV "12800.719*X+16383.64" /end COMPU_METHOD
/begin COMPU_METHOD LINEAR______0_000000__0H___639_9 "" FORM "%6.3" "ms/0.375°CRK" FORMULA "0.0097656214*X" FORMULA_INV "102.40004*X" /end COMPU_METHOD
/begin COMPU_METHOD LINEAR______0_000000__0H___816_0 "" FORM "%5.1" "s" FORMULA "3.2*X" FORMULA_INV "0.3125*X" /end COMPU_METHOD
/begin COMPU_METHOD LINEAR______0_000000__0H___0_967 "" FORM "%5.3" "s" FORMULA "0.00390625*X" FORMULA_INV "256.0*X" /end COMPU_METHOD
/begin COMPU_METHOD LINEAR______0_000000__0H___20_40 "" FORM "%5.2" "ms" FORMULA "0.08*X" FORMULA_INV "12.5*X" /end COMPU_METHOD
/begin COMPU_METHOD LINEAR______0_000000__0H___11_18 "" FORM "%7.4" "s" FORMULA "0.00017066667*X" FORMULA_INV "5859.375*X" /end COMPU_METHOD
/begin COMPU_METHOD LINEAR______0_000000__0H___655_3 "" FORM "%6.2" "s" FORMULA "0.01*X" FORMULA_INV "100.0*X" /end COMPU_METHOD
/begin COMPU_METHOD LINEAR______0_000000__0H___126_0 "" FORM "%3.0" "L" FORMULA "1.0*X" FORMULA_INV "1.0*X" /end COMPU_METHOD
/begin COMPU_METHOD LINEAR______0_000000__0H___408_0 "" FORM "%5.2" "s" FORMULA "0.05*X" FORMULA_INV "20.0*X" /end COMPU_METHOD
/begin COMPU_METHOD LINEAR_______0_125000__0H___0_12 "" FORM "%7.5" "-" FORMULA "3.8146944e-006*X-0.125" FORMULA_INV "262144.19*X+32768.024" /end COMPU_METHOD
/begin COMPU_METHOD LINEAR_______0_125000__0H___0_00 "" FORM "%8.6" "-" FORMULA "3.8146973e-006*X-0.125" FORMULA_INV "262144.0*X+32768.0" /end COMPU_METHOD
/begin COMPU_METHOD LINEAR______5_000000__8H___159_3 "" FORM "%5.1" "ms" FORMULA "0.625*X" FORMULA_INV "1.6*X" /end COMPU_METHOD
/begin COMPU_METHOD LINEAR______0_000000__0H___51068 "" FORM "%4.0" "ms" FORMULA "20.0*X" FORMULA_INV "0.05*X" /end COMPU_METHOD
/begin COMPU_METHOD LINEAR______0_078000__10H___4_99 "" FORM "%5.3" "V" FORMULA "0.0048828203*X-0.00012512413" FORMULA_INV "204.79967*X+0.025625381" /end COMPU_METHOD
/begin COMPU_METHOD LINEAR______0_750000__1H___190_5 "" FORM "%5.1" "°C/10s" FORMULA "0.75*X" FORMULA_INV "1.3333333*X" /end COMPU_METHOD
/begin COMPU_METHOD LINEAR______0_250000__1H___16383 "" FORM "%7.1" "kg/h" FORMULA "0.25*X" FORMULA_INV "4.0*X" /end COMPU_METHOD
/begin COMPU_METHOD LINEAR______0_000000__0H___66_66 "" FORM "%6.3" "ms" FORMULA "0.0053333333*X" FORMULA_INV "187.5*X" /end COMPU_METHOD
/begin COMPU_METHOD LINEAR______0_000000__0H___30_00 "" FORM "%6.3" "ms" FORMULA "0.0053333333*X" FORMULA_INV "187.5*X" /end COMPU_METHOD
/begin COMPU_METHOD LINEAR_______1023_984375__FFFFH_ "" FORM "%8.2" "°C" FORMULA "-0.015625005*X" FORMULA_INV "-63.999977*X" /end COMPU_METHOD
/begin COMPU_METHOD LINEAR______0_000000__0H___10269 "" FORM "%7.2" "kg/h" FORMULA "0.015625*X" FORMULA_INV "64.0*X" /end COMPU_METHOD
/begin COMPU_METHOD LINEAR_______512_000000__0H___51 "" FORM "%7.2" "°C" FORMULA "0.015625*X-512.0" FORMULA_INV "64.0*X+32768.0" /end COMPU_METHOD
/begin COMPU_METHOD LINEAR_______48_000000__0H___170 "" FORM "%4.2" "°C" FORMULA "0.75*X-48.0" FORMULA_INV "1.3333333*X+64.0" /end COMPU_METHOD
/begin COMPU_METHOD LINEAR_______1_000000__1H____218 "" FORM "%7.1" "us" FORMULA "-0.66663615*X-0.33336385" FORMULA_INV "-1.5000687*X-0.50006867" /end COMPU_METHOD
/begin COMPU_METHOD LINEAR_______4_995000__7C57H___5 "" FORM "%6.3" "ms" FORMULA "0.0053335111*X-174.76599" FORMULA_INV "187.49375*X+32767.531" /end COMPU_METHOD
/begin COMPU_METHOD LINEAR_______0_637500__0H___0_71 "" FORM "%8.5" "V" FORMULA "1.9455253e-005*X-0.6375" FORMULA_INV "51400.0*X+32767.5" /end COMPU_METHOD
/begin COMPU_METHOD LINEAR_______31_250000__3000H___ "" FORM "%7.3" "%" FORMULA "0.0015258789*X-50.0" FORMULA_INV "655.36*X+32768.0" /end COMPU_METHOD
/begin COMPU_METHOD LINEAR______0_000000__0H___10_88 "" FORM "%5.2" "ms" FORMULA "0.042666667*X" FORMULA_INV "23.4375*X" /end COMPU_METHOD
/begin COMPU_METHOD LINEAR______0_500000__80H___0_99 "" FORM "%5.3" "-" FORMULA "0.0039062993*X-6.3092913e-006" FORMULA_INV "255.99677*X+0.0016151582" /end COMPU_METHOD
/begin COMPU_METHOD LINEAR______0_000000__0H___0_972 "" FORM "%6.4" "-" FORMULA "0.00024324786*X" FORMULA_INV "4111.033*X" /end COMPU_METHOD
/begin COMPU_METHOD LINEAR______0_000000__0H___65573 "" FORM "%5.0" "*seg" FORMULA "1.0*X" FORMULA_INV "1.0*X" /end COMPU_METHOD
/begin COMPU_METHOD LINEAR______0_500000__0H___1_500 "" FORM "%6.4" "-" FORMULA "0.00024414063*X+0.5" FORMULA_INV "4096.0*X-2048.0" /end COMPU_METHOD
/begin COMPU_METHOD LINEAR_______0_500000__0H___0_49 "" FORM "%5.3" "-" FORMULA "0.0039058823*X-0.5" FORMULA_INV "256.0241*X+128.01205" /end COMPU_METHOD
/begin COMPU_METHOD LINEAR______0_000488__1H___0_124 "" FORM "%5.3" "-" FORMULA "0.00048827559*X-2.7559055e-007" FORMULA_INV "2048.0237*X+0.00056441599" /end COMPU_METHOD
/begin COMPU_METHOD LINEAR______0_053333__AH___21_84 "" FORM "%6.3" "ms/seg" FORMULA "0.0053333333*X+6.9388939e-018" FORMULA_INV "187.5*X-1.3010426e-015" /end COMPU_METHOD
/begin COMPU_METHOD LINEAR______0_000000__0H___32_76 "" FORM "%5.2" "ms" FORMULA "0.1285*X" FORMULA_INV "7.7821012*X" /end COMPU_METHOD
/begin RECORD_LAYOUT a_1 FNC_VALUES 1 UBYTE COLUMN_DIR DIRECT /end RECORD_LAYOUT
/begin RECORD_LAYOUT a_3 FNC_VALUES 1 UWORD COLUMN_DIR DIRECT /end RECORD_LAYOUT
/begin RECORD_LAYOUT a_6 FNC_VALUES 1 UBYTE COLUMN_DIR DIRECT /end RECORD_LAYOUT
/begin RECORD_LAYOUT a_7 FNC_VALUES 1 UBYTE COLUMN_DIR DIRECT /end RECORD_LAYOUT
/begin RECORD_LAYOUT a_9 FNC_VALUES 1 UWORD COLUMN_DIR DIRECT /end RECORD_LAYOUT
/begin RECORD_LAYOUT a_17 FNC_VALUES 1 UBYTE COLUMN_DIR DIRECT /end RECORD_LAYOUT
/begin RECORD_LAYOUT a_24 FNC_VALUES 1 UWORD COLUMN_DIR DIRECT /end RECORD_LAYOUT
/begin RECORD_LAYOUT a_28 FNC_VALUES 1 UWORD COLUMN_DIR DIRECT /end RECORD_LAYOUT
/begin RECORD_LAYOUT a_31 FNC_VALUES 1 UBYTE COLUMN_DIR DIRECT /end RECORD_LAYOUT
/begin RECORD_LAYOUT a_36 FNC_VALUES 1 UWORD COLUMN_DIR DIRECT /end RECORD_LAYOUT
/begin RECORD_LAYOUT a_39 FNC_VALUES 1 UBYTE COLUMN_DIR DIRECT /end RECORD_LAYOUT
/begin RECORD_LAYOUT a_50 FNC_VALUES 1 UWORD COLUMN_DIR DIRECT /end RECORD_LAYOUT
/begin RECORD_LAYOUT a_742 AXIS_PTS_X 1 UBYTE INDEX_INCR DIRECT /end RECORD_LAYOUT
/begin RECORD_LAYOUT a_743 AXIS_PTS_X 1 UWORD INDEX_INCR DIRECT /end RECORD_LAYOUT
/end MODULE
/end PROJECT
