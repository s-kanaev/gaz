ASAP2_VERSION 1 2
/begin PROJECT Z432 "430"
/begin HEADER "" VERSION "056.03" PROJECT_NO Z430 /end HEADER
/begin MODULE BMW-EASY ""
/begin MOD_COMMON "common attributes" DEPOSIT ABSOLUT BYTE_ORDER BIG_ENDIAN /end MOD_COMMON
/begin CHARACTERISTIC DES_VERSIONC3D "" VALUE 0x3 a_86 100 defaultConversion198 0 255 BIT_MASK 0xffffffff /end CHARACTERISTIC
/begin CHARACTERISTIC DES_VERSIONC4D "" VALUE 0x4 a_86 100 defaultConversion199 0 255 BIT_MASK 0xffffffff /end CHARACTERISTIC
/begin CHARACTERISTIC DES_VERSIONC5D "" VALUE 0x5 a_86 100 defaultConversion200 0 255 BIT_MASK 0xffffffff /end CHARACTERISTIC
/begin CHARACTERISTIC dtp_thd "DTP_THD" VALUE 0x709d8 a_85 10 LINEAR______0_000000__0H___10_24 0.0 10.24 BIT_MASK 0xffffffff /end CHARACTERISTIC
/begin CHARACTERISTIC dummy_b_2 "DUMMY_B_2" VALUE 0x70d6b a_86 100 LINEAR______0_000000__0H___255_0 0.0 255.0 BIT_MASK 0xffffffff /end CHARACTERISTIC
/begin CHARACTERISTIC dummy_w_1 "DUMMY_W_1" VALUE 0x709da a_85 100 LINEAR______0_000000__0H___65535 0.0 65535.0 BIT_MASK 0xffffffff /end CHARACTERISTIC
/begin CHARACTERISTIC fak_t_ar_2_at "C_FAC_T_2_AT_AJ" VALUE 0x70d6c a_86 100 LINEAR______0_000000__0H___1_992 0.0 1.9921875 BIT_MASK 0xffffffff /end CHARACTERISTIC
/begin CHARACTERISTIC fak_t_ar_2_mt "C_FAC_T_2_MT_AJ" VALUE 0x70d6d a_86 100 LINEAR______0_000000__0H___1_992 0.0 1.9921875 BIT_MASK 0xffffffff /end CHARACTERISTIC
/begin CHARACTERISTIC ID_ECU_SAM_TIME1C0D "" VALUE 0x73204 a_85 100 defaultConversion201 0 65535 BIT_MASK 0xffffffff /end CHARACTERISTIC
/begin CHARACTERISTIC ID_ECU_SAM_TIME1C1D "" VALUE 0x73206 a_85 100 defaultConversion202 0 65535 BIT_MASK 0xffffffff /end CHARACTERISTIC
/begin CHARACTERISTIC ID_ECU_SAM_TIME1C2D "" VALUE 0x73208 a_85 100 defaultConversion203 0 65535 BIT_MASK 0xffffffff /end CHARACTERISTIC
/begin CHARACTERISTIC ID_ECU_SAM_TIME1C3D "" VALUE 0x7320a a_85 100 defaultConversion204 0 65535 BIT_MASK 0xffffffff /end CHARACTERISTIC
/begin CHARACTERISTIC ID_ECU_SAM_TIME1C4D "" VALUE 0x7320c a_85 100 defaultConversion205 0 65535 BIT_MASK 0xffffffff /end CHARACTERISTIC
/begin CHARACTERISTIC ID_ECU_SAM_TIME1C5D "" VALUE 0x7320e a_85 100 defaultConversion206 0 65535 BIT_MASK 0xffffffff /end CHARACTERISTIC
/begin CHARACTERISTIC ID_ECU_SAM_TIME1C6D "" VALUE 0x73210 a_85 100 defaultConversion207 0 65535 BIT_MASK 0xffffffff /end CHARACTERISTIC
/begin CHARACTERISTIC ID_ECU_SAM_TIME1C7D "" VALUE 0x73212 a_85 100 defaultConversion208 0 65535 BIT_MASK 0xffffffff /end CHARACTERISTIC
/begin CHARACTERISTIC ID_ECU_SAM_TIME1C8D "" VALUE 0x73214 a_85 100 defaultConversion209 0 65535 BIT_MASK 0xffffffff /end CHARACTERISTIC
/begin CHARACTERISTIC ID_ECU_SAM_TIME1C9D "" VALUE 0x73216 a_85 100 defaultConversion210 0 65535 BIT_MASK 0xffffffff /end CHARACTERISTIC
/begin CHARACTERISTIC ID_ECU_SAM_TIME1C10D "" VALUE 0x73218 a_85 100 defaultConversion211 0 65535 BIT_MASK 0xffffffff /end CHARACTERISTIC
/begin CHARACTERISTIC ID_ECU_SAM_TIME1C11D "" VALUE 0x7321a a_85 100 defaultConversion212 0 65535 BIT_MASK 0xffffffff /end CHARACTERISTIC
/begin CHARACTERISTIC ID_ECU_SAM_TIME1C12D "" VALUE 0x7321c a_85 100 defaultConversion213 0 65535 BIT_MASK 0xffffffff /end CHARACTERISTIC
/begin CHARACTERISTIC ID_ECU_SAM_TIME1C13D "" VALUE 0x7321e a_85 100 defaultConversion214 0 65535 BIT_MASK 0xffffffff /end CHARACTERISTIC
/begin CHARACTERISTIC ID_ECU_SAM_TIME1C14D "" VALUE 0x73220 a_85 100 defaultConversion215 0 65535 BIT_MASK 0xffffffff /end CHARACTERISTIC
/begin CHARACTERISTIC ID_ECU_SAM_TIME1C15D "" VALUE 0x73222 a_85 100 defaultConversion216 0 65535 BIT_MASK 0xffffffff /end CHARACTERISTIC
/begin CHARACTERISTIC ID_ECU_SAM_TIME1C16D "" VALUE 0x73224 a_85 100 defaultConversion217 0 65535 BIT_MASK 0xffffffff /end CHARACTERISTIC
/begin CHARACTERISTIC ID_ECU_SAM_TIME1C17D "" VALUE 0x73226 a_85 100 defaultConversion218 0 65535 BIT_MASK 0xffffffff /end CHARACTERISTIC
/begin CHARACTERISTIC ID_ECU_SAM_TIME1C18D "" VALUE 0x73228 a_85 100 defaultConversion219 0 65535 BIT_MASK 0xffffffff /end CHARACTERISTIC
/begin CHARACTERISTIC ID_ECU_SAM_TIME1C19D "" VALUE 0x7322a a_85 100 defaultConversion220 0 65535 BIT_MASK 0xffffffff /end CHARACTERISTIC
/begin CHARACTERISTIC ID_ECU_SAM_TIME1C20D "" VALUE 0x7322c a_85 100 defaultConversion221 0 65535 BIT_MASK 0xffffffff /end CHARACTERISTIC
/begin CHARACTERISTIC ID_ECU_SAM_TIME1C21D "" VALUE 0x7322e a_85 100 defaultConversion222 0 65535 BIT_MASK 0xffffffff /end CHARACTERISTIC
/begin CHARACTERISTIC ID_ECU_SAM_TIME1C22D "" VALUE 0x73230 a_85 100 defaultConversion223 0 65535 BIT_MASK 0xffffffff /end CHARACTERISTIC
/begin CHARACTERISTIC ID_ECU_SAM_TIME1C23D "" VALUE 0x73232 a_85 100 defaultConversion224 0 65535 BIT_MASK 0xffffffff /end CHARACTERISTIC
/begin CHARACTERISTIC ID_ECU_SAM_TIME1C24D "" VALUE 0x73234 a_85 100 defaultConversion225 0 65535 BIT_MASK 0xffffffff /end CHARACTERISTIC
/begin CHARACTERISTIC ID_ECU_SAM_TIME1C25D "" VALUE 0x73236 a_85 100 defaultConversion226 0 65535 BIT_MASK 0xffffffff /end CHARACTERISTIC
/begin CHARACTERISTIC ID_ECU_SAM_TIME1C26D "" VALUE 0x73238 a_85 100 defaultConversion227 0 65535 BIT_MASK 0xffffffff /end CHARACTERISTIC
/begin CHARACTERISTIC ID_ECU_SAM_TIME1C27D "" VALUE 0x7323a a_85 100 defaultConversion228 0 65535 BIT_MASK 0xffffffff /end CHARACTERISTIC
/begin CHARACTERISTIC ID_ECU_SAM_TIME1C28D "" VALUE 0x7323c a_85 100 defaultConversion229 0 65535 BIT_MASK 0xffffffff /end CHARACTERISTIC
/begin CHARACTERISTIC ID_ECU_SAM_TIME1C29D "" VALUE 0x7323e a_85 100 defaultConversion230 0 65535 BIT_MASK 0xffffffff /end CHARACTERISTIC
/begin CHARACTERISTIC ID_ECU_SAM_TIME1C30D "" VALUE 0x73240 a_85 100 defaultConversion231 0 65535 BIT_MASK 0xffffffff /end CHARACTERISTIC
/begin CHARACTERISTIC ID_ECU_SAM_TIME1C31D "" VALUE 0x73242 a_85 100 defaultConversion232 0 65535 BIT_MASK 0xffffffff /end CHARACTERISTIC
/begin CHARACTERISTIC ID_ECU_SAM_TIME1C32D "" VALUE 0x73244 a_85 100 defaultConversion233 0 65535 BIT_MASK 0xffffffff /end CHARACTERISTIC
/begin CHARACTERISTIC ID_ECU_SAM_TIME1C33D "" VALUE 0x73246 a_85 100 defaultConversion234 0 65535 BIT_MASK 0xffffffff /end CHARACTERISTIC
/begin CHARACTERISTIC ID_ECU_SAM_TIME1C34D "" VALUE 0x73248 a_85 100 defaultConversion235 0 65535 BIT_MASK 0xffffffff /end CHARACTERISTIC
/begin CHARACTERISTIC ID_ECU_SAM_TIME1C35D "" VALUE 0x7324a a_85 100 defaultConversion236 0 65535 BIT_MASK 0xffffffff /end CHARACTERISTIC
/begin CHARACTERISTIC ID_ECU_SAM_TIME1C36D "" VALUE 0x7324c a_85 100 defaultConversion237 0 65535 BIT_MASK 0xffffffff /end CHARACTERISTIC
/begin CHARACTERISTIC ID_ECU_SAM_TIME1C37D "" VALUE 0x7324e a_85 100 defaultConversion238 0 65535 BIT_MASK 0xffffffff /end CHARACTERISTIC
/begin CHARACTERISTIC ID_ECU_SAM_TIME1C38D "" VALUE 0x73250 a_85 100 defaultConversion239 0 65535 BIT_MASK 0xffffffff /end CHARACTERISTIC
/begin CHARACTERISTIC ID_ECU_SAM_TIME1C39D "" VALUE 0x73252 a_85 100 defaultConversion240 0 65535 BIT_MASK 0xffffffff /end CHARACTERISTIC
/begin CHARACTERISTIC ID_ECU_SAM_TIME1C40D "" VALUE 0x73254 a_85 100 defaultConversion241 0 65535 BIT_MASK 0xffffffff /end CHARACTERISTIC
/begin CHARACTERISTIC ID_ECU_SAM_TIME1C41D "" VALUE 0x73256 a_85 100 defaultConversion242 0 65535 BIT_MASK 0xffffffff /end CHARACTERISTIC
/begin CHARACTERISTIC ID_ECU_SAM_TIME1C42D "" VALUE 0x73258 a_85 100 defaultConversion243 0 65535 BIT_MASK 0xffffffff /end CHARACTERISTIC
/begin CHARACTERISTIC ID_ECU_SAM_TIME1C43D "" VALUE 0x7325a a_85 100 defaultConversion244 0 65535 BIT_MASK 0xffffffff /end CHARACTERISTIC
/begin CHARACTERISTIC ID_ECU_SAM_TIME1C44D "" VALUE 0x7325c a_85 100 defaultConversion245 0 65535 BIT_MASK 0xffffffff /end CHARACTERISTIC
/begin CHARACTERISTIC ID_ECU_SAM_TIME1C45D "" VALUE 0x7325e a_85 100 defaultConversion246 0 65535 BIT_MASK 0xffffffff /end CHARACTERISTIC
/begin CHARACTERISTIC ID_ECU_SAM_TIME1C46D "" VALUE 0x73260 a_85 100 defaultConversion247 0 65535 BIT_MASK 0xffffffff /end CHARACTERISTIC
/begin CHARACTERISTIC ID_ECU_SAM_TIME1C47D "" VALUE 0x73262 a_85 100 defaultConversion248 0 65535 BIT_MASK 0xffffffff /end CHARACTERISTIC
/begin CHARACTERISTIC ID_ECU_SAM_TIME1C48D "" VALUE 0x73264 a_85 100 defaultConversion249 0 65535 BIT_MASK 0xffffffff /end CHARACTERISTIC
/begin CHARACTERISTIC ID_ECU_SAM_TIME1C49D "" VALUE 0x73266 a_85 100 defaultConversion250 0 65535 BIT_MASK 0xffffffff /end CHARACTERISTIC
/begin CHARACTERISTIC ID_ECU_SAM_TIME1C50D "" VALUE 0x73268 a_85 100 defaultConversion251 0 65535 BIT_MASK 0xffffffff /end CHARACTERISTIC
/begin CHARACTERISTIC ID_ECU_SAM_TIME1C51D "" VALUE 0x7326a a_85 100 defaultConversion252 0 65535 BIT_MASK 0xffffffff /end CHARACTERISTIC
/begin CHARACTERISTIC ID_ECU_SAM_TIME1C52D "" VALUE 0x7326c a_85 100 defaultConversion253 0 65535 BIT_MASK 0xffffffff /end CHARACTERISTIC
/begin CHARACTERISTIC ID_ECU_SAM_TIME1C53D "" VALUE 0x7326e a_85 100 defaultConversion254 0 65535 BIT_MASK 0xffffffff /end CHARACTERISTIC
/begin CHARACTERISTIC ID_ECU_SAM_TIME1C54D "" VALUE 0x73270 a_85 100 defaultConversion255 0 65535 BIT_MASK 0xffffffff /end CHARACTERISTIC
/begin CHARACTERISTIC ID_ECU_SAM_TIME1C55D "" VALUE 0x73272 a_85 100 defaultConversion256 0 65535 BIT_MASK 0xffffffff /end CHARACTERISTIC
/begin CHARACTERISTIC ID_ECU_SAM_TIME1C56D "" VALUE 0x73274 a_85 100 defaultConversion257 0 65535 BIT_MASK 0xffffffff /end CHARACTERISTIC
/begin CHARACTERISTIC ID_ECU_SAM_TIME1C57D "" VALUE 0x73276 a_85 100 defaultConversion258 0 65535 BIT_MASK 0xffffffff /end CHARACTERISTIC
/begin CHARACTERISTIC ID_ECU_SAM_TIME1C58D "" VALUE 0x73278 a_85 100 defaultConversion259 0 65535 BIT_MASK 0xffffffff /end CHARACTERISTIC
/begin CHARACTERISTIC ID_ECU_SAM_TIME1C59D "" VALUE 0x7327a a_85 100 defaultConversion260 0 65535 BIT_MASK 0xffffffff /end CHARACTERISTIC
/begin CHARACTERISTIC ID_ECU_SAM_TIME1C60D "" VALUE 0x7327c a_85 100 defaultConversion261 0 65535 BIT_MASK 0xffffffff /end CHARACTERISTIC
/begin CHARACTERISTIC ID_ECU_SAM_TIME1C61D "" VALUE 0x7327e a_85 100 defaultConversion262 0 65535 BIT_MASK 0xffffffff /end CHARACTERISTIC
/begin CHARACTERISTIC ID_ECU_SAM_TIME1C62D "" VALUE 0x73280 a_85 100 defaultConversion263 0 65535 BIT_MASK 0xffffffff /end CHARACTERISTIC
/begin CHARACTERISTIC ID_ECU_SAM_TIME1C63D "" VALUE 0x73282 a_85 100 defaultConversion264 0 65535 BIT_MASK 0xffffffff /end CHARACTERISTIC
/begin CHARACTERISTIC ID_ECU_SAM_TIME1C64D "" VALUE 0x73284 a_85 100 defaultConversion265 0 65535 BIT_MASK 0xffffffff /end CHARACTERISTIC
/begin CHARACTERISTIC ID_ECU_SAM_TIME1C65D "" VALUE 0x73286 a_85 100 defaultConversion266 0 65535 BIT_MASK 0xffffffff /end CHARACTERISTIC
/begin CHARACTERISTIC ID_ECU_SAM_TIME1C66D "" VALUE 0x73288 a_85 100 defaultConversion267 0 65535 BIT_MASK 0xffffffff /end CHARACTERISTIC
/begin CHARACTERISTIC ID_ECU_SAM_TIME1C67D "" VALUE 0x7328a a_85 100 defaultConversion268 0 65535 BIT_MASK 0xffffffff /end CHARACTERISTIC
/begin CHARACTERISTIC ID_ECU_SAM_TIME1C68D "" VALUE 0x7328c a_85 100 defaultConversion269 0 65535 BIT_MASK 0xffffffff /end CHARACTERISTIC
/begin CHARACTERISTIC ID_ECU_SAM_TIME1C69D "" VALUE 0x7328e a_85 100 defaultConversion270 0 65535 BIT_MASK 0xffffffff /end CHARACTERISTIC
/begin CHARACTERISTIC ID_ECU_SAM_TIME1C70D "" VALUE 0x73290 a_85 100 defaultConversion271 0 65535 BIT_MASK 0xffffffff /end CHARACTERISTIC
/begin CHARACTERISTIC ID_ECU_SAM_TIME1C71D "" VALUE 0x73292 a_85 100 defaultConversion272 0 65535 BIT_MASK 0xffffffff /end CHARACTERISTIC
/begin CHARACTERISTIC ID_ECU_SAM_TIME1C72D "" VALUE 0x73294 a_85 100 defaultConversion273 0 65535 BIT_MASK 0xffffffff /end CHARACTERISTIC
/begin CHARACTERISTIC ID_ECU_SAM_TIME1C73D "" VALUE 0x73296 a_85 100 defaultConversion274 0 65535 BIT_MASK 0xffffffff /end CHARACTERISTIC
/begin CHARACTERISTIC ID_ECU_SAM_TIME1C74D "" VALUE 0x73298 a_85 100 defaultConversion275 0 65535 BIT_MASK 0xffffffff /end CHARACTERISTIC
/begin CHARACTERISTIC ID_ECU_SAM_TIME1C75D "" VALUE 0x7329a a_85 100 defaultConversion276 0 65535 BIT_MASK 0xffffffff /end CHARACTERISTIC
/begin CHARACTERISTIC ID_ECU_SAM_TIME1C76D "" VALUE 0x7329c a_85 100 defaultConversion277 0 65535 BIT_MASK 0xffffffff /end CHARACTERISTIC
/begin CHARACTERISTIC ID_ECU_SAM_TIME1C77D "" VALUE 0x7329e a_85 100 defaultConversion278 0 65535 BIT_MASK 0xffffffff /end CHARACTERISTIC
/begin CHARACTERISTIC ID_ECU_SAM_TIME1C78D "" VALUE 0x732a0 a_85 100 defaultConversion279 0 65535 BIT_MASK 0xffffffff /end CHARACTERISTIC
/begin CHARACTERISTIC ID_ECU_SAM_TIME1C79D "" VALUE 0x732a2 a_85 100 defaultConversion280 0 65535 BIT_MASK 0xffffffff /end CHARACTERISTIC
/begin CHARACTERISTIC ID_ECU_SAM_TIME1C80D "" VALUE 0x732a4 a_85 100 defaultConversion281 0 65535 BIT_MASK 0xffffffff /end CHARACTERISTIC
/begin CHARACTERISTIC ID_ECU_SAM_TIME1C81D "" VALUE 0x732a6 a_85 100 defaultConversion282 0 65535 BIT_MASK 0xffffffff /end CHARACTERISTIC
/begin CHARACTERISTIC ID_ECU_SAM_TIME1C82D "" VALUE 0x732a8 a_85 100 defaultConversion283 0 65535 BIT_MASK 0xffffffff /end CHARACTERISTIC
/begin CHARACTERISTIC ID_ECU_SAM_TIME1C83D "" VALUE 0x732aa a_85 100 defaultConversion284 0 65535 BIT_MASK 0xffffffff /end CHARACTERISTIC
/begin CHARACTERISTIC ID_ECU_SAM_TIME1C84D "" VALUE 0x732ac a_85 100 defaultConversion285 0 65535 BIT_MASK 0xffffffff /end CHARACTERISTIC
/begin CHARACTERISTIC ID_ECU_SAM_TIME1C85D "" VALUE 0x732ae a_85 100 defaultConversion286 0 65535 BIT_MASK 0xffffffff /end CHARACTERISTIC
/begin CHARACTERISTIC ID_ECU_SAM_TIME1C86D "" VALUE 0x732b0 a_85 100 defaultConversion287 0 65535 BIT_MASK 0xffffffff /end CHARACTERISTIC
/begin CHARACTERISTIC ID_ECU_SAM_TIME1C87D "" VALUE 0x732b2 a_85 100 defaultConversion288 0 65535 BIT_MASK 0xffffffff /end CHARACTERISTIC
/begin CHARACTERISTIC ID_ECU_SAM_TIME1C88D "" VALUE 0x732b4 a_85 100 defaultConversion289 0 65535 BIT_MASK 0xffffffff /end CHARACTERISTIC
/begin CHARACTERISTIC ID_ECU_SAM_TIME1C89D "" VALUE 0x732b6 a_85 100 defaultConversion290 0 65535 BIT_MASK 0xffffffff /end CHARACTERISTIC
/begin CHARACTERISTIC ID_ECU_SAM_TIME1C90D "" VALUE 0x732b8 a_85 100 defaultConversion291 0 65535 BIT_MASK 0xffffffff /end CHARACTERISTIC
/begin CHARACTERISTIC ID_ECU_SAM_TIME1C91D "" VALUE 0x732ba a_85 100 defaultConversion292 0 65535 BIT_MASK 0xffffffff /end CHARACTERISTIC
/begin CHARACTERISTIC ID_ECU_SAM_TIME1C92D "" VALUE 0x732bc a_85 100 defaultConversion293 0 65535 BIT_MASK 0xffffffff /end CHARACTERISTIC
/begin CHARACTERISTIC ID_ECU_SAM_TIME1C93D "" VALUE 0x732be a_85 100 defaultConversion294 0 65535 BIT_MASK 0xffffffff /end CHARACTERISTIC
/begin CHARACTERISTIC ID_ECU_SAM_TIME1C94D "" VALUE 0x732c0 a_85 100 defaultConversion295 0 65535 BIT_MASK 0xffffffff /end CHARACTERISTIC
/begin CHARACTERISTIC ID_ECU_SAM_TIME1C95D "" VALUE 0x732c2 a_85 100 defaultConversion296 0 65535 BIT_MASK 0xffffffff /end CHARACTERISTIC
/begin CHARACTERISTIC ID_ECU_SAM_TIME1C96D "" VALUE 0x732c4 a_85 100 defaultConversion297 0 65535 BIT_MASK 0xffffffff /end CHARACTERISTIC
/begin CHARACTERISTIC ID_ECU_SAM_TIME1C97D "" VALUE 0x732c6 a_85 100 defaultConversion298 0 65535 BIT_MASK 0xffffffff /end CHARACTERISTIC
/begin CHARACTERISTIC ID_ECU_SAM_TIME1C98D "" VALUE 0x732c8 a_85 100 defaultConversion299 0 65535 BIT_MASK 0xffffffff /end CHARACTERISTIC
/begin CHARACTERISTIC ID_ECU_SAM_TIME1C99D "" VALUE 0x732ca a_85 100 defaultConversion300 0 65535 BIT_MASK 0xffffffff /end CHARACTERISTIC
/begin CHARACTERISTIC ID_ECU_SAM_TIME1C100D "" VALUE 0x732cc a_85 100 defaultConversion301 0 65535 BIT_MASK 0xffffffff /end CHARACTERISTIC
/begin CHARACTERISTIC ID_ECU_SAM_TIME1C101D "" VALUE 0x732ce a_85 100 defaultConversion302 0 65535 BIT_MASK 0xffffffff /end CHARACTERISTIC
/begin CHARACTERISTIC ID_ECU_SAM_TIME1C102D "" VALUE 0x732d0 a_85 100 defaultConversion303 0 65535 BIT_MASK 0xffffffff /end CHARACTERISTIC
/begin CHARACTERISTIC ID_ECU_SAM_TIME1C103D "" VALUE 0x732d2 a_85 100 defaultConversion304 0 65535 BIT_MASK 0xffffffff /end CHARACTERISTIC
/begin CHARACTERISTIC ID_ECU_SAM_TIME1C104D "" VALUE 0x732d4 a_85 100 defaultConversion305 0 65535 BIT_MASK 0xffffffff /end CHARACTERISTIC
/begin CHARACTERISTIC ID_ECU_SAM_TIME1C105D "" VALUE 0x732d6 a_85 100 defaultConversion306 0 65535 BIT_MASK 0xffffffff /end CHARACTERISTIC
/begin CHARACTERISTIC ID_ECU_SAM_TIME1C106D "" VALUE 0x732d8 a_85 100 defaultConversion307 0 65535 BIT_MASK 0xffffffff /end CHARACTERISTIC
/begin CHARACTERISTIC ID_ECU_SAM_TIME1C107D "" VALUE 0x732da a_85 100 defaultConversion308 0 65535 BIT_MASK 0xffffffff /end CHARACTERISTIC
/begin CHARACTERISTIC ID_ECU_SAM_TIME1C108D "" VALUE 0x732dc a_85 100 defaultConversion309 0 65535 BIT_MASK 0xffffffff /end CHARACTERISTIC
/begin CHARACTERISTIC ID_ECU_SAM_TIME1C109D "" VALUE 0x732de a_85 100 defaultConversion310 0 65535 BIT_MASK 0xffffffff /end CHARACTERISTIC
/begin CHARACTERISTIC ID_ECU_SAM_TIME1C110D "" VALUE 0x732e0 a_85 100 defaultConversion311 0 65535 BIT_MASK 0xffffffff /end CHARACTERISTIC
/begin CHARACTERISTIC ID_ECU_SAM_TIME1C111D "" VALUE 0x732e2 a_85 100 defaultConversion312 0 65535 BIT_MASK 0xffffffff /end CHARACTERISTIC
/begin CHARACTERISTIC ID_ECU_SAM_TIME1C112D "" VALUE 0x732e4 a_85 100 defaultConversion313 0 65535 BIT_MASK 0xffffffff /end CHARACTERISTIC
/begin CHARACTERISTIC ID_ECU_SAM_TIME1C113D "" VALUE 0x732e6 a_85 100 defaultConversion314 0 65535 BIT_MASK 0xffffffff /end CHARACTERISTIC
/begin CHARACTERISTIC ID_ECU_SAM_TIME1C114D "" VALUE 0x732e8 a_85 100 defaultConversion315 0 65535 BIT_MASK 0xffffffff /end CHARACTERISTIC
/begin CHARACTERISTIC ID_ECU_SAM_TIME1C115D "" VALUE 0x732ea a_85 100 defaultConversion316 0 65535 BIT_MASK 0xffffffff /end CHARACTERISTIC
/begin CHARACTERISTIC ID_ECU_SAM_TIME1C116D "" VALUE 0x732ec a_85 100 defaultConversion317 0 65535 BIT_MASK 0xffffffff /end CHARACTERISTIC
/begin CHARACTERISTIC ID_ECU_SAM_TIME1C117D "" VALUE 0x732ee a_85 100 defaultConversion318 0 65535 BIT_MASK 0xffffffff /end CHARACTERISTIC
/begin CHARACTERISTIC ID_ECU_SAM_TIME1C118D "" VALUE 0x732f0 a_85 100 defaultConversion319 0 65535 BIT_MASK 0xffffffff /end CHARACTERISTIC
/begin CHARACTERISTIC ID_ECU_SAM_TIME1C119D "" VALUE 0x732f2 a_85 100 defaultConversion320 0 65535 BIT_MASK 0xffffffff /end CHARACTERISTIC
/begin CHARACTERISTIC ID_ECU_SAM_TIME1C120D "" VALUE 0x732f4 a_85 100 defaultConversion321 0 65535 BIT_MASK 0xffffffff /end CHARACTERISTIC
/begin CHARACTERISTIC ID_ECU_SAM_TIME1C121D "" VALUE 0x732f6 a_85 100 defaultConversion322 0 65535 BIT_MASK 0xffffffff /end CHARACTERISTIC
/begin CHARACTERISTIC ID_ECU_SAM_TIME1C122D "" VALUE 0x732f8 a_85 100 defaultConversion323 0 65535 BIT_MASK 0xffffffff /end CHARACTERISTIC
/begin CHARACTERISTIC ID_ECU_SAM_TIME1C123D "" VALUE 0x732fa a_85 100 defaultConversion324 0 65535 BIT_MASK 0xffffffff /end CHARACTERISTIC
/begin CHARACTERISTIC ID_ECU_SAM_TIME1C124D "" VALUE 0x732fc a_85 100 defaultConversion325 0 65535 BIT_MASK 0xffffffff /end CHARACTERISTIC
/begin CHARACTERISTIC ID_ECU_SAM_TIME1C125D "" VALUE 0x732fe a_85 100 defaultConversion326 0 65535 BIT_MASK 0xffffffff /end CHARACTERISTIC
/begin CHARACTERISTIC ID_ECU_SAM_TIME1C126D "" VALUE 0x73300 a_85 100 defaultConversion327 0 65535 BIT_MASK 0xffffffff /end CHARACTERISTIC
/begin CHARACTERISTIC ID_ECU_SAM_TIME1C127D "" VALUE 0x73302 a_85 100 defaultConversion328 0 65535 BIT_MASK 0xffffffff /end CHARACTERISTIC
/begin CHARACTERISTIC ID_ECU_SAM_TIME1C128D "" VALUE 0x73304 a_85 100 defaultConversion329 0 65535 BIT_MASK 0xffffffff /end CHARACTERISTIC
/begin CHARACTERISTIC ID_ECU_SAM_TIME1C129D "" VALUE 0x73306 a_85 100 defaultConversion330 0 65535 BIT_MASK 0xffffffff /end CHARACTERISTIC
/begin CHARACTERISTIC ID_ECU_SAM_TIME1C130D "" VALUE 0x73308 a_85 100 defaultConversion331 0 65535 BIT_MASK 0xffffffff /end CHARACTERISTIC
/begin CHARACTERISTIC ID_ECU_SAM_TIME1C131D "" VALUE 0x7330a a_85 100 defaultConversion332 0 65535 BIT_MASK 0xffffffff /end CHARACTERISTIC
/begin CHARACTERISTIC ID_ECU_SAM_TIME1C132D "" VALUE 0x7330c a_85 100 defaultConversion333 0 65535 BIT_MASK 0xffffffff /end CHARACTERISTIC
/begin CHARACTERISTIC ID_ECU_SAM_TIME1C133D "" VALUE 0x7330e a_85 100 defaultConversion334 0 65535 BIT_MASK 0xffffffff /end CHARACTERISTIC
/begin CHARACTERISTIC ID_ECU_SAM_TIME1C134D "" VALUE 0x73310 a_85 100 defaultConversion335 0 65535 BIT_MASK 0xffffffff /end CHARACTERISTIC
/begin CHARACTERISTIC ID_ECU_SAM_TIME1C135D "" VALUE 0x73312 a_85 100 defaultConversion336 0 65535 BIT_MASK 0xffffffff /end CHARACTERISTIC
/begin CHARACTERISTIC ID_ECU_SAM_TIME1C136D "" VALUE 0x73314 a_85 100 defaultConversion337 0 65535 BIT_MASK 0xffffffff /end CHARACTERISTIC
/begin CHARACTERISTIC ID_ECU_SAM_TIME1C137D "" VALUE 0x73316 a_85 100 defaultConversion338 0 65535 BIT_MASK 0xffffffff /end CHARACTERISTIC
/begin CHARACTERISTIC ID_ECU_SAM_TIME1C138D "" VALUE 0x73318 a_85 100 defaultConversion339 0 65535 BIT_MASK 0xffffffff /end CHARACTERISTIC
/begin CHARACTERISTIC ID_ECU_SAM_TIME1C139D "" VALUE 0x7331a a_85 100 defaultConversion340 0 65535 BIT_MASK 0xffffffff /end CHARACTERISTIC
/begin CHARACTERISTIC ID_ECU_SAM_TIME1C140D "" VALUE 0x7331c a_85 100 defaultConversion341 0 65535 BIT_MASK 0xffffffff /end CHARACTERISTIC
/begin CHARACTERISTIC ID_ECU_SAM_TIME1C141D "" VALUE 0x7331e a_85 100 defaultConversion342 0 65535 BIT_MASK 0xffffffff /end CHARACTERISTIC
/begin CHARACTERISTIC ID_ECU_SAM_TIME1C142D "" VALUE 0x73320 a_85 100 defaultConversion343 0 65535 BIT_MASK 0xffffffff /end CHARACTERISTIC
/begin CHARACTERISTIC ID_ECU_SAM_TIME1C143D "" VALUE 0x73322 a_85 100 defaultConversion344 0 65535 BIT_MASK 0xffffffff /end CHARACTERISTIC
/begin CHARACTERISTIC ID_ECU_SAM_TIME1C144D "" VALUE 0x73324 a_85 100 defaultConversion345 0 65535 BIT_MASK 0xffffffff /end CHARACTERISTIC
/begin CHARACTERISTIC ID_ECU_SAM_TIME1C145D "" VALUE 0x73326 a_85 100 defaultConversion346 0 65535 BIT_MASK 0xffffffff /end CHARACTERISTIC
/begin CHARACTERISTIC ID_ECU_SAM_TIME1C146D "" VALUE 0x73328 a_85 100 defaultConversion347 0 65535 BIT_MASK 0xffffffff /end CHARACTERISTIC
/begin CHARACTERISTIC ID_ECU_SAM_TIME1C147D "" VALUE 0x7332a a_85 100 defaultConversion348 0 65535 BIT_MASK 0xffffffff /end CHARACTERISTIC
/begin CHARACTERISTIC ID_ECU_SAM_TIME1C148D "" VALUE 0x7332c a_85 100 defaultConversion349 0 65535 BIT_MASK 0xffffffff /end CHARACTERISTIC
/begin CHARACTERISTIC ID_ECU_SAM_TIME1C149D "" VALUE 0x7332e a_85 100 defaultConversion350 0 65535 BIT_MASK 0xffffffff /end CHARACTERISTIC
/begin CHARACTERISTIC ID_ECU_SAM_TIME1C150D "" VALUE 0x73330 a_85 100 defaultConversion351 0 65535 BIT_MASK 0xffffffff /end CHARACTERISTIC
/begin CHARACTERISTIC ID_ECU_SAM_TIME1C151D "" VALUE 0x73332 a_85 100 defaultConversion352 0 65535 BIT_MASK 0xffffffff /end CHARACTERISTIC
/begin CHARACTERISTIC ID_ECU_SAM_TIME1C152D "" VALUE 0x73334 a_85 100 defaultConversion353 0 65535 BIT_MASK 0xffffffff /end CHARACTERISTIC
/begin CHARACTERISTIC ID_ECU_SAM_TIME1C153D "" VALUE 0x73336 a_85 100 defaultConversion354 0 65535 BIT_MASK 0xffffffff /end CHARACTERISTIC
/begin CHARACTERISTIC ID_ECU_SAM_TIME1C154D "" VALUE 0x73338 a_85 100 defaultConversion355 0 65535 BIT_MASK 0xffffffff /end CHARACTERISTIC
/begin CHARACTERISTIC ID_ECU_SAM_TIME1C155D "" VALUE 0x7333a a_85 100 defaultConversion356 0 65535 BIT_MASK 0xffffffff /end CHARACTERISTIC
/begin CHARACTERISTIC ID_ECU_SAM_TIME1C156D "" VALUE 0x7333c a_85 100 defaultConversion357 0 65535 BIT_MASK 0xffffffff /end CHARACTERISTIC
/begin CHARACTERISTIC ID_ECU_SAM_TIME1C157D "" VALUE 0x7333e a_85 100 defaultConversion358 0 65535 BIT_MASK 0xffffffff /end CHARACTERISTIC
/begin CHARACTERISTIC ID_ECU_SAM_TIME1C158D "" VALUE 0x73340 a_85 100 defaultConversion359 0 65535 BIT_MASK 0xffffffff /end CHARACTERISTIC
/begin CHARACTERISTIC ID_ECU_SAM_TIME1C159D "" VALUE 0x73342 a_85 100 defaultConversion360 0 65535 BIT_MASK 0xffffffff /end CHARACTERISTIC
/begin CHARACTERISTIC ID_ECU_SAM_TIME1C160D "" VALUE 0x73344 a_85 100 defaultConversion361 0 65535 BIT_MASK 0xffffffff /end CHARACTERISTIC
/begin CHARACTERISTIC ID_ECU_SAM_TIME1C161D "" VALUE 0x73346 a_85 100 defaultConversion362 0 65535 BIT_MASK 0xffffffff /end CHARACTERISTIC
/begin CHARACTERISTIC ID_ECU_SAM_TIME1C162D "" VALUE 0x73348 a_85 100 defaultConversion363 0 65535 BIT_MASK 0xffffffff /end CHARACTERISTIC
/begin CHARACTERISTIC ID_ECU_SAM_TIME1C163D "" VALUE 0x7334a a_85 100 defaultConversion364 0 65535 BIT_MASK 0xffffffff /end CHARACTERISTIC
/begin CHARACTERISTIC ID_ECU_SAM_TIME1C164D "" VALUE 0x7334c a_85 100 defaultConversion365 0 65535 BIT_MASK 0xffffffff /end CHARACTERISTIC
/begin CHARACTERISTIC ID_ECU_SAM_TIME1C165D "" VALUE 0x7334e a_85 100 defaultConversion366 0 65535 BIT_MASK 0xffffffff /end CHARACTERISTIC
/begin CHARACTERISTIC ID_ECU_SAM_TIME1C166D "" VALUE 0x73350 a_85 100 defaultConversion367 0 65535 BIT_MASK 0xffffffff /end CHARACTERISTIC
/begin CHARACTERISTIC ID_ECU_SAM_TIME1C167D "" VALUE 0x73352 a_85 100 defaultConversion368 0 65535 BIT_MASK 0xffffffff /end CHARACTERISTIC
/begin CHARACTERISTIC ID_ECU_SAM_TIME1C168D "" VALUE 0x73354 a_85 100 defaultConversion369 0 65535 BIT_MASK 0xffffffff /end CHARACTERISTIC
/begin CHARACTERISTIC ID_ECU_SAM_TIME1C169D "" VALUE 0x73356 a_85 100 defaultConversion370 0 65535 BIT_MASK 0xffffffff /end CHARACTERISTIC
/begin CHARACTERISTIC ID_ECU_SAM_TIME1C170D "" VALUE 0x73358 a_85 100 defaultConversion371 0 65535 BIT_MASK 0xffffffff /end CHARACTERISTIC
/begin CHARACTERISTIC ID_ECU_SAM_TIME1C171D "" VALUE 0x7335a a_85 100 defaultConversion372 0 65535 BIT_MASK 0xffffffff /end CHARACTERISTIC
/begin CHARACTERISTIC ID_ECU_SAM_TIME1C172D "" VALUE 0x7335c a_85 100 defaultConversion373 0 65535 BIT_MASK 0xffffffff /end CHARACTERISTIC
/begin CHARACTERISTIC ID_ECU_SAM_TIME1C173D "" VALUE 0x7335e a_85 100 defaultConversion374 0 65535 BIT_MASK 0xffffffff /end CHARACTERISTIC
/begin CHARACTERISTIC ID_ECU_SAM_TIME1C174D "" VALUE 0x73360 a_85 100 defaultConversion375 0 65535 BIT_MASK 0xffffffff /end CHARACTERISTIC
/begin CHARACTERISTIC ID_ECU_SAM_TIME1C175D "" VALUE 0x73362 a_85 100 defaultConversion376 0 65535 BIT_MASK 0xffffffff /end CHARACTERISTIC
/begin CHARACTERISTIC ID_ECU_SAM_TIME1C176D "" VALUE 0x73364 a_85 100 defaultConversion377 0 65535 BIT_MASK 0xffffffff /end CHARACTERISTIC
/begin CHARACTERISTIC ID_ECU_SAM_TIME1C177D "" VALUE 0x73366 a_85 100 defaultConversion378 0 65535 BIT_MASK 0xffffffff /end CHARACTERISTIC
/begin CHARACTERISTIC ID_ECU_SAM_TIME1C178D "" VALUE 0x73368 a_85 100 defaultConversion379 0 65535 BIT_MASK 0xffffffff /end CHARACTERISTIC
/begin CHARACTERISTIC ID_ECU_SAM_TIME1C179D "" VALUE 0x7336a a_85 100 defaultConversion380 0 65535 BIT_MASK 0xffffffff /end CHARACTERISTIC
/begin CHARACTERISTIC ID_ECU_SAM_TIME1C180D "" VALUE 0x7336c a_85 100 defaultConversion381 0 65535 BIT_MASK 0xffffffff /end CHARACTERISTIC
/begin CHARACTERISTIC ID_ECU_SAM_TIME1C181D "" VALUE 0x7336e a_85 100 defaultConversion382 0 65535 BIT_MASK 0xffffffff /end CHARACTERISTIC
/begin CHARACTERISTIC ID_ECU_SAM_TIME1C182D "" VALUE 0x73370 a_85 100 defaultConversion383 0 65535 BIT_MASK 0xffffffff /end CHARACTERISTIC
/begin CHARACTERISTIC ID_ECU_SAM_TIME1C183D "" VALUE 0x73372 a_85 100 defaultConversion384 0 65535 BIT_MASK 0xffffffff /end CHARACTERISTIC
/begin CHARACTERISTIC ID_ECU_SAM_TIME1C184D "" VALUE 0x73374 a_85 100 defaultConversion385 0 65535 BIT_MASK 0xffffffff /end CHARACTERISTIC
/begin CHARACTERISTIC ID_ECU_SAM_TIME1C185D "" VALUE 0x73376 a_85 100 defaultConversion386 0 65535 BIT_MASK 0xffffffff /end CHARACTERISTIC
/begin CHARACTERISTIC ID_ECU_SAM_TIME1C186D "" VALUE 0x73378 a_85 100 defaultConversion387 0 65535 BIT_MASK 0xffffffff /end CHARACTERISTIC
/begin CHARACTERISTIC ID_ECU_SAM_TIME1C187D "" VALUE 0x7337a a_85 100 defaultConversion388 0 65535 BIT_MASK 0xffffffff /end CHARACTERISTIC
/begin CHARACTERISTIC ID_ECU_SAM_TIME1C188D "" VALUE 0x7337c a_85 100 defaultConversion389 0 65535 BIT_MASK 0xffffffff /end CHARACTERISTIC
/begin CHARACTERISTIC ID_ECU_SAM_TIME1C189D "" VALUE 0x7337e a_85 100 defaultConversion390 0 65535 BIT_MASK 0xffffffff /end CHARACTERISTIC
/begin CHARACTERISTIC ID_ECU_SAM_TIME1C190D "" VALUE 0x73380 a_85 100 defaultConversion391 0 65535 BIT_MASK 0xffffffff /end CHARACTERISTIC
/begin CHARACTERISTIC ID_ECU_SAM_TIME1C191D "" VALUE 0x73382 a_85 100 defaultConversion392 0 65535 BIT_MASK 0xffffffff /end CHARACTERISTIC
/begin CHARACTERISTIC ID_ECU_SAM_TIME1C192D "" VALUE 0x73384 a_85 100 defaultConversion393 0 65535 BIT_MASK 0xffffffff /end CHARACTERISTIC
/begin CHARACTERISTIC ID_ECU_SAM_TIME1C193D "" VALUE 0x73386 a_85 100 defaultConversion394 0 65535 BIT_MASK 0xffffffff /end CHARACTERISTIC
/begin CHARACTERISTIC ID_ECU_SAM_TIME1C194D "" VALUE 0x73388 a_85 100 defaultConversion395 0 65535 BIT_MASK 0xffffffff /end CHARACTERISTIC
/begin CHARACTERISTIC ID_ECU_SAM_TIME1C195D "" VALUE 0x7338a a_85 100 defaultConversion396 0 65535 BIT_MASK 0xffffffff /end CHARACTERISTIC
/begin CHARACTERISTIC ID_ECU_SAM_TIME1C196D "" VALUE 0x7338c a_85 100 defaultConversion397 0 65535 BIT_MASK 0xffffffff /end CHARACTERISTIC
/begin CHARACTERISTIC ID_ECU_SAM_TIME1C197D "" VALUE 0x7338e a_85 100 defaultConversion398 0 65535 BIT_MASK 0xffffffff /end CHARACTERISTIC
/begin CHARACTERISTIC ID_ECU_SAM_TIME1C198D "" VALUE 0x73390 a_85 100 defaultConversion399 0 65535 BIT_MASK 0xffffffff /end CHARACTERISTIC
/begin CHARACTERISTIC ID_ECU_SAM_TIME1C199D "" VALUE 0x73392 a_85 100 defaultConversion400 0 65535 BIT_MASK 0xffffffff /end CHARACTERISTIC
/begin CHARACTERISTIC ID_ECU_SAM_TIME1C200D "" VALUE 0x73394 a_85 100 defaultConversion401 0 65535 BIT_MASK 0xffffffff /end CHARACTERISTIC
/begin CHARACTERISTIC ID_ECU_SAM_TIME1C201D "" VALUE 0x73396 a_85 100 defaultConversion402 0 65535 BIT_MASK 0xffffffff /end CHARACTERISTIC
/begin CHARACTERISTIC ID_ECU_SAM_TIME1C202D "" VALUE 0x73398 a_85 100 defaultConversion403 0 65535 BIT_MASK 0xffffffff /end CHARACTERISTIC
/begin CHARACTERISTIC ID_ECU_SAM_TIME1C203D "" VALUE 0x7339a a_85 100 defaultConversion404 0 65535 BIT_MASK 0xffffffff /end CHARACTERISTIC
/begin CHARACTERISTIC ID_ECU_SAM_TIME1C204D "" VALUE 0x7339c a_85 100 defaultConversion405 0 65535 BIT_MASK 0xffffffff /end CHARACTERISTIC
/begin CHARACTERISTIC ID_ECU_SAM_TIME1C205D "" VALUE 0x7339e a_85 100 defaultConversion406 0 65535 BIT_MASK 0xffffffff /end CHARACTERISTIC
/begin CHARACTERISTIC ID_ECU_SAM_TIME1C206D "" VALUE 0x733a0 a_85 100 defaultConversion407 0 65535 BIT_MASK 0xffffffff /end CHARACTERISTIC
/begin CHARACTERISTIC ID_ECU_SAM_TIME1C207D "" VALUE 0x733a2 a_85 100 defaultConversion408 0 65535 BIT_MASK 0xffffffff /end CHARACTERISTIC
/begin CHARACTERISTIC ID_ECU_SAM_TIME1C208D "" VALUE 0x733a4 a_85 100 defaultConversion409 0 65535 BIT_MASK 0xffffffff /end CHARACTERISTIC
/begin CHARACTERISTIC ID_ECU_SAM_TIME1C209D "" VALUE 0x733a6 a_85 100 defaultConversion410 0 65535 BIT_MASK 0xffffffff /end CHARACTERISTIC
/begin CHARACTERISTIC ID_ECU_SAM_TIME1C210D "" VALUE 0x733a8 a_85 100 defaultConversion411 0 65535 BIT_MASK 0xffffffff /end CHARACTERISTIC
/begin CHARACTERISTIC ID_ECU_SAM_TIME1C211D "" VALUE 0x733aa a_85 100 defaultConversion412 0 65535 BIT_MASK 0xffffffff /end CHARACTERISTIC
/begin CHARACTERISTIC ID_ECU_SAM_TIME1C212D "" VALUE 0x733ac a_85 100 defaultConversion413 0 65535 BIT_MASK 0xffffffff /end CHARACTERISTIC
/begin CHARACTERISTIC ID_ECU_SAM_TIME1C213D "" VALUE 0x733ae a_85 100 defaultConversion414 0 65535 BIT_MASK 0xffffffff /end CHARACTERISTIC
/begin CHARACTERISTIC ID_ECU_SAM_TIME1C214D "" VALUE 0x733b0 a_85 100 defaultConversion415 0 65535 BIT_MASK 0xffffffff /end CHARACTERISTIC
/begin CHARACTERISTIC ID_ECU_SAM_TIME1C215D "" VALUE 0x733b2 a_85 100 defaultConversion416 0 65535 BIT_MASK 0xffffffff /end CHARACTERISTIC
/begin CHARACTERISTIC ID_ECU_SAM_TIME1C216D "" VALUE 0x733b4 a_85 100 defaultConversion417 0 65535 BIT_MASK 0xffffffff /end CHARACTERISTIC
/begin CHARACTERISTIC ID_ECU_SAM_TIME1C217D "" VALUE 0x733b6 a_85 100 defaultConversion418 0 65535 BIT_MASK 0xffffffff /end CHARACTERISTIC
/begin CHARACTERISTIC ID_ECU_SAM_TIME1C218D "" VALUE 0x733b8 a_85 100 defaultConversion419 0 65535 BIT_MASK 0xffffffff /end CHARACTERISTIC
/begin CHARACTERISTIC ID_ECU_SAM_TIME1C219D "" VALUE 0x733ba a_85 100 defaultConversion420 0 65535 BIT_MASK 0xffffffff /end CHARACTERISTIC
/begin CHARACTERISTIC ID_ECU_SAM_TIME1C220D "" VALUE 0x733bc a_85 100 defaultConversion421 0 65535 BIT_MASK 0xffffffff /end CHARACTERISTIC
/begin CHARACTERISTIC ID_ECU_SAM_TIME1C221D "" VALUE 0x733be a_85 100 defaultConversion422 0 65535 BIT_MASK 0xffffffff /end CHARACTERISTIC
/begin CHARACTERISTIC ID_ECU_SAM_TIME1C222D "" VALUE 0x733c0 a_85 100 defaultConversion423 0 65535 BIT_MASK 0xffffffff /end CHARACTERISTIC
/begin CHARACTERISTIC ID_ECU_SAM_TIME1C223D "" VALUE 0x733c2 a_85 100 defaultConversion424 0 65535 BIT_MASK 0xffffffff /end CHARACTERISTIC
/begin CHARACTERISTIC ID_ECU_SAM_TIME1C224D "" VALUE 0x733c4 a_85 100 defaultConversion425 0 65535 BIT_MASK 0xffffffff /end CHARACTERISTIC
/begin CHARACTERISTIC ID_ECU_SAM_TIME1C225D "" VALUE 0x733c6 a_85 100 defaultConversion426 0 65535 BIT_MASK 0xffffffff /end CHARACTERISTIC
/begin CHARACTERISTIC ID_ECU_SAM_TIME1C226D "" VALUE 0x733c8 a_85 100 defaultConversion427 0 65535 BIT_MASK 0xffffffff /end CHARACTERISTIC
/begin CHARACTERISTIC ID_ECU_SAM_TIME1C227D "" VALUE 0x733ca a_85 100 defaultConversion428 0 65535 BIT_MASK 0xffffffff /end CHARACTERISTIC
/begin CHARACTERISTIC ID_ECU_SAM_TIME1C228D "" VALUE 0x733cc a_85 100 defaultConversion429 0 65535 BIT_MASK 0xffffffff /end CHARACTERISTIC
/begin CHARACTERISTIC ID_ECU_SAM_TIME1C229D "" VALUE 0x733ce a_85 100 defaultConversion430 0 65535 BIT_MASK 0xffffffff /end CHARACTERISTIC
/begin CHARACTERISTIC ID_ECU_SAM_TIME1C230D "" VALUE 0x733d0 a_85 100 defaultConversion431 0 65535 BIT_MASK 0xffffffff /end CHARACTERISTIC
/begin CHARACTERISTIC ID_ECU_SAM_TIME1C231D "" VALUE 0x733d2 a_85 100 defaultConversion432 0 65535 BIT_MASK 0xffffffff /end CHARACTERISTIC
/begin CHARACTERISTIC ID_ECU_SAM_TIME1C232D "" VALUE 0x733d4 a_85 100 defaultConversion433 0 65535 BIT_MASK 0xffffffff /end CHARACTERISTIC
/begin CHARACTERISTIC ID_ECU_SAM_TIME1C233D "" VALUE 0x733d6 a_85 100 defaultConversion434 0 65535 BIT_MASK 0xffffffff /end CHARACTERISTIC
/begin CHARACTERISTIC ID_ECU_SAM_TIME1C234D "" VALUE 0x733d8 a_85 100 defaultConversion435 0 65535 BIT_MASK 0xffffffff /end CHARACTERISTIC
/begin CHARACTERISTIC ID_ECU_SAM_TIME1C235D "" VALUE 0x733da a_85 100 defaultConversion436 0 65535 BIT_MASK 0xffffffff /end CHARACTERISTIC
/begin CHARACTERISTIC ID_ECU_SAM_TIME1C236D "" VALUE 0x733dc a_85 100 defaultConversion437 0 65535 BIT_MASK 0xffffffff /end CHARACTERISTIC
/begin CHARACTERISTIC ID_ECU_SAM_TIME1C237D "" VALUE 0x733de a_85 100 defaultConversion438 0 65535 BIT_MASK 0xffffffff /end CHARACTERISTIC
/begin CHARACTERISTIC ID_ECU_SAM_TIME1C238D "" VALUE 0x733e0 a_85 100 defaultConversion439 0 65535 BIT_MASK 0xffffffff /end CHARACTERISTIC
/begin CHARACTERISTIC ID_ECU_SAM_TIME1C239D "" VALUE 0x733e2 a_85 100 defaultConversion440 0 65535 BIT_MASK 0xffffffff /end CHARACTERISTIC
/begin CHARACTERISTIC ID_ECU_SAM_TIME1C240D "" VALUE 0x733e4 a_85 100 defaultConversion441 0 65535 BIT_MASK 0xffffffff /end CHARACTERISTIC
/begin CHARACTERISTIC ID_ECU_SAM_TIME1C241D "" VALUE 0x733e6 a_85 100 defaultConversion442 0 65535 BIT_MASK 0xffffffff /end CHARACTERISTIC
/begin CHARACTERISTIC ID_ECU_SAM_TIME1C242D "" VALUE 0x733e8 a_85 100 defaultConversion443 0 65535 BIT_MASK 0xffffffff /end CHARACTERISTIC
/begin CHARACTERISTIC ID_ECU_SAM_TIME1C243D "" VALUE 0x733ea a_85 100 defaultConversion444 0 65535 BIT_MASK 0xffffffff /end CHARACTERISTIC
/begin CHARACTERISTIC ID_ECU_SAM_TIME1C244D "" VALUE 0x733ec a_85 100 defaultConversion445 0 65535 BIT_MASK 0xffffffff /end CHARACTERISTIC
/begin CHARACTERISTIC ID_ECU_SAM_TIME1C245D "" VALUE 0x733ee a_85 100 defaultConversion446 0 65535 BIT_MASK 0xffffffff /end CHARACTERISTIC
/begin CHARACTERISTIC ID_ECU_SAM_TIME1C246D "" VALUE 0x733f0 a_85 100 defaultConversion447 0 65535 BIT_MASK 0xffffffff /end CHARACTERISTIC
/begin CHARACTERISTIC ID_ECU_SAM_TIME1C247D "" VALUE 0x733f2 a_85 100 defaultConversion448 0 65535 BIT_MASK 0xffffffff /end CHARACTERISTIC
/begin CHARACTERISTIC ID_ECU_SAM_TIME1C248D "" VALUE 0x733f4 a_85 100 defaultConversion449 0 65535 BIT_MASK 0xffffffff /end CHARACTERISTIC
/begin CHARACTERISTIC ID_ECU_SAM_TIME1C249D "" VALUE 0x733f6 a_85 100 defaultConversion450 0 65535 BIT_MASK 0xffffffff /end CHARACTERISTIC
/begin CHARACTERISTIC ID_ECU_SAM_TIME1C250D "" VALUE 0x733f8 a_85 100 defaultConversion451 0 65535 BIT_MASK 0xffffffff /end CHARACTERISTIC
/begin CHARACTERISTIC ID_ECU_SAM_TIME1C251D "" VALUE 0x733fa a_85 100 defaultConversion452 0 65535 BIT_MASK 0xffffffff /end CHARACTERISTIC
/begin CHARACTERISTIC ID_ECU_SAM_TIME1C252D "" VALUE 0x733fc a_85 100 defaultConversion453 0 65535 BIT_MASK 0xffffffff /end CHARACTERISTIC
/begin CHARACTERISTIC ID_ECU_SAM_TIME1C253D "" VALUE 0x733fe a_85 100 defaultConversion454 0 65535 BIT_MASK 0xffffffff /end CHARACTERISTIC
/begin CHARACTERISTIC ID_ECU_SAM_TIME1C254D "" VALUE 0x73400 a_85 100 defaultConversion455 0 65535 BIT_MASK 0xffffffff /end CHARACTERISTIC
/begin CHARACTERISTIC ID_ECU_SAM_TIME1C255D "" VALUE 0x73402 a_85 100 defaultConversion456 0 65535 BIT_MASK 0xffffffff /end CHARACTERISTIC
/begin CHARACTERISTIC ID_ECU_SAM_TIME1C256D "" VALUE 0x73404 a_85 100 defaultConversion457 0 65535 BIT_MASK 0xffffffff /end CHARACTERISTIC
/begin CHARACTERISTIC ID_ECU_SAM_TIME1C257D "" VALUE 0x73406 a_85 100 defaultConversion458 0 65535 BIT_MASK 0xffffffff /end CHARACTERISTIC
/begin CHARACTERISTIC ID_ECU_SAM_TIME2C0D "" VALUE 0x73408 a_85 100 defaultConversion459 0 65535 BIT_MASK 0xffffffff /end CHARACTERISTIC
/begin CHARACTERISTIC ID_ECU_SAM_TIME2C1D "" VALUE 0x7340a a_85 100 defaultConversion460 0 65535 BIT_MASK 0xffffffff /end CHARACTERISTIC
/begin CHARACTERISTIC ID_ECU_SAM_TIME2C2D "" VALUE 0x7340c a_85 100 defaultConversion461 0 65535 BIT_MASK 0xffffffff /end CHARACTERISTIC
/begin CHARACTERISTIC ID_ECU_SAM_TIME2C3D "" VALUE 0x7340e a_85 100 defaultConversion462 0 65535 BIT_MASK 0xffffffff /end CHARACTERISTIC
/begin CHARACTERISTIC ID_ECU_SAM_TIME2C4D "" VALUE 0x73410 a_85 100 defaultConversion463 0 65535 BIT_MASK 0xffffffff /end CHARACTERISTIC
/begin CHARACTERISTIC ID_ECU_SAM_TIME2C5D "" VALUE 0x73412 a_85 100 defaultConversion464 0 65535 BIT_MASK 0xffffffff /end CHARACTERISTIC
/begin CHARACTERISTIC ID_ECU_SAM_TIME2C6D "" VALUE 0x73414 a_85 100 defaultConversion465 0 65535 BIT_MASK 0xffffffff /end CHARACTERISTIC
/begin CHARACTERISTIC ID_ECU_SAM_TIME2C7D "" VALUE 0x73416 a_85 100 defaultConversion466 0 65535 BIT_MASK 0xffffffff /end CHARACTERISTIC
/begin CHARACTERISTIC ID_ECU_SAM_TIME2C8D "" VALUE 0x73418 a_85 100 defaultConversion467 0 65535 BIT_MASK 0xffffffff /end CHARACTERISTIC
/begin CHARACTERISTIC ID_ECU_SAM_TIME2C9D "" VALUE 0x7341a a_85 100 defaultConversion468 0 65535 BIT_MASK 0xffffffff /end CHARACTERISTIC
/begin CHARACTERISTIC ID_ECU_SAM_TIME2C10D "" VALUE 0x7341c a_85 100 defaultConversion469 0 65535 BIT_MASK 0xffffffff /end CHARACTERISTIC
/begin CHARACTERISTIC ID_ECU_SAM_TIME2C11D "" VALUE 0x7341e a_85 100 defaultConversion470 0 65535 BIT_MASK 0xffffffff /end CHARACTERISTIC
/begin CHARACTERISTIC ID_ECU_SAM_TIME2C12D "" VALUE 0x73420 a_85 100 defaultConversion471 0 65535 BIT_MASK 0xffffffff /end CHARACTERISTIC
/begin CHARACTERISTIC ID_ECU_SAM_TIME2C13D "" VALUE 0x73422 a_85 100 defaultConversion472 0 65535 BIT_MASK 0xffffffff /end CHARACTERISTIC
/begin CHARACTERISTIC ID_ECU_SAM_TIME2C14D "" VALUE 0x73424 a_85 100 defaultConversion473 0 65535 BIT_MASK 0xffffffff /end CHARACTERISTIC
/begin CHARACTERISTIC ID_ECU_SAM_TIME2C15D "" VALUE 0x73426 a_85 100 defaultConversion474 0 65535 BIT_MASK 0xffffffff /end CHARACTERISTIC
/begin CHARACTERISTIC ID_ECU_SAM_TIME2C16D "" VALUE 0x73428 a_85 100 defaultConversion475 0 65535 BIT_MASK 0xffffffff /end CHARACTERISTIC
/begin CHARACTERISTIC ID_ECU_SAM_TIME2C17D "" VALUE 0x7342a a_85 100 defaultConversion476 0 65535 BIT_MASK 0xffffffff /end CHARACTERISTIC
/begin CHARACTERISTIC ID_ECU_SAM_TIME2C18D "" VALUE 0x7342c a_85 100 defaultConversion477 0 65535 BIT_MASK 0xffffffff /end CHARACTERISTIC
/begin CHARACTERISTIC ID_ECU_SAM_TIME2C19D "" VALUE 0x7342e a_85 100 defaultConversion478 0 65535 BIT_MASK 0xffffffff /end CHARACTERISTIC
/begin CHARACTERISTIC ID_ECU_SAM_TIME2C20D "" VALUE 0x73430 a_85 100 defaultConversion479 0 65535 BIT_MASK 0xffffffff /end CHARACTERISTIC
/begin CHARACTERISTIC ID_ECU_SAM_TIME2C21D "" VALUE 0x73432 a_85 100 defaultConversion480 0 65535 BIT_MASK 0xffffffff /end CHARACTERISTIC
/begin CHARACTERISTIC ID_ECU_SAM_TIME2C22D "" VALUE 0x73434 a_85 100 defaultConversion481 0 65535 BIT_MASK 0xffffffff /end CHARACTERISTIC
/begin CHARACTERISTIC ID_ECU_SAM_TIME2C23D "" VALUE 0x73436 a_85 100 defaultConversion482 0 65535 BIT_MASK 0xffffffff /end CHARACTERISTIC
/begin CHARACTERISTIC ID_ECU_SAM_TIME2C24D "" VALUE 0x73438 a_85 100 defaultConversion483 0 65535 BIT_MASK 0xffffffff /end CHARACTERISTIC
/begin CHARACTERISTIC ID_ECU_SAM_TIME2C25D "" VALUE 0x7343a a_85 100 defaultConversion484 0 65535 BIT_MASK 0xffffffff /end CHARACTERISTIC
/begin CHARACTERISTIC ID_ECU_SAM_TIME2C26D "" VALUE 0x7343c a_85 100 defaultConversion485 0 65535 BIT_MASK 0xffffffff /end CHARACTERISTIC
/begin CHARACTERISTIC ID_ECU_SAM_TIME2C27D "" VALUE 0x7343e a_85 100 defaultConversion486 0 65535 BIT_MASK 0xffffffff /end CHARACTERISTIC
/begin CHARACTERISTIC ID_ECU_SAM_TIME2C28D "" VALUE 0x73440 a_85 100 defaultConversion487 0 65535 BIT_MASK 0xffffffff /end CHARACTERISTIC
/begin CHARACTERISTIC ID_ECU_SAM_TIME2C29D "" VALUE 0x73442 a_85 100 defaultConversion488 0 65535 BIT_MASK 0xffffffff /end CHARACTERISTIC
/begin CHARACTERISTIC ID_ECU_SAM_TIME2C30D "" VALUE 0x73444 a_85 100 defaultConversion489 0 65535 BIT_MASK 0xffffffff /end CHARACTERISTIC
/begin CHARACTERISTIC ID_ECU_SAM_TIME2C31D "" VALUE 0x73446 a_85 100 defaultConversion490 0 65535 BIT_MASK 0xffffffff /end CHARACTERISTIC
/begin CHARACTERISTIC ID_ECU_SAM_TIME2C32D "" VALUE 0x73448 a_85 100 defaultConversion491 0 65535 BIT_MASK 0xffffffff /end CHARACTERISTIC
/begin CHARACTERISTIC ID_ECU_SAM_TIME2C33D "" VALUE 0x7344a a_85 100 defaultConversion492 0 65535 BIT_MASK 0xffffffff /end CHARACTERISTIC
/begin CHARACTERISTIC ID_ECU_SAM_TIME2C34D "" VALUE 0x7344c a_85 100 defaultConversion493 0 65535 BIT_MASK 0xffffffff /end CHARACTERISTIC
/begin CHARACTERISTIC ID_ECU_SAM_TIME2C35D "" VALUE 0x7344e a_85 100 defaultConversion494 0 65535 BIT_MASK 0xffffffff /end CHARACTERISTIC
/begin CHARACTERISTIC ID_ECU_SAM_TIME2C36D "" VALUE 0x73450 a_85 100 defaultConversion495 0 65535 BIT_MASK 0xffffffff /end CHARACTERISTIC
/begin CHARACTERISTIC ID_ECU_SAM_TIME2C37D "" VALUE 0x73452 a_85 100 defaultConversion496 0 65535 BIT_MASK 0xffffffff /end CHARACTERISTIC
/begin CHARACTERISTIC ID_ECU_SAM_TIME2C38D "" VALUE 0x73454 a_85 100 defaultConversion497 0 65535 BIT_MASK 0xffffffff /end CHARACTERISTIC
/begin CHARACTERISTIC ID_ECU_SAM_TIME2C39D "" VALUE 0x73456 a_85 100 defaultConversion498 0 65535 BIT_MASK 0xffffffff /end CHARACTERISTIC
/begin CHARACTERISTIC ID_ECU_SAM_TIME2C40D "" VALUE 0x73458 a_85 100 defaultConversion499 0 65535 BIT_MASK 0xffffffff /end CHARACTERISTIC
/begin CHARACTERISTIC ID_ECU_SAM_TIME2C41D "" VALUE 0x7345a a_85 100 defaultConversion500 0 65535 BIT_MASK 0xffffffff /end CHARACTERISTIC
/begin CHARACTERISTIC ID_ECU_SAM_TIME2C42D "" VALUE 0x7345c a_85 100 defaultConversion501 0 65535 BIT_MASK 0xffffffff /end CHARACTERISTIC
/begin CHARACTERISTIC ID_ECU_SAM_TIME2C43D "" VALUE 0x7345e a_85 100 defaultConversion502 0 65535 BIT_MASK 0xffffffff /end CHARACTERISTIC
/begin CHARACTERISTIC ID_ECU_SAM_TIME2C44D "" VALUE 0x73460 a_85 100 defaultConversion503 0 65535 BIT_MASK 0xffffffff /end CHARACTERISTIC
/begin CHARACTERISTIC ID_ECU_SAM_TIME2C45D "" VALUE 0x73462 a_85 100 defaultConversion504 0 65535 BIT_MASK 0xffffffff /end CHARACTERISTIC
/begin CHARACTERISTIC ID_ECU_SAM_TIME2C46D "" VALUE 0x73464 a_85 100 defaultConversion505 0 65535 BIT_MASK 0xffffffff /end CHARACTERISTIC
/begin CHARACTERISTIC ID_ECU_SAM_TIME2C47D "" VALUE 0x73466 a_85 100 defaultConversion506 0 65535 BIT_MASK 0xffffffff /end CHARACTERISTIC
/begin CHARACTERISTIC ID_ECU_SAM_TIME2C48D "" VALUE 0x73468 a_85 100 defaultConversion507 0 65535 BIT_MASK 0xffffffff /end CHARACTERISTIC
/begin CHARACTERISTIC ID_ECU_SAM_TIME2C49D "" VALUE 0x7346a a_85 100 defaultConversion508 0 65535 BIT_MASK 0xffffffff /end CHARACTERISTIC
/begin CHARACTERISTIC ID_ECU_SAM_TIME2C50D "" VALUE 0x7346c a_85 100 defaultConversion509 0 65535 BIT_MASK 0xffffffff /end CHARACTERISTIC
/begin CHARACTERISTIC ID_ECU_SAM_TIME2C51D "" VALUE 0x7346e a_85 100 defaultConversion510 0 65535 BIT_MASK 0xffffffff /end CHARACTERISTIC
/begin CHARACTERISTIC ID_ECU_SAM_TIME2C52D "" VALUE 0x73470 a_85 100 defaultConversion511 0 65535 BIT_MASK 0xffffffff /end CHARACTERISTIC
/begin CHARACTERISTIC ID_ECU_SAM_TIME2C53D "" VALUE 0x73472 a_85 100 defaultConversion512 0 65535 BIT_MASK 0xffffffff /end CHARACTERISTIC
/begin CHARACTERISTIC ID_ECU_SAM_TIME2C54D "" VALUE 0x73474 a_85 100 defaultConversion513 0 65535 BIT_MASK 0xffffffff /end CHARACTERISTIC
/begin CHARACTERISTIC ID_ECU_SAM_TIME2C55D "" VALUE 0x73476 a_85 100 defaultConversion514 0 65535 BIT_MASK 0xffffffff /end CHARACTERISTIC
/begin CHARACTERISTIC ID_ECU_SAM_TIME2C56D "" VALUE 0x73478 a_85 100 defaultConversion515 0 65535 BIT_MASK 0xffffffff /end CHARACTERISTIC
/begin CHARACTERISTIC ID_ECU_SAM_TIME2C57D "" VALUE 0x7347a a_85 100 defaultConversion516 0 65535 BIT_MASK 0xffffffff /end CHARACTERISTIC
/begin CHARACTERISTIC ID_ECU_SAM_TIME2C58D "" VALUE 0x7347c a_85 100 defaultConversion517 0 65535 BIT_MASK 0xffffffff /end CHARACTERISTIC
/begin CHARACTERISTIC ID_ECU_SAM_TIME2C59D "" VALUE 0x7347e a_85 100 defaultConversion518 0 65535 BIT_MASK 0xffffffff /end CHARACTERISTIC
/begin CHARACTERISTIC ID_ECU_SAM_TIME2C60D "" VALUE 0x73480 a_85 100 defaultConversion519 0 65535 BIT_MASK 0xffffffff /end CHARACTERISTIC
/begin CHARACTERISTIC ID_ECU_SAM_TIME2C61D "" VALUE 0x73482 a_85 100 defaultConversion520 0 65535 BIT_MASK 0xffffffff /end CHARACTERISTIC
/begin CHARACTERISTIC ID_ECU_SAM_TIME2C62D "" VALUE 0x73484 a_85 100 defaultConversion521 0 65535 BIT_MASK 0xffffffff /end CHARACTERISTIC
/begin CHARACTERISTIC ID_ECU_SAM_TIME2C63D "" VALUE 0x73486 a_85 100 defaultConversion522 0 65535 BIT_MASK 0xffffffff /end CHARACTERISTIC
/begin CHARACTERISTIC ID_ECU_SAM_TIME2C64D "" VALUE 0x73488 a_85 100 defaultConversion523 0 65535 BIT_MASK 0xffffffff /end CHARACTERISTIC
/begin CHARACTERISTIC ID_ECU_SAM_TIME2C65D "" VALUE 0x7348a a_85 100 defaultConversion524 0 65535 BIT_MASK 0xffffffff /end CHARACTERISTIC
/begin CHARACTERISTIC ID_ECU_SAM_TIME2C66D "" VALUE 0x7348c a_85 100 defaultConversion525 0 65535 BIT_MASK 0xffffffff /end CHARACTERISTIC
/begin CHARACTERISTIC ID_ECU_SAM_TIME2C67D "" VALUE 0x7348e a_85 100 defaultConversion526 0 65535 BIT_MASK 0xffffffff /end CHARACTERISTIC
/begin CHARACTERISTIC ID_ECU_SAM_TIME2C68D "" VALUE 0x73490 a_85 100 defaultConversion527 0 65535 BIT_MASK 0xffffffff /end CHARACTERISTIC
/begin CHARACTERISTIC ID_ECU_SAM_TIME2C69D "" VALUE 0x73492 a_85 100 defaultConversion528 0 65535 BIT_MASK 0xffffffff /end CHARACTERISTIC
/begin CHARACTERISTIC ID_ECU_SAM_TIME2C70D "" VALUE 0x73494 a_85 100 defaultConversion529 0 65535 BIT_MASK 0xffffffff /end CHARACTERISTIC
/begin CHARACTERISTIC ID_ECU_SAM_TIME2C71D "" VALUE 0x73496 a_85 100 defaultConversion530 0 65535 BIT_MASK 0xffffffff /end CHARACTERISTIC
/begin CHARACTERISTIC ID_ECU_SAM_TIME2C72D "" VALUE 0x73498 a_85 100 defaultConversion531 0 65535 BIT_MASK 0xffffffff /end CHARACTERISTIC
/begin CHARACTERISTIC ID_ECU_SAM_TIME2C73D "" VALUE 0x7349a a_85 100 defaultConversion532 0 65535 BIT_MASK 0xffffffff /end CHARACTERISTIC
/begin CHARACTERISTIC ID_ECU_SAM_TIME2C74D "" VALUE 0x7349c a_85 100 defaultConversion533 0 65535 BIT_MASK 0xffffffff /end CHARACTERISTIC
/begin CHARACTERISTIC ID_ECU_SAM_TIME2C75D "" VALUE 0x7349e a_85 100 defaultConversion534 0 65535 BIT_MASK 0xffffffff /end CHARACTERISTIC
/begin CHARACTERISTIC ID_ECU_SAM_TIME2C76D "" VALUE 0x734a0 a_85 100 defaultConversion535 0 65535 BIT_MASK 0xffffffff /end CHARACTERISTIC
/begin CHARACTERISTIC ID_ECU_SAM_TIME2C77D "" VALUE 0x734a2 a_85 100 defaultConversion536 0 65535 BIT_MASK 0xffffffff /end CHARACTERISTIC
/begin CHARACTERISTIC ID_ECU_SAM_TIME2C78D "" VALUE 0x734a4 a_85 100 defaultConversion537 0 65535 BIT_MASK 0xffffffff /end CHARACTERISTIC
/begin CHARACTERISTIC ID_ECU_SAM_TIME2C79D "" VALUE 0x734a6 a_85 100 defaultConversion538 0 65535 BIT_MASK 0xffffffff /end CHARACTERISTIC
/begin CHARACTERISTIC ID_ECU_SAM_TIME2C80D "" VALUE 0x734a8 a_85 100 defaultConversion539 0 65535 BIT_MASK 0xffffffff /end CHARACTERISTIC
/begin CHARACTERISTIC ID_ECU_SAM_TIME2C81D "" VALUE 0x734aa a_85 100 defaultConversion540 0 65535 BIT_MASK 0xffffffff /end CHARACTERISTIC
/begin CHARACTERISTIC ID_ECU_SAM_TIME2C82D "" VALUE 0x734ac a_85 100 defaultConversion541 0 65535 BIT_MASK 0xffffffff /end CHARACTERISTIC
/begin CHARACTERISTIC ID_ECU_SAM_TIME2C83D "" VALUE 0x734ae a_85 100 defaultConversion542 0 65535 BIT_MASK 0xffffffff /end CHARACTERISTIC
/begin CHARACTERISTIC ID_ECU_SAM_TIME2C84D "" VALUE 0x734b0 a_85 100 defaultConversion543 0 65535 BIT_MASK 0xffffffff /end CHARACTERISTIC
/begin CHARACTERISTIC ID_ECU_SAM_TIME2C85D "" VALUE 0x734b2 a_85 100 defaultConversion544 0 65535 BIT_MASK 0xffffffff /end CHARACTERISTIC
/begin CHARACTERISTIC ID_ECU_SAM_TIME2C86D "" VALUE 0x734b4 a_85 100 defaultConversion545 0 65535 BIT_MASK 0xffffffff /end CHARACTERISTIC
/begin CHARACTERISTIC ID_ECU_SAM_TIME2C87D "" VALUE 0x734b6 a_85 100 defaultConversion546 0 65535 BIT_MASK 0xffffffff /end CHARACTERISTIC
/begin CHARACTERISTIC ID_ECU_SAM_TIME2C88D "" VALUE 0x734b8 a_85 100 defaultConversion547 0 65535 BIT_MASK 0xffffffff /end CHARACTERISTIC
/begin CHARACTERISTIC ID_ECU_SAM_TIME2C89D "" VALUE 0x734ba a_85 100 defaultConversion548 0 65535 BIT_MASK 0xffffffff /end CHARACTERISTIC
/begin CHARACTERISTIC ID_ECU_SAM_TIME2C90D "" VALUE 0x734bc a_85 100 defaultConversion549 0 65535 BIT_MASK 0xffffffff /end CHARACTERISTIC
/begin CHARACTERISTIC ID_ECU_SAM_TIME2C91D "" VALUE 0x734be a_85 100 defaultConversion550 0 65535 BIT_MASK 0xffffffff /end CHARACTERISTIC
/begin CHARACTERISTIC ID_ECU_SAM_TIME2C92D "" VALUE 0x734c0 a_85 100 defaultConversion551 0 65535 BIT_MASK 0xffffffff /end CHARACTERISTIC
/begin CHARACTERISTIC ID_ECU_SAM_TIME2C93D "" VALUE 0x734c2 a_85 100 defaultConversion552 0 65535 BIT_MASK 0xffffffff /end CHARACTERISTIC
/begin CHARACTERISTIC ID_ECU_SAM_TIME2C94D "" VALUE 0x734c4 a_85 100 defaultConversion553 0 65535 BIT_MASK 0xffffffff /end CHARACTERISTIC
/begin CHARACTERISTIC ID_ECU_SAM_TIME2C95D "" VALUE 0x734c6 a_85 100 defaultConversion554 0 65535 BIT_MASK 0xffffffff /end CHARACTERISTIC
/begin CHARACTERISTIC ID_ECU_SAM_TIME2C96D "" VALUE 0x734c8 a_85 100 defaultConversion555 0 65535 BIT_MASK 0xffffffff /end CHARACTERISTIC
/begin CHARACTERISTIC ID_ECU_SAM_TIME2C97D "" VALUE 0x734ca a_85 100 defaultConversion556 0 65535 BIT_MASK 0xffffffff /end CHARACTERISTIC
/begin CHARACTERISTIC ID_ECU_SAM_TIME2C98D "" VALUE 0x734cc a_85 100 defaultConversion557 0 65535 BIT_MASK 0xffffffff /end CHARACTERISTIC
/begin CHARACTERISTIC ID_ECU_SAM_TIME2C99D "" VALUE 0x734ce a_85 100 defaultConversion558 0 65535 BIT_MASK 0xffffffff /end CHARACTERISTIC
/begin CHARACTERISTIC ID_ECU_SAM_TIME2C100D "" VALUE 0x734d0 a_85 100 defaultConversion559 0 65535 BIT_MASK 0xffffffff /end CHARACTERISTIC
/begin CHARACTERISTIC ID_ECU_SAM_TIME2C101D "" VALUE 0x734d2 a_85 100 defaultConversion560 0 65535 BIT_MASK 0xffffffff /end CHARACTERISTIC
/begin CHARACTERISTIC ID_ECU_SAM_TIME2C102D "" VALUE 0x734d4 a_85 100 defaultConversion561 0 65535 BIT_MASK 0xffffffff /end CHARACTERISTIC
/begin CHARACTERISTIC ID_ECU_SAM_TIME2C103D "" VALUE 0x734d6 a_85 100 defaultConversion562 0 65535 BIT_MASK 0xffffffff /end CHARACTERISTIC
/begin CHARACTERISTIC ID_ECU_SAM_TIME2C104D "" VALUE 0x734d8 a_85 100 defaultConversion563 0 65535 BIT_MASK 0xffffffff /end CHARACTERISTIC
/begin CHARACTERISTIC ID_ECU_SAM_TIME2C105D "" VALUE 0x734da a_85 100 defaultConversion564 0 65535 BIT_MASK 0xffffffff /end CHARACTERISTIC
/begin CHARACTERISTIC ID_ECU_SAM_TIME2C106D "" VALUE 0x734dc a_85 100 defaultConversion565 0 65535 BIT_MASK 0xffffffff /end CHARACTERISTIC
/begin CHARACTERISTIC ID_ECU_SAM_TIME2C107D "" VALUE 0x734de a_85 100 defaultConversion566 0 65535 BIT_MASK 0xffffffff /end CHARACTERISTIC
/begin CHARACTERISTIC ID_ECU_SAM_TIME2C108D "" VALUE 0x734e0 a_85 100 defaultConversion567 0 65535 BIT_MASK 0xffffffff /end CHARACTERISTIC
/begin CHARACTERISTIC ID_ECU_SAM_TIME2C109D "" VALUE 0x734e2 a_85 100 defaultConversion568 0 65535 BIT_MASK 0xffffffff /end CHARACTERISTIC
/begin CHARACTERISTIC ID_ECU_SAM_TIME2C110D "" VALUE 0x734e4 a_85 100 defaultConversion569 0 65535 BIT_MASK 0xffffffff /end CHARACTERISTIC
/begin CHARACTERISTIC ID_ECU_SAM_TIME2C111D "" VALUE 0x734e6 a_85 100 defaultConversion570 0 65535 BIT_MASK 0xffffffff /end CHARACTERISTIC
/begin CHARACTERISTIC ID_ECU_SAM_TIME2C112D "" VALUE 0x734e8 a_85 100 defaultConversion571 0 65535 BIT_MASK 0xffffffff /end CHARACTERISTIC
/begin CHARACTERISTIC ID_ECU_SAM_TIME2C113D "" VALUE 0x734ea a_85 100 defaultConversion572 0 65535 BIT_MASK 0xffffffff /end CHARACTERISTIC
/begin CHARACTERISTIC ID_ECU_SAM_TIME2C114D "" VALUE 0x734ec a_85 100 defaultConversion573 0 65535 BIT_MASK 0xffffffff /end CHARACTERISTIC
/begin CHARACTERISTIC ID_ECU_SAM_TIME2C115D "" VALUE 0x734ee a_85 100 defaultConversion574 0 65535 BIT_MASK 0xffffffff /end CHARACTERISTIC
/begin CHARACTERISTIC ID_ECU_SAM_TIME2C116D "" VALUE 0x734f0 a_85 100 defaultConversion575 0 65535 BIT_MASK 0xffffffff /end CHARACTERISTIC
/begin CHARACTERISTIC ID_ECU_SAM_TIME2C117D "" VALUE 0x734f2 a_85 100 defaultConversion576 0 65535 BIT_MASK 0xffffffff /end CHARACTERISTIC
/begin CHARACTERISTIC ID_ECU_SAM_TIME2C118D "" VALUE 0x734f4 a_85 100 defaultConversion577 0 65535 BIT_MASK 0xffffffff /end CHARACTERISTIC
/begin CHARACTERISTIC ID_ECU_SAM_TIME2C119D "" VALUE 0x734f6 a_85 100 defaultConversion578 0 65535 BIT_MASK 0xffffffff /end CHARACTERISTIC
/begin CHARACTERISTIC ID_ECU_SAM_TIME2C120D "" VALUE 0x734f8 a_85 100 defaultConversion579 0 65535 BIT_MASK 0xffffffff /end CHARACTERISTIC
/begin CHARACTERISTIC ID_ECU_SAM_TIME2C121D "" VALUE 0x734fa a_85 100 defaultConversion580 0 65535 BIT_MASK 0xffffffff /end CHARACTERISTIC
/begin CHARACTERISTIC ID_ECU_SAM_TIME2C122D "" VALUE 0x734fc a_85 100 defaultConversion581 0 65535 BIT_MASK 0xffffffff /end CHARACTERISTIC
/begin CHARACTERISTIC ID_ECU_SAM_TIME2C123D "" VALUE 0x734fe a_85 100 defaultConversion582 0 65535 BIT_MASK 0xffffffff /end CHARACTERISTIC
/begin CHARACTERISTIC ID_ECU_SAM_TIME2C124D "" VALUE 0x73500 a_85 100 defaultConversion583 0 65535 BIT_MASK 0xffffffff /end CHARACTERISTIC
/begin CHARACTERISTIC ID_ECU_SAM_TIME2C125D "" VALUE 0x73502 a_85 100 defaultConversion584 0 65535 BIT_MASK 0xffffffff /end CHARACTERISTIC
/begin CHARACTERISTIC ID_ECU_SAM_TIME2C126D "" VALUE 0x73504 a_85 100 defaultConversion585 0 65535 BIT_MASK 0xffffffff /end CHARACTERISTIC
/begin CHARACTERISTIC ID_ECU_SAM_TIME2C127D "" VALUE 0x73506 a_85 100 defaultConversion586 0 65535 BIT_MASK 0xffffffff /end CHARACTERISTIC
/begin CHARACTERISTIC ID_ECU_SAM_TIME2C128D "" VALUE 0x73508 a_85 100 defaultConversion587 0 65535 BIT_MASK 0xffffffff /end CHARACTERISTIC
/begin CHARACTERISTIC ID_ECU_SAM_TIME2C129D "" VALUE 0x7350a a_85 100 defaultConversion588 0 65535 BIT_MASK 0xffffffff /end CHARACTERISTIC
/begin CHARACTERISTIC ID_ECU_SAM_TIME2C130D "" VALUE 0x7350c a_85 100 defaultConversion589 0 65535 BIT_MASK 0xffffffff /end CHARACTERISTIC
/begin CHARACTERISTIC ID_ECU_SAM_TIME2C131D "" VALUE 0x7350e a_85 100 defaultConversion590 0 65535 BIT_MASK 0xffffffff /end CHARACTERISTIC
/begin CHARACTERISTIC ID_ECU_SAM_TIME2C132D "" VALUE 0x73510 a_85 100 defaultConversion591 0 65535 BIT_MASK 0xffffffff /end CHARACTERISTIC
/begin CHARACTERISTIC ID_ECU_SAM_TIME2C133D "" VALUE 0x73512 a_85 100 defaultConversion592 0 65535 BIT_MASK 0xffffffff /end CHARACTERISTIC
/begin CHARACTERISTIC ID_ECU_SAM_TIME2C134D "" VALUE 0x73514 a_85 100 defaultConversion593 0 65535 BIT_MASK 0xffffffff /end CHARACTERISTIC
/begin CHARACTERISTIC ID_ECU_SAM_TIME2C135D "" VALUE 0x73516 a_85 100 defaultConversion594 0 65535 BIT_MASK 0xffffffff /end CHARACTERISTIC
/begin CHARACTERISTIC ID_ECU_SAM_TIME2C136D "" VALUE 0x73518 a_85 100 defaultConversion595 0 65535 BIT_MASK 0xffffffff /end CHARACTERISTIC
/begin CHARACTERISTIC ID_ECU_SAM_TIME2C137D "" VALUE 0x7351a a_85 100 defaultConversion596 0 65535 BIT_MASK 0xffffffff /end CHARACTERISTIC
/begin CHARACTERISTIC ID_ECU_SAM_TIME2C138D "" VALUE 0x7351c a_85 100 defaultConversion597 0 65535 BIT_MASK 0xffffffff /end CHARACTERISTIC
/begin CHARACTERISTIC ID_ECU_SAM_TIME2C139D "" VALUE 0x7351e a_85 100 defaultConversion598 0 65535 BIT_MASK 0xffffffff /end CHARACTERISTIC
/begin CHARACTERISTIC ID_ECU_SAM_TIME2C140D "" VALUE 0x73520 a_85 100 defaultConversion599 0 65535 BIT_MASK 0xffffffff /end CHARACTERISTIC
/begin CHARACTERISTIC ID_ECU_SAM_TIME2C141D "" VALUE 0x73522 a_85 100 defaultConversion600 0 65535 BIT_MASK 0xffffffff /end CHARACTERISTIC
/begin CHARACTERISTIC ID_ECU_SAM_TIME2C142D "" VALUE 0x73524 a_85 100 defaultConversion601 0 65535 BIT_MASK 0xffffffff /end CHARACTERISTIC
/begin CHARACTERISTIC ID_ECU_SAM_TIME2C143D "" VALUE 0x73526 a_85 100 defaultConversion602 0 65535 BIT_MASK 0xffffffff /end CHARACTERISTIC
/begin CHARACTERISTIC ID_ECU_SAM_TIME2C144D "" VALUE 0x73528 a_85 100 defaultConversion603 0 65535 BIT_MASK 0xffffffff /end CHARACTERISTIC
/begin CHARACTERISTIC ID_ECU_SAM_TIME2C145D "" VALUE 0x7352a a_85 100 defaultConversion604 0 65535 BIT_MASK 0xffffffff /end CHARACTERISTIC
/begin CHARACTERISTIC ID_ECU_SAM_TIME2C146D "" VALUE 0x7352c a_85 100 defaultConversion605 0 65535 BIT_MASK 0xffffffff /end CHARACTERISTIC
/begin CHARACTERISTIC ID_ECU_SAM_TIME2C147D "" VALUE 0x7352e a_85 100 defaultConversion606 0 65535 BIT_MASK 0xffffffff /end CHARACTERISTIC
/begin CHARACTERISTIC ID_ECU_SAM_TIME2C148D "" VALUE 0x73530 a_85 100 defaultConversion607 0 65535 BIT_MASK 0xffffffff /end CHARACTERISTIC
/begin CHARACTERISTIC ID_ECU_SAM_TIME2C149D "" VALUE 0x73532 a_85 100 defaultConversion608 0 65535 BIT_MASK 0xffffffff /end CHARACTERISTIC
/begin CHARACTERISTIC ID_ECU_SAM_TIME2C150D "" VALUE 0x73534 a_85 100 defaultConversion609 0 65535 BIT_MASK 0xffffffff /end CHARACTERISTIC
/begin CHARACTERISTIC ID_ECU_SAM_TIME2C151D "" VALUE 0x73536 a_85 100 defaultConversion610 0 65535 BIT_MASK 0xffffffff /end CHARACTERISTIC
/begin CHARACTERISTIC ID_ECU_SAM_TIME2C152D "" VALUE 0x73538 a_85 100 defaultConversion611 0 65535 BIT_MASK 0xffffffff /end CHARACTERISTIC
/begin CHARACTERISTIC ID_ECU_SAM_TIME2C153D "" VALUE 0x7353a a_85 100 defaultConversion612 0 65535 BIT_MASK 0xffffffff /end CHARACTERISTIC
/begin CHARACTERISTIC ID_ECU_SAM_TIME2C154D "" VALUE 0x7353c a_85 100 defaultConversion613 0 65535 BIT_MASK 0xffffffff /end CHARACTERISTIC
/begin CHARACTERISTIC ID_ECU_SAM_TIME2C155D "" VALUE 0x7353e a_85 100 defaultConversion614 0 65535 BIT_MASK 0xffffffff /end CHARACTERISTIC
/begin CHARACTERISTIC ID_ECU_SAM_TIME2C156D "" VALUE 0x73540 a_85 100 defaultConversion615 0 65535 BIT_MASK 0xffffffff /end CHARACTERISTIC
/begin CHARACTERISTIC ID_ECU_SAM_TIME2C157D "" VALUE 0x73542 a_85 100 defaultConversion616 0 65535 BIT_MASK 0xffffffff /end CHARACTERISTIC
/begin CHARACTERISTIC ID_ECU_SAM_TIME2C158D "" VALUE 0x73544 a_85 100 defaultConversion617 0 65535 BIT_MASK 0xffffffff /end CHARACTERISTIC
/begin CHARACTERISTIC ID_ECU_SAM_TIME2C159D "" VALUE 0x73546 a_85 100 defaultConversion618 0 65535 BIT_MASK 0xffffffff /end CHARACTERISTIC
/begin CHARACTERISTIC ID_ECU_SAM_TIME2C160D "" VALUE 0x73548 a_85 100 defaultConversion619 0 65535 BIT_MASK 0xffffffff /end CHARACTERISTIC
/begin CHARACTERISTIC ID_ECU_SAM_TIME2C161D "" VALUE 0x7354a a_85 100 defaultConversion620 0 65535 BIT_MASK 0xffffffff /end CHARACTERISTIC
/begin CHARACTERISTIC ID_ECU_SAM_TIME2C162D "" VALUE 0x7354c a_85 100 defaultConversion621 0 65535 BIT_MASK 0xffffffff /end CHARACTERISTIC
/begin CHARACTERISTIC ID_ECU_SAM_TIME2C163D "" VALUE 0x7354e a_85 100 defaultConversion622 0 65535 BIT_MASK 0xffffffff /end CHARACTERISTIC
/begin CHARACTERISTIC ID_ECU_SAM_TIME2C164D "" VALUE 0x73550 a_85 100 defaultConversion623 0 65535 BIT_MASK 0xffffffff /end CHARACTERISTIC
/begin CHARACTERISTIC ID_ECU_SAM_TIME2C165D "" VALUE 0x73552 a_85 100 defaultConversion624 0 65535 BIT_MASK 0xffffffff /end CHARACTERISTIC
/begin CHARACTERISTIC ID_ECU_SAM_TIME2C166D "" VALUE 0x73554 a_85 100 defaultConversion625 0 65535 BIT_MASK 0xffffffff /end CHARACTERISTIC
/begin CHARACTERISTIC ID_ECU_SAM_TIME2C167D "" VALUE 0x73556 a_85 100 defaultConversion626 0 65535 BIT_MASK 0xffffffff /end CHARACTERISTIC
/begin CHARACTERISTIC ID_ECU_SAM_TIME2C168D "" VALUE 0x73558 a_85 100 defaultConversion627 0 65535 BIT_MASK 0xffffffff /end CHARACTERISTIC
/begin CHARACTERISTIC ID_ECU_SAM_TIME2C169D "" VALUE 0x7355a a_85 100 defaultConversion628 0 65535 BIT_MASK 0xffffffff /end CHARACTERISTIC
/begin CHARACTERISTIC ID_ECU_SAM_TIME2C170D "" VALUE 0x7355c a_85 100 defaultConversion629 0 65535 BIT_MASK 0xffffffff /end CHARACTERISTIC
/begin CHARACTERISTIC ID_ECU_SAM_TIME2C171D "" VALUE 0x7355e a_85 100 defaultConversion630 0 65535 BIT_MASK 0xffffffff /end CHARACTERISTIC
/begin CHARACTERISTIC ID_ECU_SAM_TIME2C172D "" VALUE 0x73560 a_85 100 defaultConversion631 0 65535 BIT_MASK 0xffffffff /end CHARACTERISTIC
/begin CHARACTERISTIC ID_ECU_SAM_TIME2C173D "" VALUE 0x73562 a_85 100 defaultConversion632 0 65535 BIT_MASK 0xffffffff /end CHARACTERISTIC
/begin CHARACTERISTIC ID_ECU_SAM_TIME2C174D "" VALUE 0x73564 a_85 100 defaultConversion633 0 65535 BIT_MASK 0xffffffff /end CHARACTERISTIC
/begin CHARACTERISTIC ID_ECU_SAM_TIME2C175D "" VALUE 0x73566 a_85 100 defaultConversion634 0 65535 BIT_MASK 0xffffffff /end CHARACTERISTIC
/begin CHARACTERISTIC ID_ECU_SAM_TIME2C176D "" VALUE 0x73568 a_85 100 defaultConversion635 0 65535 BIT_MASK 0xffffffff /end CHARACTERISTIC
/begin CHARACTERISTIC ID_ECU_SAM_TIME2C177D "" VALUE 0x7356a a_85 100 defaultConversion636 0 65535 BIT_MASK 0xffffffff /end CHARACTERISTIC
/begin CHARACTERISTIC ID_ECU_SAM_TIME2C178D "" VALUE 0x7356c a_85 100 defaultConversion637 0 65535 BIT_MASK 0xffffffff /end CHARACTERISTIC
/begin CHARACTERISTIC ID_ECU_SAM_TIME2C179D "" VALUE 0x7356e a_85 100 defaultConversion638 0 65535 BIT_MASK 0xffffffff /end CHARACTERISTIC
/begin CHARACTERISTIC ID_ECU_SAM_TIME2C180D "" VALUE 0x73570 a_85 100 defaultConversion639 0 65535 BIT_MASK 0xffffffff /end CHARACTERISTIC
/begin CHARACTERISTIC ID_ECU_SAM_TIME2C181D "" VALUE 0x73572 a_85 100 defaultConversion640 0 65535 BIT_MASK 0xffffffff /end CHARACTERISTIC
/begin CHARACTERISTIC ID_ECU_SAM_TIME2C182D "" VALUE 0x73574 a_85 100 defaultConversion641 0 65535 BIT_MASK 0xffffffff /end CHARACTERISTIC
/begin CHARACTERISTIC ID_ECU_SAM_TIME2C183D "" VALUE 0x73576 a_85 100 defaultConversion642 0 65535 BIT_MASK 0xffffffff /end CHARACTERISTIC
/begin CHARACTERISTIC ID_ECU_SAM_TIME2C184D "" VALUE 0x73578 a_85 100 defaultConversion643 0 65535 BIT_MASK 0xffffffff /end CHARACTERISTIC
/begin CHARACTERISTIC ID_ECU_SAM_TIME2C185D "" VALUE 0x7357a a_85 100 defaultConversion644 0 65535 BIT_MASK 0xffffffff /end CHARACTERISTIC
/begin CHARACTERISTIC ID_ECU_SAM_TIME2C186D "" VALUE 0x7357c a_85 100 defaultConversion645 0 65535 BIT_MASK 0xffffffff /end CHARACTERISTIC
/begin CHARACTERISTIC ID_ECU_SAM_TIME2C187D "" VALUE 0x7357e a_85 100 defaultConversion646 0 65535 BIT_MASK 0xffffffff /end CHARACTERISTIC
/begin CHARACTERISTIC ID_ECU_SAM_TIME2C188D "" VALUE 0x73580 a_85 100 defaultConversion647 0 65535 BIT_MASK 0xffffffff /end CHARACTERISTIC
/begin CHARACTERISTIC ID_ECU_SAM_TIME2C189D "" VALUE 0x73582 a_85 100 defaultConversion648 0 65535 BIT_MASK 0xffffffff /end CHARACTERISTIC
/begin CHARACTERISTIC ID_ECU_SAM_TIME2C190D "" VALUE 0x73584 a_85 100 defaultConversion649 0 65535 BIT_MASK 0xffffffff /end CHARACTERISTIC
/begin CHARACTERISTIC ID_ECU_SAM_TIME2C191D "" VALUE 0x73586 a_85 100 defaultConversion650 0 65535 BIT_MASK 0xffffffff /end CHARACTERISTIC
/begin CHARACTERISTIC ID_ECU_SAM_TIME2C192D "" VALUE 0x73588 a_85 100 defaultConversion651 0 65535 BIT_MASK 0xffffffff /end CHARACTERISTIC
/begin CHARACTERISTIC ID_ECU_SAM_TIME2C193D "" VALUE 0x7358a a_85 100 defaultConversion652 0 65535 BIT_MASK 0xffffffff /end CHARACTERISTIC
/begin CHARACTERISTIC ID_ECU_SAM_TIME2C194D "" VALUE 0x7358c a_85 100 defaultConversion653 0 65535 BIT_MASK 0xffffffff /end CHARACTERISTIC
/begin CHARACTERISTIC ID_ECU_SAM_TIME2C195D "" VALUE 0x7358e a_85 100 defaultConversion654 0 65535 BIT_MASK 0xffffffff /end CHARACTERISTIC
/begin CHARACTERISTIC ID_ECU_SAM_TIME2C196D "" VALUE 0x73590 a_85 100 defaultConversion655 0 65535 BIT_MASK 0xffffffff /end CHARACTERISTIC
/begin CHARACTERISTIC ID_ECU_SAM_TIME2C197D "" VALUE 0x73592 a_85 100 defaultConversion656 0 65535 BIT_MASK 0xffffffff /end CHARACTERISTIC
/begin CHARACTERISTIC ID_ECU_SAM_TIME2C198D "" VALUE 0x73594 a_85 100 defaultConversion657 0 65535 BIT_MASK 0xffffffff /end CHARACTERISTIC
/begin CHARACTERISTIC ID_ECU_SAM_TIME2C199D "" VALUE 0x73596 a_85 100 defaultConversion658 0 65535 BIT_MASK 0xffffffff /end CHARACTERISTIC
/begin CHARACTERISTIC ID_ECU_SAM_TIME2C200D "" VALUE 0x73598 a_85 100 defaultConversion659 0 65535 BIT_MASK 0xffffffff /end CHARACTERISTIC
/begin CHARACTERISTIC ID_ECU_SAM_TIME2C201D "" VALUE 0x7359a a_85 100 defaultConversion660 0 65535 BIT_MASK 0xffffffff /end CHARACTERISTIC
/begin CHARACTERISTIC ID_ECU_SAM_TIME2C202D "" VALUE 0x7359c a_85 100 defaultConversion661 0 65535 BIT_MASK 0xffffffff /end CHARACTERISTIC
/begin CHARACTERISTIC ID_ECU_SAM_TIME2C203D "" VALUE 0x7359e a_85 100 defaultConversion662 0 65535 BIT_MASK 0xffffffff /end CHARACTERISTIC
/begin CHARACTERISTIC ID_ECU_SAM_TIME2C204D "" VALUE 0x735a0 a_85 100 defaultConversion663 0 65535 BIT_MASK 0xffffffff /end CHARACTERISTIC
/begin CHARACTERISTIC ID_ECU_SAM_TIME2C205D "" VALUE 0x735a2 a_85 100 defaultConversion664 0 65535 BIT_MASK 0xffffffff /end CHARACTERISTIC
/begin CHARACTERISTIC ID_ECU_SAM_TIME2C206D "" VALUE 0x735a4 a_85 100 defaultConversion665 0 65535 BIT_MASK 0xffffffff /end CHARACTERISTIC
/begin CHARACTERISTIC ID_ECU_SAM_TIME2C207D "" VALUE 0x735a6 a_85 100 defaultConversion666 0 65535 BIT_MASK 0xffffffff /end CHARACTERISTIC
/begin CHARACTERISTIC ID_ECU_SAM_TIME2C208D "" VALUE 0x735a8 a_85 100 defaultConversion667 0 65535 BIT_MASK 0xffffffff /end CHARACTERISTIC
/begin CHARACTERISTIC ID_ECU_SAM_TIME2C209D "" VALUE 0x735aa a_85 100 defaultConversion668 0 65535 BIT_MASK 0xffffffff /end CHARACTERISTIC
/begin CHARACTERISTIC ID_ECU_SAM_TIME2C210D "" VALUE 0x735ac a_85 100 defaultConversion669 0 65535 BIT_MASK 0xffffffff /end CHARACTERISTIC
/begin CHARACTERISTIC ID_ECU_SAM_TIME2C211D "" VALUE 0x735ae a_85 100 defaultConversion670 0 65535 BIT_MASK 0xffffffff /end CHARACTERISTIC
/begin CHARACTERISTIC ID_ECU_SAM_TIME2C212D "" VALUE 0x735b0 a_85 100 defaultConversion671 0 65535 BIT_MASK 0xffffffff /end CHARACTERISTIC
/begin CHARACTERISTIC ID_ECU_SAM_TIME2C213D "" VALUE 0x735b2 a_85 100 defaultConversion672 0 65535 BIT_MASK 0xffffffff /end CHARACTERISTIC
/begin CHARACTERISTIC ID_ECU_SAM_TIME2C214D "" VALUE 0x735b4 a_85 100 defaultConversion673 0 65535 BIT_MASK 0xffffffff /end CHARACTERISTIC
/begin CHARACTERISTIC ID_ECU_SAM_TIME2C215D "" VALUE 0x735b6 a_85 100 defaultConversion674 0 65535 BIT_MASK 0xffffffff /end CHARACTERISTIC
/begin CHARACTERISTIC ID_ECU_SAM_TIME2C216D "" VALUE 0x735b8 a_85 100 defaultConversion675 0 65535 BIT_MASK 0xffffffff /end CHARACTERISTIC
/begin CHARACTERISTIC ID_ECU_SAM_TIME2C217D "" VALUE 0x735ba a_85 100 defaultConversion676 0 65535 BIT_MASK 0xffffffff /end CHARACTERISTIC
/begin CHARACTERISTIC ID_ECU_SAM_TIME2C218D "" VALUE 0x735bc a_85 100 defaultConversion677 0 65535 BIT_MASK 0xffffffff /end CHARACTERISTIC
/begin CHARACTERISTIC ID_ECU_SAM_TIME2C219D "" VALUE 0x735be a_85 100 defaultConversion678 0 65535 BIT_MASK 0xffffffff /end CHARACTERISTIC
/begin CHARACTERISTIC ID_ECU_SAM_TIME2C220D "" VALUE 0x735c0 a_85 100 defaultConversion679 0 65535 BIT_MASK 0xffffffff /end CHARACTERISTIC
/begin CHARACTERISTIC ID_ECU_SAM_TIME2C221D "" VALUE 0x735c2 a_85 100 defaultConversion680 0 65535 BIT_MASK 0xffffffff /end CHARACTERISTIC
/begin CHARACTERISTIC ID_ECU_SAM_TIME2C222D "" VALUE 0x735c4 a_85 100 defaultConversion681 0 65535 BIT_MASK 0xffffffff /end CHARACTERISTIC
/begin CHARACTERISTIC ID_ECU_SAM_TIME2C223D "" VALUE 0x735c6 a_85 100 defaultConversion682 0 65535 BIT_MASK 0xffffffff /end CHARACTERISTIC
/begin CHARACTERISTIC ID_ECU_SAM_TIME2C224D "" VALUE 0x735c8 a_85 100 defaultConversion683 0 65535 BIT_MASK 0xffffffff /end CHARACTERISTIC
/begin CHARACTERISTIC ID_ECU_SAM_TIME2C225D "" VALUE 0x735ca a_85 100 defaultConversion684 0 65535 BIT_MASK 0xffffffff /end CHARACTERISTIC
/begin CHARACTERISTIC ID_ECU_SAM_TIME2C226D "" VALUE 0x735cc a_85 100 defaultConversion685 0 65535 BIT_MASK 0xffffffff /end CHARACTERISTIC
/begin CHARACTERISTIC ID_ECU_SAM_TIME2C227D "" VALUE 0x735ce a_85 100 defaultConversion686 0 65535 BIT_MASK 0xffffffff /end CHARACTERISTIC
/begin CHARACTERISTIC ID_ECU_SAM_TIME2C228D "" VALUE 0x735d0 a_85 100 defaultConversion687 0 65535 BIT_MASK 0xffffffff /end CHARACTERISTIC
/begin CHARACTERISTIC ID_ECU_SAM_TIME2C229D "" VALUE 0x735d2 a_85 100 defaultConversion688 0 65535 BIT_MASK 0xffffffff /end CHARACTERISTIC
/begin CHARACTERISTIC ID_ECU_SAM_TIME2C230D "" VALUE 0x735d4 a_85 100 defaultConversion689 0 65535 BIT_MASK 0xffffffff /end CHARACTERISTIC
/begin CHARACTERISTIC ID_ECU_SAM_TIME2C231D "" VALUE 0x735d6 a_85 100 defaultConversion690 0 65535 BIT_MASK 0xffffffff /end CHARACTERISTIC
/begin CHARACTERISTIC ID_ECU_SAM_TIME2C232D "" VALUE 0x735d8 a_85 100 defaultConversion691 0 65535 BIT_MASK 0xffffffff /end CHARACTERISTIC
/begin CHARACTERISTIC ID_ECU_SAM_TIME2C233D "" VALUE 0x735da a_85 100 defaultConversion692 0 65535 BIT_MASK 0xffffffff /end CHARACTERISTIC
/begin CHARACTERISTIC ID_ECU_SAM_TIME2C234D "" VALUE 0x735dc a_85 100 defaultConversion693 0 65535 BIT_MASK 0xffffffff /end CHARACTERISTIC
/begin CHARACTERISTIC ID_ECU_SAM_TIME2C235D "" VALUE 0x735de a_85 100 defaultConversion694 0 65535 BIT_MASK 0xffffffff /end CHARACTERISTIC
/begin CHARACTERISTIC ID_ECU_SAM_TIME2C236D "" VALUE 0x735e0 a_85 100 defaultConversion695 0 65535 BIT_MASK 0xffffffff /end CHARACTERISTIC
/begin CHARACTERISTIC ID_ECU_SAM_TIME2C237D "" VALUE 0x735e2 a_85 100 defaultConversion696 0 65535 BIT_MASK 0xffffffff /end CHARACTERISTIC
/begin CHARACTERISTIC ID_ECU_SAM_TIME2C238D "" VALUE 0x735e4 a_85 100 defaultConversion697 0 65535 BIT_MASK 0xffffffff /end CHARACTERISTIC
/begin CHARACTERISTIC ID_ECU_SAM_TIME2C239D "" VALUE 0x735e6 a_85 100 defaultConversion698 0 65535 BIT_MASK 0xffffffff /end CHARACTERISTIC
/begin CHARACTERISTIC ID_ECU_SAM_TIME2C240D "" VALUE 0x735e8 a_85 100 defaultConversion699 0 65535 BIT_MASK 0xffffffff /end CHARACTERISTIC
/begin CHARACTERISTIC ID_ECU_SAM_TIME2C241D "" VALUE 0x735ea a_85 100 defaultConversion700 0 65535 BIT_MASK 0xffffffff /end CHARACTERISTIC
/begin CHARACTERISTIC ID_ECU_SAM_TIME2C242D "" VALUE 0x735ec a_85 100 defaultConversion701 0 65535 BIT_MASK 0xffffffff /end CHARACTERISTIC
/begin CHARACTERISTIC ID_ECU_SAM_TIME2C243D "" VALUE 0x735ee a_85 100 defaultConversion702 0 65535 BIT_MASK 0xffffffff /end CHARACTERISTIC
/begin CHARACTERISTIC ID_ECU_SAM_TIME2C244D "" VALUE 0x735f0 a_85 100 defaultConversion703 0 65535 BIT_MASK 0xffffffff /end CHARACTERISTIC
/begin CHARACTERISTIC ID_ECU_SAM_TIME2C245D "" VALUE 0x735f2 a_85 100 defaultConversion704 0 65535 BIT_MASK 0xffffffff /end CHARACTERISTIC
/begin CHARACTERISTIC ID_ECU_SAM_TIME2C246D "" VALUE 0x735f4 a_85 100 defaultConversion705 0 65535 BIT_MASK 0xffffffff /end CHARACTERISTIC
/begin CHARACTERISTIC ID_ECU_SAM_TIME2C247D "" VALUE 0x735f6 a_85 100 defaultConversion706 0 65535 BIT_MASK 0xffffffff /end CHARACTERISTIC
/begin CHARACTERISTIC ID_ECU_SAM_TIME2C248D "" VALUE 0x735f8 a_85 100 defaultConversion707 0 65535 BIT_MASK 0xffffffff /end CHARACTERISTIC
/begin CHARACTERISTIC ID_ECU_SAM_TIME2C249D "" VALUE 0x735fa a_85 100 defaultConversion708 0 65535 BIT_MASK 0xffffffff /end CHARACTERISTIC
/begin CHARACTERISTIC ID_ECU_SAM_TIME2C250D "" VALUE 0x735fc a_85 100 defaultConversion709 0 65535 BIT_MASK 0xffffffff /end CHARACTERISTIC
/begin CHARACTERISTIC ID_ECU_SAM_TIME2C251D "" VALUE 0x735fe a_85 100 defaultConversion710 0 65535 BIT_MASK 0xffffffff /end CHARACTERISTIC
/begin CHARACTERISTIC ID_ECU_SAM_TIME2C252D "" VALUE 0x73600 a_85 100 defaultConversion711 0 65535 BIT_MASK 0xffffffff /end CHARACTERISTIC
/begin CHARACTERISTIC ID_ECU_SAM_TIME2C253D "" VALUE 0x73602 a_85 100 defaultConversion712 0 65535 BIT_MASK 0xffffffff /end CHARACTERISTIC
/begin CHARACTERISTIC ID_ECU_SAM_TIME2C254D "" VALUE 0x73604 a_85 100 defaultConversion713 0 65535 BIT_MASK 0xffffffff /end CHARACTERISTIC
/begin CHARACTERISTIC ID_ECU_SAM_TIME2C255D "" VALUE 0x73606 a_85 100 defaultConversion714 0 65535 BIT_MASK 0xffffffff /end CHARACTERISTIC
/begin CHARACTERISTIC ID_ECU_SAM_TIME2C256D "" VALUE 0x73608 a_85 100 defaultConversion715 0 65535 BIT_MASK 0xffffffff /end CHARACTERISTIC
/begin CHARACTERISTIC ID_ECU_SAM_TIME2C257D "" VALUE 0x7360a a_85 100 defaultConversion716 0 65535 BIT_MASK 0xffffffff /end CHARACTERISTIC
/begin CHARACTERISTIC iga_as_0 "IGA_AS_1" VALUE 0x400e1 a_87 5 LINEAR_______48_000000__FFFFFF80 -48.0 47.625 BIT_MASK 0xffffffff /end CHARACTERISTIC
/begin CHARACTERISTIC iga_as_1 "IGA_AS_2" VALUE 0x400e2 a_87 5 LINEAR_______48_000000__FFFFFF80 -48.0 47.625 BIT_MASK 0xffffffff /end CHARACTERISTIC
/begin CHARACTERISTIC iga_as_2 "IGA_AS_3" VALUE 0x400e3 a_87 5 LINEAR_______48_000000__FFFFFF80 -48.0 47.625 BIT_MASK 0xffffffff /end CHARACTERISTIC
/begin CHARACTERISTIC iga_as_3 "IGA_AS_4" VALUE 0x400e4 a_87 5 LINEAR_______48_000000__FFFFFF80 -48.0 47.625 BIT_MASK 0xffffffff /end CHARACTERISTIC
/begin CHARACTERISTIC iga_as_4 "IGA_AS_5" VALUE 0x400e5 a_87 5 LINEAR_______48_000000__FFFFFF80 -48.0 47.625 BIT_MASK 0xffffffff /end CHARACTERISTIC
/begin CHARACTERISTIC iga_as_5 "IGA_AS_6" VALUE 0x400e6 a_87 5 LINEAR_______48_000000__FFFFFF80 -48.0 47.625 BIT_MASK 0xffffffff /end CHARACTERISTIC
/begin CHARACTERISTIC isapwm_erg_as "ISAPWM_ERG_AS" VALUE 0x400e7 a_87 100 LINEAR_______50_000000__FFFFFF80 -50.0 49.61 BIT_MASK 0xffffffff /end CHARACTERISTIC
/begin CHARACTERISTIC kfdirC0D "" VALUE 0x70d6e a_86 100 defaultConversion717 0 255 BIT_MASK 0xffffffff /end CHARACTERISTIC
/begin CHARACTERISTIC kfdirC1D "" VALUE 0x70d6f a_86 100 defaultConversion718 0 255 BIT_MASK 0xffffffff /end CHARACTERISTIC
/begin CHARACTERISTIC kfdirC2D "" VALUE 0x70d70 a_86 100 defaultConversion719 0 255 BIT_MASK 0xffffffff /end CHARACTERISTIC
/begin CHARACTERISTIC kfdirC3D "" VALUE 0x70d71 a_86 100 defaultConversion720 0 255 BIT_MASK 0xffffffff /end CHARACTERISTIC
/begin CHARACTERISTIC kfdirC4D "" VALUE 0x70d72 a_86 100 defaultConversion721 0 255 BIT_MASK 0xffffffff /end CHARACTERISTIC
/begin CHARACTERISTIC kfdirC5D "" VALUE 0x70d73 a_86 100 defaultConversion722 0 255 BIT_MASK 0xffffffff /end CHARACTERISTIC
/begin CHARACTERISTIC kfdirC6D "" VALUE 0x70d74 a_86 100 defaultConversion723 0 255 BIT_MASK 0xffffffff /end CHARACTERISTIC
/begin CHARACTERISTIC kfdirC7D "" VALUE 0x70d75 a_86 100 defaultConversion724 0 255 BIT_MASK 0xffffffff /end CHARACTERISTIC
/begin CHARACTERISTIC kfversionC0D "" VALUE 0x70d76 a_86 100 defaultConversion725 0 255 BIT_MASK 0xffffffff /end CHARACTERISTIC
/begin CHARACTERISTIC kfversionC1D "" VALUE 0x70d77 a_86 100 defaultConversion726 0 255 BIT_MASK 0xffffffff /end CHARACTERISTIC
/begin CHARACTERISTIC kfversionC2D "" VALUE 0x70d78 a_86 100 defaultConversion727 0 255 BIT_MASK 0xffffffff /end CHARACTERISTIC
/begin CHARACTERISTIC kfversionC3D "" VALUE 0x70d79 a_86 100 defaultConversion728 0 255 BIT_MASK 0xffffffff /end CHARACTERISTIC
/begin CHARACTERISTIC konf_mil_fus "KONF_MIL_FUS" VALUE 0x70d7a a_86 100 LINEAR______0_000000__0H___1_000 0.0 1.0 BIT_MASK 0xffffffff /end CHARACTERISTIC
/begin CHARACTERISTIC lc_dhp_ltc "LC_DHP_LTC" VALUE 0x70d7b a_86 100 LINEAR______0_000000__0H___1_000 0.0 1.0 BIT_MASK 0xffffffff /end CHARACTERISTIC
/begin CHARACTERISTIC lc_pvs_bls_bts_plaus_ena "LC_PVS_BLS_BTS_PLAUS_ENA" VALUE 0x70d7c a_86 100 LINEAR______0_000000__0H___2_000 0.0 2.0 BIT_MASK 0xffffffff /end CHARACTERISTIC
/begin CHARACTERISTIC lc_scc_asr "LC_SCC_ASR" VALUE 0x70d7d a_86 100 LINEAR______0_000000__0H___1_000 0.0 1.0 BIT_MASK 0xffffffff /end CHARACTERISTIC
/begin CHARACTERISTIC lc_swi_cal_mon_cks "LC_SWI_CAL_MON_CKS" VALUE 0x70d7e a_86 100 LINEAR______0_000000__0H___255_0 0.0 255.0 BIT_MASK 0xffffffff /end CHARACTERISTIC
/begin CHARACTERISTIC lm_ftp_max "C_MAF_FTL_MAX" VALUE 0x70d7f a_86 100 LINEAR______0_000000__0H___1389_ 0.0 1389.0 BIT_MASK 0xffffffff /end CHARACTERISTIC
/begin CHARACTERISTIC lshpwm_as_down_1 "LSHPWM_AS_DOWN_1" VALUE 0x400e8 a_87 100 LINEAR_______50_000000__FFFFFF80 -50.0 49.61 BIT_MASK 0xffffffff /end CHARACTERISTIC
/begin CHARACTERISTIC lshpwm_as_down_2 "LSHPWM_AS_DOWN_2" VALUE 0x400e9 a_87 100 LINEAR_______50_000000__FFFFFF80 -50.0 49.61 BIT_MASK 0xffffffff /end CHARACTERISTIC
/begin CHARACTERISTIC lshpwm_as_up_1 "LSHPWM_AS_UP_1" VALUE 0x400ea a_87 100 LINEAR_______50_000000__FFFFFF80 -50.0 49.61 BIT_MASK 0xffffffff /end CHARACTERISTIC
/begin CHARACTERISTIC lshpwm_as_up_2 "LSHPWM_AS_UP_2" VALUE 0x400eb a_87 100 LINEAR_______50_000000__FFFFFF80 -50.0 49.61 BIT_MASK 0xffffffff /end CHARACTERISTIC
/begin CHARACTERISTIC n_ftp_max "C_N_FTL_MAX" VALUE 0x70d80 a_86 100 LINEAR______480_000000__FH___816 480.0 8160.0 BIT_MASK 0xffffffff /end CHARACTERISTIC
/begin CHARACTERISTIC n_perc_ecf_as "N_PERC_ECF_AS" VALUE 0x400ee a_86 100 LINEAR_______50_000000__0H___49_ -50.0 49.6094 BIT_MASK 0xffffffff /end CHARACTERISTIC
/begin CHARACTERISTIC nw_verst_dif_diag_a "C_CAM_ADJ_RNG_DIF_DIAG_EX" VALUE 0x70d81 a_86 100 LINEAR______0_000000__0H___95_22 0.0 95.625 BIT_MASK 0xffffffff /end CHARACTERISTIC
/begin CHARACTERISTIC nw_verst_dif_diag_e "C_CAM_ADJ_RNG_DIF_DIAG_IN" VALUE 0x70d82 a_86 100 LINEAR______0_000000__0H___95_22 0.0 95.625 BIT_MASK 0xffffffff /end CHARACTERISTIC
/begin CHARACTERISTIC s_wk_auf "C_STATE_CC_OPEN" VALUE 0x70d83 a_86 100 LINEAR______0_000000__0H___1_000 0.0 1.0 BIT_MASK 0xffffffff /end CHARACTERISTIC
/begin CHARACTERISTIC s_wk_nd "C_STATE_CC_DFT" VALUE 0x70d84 a_86 100 LINEAR______0_000000__0H___1_000 0.0 1.0 BIT_MASK 0xffffffff /end CHARACTERISTIC
/begin CHARACTERISTIC s_wk_reg "C_STATE_CC_CTL" VALUE 0x70d85 a_86 100 LINEAR______0_000000__0H___1_000 0.0 1.0 BIT_MASK 0xffffffff /end CHARACTERISTIC
/begin CHARACTERISTIC s_wk_zu "C_STATE_CC_CLOSE" VALUE 0x70d86 a_86 100 LINEAR______0_000000__0H___1_000 0.0 1.0 BIT_MASK 0xffffffff /end CHARACTERISTIC
/begin CHARACTERISTIC schw_auss_b1 "THD_MIS_B1" VALUE 0x709dc a_85 5 LINEAR______0_000000__0H___3000_ 0.0 3000.0 BIT_MASK 0xffffffff /end CHARACTERISTIC
/begin CHARACTERISTIC schw_auss_b4 "THD_MIS_B4" VALUE 0x709de a_85 5 LINEAR______0_000000__0H___3000_ 0.0 3000.0 BIT_MASK 0xffffffff /end CHARACTERISTIC
/begin CHARACTERISTIC soi_as "SOI_AS" VALUE 0x400ec a_87 100 LINEAR_______768_000000__FFFFFF8 -768.0 762.0 BIT_MASK 0xffffffff /end CHARACTERISTIC
/begin CHARACTERISTIC stgdirC0D "" VALUE 0x70d87 a_86 100 defaultConversion729 0 255 BIT_MASK 0xffffffff /end CHARACTERISTIC
/begin CHARACTERISTIC stgdirC1D "" VALUE 0x70d88 a_86 100 defaultConversion730 0 255 BIT_MASK 0xffffffff /end CHARACTERISTIC
/begin CHARACTERISTIC stgdirC2D "" VALUE 0x70d89 a_86 100 defaultConversion731 0 255 BIT_MASK 0xffffffff /end CHARACTERISTIC
/begin CHARACTERISTIC stgdirC3D "" VALUE 0x70d8a a_86 100 defaultConversion732 0 255 BIT_MASK 0xffffffff /end CHARACTERISTIC
/begin CHARACTERISTIC stgdirC4D "" VALUE 0x70d8b a_86 100 defaultConversion733 0 255 BIT_MASK 0xffffffff /end CHARACTERISTIC
/begin CHARACTERISTIC stgdirC5D "" VALUE 0x70d8c a_86 100 defaultConversion734 0 255 BIT_MASK 0xffffffff /end CHARACTERISTIC
/begin CHARACTERISTIC stgdirC6D "" VALUE 0x70d8d a_86 100 defaultConversion735 0 255 BIT_MASK 0xffffffff /end CHARACTERISTIC
/begin CHARACTERISTIC stgdirC7D "" VALUE 0x70d8e a_86 100 defaultConversion736 0 255 BIT_MASK 0xffffffff /end CHARACTERISTIC
/begin CHARACTERISTIC stgversionC0D "" VALUE 0x70d8f a_86 100 defaultConversion737 0 255 BIT_MASK 0xffffffff /end CHARACTERISTIC
/begin CHARACTERISTIC stgversionC1D "" VALUE 0x70d90 a_86 100 defaultConversion738 0 255 BIT_MASK 0xffffffff /end CHARACTERISTIC
/begin CHARACTERISTIC stgversionC2D "" VALUE 0x70d91 a_86 100 defaultConversion739 0 255 BIT_MASK 0xffffffff /end CHARACTERISTIC
/begin CHARACTERISTIC stgversionC3D "" VALUE 0x70d92 a_86 100 defaultConversion740 0 255 BIT_MASK 0xffffffff /end CHARACTERISTIC
/begin CHARACTERISTIC T_cam_sp_as_ex "T_CAM_SP_AS_EX" VALUE 0x70092 a_87 100 LINEAR______48_000000__FFFFFF80H -47.625 48.0 BIT_MASK 0xffffffff /end CHARACTERISTIC
/begin CHARACTERISTIC T_cam_sp_as_in "T_CAM_SP_AS_IN" VALUE 0x70093 a_87 100 LINEAR_______48_000000__FFFFFF80 -48.0 47.625 BIT_MASK 0xffffffff /end CHARACTERISTIC
/begin CHARACTERISTIC T_cppwm_as "T_CPPWM_AS" VALUE 0x70094 a_87 100 LINEAR_______50_000000__FFFFFF80 -50.0 49.61 BIT_MASK 0xffffffff /end CHARACTERISTIC
/begin CHARACTERISTIC T_iga_as_0 "T_IGA_AS_1" VALUE 0x70095 a_87 5 LINEAR_______48_000000__FFFFFF80 -48.0 47.625 BIT_MASK 0xffffffff /end CHARACTERISTIC
/begin CHARACTERISTIC T_iga_as_1 "T_IGA_AS_5" VALUE 0x70096 a_87 5 LINEAR_______48_000000__FFFFFF80 -48.0 47.625 BIT_MASK 0xffffffff /end CHARACTERISTIC
/begin CHARACTERISTIC T_iga_as_2 "T_IGA_AS_3" VALUE 0x70097 a_87 5 LINEAR_______48_000000__FFFFFF80 -48.0 47.625 BIT_MASK 0xffffffff /end CHARACTERISTIC
/begin CHARACTERISTIC T_iga_as_3 "T_IGA_AS_6" VALUE 0x70098 a_87 5 LINEAR_______48_000000__FFFFFF80 -48.0 47.625 BIT_MASK 0xffffffff /end CHARACTERISTIC
/begin CHARACTERISTIC T_iga_as_4 "T_IGA_AS_2" VALUE 0x70099 a_87 5 LINEAR_______48_000000__FFFFFF80 -48.0 47.625 BIT_MASK 0xffffffff /end CHARACTERISTIC
/begin CHARACTERISTIC T_iga_as_5 "T_IGA_AS_4" VALUE 0x7009a a_87 5 LINEAR_______48_000000__FFFFFF80 -48.0 47.625 BIT_MASK 0xffffffff /end CHARACTERISTIC
/begin CHARACTERISTIC T_isapwm_erg_as "T_ISAPWM_ERG_AS" VALUE 0x7009b a_87 100 LINEAR_______50_000000__FFFFFF80 -50.0 49.61 BIT_MASK 0xffffffff /end CHARACTERISTIC
/begin CHARACTERISTIC T_km_ctr_as "C_KM_CTR_AS" VALUE 0x70e1c a_95 100 LINEAR_______160000_000000__FFFF -160000.0 160000.0 BIT_MASK 0xffffffff /end CHARACTERISTIC
/begin CHARACTERISTIC T_lshpwm_as_down_1 "C_T_LSHPWM_AS_DOWN_1" VALUE 0x7009c a_87 100 LINEAR_______50_000000__FFFFFF80 -50.0 49.61 BIT_MASK 0xffffffff /end CHARACTERISTIC
/begin CHARACTERISTIC T_lshpwm_as_down_2 "C_T_LSHPWM_AS_DOWN_2" VALUE 0x7009d a_87 100 LINEAR_______50_000000__FFFFFF80 -50.0 49.61 BIT_MASK 0xffffffff /end CHARACTERISTIC
/begin CHARACTERISTIC T_lshpwm_as_up_1 "C_T_LSHPWM_AS_UP_1" VALUE 0x7009e a_87 100 LINEAR_______50_000000__FFFFFF80 -50.0 49.61 BIT_MASK 0xffffffff /end CHARACTERISTIC
/begin CHARACTERISTIC T_lshpwm_as_up_2 "C_T_LSHPWM_AS_UP_2" VALUE 0x7009f a_87 100 LINEAR_______50_000000__FFFFFF80 -50.0 49.61 BIT_MASK 0xffffffff /end CHARACTERISTIC
/begin CHARACTERISTIC t_min_fgr_const "T_MIN_FGR_CONST" VALUE 0x70d93 a_86 100 LINEAR______0_000000__0H___25_50 0.0 25.5 BIT_MASK 0xffffffff /end CHARACTERISTIC
/begin CHARACTERISTIC T_n_perc_ecf_as "C_T_N_PERC_ECF_AS" VALUE 0x700a2 a_86 100 LINEAR_______50_000000__0H___49_ -50.0 49.6094 BIT_MASK 0xffffffff /end CHARACTERISTIC
/begin CHARACTERISTIC T_soi_as "T_SOI_AS" VALUE 0x700a0 a_87 100 LINEAR_______768_000000__FFFFFF8 -768.0 762.0 BIT_MASK 0xffffffff /end CHARACTERISTIC
/begin CHARACTERISTIC T_td_as "T_TD_AS" VALUE 0x700a1 a_87 100 LINEAR_______10_922666__FFFFFF80 -10.922667 10.837333 BIT_MASK 0xffffffff /end CHARACTERISTIC
/begin CHARACTERISTIC T_ti_as_0 "T_TI_AS_1" VALUE 0x700a3 a_86 100 LINEAR______0_500000__40H___1_50 0.5 1.5 BIT_MASK 0xffffffff /end CHARACTERISTIC
/begin CHARACTERISTIC T_ti_as_1 "T_TI_AS_5" VALUE 0x700a4 a_86 100 LINEAR______0_500000__40H___1_50 0.5 1.5 BIT_MASK 0xffffffff /end CHARACTERISTIC
/begin CHARACTERISTIC T_ti_as_2 "T_TI_AS_3" VALUE 0x700a5 a_86 100 LINEAR______0_500000__40H___1_50 0.5 1.5 BIT_MASK 0xffffffff /end CHARACTERISTIC
/begin CHARACTERISTIC T_ti_as_3 "T_TI_AS_6" VALUE 0x700a6 a_86 100 LINEAR______0_500000__40H___1_50 0.5 1.5 BIT_MASK 0xffffffff /end CHARACTERISTIC
/begin CHARACTERISTIC T_ti_as_4 "T_TI_AS_2" VALUE 0x700a7 a_86 100 LINEAR______0_500000__40H___1_50 0.5 1.5 BIT_MASK 0xffffffff /end CHARACTERISTIC
/begin CHARACTERISTIC T_ti_as_5 "T_TI_AS_4" VALUE 0x700a8 a_86 100 LINEAR______0_500000__40H___1_50 0.5 1.5 BIT_MASK 0xffffffff /end CHARACTERISTIC
/begin CHARACTERISTIC td_as "TD_AS" VALUE 0x400ed a_87 100 LINEAR_______10_922666__FFFFFF80 -10.922667 10.837333 BIT_MASK 0xffffffff /end CHARACTERISTIC
/begin CHARACTERISTIC ti_as_0 "TI_AS_1" VALUE 0x400ef a_86 100 LINEAR______0_500000__40H___1_50 0.5 1.5 BIT_MASK 0xffffffff /end CHARACTERISTIC
/begin CHARACTERISTIC ti_as_1 "TI_AS_5" VALUE 0x400f0 a_86 100 LINEAR______0_500000__40H___1_50 0.5 1.5 BIT_MASK 0xffffffff /end CHARACTERISTIC
/begin CHARACTERISTIC ti_as_2 "TI_AS_3" VALUE 0x400f1 a_86 100 LINEAR______0_500000__40H___1_50 0.5 1.5 BIT_MASK 0xffffffff /end CHARACTERISTIC
/begin CHARACTERISTIC ti_as_3 "TI_AS_6" VALUE 0x400f2 a_86 100 LINEAR______0_500000__40H___1_50 0.5 1.5 BIT_MASK 0xffffffff /end CHARACTERISTIC
/begin CHARACTERISTIC ti_as_4 "TI_AS_2" VALUE 0x400f3 a_86 100 LINEAR______0_500000__40H___1_50 0.5 1.5 BIT_MASK 0xffffffff /end CHARACTERISTIC
/begin CHARACTERISTIC ti_as_5 "TI_AS_4" VALUE 0x400f4 a_86 100 LINEAR______0_500000__40H___1_50 0.5 1.5 BIT_MASK 0xffffffff /end CHARACTERISTIC
/begin CHARACTERISTIC toel_kfk_hys "C_TOIL_HYS_ECT" VALUE 0x70d94 a_86 15 LINEAR______0_000000__0H___20174 0.0 203.0 BIT_MASK 0xffffffff /end CHARACTERISTIC
/begin CHARACTERISTIC toel_kfk_max "C_TOIL_MAX_ECT" VALUE 0x70d95 a_86 15 LINEAR_______48_000000__0H___155 -48.0 155.0 BIT_MASK 0xffffffff /end CHARACTERISTIC
/begin CHARACTERISTIC toel_kfk_min "C_TOIL_MIN_ECT" VALUE 0x70d96 a_86 15 LINEAR_______48_000000__0H___155 -48.0 155.0 BIT_MASK 0xffffffff /end CHARACTERISTIC
/begin CHARACTERISTIC c_crk_vld_tooth_sync_lock "C_CRK_VLD_TOOTH_SYNC_LOCK" VALUE 0x70d97 a_86 100 LINEAR______4_000000__4H___56741 4.0 56.0 BIT_MASK 0xffffffff FUNCTION_LIST Z41R /end CHARACTERISTIC
/begin CHARACTERISTIC c_t_sync_lock "C_T_SYNC_LOCK" VALUE 0x70d98 a_86 100 LINEAR______0_000000__0H___2_544 0.0 2.55 BIT_MASK 0xffffffff FUNCTION_LIST Z41R /end CHARACTERISTIC
/begin CHARACTERISTIC c_t_sync_lock_cam "C_T_SYNC_LOCK_CAM" VALUE 0x70d99 a_86 100 LINEAR______0_000000__0H___2_544 0.0 2.55 BIT_MASK 0xffffffff FUNCTION_LIST Z41R /end CHARACTERISTIC
/begin CHARACTERISTIC c_t_es_sync_max "C_T_ES_SYNC_MAX" VALUE 0x709e0 a_85 100 LINEAR______0_000000__0H___655_3 0.0 655.35 BIT_MASK 0xffffffff FUNCTION_LIST Z41R /end CHARACTERISTIC
/begin CHARACTERISTIC lc_sync_lock_cam_activ "LC_SYNC_LOCK_CAM_ACTIV" VALUE 0x70d9a a_86 100 LINEAR______0_000000__0H___1_000 0.0 1.0 BIT_MASK 0xffffffff FUNCTION_LIST Z41R /end CHARACTERISTIC
/begin CHARACTERISTIC c_nr_cam_1_edge_ebr_det "C_NR_CAM_1_EDGE_EBR_DET" VALUE 0x70d9b a_86 100 LINEAR______0_000000__0H___255_0 0.0 255.0 BIT_MASK 0xffffffff FUNCTION_LIST Z41R /end CHARACTERISTIC
/begin CHARACTERISTIC c_nr_cam_1_cam_2_ebr_det "C_NR_CAM_1_CAM_2_EBR_DET" VALUE 0x70d9c a_86 100 LINEAR______0_000000__0H___255_0 0.0 255.0 BIT_MASK 0xffffffff FUNCTION_LIST Z41R /end CHARACTERISTIC
/begin CHARACTERISTIC c_fac_temp_sub_wall_ivvt_fl_down "C_FAC_TEMP_SUB_WALL_IVVT_FL_DOWN_1" VALUE 0x70b1d a_86 100 LINEAR______0_000000__0H___1_992 0.0 1.9921875 BIT_MASK 0xffffffff FUNCTION_LIST ETM /end CHARACTERISTIC
/begin CHARACTERISTIC c_fac_temp_sub_wall_ivvt_fl_dow1 "C_FAC_TEMP_SUB_WALL_IVVT_FL_DOWN_2" VALUE 0x70b1e a_86 100 LINEAR______0_000000__0H___1_992 0.0 1.9921875 BIT_MASK 0xffffffff FUNCTION_LIST ETM /end CHARACTERISTIC
/begin CHARACTERISTIC c_t_cur_dly_r_down_ls_mes_max_ma "C_T_CUR_DLY_R_DOWN_LS_MES_MAX_MAX" VALUE 0x70816 a_85 100 LINEAR______0_010000__1H___655_3 0.01 655.34998 BIT_MASK 0xffffffff FUNCTION_LIST R_LS_CALC /end CHARACTERISTIC
/begin MEASUREMENT ABC_AMT_MON "abc_amt_mon" UBYTE LINEAR______0_000000__0H___255_0 2 2.0 0.0 255.0 BIT_MASK 0xffffffff FUNCTION_LIST Z1S1 ECU_ADDRESS 0x4003e /end MEASUREMENT
/begin MEASUREMENT ABC_CONV_MON "abc_conv_mon" UBYTE LINEAR______0_000000__0H___255_0 2 2.0 0.0 255.0 BIT_MASK 0xffffffff ECU_ADDRESS 0x40000 /end MEASUREMENT
/begin MEASUREMENT ABC_CRU_MON "abc_cru_mon" UBYTE LINEAR______0_000000__0H___255_0 2 2.0 0.0 255.0 BIT_MASK 0xffffffff ECU_ADDRESS 0x4004e /end MEASUREMENT
/begin MEASUREMENT ABC_MAF_MON "abc_maf_mon" UBYTE LINEAR______0_000000__0H___255_0 2 2.0 0.0 255.0 BIT_MASK 0xffffffff ECU_ADDRESS 0x4005a /end MEASUREMENT
/begin MEASUREMENT ABC_MSR_MON "abc_msr_mon" UBYTE LINEAR______0_000000__0H___255_0 2 2.0 0.0 255.0 BIT_MASK 0xffffffff ECU_ADDRESS 0x40037 /end MEASUREMENT
/begin MEASUREMENT ABC_N_32_MON "abc_n_32_mon" UBYTE LINEAR______0_000000__0H___255_0 2 2.0 0.0 255.0 BIT_MASK 0xffffffff ECU_ADDRESS 0x40005 /end MEASUREMENT
/begin MEASUREMENT ABC_TPS_RATIO_MON "abc_tps_ratio_mon" UBYTE LINEAR______0_000000__0H___255_0 2 2.0 0.0 255.0 BIT_MASK 0xffffffff ECU_ADDRESS 0x4005b /end MEASUREMENT
/begin MEASUREMENT ABC_TQI_AV_MON "abc_tqi_av_mon" UBYTE LINEAR______0_000000__0H___255_0 2 2.0 0.0 255.0 BIT_MASK 0xffffffff ECU_ADDRESS 0x40017 /end MEASUREMENT
/begin MEASUREMENT ABC_TQI_AV_MON2 "abc_tqi_av_mon2" UBYTE LINEAR______0_000000__0H___255_0 2 2.0 0.0 255.0 BIT_MASK 0xffffffff FUNCTION_LIST MON2 ECU_ADDRESS 0x4006e /end MEASUREMENT
/begin MEASUREMENT ABC_TQI_N_MAX_MON "abc_tqi_n_max_mon" UBYTE LINEAR______0_000000__0H___255_0 2 2.0 0.0 255.0 BIT_MASK 0xffffffff ECU_ADDRESS 0x40002 /end MEASUREMENT
/begin MEASUREMENT ABC_TQI_N_MAX_MON2 "abc_tqi_n_max_mon2" UBYTE LINEAR______0_000000__0H___255_0 2 2.0 0.0 255.0 BIT_MASK 0xffffffff FUNCTION_LIST MON2 ECU_ADDRESS 0x4006f /end MEASUREMENT
/begin MEASUREMENT LV_INF "abf" UWORD RANGE________INF___1H__1H_______ 2 2.0 0 65535 BIT_MASK 0x800 ECU_ADDRESS 0xfd96 /end MEASUREMENT
/begin MEASUREMENT AC_CRU "ac_cru" SWORD LINEAR_______1777_777752__FFFF80 2 2.0 -1777.7778 1777.7235 BIT_MASK 0xffffffff ECU_ADDRESS 0x40690 /end MEASUREMENT
/begin MEASUREMENT LV_LAM_AD_1 "adaption_1" UBYTE RANGE________active___1H__1H____ 2 2.0 0 255 BIT_MASK 0x8 ECU_ADDRESS 0x40c3e /end MEASUREMENT
/begin MEASUREMENT LV_LAM_AD_2 "adaption_2" UBYTE RANGE________active___1H__1H____ 2 2.0 0 255 BIT_MASK 0x8 ECU_ADDRESS 0x40d9c /end MEASUREMENT
/begin MEASUREMENT KNK_AD_CIRCUIT_1 "adaptk1_mz4" UWORD RANGE________active___1H__1H_744 2 2.0 0 65535 BIT_MASK 0x400 ECU_ADDRESS 0xfd9a /end MEASUREMENT
/begin MEASUREMENT KNK_AD_RON "adaptk2_mz4" UWORD RANGE________active___1H__1H_744 2 2.0 0 65535 BIT_MASK 0x800 ECU_ADDRESS 0xfd9a /end MEASUREMENT
/begin MEASUREMENT LV_LAM_AD_ADD_1_STABILIZED "add_adap_1_eingeschwungen" UBYTE RANGE________YES___1H__1H____NO_ 2 2.0 0 255 BIT_MASK 0x80 ECU_ADDRESS 0x40c3e /end MEASUREMENT
/begin MEASUREMENT LV_LAM_AD_ADD_2_STABILIZED "add_adap_2_eingeschwungen" UBYTE RANGE________YES___1H__1H____NO_ 2 2.0 0 255 BIT_MASK 0x80 ECU_ADDRESS 0x40d9c /end MEASUREMENT
/begin MEASUREMENT AJ_TRIG "aj_trig" UBYTE LINEAR______0_000000__0H___255_0 2 2.0 0.0 255.0 BIT_MASK 0xffffffff ECU_ADDRESS 0x400dd /end MEASUREMENT
/begin MEASUREMENT AMP_MES "amp_longvwordC1D" UWORD LINEAR______0_000000__0H___5434_ 2 2.0 0.0 5434.2598 BIT_MASK 0xffffffff ECU_ADDRESS 0x404a6 /end MEASUREMENT
/begin MEASUREMENT ANG_PSTE "ang_pste" SWORD LINEAR_______1439_956055__FFFF80 2 2.0 -1439.9561 1439.9121 BIT_MASK 0xffffffff ECU_ADDRESS 0xe1ac /end MEASUREMENT
/begin MEASUREMENT ANS_MON2 "ans_mon2" UWORD LINEAR______0_000000__0H___65535 2 2.0 0.0 65535.0 BIT_MASK 0xffffffff FUNCTION_LIST MON2 ECU_ADDRESS 0xe680 /end MEASUREMENT
/begin MEASUREMENT ANS_MON2_TEST "ans_mon2_test" UWORD LINEAR______0_000000__0H___65535 2 2.0 0.0 65535.0 BIT_MASK 0xffffffff FUNCTION_LIST MON2 ECU_ADDRESS 0xe0c2 /end MEASUREMENT
/begin MEASUREMENT LV_MIS_1 "aussetz_zyl_0" UBYTE RANGE________YES___1H__1H____NO_ 2 2.0 0 255 BIT_MASK 0x1 ECU_ADDRESS 0x40185 /end MEASUREMENT
/begin MEASUREMENT LV_MIS_5 "aussetz_zyl_1" UBYTE RANGE________YES___1H__1H____NO_ 2 2.0 0 255 BIT_MASK 0x2 ECU_ADDRESS 0x40185 /end MEASUREMENT
/begin MEASUREMENT LV_MIS_3 "aussetz_zyl_2" UBYTE RANGE________YES___1H__1H____NO_ 2 2.0 0 255 BIT_MASK 0x4 ECU_ADDRESS 0x40185 /end MEASUREMENT
/begin MEASUREMENT LV_MIS_6 "aussetz_zyl_3" UBYTE RANGE________YES___1H__1H____NO_ 2 2.0 0 255 BIT_MASK 0x8 ECU_ADDRESS 0x40185 /end MEASUREMENT
/begin MEASUREMENT LV_MIS_2 "aussetz_zyl_4" UBYTE RANGE________YES___1H__1H____NO_ 2 2.0 0 255 BIT_MASK 0x10 ECU_ADDRESS 0x40185 /end MEASUREMENT
/begin MEASUREMENT LV_MIS_4 "aussetz_zyl_5" UBYTE RANGE________YES___1H__1H____NO_ 2 2.0 0 255 BIT_MASK 0x20 ECU_ADDRESS 0x40185 /end MEASUREMENT
/begin MEASUREMENT AV_CAL_MON_CKS "av_cal_mon_cks" ULONG LINEAR______0_000000__0H___42146 2 2.0 0.0 4.2949673e+009 BIT_MASK 0xffffffff ECU_ADDRESS 0xe672 /end MEASUREMENT
/begin MEASUREMENT LV_LDC_CAT_1 "bdyn_kat_1" UBYTE RANGE________YES___1H__1H____NO_ 2 2.0 0 255 BIT_MASK 0x1 ECU_ADDRESS 0x40119 /end MEASUREMENT
/begin MEASUREMENT LV_LDC_CAT_2 "bdyn_kat_2" UBYTE RANGE________YES___1H__1H____NO_ 2 2.0 0 255 BIT_MASK 0x2 ECU_ADDRESS 0x40119 /end MEASUREMENT
/begin MEASUREMENT LV_CDN_CAT_DIAG_1 "bed_cat_diag_1" UWORD RANGE________YES___1H__1H____745 2 2.0 0 65535 BIT_MASK 0x4 ECU_ADDRESS 0x40c62 /end MEASUREMENT
/begin MEASUREMENT LV_CDN_CAT_DIAG_2 "bed_cat_diag_2" UWORD RANGE________YES___1H__1H____745 2 2.0 0 65535 BIT_MASK 0x4 ECU_ADDRESS 0x40dc0 /end MEASUREMENT
/begin MEASUREMENT LV_LDC_LAM_DLY_1 "begr_dyn_lam_mv_zv_1" UWORD RANGE________passive___0H__0H___ 2 2.0 0 65535 BIT_MASK 0x1000 ECU_ADDRESS 0x40c62 /end MEASUREMENT
/begin MEASUREMENT LV_LDC_LAM_DLY_2 "begr_dyn_lam_mv_zv_2" UWORD RANGE________passive___0H__0H___ 2 2.0 0 65535 BIT_MASK 0x1000 ECU_ADDRESS 0x40dc0 /end MEASUREMENT
/begin MEASUREMENT LV_LAM_DYW_1 "begr_dyn_lam1" UBYTE RANGE________passive___0H__0H746 2 2.0 0 255 BIT_MASK 0x4 ECU_ADDRESS 0x40c3f /end MEASUREMENT
/begin MEASUREMENT LV_LAM_DYW_2 "begr_dyn_lam2" UBYTE RANGE________passive___0H__0H746 2 2.0 0 255 BIT_MASK 0x4 ECU_ADDRESS 0x40d9d /end MEASUREMENT
/begin MEASUREMENT LV_LDC_MAF_DLY "begr_dyn_maf_zv" UWORD RANGE________passive___0H__0H747 2 2.0 0 65535 BIT_MASK 0x200 ECU_ADDRESS 0xfda4 /end MEASUREMENT
/begin MEASUREMENT LV_N_MAF_DYW_1 "begr_dyn_n_maf1" UBYTE RANGE________passive___0H__0H748 2 2.0 0 255 BIT_MASK 0x8 ECU_ADDRESS 0x40c3f /end MEASUREMENT
/begin MEASUREMENT LV_N_MAF_DYW_2 "begr_dyn_n_maf2" UBYTE RANGE________passive___0H__0H748 2 2.0 0 255 BIT_MASK 0x8 ECU_ADDRESS 0x40d9d /end MEASUREMENT
/begin MEASUREMENT LV_LDC_N_DLY "begr_dyn_n_zv" UWORD RANGE________passive___0H__0H749 2 2.0 0 65535 BIT_MASK 0x4 ECU_ADDRESS 0xfda4 /end MEASUREMENT
/begin MEASUREMENT LV_LD "beladung" UWORD RANGE________0___0H__0H____1___1 2 2.0 0 65535 BIT_MASK 0x8 ECU_ADDRESS 0xfd90 /end MEASUREMENT
/begin MEASUREMENT CTR_DLY_SAFM_DIAG_INTR "c_dly_safm_diag_intr_t1" UWORD LINEAR______0_000000__0H___10_00 2 2.0 0.0 10.0 BIT_MASK 0xffffffff ECU_ADDRESS 0xe3b6 /end MEASUREMENT
/begin MEASUREMENT CAM_ADJ_RNG_EX "cam_adj_rng_ex" UWORD CAM_ADJ_RTD 2 2.0 0 65535 BIT_MASK 0x7 ECU_ADDRESS 0xfda0 /end MEASUREMENT
/begin MEASUREMENT CAM_ADJ_RNG_IN "cam_adj_rng_in" UWORD CAM_ADJ_ADC 2 2.0 0 65535 BIT_MASK 0x7 ECU_ADDRESS 0xfd9e /end MEASUREMENT
/begin MEASUREMENT CAM_GRD_EX "cam_grd_ex" SWORD LINEAR_______95_625000__FFFFFF01 2 2.0 -96.25 96.25 BIT_MASK 0xffffffff ECU_ADDRESS 0x40bd2 /end MEASUREMENT
/begin MEASUREMENT CAM_GRD_IN "cam_grd_in" SWORD LINEAR_______95_625000__FFFFFF01 2 2.0 -96.25 96.25 BIT_MASK 0xffffffff ECU_ADDRESS 0x40bd4 /end MEASUREMENT
/begin MEASUREMENT CAM_REF_EX "cam_ref_ex" UWORD LINEAR_______155_996700__FFFFH__ 2 2.0 -155.9967 -60.0 BIT_MASK 0xffff ECU_ADDRESS 0x40bd8 /end MEASUREMENT
/begin MEASUREMENT CAM_REF_IN "cam_ref_in" UWORD LINEAR______60_000000__0H___1750 2 2.0 60.0 155.9967 BIT_MASK 0xffff ECU_ADDRESS 0x40bda /end MEASUREMENT
/begin MEASUREMENT CAM_SP_IN_LGRD "cam_sp_in_lgrdvbyteC1D" UBYTE LINEAR_______48_000000__0H___47_ 2 2.0 -48.0 47.625 BIT_MASK 0xffffffff ECU_ADDRESS 0x40be9 /end MEASUREMENT
/begin MEASUREMENT LV_ERR_CARB "carb" UWORD RANGE________0___0H__0H____1___1 2 2.0 0 65535 BIT_MASK 0x2 ECU_ADDRESS 0xfd9a /end MEASUREMENT
/begin MEASUREMENT CHA_CDN_BAT "cha_cdn_bat" UBYTE LINEAR______0_000000__0H___12779 2 2.0 0.0 127.5 BIT_MASK 0xffffffff ECU_ADDRESS 0x401ea /end MEASUREMENT
/begin MEASUREMENT CHA_CDN_BAT_GRD "cha_cdn_bat_grd" SWORD LINEAR_______32768_000000__FF751 2 2.0 -32768.0 32767.0 BIT_MASK 0xffffffff ECU_ADDRESS 0x408ce /end MEASUREMENT
/begin MEASUREMENT CPPWM "cppwm" UWORD LINEAR______0_000000__0H___99_97 2 2.0 0.0 99.97559 BIT_MASK 0xffffffff ECU_ADDRESS 0x406f2 /end MEASUREMENT
/begin MEASUREMENT CPPWM_CLC "cppwm_clc" UWORD LINEAR______0_000000__0H___800_0 2 2.0 0.0 800.0 BIT_MASK 0xffffffff ECU_ADDRESS 0x40712 /end MEASUREMENT
/begin MEASUREMENT CPPWM_MAX_COR "cppwm_max_cor" UWORD LINEAR______0_000000__0H___800_0 2 2.0 0.0 800.0 BIT_MASK 0xffffffff ECU_ADDRESS 0x406f6 /end MEASUREMENT
/begin MEASUREMENT CRK_CYL_LAM_1_1 "crk_cyl_lamC0D" UBYTE LINEAR______0_000000__0H___72752 2 2.0 0.0 720.0 BIT_MASK 0xffffffff FUNCTION_LIST CSCM ECU_ADDRESS 0xfb8c /end MEASUREMENT
/begin MEASUREMENT CRK_CYL_LAM_2_5 "crk_cyl_lamC1D" UBYTE LINEAR______0_000000__0H___72752 2 2.0 0.0 720.0 BIT_MASK 0xffffffff FUNCTION_LIST CSCM ECU_ADDRESS 0xfb8d /end MEASUREMENT
/begin MEASUREMENT CRK_CYL_LAM_1_3 "crk_cyl_lamC2D" UBYTE LINEAR______0_000000__0H___72752 2 2.0 0.0 720.0 BIT_MASK 0xffffffff FUNCTION_LIST CSCM ECU_ADDRESS 0xfb8e /end MEASUREMENT
/begin MEASUREMENT CRK_CYL_LAM_2_6 "crk_cyl_lamC3D" UBYTE LINEAR______0_000000__0H___72752 2 2.0 0.0 720.0 BIT_MASK 0xffffffff FUNCTION_LIST CSCM ECU_ADDRESS 0xfb8f /end MEASUREMENT
/begin MEASUREMENT CRK_CYL_LAM_1_2 "crk_cyl_lamC4D" UBYTE LINEAR______0_000000__0H___72752 2 2.0 0.0 720.0 BIT_MASK 0xffffffff FUNCTION_LIST CSCM ECU_ADDRESS 0xfb90 /end MEASUREMENT
/begin MEASUREMENT CRK_CYL_LAM_2_4 "crk_cyl_lamC5D" UBYTE LINEAR______0_000000__0H___72752 2 2.0 0.0 720.0 BIT_MASK 0xffffffff FUNCTION_LIST CSCM ECU_ADDRESS 0xfb91 /end MEASUREMENT
/begin MEASUREMENT CRLC_DEC_DOWN_1 "crlc_dec_down_1" UWORD LINEAR______0_000000__0H___1_027 2 2.0 0.0 1.0 BIT_MASK 0xffffffff FUNCTION_LIST ETM ECU_ADDRESS 0x405e2 /end MEASUREMENT
/begin MEASUREMENT CRLC_DEC_DOWN_2 "crlc_dec_down_2" UWORD LINEAR______0_000000__0H___1_027 2 2.0 0.0 1.0 BIT_MASK 0xffffffff FUNCTION_LIST ETM ECU_ADDRESS 0x405e4 /end MEASUREMENT
/begin MEASUREMENT CRLC_DEC_UP_1 "crlc_dec_up_1" UWORD LINEAR______0_000000__0H___1_027 2 2.0 0.0 1.0 BIT_MASK 0xffffffff FUNCTION_LIST ETM ECU_ADDRESS 0x405e6 /end MEASUREMENT
/begin MEASUREMENT CRLC_DEC_UP_2 "crlc_dec_up_2" UWORD LINEAR______0_000000__0H___1_027 2 2.0 0.0 1.0 BIT_MASK 0xffffffff FUNCTION_LIST ETM ECU_ADDRESS 0x405e8 /end MEASUREMENT
/begin MEASUREMENT CRLC_INC_DOWN_1 "crlc_inc_down_1" UWORD LINEAR______0_000000__0H___1_027 2 2.0 0.0 1.0 BIT_MASK 0xffffffff FUNCTION_LIST ETM ECU_ADDRESS 0x405ea /end MEASUREMENT
/begin MEASUREMENT CRLC_INC_DOWN_2 "crlc_inc_down_2" UWORD LINEAR______0_000000__0H___1_027 2 2.0 0.0 1.0 BIT_MASK 0xffffffff FUNCTION_LIST ETM ECU_ADDRESS 0x405ec /end MEASUREMENT
/begin MEASUREMENT CRLC_INC_UP_1 "crlc_inc_up_1" UWORD LINEAR______0_000000__0H___1_027 2 2.0 0.0 1.0 BIT_MASK 0xffffffff FUNCTION_LIST ETM ECU_ADDRESS 0x405ee /end MEASUREMENT
/begin MEASUREMENT CRLC_INC_UP_2 "crlc_inc_up_2" UWORD LINEAR______0_000000__0H___1_027 2 2.0 0.0 1.0 BIT_MASK 0xffffffff FUNCTION_LIST ETM ECU_ADDRESS 0x405f0 /end MEASUREMENT
/begin MEASUREMENT CRLC_WALL_DEC_DOWN_1 "crlc_wall_dec_down_1" UWORD LINEAR______0_000000__0H___1_027 2 2.0 0.0 1.0 BIT_MASK 0xffffffff FUNCTION_LIST ETM ECU_ADDRESS 0x405f2 /end MEASUREMENT
/begin MEASUREMENT CRLC_WALL_DEC_DOWN_2 "crlc_wall_dec_down_2" UWORD LINEAR______0_000000__0H___1_027 2 2.0 0.0 1.0 BIT_MASK 0xffffffff FUNCTION_LIST ETM ECU_ADDRESS 0x405f4 /end MEASUREMENT
/begin MEASUREMENT CRLC_WALL_DEC_UP_1 "crlc_wall_dec_up_1" UWORD LINEAR______0_000000__0H___1_027 2 2.0 0.0 1.0 BIT_MASK 0xffffffff FUNCTION_LIST ETM ECU_ADDRESS 0x405f6 /end MEASUREMENT
/begin MEASUREMENT CRLC_WALL_DEC_UP_2 "crlc_wall_dec_up_2" UWORD LINEAR______0_000000__0H___1_027 2 2.0 0.0 1.0 BIT_MASK 0xffffffff FUNCTION_LIST ETM ECU_ADDRESS 0x405f8 /end MEASUREMENT
/begin MEASUREMENT CRLC_WALL_INC_DOWN_1 "crlc_wall_inc_down_1" UWORD LINEAR______0_000000__0H___1_027 2 2.0 0.0 1.0 BIT_MASK 0xffffffff FUNCTION_LIST ETM ECU_ADDRESS 0x405fa /end MEASUREMENT
/begin MEASUREMENT CRLC_WALL_INC_DOWN_2 "crlc_wall_inc_down_2" UWORD LINEAR______0_000000__0H___1_027 2 2.0 0.0 1.0 BIT_MASK 0xffffffff FUNCTION_LIST ETM ECU_ADDRESS 0x405fc /end MEASUREMENT
/begin MEASUREMENT CRLC_WALL_INC_UP_1 "crlc_wall_inc_up_1" UWORD LINEAR______0_000000__0H___1_027 2 2.0 0.0 1.0 BIT_MASK 0xffffffff FUNCTION_LIST ETM ECU_ADDRESS 0x405fe /end MEASUREMENT
/begin MEASUREMENT CRLC_WALL_INC_UP_2 "crlc_wall_inc_up_2" UWORD LINEAR______0_000000__0H___1_027 2 2.0 0.0 1.0 BIT_MASK 0xffffffff FUNCTION_LIST ETM ECU_ADDRESS 0x40600 /end MEASUREMENT
/begin MEASUREMENT CTR_ABC_CS "ctr_abc_cs" UBYTE LINEAR______0_000000__0H___255_0 2 2.0 0.0 255.0 BIT_MASK 0xffffffff ECU_ADDRESS 0x4015e /end MEASUREMENT
/begin MEASUREMENT CTR_CNL_ROUGH_LEAK_MES_FUC "ctr_cnl_rough_leak_mes_fuc" UBYTE LINEAR______0_000000__0H___255_0 2 2.0 0.0 255.0 BIT_MASK 0xffffffff FUNCTION_LIST DMTL ECU_ADDRESS 0x40494 /end MEASUREMENT
/begin MEASUREMENT CTR_CNL_SMALL_LEAK_MES "ctr_cnl_small_leak_mes" UBYTE LINEAR______0_000000__0H___255_0 2 2.0 0.0 255.0 BIT_MASK 0xffffffff FUNCTION_LIST DMTL ECU_ADDRESS 0x40493 /end MEASUREMENT
/begin MEASUREMENT CTR_CUR_DMTL_REF_DIF_MAX "ctr_cur_dmtl_ref_dif_max" UWORD LINEAR______0_000000__0H___65535 2 2.0 0.0 65535.0 BIT_MASK 0xffffffff FUNCTION_LIST DMTL ECU_ADDRESS 0x419fa /end MEASUREMENT
/begin MEASUREMENT CTR_DLY_SA_ACT "ctr_dly_sa_act" UWORD LINEAR______0_000000__0H___65593 2 2.0 0.0 65534.0 BIT_MASK 0xffffffff ECU_ADDRESS 0xe146 /end MEASUREMENT
/begin MEASUREMENT CTR_DMTL_ACT "ctr_dmtl_act" UWORD LINEAR______0_000000__0H___65535 2 2.0 0.0 65535.0 BIT_MASK 0xffffffff FUNCTION_LIST DMTL ECU_ADDRESS 0x41a00 /end MEASUREMENT
/begin MEASUREMENT CTR_ENA_ROUGH_LEAK_1 "ctr_ena_rough_leak_1" UBYTE LINEAR______0_000000__0H___255_0 2 2.0 0.0 255.0 BIT_MASK 0xffffffff FUNCTION_LIST DMTL ECU_ADDRESS 0x40489 /end MEASUREMENT
/begin MEASUREMENT CTR_ENA_ROUGH_LEAK_TEST_1 "ctr_ena_rough_leak_test_1" UBYTE LINEAR______0_000000__0H___255_0 2 2.0 0.0 255.0 BIT_MASK 0xffffffff FUNCTION_LIST DMTL ECU_ADDRESS 0x4048a /end MEASUREMENT
/begin MEASUREMENT CTR_ENA_SMALL_LEAK_TEST_2 "ctr_ena_small_leak_test_2" UBYTE LINEAR______0_000000__0H___255_0 2 2.0 0.0 255.0 BIT_MASK 0xffffffff FUNCTION_LIST DMTL ECU_ADDRESS 0x4048b /end MEASUREMENT
/begin MEASUREMENT CTR_LEARN_SAP "ctr_learn_sap" UBYTE LINEAR______0_000000__0H___255_0 2 2.0 0.0 255.0 BIT_MASK 0xffffffff ECU_ADDRESS 0x40156 /end MEASUREMENT
/begin MEASUREMENT CTR_LEARN_SAP_OK "ctr_learn_sap_ok" UBYTE LINEAR______0_000000__0H___255_0 2 2.0 0.0 255.0 BIT_MASK 0xffffffff ECU_ADDRESS 0x40157 /end MEASUREMENT
/begin MEASUREMENT CTR_N_MAX_AMT_GS "ctr_n_max_amt_gs" UWORD LINEAR______0_000000__0H___65535 2 2.0 0.0 65535.0 BIT_MASK 0xffffffff FUNCTION_LIST Z1S1 ECU_ADDRESS 0x40f0a /end MEASUREMENT
/begin MEASUREMENT CTR_PVS_BLS "ctr_pvs_bls" UBYTE LINEAR______0_000000__0H___255_0 2 2.0 0.0 255.0 BIT_MASK 0xffffffff ECU_ADDRESS 0x4014f /end MEASUREMENT
/begin MEASUREMENT CTR_PVS_BLS_BTS_PLAUS "ctr_pvs_bls_bts_plaus" UBYTE LINEAR______0_000000__0H___255_0 2 2.0 0.0 255.0 BIT_MASK 0xffffffff ECU_ADDRESS 0xfb46 /end MEASUREMENT
/begin MEASUREMENT CTR_REP_ROUGH_LEAK_MES_FUC "ctr_rep_rough_leak_mes_fuc" UBYTE LINEAR______0_000000__0H___255_0 2 2.0 0.0 255.0 BIT_MASK 0xffffffff FUNCTION_LIST DMTL ECU_ADDRESS 0x40495 /end MEASUREMENT
/begin MEASUREMENT CTR_REST_SA "ctr_rest_sa" UBYTE LINEAR______0_000000__0H___255_0 2 2.0 0.0 255.0 BIT_MASK 0xffffffff ECU_ADDRESS 0x40410 /end MEASUREMENT
/begin MEASUREMENT CTR_ROUGH_LEAK_MES "ctr_rough_leak_mes" UWORD LINEAR______0_000000__0H___65535 2 2.0 0.0 65535.0 BIT_MASK 0xffffffff FUNCTION_LIST DMTL ECU_ADDRESS 0x419fc /end MEASUREMENT
/begin MEASUREMENT CTR_SAFM_DIAG "ctr_safm_diag" UWORD LINEAR______0_000000__0H___65593 2 2.0 0.0 65534.0 BIT_MASK 0xffffffff ECU_ADDRESS 0xe11e /end MEASUREMENT
/begin MEASUREMENT CTR_SAV_THD "ctr_sav_thd" UBYTE LINEAR______0_000000__0H___255_0 2 2.0 0.0 255.0 BIT_MASK 0xffffffff ECU_ADDRESS 0x40092 /end MEASUREMENT
/begin MEASUREMENT CTR_SMALL_LEAK_MES "ctr_small_leak_mes" UWORD LINEAR______0_000000__0H___65535 2 2.0 0.0 65535.0 BIT_MASK 0xffffffff FUNCTION_LIST DMTL ECU_ADDRESS 0x419fe /end MEASUREMENT
/begin MEASUREMENT CTR_T_COP_STEP_2_1 "ctr_t_cop_step_2_1" UBYTE LINEAR______0_000000__0H___25514 2 2.0 0.0 255.0 BIT_MASK 0xffffffff ECU_ADDRESS 0x4043e /end MEASUREMENT
/begin MEASUREMENT CTR_T_COP_STEP_2_2 "ctr_t_cop_step_2_2" UBYTE LINEAR______0_000000__0H___25514 2 2.0 0.0 255.0 BIT_MASK 0xffffffff ECU_ADDRESS 0x4043f /end MEASUREMENT
/begin MEASUREMENT CTR_T_DIAG_CS "ctr_t_diag_cs" UWORD LINEAR______0_000000__0H___65535 2 2.0 0.0 65535.0 BIT_MASK 0xffffffff ECU_ADDRESS 0x4073c /end MEASUREMENT
/begin MEASUREMENT CTR_T_DLY_IGK "ctr_t_dly_igk" UBYTE LINEAR______0_000000__0H___25_50 2 2.0 0.0 25.5 BIT_MASK 0xffffffff FUNCTION_LIST DMTL ECU_ADDRESS 0x4048c /end MEASUREMENT
/begin MEASUREMENT CTR_T_DMTL "ctr_t_dmtl" UWORD LINEAR______0_000000__0H___6553_ 2 2.0 0.0 6553.5 BIT_MASK 0xffffffff FUNCTION_LIST DMTL ECU_ADDRESS 0x41a1e /end MEASUREMENT
/begin MEASUREMENT CUR_DMTL "cur_dmtl" UWORD LINEAR______0_000000__0H___400_0 2 2.0 0.0 400.0 BIT_MASK 0xffffffff FUNCTION_LIST DMTL ECU_ADDRESS 0x41a02 /end MEASUREMENT
/begin MEASUREMENT CUR_DMTL_COMP_ROUGH_LEAK "cur_dmtl_comp_rough_leak" UWORD LINEAR______0_000000__0H___400_0 2 2.0 0.0 400.0 BIT_MASK 0xffffffff FUNCTION_LIST DMTL ECU_ADDRESS 0x41a20 /end MEASUREMENT
/begin MEASUREMENT CUR_DMTL_COMP_SMALL_LEAK_LEN "cur_dmtl_comp_small_leak_len" UWORD LINEAR______0_000000__0H___400_0 2 2.0 0.0 400.0 BIT_MASK 0xffffffff FUNCTION_LIST DMTL ECU_ADDRESS 0x41a6c /end MEASUREMENT
/begin MEASUREMENT CUR_DMTL_COR "cur_dmtl_cor" UWORD LINEAR______0_000000__0H___400_0 2 2.0 0.0 400.0 BIT_MASK 0xffffffff FUNCTION_LIST DMTL ECU_ADDRESS 0x41a22 /end MEASUREMENT
/begin MEASUREMENT CUR_DMTL_COR_FIL "cur_dmtl_cor_filvwordC1D" UWORD LINEAR______0_000000__0H___400_0 2 2.0 0.0 400.0 BIT_MASK 0xffffffff FUNCTION_LIST DMTL ECU_ADDRESS 0x41a58 /end MEASUREMENT
/begin MEASUREMENT CUR_DMTL_COR_FIL_MAX "cur_dmtl_cor_fil_max" UWORD LINEAR______0_000000__0H___400_0 2 2.0 0.0 400.0 BIT_MASK 0xffffffff FUNCTION_LIST DMTL ECU_ADDRESS 0x41a24 /end MEASUREMENT
/begin MEASUREMENT CUR_DMTL_COR_FIL_MES_MAX "cur_dmtl_cor_fil_mes_max" UWORD LINEAR______0_000000__0H___400_0 2 2.0 0.0 400.0 BIT_MASK 0xffffffff FUNCTION_LIST DMTL ECU_ADDRESS 0x41a26 /end MEASUREMENT
/begin MEASUREMENT CUR_DMTL_COR_FIL_MIN "cur_dmtl_cor_fil_min" UWORD LINEAR______0_000000__0H___400_0 2 2.0 0.0 400.0 BIT_MASK 0xffffffff FUNCTION_LIST DMTL ECU_ADDRESS 0x41a28 /end MEASUREMENT
/begin MEASUREMENT CUR_DMTL_COR_FIL_REFU "cur_dmtl_cor_fil_refuvwordC1D" UWORD LINEAR______0_000000__0H___400_0 2 2.0 0.0 400.0 BIT_MASK 0xffffffff FUNCTION_LIST DMTL ECU_ADDRESS 0x41a5c /end MEASUREMENT
/begin MEASUREMENT CUR_DMTL_COR_FIL_REFU_HPF "cur_dmtl_cor_fil_refu_hpf" SWORD LINEAR_______200_000000__FFFF800 2 2.0 -200.0 199.9938 BIT_MASK 0xffffffff FUNCTION_LIST DMTL ECU_ADDRESS 0x41a1c /end MEASUREMENT
/begin MEASUREMENT CUR_DMTL_DIF "cur_dmtl_dif" UWORD LINEAR______0_000000__0H___400_0 2 2.0 0.0 400.0 BIT_MASK 0xffffffff FUNCTION_LIST DMTL ECU_ADDRESS 0x41a2a /end MEASUREMENT
/begin MEASUREMENT CUR_DMTL_DIF_REF_ROUGH_LEAK "cur_dmtl_dif_ref_rough_leak" UWORD LINEAR______0_000000__0H___400_0 2 2.0 0.0 400.0 BIT_MASK 0xffffffff FUNCTION_LIST DMTL ECU_ADDRESS 0x41a04 /end MEASUREMENT
/begin MEASUREMENT CUR_DMTL_REF_DIF_MAX "cur_dmtl_ref_dif_max" UWORD LINEAR______0_000000__0H___400_0 2 2.0 0.0 400.0 BIT_MASK 0xffffffff FUNCTION_LIST DMTL ECU_ADDRESS 0x41a2e /end MEASUREMENT
/begin MEASUREMENT CUR_DMTL_REF_LEAK "cur_dmtl_ref_leak" UWORD LINEAR______0_000000__0H___400_0 2 2.0 0.0 400.0 BIT_MASK 0xffffffff FUNCTION_LIST DMTL ECU_ADDRESS 0x41a06 /end MEASUREMENT
/begin MEASUREMENT CUR_DMTL_ROUGH_LEAK_END "cur_dmtl_rough_leak_end" UWORD LINEAR______0_000000__0H___400_0 2 2.0 0.0 400.0 BIT_MASK 0xffffffff FUNCTION_LIST DMTL ECU_ADDRESS 0x41a30 /end MEASUREMENT
/begin MEASUREMENT CUR_DMTL_ROUGH_LEAK_LEN_END "cur_dmtl_rough_leak_len_end" UWORD LINEAR______0_000000__0H___400_0 2 2.0 0.0 400.0 BIT_MASK 0xffffffff FUNCTION_LIST DMTL ECU_ADDRESS 0x41a6e /end MEASUREMENT
/begin MEASUREMENT CUR_DMTL_ROUGH_LEAK_MIN "cur_dmtl_rough_leak_min" UWORD LINEAR______0_000000__0H___400_0 2 2.0 0.0 400.0 BIT_MASK 0xffffffff FUNCTION_LIST DMTL ECU_ADDRESS 0x41a08 /end MEASUREMENT
/begin MEASUREMENT CUR_DMTL_SMALL_LEAK_END "cur_dmtl_small_leak_end" UWORD LINEAR______0_000000__0H___400_0 2 2.0 0.0 400.0 BIT_MASK 0xffffffff FUNCTION_LIST DMTL ECU_ADDRESS 0x41a32 /end MEASUREMENT
/begin MEASUREMENT CUR_DMTL_THD_ROUGH_LEAK "cur_dmtl_thd_rough_leak" UWORD LINEAR______0_000000__0H___400_0 2 2.0 0.0 400.0 BIT_MASK 0xffffffff FUNCTION_LIST DMTL ECU_ADDRESS 0x41a36 /end MEASUREMENT
/begin MEASUREMENT CUR_DMTL_THD_ROUGH_LEAK_LEN "cur_dmtl_thd_rough_leak_len" UWORD LINEAR______0_000000__0H___400_0 2 2.0 0.0 400.0 BIT_MASK 0xffffffff FUNCTION_LIST DMTL ECU_ADDRESS 0x41a70 /end MEASUREMENT
/begin MEASUREMENT CUR_IGC_COR_1 "cur_igc_corC0Dvword" UWORD LINEAR______0_000000__0H___1_753 2 2.0 0.0 1.99997 BIT_MASK 0xffffffff ECU_ADDRESS 0xe2b8 /end MEASUREMENT
/begin MEASUREMENT CUR_IGC_COR_5 "cur_igc_corC1Dvword" UWORD LINEAR______0_000000__0H___1_753 2 2.0 0.0 1.99997 BIT_MASK 0xffffffff ECU_ADDRESS 0xe2ba /end MEASUREMENT
/begin MEASUREMENT CUR_IGC_COR_3 "cur_igc_corC2Dvword" UWORD LINEAR______0_000000__0H___1_753 2 2.0 0.0 1.99997 BIT_MASK 0xffffffff ECU_ADDRESS 0xe2bc /end MEASUREMENT
/begin MEASUREMENT CUR_IGC_COR_6 "cur_igc_corC3Dvword" UWORD LINEAR______0_000000__0H___1_753 2 2.0 0.0 1.99997 BIT_MASK 0xffffffff ECU_ADDRESS 0xe2be /end MEASUREMENT
/begin MEASUREMENT CUR_IGC_COR_2 "cur_igc_corC4Dvword" UWORD LINEAR______0_000000__0H___1_753 2 2.0 0.0 1.99997 BIT_MASK 0xffffffff ECU_ADDRESS 0xe2c0 /end MEASUREMENT
/begin MEASUREMENT CUR_IGC_COR_4 "cur_igc_corC5Dvword" UWORD LINEAR______0_000000__0H___1_753 2 2.0 0.0 1.99997 BIT_MASK 0xffffffff ECU_ADDRESS 0xe2c2 /end MEASUREMENT
/begin MEASUREMENT CYCNR_DLY_ER "cycnr_dly_er" UBYTE LINEAR______0_000000__0H___255_0 2 2.0 0.0 255.0 BIT_MASK 0xffffffff ECU_ADDRESS 0x40182 /end MEASUREMENT
/begin MEASUREMENT CYCNR_FAC_RON_LOW "cycnr_fac_ron_low" UWORD LINEAR______0_000000__0H___65535 2 2.0 0.0 65535.0 BIT_MASK 0xffffffff ECU_ADDRESS 0xe312 /end MEASUREMENT
/begin MEASUREMENT CYCNR_PUC "cycnr_puc" UWORD LINEAR______0_000000__0H___65573 2 2.0 0.0 65535.0 BIT_MASK 0xffffffff ECU_ADDRESS 0xe2a2 /end MEASUREMENT
/begin MEASUREMENT CYCNR_ST "cycnr_st" UWORD LINEAR______0_000000__0H___65573 2 2.0 0.0 65535.0 BIT_MASK 0xffffffff ECU_ADDRESS 0x41114 /end MEASUREMENT
/begin MEASUREMENT CYCNR_ST_AST "cycnr_st_ast" UWORD LINEAR______0_000000__0H___65573 2 2.0 0.0 65535.0 BIT_MASK 0xffffffff ECU_ADDRESS 0x41116 /end MEASUREMENT
/begin MEASUREMENT CYCNR_SUPP_ST "cycnr_supp_st" UBYTE LINEAR______0_000000__0H___255_4 2 2.0 0.0 255.0 BIT_MASK 0xffffffff ECU_ADDRESS 0x40462 /end MEASUREMENT
/begin MEASUREMENT CYL_ID_NR "cyl_id_nr" UBYTE ZYL_ID 2 2.0 1.0 6.0 BIT_MASK 0xffffffff ECU_ADDRESS 0x41be6 /end MEASUREMENT
/begin MEASUREMENT CYL_ID_SAM_TRIG "cyl_id_sam_trig" UBYTE ZYL_ID 2 2.0 1.0 6.0 BIT_MASK 0xffffffff ECU_ADDRESS 0x41be8 /end MEASUREMENT
/begin MEASUREMENT LV_ERR_DIAG "diag" UWORD RANGE________0___0H__0H____1___1 2 2.0 0 65535 BIT_MASK 0x1 ECU_ADDRESS 0xfd9a /end MEASUREMENT
/begin MEASUREMENT DIAG_STAT_KNK "diag_stat_knk" UBYTE LINEAR______0_000000__0H___25754 2 2.0 0.0 255.0 BIT_MASK 0xffffffff ECU_ADDRESS 0x403cf /end MEASUREMENT
/begin MEASUREMENT DIAG_TEV_FLAGS "diag_tev_flags" UWORD LINEAR______0_000000__0H___65535 2 2.0 0.0 65535.0 BIT_MASK 0xffffffff ECU_ADDRESS 0xfd92 /end MEASUREMENT
/begin COMPU_METHOD LINEAR______0_000000__0H___255_0 "" FORM "%3.0" "-" FORMULA "1.0*X" FORMULA_INV "1.0*X" /end COMPU_METHOD
/begin COMPU_METHOD LINEAR______0_000000__0H___65535 "" FORM "%5.0" "-" FORMULA "1.0*X" FORMULA_INV "1.0*X" /end COMPU_METHOD
/begin COMPU_METHOD LINEAR______0_000000__0H___255_4 "" FORM "%3.0" "*seg" FORMULA "1.0*X" FORMULA_INV "1.0*X" /end COMPU_METHOD
/begin COMPU_METHOD LINEAR______0_000000__0H___1_000 "" FORM "%2.0" "-" FORMULA "1.0*X" FORMULA_INV "1.0*X" /end COMPU_METHOD
/begin COMPU_METHOD LINEAR_______48_000000__0H___155 "" FORM "%5.1" "°C" FORMULA "0.79607843*X-48.0" FORMULA_INV "1.2561576*X+60.295567" /end COMPU_METHOD
/begin COMPU_METHOD LINEAR______0_000000__0H___1_992 "" FORM "%5.3" "-" FORMULA "0.0078125*X" FORMULA_INV "128.0*X" /end COMPU_METHOD
/begin COMPU_METHOD LINEAR_______48_000000__0H___47_ "" FORM "%6.2" "°CRK" FORMULA "0.375*X-48.0" FORMULA_INV "2.6666667*X+128.0" /end COMPU_METHOD
/begin COMPU_METHOD LINEAR_______50_000000__0H___49_ "" FORM "%5.1" "%" FORMULA "0.3906251*X-50.0" FORMULA_INV "2.5599994*X+127.99997" /end COMPU_METHOD
/begin COMPU_METHOD LINEAR______0_000000__0H___1389_ "" FORM "%4.0" "mg/stk" FORMULA "5.4470588*X" FORMULA_INV "0.18358531*X" /end COMPU_METHOD
/begin COMPU_METHOD LINEAR______0_000000__0H___2_000 "" FORM "%2.0" "-" FORMULA "1.0*X" FORMULA_INV "1.0*X" /end COMPU_METHOD
/begin COMPU_METHOD LINEAR______0_000000__0H___6553_ "" FORM "%6.1" "s" FORMULA "0.1*X" FORMULA_INV "10.0*X" /end COMPU_METHOD
/begin COMPU_METHOD LINEAR______0_000000__0H___25514 "" FORM "%3.0" "s" FORMULA "1.0*X" FORMULA_INV "1.0*X" /end COMPU_METHOD
/begin COMPU_METHOD LINEAR______0_010000__1H___655_3 "" FORM "%6.2" "s" FORMULA "0.0099999996*X+3.7247841e-010" FORMULA_INV "100.0*X-3.7247842e-008" /end COMPU_METHOD
/begin COMPU_METHOD LINEAR______0_000000__0H___95_22 "" FORM "%5.2" "°CRK" FORMULA "0.375*X" FORMULA_INV "2.6666667*X" /end COMPU_METHOD
/begin COMPU_METHOD LINEAR______0_000000__0H___5434_ "" FORM "%7.2" "hPa" FORMULA "0.082921489*X" FORMULA_INV "12.0596*X" /end COMPU_METHOD
/begin COMPU_METHOD LINEAR______0_000000__0H___99_97 "" FORM "%5.2" "%" FORMULA "0.024414063*X" FORMULA_INV "40.959998*X" /end COMPU_METHOD
/begin COMPU_METHOD LINEAR______0_000000__0H___800_0 "" FORM "%6.2" "%" FORMULA "0.024414063*X" FORMULA_INV "40.96*X" /end COMPU_METHOD
/begin COMPU_METHOD LINEAR______0_000000__0H___1_027 "" FORM "%7.5" "-" FORMULA "1.5259022e-005*X" FORMULA_INV "65535.0*X" /end COMPU_METHOD
/begin COMPU_METHOD LINEAR______0_000000__0H___25_50 "" FORM "%4.1" "s" FORMULA "0.1*X" FORMULA_INV "10.0*X" /end COMPU_METHOD
/begin COMPU_METHOD LINEAR______0_000000__0H___2_544 "" FORM "%4.2" "s" FORMULA "0.0099999998*X" FORMULA_INV "100.0*X" /end COMPU_METHOD
/begin COMPU_METHOD LINEAR______0_000000__0H___655_3 "" FORM "%6.2" "s" FORMULA "0.01*X" FORMULA_INV "100.0*X" /end COMPU_METHOD
/begin COMPU_METHOD LINEAR______0_000000__0H___65573 "" FORM "%5.0" "*seg" FORMULA "1.0*X" FORMULA_INV "1.0*X" /end COMPU_METHOD
/begin COMPU_METHOD LINEAR______0_500000__40H___1_50 "" FORM "%5.3" "-" FORMULA "0.0078125*X" FORMULA_INV "128.0*X" /end COMPU_METHOD
/begin COMPU_METHOD LINEAR______0_000000__0H___12779 "" FORM "%5.1" "Ah" FORMULA "0.5*X" FORMULA_INV "2.0*X" /end COMPU_METHOD
/begin COMPU_METHOD LINEAR______0_000000__0H___400_0 "" FORM "%7.3" "mA" FORMULA "0.0061036088*X" FORMULA_INV "163.8375*X" /end COMPU_METHOD
/begin COMPU_METHOD LINEAR______0_000000__0H___65593 "" FORM "%5.0" "-" FORMULA "1.0*X" FORMULA_INV "1.0*X" /end COMPU_METHOD
/begin COMPU_METHOD LINEAR_______200_000000__FFFF800 "" FORM "%8.3" "mA" FORMULA "0.0061035142*X-4.8242924e-005" FORMULA_INV "163.84004*X+0.0079041225" /end COMPU_METHOD
/begin COMPU_METHOD LINEAR_______50_000000__FFFFFF80 "" FORM "%6.2" "%" FORMULA "0.39062745*X+0.00031372549" FORMULA_INV "2.5599839*X-0.00080313222" /end COMPU_METHOD
/begin COMPU_METHOD LINEAR______480_000000__FH___816 "" FORM "%4.0" "rpm" FORMULA "32.0*X" FORMULA_INV "0.03125*X" /end COMPU_METHOD
/begin COMPU_METHOD LINEAR______0_000000__0H___42146 "" FORM "%10.0" "-" FORMULA "1.0*X" FORMULA_INV "1.0*X" /end COMPU_METHOD
/begin COMPU_METHOD LINEAR______0_000000__0H___10_00 "" FORM "%4.2" "s" FORMULA "0.01*X" FORMULA_INV "100.0*X" /end COMPU_METHOD
/begin COMPU_METHOD LINEAR______0_000000__0H___20174 "" FORM "%5.1" "°C" FORMULA "0.79607843*X" FORMULA_INV "1.2561576*X" /end COMPU_METHOD
/begin COMPU_METHOD LINEAR______48_000000__FFFFFF80H "" FORM "%4.1" "°CRK" FORMULA "-0.375*X" FORMULA_INV "-2.6666667*X" /end COMPU_METHOD
/begin COMPU_METHOD defaultConversion198 "" FORM "%8.4" "[]" FORMULA "1.0*X" FORMULA_INV "1.0*X" /end COMPU_METHOD
/begin COMPU_METHOD defaultConversion199 "" FORM "%8.4" "[]" FORMULA "1.0*X" FORMULA_INV "1.0*X" /end COMPU_METHOD
/begin COMPU_METHOD defaultConversion200 "" FORM "%8.4" "[]" FORMULA "1.0*X" FORMULA_INV "1.0*X" /end COMPU_METHOD
/begin COMPU_METHOD LINEAR______0_000000__0H___10_24 "" FORM "%6.3" "hPa" FORMULA "0.0049999999*X" FORMULA_INV "200.0*X" /end COMPU_METHOD
/begin COMPU_METHOD defaultConversion201 "" FORM "%8.4" "[]" FORMULA "1.0*X" FORMULA_INV "1.0*X" /end COMPU_METHOD
/begin COMPU_METHOD defaultConversion202 "" FORM "%8.4" "[]" FORMULA "1.0*X" FORMULA_INV "1.0*X" /end COMPU_METHOD
/begin COMPU_METHOD defaultConversion203 "" FORM "%8.4" "[]" FORMULA "1.0*X" FORMULA_INV "1.0*X" /end COMPU_METHOD
/begin COMPU_METHOD defaultConversion204 "" FORM "%8.4" "[]" FORMULA "1.0*X" FORMULA_INV "1.0*X" /end COMPU_METHOD
/begin COMPU_METHOD defaultConversion205 "" FORM "%8.4" "[]" FORMULA "1.0*X" FORMULA_INV "1.0*X" /end COMPU_METHOD
/begin COMPU_METHOD defaultConversion206 "" FORM "%8.4" "[]" FORMULA "1.0*X" FORMULA_INV "1.0*X" /end COMPU_METHOD
/begin COMPU_METHOD defaultConversion207 "" FORM "%8.4" "[]" FORMULA "1.0*X" FORMULA_INV "1.0*X" /end COMPU_METHOD
/begin COMPU_METHOD defaultConversion208 "" FORM "%8.4" "[]" FORMULA "1.0*X" FORMULA_INV "1.0*X" /end COMPU_METHOD
/begin COMPU_METHOD defaultConversion209 "" FORM "%8.4" "[]" FORMULA "1.0*X" FORMULA_INV "1.0*X" /end COMPU_METHOD
/begin COMPU_METHOD defaultConversion210 "" FORM "%8.4" "[]" FORMULA "1.0*X" FORMULA_INV "1.0*X" /end COMPU_METHOD
/begin COMPU_METHOD defaultConversion211 "" FORM "%8.4" "[]" FORMULA "1.0*X" FORMULA_INV "1.0*X" /end COMPU_METHOD
/begin COMPU_METHOD defaultConversion212 "" FORM "%8.4" "[]" FORMULA "1.0*X" FORMULA_INV "1.0*X" /end COMPU_METHOD
/begin COMPU_METHOD defaultConversion213 "" FORM "%8.4" "[]" FORMULA "1.0*X" FORMULA_INV "1.0*X" /end COMPU_METHOD
/begin COMPU_METHOD defaultConversion214 "" FORM "%8.4" "[]" FORMULA "1.0*X" FORMULA_INV "1.0*X" /end COMPU_METHOD
/begin COMPU_METHOD defaultConversion215 "" FORM "%8.4" "[]" FORMULA "1.0*X" FORMULA_INV "1.0*X" /end COMPU_METHOD
/begin COMPU_METHOD defaultConversion216 "" FORM "%8.4" "[]" FORMULA "1.0*X" FORMULA_INV "1.0*X" /end COMPU_METHOD
/begin COMPU_METHOD defaultConversion217 "" FORM "%8.4" "[]" FORMULA "1.0*X" FORMULA_INV "1.0*X" /end COMPU_METHOD
/begin COMPU_METHOD defaultConversion218 "" FORM "%8.4" "[]" FORMULA "1.0*X" FORMULA_INV "1.0*X" /end COMPU_METHOD
/begin COMPU_METHOD defaultConversion219 "" FORM "%8.4" "[]" FORMULA "1.0*X" FORMULA_INV "1.0*X" /end COMPU_METHOD
/begin COMPU_METHOD defaultConversion220 "" FORM "%8.4" "[]" FORMULA "1.0*X" FORMULA_INV "1.0*X" /end COMPU_METHOD
/begin COMPU_METHOD defaultConversion221 "" FORM "%8.4" "[]" FORMULA "1.0*X" FORMULA_INV "1.0*X" /end COMPU_METHOD
/begin COMPU_METHOD defaultConversion222 "" FORM "%8.4" "[]" FORMULA "1.0*X" FORMULA_INV "1.0*X" /end COMPU_METHOD
/begin COMPU_METHOD defaultConversion223 "" FORM "%8.4" "[]" FORMULA "1.0*X" FORMULA_INV "1.0*X" /end COMPU_METHOD
/begin COMPU_METHOD defaultConversion224 "" FORM "%8.4" "[]" FORMULA "1.0*X" FORMULA_INV "1.0*X" /end COMPU_METHOD
/begin COMPU_METHOD defaultConversion225 "" FORM "%8.4" "[]" FORMULA "1.0*X" FORMULA_INV "1.0*X" /end COMPU_METHOD
/begin COMPU_METHOD defaultConversion226 "" FORM "%8.4" "[]" FORMULA "1.0*X" FORMULA_INV "1.0*X" /end COMPU_METHOD
/begin COMPU_METHOD defaultConversion227 "" FORM "%8.4" "[]" FORMULA "1.0*X" FORMULA_INV "1.0*X" /end COMPU_METHOD
/begin COMPU_METHOD defaultConversion228 "" FORM "%8.4" "[]" FORMULA "1.0*X" FORMULA_INV "1.0*X" /end COMPU_METHOD
/begin COMPU_METHOD defaultConversion229 "" FORM "%8.4" "[]" FORMULA "1.0*X" FORMULA_INV "1.0*X" /end COMPU_METHOD
/begin COMPU_METHOD defaultConversion230 "" FORM "%8.4" "[]" FORMULA "1.0*X" FORMULA_INV "1.0*X" /end COMPU_METHOD
/begin COMPU_METHOD defaultConversion231 "" FORM "%8.4" "[]" FORMULA "1.0*X" FORMULA_INV "1.0*X" /end COMPU_METHOD
/begin COMPU_METHOD defaultConversion232 "" FORM "%8.4" "[]" FORMULA "1.0*X" FORMULA_INV "1.0*X" /end COMPU_METHOD
/begin COMPU_METHOD defaultConversion233 "" FORM "%8.4" "[]" FORMULA "1.0*X" FORMULA_INV "1.0*X" /end COMPU_METHOD
/begin COMPU_METHOD defaultConversion234 "" FORM "%8.4" "[]" FORMULA "1.0*X" FORMULA_INV "1.0*X" /end COMPU_METHOD
/begin COMPU_METHOD defaultConversion235 "" FORM "%8.4" "[]" FORMULA "1.0*X" FORMULA_INV "1.0*X" /end COMPU_METHOD
/begin COMPU_METHOD defaultConversion236 "" FORM "%8.4" "[]" FORMULA "1.0*X" FORMULA_INV "1.0*X" /end COMPU_METHOD
/begin COMPU_METHOD defaultConversion237 "" FORM "%8.4" "[]" FORMULA "1.0*X" FORMULA_INV "1.0*X" /end COMPU_METHOD
/begin COMPU_METHOD defaultConversion238 "" FORM "%8.4" "[]" FORMULA "1.0*X" FORMULA_INV "1.0*X" /end COMPU_METHOD
/begin COMPU_METHOD defaultConversion239 "" FORM "%8.4" "[]" FORMULA "1.0*X" FORMULA_INV "1.0*X" /end COMPU_METHOD
/begin COMPU_METHOD defaultConversion240 "" FORM "%8.4" "[]" FORMULA "1.0*X" FORMULA_INV "1.0*X" /end COMPU_METHOD
/begin COMPU_METHOD defaultConversion241 "" FORM "%8.4" "[]" FORMULA "1.0*X" FORMULA_INV "1.0*X" /end COMPU_METHOD
/begin COMPU_METHOD defaultConversion242 "" FORM "%8.4" "[]" FORMULA "1.0*X" FORMULA_INV "1.0*X" /end COMPU_METHOD
/begin COMPU_METHOD defaultConversion243 "" FORM "%8.4" "[]" FORMULA "1.0*X" FORMULA_INV "1.0*X" /end COMPU_METHOD
/begin COMPU_METHOD defaultConversion244 "" FORM "%8.4" "[]" FORMULA "1.0*X" FORMULA_INV "1.0*X" /end COMPU_METHOD
/begin COMPU_METHOD defaultConversion245 "" FORM "%8.4" "[]" FORMULA "1.0*X" FORMULA_INV "1.0*X" /end COMPU_METHOD
/begin COMPU_METHOD defaultConversion246 "" FORM "%8.4" "[]" FORMULA "1.0*X" FORMULA_INV "1.0*X" /end COMPU_METHOD
/begin COMPU_METHOD defaultConversion247 "" FORM "%8.4" "[]" FORMULA "1.0*X" FORMULA_INV "1.0*X" /end COMPU_METHOD
/begin COMPU_METHOD defaultConversion248 "" FORM "%8.4" "[]" FORMULA "1.0*X" FORMULA_INV "1.0*X" /end COMPU_METHOD
/begin COMPU_METHOD defaultConversion249 "" FORM "%8.4" "[]" FORMULA "1.0*X" FORMULA_INV "1.0*X" /end COMPU_METHOD
/begin COMPU_METHOD defaultConversion250 "" FORM "%8.4" "[]" FORMULA "1.0*X" FORMULA_INV "1.0*X" /end COMPU_METHOD
/begin COMPU_METHOD defaultConversion251 "" FORM "%8.4" "[]" FORMULA "1.0*X" FORMULA_INV "1.0*X" /end COMPU_METHOD
/begin COMPU_METHOD defaultConversion252 "" FORM "%8.4" "[]" FORMULA "1.0*X" FORMULA_INV "1.0*X" /end COMPU_METHOD
/begin COMPU_METHOD defaultConversion253 "" FORM "%8.4" "[]" FORMULA "1.0*X" FORMULA_INV "1.0*X" /end COMPU_METHOD
/begin COMPU_METHOD defaultConversion254 "" FORM "%8.4" "[]" FORMULA "1.0*X" FORMULA_INV "1.0*X" /end COMPU_METHOD
/begin COMPU_METHOD defaultConversion255 "" FORM "%8.4" "[]" FORMULA "1.0*X" FORMULA_INV "1.0*X" /end COMPU_METHOD
/begin COMPU_METHOD defaultConversion256 "" FORM "%8.4" "[]" FORMULA "1.0*X" FORMULA_INV "1.0*X" /end COMPU_METHOD
/begin COMPU_METHOD defaultConversion257 "" FORM "%8.4" "[]" FORMULA "1.0*X" FORMULA_INV "1.0*X" /end COMPU_METHOD
/begin COMPU_METHOD defaultConversion258 "" FORM "%8.4" "[]" FORMULA "1.0*X" FORMULA_INV "1.0*X" /end COMPU_METHOD
/begin COMPU_METHOD defaultConversion259 "" FORM "%8.4" "[]" FORMULA "1.0*X" FORMULA_INV "1.0*X" /end COMPU_METHOD
/begin COMPU_METHOD defaultConversion260 "" FORM "%8.4" "[]" FORMULA "1.0*X" FORMULA_INV "1.0*X" /end COMPU_METHOD
/begin COMPU_METHOD defaultConversion261 "" FORM "%8.4" "[]" FORMULA "1.0*X" FORMULA_INV "1.0*X" /end COMPU_METHOD
/begin COMPU_METHOD defaultConversion262 "" FORM "%8.4" "[]" FORMULA "1.0*X" FORMULA_INV "1.0*X" /end COMPU_METHOD
/begin COMPU_METHOD defaultConversion263 "" FORM "%8.4" "[]" FORMULA "1.0*X" FORMULA_INV "1.0*X" /end COMPU_METHOD
/begin COMPU_METHOD defaultConversion264 "" FORM "%8.4" "[]" FORMULA "1.0*X" FORMULA_INV "1.0*X" /end COMPU_METHOD
/begin COMPU_METHOD defaultConversion265 "" FORM "%8.4" "[]" FORMULA "1.0*X" FORMULA_INV "1.0*X" /end COMPU_METHOD
/begin COMPU_METHOD defaultConversion266 "" FORM "%8.4" "[]" FORMULA "1.0*X" FORMULA_INV "1.0*X" /end COMPU_METHOD
/begin COMPU_METHOD defaultConversion267 "" FORM "%8.4" "[]" FORMULA "1.0*X" FORMULA_INV "1.0*X" /end COMPU_METHOD
/begin COMPU_METHOD defaultConversion268 "" FORM "%8.4" "[]" FORMULA "1.0*X" FORMULA_INV "1.0*X" /end COMPU_METHOD
/begin COMPU_METHOD defaultConversion269 "" FORM "%8.4" "[]" FORMULA "1.0*X" FORMULA_INV "1.0*X" /end COMPU_METHOD
/begin COMPU_METHOD defaultConversion270 "" FORM "%8.4" "[]" FORMULA "1.0*X" FORMULA_INV "1.0*X" /end COMPU_METHOD
/begin COMPU_METHOD defaultConversion271 "" FORM "%8.4" "[]" FORMULA "1.0*X" FORMULA_INV "1.0*X" /end COMPU_METHOD
/begin COMPU_METHOD defaultConversion272 "" FORM "%8.4" "[]" FORMULA "1.0*X" FORMULA_INV "1.0*X" /end COMPU_METHOD
/begin COMPU_METHOD defaultConversion273 "" FORM "%8.4" "[]" FORMULA "1.0*X" FORMULA_INV "1.0*X" /end COMPU_METHOD
/begin COMPU_METHOD defaultConversion274 "" FORM "%8.4" "[]" FORMULA "1.0*X" FORMULA_INV "1.0*X" /end COMPU_METHOD
/begin COMPU_METHOD defaultConversion275 "" FORM "%8.4" "[]" FORMULA "1.0*X" FORMULA_INV "1.0*X" /end COMPU_METHOD
/begin COMPU_METHOD defaultConversion276 "" FORM "%8.4" "[]" FORMULA "1.0*X" FORMULA_INV "1.0*X" /end COMPU_METHOD
/begin COMPU_METHOD defaultConversion277 "" FORM "%8.4" "[]" FORMULA "1.0*X" FORMULA_INV "1.0*X" /end COMPU_METHOD
/begin COMPU_METHOD defaultConversion278 "" FORM "%8.4" "[]" FORMULA "1.0*X" FORMULA_INV "1.0*X" /end COMPU_METHOD
/begin COMPU_METHOD defaultConversion279 "" FORM "%8.4" "[]" FORMULA "1.0*X" FORMULA_INV "1.0*X" /end COMPU_METHOD
/begin COMPU_METHOD defaultConversion280 "" FORM "%8.4" "[]" FORMULA "1.0*X" FORMULA_INV "1.0*X" /end COMPU_METHOD
/begin COMPU_METHOD defaultConversion281 "" FORM "%8.4" "[]" FORMULA "1.0*X" FORMULA_INV "1.0*X" /end COMPU_METHOD
/begin COMPU_METHOD defaultConversion282 "" FORM "%8.4" "[]" FORMULA "1.0*X" FORMULA_INV "1.0*X" /end COMPU_METHOD
/begin COMPU_METHOD defaultConversion283 "" FORM "%8.4" "[]" FORMULA "1.0*X" FORMULA_INV "1.0*X" /end COMPU_METHOD
/begin COMPU_METHOD defaultConversion284 "" FORM "%8.4" "[]" FORMULA "1.0*X" FORMULA_INV "1.0*X" /end COMPU_METHOD
/begin COMPU_METHOD defaultConversion285 "" FORM "%8.4" "[]" FORMULA "1.0*X" FORMULA_INV "1.0*X" /end COMPU_METHOD
/begin COMPU_METHOD defaultConversion286 "" FORM "%8.4" "[]" FORMULA "1.0*X" FORMULA_INV "1.0*X" /end COMPU_METHOD
/begin COMPU_METHOD defaultConversion287 "" FORM "%8.4" "[]" FORMULA "1.0*X" FORMULA_INV "1.0*X" /end COMPU_METHOD
/begin COMPU_METHOD defaultConversion288 "" FORM "%8.4" "[]" FORMULA "1.0*X" FORMULA_INV "1.0*X" /end COMPU_METHOD
/begin COMPU_METHOD defaultConversion289 "" FORM "%8.4" "[]" FORMULA "1.0*X" FORMULA_INV "1.0*X" /end COMPU_METHOD
/begin COMPU_METHOD defaultConversion290 "" FORM "%8.4" "[]" FORMULA "1.0*X" FORMULA_INV "1.0*X" /end COMPU_METHOD
/begin COMPU_METHOD defaultConversion291 "" FORM "%8.4" "[]" FORMULA "1.0*X" FORMULA_INV "1.0*X" /end COMPU_METHOD
/begin COMPU_METHOD defaultConversion292 "" FORM "%8.4" "[]" FORMULA "1.0*X" FORMULA_INV "1.0*X" /end COMPU_METHOD
/begin COMPU_METHOD defaultConversion293 "" FORM "%8.4" "[]" FORMULA "1.0*X" FORMULA_INV "1.0*X" /end COMPU_METHOD
/begin COMPU_METHOD defaultConversion294 "" FORM "%8.4" "[]" FORMULA "1.0*X" FORMULA_INV "1.0*X" /end COMPU_METHOD
/begin COMPU_METHOD defaultConversion295 "" FORM "%8.4" "[]" FORMULA "1.0*X" FORMULA_INV "1.0*X" /end COMPU_METHOD
/begin COMPU_METHOD defaultConversion296 "" FORM "%8.4" "[]" FORMULA "1.0*X" FORMULA_INV "1.0*X" /end COMPU_METHOD
/begin COMPU_METHOD defaultConversion297 "" FORM "%8.4" "[]" FORMULA "1.0*X" FORMULA_INV "1.0*X" /end COMPU_METHOD
/begin COMPU_METHOD defaultConversion298 "" FORM "%8.4" "[]" FORMULA "1.0*X" FORMULA_INV "1.0*X" /end COMPU_METHOD
/begin COMPU_METHOD defaultConversion299 "" FORM "%8.4" "[]" FORMULA "1.0*X" FORMULA_INV "1.0*X" /end COMPU_METHOD
/begin COMPU_METHOD defaultConversion300 "" FORM "%8.4" "[]" FORMULA "1.0*X" FORMULA_INV "1.0*X" /end COMPU_METHOD
/begin COMPU_METHOD defaultConversion301 "" FORM "%8.4" "[]" FORMULA "1.0*X" FORMULA_INV "1.0*X" /end COMPU_METHOD
/begin COMPU_METHOD defaultConversion302 "" FORM "%8.4" "[]" FORMULA "1.0*X" FORMULA_INV "1.0*X" /end COMPU_METHOD
/begin COMPU_METHOD defaultConversion303 "" FORM "%8.4" "[]" FORMULA "1.0*X" FORMULA_INV "1.0*X" /end COMPU_METHOD
/begin COMPU_METHOD defaultConversion304 "" FORM "%8.4" "[]" FORMULA "1.0*X" FORMULA_INV "1.0*X" /end COMPU_METHOD
/begin COMPU_METHOD defaultConversion305 "" FORM "%8.4" "[]" FORMULA "1.0*X" FORMULA_INV "1.0*X" /end COMPU_METHOD
/begin COMPU_METHOD defaultConversion306 "" FORM "%8.4" "[]" FORMULA "1.0*X" FORMULA_INV "1.0*X" /end COMPU_METHOD
/begin COMPU_METHOD defaultConversion307 "" FORM "%8.4" "[]" FORMULA "1.0*X" FORMULA_INV "1.0*X" /end COMPU_METHOD
/begin COMPU_METHOD defaultConversion308 "" FORM "%8.4" "[]" FORMULA "1.0*X" FORMULA_INV "1.0*X" /end COMPU_METHOD
/begin COMPU_METHOD defaultConversion309 "" FORM "%8.4" "[]" FORMULA "1.0*X" FORMULA_INV "1.0*X" /end COMPU_METHOD
/begin COMPU_METHOD defaultConversion310 "" FORM "%8.4" "[]" FORMULA "1.0*X" FORMULA_INV "1.0*X" /end COMPU_METHOD
/begin COMPU_METHOD defaultConversion311 "" FORM "%8.4" "[]" FORMULA "1.0*X" FORMULA_INV "1.0*X" /end COMPU_METHOD
/begin COMPU_METHOD defaultConversion312 "" FORM "%8.4" "[]" FORMULA "1.0*X" FORMULA_INV "1.0*X" /end COMPU_METHOD
/begin COMPU_METHOD defaultConversion313 "" FORM "%8.4" "[]" FORMULA "1.0*X" FORMULA_INV "1.0*X" /end COMPU_METHOD
/begin COMPU_METHOD defaultConversion314 "" FORM "%8.4" "[]" FORMULA "1.0*X" FORMULA_INV "1.0*X" /end COMPU_METHOD
/begin COMPU_METHOD defaultConversion315 "" FORM "%8.4" "[]" FORMULA "1.0*X" FORMULA_INV "1.0*X" /end COMPU_METHOD
/begin COMPU_METHOD defaultConversion316 "" FORM "%8.4" "[]" FORMULA "1.0*X" FORMULA_INV "1.0*X" /end COMPU_METHOD
/begin COMPU_METHOD defaultConversion317 "" FORM "%8.4" "[]" FORMULA "1.0*X" FORMULA_INV "1.0*X" /end COMPU_METHOD
/begin COMPU_METHOD defaultConversion318 "" FORM "%8.4" "[]" FORMULA "1.0*X" FORMULA_INV "1.0*X" /end COMPU_METHOD
/begin COMPU_METHOD defaultConversion319 "" FORM "%8.4" "[]" FORMULA "1.0*X" FORMULA_INV "1.0*X" /end COMPU_METHOD
/begin COMPU_METHOD defaultConversion320 "" FORM "%8.4" "[]" FORMULA "1.0*X" FORMULA_INV "1.0*X" /end COMPU_METHOD
/begin COMPU_METHOD defaultConversion321 "" FORM "%8.4" "[]" FORMULA "1.0*X" FORMULA_INV "1.0*X" /end COMPU_METHOD
/begin COMPU_METHOD defaultConversion322 "" FORM "%8.4" "[]" FORMULA "1.0*X" FORMULA_INV "1.0*X" /end COMPU_METHOD
/begin COMPU_METHOD defaultConversion323 "" FORM "%8.4" "[]" FORMULA "1.0*X" FORMULA_INV "1.0*X" /end COMPU_METHOD
/begin COMPU_METHOD defaultConversion324 "" FORM "%8.4" "[]" FORMULA "1.0*X" FORMULA_INV "1.0*X" /end COMPU_METHOD
/begin COMPU_METHOD defaultConversion325 "" FORM "%8.4" "[]" FORMULA "1.0*X" FORMULA_INV "1.0*X" /end COMPU_METHOD
/begin COMPU_METHOD defaultConversion326 "" FORM "%8.4" "[]" FORMULA "1.0*X" FORMULA_INV "1.0*X" /end COMPU_METHOD
/begin COMPU_METHOD defaultConversion327 "" FORM "%8.4" "[]" FORMULA "1.0*X" FORMULA_INV "1.0*X" /end COMPU_METHOD
/begin COMPU_METHOD defaultConversion328 "" FORM "%8.4" "[]" FORMULA "1.0*X" FORMULA_INV "1.0*X" /end COMPU_METHOD
/begin COMPU_METHOD defaultConversion329 "" FORM "%8.4" "[]" FORMULA "1.0*X" FORMULA_INV "1.0*X" /end COMPU_METHOD
/begin COMPU_METHOD defaultConversion330 "" FORM "%8.4" "[]" FORMULA "1.0*X" FORMULA_INV "1.0*X" /end COMPU_METHOD
/begin COMPU_METHOD defaultConversion331 "" FORM "%8.4" "[]" FORMULA "1.0*X" FORMULA_INV "1.0*X" /end COMPU_METHOD
/begin COMPU_METHOD defaultConversion332 "" FORM "%8.4" "[]" FORMULA "1.0*X" FORMULA_INV "1.0*X" /end COMPU_METHOD
/begin COMPU_METHOD defaultConversion333 "" FORM "%8.4" "[]" FORMULA "1.0*X" FORMULA_INV "1.0*X" /end COMPU_METHOD
/begin COMPU_METHOD defaultConversion334 "" FORM "%8.4" "[]" FORMULA "1.0*X" FORMULA_INV "1.0*X" /end COMPU_METHOD
/begin COMPU_METHOD defaultConversion335 "" FORM "%8.4" "[]" FORMULA "1.0*X" FORMULA_INV "1.0*X" /end COMPU_METHOD
/begin COMPU_METHOD defaultConversion336 "" FORM "%8.4" "[]" FORMULA "1.0*X" FORMULA_INV "1.0*X" /end COMPU_METHOD
/begin COMPU_METHOD defaultConversion337 "" FORM "%8.4" "[]" FORMULA "1.0*X" FORMULA_INV "1.0*X" /end COMPU_METHOD
/begin COMPU_METHOD defaultConversion338 "" FORM "%8.4" "[]" FORMULA "1.0*X" FORMULA_INV "1.0*X" /end COMPU_METHOD
/begin COMPU_METHOD defaultConversion339 "" FORM "%8.4" "[]" FORMULA "1.0*X" FORMULA_INV "1.0*X" /end COMPU_METHOD
/begin COMPU_METHOD defaultConversion340 "" FORM "%8.4" "[]" FORMULA "1.0*X" FORMULA_INV "1.0*X" /end COMPU_METHOD
/begin COMPU_METHOD defaultConversion341 "" FORM "%8.4" "[]" FORMULA "1.0*X" FORMULA_INV "1.0*X" /end COMPU_METHOD
/begin COMPU_METHOD defaultConversion342 "" FORM "%8.4" "[]" FORMULA "1.0*X" FORMULA_INV "1.0*X" /end COMPU_METHOD
/begin COMPU_METHOD defaultConversion343 "" FORM "%8.4" "[]" FORMULA "1.0*X" FORMULA_INV "1.0*X" /end COMPU_METHOD
/begin COMPU_METHOD defaultConversion344 "" FORM "%8.4" "[]" FORMULA "1.0*X" FORMULA_INV "1.0*X" /end COMPU_METHOD
/begin COMPU_METHOD defaultConversion345 "" FORM "%8.4" "[]" FORMULA "1.0*X" FORMULA_INV "1.0*X" /end COMPU_METHOD
/begin COMPU_METHOD defaultConversion346 "" FORM "%8.4" "[]" FORMULA "1.0*X" FORMULA_INV "1.0*X" /end COMPU_METHOD
/begin COMPU_METHOD defaultConversion347 "" FORM "%8.4" "[]" FORMULA "1.0*X" FORMULA_INV "1.0*X" /end COMPU_METHOD
/begin COMPU_METHOD defaultConversion348 "" FORM "%8.4" "[]" FORMULA "1.0*X" FORMULA_INV "1.0*X" /end COMPU_METHOD
/begin COMPU_METHOD defaultConversion349 "" FORM "%8.4" "[]" FORMULA "1.0*X" FORMULA_INV "1.0*X" /end COMPU_METHOD
/begin COMPU_METHOD defaultConversion350 "" FORM "%8.4" "[]" FORMULA "1.0*X" FORMULA_INV "1.0*X" /end COMPU_METHOD
/begin COMPU_METHOD defaultConversion351 "" FORM "%8.4" "[]" FORMULA "1.0*X" FORMULA_INV "1.0*X" /end COMPU_METHOD
/begin COMPU_METHOD defaultConversion352 "" FORM "%8.4" "[]" FORMULA "1.0*X" FORMULA_INV "1.0*X" /end COMPU_METHOD
/begin COMPU_METHOD defaultConversion353 "" FORM "%8.4" "[]" FORMULA "1.0*X" FORMULA_INV "1.0*X" /end COMPU_METHOD
/begin COMPU_METHOD defaultConversion354 "" FORM "%8.4" "[]" FORMULA "1.0*X" FORMULA_INV "1.0*X" /end COMPU_METHOD
/begin COMPU_METHOD defaultConversion355 "" FORM "%8.4" "[]" FORMULA "1.0*X" FORMULA_INV "1.0*X" /end COMPU_METHOD
/begin COMPU_METHOD defaultConversion356 "" FORM "%8.4" "[]" FORMULA "1.0*X" FORMULA_INV "1.0*X" /end COMPU_METHOD
/begin COMPU_METHOD defaultConversion357 "" FORM "%8.4" "[]" FORMULA "1.0*X" FORMULA_INV "1.0*X" /end COMPU_METHOD
/begin COMPU_METHOD defaultConversion358 "" FORM "%8.4" "[]" FORMULA "1.0*X" FORMULA_INV "1.0*X" /end COMPU_METHOD
/begin COMPU_METHOD defaultConversion359 "" FORM "%8.4" "[]" FORMULA "1.0*X" FORMULA_INV "1.0*X" /end COMPU_METHOD
/begin COMPU_METHOD defaultConversion360 "" FORM "%8.4" "[]" FORMULA "1.0*X" FORMULA_INV "1.0*X" /end COMPU_METHOD
/begin COMPU_METHOD defaultConversion361 "" FORM "%8.4" "[]" FORMULA "1.0*X" FORMULA_INV "1.0*X" /end COMPU_METHOD
/begin COMPU_METHOD defaultConversion362 "" FORM "%8.4" "[]" FORMULA "1.0*X" FORMULA_INV "1.0*X" /end COMPU_METHOD
/begin COMPU_METHOD defaultConversion363 "" FORM "%8.4" "[]" FORMULA "1.0*X" FORMULA_INV "1.0*X" /end COMPU_METHOD
/begin COMPU_METHOD defaultConversion364 "" FORM "%8.4" "[]" FORMULA "1.0*X" FORMULA_INV "1.0*X" /end COMPU_METHOD
/begin COMPU_METHOD defaultConversion365 "" FORM "%8.4" "[]" FORMULA "1.0*X" FORMULA_INV "1.0*X" /end COMPU_METHOD
/begin COMPU_METHOD defaultConversion366 "" FORM "%8.4" "[]" FORMULA "1.0*X" FORMULA_INV "1.0*X" /end COMPU_METHOD
/begin COMPU_METHOD defaultConversion367 "" FORM "%8.4" "[]" FORMULA "1.0*X" FORMULA_INV "1.0*X" /end COMPU_METHOD
/begin COMPU_METHOD defaultConversion368 "" FORM "%8.4" "[]" FORMULA "1.0*X" FORMULA_INV "1.0*X" /end COMPU_METHOD
/begin COMPU_METHOD defaultConversion369 "" FORM "%8.4" "[]" FORMULA "1.0*X" FORMULA_INV "1.0*X" /end COMPU_METHOD
/begin COMPU_METHOD defaultConversion370 "" FORM "%8.4" "[]" FORMULA "1.0*X" FORMULA_INV "1.0*X" /end COMPU_METHOD
/begin COMPU_METHOD defaultConversion371 "" FORM "%8.4" "[]" FORMULA "1.0*X" FORMULA_INV "1.0*X" /end COMPU_METHOD
/begin COMPU_METHOD defaultConversion372 "" FORM "%8.4" "[]" FORMULA "1.0*X" FORMULA_INV "1.0*X" /end COMPU_METHOD
/begin COMPU_METHOD defaultConversion373 "" FORM "%8.4" "[]" FORMULA "1.0*X" FORMULA_INV "1.0*X" /end COMPU_METHOD
/begin COMPU_METHOD defaultConversion374 "" FORM "%8.4" "[]" FORMULA "1.0*X" FORMULA_INV "1.0*X" /end COMPU_METHOD
/begin COMPU_METHOD defaultConversion375 "" FORM "%8.4" "[]" FORMULA "1.0*X" FORMULA_INV "1.0*X" /end COMPU_METHOD
/begin COMPU_METHOD defaultConversion376 "" FORM "%8.4" "[]" FORMULA "1.0*X" FORMULA_INV "1.0*X" /end COMPU_METHOD
/begin COMPU_METHOD defaultConversion377 "" FORM "%8.4" "[]" FORMULA "1.0*X" FORMULA_INV "1.0*X" /end COMPU_METHOD
/begin COMPU_METHOD defaultConversion378 "" FORM "%8.4" "[]" FORMULA "1.0*X" FORMULA_INV "1.0*X" /end COMPU_METHOD
/begin COMPU_METHOD defaultConversion379 "" FORM "%8.4" "[]" FORMULA "1.0*X" FORMULA_INV "1.0*X" /end COMPU_METHOD
/begin COMPU_METHOD defaultConversion380 "" FORM "%8.4" "[]" FORMULA "1.0*X" FORMULA_INV "1.0*X" /end COMPU_METHOD
/begin COMPU_METHOD defaultConversion381 "" FORM "%8.4" "[]" FORMULA "1.0*X" FORMULA_INV "1.0*X" /end COMPU_METHOD
/begin COMPU_METHOD defaultConversion382 "" FORM "%8.4" "[]" FORMULA "1.0*X" FORMULA_INV "1.0*X" /end COMPU_METHOD
/begin COMPU_METHOD defaultConversion383 "" FORM "%8.4" "[]" FORMULA "1.0*X" FORMULA_INV "1.0*X" /end COMPU_METHOD
/begin COMPU_METHOD defaultConversion384 "" FORM "%8.4" "[]" FORMULA "1.0*X" FORMULA_INV "1.0*X" /end COMPU_METHOD
/begin COMPU_METHOD defaultConversion385 "" FORM "%8.4" "[]" FORMULA "1.0*X" FORMULA_INV "1.0*X" /end COMPU_METHOD
/begin COMPU_METHOD defaultConversion386 "" FORM "%8.4" "[]" FORMULA "1.0*X" FORMULA_INV "1.0*X" /end COMPU_METHOD
/begin COMPU_METHOD defaultConversion387 "" FORM "%8.4" "[]" FORMULA "1.0*X" FORMULA_INV "1.0*X" /end COMPU_METHOD
/begin COMPU_METHOD defaultConversion388 "" FORM "%8.4" "[]" FORMULA "1.0*X" FORMULA_INV "1.0*X" /end COMPU_METHOD
/begin COMPU_METHOD defaultConversion389 "" FORM "%8.4" "[]" FORMULA "1.0*X" FORMULA_INV "1.0*X" /end COMPU_METHOD
/begin COMPU_METHOD defaultConversion390 "" FORM "%8.4" "[]" FORMULA "1.0*X" FORMULA_INV "1.0*X" /end COMPU_METHOD
/begin COMPU_METHOD defaultConversion391 "" FORM "%8.4" "[]" FORMULA "1.0*X" FORMULA_INV "1.0*X" /end COMPU_METHOD
/begin COMPU_METHOD defaultConversion392 "" FORM "%8.4" "[]" FORMULA "1.0*X" FORMULA_INV "1.0*X" /end COMPU_METHOD
/begin COMPU_METHOD defaultConversion393 "" FORM "%8.4" "[]" FORMULA "1.0*X" FORMULA_INV "1.0*X" /end COMPU_METHOD
/begin COMPU_METHOD defaultConversion394 "" FORM "%8.4" "[]" FORMULA "1.0*X" FORMULA_INV "1.0*X" /end COMPU_METHOD
/begin COMPU_METHOD defaultConversion395 "" FORM "%8.4" "[]" FORMULA "1.0*X" FORMULA_INV "1.0*X" /end COMPU_METHOD
/begin COMPU_METHOD defaultConversion396 "" FORM "%8.4" "[]" FORMULA "1.0*X" FORMULA_INV "1.0*X" /end COMPU_METHOD
/begin COMPU_METHOD defaultConversion397 "" FORM "%8.4" "[]" FORMULA "1.0*X" FORMULA_INV "1.0*X" /end COMPU_METHOD
/begin COMPU_METHOD defaultConversion398 "" FORM "%8.4" "[]" FORMULA "1.0*X" FORMULA_INV "1.0*X" /end COMPU_METHOD
/begin COMPU_METHOD defaultConversion399 "" FORM "%8.4" "[]" FORMULA "1.0*X" FORMULA_INV "1.0*X" /end COMPU_METHOD
/begin COMPU_METHOD defaultConversion400 "" FORM "%8.4" "[]" FORMULA "1.0*X" FORMULA_INV "1.0*X" /end COMPU_METHOD
/begin COMPU_METHOD defaultConversion401 "" FORM "%8.4" "[]" FORMULA "1.0*X" FORMULA_INV "1.0*X" /end COMPU_METHOD
/begin COMPU_METHOD defaultConversion402 "" FORM "%8.4" "[]" FORMULA "1.0*X" FORMULA_INV "1.0*X" /end COMPU_METHOD
/begin COMPU_METHOD defaultConversion403 "" FORM "%8.4" "[]" FORMULA "1.0*X" FORMULA_INV "1.0*X" /end COMPU_METHOD
/begin COMPU_METHOD defaultConversion404 "" FORM "%8.4" "[]" FORMULA "1.0*X" FORMULA_INV "1.0*X" /end COMPU_METHOD
/begin COMPU_METHOD defaultConversion405 "" FORM "%8.4" "[]" FORMULA "1.0*X" FORMULA_INV "1.0*X" /end COMPU_METHOD
/begin COMPU_METHOD defaultConversion406 "" FORM "%8.4" "[]" FORMULA "1.0*X" FORMULA_INV "1.0*X" /end COMPU_METHOD
/begin COMPU_METHOD defaultConversion407 "" FORM "%8.4" "[]" FORMULA "1.0*X" FORMULA_INV "1.0*X" /end COMPU_METHOD
/begin COMPU_METHOD defaultConversion408 "" FORM "%8.4" "[]" FORMULA "1.0*X" FORMULA_INV "1.0*X" /end COMPU_METHOD
/begin COMPU_METHOD defaultConversion409 "" FORM "%8.4" "[]" FORMULA "1.0*X" FORMULA_INV "1.0*X" /end COMPU_METHOD
/begin COMPU_METHOD defaultConversion410 "" FORM "%8.4" "[]" FORMULA "1.0*X" FORMULA_INV "1.0*X" /end COMPU_METHOD
/begin COMPU_METHOD defaultConversion411 "" FORM "%8.4" "[]" FORMULA "1.0*X" FORMULA_INV "1.0*X" /end COMPU_METHOD
/begin COMPU_METHOD defaultConversion412 "" FORM "%8.4" "[]" FORMULA "1.0*X" FORMULA_INV "1.0*X" /end COMPU_METHOD
/begin COMPU_METHOD defaultConversion413 "" FORM "%8.4" "[]" FORMULA "1.0*X" FORMULA_INV "1.0*X" /end COMPU_METHOD
/begin COMPU_METHOD defaultConversion414 "" FORM "%8.4" "[]" FORMULA "1.0*X" FORMULA_INV "1.0*X" /end COMPU_METHOD
/begin COMPU_METHOD defaultConversion415 "" FORM "%8.4" "[]" FORMULA "1.0*X" FORMULA_INV "1.0*X" /end COMPU_METHOD
/begin COMPU_METHOD defaultConversion416 "" FORM "%8.4" "[]" FORMULA "1.0*X" FORMULA_INV "1.0*X" /end COMPU_METHOD
/begin COMPU_METHOD defaultConversion417 "" FORM "%8.4" "[]" FORMULA "1.0*X" FORMULA_INV "1.0*X" /end COMPU_METHOD
/begin COMPU_METHOD defaultConversion418 "" FORM "%8.4" "[]" FORMULA "1.0*X" FORMULA_INV "1.0*X" /end COMPU_METHOD
/begin COMPU_METHOD defaultConversion419 "" FORM "%8.4" "[]" FORMULA "1.0*X" FORMULA_INV "1.0*X" /end COMPU_METHOD
/begin COMPU_METHOD defaultConversion420 "" FORM "%8.4" "[]" FORMULA "1.0*X" FORMULA_INV "1.0*X" /end COMPU_METHOD
/begin COMPU_METHOD defaultConversion421 "" FORM "%8.4" "[]" FORMULA "1.0*X" FORMULA_INV "1.0*X" /end COMPU_METHOD
/begin COMPU_METHOD defaultConversion422 "" FORM "%8.4" "[]" FORMULA "1.0*X" FORMULA_INV "1.0*X" /end COMPU_METHOD
/begin COMPU_METHOD defaultConversion423 "" FORM "%8.4" "[]" FORMULA "1.0*X" FORMULA_INV "1.0*X" /end COMPU_METHOD
/begin COMPU_METHOD defaultConversion424 "" FORM "%8.4" "[]" FORMULA "1.0*X" FORMULA_INV "1.0*X" /end COMPU_METHOD
/begin COMPU_METHOD defaultConversion425 "" FORM "%8.4" "[]" FORMULA "1.0*X" FORMULA_INV "1.0*X" /end COMPU_METHOD
/begin COMPU_METHOD defaultConversion426 "" FORM "%8.4" "[]" FORMULA "1.0*X" FORMULA_INV "1.0*X" /end COMPU_METHOD
/begin COMPU_METHOD defaultConversion427 "" FORM "%8.4" "[]" FORMULA "1.0*X" FORMULA_INV "1.0*X" /end COMPU_METHOD
/begin COMPU_METHOD defaultConversion428 "" FORM "%8.4" "[]" FORMULA "1.0*X" FORMULA_INV "1.0*X" /end COMPU_METHOD
/begin COMPU_METHOD defaultConversion429 "" FORM "%8.4" "[]" FORMULA "1.0*X" FORMULA_INV "1.0*X" /end COMPU_METHOD
/begin COMPU_METHOD defaultConversion430 "" FORM "%8.4" "[]" FORMULA "1.0*X" FORMULA_INV "1.0*X" /end COMPU_METHOD
/begin COMPU_METHOD defaultConversion431 "" FORM "%8.4" "[]" FORMULA "1.0*X" FORMULA_INV "1.0*X" /end COMPU_METHOD
/begin COMPU_METHOD defaultConversion432 "" FORM "%8.4" "[]" FORMULA "1.0*X" FORMULA_INV "1.0*X" /end COMPU_METHOD
/begin COMPU_METHOD defaultConversion433 "" FORM "%8.4" "[]" FORMULA "1.0*X" FORMULA_INV "1.0*X" /end COMPU_METHOD
/begin COMPU_METHOD defaultConversion434 "" FORM "%8.4" "[]" FORMULA "1.0*X" FORMULA_INV "1.0*X" /end COMPU_METHOD
/begin COMPU_METHOD defaultConversion435 "" FORM "%8.4" "[]" FORMULA "1.0*X" FORMULA_INV "1.0*X" /end COMPU_METHOD
/begin COMPU_METHOD defaultConversion436 "" FORM "%8.4" "[]" FORMULA "1.0*X" FORMULA_INV "1.0*X" /end COMPU_METHOD
/begin COMPU_METHOD defaultConversion437 "" FORM "%8.4" "[]" FORMULA "1.0*X" FORMULA_INV "1.0*X" /end COMPU_METHOD
/begin COMPU_METHOD defaultConversion438 "" FORM "%8.4" "[]" FORMULA "1.0*X" FORMULA_INV "1.0*X" /end COMPU_METHOD
/begin COMPU_METHOD defaultConversion439 "" FORM "%8.4" "[]" FORMULA "1.0*X" FORMULA_INV "1.0*X" /end COMPU_METHOD
/begin COMPU_METHOD defaultConversion440 "" FORM "%8.4" "[]" FORMULA "1.0*X" FORMULA_INV "1.0*X" /end COMPU_METHOD
/begin COMPU_METHOD defaultConversion441 "" FORM "%8.4" "[]" FORMULA "1.0*X" FORMULA_INV "1.0*X" /end COMPU_METHOD
/begin COMPU_METHOD defaultConversion442 "" FORM "%8.4" "[]" FORMULA "1.0*X" FORMULA_INV "1.0*X" /end COMPU_METHOD
/begin COMPU_METHOD defaultConversion443 "" FORM "%8.4" "[]" FORMULA "1.0*X" FORMULA_INV "1.0*X" /end COMPU_METHOD
/begin COMPU_METHOD defaultConversion444 "" FORM "%8.4" "[]" FORMULA "1.0*X" FORMULA_INV "1.0*X" /end COMPU_METHOD
/begin COMPU_METHOD defaultConversion445 "" FORM "%8.4" "[]" FORMULA "1.0*X" FORMULA_INV "1.0*X" /end COMPU_METHOD
/begin COMPU_METHOD defaultConversion446 "" FORM "%8.4" "[]" FORMULA "1.0*X" FORMULA_INV "1.0*X" /end COMPU_METHOD
/begin COMPU_METHOD defaultConversion447 "" FORM "%8.4" "[]" FORMULA "1.0*X" FORMULA_INV "1.0*X" /end COMPU_METHOD
/begin COMPU_METHOD defaultConversion448 "" FORM "%8.4" "[]" FORMULA "1.0*X" FORMULA_INV "1.0*X" /end COMPU_METHOD
/begin COMPU_METHOD defaultConversion449 "" FORM "%8.4" "[]" FORMULA "1.0*X" FORMULA_INV "1.0*X" /end COMPU_METHOD
/begin COMPU_METHOD defaultConversion450 "" FORM "%8.4" "[]" FORMULA "1.0*X" FORMULA_INV "1.0*X" /end COMPU_METHOD
/begin COMPU_METHOD defaultConversion451 "" FORM "%8.4" "[]" FORMULA "1.0*X" FORMULA_INV "1.0*X" /end COMPU_METHOD
/begin COMPU_METHOD defaultConversion452 "" FORM "%8.4" "[]" FORMULA "1.0*X" FORMULA_INV "1.0*X" /end COMPU_METHOD
/begin COMPU_METHOD defaultConversion453 "" FORM "%8.4" "[]" FORMULA "1.0*X" FORMULA_INV "1.0*X" /end COMPU_METHOD
/begin COMPU_METHOD defaultConversion454 "" FORM "%8.4" "[]" FORMULA "1.0*X" FORMULA_INV "1.0*X" /end COMPU_METHOD
/begin COMPU_METHOD defaultConversion455 "" FORM "%8.4" "[]" FORMULA "1.0*X" FORMULA_INV "1.0*X" /end COMPU_METHOD
/begin COMPU_METHOD defaultConversion456 "" FORM "%8.4" "[]" FORMULA "1.0*X" FORMULA_INV "1.0*X" /end COMPU_METHOD
/begin COMPU_METHOD defaultConversion457 "" FORM "%8.4" "[]" FORMULA "1.0*X" FORMULA_INV "1.0*X" /end COMPU_METHOD
/begin COMPU_METHOD defaultConversion458 "" FORM "%8.4" "[]" FORMULA "1.0*X" FORMULA_INV "1.0*X" /end COMPU_METHOD
/begin COMPU_METHOD defaultConversion459 "" FORM "%8.4" "[]" FORMULA "1.0*X" FORMULA_INV "1.0*X" /end COMPU_METHOD
/begin COMPU_METHOD defaultConversion460 "" FORM "%8.4" "[]" FORMULA "1.0*X" FORMULA_INV "1.0*X" /end COMPU_METHOD
/begin COMPU_METHOD defaultConversion461 "" FORM "%8.4" "[]" FORMULA "1.0*X" FORMULA_INV "1.0*X" /end COMPU_METHOD
/begin COMPU_METHOD defaultConversion462 "" FORM "%8.4" "[]" FORMULA "1.0*X" FORMULA_INV "1.0*X" /end COMPU_METHOD
/begin COMPU_METHOD defaultConversion463 "" FORM "%8.4" "[]" FORMULA "1.0*X" FORMULA_INV "1.0*X" /end COMPU_METHOD
/begin COMPU_METHOD defaultConversion464 "" FORM "%8.4" "[]" FORMULA "1.0*X" FORMULA_INV "1.0*X" /end COMPU_METHOD
/begin COMPU_METHOD defaultConversion465 "" FORM "%8.4" "[]" FORMULA "1.0*X" FORMULA_INV "1.0*X" /end COMPU_METHOD
/begin COMPU_METHOD defaultConversion466 "" FORM "%8.4" "[]" FORMULA "1.0*X" FORMULA_INV "1.0*X" /end COMPU_METHOD
/begin COMPU_METHOD defaultConversion467 "" FORM "%8.4" "[]" FORMULA "1.0*X" FORMULA_INV "1.0*X" /end COMPU_METHOD
/begin COMPU_METHOD defaultConversion468 "" FORM "%8.4" "[]" FORMULA "1.0*X" FORMULA_INV "1.0*X" /end COMPU_METHOD
/begin COMPU_METHOD defaultConversion469 "" FORM "%8.4" "[]" FORMULA "1.0*X" FORMULA_INV "1.0*X" /end COMPU_METHOD
/begin COMPU_METHOD defaultConversion470 "" FORM "%8.4" "[]" FORMULA "1.0*X" FORMULA_INV "1.0*X" /end COMPU_METHOD
/begin COMPU_METHOD defaultConversion471 "" FORM "%8.4" "[]" FORMULA "1.0*X" FORMULA_INV "1.0*X" /end COMPU_METHOD
/begin COMPU_METHOD defaultConversion472 "" FORM "%8.4" "[]" FORMULA "1.0*X" FORMULA_INV "1.0*X" /end COMPU_METHOD
/begin COMPU_METHOD defaultConversion473 "" FORM "%8.4" "[]" FORMULA "1.0*X" FORMULA_INV "1.0*X" /end COMPU_METHOD
/begin COMPU_METHOD defaultConversion474 "" FORM "%8.4" "[]" FORMULA "1.0*X" FORMULA_INV "1.0*X" /end COMPU_METHOD
/begin COMPU_METHOD defaultConversion475 "" FORM "%8.4" "[]" FORMULA "1.0*X" FORMULA_INV "1.0*X" /end COMPU_METHOD
/begin COMPU_METHOD defaultConversion476 "" FORM "%8.4" "[]" FORMULA "1.0*X" FORMULA_INV "1.0*X" /end COMPU_METHOD
/begin COMPU_METHOD defaultConversion477 "" FORM "%8.4" "[]" FORMULA "1.0*X" FORMULA_INV "1.0*X" /end COMPU_METHOD
/begin COMPU_METHOD defaultConversion478 "" FORM "%8.4" "[]" FORMULA "1.0*X" FORMULA_INV "1.0*X" /end COMPU_METHOD
/begin COMPU_METHOD defaultConversion479 "" FORM "%8.4" "[]" FORMULA "1.0*X" FORMULA_INV "1.0*X" /end COMPU_METHOD
/begin COMPU_METHOD defaultConversion480 "" FORM "%8.4" "[]" FORMULA "1.0*X" FORMULA_INV "1.0*X" /end COMPU_METHOD
/begin COMPU_METHOD defaultConversion481 "" FORM "%8.4" "[]" FORMULA "1.0*X" FORMULA_INV "1.0*X" /end COMPU_METHOD
/begin COMPU_METHOD defaultConversion482 "" FORM "%8.4" "[]" FORMULA "1.0*X" FORMULA_INV "1.0*X" /end COMPU_METHOD
/begin COMPU_METHOD defaultConversion483 "" FORM "%8.4" "[]" FORMULA "1.0*X" FORMULA_INV "1.0*X" /end COMPU_METHOD
/begin COMPU_METHOD defaultConversion484 "" FORM "%8.4" "[]" FORMULA "1.0*X" FORMULA_INV "1.0*X" /end COMPU_METHOD
/begin COMPU_METHOD defaultConversion485 "" FORM "%8.4" "[]" FORMULA "1.0*X" FORMULA_INV "1.0*X" /end COMPU_METHOD
/begin COMPU_METHOD defaultConversion486 "" FORM "%8.4" "[]" FORMULA "1.0*X" FORMULA_INV "1.0*X" /end COMPU_METHOD
/begin COMPU_METHOD defaultConversion487 "" FORM "%8.4" "[]" FORMULA "1.0*X" FORMULA_INV "1.0*X" /end COMPU_METHOD
/begin COMPU_METHOD defaultConversion488 "" FORM "%8.4" "[]" FORMULA "1.0*X" FORMULA_INV "1.0*X" /end COMPU_METHOD
/begin COMPU_METHOD defaultConversion489 "" FORM "%8.4" "[]" FORMULA "1.0*X" FORMULA_INV "1.0*X" /end COMPU_METHOD
/begin COMPU_METHOD defaultConversion490 "" FORM "%8.4" "[]" FORMULA "1.0*X" FORMULA_INV "1.0*X" /end COMPU_METHOD
/begin COMPU_METHOD defaultConversion491 "" FORM "%8.4" "[]" FORMULA "1.0*X" FORMULA_INV "1.0*X" /end COMPU_METHOD
/begin COMPU_METHOD defaultConversion492 "" FORM "%8.4" "[]" FORMULA "1.0*X" FORMULA_INV "1.0*X" /end COMPU_METHOD
/begin COMPU_METHOD defaultConversion493 "" FORM "%8.4" "[]" FORMULA "1.0*X" FORMULA_INV "1.0*X" /end COMPU_METHOD
/begin COMPU_METHOD defaultConversion494 "" FORM "%8.4" "[]" FORMULA "1.0*X" FORMULA_INV "1.0*X" /end COMPU_METHOD
/begin COMPU_METHOD defaultConversion495 "" FORM "%8.4" "[]" FORMULA "1.0*X" FORMULA_INV "1.0*X" /end COMPU_METHOD
/begin COMPU_METHOD defaultConversion496 "" FORM "%8.4" "[]" FORMULA "1.0*X" FORMULA_INV "1.0*X" /end COMPU_METHOD
/begin COMPU_METHOD defaultConversion497 "" FORM "%8.4" "[]" FORMULA "1.0*X" FORMULA_INV "1.0*X" /end COMPU_METHOD
/begin COMPU_METHOD defaultConversion498 "" FORM "%8.4" "[]" FORMULA "1.0*X" FORMULA_INV "1.0*X" /end COMPU_METHOD
/begin COMPU_METHOD defaultConversion499 "" FORM "%8.4" "[]" FORMULA "1.0*X" FORMULA_INV "1.0*X" /end COMPU_METHOD
/begin COMPU_METHOD defaultConversion500 "" FORM "%8.4" "[]" FORMULA "1.0*X" FORMULA_INV "1.0*X" /end COMPU_METHOD
/begin COMPU_METHOD defaultConversion501 "" FORM "%8.4" "[]" FORMULA "1.0*X" FORMULA_INV "1.0*X" /end COMPU_METHOD
/begin COMPU_METHOD defaultConversion502 "" FORM "%8.4" "[]" FORMULA "1.0*X" FORMULA_INV "1.0*X" /end COMPU_METHOD
/begin COMPU_METHOD defaultConversion503 "" FORM "%8.4" "[]" FORMULA "1.0*X" FORMULA_INV "1.0*X" /end COMPU_METHOD
/begin COMPU_METHOD defaultConversion504 "" FORM "%8.4" "[]" FORMULA "1.0*X" FORMULA_INV "1.0*X" /end COMPU_METHOD
/begin COMPU_METHOD defaultConversion505 "" FORM "%8.4" "[]" FORMULA "1.0*X" FORMULA_INV "1.0*X" /end COMPU_METHOD
/begin COMPU_METHOD defaultConversion506 "" FORM "%8.4" "[]" FORMULA "1.0*X" FORMULA_INV "1.0*X" /end COMPU_METHOD
/begin COMPU_METHOD defaultConversion507 "" FORM "%8.4" "[]" FORMULA "1.0*X" FORMULA_INV "1.0*X" /end COMPU_METHOD
/begin COMPU_METHOD defaultConversion508 "" FORM "%8.4" "[]" FORMULA "1.0*X" FORMULA_INV "1.0*X" /end COMPU_METHOD
/begin COMPU_METHOD defaultConversion509 "" FORM "%8.4" "[]" FORMULA "1.0*X" FORMULA_INV "1.0*X" /end COMPU_METHOD
/begin COMPU_METHOD defaultConversion510 "" FORM "%8.4" "[]" FORMULA "1.0*X" FORMULA_INV "1.0*X" /end COMPU_METHOD
/begin COMPU_METHOD defaultConversion511 "" FORM "%8.4" "[]" FORMULA "1.0*X" FORMULA_INV "1.0*X" /end COMPU_METHOD
/begin COMPU_METHOD defaultConversion512 "" FORM "%8.4" "[]" FORMULA "1.0*X" FORMULA_INV "1.0*X" /end COMPU_METHOD
/begin COMPU_METHOD defaultConversion513 "" FORM "%8.4" "[]" FORMULA "1.0*X" FORMULA_INV "1.0*X" /end COMPU_METHOD
/begin COMPU_METHOD defaultConversion514 "" FORM "%8.4" "[]" FORMULA "1.0*X" FORMULA_INV "1.0*X" /end COMPU_METHOD
/begin COMPU_METHOD defaultConversion515 "" FORM "%8.4" "[]" FORMULA "1.0*X" FORMULA_INV "1.0*X" /end COMPU_METHOD
/begin COMPU_METHOD defaultConversion516 "" FORM "%8.4" "[]" FORMULA "1.0*X" FORMULA_INV "1.0*X" /end COMPU_METHOD
/begin COMPU_METHOD defaultConversion517 "" FORM "%8.4" "[]" FORMULA "1.0*X" FORMULA_INV "1.0*X" /end COMPU_METHOD
/begin COMPU_METHOD defaultConversion518 "" FORM "%8.4" "[]" FORMULA "1.0*X" FORMULA_INV "1.0*X" /end COMPU_METHOD
/begin COMPU_METHOD defaultConversion519 "" FORM "%8.4" "[]" FORMULA "1.0*X" FORMULA_INV "1.0*X" /end COMPU_METHOD
/begin COMPU_METHOD defaultConversion520 "" FORM "%8.4" "[]" FORMULA "1.0*X" FORMULA_INV "1.0*X" /end COMPU_METHOD
/begin COMPU_METHOD defaultConversion521 "" FORM "%8.4" "[]" FORMULA "1.0*X" FORMULA_INV "1.0*X" /end COMPU_METHOD
/begin COMPU_METHOD defaultConversion522 "" FORM "%8.4" "[]" FORMULA "1.0*X" FORMULA_INV "1.0*X" /end COMPU_METHOD
/begin COMPU_METHOD defaultConversion523 "" FORM "%8.4" "[]" FORMULA "1.0*X" FORMULA_INV "1.0*X" /end COMPU_METHOD
/begin COMPU_METHOD defaultConversion524 "" FORM "%8.4" "[]" FORMULA "1.0*X" FORMULA_INV "1.0*X" /end COMPU_METHOD
/begin COMPU_METHOD defaultConversion525 "" FORM "%8.4" "[]" FORMULA "1.0*X" FORMULA_INV "1.0*X" /end COMPU_METHOD
/begin COMPU_METHOD defaultConversion526 "" FORM "%8.4" "[]" FORMULA "1.0*X" FORMULA_INV "1.0*X" /end COMPU_METHOD
/begin COMPU_METHOD defaultConversion527 "" FORM "%8.4" "[]" FORMULA "1.0*X" FORMULA_INV "1.0*X" /end COMPU_METHOD
/begin COMPU_METHOD defaultConversion528 "" FORM "%8.4" "[]" FORMULA "1.0*X" FORMULA_INV "1.0*X" /end COMPU_METHOD
/begin COMPU_METHOD defaultConversion529 "" FORM "%8.4" "[]" FORMULA "1.0*X" FORMULA_INV "1.0*X" /end COMPU_METHOD
/begin COMPU_METHOD defaultConversion530 "" FORM "%8.4" "[]" FORMULA "1.0*X" FORMULA_INV "1.0*X" /end COMPU_METHOD
/begin COMPU_METHOD defaultConversion531 "" FORM "%8.4" "[]" FORMULA "1.0*X" FORMULA_INV "1.0*X" /end COMPU_METHOD
/begin COMPU_METHOD defaultConversion532 "" FORM "%8.4" "[]" FORMULA "1.0*X" FORMULA_INV "1.0*X" /end COMPU_METHOD
/begin COMPU_METHOD defaultConversion533 "" FORM "%8.4" "[]" FORMULA "1.0*X" FORMULA_INV "1.0*X" /end COMPU_METHOD
/begin COMPU_METHOD defaultConversion534 "" FORM "%8.4" "[]" FORMULA "1.0*X" FORMULA_INV "1.0*X" /end COMPU_METHOD
/begin COMPU_METHOD defaultConversion535 "" FORM "%8.4" "[]" FORMULA "1.0*X" FORMULA_INV "1.0*X" /end COMPU_METHOD
/begin COMPU_METHOD defaultConversion536 "" FORM "%8.4" "[]" FORMULA "1.0*X" FORMULA_INV "1.0*X" /end COMPU_METHOD
/begin COMPU_METHOD defaultConversion537 "" FORM "%8.4" "[]" FORMULA "1.0*X" FORMULA_INV "1.0*X" /end COMPU_METHOD
/begin COMPU_METHOD defaultConversion538 "" FORM "%8.4" "[]" FORMULA "1.0*X" FORMULA_INV "1.0*X" /end COMPU_METHOD
/begin COMPU_METHOD defaultConversion539 "" FORM "%8.4" "[]" FORMULA "1.0*X" FORMULA_INV "1.0*X" /end COMPU_METHOD
/begin COMPU_METHOD defaultConversion540 "" FORM "%8.4" "[]" FORMULA "1.0*X" FORMULA_INV "1.0*X" /end COMPU_METHOD
/begin COMPU_METHOD defaultConversion541 "" FORM "%8.4" "[]" FORMULA "1.0*X" FORMULA_INV "1.0*X" /end COMPU_METHOD
/begin COMPU_METHOD defaultConversion542 "" FORM "%8.4" "[]" FORMULA "1.0*X" FORMULA_INV "1.0*X" /end COMPU_METHOD
/begin COMPU_METHOD defaultConversion543 "" FORM "%8.4" "[]" FORMULA "1.0*X" FORMULA_INV "1.0*X" /end COMPU_METHOD
/begin COMPU_METHOD defaultConversion544 "" FORM "%8.4" "[]" FORMULA "1.0*X" FORMULA_INV "1.0*X" /end COMPU_METHOD
/begin COMPU_METHOD defaultConversion545 "" FORM "%8.4" "[]" FORMULA "1.0*X" FORMULA_INV "1.0*X" /end COMPU_METHOD
/begin COMPU_METHOD defaultConversion546 "" FORM "%8.4" "[]" FORMULA "1.0*X" FORMULA_INV "1.0*X" /end COMPU_METHOD
/begin COMPU_METHOD defaultConversion547 "" FORM "%8.4" "[]" FORMULA "1.0*X" FORMULA_INV "1.0*X" /end COMPU_METHOD
/begin COMPU_METHOD defaultConversion548 "" FORM "%8.4" "[]" FORMULA "1.0*X" FORMULA_INV "1.0*X" /end COMPU_METHOD
/begin COMPU_METHOD defaultConversion549 "" FORM "%8.4" "[]" FORMULA "1.0*X" FORMULA_INV "1.0*X" /end COMPU_METHOD
/begin COMPU_METHOD defaultConversion550 "" FORM "%8.4" "[]" FORMULA "1.0*X" FORMULA_INV "1.0*X" /end COMPU_METHOD
/begin COMPU_METHOD defaultConversion551 "" FORM "%8.4" "[]" FORMULA "1.0*X" FORMULA_INV "1.0*X" /end COMPU_METHOD
/begin COMPU_METHOD defaultConversion552 "" FORM "%8.4" "[]" FORMULA "1.0*X" FORMULA_INV "1.0*X" /end COMPU_METHOD
/begin COMPU_METHOD defaultConversion553 "" FORM "%8.4" "[]" FORMULA "1.0*X" FORMULA_INV "1.0*X" /end COMPU_METHOD
/begin COMPU_METHOD defaultConversion554 "" FORM "%8.4" "[]" FORMULA "1.0*X" FORMULA_INV "1.0*X" /end COMPU_METHOD
/begin COMPU_METHOD defaultConversion555 "" FORM "%8.4" "[]" FORMULA "1.0*X" FORMULA_INV "1.0*X" /end COMPU_METHOD
/begin COMPU_METHOD defaultConversion556 "" FORM "%8.4" "[]" FORMULA "1.0*X" FORMULA_INV "1.0*X" /end COMPU_METHOD
/begin COMPU_METHOD defaultConversion557 "" FORM "%8.4" "[]" FORMULA "1.0*X" FORMULA_INV "1.0*X" /end COMPU_METHOD
/begin COMPU_METHOD defaultConversion558 "" FORM "%8.4" "[]" FORMULA "1.0*X" FORMULA_INV "1.0*X" /end COMPU_METHOD
/begin COMPU_METHOD defaultConversion559 "" FORM "%8.4" "[]" FORMULA "1.0*X" FORMULA_INV "1.0*X" /end COMPU_METHOD
/begin COMPU_METHOD defaultConversion560 "" FORM "%8.4" "[]" FORMULA "1.0*X" FORMULA_INV "1.0*X" /end COMPU_METHOD
/begin COMPU_METHOD defaultConversion561 "" FORM "%8.4" "[]" FORMULA "1.0*X" FORMULA_INV "1.0*X" /end COMPU_METHOD
/begin COMPU_METHOD defaultConversion562 "" FORM "%8.4" "[]" FORMULA "1.0*X" FORMULA_INV "1.0*X" /end COMPU_METHOD
/begin COMPU_METHOD defaultConversion563 "" FORM "%8.4" "[]" FORMULA "1.0*X" FORMULA_INV "1.0*X" /end COMPU_METHOD
/begin COMPU_METHOD defaultConversion564 "" FORM "%8.4" "[]" FORMULA "1.0*X" FORMULA_INV "1.0*X" /end COMPU_METHOD
/begin COMPU_METHOD defaultConversion565 "" FORM "%8.4" "[]" FORMULA "1.0*X" FORMULA_INV "1.0*X" /end COMPU_METHOD
/begin COMPU_METHOD defaultConversion566 "" FORM "%8.4" "[]" FORMULA "1.0*X" FORMULA_INV "1.0*X" /end COMPU_METHOD
/begin COMPU_METHOD defaultConversion567 "" FORM "%8.4" "[]" FORMULA "1.0*X" FORMULA_INV "1.0*X" /end COMPU_METHOD
/begin COMPU_METHOD defaultConversion568 "" FORM "%8.4" "[]" FORMULA "1.0*X" FORMULA_INV "1.0*X" /end COMPU_METHOD
/begin COMPU_METHOD defaultConversion569 "" FORM "%8.4" "[]" FORMULA "1.0*X" FORMULA_INV "1.0*X" /end COMPU_METHOD
/begin COMPU_METHOD defaultConversion570 "" FORM "%8.4" "[]" FORMULA "1.0*X" FORMULA_INV "1.0*X" /end COMPU_METHOD
/begin COMPU_METHOD defaultConversion571 "" FORM "%8.4" "[]" FORMULA "1.0*X" FORMULA_INV "1.0*X" /end COMPU_METHOD
/begin COMPU_METHOD defaultConversion572 "" FORM "%8.4" "[]" FORMULA "1.0*X" FORMULA_INV "1.0*X" /end COMPU_METHOD
/begin COMPU_METHOD defaultConversion573 "" FORM "%8.4" "[]" FORMULA "1.0*X" FORMULA_INV "1.0*X" /end COMPU_METHOD
/begin COMPU_METHOD defaultConversion574 "" FORM "%8.4" "[]" FORMULA "1.0*X" FORMULA_INV "1.0*X" /end COMPU_METHOD
/begin COMPU_METHOD defaultConversion575 "" FORM "%8.4" "[]" FORMULA "1.0*X" FORMULA_INV "1.0*X" /end COMPU_METHOD
/begin COMPU_METHOD defaultConversion576 "" FORM "%8.4" "[]" FORMULA "1.0*X" FORMULA_INV "1.0*X" /end COMPU_METHOD
/begin COMPU_METHOD defaultConversion577 "" FORM "%8.4" "[]" FORMULA "1.0*X" FORMULA_INV "1.0*X" /end COMPU_METHOD
/begin COMPU_METHOD defaultConversion578 "" FORM "%8.4" "[]" FORMULA "1.0*X" FORMULA_INV "1.0*X" /end COMPU_METHOD
/begin COMPU_METHOD defaultConversion579 "" FORM "%8.4" "[]" FORMULA "1.0*X" FORMULA_INV "1.0*X" /end COMPU_METHOD
/begin COMPU_METHOD defaultConversion580 "" FORM "%8.4" "[]" FORMULA "1.0*X" FORMULA_INV "1.0*X" /end COMPU_METHOD
/begin COMPU_METHOD defaultConversion581 "" FORM "%8.4" "[]" FORMULA "1.0*X" FORMULA_INV "1.0*X" /end COMPU_METHOD
/begin COMPU_METHOD defaultConversion582 "" FORM "%8.4" "[]" FORMULA "1.0*X" FORMULA_INV "1.0*X" /end COMPU_METHOD
/begin COMPU_METHOD defaultConversion583 "" FORM "%8.4" "[]" FORMULA "1.0*X" FORMULA_INV "1.0*X" /end COMPU_METHOD
/begin COMPU_METHOD defaultConversion584 "" FORM "%8.4" "[]" FORMULA "1.0*X" FORMULA_INV "1.0*X" /end COMPU_METHOD
/begin COMPU_METHOD defaultConversion585 "" FORM "%8.4" "[]" FORMULA "1.0*X" FORMULA_INV "1.0*X" /end COMPU_METHOD
/begin COMPU_METHOD defaultConversion586 "" FORM "%8.4" "[]" FORMULA "1.0*X" FORMULA_INV "1.0*X" /end COMPU_METHOD
/begin COMPU_METHOD defaultConversion587 "" FORM "%8.4" "[]" FORMULA "1.0*X" FORMULA_INV "1.0*X" /end COMPU_METHOD
/begin COMPU_METHOD defaultConversion588 "" FORM "%8.4" "[]" FORMULA "1.0*X" FORMULA_INV "1.0*X" /end COMPU_METHOD
/begin COMPU_METHOD defaultConversion589 "" FORM "%8.4" "[]" FORMULA "1.0*X" FORMULA_INV "1.0*X" /end COMPU_METHOD
/begin COMPU_METHOD defaultConversion590 "" FORM "%8.4" "[]" FORMULA "1.0*X" FORMULA_INV "1.0*X" /end COMPU_METHOD
/begin COMPU_METHOD defaultConversion591 "" FORM "%8.4" "[]" FORMULA "1.0*X" FORMULA_INV "1.0*X" /end COMPU_METHOD
/begin COMPU_METHOD defaultConversion592 "" FORM "%8.4" "[]" FORMULA "1.0*X" FORMULA_INV "1.0*X" /end COMPU_METHOD
/begin COMPU_METHOD defaultConversion593 "" FORM "%8.4" "[]" FORMULA "1.0*X" FORMULA_INV "1.0*X" /end COMPU_METHOD
/begin COMPU_METHOD defaultConversion594 "" FORM "%8.4" "[]" FORMULA "1.0*X" FORMULA_INV "1.0*X" /end COMPU_METHOD
/begin COMPU_METHOD defaultConversion595 "" FORM "%8.4" "[]" FORMULA "1.0*X" FORMULA_INV "1.0*X" /end COMPU_METHOD
/begin COMPU_METHOD defaultConversion596 "" FORM "%8.4" "[]" FORMULA "1.0*X" FORMULA_INV "1.0*X" /end COMPU_METHOD
/begin COMPU_METHOD defaultConversion597 "" FORM "%8.4" "[]" FORMULA "1.0*X" FORMULA_INV "1.0*X" /end COMPU_METHOD
/begin COMPU_METHOD defaultConversion598 "" FORM "%8.4" "[]" FORMULA "1.0*X" FORMULA_INV "1.0*X" /end COMPU_METHOD
/begin COMPU_METHOD defaultConversion599 "" FORM "%8.4" "[]" FORMULA "1.0*X" FORMULA_INV "1.0*X" /end COMPU_METHOD
/begin COMPU_METHOD defaultConversion600 "" FORM "%8.4" "[]" FORMULA "1.0*X" FORMULA_INV "1.0*X" /end COMPU_METHOD
/begin COMPU_METHOD defaultConversion601 "" FORM "%8.4" "[]" FORMULA "1.0*X" FORMULA_INV "1.0*X" /end COMPU_METHOD
/begin COMPU_METHOD defaultConversion602 "" FORM "%8.4" "[]" FORMULA "1.0*X" FORMULA_INV "1.0*X" /end COMPU_METHOD
/begin COMPU_METHOD defaultConversion603 "" FORM "%8.4" "[]" FORMULA "1.0*X" FORMULA_INV "1.0*X" /end COMPU_METHOD
/begin COMPU_METHOD defaultConversion604 "" FORM "%8.4" "[]" FORMULA "1.0*X" FORMULA_INV "1.0*X" /end COMPU_METHOD
/begin COMPU_METHOD defaultConversion605 "" FORM "%8.4" "[]" FORMULA "1.0*X" FORMULA_INV "1.0*X" /end COMPU_METHOD
/begin COMPU_METHOD defaultConversion606 "" FORM "%8.4" "[]" FORMULA "1.0*X" FORMULA_INV "1.0*X" /end COMPU_METHOD
/begin COMPU_METHOD defaultConversion607 "" FORM "%8.4" "[]" FORMULA "1.0*X" FORMULA_INV "1.0*X" /end COMPU_METHOD
/begin COMPU_METHOD defaultConversion608 "" FORM "%8.4" "[]" FORMULA "1.0*X" FORMULA_INV "1.0*X" /end COMPU_METHOD
/begin COMPU_METHOD defaultConversion609 "" FORM "%8.4" "[]" FORMULA "1.0*X" FORMULA_INV "1.0*X" /end COMPU_METHOD
/begin COMPU_METHOD defaultConversion610 "" FORM "%8.4" "[]" FORMULA "1.0*X" FORMULA_INV "1.0*X" /end COMPU_METHOD
/begin COMPU_METHOD defaultConversion611 "" FORM "%8.4" "[]" FORMULA "1.0*X" FORMULA_INV "1.0*X" /end COMPU_METHOD
/begin COMPU_METHOD defaultConversion612 "" FORM "%8.4" "[]" FORMULA "1.0*X" FORMULA_INV "1.0*X" /end COMPU_METHOD
/begin COMPU_METHOD defaultConversion613 "" FORM "%8.4" "[]" FORMULA "1.0*X" FORMULA_INV "1.0*X" /end COMPU_METHOD
/begin COMPU_METHOD defaultConversion614 "" FORM "%8.4" "[]" FORMULA "1.0*X" FORMULA_INV "1.0*X" /end COMPU_METHOD
/begin COMPU_METHOD defaultConversion615 "" FORM "%8.4" "[]" FORMULA "1.0*X" FORMULA_INV "1.0*X" /end COMPU_METHOD
/begin COMPU_METHOD defaultConversion616 "" FORM "%8.4" "[]" FORMULA "1.0*X" FORMULA_INV "1.0*X" /end COMPU_METHOD
/begin COMPU_METHOD defaultConversion617 "" FORM "%8.4" "[]" FORMULA "1.0*X" FORMULA_INV "1.0*X" /end COMPU_METHOD
/begin COMPU_METHOD defaultConversion618 "" FORM "%8.4" "[]" FORMULA "1.0*X" FORMULA_INV "1.0*X" /end COMPU_METHOD
/begin COMPU_METHOD defaultConversion619 "" FORM "%8.4" "[]" FORMULA "1.0*X" FORMULA_INV "1.0*X" /end COMPU_METHOD
/begin COMPU_METHOD defaultConversion620 "" FORM "%8.4" "[]" FORMULA "1.0*X" FORMULA_INV "1.0*X" /end COMPU_METHOD
/begin COMPU_METHOD defaultConversion621 "" FORM "%8.4" "[]" FORMULA "1.0*X" FORMULA_INV "1.0*X" /end COMPU_METHOD
/begin COMPU_METHOD defaultConversion622 "" FORM "%8.4" "[]" FORMULA "1.0*X" FORMULA_INV "1.0*X" /end COMPU_METHOD
/begin COMPU_METHOD defaultConversion623 "" FORM "%8.4" "[]" FORMULA "1.0*X" FORMULA_INV "1.0*X" /end COMPU_METHOD
/begin COMPU_METHOD defaultConversion624 "" FORM "%8.4" "[]" FORMULA "1.0*X" FORMULA_INV "1.0*X" /end COMPU_METHOD
/begin COMPU_METHOD defaultConversion625 "" FORM "%8.4" "[]" FORMULA "1.0*X" FORMULA_INV "1.0*X" /end COMPU_METHOD
/begin COMPU_METHOD defaultConversion626 "" FORM "%8.4" "[]" FORMULA "1.0*X" FORMULA_INV "1.0*X" /end COMPU_METHOD
/begin COMPU_METHOD defaultConversion627 "" FORM "%8.4" "[]" FORMULA "1.0*X" FORMULA_INV "1.0*X" /end COMPU_METHOD
/begin COMPU_METHOD defaultConversion628 "" FORM "%8.4" "[]" FORMULA "1.0*X" FORMULA_INV "1.0*X" /end COMPU_METHOD
/begin COMPU_METHOD defaultConversion629 "" FORM "%8.4" "[]" FORMULA "1.0*X" FORMULA_INV "1.0*X" /end COMPU_METHOD
/begin COMPU_METHOD defaultConversion630 "" FORM "%8.4" "[]" FORMULA "1.0*X" FORMULA_INV "1.0*X" /end COMPU_METHOD
/begin COMPU_METHOD defaultConversion631 "" FORM "%8.4" "[]" FORMULA "1.0*X" FORMULA_INV "1.0*X" /end COMPU_METHOD
/begin COMPU_METHOD defaultConversion632 "" FORM "%8.4" "[]" FORMULA "1.0*X" FORMULA_INV "1.0*X" /end COMPU_METHOD
/begin COMPU_METHOD defaultConversion633 "" FORM "%8.4" "[]" FORMULA "1.0*X" FORMULA_INV "1.0*X" /end COMPU_METHOD
/begin COMPU_METHOD defaultConversion634 "" FORM "%8.4" "[]" FORMULA "1.0*X" FORMULA_INV "1.0*X" /end COMPU_METHOD
/begin COMPU_METHOD defaultConversion635 "" FORM "%8.4" "[]" FORMULA "1.0*X" FORMULA_INV "1.0*X" /end COMPU_METHOD
/begin COMPU_METHOD defaultConversion636 "" FORM "%8.4" "[]" FORMULA "1.0*X" FORMULA_INV "1.0*X" /end COMPU_METHOD
/begin COMPU_METHOD defaultConversion637 "" FORM "%8.4" "[]" FORMULA "1.0*X" FORMULA_INV "1.0*X" /end COMPU_METHOD
/begin COMPU_METHOD defaultConversion638 "" FORM "%8.4" "[]" FORMULA "1.0*X" FORMULA_INV "1.0*X" /end COMPU_METHOD
/begin COMPU_METHOD defaultConversion639 "" FORM "%8.4" "[]" FORMULA "1.0*X" FORMULA_INV "1.0*X" /end COMPU_METHOD
/begin COMPU_METHOD defaultConversion640 "" FORM "%8.4" "[]" FORMULA "1.0*X" FORMULA_INV "1.0*X" /end COMPU_METHOD
/begin COMPU_METHOD defaultConversion641 "" FORM "%8.4" "[]" FORMULA "1.0*X" FORMULA_INV "1.0*X" /end COMPU_METHOD
/begin COMPU_METHOD defaultConversion642 "" FORM "%8.4" "[]" FORMULA "1.0*X" FORMULA_INV "1.0*X" /end COMPU_METHOD
/begin COMPU_METHOD defaultConversion643 "" FORM "%8.4" "[]" FORMULA "1.0*X" FORMULA_INV "1.0*X" /end COMPU_METHOD
/begin COMPU_METHOD defaultConversion644 "" FORM "%8.4" "[]" FORMULA "1.0*X" FORMULA_INV "1.0*X" /end COMPU_METHOD
/begin COMPU_METHOD defaultConversion645 "" FORM "%8.4" "[]" FORMULA "1.0*X" FORMULA_INV "1.0*X" /end COMPU_METHOD
/begin COMPU_METHOD defaultConversion646 "" FORM "%8.4" "[]" FORMULA "1.0*X" FORMULA_INV "1.0*X" /end COMPU_METHOD
/begin COMPU_METHOD defaultConversion647 "" FORM "%8.4" "[]" FORMULA "1.0*X" FORMULA_INV "1.0*X" /end COMPU_METHOD
/begin COMPU_METHOD defaultConversion648 "" FORM "%8.4" "[]" FORMULA "1.0*X" FORMULA_INV "1.0*X" /end COMPU_METHOD
/begin COMPU_METHOD defaultConversion649 "" FORM "%8.4" "[]" FORMULA "1.0*X" FORMULA_INV "1.0*X" /end COMPU_METHOD
/begin COMPU_METHOD defaultConversion650 "" FORM "%8.4" "[]" FORMULA "1.0*X" FORMULA_INV "1.0*X" /end COMPU_METHOD
/begin COMPU_METHOD defaultConversion651 "" FORM "%8.4" "[]" FORMULA "1.0*X" FORMULA_INV "1.0*X" /end COMPU_METHOD
/begin COMPU_METHOD defaultConversion652 "" FORM "%8.4" "[]" FORMULA "1.0*X" FORMULA_INV "1.0*X" /end COMPU_METHOD
/begin COMPU_METHOD defaultConversion653 "" FORM "%8.4" "[]" FORMULA "1.0*X" FORMULA_INV "1.0*X" /end COMPU_METHOD
/begin COMPU_METHOD defaultConversion654 "" FORM "%8.4" "[]" FORMULA "1.0*X" FORMULA_INV "1.0*X" /end COMPU_METHOD
/begin COMPU_METHOD defaultConversion655 "" FORM "%8.4" "[]" FORMULA "1.0*X" FORMULA_INV "1.0*X" /end COMPU_METHOD
/begin COMPU_METHOD defaultConversion656 "" FORM "%8.4" "[]" FORMULA "1.0*X" FORMULA_INV "1.0*X" /end COMPU_METHOD
/begin COMPU_METHOD defaultConversion657 "" FORM "%8.4" "[]" FORMULA "1.0*X" FORMULA_INV "1.0*X" /end COMPU_METHOD
/begin COMPU_METHOD defaultConversion658 "" FORM "%8.4" "[]" FORMULA "1.0*X" FORMULA_INV "1.0*X" /end COMPU_METHOD
/begin COMPU_METHOD defaultConversion659 "" FORM "%8.4" "[]" FORMULA "1.0*X" FORMULA_INV "1.0*X" /end COMPU_METHOD
/begin COMPU_METHOD defaultConversion660 "" FORM "%8.4" "[]" FORMULA "1.0*X" FORMULA_INV "1.0*X" /end COMPU_METHOD
/begin COMPU_METHOD defaultConversion661 "" FORM "%8.4" "[]" FORMULA "1.0*X" FORMULA_INV "1.0*X" /end COMPU_METHOD
/begin COMPU_METHOD defaultConversion662 "" FORM "%8.4" "[]" FORMULA "1.0*X" FORMULA_INV "1.0*X" /end COMPU_METHOD
/begin COMPU_METHOD defaultConversion663 "" FORM "%8.4" "[]" FORMULA "1.0*X" FORMULA_INV "1.0*X" /end COMPU_METHOD
/begin COMPU_METHOD defaultConversion664 "" FORM "%8.4" "[]" FORMULA "1.0*X" FORMULA_INV "1.0*X" /end COMPU_METHOD
/begin COMPU_METHOD defaultConversion665 "" FORM "%8.4" "[]" FORMULA "1.0*X" FORMULA_INV "1.0*X" /end COMPU_METHOD
/begin COMPU_METHOD defaultConversion666 "" FORM "%8.4" "[]" FORMULA "1.0*X" FORMULA_INV "1.0*X" /end COMPU_METHOD
/begin COMPU_METHOD defaultConversion667 "" FORM "%8.4" "[]" FORMULA "1.0*X" FORMULA_INV "1.0*X" /end COMPU_METHOD
/begin COMPU_METHOD defaultConversion668 "" FORM "%8.4" "[]" FORMULA "1.0*X" FORMULA_INV "1.0*X" /end COMPU_METHOD
/begin COMPU_METHOD defaultConversion669 "" FORM "%8.4" "[]" FORMULA "1.0*X" FORMULA_INV "1.0*X" /end COMPU_METHOD
/begin COMPU_METHOD defaultConversion670 "" FORM "%8.4" "[]" FORMULA "1.0*X" FORMULA_INV "1.0*X" /end COMPU_METHOD
/begin COMPU_METHOD defaultConversion671 "" FORM "%8.4" "[]" FORMULA "1.0*X" FORMULA_INV "1.0*X" /end COMPU_METHOD
/begin COMPU_METHOD defaultConversion672 "" FORM "%8.4" "[]" FORMULA "1.0*X" FORMULA_INV "1.0*X" /end COMPU_METHOD
/begin COMPU_METHOD defaultConversion673 "" FORM "%8.4" "[]" FORMULA "1.0*X" FORMULA_INV "1.0*X" /end COMPU_METHOD
/begin COMPU_METHOD defaultConversion674 "" FORM "%8.4" "[]" FORMULA "1.0*X" FORMULA_INV "1.0*X" /end COMPU_METHOD
/begin COMPU_METHOD defaultConversion675 "" FORM "%8.4" "[]" FORMULA "1.0*X" FORMULA_INV "1.0*X" /end COMPU_METHOD
/begin COMPU_METHOD defaultConversion676 "" FORM "%8.4" "[]" FORMULA "1.0*X" FORMULA_INV "1.0*X" /end COMPU_METHOD
/begin COMPU_METHOD defaultConversion677 "" FORM "%8.4" "[]" FORMULA "1.0*X" FORMULA_INV "1.0*X" /end COMPU_METHOD
/begin COMPU_METHOD defaultConversion678 "" FORM "%8.4" "[]" FORMULA "1.0*X" FORMULA_INV "1.0*X" /end COMPU_METHOD
/begin COMPU_METHOD defaultConversion679 "" FORM "%8.4" "[]" FORMULA "1.0*X" FORMULA_INV "1.0*X" /end COMPU_METHOD
/begin COMPU_METHOD defaultConversion680 "" FORM "%8.4" "[]" FORMULA "1.0*X" FORMULA_INV "1.0*X" /end COMPU_METHOD
/begin COMPU_METHOD defaultConversion681 "" FORM "%8.4" "[]" FORMULA "1.0*X" FORMULA_INV "1.0*X" /end COMPU_METHOD
/begin COMPU_METHOD defaultConversion682 "" FORM "%8.4" "[]" FORMULA "1.0*X" FORMULA_INV "1.0*X" /end COMPU_METHOD
/begin COMPU_METHOD defaultConversion683 "" FORM "%8.4" "[]" FORMULA "1.0*X" FORMULA_INV "1.0*X" /end COMPU_METHOD
/begin COMPU_METHOD defaultConversion684 "" FORM "%8.4" "[]" FORMULA "1.0*X" FORMULA_INV "1.0*X" /end COMPU_METHOD
/begin COMPU_METHOD defaultConversion685 "" FORM "%8.4" "[]" FORMULA "1.0*X" FORMULA_INV "1.0*X" /end COMPU_METHOD
/begin COMPU_METHOD defaultConversion686 "" FORM "%8.4" "[]" FORMULA "1.0*X" FORMULA_INV "1.0*X" /end COMPU_METHOD
/begin COMPU_METHOD defaultConversion687 "" FORM "%8.4" "[]" FORMULA "1.0*X" FORMULA_INV "1.0*X" /end COMPU_METHOD
/begin COMPU_METHOD defaultConversion688 "" FORM "%8.4" "[]" FORMULA "1.0*X" FORMULA_INV "1.0*X" /end COMPU_METHOD
/begin COMPU_METHOD defaultConversion689 "" FORM "%8.4" "[]" FORMULA "1.0*X" FORMULA_INV "1.0*X" /end COMPU_METHOD
/begin COMPU_METHOD defaultConversion690 "" FORM "%8.4" "[]" FORMULA "1.0*X" FORMULA_INV "1.0*X" /end COMPU_METHOD
/begin COMPU_METHOD defaultConversion691 "" FORM "%8.4" "[]" FORMULA "1.0*X" FORMULA_INV "1.0*X" /end COMPU_METHOD
/begin COMPU_METHOD defaultConversion692 "" FORM "%8.4" "[]" FORMULA "1.0*X" FORMULA_INV "1.0*X" /end COMPU_METHOD
/begin COMPU_METHOD defaultConversion693 "" FORM "%8.4" "[]" FORMULA "1.0*X" FORMULA_INV "1.0*X" /end COMPU_METHOD
/begin COMPU_METHOD defaultConversion694 "" FORM "%8.4" "[]" FORMULA "1.0*X" FORMULA_INV "1.0*X" /end COMPU_METHOD
/begin COMPU_METHOD defaultConversion695 "" FORM "%8.4" "[]" FORMULA "1.0*X" FORMULA_INV "1.0*X" /end COMPU_METHOD
/begin COMPU_METHOD defaultConversion696 "" FORM "%8.4" "[]" FORMULA "1.0*X" FORMULA_INV "1.0*X" /end COMPU_METHOD
/begin COMPU_METHOD defaultConversion697 "" FORM "%8.4" "[]" FORMULA "1.0*X" FORMULA_INV "1.0*X" /end COMPU_METHOD
/begin COMPU_METHOD defaultConversion698 "" FORM "%8.4" "[]" FORMULA "1.0*X" FORMULA_INV "1.0*X" /end COMPU_METHOD
/begin COMPU_METHOD defaultConversion699 "" FORM "%8.4" "[]" FORMULA "1.0*X" FORMULA_INV "1.0*X" /end COMPU_METHOD
/begin COMPU_METHOD defaultConversion700 "" FORM "%8.4" "[]" FORMULA "1.0*X" FORMULA_INV "1.0*X" /end COMPU_METHOD
/begin COMPU_METHOD defaultConversion701 "" FORM "%8.4" "[]" FORMULA "1.0*X" FORMULA_INV "1.0*X" /end COMPU_METHOD
/begin COMPU_METHOD defaultConversion702 "" FORM "%8.4" "[]" FORMULA "1.0*X" FORMULA_INV "1.0*X" /end COMPU_METHOD
/begin COMPU_METHOD defaultConversion703 "" FORM "%8.4" "[]" FORMULA "1.0*X" FORMULA_INV "1.0*X" /end COMPU_METHOD
/begin COMPU_METHOD defaultConversion704 "" FORM "%8.4" "[]" FORMULA "1.0*X" FORMULA_INV "1.0*X" /end COMPU_METHOD
/begin COMPU_METHOD defaultConversion705 "" FORM "%8.4" "[]" FORMULA "1.0*X" FORMULA_INV "1.0*X" /end COMPU_METHOD
/begin COMPU_METHOD defaultConversion706 "" FORM "%8.4" "[]" FORMULA "1.0*X" FORMULA_INV "1.0*X" /end COMPU_METHOD
/begin COMPU_METHOD defaultConversion707 "" FORM "%8.4" "[]" FORMULA "1.0*X" FORMULA_INV "1.0*X" /end COMPU_METHOD
/begin COMPU_METHOD defaultConversion708 "" FORM "%8.4" "[]" FORMULA "1.0*X" FORMULA_INV "1.0*X" /end COMPU_METHOD
/begin COMPU_METHOD defaultConversion709 "" FORM "%8.4" "[]" FORMULA "1.0*X" FORMULA_INV "1.0*X" /end COMPU_METHOD
/begin COMPU_METHOD defaultConversion710 "" FORM "%8.4" "[]" FORMULA "1.0*X" FORMULA_INV "1.0*X" /end COMPU_METHOD
/begin COMPU_METHOD defaultConversion711 "" FORM "%8.4" "[]" FORMULA "1.0*X" FORMULA_INV "1.0*X" /end COMPU_METHOD
/begin COMPU_METHOD defaultConversion712 "" FORM "%8.4" "[]" FORMULA "1.0*X" FORMULA_INV "1.0*X" /end COMPU_METHOD
/begin COMPU_METHOD defaultConversion713 "" FORM "%8.4" "[]" FORMULA "1.0*X" FORMULA_INV "1.0*X" /end COMPU_METHOD
/begin COMPU_METHOD defaultConversion714 "" FORM "%8.4" "[]" FORMULA "1.0*X" FORMULA_INV "1.0*X" /end COMPU_METHOD
/begin COMPU_METHOD defaultConversion715 "" FORM "%8.4" "[]" FORMULA "1.0*X" FORMULA_INV "1.0*X" /end COMPU_METHOD
/begin COMPU_METHOD defaultConversion716 "" FORM "%8.4" "[]" FORMULA "1.0*X" FORMULA_INV "1.0*X" /end COMPU_METHOD
/begin COMPU_METHOD LINEAR_______48_000000__FFFFFF80 "" FORM "%6.2" "°CRK" FORMULA "0.375*X" FORMULA_INV "2.6666667*X" /end COMPU_METHOD
/begin COMPU_METHOD defaultConversion717 "" FORM "%8.4" "[]" FORMULA "1.0*X" FORMULA_INV "1.0*X" /end COMPU_METHOD
/begin COMPU_METHOD defaultConversion718 "" FORM "%8.4" "[]" FORMULA "1.0*X" FORMULA_INV "1.0*X" /end COMPU_METHOD
/begin COMPU_METHOD defaultConversion719 "" FORM "%8.4" "[]" FORMULA "1.0*X" FORMULA_INV "1.0*X" /end COMPU_METHOD
/begin COMPU_METHOD defaultConversion720 "" FORM "%8.4" "[]" FORMULA "1.0*X" FORMULA_INV "1.0*X" /end COMPU_METHOD
/begin COMPU_METHOD defaultConversion721 "" FORM "%8.4" "[]" FORMULA "1.0*X" FORMULA_INV "1.0*X" /end COMPU_METHOD
/begin COMPU_METHOD defaultConversion722 "" FORM "%8.4" "[]" FORMULA "1.0*X" FORMULA_INV "1.0*X" /end COMPU_METHOD
/begin COMPU_METHOD defaultConversion723 "" FORM "%8.4" "[]" FORMULA "1.0*X" FORMULA_INV "1.0*X" /end COMPU_METHOD
/begin COMPU_METHOD defaultConversion724 "" FORM "%8.4" "[]" FORMULA "1.0*X" FORMULA_INV "1.0*X" /end COMPU_METHOD
/begin COMPU_METHOD defaultConversion725 "" FORM "%8.4" "[]" FORMULA "1.0*X" FORMULA_INV "1.0*X" /end COMPU_METHOD
/begin COMPU_METHOD defaultConversion726 "" FORM "%8.4" "[]" FORMULA "1.0*X" FORMULA_INV "1.0*X" /end COMPU_METHOD
/begin COMPU_METHOD defaultConversion727 "" FORM "%8.4" "[]" FORMULA "1.0*X" FORMULA_INV "1.0*X" /end COMPU_METHOD
/begin COMPU_METHOD defaultConversion728 "" FORM "%8.4" "[]" FORMULA "1.0*X" FORMULA_INV "1.0*X" /end COMPU_METHOD
/begin COMPU_METHOD LINEAR______0_000000__0H___3000_ "" FORM "%4.0" "1/1000rev" FORMULA "1.0*X" FORMULA_INV "1.0*X" /end COMPU_METHOD
/begin COMPU_METHOD LINEAR_______768_000000__FFFFFF8 "" FORM "%4.0" "*tdc" FORMULA "6.0*X" FORMULA_INV "0.16666667*X" /end COMPU_METHOD
/begin COMPU_METHOD defaultConversion729 "" FORM "%8.4" "[]" FORMULA "1.0*X" FORMULA_INV "1.0*X" /end COMPU_METHOD
/begin COMPU_METHOD defaultConversion730 "" FORM "%8.4" "[]" FORMULA "1.0*X" FORMULA_INV "1.0*X" /end COMPU_METHOD
/begin COMPU_METHOD defaultConversion731 "" FORM "%8.4" "[]" FORMULA "1.0*X" FORMULA_INV "1.0*X" /end COMPU_METHOD
/begin COMPU_METHOD defaultConversion732 "" FORM "%8.4" "[]" FORMULA "1.0*X" FORMULA_INV "1.0*X" /end COMPU_METHOD
/begin COMPU_METHOD defaultConversion733 "" FORM "%8.4" "[]" FORMULA "1.0*X" FORMULA_INV "1.0*X" /end COMPU_METHOD
/begin COMPU_METHOD defaultConversion734 "" FORM "%8.4" "[]" FORMULA "1.0*X" FORMULA_INV "1.0*X" /end COMPU_METHOD
/begin COMPU_METHOD defaultConversion735 "" FORM "%8.4" "[]" FORMULA "1.0*X" FORMULA_INV "1.0*X" /end COMPU_METHOD
/begin COMPU_METHOD defaultConversion736 "" FORM "%8.4" "[]" FORMULA "1.0*X" FORMULA_INV "1.0*X" /end COMPU_METHOD
/begin COMPU_METHOD defaultConversion737 "" FORM "%8.4" "[]" FORMULA "1.0*X" FORMULA_INV "1.0*X" /end COMPU_METHOD
/begin COMPU_METHOD defaultConversion738 "" FORM "%8.4" "[]" FORMULA "1.0*X" FORMULA_INV "1.0*X" /end COMPU_METHOD
/begin COMPU_METHOD defaultConversion739 "" FORM "%8.4" "[]" FORMULA "1.0*X" FORMULA_INV "1.0*X" /end COMPU_METHOD
/begin COMPU_METHOD defaultConversion740 "" FORM "%8.4" "[]" FORMULA "1.0*X" FORMULA_INV "1.0*X" /end COMPU_METHOD
/begin COMPU_METHOD LINEAR_______160000_000000__FFFF "" FORM "%6.0" "km" FORMULA "10.0*X" FORMULA_INV "0.1*X" /end COMPU_METHOD
/begin COMPU_METHOD LINEAR_______10_922666__FFFFFF80 "" FORM "%5.2" "ms" FORMULA "0.085333333*X-3.5527137e-015" FORMULA_INV "11.71875*X+4.1633363e-014" /end COMPU_METHOD
/begin COMPU_METHOD LINEAR______4_000000__4H___56741 "" FORM "%2.0" "-" FORMULA "1.0*X" FORMULA_INV "1.0*X" /end COMPU_METHOD
/begin COMPU_METHOD RANGE________INF___1H__1H_______ "" TAB_VERB "%8.4" "-" COMPU_TAB_REF RANGE________INF___1H__1H_______ /end COMPU_METHOD
/begin COMPU_METHOD LINEAR_______1777_777752__FFFF80 "" FORM "%6.1" "m/s^2" FORMULA "0.054253471*X-2.642862e-007" FORMULA_INV "18.432*X+4.8713233e-006" /end COMPU_METHOD
/begin COMPU_METHOD RANGE________active___1H__1H____ "" TAB_VERB "%8.4" "-" COMPU_TAB_REF RANGE________active___1H__1H____ /end COMPU_METHOD
/begin COMPU_METHOD RANGE________active___1H__1H_744 "" TAB_VERB "%8.4" "-" COMPU_TAB_REF RANGE________active___1H__1H_744 /end COMPU_METHOD
/begin COMPU_METHOD RANGE________YES___1H__1H____NO_ "" TAB_VERB "%8.4" "-" COMPU_TAB_REF RANGE________YES___1H__1H____NO_ /end COMPU_METHOD
/begin COMPU_METHOD LINEAR_______1439_956055__FFFF80 "" FORM "%8.1" "°pste" FORMULA "0.043943971*X-1.0143128e-006" FORMULA_INV "22.75625*X+2.3081956e-005" /end COMPU_METHOD
/begin COMPU_METHOD RANGE________YES___1H__1H____745 "" TAB_VERB "%8.4" "" COMPU_TAB_REF RANGE________YES___1H__1H____745 /end COMPU_METHOD
/begin COMPU_METHOD RANGE________passive___0H__0H___ "" TAB_VERB "%8.4" "" COMPU_TAB_REF RANGE________passive___0H__0H___ /end COMPU_METHOD
/begin COMPU_METHOD RANGE________passive___0H__0H746 "" TAB_VERB "%8.4" "-" COMPU_TAB_REF RANGE________passive___0H__0H746 /end COMPU_METHOD
/begin COMPU_METHOD RANGE________passive___0H__0H747 "" TAB_VERB "%8.4" "-" COMPU_TAB_REF RANGE________passive___0H__0H747 /end COMPU_METHOD
/begin COMPU_METHOD RANGE________passive___0H__0H748 "" TAB_VERB "%8.4" "-" COMPU_TAB_REF RANGE________passive___0H__0H748 /end COMPU_METHOD
/begin COMPU_METHOD RANGE________passive___0H__0H749 "" TAB_VERB "%8.4" "-" COMPU_TAB_REF RANGE________passive___0H__0H749 /end COMPU_METHOD
/begin COMPU_METHOD RANGE________0___0H__0H____1___1 "" TAB_VERB "%8.4" "-" COMPU_TAB_REF RANGE________0___0H__0H____1___1 /end COMPU_METHOD
/begin COMPU_METHOD CAM_ADJ_RTD "" TAB_VERB "%8.4" "" COMPU_TAB_REF CAM_ADJ_RTD_TAB_NAME /end COMPU_METHOD
/begin COMPU_METHOD CAM_ADJ_ADC "" TAB_VERB "%8.4" "" COMPU_TAB_REF CAM_ADJ_ADC_TAB_NAME /end COMPU_METHOD
/begin COMPU_METHOD LINEAR_______95_625000__FFFFFF01 "" FORM "%6.2" "°CRK/wcyc" FORMULA "0.37745098*X" FORMULA_INV "2.6493506*X" /end COMPU_METHOD
/begin COMPU_METHOD LINEAR_______155_996700__FFFFH__ "" FORM "%5.1" "°CRK" FORMULA "-0.0014648157*X-60.0" FORMULA_INV "-682.67972*X-40960.783" /end COMPU_METHOD
/begin COMPU_METHOD LINEAR______60_000000__0H___1750 "" FORM "%5.1" "°CRK" FORMULA "0.0014648157*X+60.0" FORMULA_INV "682.67972*X-40960.783" /end COMPU_METHOD
/begin COMPU_METHOD LINEAR_______32768_000000__FF751 "" FORM "%6.0" "Ah/h" FORMULA "1.0*X" FORMULA_INV "1.0*X" /end COMPU_METHOD
/begin COMPU_METHOD LINEAR______0_000000__0H___72752 "" FORM "%3.0" "°CRK" FORMULA "6.0*X" FORMULA_INV "0.16666667*X" /end COMPU_METHOD
/begin COMPU_METHOD LINEAR______0_000000__0H___1_753 "" FORM "%4.2" "-" FORMULA "3.0517585e-005*X" FORMULA_INV "32767.992*X" /end COMPU_METHOD
/begin COMPU_METHOD ZYL_ID "" FORM "%2.0" "-" FORMULA "1.0*X+1.0" FORMULA_INV "1.0*X-1.0" /end COMPU_METHOD
/begin COMPU_METHOD LINEAR______0_000000__0H___25754 "" FORM "%3.0" "hex" FORMULA "1.0*X" FORMULA_INV "1.0*X" /end COMPU_METHOD
/begin COMPU_VTAB RANGE________INF___1H__1H_______ "" TAB_VERB 2 0x0 "" 0x1 "INF" /end COMPU_VTAB
/begin COMPU_VTAB RANGE________active___1H__1H____ "" TAB_VERB 2 0x0 "passive" 0x1 "active" /end COMPU_VTAB
/begin COMPU_VTAB RANGE________active___1H__1H_744 "" TAB_VERB 2 0x0 "passive" 0x1 "active" /end COMPU_VTAB
/begin COMPU_VTAB RANGE________YES___1H__1H____NO_ "" TAB_VERB 2 0x0 "NO" 0x1 "YES" /end COMPU_VTAB
/begin COMPU_VTAB RANGE________YES___1H__1H____745 "" TAB_VERB 2 0x0 "NO" 0x1 "YES" /end COMPU_VTAB
/begin COMPU_VTAB RANGE________passive___0H__0H___ "" TAB_VERB 2 0x0 "passive" 0x1 "LAMMW_ZV" /end COMPU_VTAB
/begin COMPU_VTAB RANGE________passive___0H__0H746 "" TAB_VERB 2 0x0 "passive" 0x1 "LAM" /end COMPU_VTAB
/begin COMPU_VTAB RANGE________passive___0H__0H747 "" TAB_VERB 2 0x0 "passive" 0x1 "LM_ZV" /end COMPU_VTAB
/begin COMPU_VTAB RANGE________passive___0H__0H748 "" TAB_VERB 2 0x0 "passive" 0x1 "N/MAF" /end COMPU_VTAB
/begin COMPU_VTAB RANGE________passive___0H__0H749 "" TAB_VERB 2 0x0 "passive" 0x1 "N_ZV" /end COMPU_VTAB
/begin COMPU_VTAB RANGE________0___0H__0H____1___1 "" TAB_VERB 2 0x0 "0" 0x1 "1" /end COMPU_VTAB
/begin COMPU_VTAB CAM_ADJ_RTD_TAB_NAME "" TAB_VERB 4 0x0 "" 0x1 "   RTD" 0x2 "ADC" 0x4 "  H" /end COMPU_VTAB
/begin COMPU_VTAB CAM_ADJ_ADC_TAB_NAME "" TAB_VERB 4 0x0 "" 0x1 "ADC" 0x2 "   RTD" 0x4 "  H" /end COMPU_VTAB
/begin RECORD_LAYOUT a_85 FNC_VALUES 1 UWORD ROW_DIR DIRECT /end RECORD_LAYOUT
/begin RECORD_LAYOUT a_86 FNC_VALUES 1 UBYTE ROW_DIR DIRECT /end RECORD_LAYOUT
/begin RECORD_LAYOUT a_87 FNC_VALUES 1 SBYTE ROW_DIR DIRECT /end RECORD_LAYOUT
/begin RECORD_LAYOUT a_95 FNC_VALUES 1 SWORD ROW_DIR DIRECT /end RECORD_LAYOUT
/end MODULE
/end PROJECT
