ASAP2_VERSION 1 2
/begin PROJECT Z432 "430"
/begin HEADER "" VERSION "056.03" PROJECT_NO Z430 /end HEADER
/begin MODULE BMW-EASY ""
/begin MOD_COMMON "common attributes" DEPOSIT ABSOLUT BYTE_ORDER BIG_ENDIAN /end MOD_COMMON
/begin CHARACTERISTIC ip_ti_sawup__n__maf "IP_TI_SAWUP" MAP 0x78a41 a_6 15 LINEAR______0_000000__0H___0_996 0.0 0.99609375
 /begin AXIS_DESCR COM_AXIS maf LINEAR______0_000000__0H___1389_ 8 0.0 1389.0 AXIS_PTS_REF ldp_maf__ti_sawup MAX_GRAD 100 MONOTONY MON_INCREASE /end AXIS_DESCR
 /begin AXIS_DESCR COM_AXIS n LINEAR______0_000000__0H___8160_ 8 0.0 8160.0 AXIS_PTS_REF ldp_n_32__ti_sawup MAX_GRAD 100 MONOTONY MON_INCREASE /end AXIS_DESCR
/end CHARACTERISTIC
/begin CHARACTERISTIC ip_ti_slow_wf_thd_min__tco "IP_TI_SLOW_WF_THD_MIN" CURVE 0x7d0cc a_3 100 LINEAR______0_000000__0H___349_5 0.0 349.52
 /begin AXIS_DESCR COM_AXIS tco LINEAR_______48_000000__0H___142 4 -48.0 142.5 AXIS_PTS_REF ldpm_tco_18 MAX_GRAD 100 MONOTONY MON_INCREASE /end AXIS_DESCR
/end CHARACTERISTIC
/begin CHARACTERISTIC ip_ti_st_rest__tco "IP_TI_ST_REST" CURVE 0x78a81 a_1 20 LINEAR______0_500000__80H___0_99 0.5 0.99610001
 /begin AXIS_DESCR COM_AXIS tco LINEAR_______48_000000__0H___142 8 -48.0 142.5 AXIS_PTS_REF ldpm_tco_3 MAX_GRAD 100 MONOTONY MON_INCREASE /end AXIS_DESCR
/end CHARACTERISTIC
/begin CHARACTERISTIC ip_ti_tco_1_is_ivvt__n__maf "IP_TI_TCO_1_IS_IVVT" MAP 0x7d0d4 a_28 100 LINEAR______0_000000__0H___349_5 0.0 349.52
 /begin AXIS_DESCR COM_AXIS maf LINEAR______0_000000__0H___13818 6 0.0 1389.0 AXIS_PTS_REF ldpm_maf_3 MAX_GRAD 100 MONOTONY MON_INCREASE /end AXIS_DESCR
 /begin AXIS_DESCR COM_AXIS n LINEAR______0_000000__0H___81612 6 0.0 8160.0 AXIS_PTS_REF ldpm_n_2 MAX_GRAD 100 MONOTONY MON_INCREASE /end AXIS_DESCR
/end CHARACTERISTIC
/begin CHARACTERISTIC ip_ti_tco_1_pl_ivvt_1__n__maf "IP_TI_TCO_1_PL_IVVT_1" MAP 0x7d11c a_28 100 LINEAR______0_000000__0H___349_5 0.0 349.52
 /begin AXIS_DESCR COM_AXIS maf LINEAR______0_000000__0H___13818 12 0.0 1389.0 AXIS_PTS_REF ldpm_maf_8 MAX_GRAD 100 MONOTONY MON_INCREASE /end AXIS_DESCR
 /begin AXIS_DESCR COM_AXIS n LINEAR______0_000000__0H___81612 16 0.0 8160.0 AXIS_PTS_REF ldpm_n_11 MAX_GRAD 100 MONOTONY MON_INCREASE /end AXIS_DESCR
/end CHARACTERISTIC
/begin CHARACTERISTIC ip_ti_tco_1_pl_ivvt_2__n__maf "IP_TI_TCO_1_PL_IVVT_2" MAP 0x7d29c a_28 100 LINEAR______0_000000__0H___349_5 0.0 349.52
 /begin AXIS_DESCR COM_AXIS maf LINEAR______0_000000__0H___13818 12 0.0 1389.0 AXIS_PTS_REF ldpm_maf_8 MAX_GRAD 100 MONOTONY MON_INCREASE /end AXIS_DESCR
 /begin AXIS_DESCR COM_AXIS n LINEAR______0_000000__0H___81612 16 0.0 8160.0 AXIS_PTS_REF ldpm_n_11 MAX_GRAD 100 MONOTONY MON_INCREASE /end AXIS_DESCR
/end CHARACTERISTIC
/begin CHARACTERISTIC ip_ti_tco_2_is_ivvt__n__maf "IP_TI_TCO_2_IS_IVVT" MAP 0x7d41c a_28 100 LINEAR______0_000000__0H___349_5 0.0 349.52
 /begin AXIS_DESCR COM_AXIS maf LINEAR______0_000000__0H___13818 6 0.0 1389.0 AXIS_PTS_REF ldpm_maf_3 MAX_GRAD 100 MONOTONY MON_INCREASE /end AXIS_DESCR
 /begin AXIS_DESCR COM_AXIS n LINEAR______0_000000__0H___81612 6 0.0 8160.0 AXIS_PTS_REF ldpm_n_2 MAX_GRAD 100 MONOTONY MON_INCREASE /end AXIS_DESCR
/end CHARACTERISTIC
/begin CHARACTERISTIC ip_ti_tco_2_pl_ivvt_1__n__maf "IP_TI_TCO_2_PL_IVVT_1" MAP 0x7d464 a_28 100 LINEAR______0_000000__0H___349_5 0.0 349.52
 /begin AXIS_DESCR COM_AXIS maf LINEAR______0_000000__0H___13818 12 0.0 1389.0 AXIS_PTS_REF ldpm_maf_8 MAX_GRAD 100 MONOTONY MON_INCREASE /end AXIS_DESCR
 /begin AXIS_DESCR COM_AXIS n LINEAR______0_000000__0H___81612 16 0.0 8160.0 AXIS_PTS_REF ldpm_n_11 MAX_GRAD 100 MONOTONY MON_INCREASE /end AXIS_DESCR
/end CHARACTERISTIC
/begin CHARACTERISTIC ip_ti_tco_2_pl_ivvt_2__n__maf "IP_TI_TCO_2_PL_IVVT_2" MAP 0x7d5e4 a_28 100 LINEAR______0_000000__0H___349_5 0.0 349.52
 /begin AXIS_DESCR COM_AXIS maf LINEAR______0_000000__0H___13818 12 0.0 1389.0 AXIS_PTS_REF ldpm_maf_8 MAX_GRAD 100 MONOTONY MON_INCREASE /end AXIS_DESCR
 /begin AXIS_DESCR COM_AXIS n LINEAR______0_000000__0H___81612 16 0.0 8160.0 AXIS_PTS_REF ldpm_n_11 MAX_GRAD 100 MONOTONY MON_INCREASE /end AXIS_DESCR
/end CHARACTERISTIC
/begin CHARACTERISTIC ip_ti_tco_ch__tco "IP_TI_TCO_CH" CURVE 0x78a89 a_1 10 LINEAR______0_000000__0H___1_992 0.0 1.9921875
 /begin AXIS_DESCR COM_AXIS tco LINEAR_______48_000000__0H___142 8 -48.0 142.5 AXIS_PTS_REF ldpm_tco_7 MAX_GRAD 100 MONOTONY MON_INCREASE /end AXIS_DESCR
/end CHARACTERISTIC
/begin CHARACTERISTIC ip_ti_tco_ch_is__tco "IP_TI_TCO_CH_IS" CURVE 0x78a91 a_1 10 LINEAR______0_000000__0H___1_992 0.0 1.9921875
 /begin AXIS_DESCR COM_AXIS tco LINEAR_______48_000000__0H___142 8 -48.0 142.5 AXIS_PTS_REF ldpm_tco_7 MAX_GRAD 100 MONOTONY MON_INCREASE /end AXIS_DESCR
/end CHARACTERISTIC
/begin CHARACTERISTIC ip_ti_tco_neg_fast_wf__n__tco "IP_TI_TCO_NEG_FAST_WF" MAP 0x78a99 a_6 100 LINEAR______0_000000__0H___127_5 0.0 127.5
 /begin AXIS_DESCR COM_AXIS tco LINEAR_______48_000000__0H___142 8 -48.0 142.5 AXIS_PTS_REF ldpm_tco_10 MAX_GRAD 100 MONOTONY MON_INCREASE /end AXIS_DESCR
 /begin AXIS_DESCR COM_AXIS n LINEAR______0_000000__0H___8160_ 8 0.0 8160.0 AXIS_PTS_REF ldpm_n_32_9 MAX_GRAD 100 MONOTONY MON_INCREASE /end AXIS_DESCR
/end CHARACTERISTIC
/begin CHARACTERISTIC ip_ti_tco_neg_wf__n__tco "IP_TI_TCO_NEG_WF" MAP 0x78ad9 a_6 100 LINEAR______0_000000__0H___255_0 0.0 255.0
 /begin AXIS_DESCR COM_AXIS tco LINEAR_______48_000000__0H___142 8 -48.0 142.5 AXIS_PTS_REF ldpm_tco_10 MAX_GRAD 100 MONOTONY MON_INCREASE /end AXIS_DESCR
 /begin AXIS_DESCR COM_AXIS n LINEAR______0_000000__0H___8160_ 8 0.0 8160.0 AXIS_PTS_REF ldpm_n_32_9 MAX_GRAD 100 MONOTONY MON_INCREASE /end AXIS_DESCR
/end CHARACTERISTIC
/begin CHARACTERISTIC ip_ti_tco_pos_fast_wf__n__tco "IP_TI_TCO_POS_FAST_WF" MAP 0x78b19 a_6 100 LINEAR______0_000000__0H___127_5 0.0 127.5
 /begin AXIS_DESCR COM_AXIS tco LINEAR_______48_000000__0H___142 8 -48.0 142.5 AXIS_PTS_REF ldpm_tco_10 MAX_GRAD 100 MONOTONY MON_INCREASE /end AXIS_DESCR
 /begin AXIS_DESCR COM_AXIS n LINEAR______0_000000__0H___8160_ 8 0.0 8160.0 AXIS_PTS_REF ldpm_n_32_9 MAX_GRAD 100 MONOTONY MON_INCREASE /end AXIS_DESCR
/end CHARACTERISTIC
/begin CHARACTERISTIC ip_ti_tco_pos_wf__n__tco "IP_TI_TCO_POS_WF" MAP 0x78b59 a_6 100 LINEAR______0_000000__0H___255_0 0.0 255.0
 /begin AXIS_DESCR COM_AXIS tco LINEAR_______48_000000__0H___142 8 -48.0 142.5 AXIS_PTS_REF ldpm_tco_10 MAX_GRAD 100 MONOTONY MON_INCREASE /end AXIS_DESCR
 /begin AXIS_DESCR COM_AXIS n LINEAR______0_000000__0H___8160_ 8 0.0 8160.0 AXIS_PTS_REF ldpm_n_32_9 MAX_GRAD 100 MONOTONY MON_INCREASE /end AXIS_DESCR
/end CHARACTERISTIC
/begin CHARACTERISTIC ip_ti_tco_sawup__tco__km_ctr "IP_TI_TCO_SAWUP" MAP 0x78b99 a_31 10 LINEAR______0_000000__0H___1_992 0.0 1.9921875
 /begin AXIS_DESCR COM_AXIS km_ctr LINEAR______0_000000__0H___65534 4 0.0 655340.0 AXIS_PTS_REF ldpm_km_ctr_1 MAX_GRAD 100 MONOTONY MON_INCREASE /end AXIS_DESCR
 /begin AXIS_DESCR COM_AXIS tco LINEAR_______48_000000__0H___142 8 -48.0 142.5 AXIS_PTS_REF ldpm_tco_1 MAX_GRAD 100 MONOTONY MON_INCREASE /end AXIS_DESCR
/end CHARACTERISTIC
/begin CHARACTERISTIC ip_ti_tco_sawup_is__tco__km_ctr "IP_TI_TCO_SAWUP_IS" MAP 0x78bb9 a_31 10 LINEAR______0_000000__0H___1_992 0.0 1.9921875
 /begin AXIS_DESCR COM_AXIS km_ctr LINEAR______0_000000__0H___65534 4 0.0 655340.0 AXIS_PTS_REF ldpm_km_ctr_1 MAX_GRAD 100 MONOTONY MON_INCREASE /end AXIS_DESCR
 /begin AXIS_DESCR COM_AXIS tco LINEAR_______48_000000__0H___142 8 -48.0 142.5 AXIS_PTS_REF ldpm_tco_1 MAX_GRAD 100 MONOTONY MON_INCREASE /end AXIS_DESCR
/end CHARACTERISTIC
/begin CHARACTERISTIC ip_ti_tco_wup__tco__tco_st "IP_TI_TCO_WUP" MAP 0x78bd9 a_6 10 LINEAR______0_000000__0H___1_992 0.0 1.9921875
 /begin AXIS_DESCR COM_AXIS tco_st LINEAR_______48_000000__0H___142 3 -48.0 142.5 AXIS_PTS_REF ldpm_tco_st_10 MAX_GRAD 100 MONOTONY MON_INCREASE /end AXIS_DESCR
 /begin AXIS_DESCR COM_AXIS tco LINEAR_______48_000000__0H___142 8 -48.0 142.5 AXIS_PTS_REF ldpm_tco_14 MAX_GRAD 100 MONOTONY MON_INCREASE /end AXIS_DESCR
/end CHARACTERISTIC
/begin CHARACTERISTIC ip_ti_tco_wup_is__tco__tco_st "IP_TI_TCO_WUP_IS" MAP 0x78bf1 a_6 10 LINEAR______0_000000__0H___1_992 0.0 1.9921875
 /begin AXIS_DESCR COM_AXIS tco_st LINEAR_______48_000000__0H___142 3 -48.0 142.5 AXIS_PTS_REF ldpm_tco_st_10 MAX_GRAD 100 MONOTONY MON_INCREASE /end AXIS_DESCR
 /begin AXIS_DESCR COM_AXIS tco LINEAR_______48_000000__0H___142 8 -48.0 142.5 AXIS_PTS_REF ldpm_tco_14 MAX_GRAD 100 MONOTONY MON_INCREASE /end AXIS_DESCR
/end CHARACTERISTIC
/begin CHARACTERISTIC ip_ti_tra_fac__tco__tia "IP_TI_TRA_FAC" MAP 0x78c09 a_6 100 LINEAR______0_000000__0H___1_992 0.0 1.9921875
 /begin AXIS_DESCR COM_AXIS tia LINEAR_______48_000000__0H___142 4 -48.0 142.5 AXIS_PTS_REF ldp_tia__ti_tra_fac MAX_GRAD 100 MONOTONY MON_INCREASE /end AXIS_DESCR
 /begin AXIS_DESCR COM_AXIS tco LINEAR_______48_000000__0H___142 4 -48.0 142.5 AXIS_PTS_REF ldp_tco__ti_tra_fac MAX_GRAD 100 MONOTONY MON_INCREASE /end AXIS_DESCR
/end CHARACTERISTIC
/begin CHARACTERISTIC ip_ti_vo_fast_wf__vo "IP_TI_VO_FAST_WF" CURVE 0x78c19 a_7 100 LINEAR______0_000000__0H___1_992 0.0 1.9921875
 /begin AXIS_DESCR COM_AXIS vo LINEAR______0_000000__0H___120_0 8 0.0 120.0 AXIS_PTS_REF ldpm_vo_1 MAX_GRAD 100 MONOTONY MON_INCREASE /end AXIS_DESCR
/end CHARACTERISTIC
/begin CHARACTERISTIC ip_ti_vo_slow_wf__vo "IP_TI_VO_SLOW_WF" CURVE 0x78c21 a_7 100 LINEAR______0_000000__0H___1_992 0.0 1.9921875
 /begin AXIS_DESCR COM_AXIS vo LINEAR______0_000000__0H___120_0 8 0.0 120.0 AXIS_PTS_REF ldpm_vo_1 MAX_GRAD 100 MONOTONY MON_INCREASE /end AXIS_DESCR
/end CHARACTERISTIC
/begin CHARACTERISTIC ip_ti_vo_wup__tco__vo "IP_TI_VO_WUP" MAP 0x78c29 a_31 100 LINEAR______0_500000__40H___1_50 0.5 1.5
 /begin AXIS_DESCR COM_AXIS vo LINEAR______0_000000__0H___120_0 8 0.0 120.0 AXIS_PTS_REF ldpm_vo_2 MAX_GRAD 100 MONOTONY MON_INCREASE /end AXIS_DESCR
 /begin AXIS_DESCR COM_AXIS tco LINEAR_______48_000000__0H___142 8 -48.0 142.5 AXIS_PTS_REF ldpm_tco_16 MAX_GRAD 100 MONOTONY MON_INCREASE /end AXIS_DESCR
/end CHARACTERISTIC
/begin CHARACTERISTIC ip_ti_wup__n__maf "IP_TI_WUP" MAP 0x78c69 a_6 15 LINEAR______0_000000__0H___0_996 0.0 0.99609375
 /begin AXIS_DESCR COM_AXIS maf LINEAR______0_000000__0H___1389_ 8 0.0 1389.0 AXIS_PTS_REF ldpm_maf_9 MAX_GRAD 100 MONOTONY MON_INCREASE /end AXIS_DESCR
 /begin AXIS_DESCR COM_AXIS n LINEAR______0_000000__0H___8160_ 8 0.0 8160.0 AXIS_PTS_REF ldpm_n_32_20 MAX_GRAD 100 MONOTONY MON_INCREASE /end AXIS_DESCR
/end CHARACTERISTIC
/begin CHARACTERISTIC ip_tia__v_tia "IP_TIA" CURVE 0x78ca9 a_1 15 LINEAR_______48_000000__0H___142 -48.0 142.5
 /begin AXIS_DESCR COM_AXIS dummy_b LINEAR______0_039000__2H___4_986 16 0.039 4.986 AXIS_PTS_REF ldp_v_tia__tia MAX_GRAD 100 MONOTONY MON_INCREASE /end AXIS_DESCR
/end CHARACTERISTIC
/begin CHARACTERISTIC ip_tib__n__maf "IP_TIB" MAP 0x7d764 a_28 25 LINEAR______0_000000__0H___349_5 0.0 349.52
 /begin AXIS_DESCR COM_AXIS maf LINEAR______0_000000__0H___13818 12 0.0 1389.0 AXIS_PTS_REF ldpm_maf_8 MAX_GRAD 100 MONOTONY MON_INCREASE /end AXIS_DESCR
 /begin AXIS_DESCR COM_AXIS n LINEAR______0_000000__0H___81612 16 0.0 8160.0 AXIS_PTS_REF ldpm_n_11 MAX_GRAD 100 MONOTONY MON_INCREASE /end AXIS_DESCR
/end CHARACTERISTIC
/begin CHARACTERISTIC ip_tipr_cst__tco "IP_TIPR_CST" CURVE 0x7d8e4 a_3 10 LINEAR______0_000000__0H___349_5 0.0 349.52
 /begin AXIS_DESCR COM_AXIS tco LINEAR_______48_000000__0H___142 8 -48.0 142.5 AXIS_PTS_REF ldpm_tco_3 MAX_GRAD 100 MONOTONY MON_INCREASE /end AXIS_DESCR
/end CHARACTERISTIC
/begin CHARACTERISTIC ip_tipr_fac_st_es__tco "IP_TIPR_FAC_ST_ES" CURVE 0x78cb9 a_1 100 LINEAR______0_000000__0H___0_996 0.0 0.99609375
 /begin AXIS_DESCR COM_AXIS tco LINEAR_______48_000000__0H___142 8 -48.0 142.5 AXIS_PTS_REF ldpm_tco_3 MAX_GRAD 100 MONOTONY MON_INCREASE /end AXIS_DESCR
/end CHARACTERISTIC
/begin CHARACTERISTIC ip_tmag__toil__tco "IP_TMAG" MAP 0x78cc1 a_6 100 LINEAR_______48_000000__0H___155 -48.0 155.0
 /begin AXIS_DESCR COM_AXIS tco LINEAR_______48_000000__0H___142 10 -48.0 142.5 AXIS_PTS_REF ldp_tco__tmag MAX_GRAD 100 MONOTONY MON_INCREASE /end AXIS_DESCR
 /begin AXIS_DESCR COM_AXIS toil LINEAR_______48_000000__0H___155 10 -48.0 155.0 AXIS_PTS_REF ldp_toil__tmag MAX_GRAD 100 MONOTONY MON_INCREASE /end AXIS_DESCR
/end CHARACTERISTIC
/begin CHARACTERISTIC ip_toil__v_toil "IP_TOIL" CURVE 0x78d25 a_1 100 LINEAR_______48_000000__0H___155 -48.0 155.0
 /begin AXIS_DESCR COM_AXIS dummy_b LINEAR______0_000000__0H___5_074 16 0.0 5.0 AXIS_PTS_REF ldp_v_toil__toil MAX_GRAD 100 MONOTONY MON_INCREASE /end AXIS_DESCR
/end CHARACTERISTIC
/begin CHARACTERISTIC ip_toil_max_ivvt__n "IP_TOIL_MAX_IVVT" CURVE 0x78d35 a_1 100 LINEAR_______48_000000__0H___155 -48.0 155.0
 /begin AXIS_DESCR COM_AXIS n LINEAR______0_000000__0H___8160_ 6 0.0 8160.0 AXIS_PTS_REF ldpm_n_32_22 MAX_GRAD 100 MONOTONY MON_INCREASE /end AXIS_DESCR
/end CHARACTERISTIC
/begin CHARACTERISTIC ip_toil_max_ivvt_diag__n "IP_TOIL_MAX_IVVT_DIAG" CURVE 0x78d3b a_1 100 LINEAR_______48_000000__0H___155 -48.0 155.0
 /begin AXIS_DESCR COM_AXIS n_32 LINEAR______0_000000__0H___8160_ 4 0.0 8160.0 AXIS_PTS_REF ldpm_n_32_47 MAX_GRAD 100 MONOTONY MON_INCREASE /end AXIS_DESCR
/end CHARACTERISTIC
/begin CHARACTERISTIC ip_toil_min_ivvt_diag__n "IP_TOIL_MIN_IVVT_DIAG" CURVE 0x78d3f a_1 100 LINEAR_______48_000000__0H___155 -48.0 155.0
 /begin AXIS_DESCR COM_AXIS n_32 LINEAR______0_000000__0H___8160_ 4 0.0 8160.0 AXIS_PTS_REF ldpm_n_32_47 MAX_GRAD 100 MONOTONY MON_INCREASE /end AXIS_DESCR
/end CHARACTERISTIC
/begin CHARACTERISTIC ip_tors_0_at__n_32 "IP_TORS_0_AT" CURVE 0x7d8f4 a_3 100 LINEAR______0_000000__0H___1_996 0.0 1.9961
 /begin AXIS_DESCR COM_AXIS n_32 LINEAR______0_000000__0H___8160_ 6 0.0 8160.0 AXIS_PTS_REF ldpm_n_32_31 MAX_GRAD 100 MONOTONY MON_INCREASE /end AXIS_DESCR
/end CHARACTERISTIC
/begin CHARACTERISTIC ip_tors_0_at_er__n_32__maf "IP_TORS_0_AT_ER" MAP 0x7d900 a_9 100 LINEAR_______21844_000000__1H___ -21844.0 21844.0
 /begin AXIS_DESCR COM_AXIS maf LINEAR______0_000000__0H___1389_ 6 0.0 1389.0 AXIS_PTS_REF ldp_maf__tors_0_at_er MAX_GRAD 10 MONOTONY MON_INCREASE /end AXIS_DESCR
 /begin AXIS_DESCR COM_AXIS n_32 LINEAR______0_000000__0H___8160_ 6 0.0 8160.0 AXIS_PTS_REF ldpm_n_32_31 MAX_GRAD 100 MONOTONY MON_INCREASE /end AXIS_DESCR
/end CHARACTERISTIC
/begin CHARACTERISTIC ip_tors_0_mt__n_32 "IP_TORS_0_MT" CURVE 0x7d948 a_3 100 LINEAR______0_000000__0H___1_996 0.0 1.9961
 /begin AXIS_DESCR COM_AXIS n_32 LINEAR______0_000000__0H___8160_ 6 0.0 8160.0 AXIS_PTS_REF ldpm_n_32_32 MAX_GRAD 100 MONOTONY MON_INCREASE /end AXIS_DESCR
/end CHARACTERISTIC
/begin CHARACTERISTIC ip_tors_0_mt_er__n_32__maf "IP_TORS_0_MT_ER" MAP 0x7d954 a_9 100 LINEAR_______21844_000000__1H___ -21844.0 21844.0
 /begin AXIS_DESCR COM_AXIS maf LINEAR______0_000000__0H___1389_ 6 0.0 1389.0 AXIS_PTS_REF ldp_maf__tors_0_mt_er MAX_GRAD 10 MONOTONY MON_INCREASE /end AXIS_DESCR
 /begin AXIS_DESCR COM_AXIS n_32 LINEAR______0_000000__0H___8160_ 6 0.0 8160.0 AXIS_PTS_REF ldpm_n_32_32 MAX_GRAD 100 MONOTONY MON_INCREASE /end AXIS_DESCR
/end CHARACTERISTIC
/begin CHARACTERISTIC ip_tors_1_at__n_32 "IP_TORS_1_AT" CURVE 0x7d99c a_3 100 LINEAR______0_000000__0H___1_996 0.0 1.9961
 /begin AXIS_DESCR COM_AXIS n_32 LINEAR______0_000000__0H___8160_ 6 0.0 8160.0 AXIS_PTS_REF ldpm_n_32_33 MAX_GRAD 100 MONOTONY MON_INCREASE /end AXIS_DESCR
/end CHARACTERISTIC
/begin CHARACTERISTIC ip_tors_1_at_er__n_32__maf "IP_TORS_1_AT_ER" MAP 0x7d9a8 a_9 100 LINEAR_______21844_000000__1H___ -21844.0 21844.0
 /begin AXIS_DESCR COM_AXIS maf LINEAR______0_000000__0H___1389_ 6 0.0 1389.0 AXIS_PTS_REF ldp_maf__tors_1_at_er MAX_GRAD 10 MONOTONY MON_INCREASE /end AXIS_DESCR
 /begin AXIS_DESCR COM_AXIS n_32 LINEAR______0_000000__0H___8160_ 6 0.0 8160.0 AXIS_PTS_REF ldpm_n_32_33 MAX_GRAD 100 MONOTONY MON_INCREASE /end AXIS_DESCR
/end CHARACTERISTIC
/begin CHARACTERISTIC ip_tors_1_mt__n_32 "IP_TORS_1_MT" CURVE 0x7d9f0 a_3 100 LINEAR______0_000000__0H___1_996 0.0 1.9961
 /begin AXIS_DESCR COM_AXIS n_32 LINEAR______0_000000__0H___8160_ 6 0.0 8160.0 AXIS_PTS_REF ldpm_n_32_34 MAX_GRAD 100 MONOTONY MON_INCREASE /end AXIS_DESCR
/end CHARACTERISTIC
/begin CHARACTERISTIC ip_tors_1_mt_er__n_32__maf "IP_TORS_1_MT_ER" MAP 0x7d9fc a_9 100 LINEAR_______21844_000000__1H___ -21844.0 21844.0
 /begin AXIS_DESCR COM_AXIS maf LINEAR______0_000000__0H___1389_ 6 0.0 1389.0 AXIS_PTS_REF ldp_maf__tors_1_mt_er MAX_GRAD 10 MONOTONY MON_INCREASE /end AXIS_DESCR
 /begin AXIS_DESCR COM_AXIS n_32 LINEAR______0_000000__0H___8160_ 6 0.0 8160.0 AXIS_PTS_REF ldpm_n_32_34 MAX_GRAD 100 MONOTONY MON_INCREASE /end AXIS_DESCR
/end CHARACTERISTIC
/begin CHARACTERISTIC ip_tors_2_at__n_32 "IP_TORS_2_AT" CURVE 0x7da44 a_3 100 LINEAR______0_000000__0H___1_996 0.0 1.9961
 /begin AXIS_DESCR COM_AXIS n_32 LINEAR______0_000000__0H___8160_ 6 0.0 8160.0 AXIS_PTS_REF ldpm_n_32_35 MAX_GRAD 100 MONOTONY MON_INCREASE /end AXIS_DESCR
/end CHARACTERISTIC
/begin CHARACTERISTIC ip_tors_2_at_er__n_32__maf "IP_TORS_2_AT_ER" MAP 0x7da50 a_9 100 LINEAR_______21844_000000__1H___ -21844.0 21844.0
 /begin AXIS_DESCR COM_AXIS maf LINEAR______0_000000__0H___1389_ 6 0.0 1389.0 AXIS_PTS_REF ldp_maf__tors_2_at_er MAX_GRAD 10 MONOTONY MON_INCREASE /end AXIS_DESCR
 /begin AXIS_DESCR COM_AXIS n_32 LINEAR______0_000000__0H___8160_ 6 0.0 8160.0 AXIS_PTS_REF ldpm_n_32_35 MAX_GRAD 100 MONOTONY MON_INCREASE /end AXIS_DESCR
/end CHARACTERISTIC
/begin CHARACTERISTIC ip_tors_2_mt__n_32 "IP_TORS_2_MT" CURVE 0x7da98 a_3 100 LINEAR______0_000000__0H___1_996 0.0 1.9961
 /begin AXIS_DESCR COM_AXIS n_32 LINEAR______0_000000__0H___8160_ 6 0.0 8160.0 AXIS_PTS_REF ldpm_n_32_36 MAX_GRAD 100 MONOTONY MON_INCREASE /end AXIS_DESCR
/end CHARACTERISTIC
/begin CHARACTERISTIC ip_tors_2_mt_er__n_32__maf "IP_TORS_2_MT_ER" MAP 0x7daa4 a_9 100 LINEAR_______21844_000000__1H___ -21844.0 21844.0
 /begin AXIS_DESCR COM_AXIS maf LINEAR______0_000000__0H___1389_ 6 0.0 1389.0 AXIS_PTS_REF ldp_maf__tors_2_mt_er MAX_GRAD 10 MONOTONY MON_INCREASE /end AXIS_DESCR
 /begin AXIS_DESCR COM_AXIS n_32 LINEAR______0_000000__0H___8160_ 6 0.0 8160.0 AXIS_PTS_REF ldpm_n_32_36 MAX_GRAD 100 MONOTONY MON_INCREASE /end AXIS_DESCR
/end CHARACTERISTIC
/begin CHARACTERISTIC ip_tors_3_at__n_32 "IP_TORS_3_AT" CURVE 0x7daec a_3 100 LINEAR______0_000000__0H___1_996 0.0 1.9961
 /begin AXIS_DESCR COM_AXIS n_32 LINEAR______0_000000__0H___8160_ 6 0.0 8160.0 AXIS_PTS_REF ldpm_n_32_37 MAX_GRAD 100 MONOTONY MON_INCREASE /end AXIS_DESCR
/end CHARACTERISTIC
/begin CHARACTERISTIC ip_tors_3_at_er__n_32__maf "IP_TORS_3_AT_ER" MAP 0x7daf8 a_9 100 LINEAR_______21844_000000__1H___ -21844.0 21844.0
 /begin AXIS_DESCR COM_AXIS maf LINEAR______0_000000__0H___1389_ 6 0.0 1389.0 AXIS_PTS_REF ldp_maf__tors_3_at_er MAX_GRAD 10 MONOTONY MON_INCREASE /end AXIS_DESCR
 /begin AXIS_DESCR COM_AXIS n_32 LINEAR______0_000000__0H___8160_ 6 0.0 8160.0 AXIS_PTS_REF ldpm_n_32_37 MAX_GRAD 100 MONOTONY MON_INCREASE /end AXIS_DESCR
/end CHARACTERISTIC
/begin CHARACTERISTIC ip_tors_3_mt__n_32 "IP_TORS_3_MT" CURVE 0x7db40 a_3 100 LINEAR______0_000000__0H___1_996 0.0 1.9961
 /begin AXIS_DESCR COM_AXIS n_32 LINEAR______0_000000__0H___8160_ 6 0.0 8160.0 AXIS_PTS_REF ldpm_n_32_38 MAX_GRAD 100 MONOTONY MON_INCREASE /end AXIS_DESCR
/end CHARACTERISTIC
/begin CHARACTERISTIC ip_tors_3_mt_er__n_32__maf "IP_TORS_3_MT_ER" MAP 0x7db4c a_9 100 LINEAR_______21844_000000__1H___ -21844.0 21844.0
 /begin AXIS_DESCR COM_AXIS maf LINEAR______0_000000__0H___1389_ 6 0.0 1389.0 AXIS_PTS_REF ldp_maf__tors_3_mt_er MAX_GRAD 10 MONOTONY MON_INCREASE /end AXIS_DESCR
 /begin AXIS_DESCR COM_AXIS n_32 LINEAR______0_000000__0H___8160_ 6 0.0 8160.0 AXIS_PTS_REF ldpm_n_32_38 MAX_GRAD 100 MONOTONY MON_INCREASE /end AXIS_DESCR
/end CHARACTERISTIC
/begin CHARACTERISTIC ip_tors_4_at__n_32 "IP_TORS_4_AT" CURVE 0x7db94 a_3 100 LINEAR______0_000000__0H___1_996 0.0 1.9961
 /begin AXIS_DESCR COM_AXIS n_32 LINEAR______0_000000__0H___8160_ 6 0.0 8160.0 AXIS_PTS_REF ldpm_n_32_39 MAX_GRAD 100 MONOTONY MON_INCREASE /end AXIS_DESCR
/end CHARACTERISTIC
/begin CHARACTERISTIC ip_tors_4_at_er__n_32__maf "IP_TORS_4_AT_ER" MAP 0x7dba0 a_9 100 LINEAR_______21844_000000__1H___ -21844.0 21844.0
 /begin AXIS_DESCR COM_AXIS maf LINEAR______0_000000__0H___1389_ 6 0.0 1389.0 AXIS_PTS_REF ldp_maf__tors_4_at_er MAX_GRAD 10 MONOTONY MON_INCREASE /end AXIS_DESCR
 /begin AXIS_DESCR COM_AXIS n_32 LINEAR______0_000000__0H___8160_ 6 0.0 8160.0 AXIS_PTS_REF ldpm_n_32_39 MAX_GRAD 100 MONOTONY MON_INCREASE /end AXIS_DESCR
/end CHARACTERISTIC
/begin CHARACTERISTIC ip_tors_4_mt__n_32 "IP_TORS_4_MT" CURVE 0x7dbe8 a_3 100 LINEAR______0_000000__0H___1_996 0.0 1.9961
 /begin AXIS_DESCR COM_AXIS n_32 LINEAR______0_000000__0H___8160_ 6 0.0 8160.0 AXIS_PTS_REF ldpm_n_32_40 MAX_GRAD 100 MONOTONY MON_INCREASE /end AXIS_DESCR
/end CHARACTERISTIC
/begin CHARACTERISTIC ip_tors_4_mt_er__n_32__maf "IP_TORS_4_MT_ER" MAP 0x7dbf4 a_9 100 LINEAR_______21844_000000__1H___ -21844.0 21844.0
 /begin AXIS_DESCR COM_AXIS maf LINEAR______0_000000__0H___1389_ 6 0.0 1389.0 AXIS_PTS_REF ldp_maf__tors_4_mt_er MAX_GRAD 10 MONOTONY MON_INCREASE /end AXIS_DESCR
 /begin AXIS_DESCR COM_AXIS n_32 LINEAR______0_000000__0H___8160_ 6 0.0 8160.0 AXIS_PTS_REF ldpm_n_32_40 MAX_GRAD 100 MONOTONY MON_INCREASE /end AXIS_DESCR
/end CHARACTERISTIC
/begin CHARACTERISTIC ip_tors_5_at__n_32 "IP_TORS_5_AT" CURVE 0x7dc3c a_3 100 LINEAR______0_000000__0H___1_996 0.0 1.9961
 /begin AXIS_DESCR COM_AXIS n_32 LINEAR______0_000000__0H___8160_ 6 0.0 8160.0 AXIS_PTS_REF ldpm_n_32_41 MAX_GRAD 100 MONOTONY MON_INCREASE /end AXIS_DESCR
/end CHARACTERISTIC
/begin CHARACTERISTIC ip_tors_5_at_er__n_32__maf "IP_TORS_5_AT_ER" MAP 0x7dc48 a_9 100 LINEAR_______21844_000000__1H___ -21844.0 21844.0
 /begin AXIS_DESCR COM_AXIS maf LINEAR______0_000000__0H___1389_ 6 0.0 1389.0 AXIS_PTS_REF ldp_maf__tors_5_at_er MAX_GRAD 10 MONOTONY MON_INCREASE /end AXIS_DESCR
 /begin AXIS_DESCR COM_AXIS n_32 LINEAR______0_000000__0H___8160_ 6 0.0 8160.0 AXIS_PTS_REF ldpm_n_32_41 MAX_GRAD 100 MONOTONY MON_INCREASE /end AXIS_DESCR
/end CHARACTERISTIC
/begin CHARACTERISTIC ip_tors_5_mt__n_32 "IP_TORS_5_MT" CURVE 0x7dc90 a_3 100 LINEAR______0_000000__0H___1_996 0.0 1.9961
 /begin AXIS_DESCR COM_AXIS n_32 LINEAR______0_000000__0H___8160_ 6 0.0 8160.0 AXIS_PTS_REF ldpm_n_32_42 MAX_GRAD 100 MONOTONY MON_INCREASE /end AXIS_DESCR
/end CHARACTERISTIC
/begin CHARACTERISTIC ip_tors_5_mt_er__n_32__maf "IP_TORS_5_MT_ER" MAP 0x7dc9c a_9 100 LINEAR_______21844_000000__1H___ -21844.0 21844.0
 /begin AXIS_DESCR COM_AXIS maf LINEAR______0_000000__0H___1389_ 6 0.0 1389.0 AXIS_PTS_REF ldp_maf__tors_5_mt_er MAX_GRAD 10 MONOTONY MON_INCREASE /end AXIS_DESCR
 /begin AXIS_DESCR COM_AXIS n_32 LINEAR______0_000000__0H___8160_ 6 0.0 8160.0 AXIS_PTS_REF ldpm_n_32_42 MAX_GRAD 100 MONOTONY MON_INCREASE /end AXIS_DESCR
/end CHARACTERISTIC
/begin CHARACTERISTIC ip_tps_max_tps_ratio_diag__n "IP_TPS_MAX_TPS_RATIO_DIAG" CURVE 0x7dce4 a_3 100 LINEAR______0_000000__0H___11975 0.0 119.5
 /begin AXIS_DESCR COM_AXIS n_32 LINEAR______0_000000__0H___8160_ 4 0.0 8160.0 AXIS_PTS_REF ldp_n__tps_max_tps_ratio_diag MAX_GRAD 100 MONOTONY MON_INCREASE /end AXIS_DESCR
/end CHARACTERISTIC
/begin CHARACTERISTIC ip_tps_req_ltc_min_0__n__maf_mmv "IP_TPS_REQ_LTC_MIN_0" MAP 0x7de0c a_28 100 LINEAR______0_000000__0H___11975 0.0 119.5
 /begin AXIS_DESCR COM_AXIS maf_mmv LINEAR______0_000000__0H___13818 4 0.0 1389.0 AXIS_PTS_REF ldpm_maf_mmv_1 MAX_GRAD 100 MONOTONY MON_INCREASE /end AXIS_DESCR
 /begin AXIS_DESCR COM_AXIS n LINEAR______0_000000__0H___81612 6 0.0 8160.0 AXIS_PTS_REF ldpm_n_24 MAX_GRAD 100 MONOTONY MON_INCREASE /end AXIS_DESCR
/end CHARACTERISTIC
/begin CHARACTERISTIC ip_tps_req_ltc_min_1__n__maf_mmv "IP_TPS_REQ_LTC_MIN_1" MAP 0x7de3c a_28 100 LINEAR______0_000000__0H___11975 0.0 119.5
 /begin AXIS_DESCR COM_AXIS maf_mmv LINEAR______0_000000__0H___13818 4 0.0 1389.0 AXIS_PTS_REF ldpm_maf_mmv_1 MAX_GRAD 100 MONOTONY MON_INCREASE /end AXIS_DESCR
 /begin AXIS_DESCR COM_AXIS n LINEAR______0_000000__0H___81612 6 0.0 8160.0 AXIS_PTS_REF ldpm_n_24 MAX_GRAD 100 MONOTONY MON_INCREASE /end AXIS_DESCR
/end CHARACTERISTIC
/begin CHARACTERISTIC ip_tps_req_ltc_min_2__n__maf_mmv "IP_TPS_REQ_LTC_MIN_2" MAP 0x7de6c a_28 100 LINEAR______0_000000__0H___11975 0.0 119.5
 /begin AXIS_DESCR COM_AXIS maf_mmv LINEAR______0_000000__0H___13818 4 0.0 1389.0 AXIS_PTS_REF ldpm_maf_mmv_1 MAX_GRAD 100 MONOTONY MON_INCREASE /end AXIS_DESCR
 /begin AXIS_DESCR COM_AXIS n LINEAR______0_000000__0H___81612 6 0.0 8160.0 AXIS_PTS_REF ldpm_n_24 MAX_GRAD 100 MONOTONY MON_INCREASE /end AXIS_DESCR
/end CHARACTERISTIC
/begin CHARACTERISTIC ip_tps_req_ltc_min_3__n__maf_mmv "IP_TPS_REQ_LTC_MIN_3" MAP 0x7de9c a_28 100 LINEAR______0_000000__0H___11975 0.0 119.5
 /begin AXIS_DESCR COM_AXIS maf_mmv LINEAR______0_000000__0H___13818 4 0.0 1389.0 AXIS_PTS_REF ldpm_maf_mmv_1 MAX_GRAD 100 MONOTONY MON_INCREASE /end AXIS_DESCR
 /begin AXIS_DESCR COM_AXIS n LINEAR______0_000000__0H___81612 6 0.0 8160.0 AXIS_PTS_REF ldpm_n_24 MAX_GRAD 100 MONOTONY MON_INCREASE /end AXIS_DESCR
/end CHARACTERISTIC
/begin CHARACTERISTIC ip_tps_req_ltc_min_4__n__maf_mmv "IP_TPS_REQ_LTC_MIN_4" MAP 0x7decc a_28 100 LINEAR______0_000000__0H___11975 0.0 119.5
 /begin AXIS_DESCR COM_AXIS maf_mmv LINEAR______0_000000__0H___13818 4 0.0 1389.0 AXIS_PTS_REF ldpm_maf_mmv_1 MAX_GRAD 100 MONOTONY MON_INCREASE /end AXIS_DESCR
 /begin AXIS_DESCR COM_AXIS n LINEAR______0_000000__0H___81612 6 0.0 8160.0 AXIS_PTS_REF ldpm_n_24 MAX_GRAD 100 MONOTONY MON_INCREASE /end AXIS_DESCR
/end CHARACTERISTIC
/begin CHARACTERISTIC ip_tps_req_ltc_min_5__n__maf_mmv "IP_TPS_REQ_LTC_MIN_5" MAP 0x7defc a_28 100 LINEAR______0_000000__0H___11975 0.0 119.5
 /begin AXIS_DESCR COM_AXIS maf_mmv LINEAR______0_000000__0H___13818 4 0.0 1389.0 AXIS_PTS_REF ldpm_maf_mmv_1 MAX_GRAD 100 MONOTONY MON_INCREASE /end AXIS_DESCR
 /begin AXIS_DESCR COM_AXIS n LINEAR______0_000000__0H___81612 6 0.0 8160.0 AXIS_PTS_REF ldpm_n_24 MAX_GRAD 100 MONOTONY MON_INCREASE /end AXIS_DESCR
/end CHARACTERISTIC
/begin CHARACTERISTIC ip_tps_sp_amp_cor_st__fac_amp__n "IP_TPS_SP_AMP_COR_ST" MAP 0x7df2c a_50 100 LINEAR_______60_000000__0H___59_ -60.0 59.998169
 /begin AXIS_DESCR COM_AXIS n LINEAR______0_000000__0H___81612 4 0.0 8160.0 AXIS_PTS_REF ldpm_n_22 MAX_GRAD 100 MONOTONY MON_INCREASE /end AXIS_DESCR
 /begin AXIS_DESCR COM_AXIS fac_amp LINEAR______0_000000__0H___1_992 6 0.0 1.9921875 AXIS_PTS_REF ldp_fac_amp__tps_sp_amp_cor_st MAX_GRAD 100 MONOTONY MON_INCREASE /end AXIS_DESCR
/end CHARACTERISTIC
/begin CHARACTERISTIC ip_tps_sp_pvs__pvs__n "IP_TPS_SP_PVS" MAP 0x7df5c a_36 100 LINEAR______0_000000__0H___119_9 0.0 119.99817
 /begin AXIS_DESCR COM_AXIS n LINEAR______0_000000__0H___8160_ 12 0.0 8160.0 AXIS_PTS_REF ldpm_n_32_3 MAX_GRAD 100 MONOTONY MON_INCREASE /end AXIS_DESCR
 /begin AXIS_DESCR COM_AXIS dummy_b LINEAR______0_000000__0H___119_8 12 0.0 119.8828 AXIS_PTS_REF ldpm_pvs_3 MAX_GRAD 100 MONOTONY MON_INCREASE /end AXIS_DESCR
/end CHARACTERISTIC
/begin CHARACTERISTIC ip_tps_sp_st__tco__n "IP_TPS_SP_ST" MAP 0x7e09c a_50 100 LINEAR______0_000000__0H___119_9 0.0 119.99817
 /begin AXIS_DESCR COM_AXIS n LINEAR______0_000000__0H___81612 4 0.0 8160.0 AXIS_PTS_REF ldpm_n_22 MAX_GRAD 100 MONOTONY MON_INCREASE /end AXIS_DESCR
 /begin AXIS_DESCR COM_AXIS tco LINEAR_______48_000000__0H___142 8 -48.0 142.5 AXIS_PTS_REF ldpm_tco_3 MAX_GRAD 100 MONOTONY MON_INCREASE /end AXIS_DESCR
/end CHARACTERISTIC
/begin CHARACTERISTIC ip_tps_sp_st_pvs__pvs_av "IP_TPS_SP_ST_PVS" CURVE 0x7e0dc a_24 100 LINEAR______0_000000__0H___119_9 0.0 119.99817
 /begin AXIS_DESCR COM_AXIS pvs_av LINEAR______0_000000__0H___119_9 4 0.0 119.99817 AXIS_PTS_REF ldp_pvs_av__tps_sp_st_pvs MAX_GRAD 100 MONOTONY MON_INCREASE /end AXIS_DESCR
/end CHARACTERISTIC
/begin CHARACTERISTIC ip_tq_ast_ofs__t_ast "IP_TQ_AST_OFS" CURVE 0x7e0e4 a_24 100 LINEAR______0_000000__0H___1023_ 0.0 1023.0
 /begin AXIS_DESCR COM_AXIS t_ast LINEAR______0_000000__0H___6553_ 4 0.0 6553.5 AXIS_PTS_REF ldp_t_ast__tq_ast_ofs MAX_GRAD 100 MONOTONY MON_INCREASE /end AXIS_DESCR
/end CHARACTERISTIC
/begin CHARACTERISTIC ip_tq_loss_acc__n__tq_accin_can "IP_TQ_LOSS_ACC" MAP 0x7e0ec a_9 100 LINEAR______0_000000__0H___1022_ 0.0 1022.9688
 /begin AXIS_DESCR COM_AXIS tq_accin_can LINEAR______0_000000__0H___31_00 6 0.0 31.0 AXIS_PTS_REF ldp_tq_accin_can__tq_loss_acc MAX_GRAD 100 MONOTONY MON_INCREASE /end AXIS_DESCR
 /begin AXIS_DESCR COM_AXIS n_32 LINEAR______0_000000__0H___8160_ 6 0.0 8160.0 AXIS_PTS_REF ldp_n_32__tq_loss_acc MAX_GRAD 100 MONOTONY MON_INCREASE /end AXIS_DESCR
/end CHARACTERISTIC
/begin CHARACTERISTIC ip_tq_loss_mon "IP_TQ_LOSS_MON" MAP 0x7e802 a_6 100 LINEAR______0_000000__0H___510_0 0.0 510.0
 /begin AXIS_DESCR COM_AXIS tco_mon LINEAR_______48_000000__0H___176 8 -48.0 142.5 AXIS_PTS_REF ldp_tco_mon__tq_loss_mon MAX_GRAD 100 MONOTONY MON_INCREASE /end AXIS_DESCR
 /begin AXIS_DESCR COM_AXIS n_32 LINEAR______0_000000__0H___8160_ 8 0.0 8160.0 AXIS_PTS_REF ldp_n_32_mon__tq_loss_mon MAX_GRAD 100 MONOTONY MON_INCREASE /end AXIS_DESCR
/end CHARACTERISTIC
/begin CHARACTERISTIC ip_tq_loss_mon2 "IP_TQ_LOSS_MON2" MAP 0x78d43 a_6 100 LINEAR______0_000000__0H___510_0 0.0 510.0
 /begin AXIS_DESCR COM_AXIS tco_mon2 LINEAR_______48_000000__0H___176 8 -48.0 142.5 AXIS_PTS_REF ldp_tco_mon__tq_loss_mon2 MAX_GRAD 100 MONOTONY MON_INCREASE /end AXIS_DESCR
 /begin AXIS_DESCR COM_AXIS n_32_mon2 LINEAR______0_000000__0H___8160_ 8 0.0 8160.0 AXIS_PTS_REF ldp_n_32_mon__tq_loss_mon2 MAX_GRAD 100 MONOTONY MON_INCREASE /end AXIS_DESCR
 FUNCTION_LIST MON2 /end CHARACTERISTIC
/begin CHARACTERISTIC ip_tq_max__n__pvs_cor_rpl "IP_TQ_MAX" MAP 0x7e134 a_50 5 LINEAR______0_000000__0H___1023_ 0.0 1023.0
 /begin AXIS_DESCR COM_AXIS pvs_cor_rpl LINEAR______0_000000__0H___11960 8 0.0 119.9982 AXIS_PTS_REF ldp_pvs_cor_rpl__tq_max MAX_GRAD 100 MONOTONY MON_INCREASE /end AXIS_DESCR
 /begin AXIS_DESCR COM_AXIS n_32 LINEAR______0_000000__0H___8160_ 8 0.0 8160.0 AXIS_PTS_REF ldp_n_32__tq_max MAX_GRAD 100 MONOTONY MON_INCREASE /end AXIS_DESCR
/end CHARACTERISTIC
/begin CHARACTERISTIC ip_tq_max_mon "IP_TQ_MAX_MON" MAP 0x7e842 a_6 100 LINEAR______0_000000__0H___510_0 0.0 510.0
 /begin AXIS_DESCR COM_AXIS dummy_b LINEAR______0_000000__0H___119_5 8 0.0 119.53125 AXIS_PTS_REF ldp_pvs_max_mon__tqi_max_mon MAX_GRAD 100 MONOTONY MON_INCREASE /end AXIS_DESCR
 /begin AXIS_DESCR COM_AXIS n_32_mon LINEAR______0_000000__0H___8160_ 8 0.0 8160.0 AXIS_PTS_REF ldp_n_32_mon__tqi_max_mon MAX_GRAD 100 MONOTONY MON_INCREASE /end AXIS_DESCR
/end CHARACTERISTIC
/begin CHARACTERISTIC ip_tq_max_mon2 "IP_TQ_MAX_MON2" MAP 0x78d83 a_6 100 LINEAR______0_000000__0H___510_0 0.0 510.0
 /begin AXIS_DESCR COM_AXIS pvs_max_mon2 LINEAR______0_000000__0H___119_5 8 0.0 119.53125 AXIS_PTS_REF ldp_pvs_max_mon__tqi_max_mon2 MAX_GRAD 100 MONOTONY MON_INCREASE /end AXIS_DESCR
 /begin AXIS_DESCR COM_AXIS n_32_mon2 LINEAR______0_000000__0H___8160_ 8 0.0 8160.0 AXIS_PTS_REF ldp_n_32_mon__tqi_max_mon2 MAX_GRAD 100 MONOTONY MON_INCREASE /end AXIS_DESCR
 FUNCTION_LIST MON2 /end CHARACTERISTIC
/begin CHARACTERISTIC ip_tqfr__n__maf "IP_TQFR" MAP 0x7e1b4 a_50 100 LINEAR______0_000000__0H___1022_ 0.0 1022.9688
 /begin AXIS_DESCR COM_AXIS maf LINEAR______0_000000__0H___13818 4 0.0 1389.0 AXIS_PTS_REF ldp_maf__tqfr MAX_GRAD 100 MONOTONY MON_INCREASE /end AXIS_DESCR
 /begin AXIS_DESCR COM_AXIS n_32 LINEAR______0_000000__0H___8160_ 8 0.0 8160.0 AXIS_PTS_REF ldp_n_32__tqfr MAX_GRAD 100 MONOTONY MON_INCREASE /end AXIS_DESCR
/end CHARACTERISTIC
/begin CHARACTERISTIC ip_tqfr_add__tco__toil "IP_TQFR_ADD" MAP 0x7e1f4 a_9 100 LINEAR______0_000000__0H___1022_ 0.0 1022.9688
 /begin AXIS_DESCR COM_AXIS toil LINEAR_______48_000000__0H___155 8 -48.0 155.0 AXIS_PTS_REF ldp_toil__tqfr MAX_GRAD 100 MONOTONY MON_INCREASE /end AXIS_DESCR
 /begin AXIS_DESCR COM_AXIS tco LINEAR_______48_000000__0H___142 8 -48.0 142.5 AXIS_PTS_REF ldp_tco__tqfr MAX_GRAD 100 MONOTONY MON_INCREASE /end AXIS_DESCR
/end CHARACTERISTIC
/begin CHARACTERISTIC ip_tqfr_st__tco_st "IP_TQFR_ST" CURVE 0x7e274 a_3 100 LINEAR______0_000000__0H___1022_ 0.0 1022.9688
 /begin AXIS_DESCR COM_AXIS tco_st LINEAR_______48_000000__0H___142 4 -48.0 142.5 AXIS_PTS_REF ldp_tco_st__tqfr_st MAX_GRAD 100 MONOTONY MON_INCREASE /end AXIS_DESCR
/end CHARACTERISTIC
/begin CHARACTERISTIC ip_tqi_ctl_dif_max__n "IP_TQI_CTL_DIF_MAX" CURVE 0x7e27c a_3 20 LINEAR______0_000000__0H___1022_ 0.0 1022.9688
 /begin AXIS_DESCR COM_AXIS n_32 LINEAR______0_000000__0H___8160_ 4 0.0 8160.0 AXIS_PTS_REF ldp_n_32__tqi_ctl_dif_max MAX_GRAD 100 MONOTONY MON_INCREASE /end AXIS_DESCR
/end CHARACTERISTIC
/begin CHARACTERISTIC ip_tqi_dif_i__tqi_dif "IP_TQI_DIF_I" CURVE 0x7e284 a_24 100 LINEAR_______1023_000000__0H___1 -1023.0 1022.9688
 /begin AXIS_DESCR COM_AXIS tqi_dif LINEAR_______1023_000000__0H___1 8 -1023.0 1022.9688 AXIS_PTS_REF ldpm_tqi_dif_1 MAX_GRAD 100 MONOTONY MON_INCREASE /end AXIS_DESCR
/end CHARACTERISTIC
/begin CHARACTERISTIC ip_tqi_dif_max_mon "IP_TQI_DIF_MAX_MON" MAP 0x7e882 a_6 100 LINEAR______0_000000__0H___510_0 0.0 510.0
 /begin AXIS_DESCR COM_AXIS tqi_sp_mon LINEAR______0_000000__0H___510_0 4 0.0 510.0 AXIS_PTS_REF ldp_tqi_sp__tqi_dif_max_mon MAX_GRAD 100 MONOTONY MON_INCREASE /end AXIS_DESCR
 /begin AXIS_DESCR COM_AXIS n_32_mon LINEAR______0_000000__0H___8160_ 4 0.0 8160.0 AXIS_PTS_REF ldp_n_32__tqi_dif_max_mon MAX_GRAD 100 MONOTONY MON_INCREASE /end AXIS_DESCR
/end CHARACTERISTIC
/begin CHARACTERISTIC ip_tqi_dif_max_mon2 "IP_TQI_DIF_MAX_MON2" MAP 0x78dc3 a_6 100 LINEAR______0_000000__0H___510_0 0.0 510.0
 /begin AXIS_DESCR COM_AXIS tqi_sp_mon2 LINEAR______0_000000__0H___510_0 4 0.0 510.0 AXIS_PTS_REF ldp_tqi_sp__tqi_dif_max_mon2 MAX_GRAD 100 MONOTONY MON_INCREASE /end AXIS_DESCR
 /begin AXIS_DESCR COM_AXIS n_32_mon2 LINEAR______0_000000__0H___8160_ 4 0.0 8160.0 AXIS_PTS_REF ldp_n_32__tqi_dif_max_mon2 MAX_GRAD 100 MONOTONY MON_INCREASE /end AXIS_DESCR
 FUNCTION_LIST MON2 /end CHARACTERISTIC
/begin CHARACTERISTIC ip_tqi_dif_p__tqi_dif "IP_TQI_DIF_P" CURVE 0x7e294 a_24 100 LINEAR_______1023_000000__0H___1 -1023.0 1022.9688
 /begin AXIS_DESCR COM_AXIS tqi_dif LINEAR_______1023_000000__0H___1 8 -1023.0 1022.9688 AXIS_PTS_REF ldpm_tqi_dif_1 MAX_GRAD 100 MONOTONY MON_INCREASE /end AXIS_DESCR
/end CHARACTERISTIC
/begin CHARACTERISTIC ip_tqi_lim_dif_i__tqi_lim_dif "IP_TQI_LIM_DIF_I" CURVE 0x7e2a4 a_24 100 LINEAR_______1023_000000__0H___1 -1023.0 1022.9688
 /begin AXIS_DESCR COM_AXIS tqi_lim_dif LINEAR_______1023_000000__0H___1 8 -1023.0 1022.9688 AXIS_PTS_REF ldpm_tqi_lim_dif_1 MAX_GRAD 100 MONOTONY MON_INCREASE /end AXIS_DESCR
/end CHARACTERISTIC
/begin CHARACTERISTIC ip_tqi_lim_dif_p__tqi_lim_dif "IP_TQI_LIM_DIF_P" CURVE 0x7e2b4 a_24 100 LINEAR_______1023_000000__0H___1 -1023.0 1022.9688
 /begin AXIS_DESCR COM_AXIS tqi_lim_dif LINEAR_______1023_000000__0H___1 8 -1023.0 1022.9688 AXIS_PTS_REF ldpm_tqi_lim_dif_1 MAX_GRAD 100 MONOTONY MON_INCREASE /end AXIS_DESCR
/end CHARACTERISTIC
/begin CHARACTERISTIC ip_tqi_maf__n__maf "IP_TQI_MAF" MAP 0x7e2c4 a_9 100 LINEAR______0_000000__0H___1023_ 0.0 1023.0
 /begin AXIS_DESCR COM_AXIS maf LINEAR______0_000000__0H___1389_ 4 0.0 1389.0 AXIS_PTS_REF ldp_maf__tqi_maf MAX_GRAD 100 MONOTONY MON_INCREASE /end AXIS_DESCR
 /begin AXIS_DESCR COM_AXIS n LINEAR______0_000000__0H___8160_ 16 0.0 8160.0 AXIS_PTS_REF ldpm_n_32_6 MAX_GRAD 100 MONOTONY MON_INCREASE /end AXIS_DESCR
/end CHARACTERISTIC
/begin CHARACTERISTIC ip_tqi_max_isa_diag__isapwm "IP_TQI_MAX_ISA_DIAG" CURVE 0x7e344 a_3 100 LINEAR_______1023_000000__0H___1 -1023.0 1022.9688
 /begin AXIS_DESCR COM_AXIS isapwm LINEAR______0_000000__0H___99_60 4 0.0 99.609375 AXIS_PTS_REF ldpm_isapwm_1 MAX_GRAD 100 MONOTONY MON_INCREASE /end AXIS_DESCR
/end CHARACTERISTIC
/begin CHARACTERISTIC ip_tqi_min_isa_diag__isapwm "IP_TQI_MIN_ISA_DIAG" CURVE 0x7e34c a_3 100 LINEAR_______1023_000000__0H___1 -1023.0 1022.9688
 /begin AXIS_DESCR COM_AXIS isapwm LINEAR______0_000000__0H___99_60 4 0.0 99.609375 AXIS_PTS_REF ldpm_isapwm_1 MAX_GRAD 100 MONOTONY MON_INCREASE /end AXIS_DESCR
/end CHARACTERISTIC
/begin CHARACTERISTIC ip_tqi_mtc_close_crlc__tps_av "IP_TQI_MTC_CLOSE_CRLC" CURVE 0x78dd3 a_7 100 LINEAR______0_000000__0H___0_996 0.0 0.99609375
 /begin AXIS_DESCR COM_AXIS tps_av_prj LINEAR______0_000000__0H___119_9 6 0.0 119.99817 AXIS_PTS_REF ldpm_tps_av_3 MAX_GRAD 100 MONOTONY MON_INCREASE /end AXIS_DESCR
/end CHARACTERISTIC
/begin CHARACTERISTIC ip_tqi_mtc_open_crlc__tps_av "IP_TQI_MTC_OPEN_CRLC" CURVE 0x78deb a_7 100 LINEAR______0_000000__0H___0_996 0.0 0.99609375
 /begin AXIS_DESCR COM_AXIS tps_av_prj LINEAR______0_000000__0H___119_9 6 0.0 119.99817 AXIS_PTS_REF ldpm_tps_av_3 MAX_GRAD 100 MONOTONY MON_INCREASE /end AXIS_DESCR
/end CHARACTERISTIC
/begin CHARACTERISTIC ip_tqi_mtc_open_crlc_amt__tps_av "IP_TQI_MTC_OPEN_CRLC_AMT" CURVE 0x78df1 a_7 100 LINEAR______0_000000__0H___0_996 0.0 0.99609375
 /begin AXIS_DESCR COM_AXIS tps_av_prj LINEAR______0_000000__0H___119_9 6 0.0 119.99817 AXIS_PTS_REF ldpm_tps_av_3 MAX_GRAD 100 MONOTONY MON_INCREASE /end AXIS_DESCR
 FUNCTION_LIST Z1S1 /end CHARACTERISTIC
/begin CHARACTERISTIC ip_tqi_mtc_open_crlc_etc__tps_av "IP_TQI_MTC_OPEN_CRLC_ETC" CURVE 0x78df7 a_7 100 LINEAR______0_000000__0H___0_996 0.0 0.99609375
 /begin AXIS_DESCR COM_AXIS tps_av_prj LINEAR______0_000000__0H___119_9 6 0.0 119.99817 AXIS_PTS_REF ldpm_tps_av_3 MAX_GRAD 100 MONOTONY MON_INCREASE /end AXIS_DESCR
/end CHARACTERISTIC
/begin CHARACTERISTIC ip_tqi_mtc_open_crlc_lim__tps_av "IP_TQI_MTC_OPEN_CRLC_LIM" CURVE 0x78dfd a_7 100 LINEAR______0_000000__0H___0_996 0.0 0.99609375
 /begin AXIS_DESCR COM_AXIS tps_av_1 LINEAR______0_000000__0H___119_9 6 0.0 119.99817 AXIS_PTS_REF ldpm_tps_av_1 MAX_GRAD 100 MONOTONY MON_INCREASE /end AXIS_DESCR
/end CHARACTERISTIC
/begin CHARACTERISTIC ip_tqi_pvs__n__pvs "IP_TQI_PVS" MAP 0x7e354 a_9 100 LINEAR______0_000000__0H___1023_ 0.0 1023.0
 /begin AXIS_DESCR COM_AXIS dummy_b LINEAR______0_000000__0H___11913 12 0.0 119.5 AXIS_PTS_REF ldpm_pvs_1 MAX_GRAD 100 MONOTONY MON_INCREASE /end AXIS_DESCR
 /begin AXIS_DESCR COM_AXIS n_32 LINEAR______0_000000__0H___8160_ 12 0.0 8160.0 AXIS_PTS_REF ldpm_n_32_14 MAX_GRAD 100 MONOTONY MON_INCREASE /end AXIS_DESCR
/end CHARACTERISTIC
/begin CHARACTERISTIC ip_tqi_ref_mon "IP_TQI_REF_MON" MAP 0x7e892 a_6 100 LINEAR______0_000000__0H___510_0 0.0 510.0
 /begin AXIS_DESCR COM_AXIS maf LINEAR______0_000000__0H___1389_ 4 0.0 1389.0 AXIS_PTS_REF ldp_maf__tqi_ref_mon MAX_GRAD 100 MONOTONY MON_INCREASE /end AXIS_DESCR
 /begin AXIS_DESCR COM_AXIS n_32 LINEAR______0_000000__0H___8160_ 16 0.0 8160.0 AXIS_PTS_REF ldp_n_32__tqi_ref_mon MAX_GRAD 100 MONOTONY MON_INCREASE /end AXIS_DESCR
/end CHARACTERISTIC
/begin CHARACTERISTIC ip_tqi_ref_mon2 "IP_TQI_REF_MON2" MAP 0x78e03 a_6 100 LINEAR______0_000000__0H___510_0 0.0 510.0
 /begin AXIS_DESCR COM_AXIS maf_mon2 LINEAR______0_000000__0H___1389_ 4 0.0 1389.0 AXIS_PTS_REF ldp_maf__tqi_ref_mon2 MAX_GRAD 100 MONOTONY MON_INCREASE /end AXIS_DESCR
 /begin AXIS_DESCR COM_AXIS n_32_mon2 LINEAR______0_000000__0H___8160_ 16 0.0 8160.0 AXIS_PTS_REF ldp_n_32__tqi_ref_mon2 MAX_GRAD 100 MONOTONY MON_INCREASE /end AXIS_DESCR
 FUNCTION_LIST MON2 /end CHARACTERISTIC
/begin CHARACTERISTIC ip_vls_cat_max_cycnr__maf_kgh "IP_VLS_CAT_MAX_CYCNR" CURVE 0x78e43 a_7 100 LINEAR______0_000000__0H___51068 0.0 5100.0
 /begin AXIS_DESCR COM_AXIS maf_kgh LINEAR______0_000000__0H___16383 8 0.0 16383.75 AXIS_PTS_REF ldp_maf_kgh__vls_cat_max_cycnr MAX_GRAD 100 MONOTONY MON_INCREASE /end AXIS_DESCR
/end CHARACTERISTIC
/begin CHARACTERISTIC ip_vls_dif_val__n__maf "IP_VLS_DIF_VAL" MAP 0x78e4b a_17 100 LINEAR______0_000000__0H___1_077 0.0 1.0
 /begin AXIS_DESCR COM_AXIS maf LINEAR______0_000000__0H___13818 8 0.0 1389.0 AXIS_PTS_REF ldp_maf__vls_dif_val MAX_GRAD 100 MONOTONY MON_INCREASE /end AXIS_DESCR
 /begin AXIS_DESCR COM_AXIS n LINEAR______0_000000__0H___81612 8 0.0 8160.0 AXIS_PTS_REF ldpm_n_12 MAX_GRAD 100 MONOTONY MON_INCREASE /end AXIS_DESCR
 FUNCTION_LIST CSCM /end CHARACTERISTIC
/begin CHARACTERISTIC ip_vls_sp_dly__n__maf "IP_VLS_SP_DLY" MAP 0x78e8b a_39 100 LINEAR______0_000000__0H___1_275 0.0 1.275
 /begin AXIS_DESCR COM_AXIS maf LINEAR______0_000000__0H___1389_ 8 0.0 1389.0 AXIS_PTS_REF ldpm_maf_4 MAX_GRAD 100 MONOTONY MON_INCREASE /end AXIS_DESCR
 /begin AXIS_DESCR COM_AXIS n LINEAR______0_000000__0H___81612 8 0.0 8160.0 AXIS_PTS_REF ldpm_n_7 MAX_GRAD 100 MONOTONY MON_INCREASE /end AXIS_DESCR
/end CHARACTERISTIC
/begin CHARACTERISTIC ip_vol_im__n__maf_mes "IP_VOL_IM" MAP 0x7e474 a_9 100 LINEAR______1_000000__1H___20_33 1.0 20.331
 /begin AXIS_DESCR COM_AXIS maf_mes LINEAR______0_000000__0H___1389_ 6 0.0 1389.0 AXIS_PTS_REF ldpm_maf_mes_1 MAX_GRAD 100 MONOTONY MON_INCREASE /end AXIS_DESCR
 /begin AXIS_DESCR COM_AXIS n_32 LINEAR______0_000000__0H___8160_ 8 0.0 8160.0 AXIS_PTS_REF ldpm_n_32_13 MAX_GRAD 100 MONOTONY MON_INCREASE /end AXIS_DESCR
/end CHARACTERISTIC
/begin CHARACTERISTIC ip_vol_im_is__n__maf_mes "IP_VOL_IM_IS" MAP 0x7e4d4 a_9 100 LINEAR______1_000000__1H___20_33 1.0 20.331
 /begin AXIS_DESCR COM_AXIS maf_mes LINEAR______0_000000__0H___1389_ 6 0.0 1389.0 AXIS_PTS_REF ldpm_maf_mes_2 MAX_GRAD 100 MONOTONY MON_INCREASE /end AXIS_DESCR
 /begin AXIS_DESCR COM_AXIS n_32 LINEAR______0_000000__0H___8160_ 8 0.0 8160.0 AXIS_PTS_REF ldpm_n_32_55 MAX_GRAD 100 MONOTONY MON_INCREASE /end AXIS_DESCR
 FUNCTION_LIST Z10I /end CHARACTERISTIC
/begin CHARACTERISTIC ip_vol_im_neg__n__maf_mes "IP_VOL_IM_NEG" MAP 0x7e534 a_9 100 LINEAR______1_000000__1H___20_33 1.0 20.331
 /begin AXIS_DESCR COM_AXIS maf_mes LINEAR______0_000000__0H___1389_ 6 0.0 1389.0 AXIS_PTS_REF ldpm_maf_mes_1 MAX_GRAD 100 MONOTONY MON_INCREASE /end AXIS_DESCR
 /begin AXIS_DESCR COM_AXIS n_32 LINEAR______0_000000__0H___8160_ 8 0.0 8160.0 AXIS_PTS_REF ldpm_n_32_13 MAX_GRAD 100 MONOTONY MON_INCREASE /end AXIS_DESCR
/end CHARACTERISTIC
/begin CHARACTERISTIC ip_vol_im_neg_is__n__maf_mes "IP_VOL_IM_NEG_IS" MAP 0x7e594 a_9 100 LINEAR______1_000000__1H___20_33 1.0 20.331
 /begin AXIS_DESCR COM_AXIS maf_mes LINEAR______0_000000__0H___1389_ 6 0.0 1389.0 AXIS_PTS_REF ldpm_maf_mes_2 MAX_GRAD 100 MONOTONY MON_INCREASE /end AXIS_DESCR
 /begin AXIS_DESCR COM_AXIS n_32 LINEAR______0_000000__0H___8160_ 8 0.0 8160.0 AXIS_PTS_REF ldpm_n_32_55 MAX_GRAD 100 MONOTONY MON_INCREASE /end AXIS_DESCR
 FUNCTION_LIST Z10I /end CHARACTERISTIC
/begin CHARACTERISTIC ip_wheel_grd_mmv_thd_rr__vs "IP_WHEEL_GRD_MMV_THD_RR" CURVE 0x7e5f4 a_3 100 LINEAR______0_000000__0H___25578 0.0 255.0
 /begin AXIS_DESCR COM_AXIS vs LINEAR______0_000000__0H___25511 8 0.0 255.0 AXIS_PTS_REF ldp_vs__wheel_grd_thd_rr MAX_GRAD 100 MONOTONY MON_INCREASE /end AXIS_DESCR
/end CHARACTERISTIC
/begin CHARACTERISTIC id_t_tooth_max__vb__tco "ID_T_TOOTH_MAX" MAP 0x7e604 a_9 100 LINEAR______0_000000__0H___349_5 0.0 349.52
 /begin AXIS_DESCR COM_AXIS tco LINEAR_______48_000000__0H___142 6 -48.0 142.5 AXIS_PTS_REF ldp_tco__t_tooth_max MAX_GRAD 100 MONOTONY MON_INCREASE /end AXIS_DESCR
 /begin AXIS_DESCR COM_AXIS vb LINEAR______0_000000__0H___26_00 6 0.0 26.0 AXIS_PTS_REF ldp_vb__t_tooth_max MAX_GRAD 100 MONOTONY MON_INCREASE /end AXIS_DESCR
/end CHARACTERISTIC
/begin CHARACTERISTIC id_nr_pat_scc_asr__factqrsccasrm "ID_NR_PAT_SCC_ASR" CURVE 0x75bfb a_7 100 LINEAR______0_000000__0H___13_00 0.0 13.0
 /begin AXIS_DESCR COM_AXIS fac_tqr_scc_asr_mmv_tot LINEAR______0_000000__0H___0_999 14 0.0 0.99998474 AXIS_PTS_REF ldp_fac_tqr_scc_asr_mmv__nr_pat MAX_GRAD 100 MONOTONY MON_INCREASE /end AXIS_DESCR
/end CHARACTERISTIC
/begin CHARACTERISTIC ip_acin_n_sp_add_ccb__cha_cdn_ba "IP_ACIN_N_SP_ADD_CCB" CURVE 0x791d8 a_3 100 LINEAR______0_000000__0H___10059 0.0 1000.0
 /begin AXIS_DESCR COM_AXIS cha_cdn_bat LINEAR______0_000000__0H___12779 6 0.0 127.5 AXIS_PTS_REF ldpm_cha_cdn_bat_1 MAX_GRAD 100 MONOTONY MON_INCREASE /end AXIS_DESCR
/end CHARACTERISTIC
/begin CHARACTERISTIC ip_cam_sp_add_cat_pl_ex__tco_st_ "IP_CAM_SP_ADD_CAT_PL_EX" MAP 0x75e52 a_31 100 LINEAR______47_625000__1H____47_ -47.625 47.625
 /begin AXIS_DESCR COM_AXIS km_ctr LINEAR______0_000000__0H___65534 4 0.0 655340.0 AXIS_PTS_REF ldpm_km_ctr_1 MAX_GRAD 100 MONOTONY MON_INCREASE /end AXIS_DESCR
 /begin AXIS_DESCR COM_AXIS tco_st LINEAR_______48_000000__0H___142 8 -48.0 142.5 AXIS_PTS_REF ldp_tco_st__cam_sp_add_cat_pl_ex MAX_GRAD 100 MONOTONY MON_INCREASE /end AXIS_DESCR
/end CHARACTERISTIC
/begin CHARACTERISTIC ip_cam_sp_add_ex_ch_2_is_at__tco "IP_CAM_SP_ADD_EX_CH_2_IS_AT" MAP 0x75e72 a_31 100 LINEAR_______47_625000__1H___47_ -47.625 47.625
 /begin AXIS_DESCR COM_AXIS km_ctr LINEAR______0_000000__0H___65534 4 0.0 655340.0 AXIS_PTS_REF ldpm_km_ctr_1 MAX_GRAD 100 MONOTONY MON_INCREASE /end AXIS_DESCR
 /begin AXIS_DESCR COM_AXIS tco_st LINEAR_______48_000000__0H___142 8 -48.0 142.5 AXIS_PTS_REF ldpm_tco_st_6 MAX_GRAD 100 MONOTONY MON_INCREASE /end AXIS_DESCR
/end CHARACTERISTIC
/begin CHARACTERISTIC ip_cam_sp_add_ex_ch_2_is_mt__tco "IP_CAM_SP_ADD_EX_CH_2_IS_MT" MAP 0x75e92 a_31 100 LINEAR_______47_625000__1H___47_ -47.625 47.625
 /begin AXIS_DESCR COM_AXIS km_ctr LINEAR______0_000000__0H___65534 4 0.0 655340.0 AXIS_PTS_REF ldpm_km_ctr_1 MAX_GRAD 100 MONOTONY MON_INCREASE /end AXIS_DESCR
 /begin AXIS_DESCR COM_AXIS tco_st LINEAR_______48_000000__0H___142 8 -48.0 142.5 AXIS_PTS_REF ldpm_tco_st_6 MAX_GRAD 100 MONOTONY MON_INCREASE /end AXIS_DESCR
/end CHARACTERISTIC
/begin CHARACTERISTIC ip_cam_sp_add_in_ch_2_is_at__tco "IP_CAM_SP_ADD_IN_CH_2_IS_AT" MAP 0x75eb2 a_31 100 LINEAR_______48_000000__0H___47_ -48.0 47.625
 /begin AXIS_DESCR COM_AXIS km_ctr LINEAR______0_000000__0H___65534 4 0.0 655340.0 AXIS_PTS_REF ldpm_km_ctr_1 MAX_GRAD 100 MONOTONY MON_INCREASE /end AXIS_DESCR
 /begin AXIS_DESCR COM_AXIS tco_st LINEAR_______48_000000__0H___142 8 -48.0 142.5 AXIS_PTS_REF ldpm_tco_st_6 MAX_GRAD 100 MONOTONY MON_INCREASE /end AXIS_DESCR
/end CHARACTERISTIC
/begin CHARACTERISTIC ip_cam_sp_add_in_ch_2_is_mt__tco "IP_CAM_SP_ADD_IN_CH_2_IS_MT" MAP 0x75ed2 a_31 100 LINEAR_______48_000000__0H___47_ -48.0 47.625
 /begin AXIS_DESCR COM_AXIS km_ctr LINEAR______0_000000__0H___65534 4 0.0 655340.0 AXIS_PTS_REF ldpm_km_ctr_1 MAX_GRAD 100 MONOTONY MON_INCREASE /end AXIS_DESCR
 /begin AXIS_DESCR COM_AXIS tco_st LINEAR_______48_000000__0H___142 8 -48.0 142.5 AXIS_PTS_REF ldpm_tco_st_6 MAX_GRAD 100 MONOTONY MON_INCREASE /end AXIS_DESCR
/end CHARACTERISTIC
/begin CHARACTERISTIC ip_cam_sp_in_isapwm_min__isapwm_ "IP_CAM_SP_IN_ISAPWM_MIN" MAP 0x75ef2 a_6 100 LINEAR_______48_000000__0H___47_ -48.0 47.625
 /begin AXIS_DESCR COM_AXIS maf LINEAR______0_000000__0H___1389_ 2 0.0 1389.0 AXIS_PTS_REF ldpm_maf_16 MAX_GRAD 100 MONOTONY MON_INCREASE /end AXIS_DESCR
 /begin AXIS_DESCR COM_AXIS isapwm LINEAR______0_000000__0H___99_60 5 0.0 99.609375 AXIS_PTS_REF ldpm_isapwm_2 MAX_GRAD 100 MONOTONY MON_INCREASE /end AXIS_DESCR
/end CHARACTERISTIC
/begin CHARACTERISTIC ip_cam_sp_tco_1_ex_is__n__maf_iv "IP_CAM_SP_TCO_1_EX_IS" MAP 0x75f0c a_17 100 LINEAR_______155_625000__FFH____ -155.625 -60.0
 /begin AXIS_DESCR COM_AXIS maf_ivvt LINEAR______0_000000__0H___13818 6 0.0 1389.0 AXIS_PTS_REF ldpm_maf_ivvt_1 MAX_GRAD 100 MONOTONY MON_INCREASE /end AXIS_DESCR
 /begin AXIS_DESCR COM_AXIS n LINEAR______0_000000__0H___81612 6 0.0 8160.0 AXIS_PTS_REF ldpm_n_13 MAX_GRAD 100 MONOTONY MON_INCREASE /end AXIS_DESCR
/end CHARACTERISTIC
/begin CHARACTERISTIC ip_cam_sp_tco_1_ex_pl__n__maf_iv "IP_CAM_SP_TCO_1_EX_PL" MAP 0x75f30 a_17 100 LINEAR_______155_625000__FFH____ -155.625 -60.0
 /begin AXIS_DESCR COM_AXIS maf_ivvt LINEAR______0_000000__0H___13818 12 0.0 1389.0 AXIS_PTS_REF ldpm_maf_ivvt_2 MAX_GRAD 100 MONOTONY MON_INCREASE /end AXIS_DESCR
 /begin AXIS_DESCR COM_AXIS n LINEAR______0_000000__0H___81612 16 0.0 8160.0 AXIS_PTS_REF ldpm_n_5 MAX_GRAD 100 MONOTONY MON_INCREASE /end AXIS_DESCR
/end CHARACTERISTIC
/begin CHARACTERISTIC ip_cam_sp_tco_1_in_is__n__maf_iv "IP_CAM_SP_TCO_1_IN_IS" MAP 0x76000 a_17 100 LINEAR______60_000000__0H___155_ 60.0 155.625
 /begin AXIS_DESCR COM_AXIS maf_ivvt LINEAR______0_000000__0H___13818 6 0.0 1389.0 AXIS_PTS_REF ldpm_maf_ivvt_1 MAX_GRAD 100 MONOTONY MON_INCREASE /end AXIS_DESCR
 /begin AXIS_DESCR COM_AXIS n LINEAR______0_000000__0H___81612 6 0.0 8160.0 AXIS_PTS_REF ldpm_n_13 MAX_GRAD 100 MONOTONY MON_INCREASE /end AXIS_DESCR
/end CHARACTERISTIC
/begin CHARACTERISTIC ip_cam_sp_tco_1_in_pl__n__maf_iv "IP_CAM_SP_TCO_1_IN_PL" MAP 0x76024 a_17 100 LINEAR______60_000000__0H___155_ 60.0 155.625
 /begin AXIS_DESCR COM_AXIS maf_ivvt LINEAR______0_000000__0H___13818 12 0.0 1389.0 AXIS_PTS_REF ldpm_maf_ivvt_2 MAX_GRAD 100 MONOTONY MON_INCREASE /end AXIS_DESCR
 /begin AXIS_DESCR COM_AXIS n LINEAR______0_000000__0H___81612 16 0.0 8160.0 AXIS_PTS_REF ldpm_n_5 MAX_GRAD 100 MONOTONY MON_INCREASE /end AXIS_DESCR
/end CHARACTERISTIC
/begin CHARACTERISTIC ip_cam_sp_tco_2_ex_is__n__maf_iv "IP_CAM_SP_TCO_2_EX_IS" MAP 0x760f4 a_17 100 LINEAR_______155_625000__FFH____ -155.625 -60.0
 /begin AXIS_DESCR COM_AXIS maf_ivvt LINEAR______0_000000__0H___13818 6 0.0 1389.0 AXIS_PTS_REF ldpm_maf_ivvt_1 MAX_GRAD 100 MONOTONY MON_INCREASE /end AXIS_DESCR
 /begin AXIS_DESCR COM_AXIS n LINEAR______0_000000__0H___81612 6 0.0 8160.0 AXIS_PTS_REF ldpm_n_13 MAX_GRAD 100 MONOTONY MON_INCREASE /end AXIS_DESCR
/end CHARACTERISTIC
/begin CHARACTERISTIC ip_cam_sp_tco_2_ex_pl__n__maf_iv "IP_CAM_SP_TCO_2_EX_PL" MAP 0x76118 a_17 100 LINEAR_______155_625000__FFH____ -155.625 -60.0
 /begin AXIS_DESCR COM_AXIS maf_ivvt LINEAR______0_000000__0H___13818 12 0.0 1389.0 AXIS_PTS_REF ldpm_maf_ivvt_2 MAX_GRAD 100 MONOTONY MON_INCREASE /end AXIS_DESCR
 /begin AXIS_DESCR COM_AXIS n LINEAR______0_000000__0H___81612 16 0.0 8160.0 AXIS_PTS_REF ldpm_n_5 MAX_GRAD 100 MONOTONY MON_INCREASE /end AXIS_DESCR
/end CHARACTERISTIC
/begin CHARACTERISTIC ip_cam_sp_tco_2_in_is__n__maf_iv "IP_CAM_SP_TCO_2_IN_IS" MAP 0x761e8 a_17 100 LINEAR______60_000000__0H___155_ 60.0 155.625
 /begin AXIS_DESCR COM_AXIS maf_ivvt LINEAR______0_000000__0H___13818 6 0.0 1389.0 AXIS_PTS_REF ldpm_maf_ivvt_1 MAX_GRAD 100 MONOTONY MON_INCREASE /end AXIS_DESCR
 /begin AXIS_DESCR COM_AXIS n LINEAR______0_000000__0H___81612 6 0.0 8160.0 AXIS_PTS_REF ldpm_n_13 MAX_GRAD 100 MONOTONY MON_INCREASE /end AXIS_DESCR
/end CHARACTERISTIC
/begin CHARACTERISTIC ip_cam_sp_tco_2_in_pl__n__maf_iv "IP_CAM_SP_TCO_2_IN_PL" MAP 0x7620c a_17 100 LINEAR______60_000000__0H___155_ 60.0 155.625
 /begin AXIS_DESCR COM_AXIS maf_ivvt LINEAR______0_000000__0H___13818 12 0.0 1389.0 AXIS_PTS_REF ldpm_maf_ivvt_2 MAX_GRAD 100 MONOTONY MON_INCREASE /end AXIS_DESCR
 /begin AXIS_DESCR COM_AXIS n LINEAR______0_000000__0H___81612 16 0.0 8160.0 AXIS_PTS_REF ldpm_n_5 MAX_GRAD 100 MONOTONY MON_INCREASE /end AXIS_DESCR
/end CHARACTERISTIC
/begin CHARACTERISTIC ip_crlc_dec_puc_up_1__maf_int_pu "IP_CRLC_DEC_PUC_UP_1" CURVE 0x7960e a_24 100 LINEAR______0_000000__0H___0_999 0.0 0.99998474
 /begin AXIS_DESCR COM_AXIS maf_int_puc_temp_sub LINEAR______0_000000__0H___36400 8 0.0 36400.0 AXIS_PTS_REF ldpm_maf_int_puc_temp_sub_1 MAX_GRAD 100 MONOTONY MON_INCREASE /end AXIS_DESCR
 FUNCTION_LIST ETM /end CHARACTERISTIC
/begin CHARACTERISTIC ip_crlc_dec_puc_up_2__maf_int_pu "IP_CRLC_DEC_PUC_UP_2" CURVE 0x7962e a_24 100 LINEAR______0_000000__0H___0_999 0.0 0.99998474
 /begin AXIS_DESCR COM_AXIS maf_int_puc_temp_sub LINEAR______0_000000__0H___36400 8 0.0 36400.0 AXIS_PTS_REF ldpm_maf_int_puc_temp_sub_1 MAX_GRAD 100 MONOTONY MON_INCREASE /end AXIS_DESCR
 FUNCTION_LIST ETM /end CHARACTERISTIC
/begin CHARACTERISTIC ip_crlc_maf_ivvt__n__maf_sub_dia "IP_CRLC_MAF_IVVT" MAP 0x76328 a_6 100 LINEAR______0_000000__0H___0_996 0.0 0.99609375
 /begin AXIS_DESCR COM_AXIS dummy_b LINEAR______0_000000__0H___1389_ 6 0.0 1389.0 AXIS_PTS_REF ldp_maf_sub_diag__crlc_maf_ivvt MAX_GRAD 100 MONOTONY MON_INCREASE /end AXIS_DESCR
 /begin AXIS_DESCR COM_AXIS n LINEAR______0_000000__0H___8160_ 6 0.0 8160.0 AXIS_PTS_REF ldp_n_32__crlc_maf_ivvt MAX_GRAD 100 MONOTONY MON_INCREASE /end AXIS_DESCR
/end CHARACTERISTIC
/begin CHARACTERISTIC ip_crlc_wall_dec_puc_up_1__maf_i "IP_CRLC_WALL_DEC_PUC_UP_1" CURVE 0x7986a a_24 100 LINEAR______0_000000__0H___0_999 0.0 0.99998474
 /begin AXIS_DESCR COM_AXIS maf_int_puc_temp_sub LINEAR______0_000000__0H___36400 8 0.0 36400.0 AXIS_PTS_REF ldpm_maf_int_puc_temp_sub_1 MAX_GRAD 100 MONOTONY MON_INCREASE /end AXIS_DESCR
 FUNCTION_LIST ETM /end CHARACTERISTIC
/begin CHARACTERISTIC ip_crlc_wall_dec_puc_up_1__maf_k "IP_CRLC_WALL_DEC_PUC_UP_1" CURVE 0x7987a a_24 100 LINEAR______0_000000__0H___1_027 0.0 1.0
 /begin AXIS_DESCR COM_AXIS maf_kgh LINEAR______0_000000__0H___16383 8 0.0 16383.75 AXIS_PTS_REF ldpm_maf_kgh_17 MAX_GRAD 100 MONOTONY MON_INCREASE /end AXIS_DESCR
 FUNCTION_LIST ETM /end CHARACTERISTIC
/begin CHARACTERISTIC ip_crlc_wall_dec_puc_up_2__maf_i "IP_CRLC_WALL_DEC_PUC_UP_2" CURVE 0x7988a a_24 100 LINEAR______0_000000__0H___0_999 0.0 0.99998474
 /begin AXIS_DESCR COM_AXIS maf_int_puc_temp_sub LINEAR______0_000000__0H___36400 8 0.0 36400.0 AXIS_PTS_REF ldpm_maf_int_puc_temp_sub_1 MAX_GRAD 100 MONOTONY MON_INCREASE /end AXIS_DESCR
 FUNCTION_LIST ETM /end CHARACTERISTIC
/begin CHARACTERISTIC ip_crlc_wall_dec_puc_up_2__maf_k "IP_CRLC_WALL_DEC_PUC_UP_2" CURVE 0x7989a a_24 100 LINEAR______0_000000__0H___1_027 0.0 1.0
 /begin AXIS_DESCR COM_AXIS maf_kgh LINEAR______0_000000__0H___16383 8 0.0 16383.75 AXIS_PTS_REF ldpm_maf_kgh_17 MAX_GRAD 100 MONOTONY MON_INCREASE /end AXIS_DESCR
 FUNCTION_LIST ETM /end CHARACTERISTIC
/begin CHARACTERISTIC ip_crlc_wall_fac_toil__tmptoildi "IP_CRLC_WALL_FAC_TOIL" CURVE 0x76354 a_7 100 LINEAR______0_000000__0H___7_968 0.0 7.96875
 /begin AXIS_DESCR COM_AXIS toil_dif LINEAR_______203_000000__0H___20 8 -203.0 203.0 AXIS_PTS_REF ldpm_temp_sp_toil_dif_1 MAX_GRAD 100 MONOTONY MON_INCREASE /end AXIS_DESCR
 FUNCTION_LIST ETM /end CHARACTERISTIC
/begin CHARACTERISTIC ip_crlc_wall_sap_fac__tempmvexup "IP_CRLC_WALL_SAP_FAC" CURVE 0x7635c a_7 100 LINEAR______0_000000__0H___7_968 0.0 7.96875
 /begin AXIS_DESCR COM_AXIS dummy_w LINEAR_______33_000000__0H___989 8 -33.0 989.9844 AXIS_PTS_REF ldpm_temp_mmv_sub_ex_up_i_1 MAX_GRAD 100 MONOTONY MON_INCREASE /end AXIS_DESCR
 FUNCTION_LIST ETM /end CHARACTERISTIC
/begin CHARACTERISTIC ip_crlc_wall_sap_fac_inc_1__temp "IP_CRLC_WALL_SAP_FAC_INC_1" CURVE 0x76364 a_7 100 LINEAR______0_000000__0H___0_996 0.0 0.99609375
 /begin AXIS_DESCR COM_AXIS dummy_w LINEAR_______33_000000__0H___989 8 -33.0 989.9844 AXIS_PTS_REF ldp_temp_mmv_sub_ex_up_i MAX_GRAD 100 MONOTONY MON_INCREASE /end AXIS_DESCR
 FUNCTION_LIST ETM /end CHARACTERISTIC
/begin CHARACTERISTIC ip_crlc_wall_sap_fac_inc_2__temp "IP_CRLC_WALL_SAP_FAC_INC_2" CURVE 0x7636c a_7 100 LINEAR______0_000000__0H___0_996 0.0 0.99609375
 /begin AXIS_DESCR COM_AXIS dummy_w LINEAR_______33_000000__0H___989 8 -33.0 989.9844 AXIS_PTS_REF ldp_temp_mmv_sub_ex_up_i MAX_GRAD 100 MONOTONY MON_INCREASE /end AXIS_DESCR
 FUNCTION_LIST ETM /end CHARACTERISTIC
/begin CHARACTERISTIC ip_dri_acin_n_sp_add_ccb__cha_cd "IP_DRI_ACIN_N_SP_ADD_CCB" CURVE 0x79b42 a_3 100 LINEAR______0_000000__0H___10059 0.0 1000.0
 /begin AXIS_DESCR COM_AXIS cha_cdn_bat LINEAR______0_000000__0H___12779 6 0.0 127.5 AXIS_PTS_REF ldpm_cha_cdn_bat_1 MAX_GRAD 100 MONOTONY MON_INCREASE /end AXIS_DESCR
/end CHARACTERISTIC
/begin CHARACTERISTIC ip_dri_n_sp_add_ch_2__tco_st__km "IP_DRI_N_SP_ADD_CH_2" MAP 0x79b66 a_50 100 LINEAR______0_000000__0H___10059 0.0 1000.0
 /begin AXIS_DESCR COM_AXIS km_ctr LINEAR______0_000000__0H___65534 4 0.0 655340.0 AXIS_PTS_REF ldpm_km_ctr_1 MAX_GRAD 100 MONOTONY MON_INCREASE /end AXIS_DESCR
 /begin AXIS_DESCR COM_AXIS tco_st LINEAR_______48_000000__0H___142 8 -48.0 142.5 AXIS_PTS_REF ldpm_tco_st_3 MAX_GRAD 100 MONOTONY MON_INCREASE /end AXIS_DESCR
/end CHARACTERISTIC
/begin CHARACTERISTIC ip_dri_n_sp_add_cha_cdn_bat__cha "IP_DRI_N_SP_ADD_CHA_CDN_BAT" CURVE 0x79ba6 a_3 100 LINEAR______0_000000__0H___10059 0.0 1000.0
 /begin AXIS_DESCR COM_AXIS cha_cdn_bat LINEAR______0_000000__0H___12779 6 0.0 127.5 AXIS_PTS_REF ldpm_cha_cdn_bat_1 MAX_GRAD 100 MONOTONY MON_INCREASE /end AXIS_DESCR
/end CHARACTERISTIC
/begin CHARACTERISTIC ip_fac_isapwm_cor__pvs_cor_rpl__ "IP_FAC_ISAPWM_COR" MAP 0x79d6a a_28 100 LINEAR______0_000000__0H___0_999 0.0 0.99998474
 /begin AXIS_DESCR COM_AXIS n LINEAR______0_000000__0H___81612 4 0.0 8160.0 AXIS_PTS_REF ldp_n__fac_isapwm_cor MAX_GRAD 100 MONOTONY MON_INCREASE /end AXIS_DESCR
 /begin AXIS_DESCR COM_AXIS pvs_cor_rpl LINEAR______0_000000__0H___119_8 8 0.0 119.8828 AXIS_PTS_REF ldp_pvs_cor_rpl__fac_isapwm_cor MAX_GRAD 100 MONOTONY MON_INCREASE /end AXIS_DESCR
/end CHARACTERISTIC
/begin CHARACTERISTIC ip_fac_maf_sub_ivvt__maf_sub_dia "IP_FAC_MAF_SUB_IVVT" CURVE 0x76900 a_1 100 LINEAR______0_000000__0H___0_996 0.0 0.99609375
 /begin AXIS_DESCR COM_AXIS maf_sub_diag LINEAR______0_000000__0H___1389_ 6 0.0 1389.0 AXIS_PTS_REF ldp_maf_sub_diag__fac_maf_ivvt MAX_GRAD 100 MONOTONY MON_INCREASE /end AXIS_DESCR
/end CHARACTERISTIC
/begin CHARACTERISTIC ip_fac_prop_cru__vs_sp_cru__vs_d "IP_FAC_PROP_CRU" MAP 0x79e8a a_28 10 LINEAR______0_014648__1H___959_9 0.014648 959.854
 /begin AXIS_DESCR COM_AXIS vs_dif_cru LINEAR_______256_000000__0H___25 4 -256.0 255.99218 AXIS_PTS_REF ldp_vs_dif_cru MAX_GRAD 100 MONOTONY MON_INCREASE /end AXIS_DESCR
 /begin AXIS_DESCR COM_AXIS vs_sp_cru LINEAR______0_000000__0H___51151 5 0.0 511.99218 AXIS_PTS_REF ldpm_vs_sp_cru_1 MAX_GRAD 100 MONOTONY MON_INCREASE /end AXIS_DESCR
/end CHARACTERISTIC
/begin CHARACTERISTIC ip_iga_isapwm_min_is__isapwm__ma "IP_IGA_ISAPWM_MIN_IS" MAP 0x76cb3 a_6 100 LINEAR_______48_000000__0H___041 -48.0 0.0
 /begin AXIS_DESCR COM_AXIS maf LINEAR______0_000000__0H___1389_ 2 0.0 1389.0 AXIS_PTS_REF ldpm_maf_16 MAX_GRAD 100 MONOTONY MON_INCREASE /end AXIS_DESCR
 /begin AXIS_DESCR COM_AXIS isapwm LINEAR______0_000000__0H___99_60 5 0.0 99.609375 AXIS_PTS_REF ldpm_isapwm_2 MAX_GRAD 100 MONOTONY MON_INCREASE /end AXIS_DESCR
/end CHARACTERISTIC
/begin CHARACTERISTIC ip_iga_lgrd_fac_st__tco__cycnr_s "IP_IGA_LGRD_FAC_ST" MAP 0x76d3d a_6 100 LINEAR______0_000000__0H___0_996 0.0 0.99609375
 /begin AXIS_DESCR COM_AXIS cycnr_st LINEAR______0_000000__0H___25580 6 0.0 255.0 AXIS_PTS_REF ldp_cycnr_st__iga_lgrd_fac_st MAX_GRAD 100 MONOTONY MON_INCREASE /end AXIS_DESCR
 /begin AXIS_DESCR COM_AXIS tco LINEAR_______48_000000__0H___142 4 -48.0 142.5 AXIS_PTS_REF ldp_tco__iga_lgrd_fac_st MAX_GRAD 100 MONOTONY MON_INCREASE /end AXIS_DESCR
/end CHARACTERISTIC
/begin CHARACTERISTIC ip_isapwm_add_at__tqconvcan__pvs "IP_ISAPWM_ADD_AT" MAP 0x79fb2 a_50 100 LINEAR______0_000000__0H___399_9 0.0 399.9938
 /begin AXIS_DESCR COM_AXIS pvs_av LINEAR______0_000000__0H___119_9 6 0.0 119.99817 AXIS_PTS_REF ldp_pvs_av__isapwm_add_at MAX_GRAD 100 MONOTONY MON_INCREASE /end AXIS_DESCR
 /begin AXIS_DESCR COM_AXIS tq_conv_can LINEAR______0_000000__0H___99_60 6 0.0 99.609375 AXIS_PTS_REF ldp_tq_conv_can__isapwm_add_at MAX_GRAD 100 MONOTONY MON_INCREASE /end AXIS_DESCR
/end CHARACTERISTIC
/begin CHARACTERISTIC ip_isapwm_add_pste__ang_pste__to "IP_ISAPWM_ADD_PSTE" MAP 0x79ffa a_36 100 LINEAR______0_000000__0H___399_9 0.0 399.9938
 /begin AXIS_DESCR COM_AXIS toil LINEAR_______48_000000__0H___155 4 -48.0 155.0 AXIS_PTS_REF ldp_toil__isapwm_add_pste MAX_GRAD 100 MONOTONY MON_INCREASE /end AXIS_DESCR
 /begin AXIS_DESCR COM_AXIS ang_pste LINEAR_______1439_956055__0H___1 6 -1439.9561 1439.9121 AXIS_PTS_REF ldp_ang_pste__isapwm_add_pste MAX_GRAD 100 MONOTONY MON_INCREASE /end AXIS_DESCR
/end CHARACTERISTIC
/begin CHARACTERISTIC ip_isapwm_ch_2_n__tco__n_dif_ch_ "IP_ISAPWM_CH_2_N" MAP 0x7a0a2 a_50 100 LINEAR______0_000000__0H___399_9 0.0 399.9938
 /begin AXIS_DESCR COM_AXIS n_dif_ch_2 LINEAR______0_000000__0H___81605 6 0.0 8160.0 AXIS_PTS_REF ldpm_n_dif_ch_2_1 MAX_GRAD 100 MONOTONY MON_INCREASE /end AXIS_DESCR
 /begin AXIS_DESCR COM_AXIS tco LINEAR_______48_000000__0H___142 8 -48.0 142.5 AXIS_PTS_REF ldpm_tco_13 MAX_GRAD 100 MONOTONY MON_INCREASE /end AXIS_DESCR
/end CHARACTERISTIC
/begin CHARACTERISTIC ip_isapwm_dri_ch_2_n__tco__n_dif "IP_ISAPWM_DRI_CH_2_N" MAP 0x7a1a2 a_50 100 LINEAR______0_000000__0H___399_9 0.0 399.9938
 /begin AXIS_DESCR COM_AXIS n_dif_ch_2 LINEAR______0_000000__0H___81605 6 0.0 8160.0 AXIS_PTS_REF ldpm_n_dif_ch_2_1 MAX_GRAD 100 MONOTONY MON_INCREASE /end AXIS_DESCR
 /begin AXIS_DESCR COM_AXIS tco LINEAR_______48_000000__0H___142 8 -48.0 142.5 AXIS_PTS_REF ldpm_tco_13 MAX_GRAD 100 MONOTONY MON_INCREASE /end AXIS_DESCR
/end CHARACTERISTIC
/begin CHARACTERISTIC ip_isapwm_n_sp_add_spi__n_dif_si "IP_ISAPWM_N_SP_ADD_SPI" CURVE 0x776b2 a_1 100 LINEAR_______25_000000__0H___24_ -25.0 24.804688
 /begin AXIS_DESCR COM_AXIS n_sp_is_sif LINEAR_______256_000000__0H___81 6 -256.0 254.0 AXIS_PTS_REF ldp_n_dif_spi__isapwm_n_sp_add_s MAX_GRAD 100 MONOTONY MON_INCREASE /end AXIS_DESCR
/end CHARACTERISTIC
/begin CHARACTERISTIC ip_isapwm_pvs_add_low_n__n_dif__ "IP_ISAPWM_PVS_ADD_LOW_N" MAP 0x7a3a6 a_36 100 LINEAR______0_000000__0H___99_99 0.0 99.998474
 /begin AXIS_DESCR COM_AXIS n_grd LINEAR_______4096_000000__0H___4 4 -4096.0 4064.0 AXIS_PTS_REF ldpm_n_grd_1 MAX_GRAD 100 MONOTONY MON_INCREASE /end AXIS_DESCR
 /begin AXIS_DESCR COM_AXIS n_dif LINEAR_______32768_000000__0H___ 4 -32768.0 32767.0 AXIS_PTS_REF ldpm_n_dif_1 MAX_GRAD 100 MONOTONY MON_INCREASE /end AXIS_DESCR
 FUNCTION_LIST Z10I /end CHARACTERISTIC
/begin CHARACTERISTIC ip_n_sp_add_cha_cdn_bat__cha_cdn "IP_N_SP_ADD_CHA_CDN_BAT" CURVE 0x7b10c a_3 100 LINEAR______0_000000__0H___10059 0.0 1000.0
 /begin AXIS_DESCR COM_AXIS cha_cdn_bat LINEAR______0_000000__0H___12779 6 0.0 127.5 AXIS_PTS_REF ldpm_cha_cdn_bat_1 MAX_GRAD 100 MONOTONY MON_INCREASE /end AXIS_DESCR
/end CHARACTERISTIC
/begin CHARACTERISTIC ip_pvs_fac_shift_ssg__vs_fil__pv "IP_PVS_FAC_SHIFT_SSG" MAP 0x77b19 a_17 100 LINEAR______0_000000__0H___0_996 0.0 0.99609375
 /begin AXIS_DESCR COM_AXIS pvs_av LINEAR______0_000000__0H___119_9 4 0.0 119.99817 AXIS_PTS_REF ldp_pvs_av__pvs_fac_shift_ssg MAX_GRAD 100 MONOTONY MON_INCREASE /end AXIS_DESCR
 /begin AXIS_DESCR COM_AXIS vs_fil LINEAR______0_000000__0H___51151 4 0.0 511.99218 AXIS_PTS_REF ldp_vs_fil__pvs_fac_shift_ssg MAX_GRAD 100 MONOTONY MON_INCREASE /end AXIS_DESCR
 FUNCTION_LIST Z1S1 /end CHARACTERISTIC
/begin CHARACTERISTIC ip_t_ctl_ivvt_adc_ex__camdifex__ "IP_T_CTL_IVVT_ADC_EX" MAP 0x77c7f a_6 100 LINEAR______0_000000__0H___159_3 0.0 159.375
 /begin AXIS_DESCR COM_AXIS dummy_b LINEAR______0_000000__0H___2550_ 6 0.0 2550.0 AXIS_PTS_REF ldpm_dly_ivvt_y_1 MAX_GRAD 100 MONOTONY MON_INCREASE /end AXIS_DESCR
 /begin AXIS_DESCR COM_AXIS dummy_b LINEAR______0_000000__0H___48_00 8 0.0 48.0 AXIS_PTS_REF ldpm_cam_dif_ctl_x_1 MAX_GRAD 100 MONOTONY MON_INCREASE /end AXIS_DESCR
/end CHARACTERISTIC
/begin CHARACTERISTIC ip_t_ctl_ivvt_adc_in__camdifin__ "IP_T_CTL_IVVT_ADC_IN" MAP 0x77caf a_6 100 LINEAR______0_000000__0H___159_3 0.0 159.375
 /begin AXIS_DESCR COM_AXIS dummy_b LINEAR______0_000000__0H___2550_ 6 0.0 2550.0 AXIS_PTS_REF ldpm_dly_ivvt_y_1 MAX_GRAD 100 MONOTONY MON_INCREASE /end AXIS_DESCR
 /begin AXIS_DESCR COM_AXIS dummy_b LINEAR______0_000000__0H___48_00 8 0.0 48.0 AXIS_PTS_REF ldpm_cam_dif_ctl_x_1 MAX_GRAD 100 MONOTONY MON_INCREASE /end AXIS_DESCR
/end CHARACTERISTIC
/begin CHARACTERISTIC ip_t_ctl_ivvt_rtd_ex__camdifex__ "IP_T_CTL_IVVT_RTD_EX" MAP 0x77d3f a_6 100 LINEAR______0_000000__0H___159_3 0.0 159.375
 /begin AXIS_DESCR COM_AXIS dummy_b LINEAR______0_000000__0H___2550_ 6 0.0 2550.0 AXIS_PTS_REF ldpm_dly_ivvt_y_1 MAX_GRAD 100 MONOTONY MON_INCREASE /end AXIS_DESCR
 /begin AXIS_DESCR COM_AXIS dummy_b LINEAR______0_000000__0H___48_00 8 0.0 48.0 AXIS_PTS_REF ldpm_cam_dif_ctl_x_1 MAX_GRAD 100 MONOTONY MON_INCREASE /end AXIS_DESCR
/end CHARACTERISTIC
/begin CHARACTERISTIC ip_t_ctl_ivvt_rtd_in__camdifin__ "IP_T_CTL_IVVT_RTD_IN" MAP 0x77d6f a_6 100 LINEAR______0_000000__0H___159_3 0.0 159.375
 /begin AXIS_DESCR COM_AXIS dummy_b LINEAR______0_000000__0H___2550_ 6 0.0 2550.0 AXIS_PTS_REF ldpm_dly_ivvt_y_1 MAX_GRAD 100 MONOTONY MON_INCREASE /end AXIS_DESCR
 /begin AXIS_DESCR COM_AXIS dummy_b LINEAR______0_000000__0H___48_00 8 0.0 48.0 AXIS_PTS_REF ldpm_cam_dif_ctl_x_1 MAX_GRAD 100 MONOTONY MON_INCREASE /end AXIS_DESCR
/end CHARACTERISTIC
/begin CHARACTERISTIC ip_t_max_diag_sap__tco_st__km_ct "IP_T_MAX_DIAG_SAP" MAP 0x7bccc a_50 10 LINEAR______0_100000__1H___6553_ 0.1 6553.5
 /begin AXIS_DESCR COM_AXIS km_ctr LINEAR______0_000000__0H___65534 4 0.0 655340.0 AXIS_PTS_REF ldpm_km_ctr_1 MAX_GRAD 100 MONOTONY MON_INCREASE /end AXIS_DESCR
 /begin AXIS_DESCR COM_AXIS tco_st LINEAR_______48_000000__0H___142 8 -48.0 142.5 AXIS_PTS_REF ldpm_tco_st_7 MAX_GRAD 100 MONOTONY MON_INCREASE /end AXIS_DESCR
/end CHARACTERISTIC
/begin CHARACTERISTIC ip_t_max_diag_sav__tco_st__km_ct "IP_T_MAX_DIAG_SAV" MAP 0x7bd0c a_50 10 LINEAR______0_100000__1H___6553_ 0.1 6553.5
 /begin AXIS_DESCR COM_AXIS km_ctr LINEAR______0_000000__0H___65534 4 0.0 655340.0 AXIS_PTS_REF ldpm_km_ctr_1 MAX_GRAD 100 MONOTONY MON_INCREASE /end AXIS_DESCR
 /begin AXIS_DESCR COM_AXIS tco_st LINEAR_______48_000000__0H___142 8 -48.0 142.5 AXIS_PTS_REF ldpm_tco_st_7 MAX_GRAD 100 MONOTONY MON_INCREASE /end AXIS_DESCR
/end CHARACTERISTIC
/begin CHARACTERISTIC ip_t_sum_min_ivvt_adc_ex__n__toi "IP_T_SUM_MIN_IVVT_ADC_EX" MAP 0x78050 a_6 100 LINEAR______0_625000__1H___159_3 0.625 159.375
 /begin AXIS_DESCR COM_AXIS toil LINEAR_______48_000000__0H___155 3 -48.0 155.0 AXIS_PTS_REF ldpm_toil_4 MAX_GRAD 100 MONOTONY MON_INCREASE /end AXIS_DESCR
 /begin AXIS_DESCR COM_AXIS n_32 LINEAR______0_000000__0H___8160_ 3 0.0 8160.0 AXIS_PTS_REF ldpm_n_32_50 MAX_GRAD 100 MONOTONY MON_INCREASE /end AXIS_DESCR
/end CHARACTERISTIC
/begin CHARACTERISTIC ip_t_sum_min_ivvt_adc_in__n__toi "IP_T_SUM_MIN_IVVT_ADC_IN" MAP 0x78059 a_6 100 LINEAR______0_625000__1H___159_3 0.625 159.375
 /begin AXIS_DESCR COM_AXIS toil LINEAR_______48_000000__0H___155 3 -48.0 155.0 AXIS_PTS_REF ldpm_toil_4 MAX_GRAD 100 MONOTONY MON_INCREASE /end AXIS_DESCR
 /begin AXIS_DESCR COM_AXIS n_32 LINEAR______0_000000__0H___8160_ 3 0.0 8160.0 AXIS_PTS_REF ldpm_n_32_50 MAX_GRAD 100 MONOTONY MON_INCREASE /end AXIS_DESCR
/end CHARACTERISTIC
/begin CHARACTERISTIC ip_t_sum_min_ivvt_rtd_ex__n__toi "IP_T_SUM_MIN_IVVT_RTD_EX" MAP 0x78066 a_6 100 LINEAR______0_625000__1H___159_3 0.625 159.375
 /begin AXIS_DESCR COM_AXIS toil LINEAR_______48_000000__0H___155 3 -48.0 155.0 AXIS_PTS_REF ldpm_toil_4 MAX_GRAD 100 MONOTONY MON_INCREASE /end AXIS_DESCR
 /begin AXIS_DESCR COM_AXIS n_32 LINEAR______0_000000__0H___8160_ 3 0.0 8160.0 AXIS_PTS_REF ldpm_n_32_50 MAX_GRAD 100 MONOTONY MON_INCREASE /end AXIS_DESCR
/end CHARACTERISTIC
/begin CHARACTERISTIC ip_t_sum_min_ivvt_rtd_in__n__toi "IP_T_SUM_MIN_IVVT_RTD_IN" MAP 0x7806f a_6 100 LINEAR______0_625000__1H___159_3 0.625 159.375
 /begin AXIS_DESCR COM_AXIS toil LINEAR_______48_000000__0H___155 3 -48.0 155.0 AXIS_PTS_REF ldpm_toil_4 MAX_GRAD 100 MONOTONY MON_INCREASE /end AXIS_DESCR
 /begin AXIS_DESCR COM_AXIS n_32 LINEAR______0_000000__0H___8160_ 3 0.0 8160.0 AXIS_PTS_REF ldpm_n_32_50 MAX_GRAD 100 MONOTONY MON_INCREASE /end AXIS_DESCR
/end CHARACTERISTIC
/begin CHARACTERISTIC ip_t_tps_req_ltc_max_0__n__maf_m "IP_T_TPS_REQ_LTC_MAX_0" MAP 0x7c254 a_28 100 LINEAR______0_000000__0H___65582 0.0 655.35
 /begin AXIS_DESCR COM_AXIS maf_mmv LINEAR______0_000000__0H___13818 4 0.0 1389.0 AXIS_PTS_REF ldpm_maf_mmv_2 MAX_GRAD 100 MONOTONY MON_INCREASE /end AXIS_DESCR
 /begin AXIS_DESCR COM_AXIS n LINEAR______0_000000__0H___81612 6 0.0 8160.0 AXIS_PTS_REF ldpm_n_25 MAX_GRAD 100 MONOTONY MON_INCREASE /end AXIS_DESCR
/end CHARACTERISTIC
/begin CHARACTERISTIC ip_t_tps_req_ltc_max_1__n__maf_m "IP_T_TPS_REQ_LTC_MAX_1" MAP 0x7c284 a_28 100 LINEAR______0_000000__0H___65582 0.0 655.35
 /begin AXIS_DESCR COM_AXIS maf_mmv LINEAR______0_000000__0H___13818 4 0.0 1389.0 AXIS_PTS_REF ldpm_maf_mmv_2 MAX_GRAD 100 MONOTONY MON_INCREASE /end AXIS_DESCR
 /begin AXIS_DESCR COM_AXIS n LINEAR______0_000000__0H___81612 6 0.0 8160.0 AXIS_PTS_REF ldpm_n_25 MAX_GRAD 100 MONOTONY MON_INCREASE /end AXIS_DESCR
/end CHARACTERISTIC
/begin CHARACTERISTIC ip_t_tps_req_ltc_max_2__n__maf_m "IP_T_TPS_REQ_LTC_MAX_2" MAP 0x7c2b4 a_28 100 LINEAR______0_000000__0H___65582 0.0 655.35
 /begin AXIS_DESCR COM_AXIS maf_mmv LINEAR______0_000000__0H___13818 4 0.0 1389.0 AXIS_PTS_REF ldpm_maf_mmv_2 MAX_GRAD 100 MONOTONY MON_INCREASE /end AXIS_DESCR
 /begin AXIS_DESCR COM_AXIS n LINEAR______0_000000__0H___81612 6 0.0 8160.0 AXIS_PTS_REF ldpm_n_25 MAX_GRAD 100 MONOTONY MON_INCREASE /end AXIS_DESCR
/end CHARACTERISTIC
/begin CHARACTERISTIC ip_t_tps_req_ltc_max_3__n__maf_m "IP_T_TPS_REQ_LTC_MAX_3" MAP 0x7c2e4 a_28 100 LINEAR______0_000000__0H___65582 0.0 655.35
 /begin AXIS_DESCR COM_AXIS maf_mmv LINEAR______0_000000__0H___13818 4 0.0 1389.0 AXIS_PTS_REF ldpm_maf_mmv_2 MAX_GRAD 100 MONOTONY MON_INCREASE /end AXIS_DESCR
 /begin AXIS_DESCR COM_AXIS n LINEAR______0_000000__0H___81612 6 0.0 8160.0 AXIS_PTS_REF ldpm_n_25 MAX_GRAD 100 MONOTONY MON_INCREASE /end AXIS_DESCR
/end CHARACTERISTIC
/begin CHARACTERISTIC ip_t_tps_req_ltc_max_4__n__maf_m "IP_T_TPS_REQ_LTC_MAX_4" MAP 0x7c314 a_28 100 LINEAR______0_000000__0H___65582 0.0 655.35
 /begin AXIS_DESCR COM_AXIS maf_mmv LINEAR______0_000000__0H___13818 4 0.0 1389.0 AXIS_PTS_REF ldpm_maf_mmv_2 MAX_GRAD 100 MONOTONY MON_INCREASE /end AXIS_DESCR
 /begin AXIS_DESCR COM_AXIS n LINEAR______0_000000__0H___81612 6 0.0 8160.0 AXIS_PTS_REF ldpm_n_25 MAX_GRAD 100 MONOTONY MON_INCREASE /end AXIS_DESCR
/end CHARACTERISTIC
/begin CHARACTERISTIC ip_t_tps_req_ltc_max_5__n__maf_m "IP_T_TPS_REQ_LTC_MAX_5" MAP 0x7c344 a_28 100 LINEAR______0_000000__0H___65582 0.0 655.35
 /begin AXIS_DESCR COM_AXIS maf_mmv LINEAR______0_000000__0H___13818 4 0.0 1389.0 AXIS_PTS_REF ldpm_maf_mmv_2 MAX_GRAD 100 MONOTONY MON_INCREASE /end AXIS_DESCR
 /begin AXIS_DESCR COM_AXIS n LINEAR______0_000000__0H___81612 6 0.0 8160.0 AXIS_PTS_REF ldpm_n_25 MAX_GRAD 100 MONOTONY MON_INCREASE /end AXIS_DESCR
/end CHARACTERISTIC
/begin CHARACTERISTIC ip_temp_ecf_up_1__ecfpwm_ecf__ma "IP_TEMP_ECF_UP_1" MAP 0x7c3d4 a_50 100 LINEAR_______1024_000000__0H__83 -1024.0 1023.9688
 /begin AXIS_DESCR COM_AXIS maf_kgh LINEAR______0_000000__0H___16383 6 0.0 16383.75 AXIS_PTS_REF ldpm_maf_kgh_18 MAX_GRAD 100 MONOTONY MON_INCREASE /end AXIS_DESCR
 /begin AXIS_DESCR COM_AXIS ecfpwm_ecf LINEAR______0_000000__0H___99_60 6 0.0 99.609375 AXIS_PTS_REF ldp_ecfpwm_ecf__temp_ecf_up_1 MAX_GRAD 100 MONOTONY MON_INCREASE /end AXIS_DESCR
 FUNCTION_LIST ETM /end CHARACTERISTIC
/begin CHARACTERISTIC ip_temp_ecf_up_2__ecfpwm_ecf__ma "IP_TEMP_ECF_UP_2" MAP 0x7c41c a_50 100 LINEAR_______1024_000000__0H__83 -1024.0 1023.9688
 /begin AXIS_DESCR COM_AXIS maf_kgh LINEAR______0_000000__0H___16383 6 0.0 16383.75 AXIS_PTS_REF ldpm_maf_kgh_18 MAX_GRAD 100 MONOTONY MON_INCREASE /end AXIS_DESCR
 /begin AXIS_DESCR COM_AXIS ecfpwm_ecf LINEAR______0_000000__0H___99_60 6 0.0 99.609375 AXIS_PTS_REF ldp_ecfpwm_ecf__temp_ecf_up_2 MAX_GRAD 100 MONOTONY MON_INCREASE /end AXIS_DESCR
 FUNCTION_LIST ETM /end CHARACTERISTIC
/begin CHARACTERISTIC ip_temp_fac_ti_dif_up__n__fac_ti "IP_TEMP_FAC_TI_DIF_UP" MAP 0x7c464 a_36 100 LINEAR_______1024_000000__0H__83 -1024.0 1023.9688
 /begin AXIS_DESCR COM_AXIS dummy_b LINEAR_______0_500000__0H___0_49 12 -0.5 0.49599999 AXIS_PTS_REF ldpm_fac_ti_dif_i_1 MAX_GRAD 100 MONOTONY MON_INCREASE /end AXIS_DESCR
 /begin AXIS_DESCR COM_AXIS n LINEAR______0_000000__0H___81612 8 0.0 8160.0 AXIS_PTS_REF ldpm_n_17 MAX_GRAD 100 MONOTONY MON_INCREASE /end AXIS_DESCR
 FUNCTION_LIST ETM /end CHARACTERISTIC
/begin CHARACTERISTIC ip_temp_fac_toil__temp_sp_toil_d "IP_TEMP_FAC_TOIL" CURVE 0x78244 a_7 100 LINEAR______0_000000__0H___1_992 0.0 1.9921875
 /begin AXIS_DESCR COM_AXIS toil_dif LINEAR_______203_000000__0H___20 8 -203.0 203.0 AXIS_PTS_REF ldpm_temp_sp_toil_dif_1 MAX_GRAD 100 MONOTONY MON_INCREASE /end AXIS_DESCR
 FUNCTION_LIST ETM /end CHARACTERISTIC
/begin CHARACTERISTIC ip_temp_sub_cat_min_cop_ron__iga "IP_TEMP_SUB_CAT_MIN_COP_RON" CURVE 0x78330 a_1 100 LINEAR_______33_000000__0H___987 -33.0 987.0
 /begin AXIS_DESCR COM_AXIS dummy_b LINEAR______0_000000__0H___95_22 4 0.0 95.625 AXIS_PTS_REF ldp_iga_dif__tmpsubcatmincopron MAX_GRAD 100 MONOTONY MON_INCREASE /end AXIS_DESCR
/end CHARACTERISTIC
/begin CHARACTERISTIC ip_temp_sub_wall_puc_up_1__maf_k "IP_TEMP_SUB_WALL_PUC_UP_1" CURVE 0x7c82c a_24 100 LINEAR_______33_000000__0H___989 -33.0 989.9844
 /begin AXIS_DESCR COM_AXIS maf_kgh LINEAR______0_000000__0H___16383 8 0.0 16383.75 AXIS_PTS_REF ldpm_maf_kgh_17 MAX_GRAD 100 MONOTONY MON_INCREASE /end AXIS_DESCR
 FUNCTION_LIST ETM /end CHARACTERISTIC
/begin CHARACTERISTIC ip_temp_sub_wall_puc_up_2__maf_k "IP_TEMP_SUB_WALL_PUC_UP_2" CURVE 0x7c83c a_24 100 LINEAR_______33_000000__0H___989 -33.0 989.9844
 /begin AXIS_DESCR COM_AXIS maf_kgh LINEAR______0_000000__0H___16383 8 0.0 16383.75 AXIS_PTS_REF ldpm_maf_kgh_17 MAX_GRAD 100 MONOTONY MON_INCREASE /end AXIS_DESCR
 FUNCTION_LIST ETM /end CHARACTERISTIC
/begin CHARACTERISTIC ip_temp_wall_ecf_up_1__ecfpwm_ec "IP_TEMP_WALL_ECF_UP_1" MAP 0x7ca0c a_50 100 LINEAR_______1024_000000__0H__83 -1024.0 1023.9688
 /begin AXIS_DESCR COM_AXIS maf_kgh LINEAR______0_000000__0H___16383 6 0.0 16383.75 AXIS_PTS_REF ldpm_maf_kgh_18 MAX_GRAD 100 MONOTONY MON_INCREASE /end AXIS_DESCR
 /begin AXIS_DESCR COM_AXIS ecfpwm_ecf LINEAR______0_000000__0H___99_60 6 0.0 99.609375 AXIS_PTS_REF ldp_ecfpwm_ecf__temp_ecf_up_1 MAX_GRAD 100 MONOTONY MON_INCREASE /end AXIS_DESCR
 FUNCTION_LIST ETM /end CHARACTERISTIC
/begin CHARACTERISTIC ip_temp_wall_ecf_up_2__ecfpwm_ec "IP_TEMP_WALL_ECF_UP_2" MAP 0x7ca54 a_50 100 LINEAR_______1024_000000__0H__83 -1024.0 1023.9688
 /begin AXIS_DESCR COM_AXIS maf_kgh LINEAR______0_000000__0H___16383 6 0.0 16383.75 AXIS_PTS_REF ldpm_maf_kgh_18 MAX_GRAD 100 MONOTONY MON_INCREASE /end AXIS_DESCR
 /begin AXIS_DESCR COM_AXIS ecfpwm_ecf LINEAR______0_000000__0H___99_60 6 0.0 99.609375 AXIS_PTS_REF ldp_ecfpwm_ecf__temp_ecf_up_2 MAX_GRAD 100 MONOTONY MON_INCREASE /end AXIS_DESCR
 FUNCTION_LIST ETM /end CHARACTERISTIC
/begin CHARACTERISTIC ip_temp_wall_fac_maf_fac_ti_dif_ "IP_TEMP_WALL_FAC_MAF_FAC_TI_DIF" CURVE 0x78360 a_7 100 LINEAR______0_000000__0H___1_992 0.0 1.9921875
 /begin AXIS_DESCR COM_AXIS maf LINEAR______0_000000__0H___13818 8 0.0 1389.0 AXIS_PTS_REF ldpm_maf_17 MAX_GRAD 100 MONOTONY MON_INCREASE /end AXIS_DESCR
 FUNCTION_LIST ETM /end CHARACTERISTIC
/begin CHARACTERISTIC ip_temp_wall_fac_maf_iga_dif__ma "IP_TEMP_WALL_FAC_MAF_IGA_DIF" CURVE 0x78368 a_7 100 LINEAR______0_000000__0H___1_992 0.0 1.9921875
 /begin AXIS_DESCR COM_AXIS maf LINEAR______0_000000__0H___13818 8 0.0 1389.0 AXIS_PTS_REF ldpm_maf_17 MAX_GRAD 100 MONOTONY MON_INCREASE /end AXIS_DESCR
 FUNCTION_LIST ETM /end CHARACTERISTIC
/begin CHARACTERISTIC ip_temp_wall_fac_ti_dif_up__n__f "IP_TEMP_WALL_FAC_TI_DIF_UP" MAP 0x7ca9c a_36 100 LINEAR_______1024_000000__0H__83 -1024.0 1023.9688
 /begin AXIS_DESCR COM_AXIS dummy_b LINEAR_______0_500000__0H___0_49 12 -0.5 0.49599999 AXIS_PTS_REF ldpm_fac_ti_dif_i_1 MAX_GRAD 100 MONOTONY MON_INCREASE /end AXIS_DESCR
 /begin AXIS_DESCR COM_AXIS n LINEAR______0_000000__0H___81612 8 0.0 8160.0 AXIS_PTS_REF ldpm_n_17 MAX_GRAD 100 MONOTONY MON_INCREASE /end AXIS_DESCR
 FUNCTION_LIST ETM /end CHARACTERISTIC
/begin CHARACTERISTIC ip_temp_wall_fac_toil__temp_sp_t "IP_TEMP_WALL_FAC_TOIL" CURVE 0x783b0 a_7 100 LINEAR______0_000000__0H___1_992 0.0 1.9921875
 /begin AXIS_DESCR COM_AXIS toil_dif LINEAR_______203_000000__0H___20 8 -203.0 203.0 AXIS_PTS_REF ldpm_temp_sp_toil_dif_1 MAX_GRAD 100 MONOTONY MON_INCREASE /end AXIS_DESCR
 FUNCTION_LIST ETM /end CHARACTERISTIC
/begin CHARACTERISTIC ip_temp_wall_iga_dif_up__n__iga_ "IP_TEMP_WALL_IGA_DIF_UP" MAP 0x7cb5c a_36 100 LINEAR______0_000000__0H___10253 0.0 1023.9844
 /begin AXIS_DESCR COM_AXIS dummy_b LINEAR______0_000000__0H___95_22 6 0.0 95.625 AXIS_PTS_REF ldpm_iga_dif_1 MAX_GRAD 100 MONOTONY MON_INCREASE /end AXIS_DESCR
 /begin AXIS_DESCR COM_AXIS n LINEAR______0_000000__0H___81612 8 0.0 8160.0 AXIS_PTS_REF ldpm_n_17 MAX_GRAD 100 MONOTONY MON_INCREASE /end AXIS_DESCR
 FUNCTION_LIST ETM /end CHARACTERISTIC
/begin CHARACTERISTIC ip_temp_wall_sap_up__saf_kgh__ma "IP_TEMP_WALL_SAP_UP" MAP 0x7cbbc a_28 100 LINEAR_______1023_984375__FFFFH_ -1023.9847 0.0
 /begin AXIS_DESCR COM_AXIS maf_kgh LINEAR______0_000000__0H___16383 6 0.0 16383.75 AXIS_PTS_REF ldpm_maf_kgh_18 MAX_GRAD 100 MONOTONY MON_INCREASE /end AXIS_DESCR
 /begin AXIS_DESCR COM_AXIS saf_kgh LINEAR______0_000000__0H___10269 6 0.0 1023.9844 AXIS_PTS_REF ldp_saf_kgh__temp_sap_up MAX_GRAD 100 MONOTONY MON_INCREASE /end AXIS_DESCR
 FUNCTION_LIST ETM /end CHARACTERISTIC
/begin CHARACTERISTIC ip_tps_req_ltc_lgrd_0__n__maf_mm "IP_TPS_REQ_LTC_LGRD_0" MAP 0x7dcec a_28 100 LINEAR______0_000000__0H___11975 0.0 119.5
 /begin AXIS_DESCR COM_AXIS maf_mmv LINEAR______0_000000__0H___13818 4 0.0 1389.0 AXIS_PTS_REF ldpm_maf_mmv_3 MAX_GRAD 100 MONOTONY MON_INCREASE /end AXIS_DESCR
 /begin AXIS_DESCR COM_AXIS n LINEAR______0_000000__0H___81612 6 0.0 8160.0 AXIS_PTS_REF ldpm_n_26 MAX_GRAD 100 MONOTONY MON_INCREASE /end AXIS_DESCR
/end CHARACTERISTIC
/begin CHARACTERISTIC ip_tps_req_ltc_lgrd_1__n__maf_mm "IP_TPS_REQ_LTC_LGRD_1" MAP 0x7dd1c a_28 100 LINEAR______0_000000__0H___11975 0.0 119.5
 /begin AXIS_DESCR COM_AXIS maf_mmv LINEAR______0_000000__0H___13818 4 0.0 1389.0 AXIS_PTS_REF ldpm_maf_mmv_3 MAX_GRAD 100 MONOTONY MON_INCREASE /end AXIS_DESCR
 /begin AXIS_DESCR COM_AXIS n LINEAR______0_000000__0H___81612 6 0.0 8160.0 AXIS_PTS_REF ldpm_n_26 MAX_GRAD 100 MONOTONY MON_INCREASE /end AXIS_DESCR
/end CHARACTERISTIC
/begin CHARACTERISTIC ip_tps_req_ltc_lgrd_2__n__maf_mm "IP_TPS_REQ_LTC_LGRD_2" MAP 0x7dd4c a_28 100 LINEAR______0_000000__0H___11975 0.0 119.5
 /begin AXIS_DESCR COM_AXIS maf_mmv LINEAR______0_000000__0H___13818 4 0.0 1389.0 AXIS_PTS_REF ldpm_maf_mmv_3 MAX_GRAD 100 MONOTONY MON_INCREASE /end AXIS_DESCR
 /begin AXIS_DESCR COM_AXIS n LINEAR______0_000000__0H___81612 6 0.0 8160.0 AXIS_PTS_REF ldpm_n_26 MAX_GRAD 100 MONOTONY MON_INCREASE /end AXIS_DESCR
/end CHARACTERISTIC
/begin CHARACTERISTIC ip_tps_req_ltc_lgrd_3__n__maf_mm "IP_TPS_REQ_LTC_LGRD_3" MAP 0x7dd7c a_28 100 LINEAR______0_000000__0H___11975 0.0 119.5
 /begin AXIS_DESCR COM_AXIS maf_mmv LINEAR______0_000000__0H___13818 4 0.0 1389.0 AXIS_PTS_REF ldpm_maf_mmv_3 MAX_GRAD 100 MONOTONY MON_INCREASE /end AXIS_DESCR
 /begin AXIS_DESCR COM_AXIS n LINEAR______0_000000__0H___81612 6 0.0 8160.0 AXIS_PTS_REF ldpm_n_26 MAX_GRAD 100 MONOTONY MON_INCREASE /end AXIS_DESCR
/end CHARACTERISTIC
/begin CHARACTERISTIC ip_tps_req_ltc_lgrd_4__n__maf_mm "IP_TPS_REQ_LTC_LGRD_4" MAP 0x7ddac a_28 100 LINEAR______0_000000__0H___11975 0.0 119.5
 /begin AXIS_DESCR COM_AXIS maf_mmv LINEAR______0_000000__0H___13818 4 0.0 1389.0 AXIS_PTS_REF ldpm_maf_mmv_3 MAX_GRAD 100 MONOTONY MON_INCREASE /end AXIS_DESCR
 /begin AXIS_DESCR COM_AXIS n LINEAR______0_000000__0H___81612 6 0.0 8160.0 AXIS_PTS_REF ldpm_n_26 MAX_GRAD 100 MONOTONY MON_INCREASE /end AXIS_DESCR
/end CHARACTERISTIC
/begin CHARACTERISTIC ip_tps_req_ltc_lgrd_5__n__maf_mm "IP_TPS_REQ_LTC_LGRD_5" MAP 0x7dddc a_28 100 LINEAR______0_000000__0H___11975 0.0 119.5
 /begin AXIS_DESCR COM_AXIS maf_mmv LINEAR______0_000000__0H___13818 4 0.0 1389.0 AXIS_PTS_REF ldpm_maf_mmv_3 MAX_GRAD 100 MONOTONY MON_INCREASE /end AXIS_DESCR
 /begin AXIS_DESCR COM_AXIS n LINEAR______0_000000__0H___81612 6 0.0 8160.0 AXIS_PTS_REF ldpm_n_26 MAX_GRAD 100 MONOTONY MON_INCREASE /end AXIS_DESCR
/end CHARACTERISTIC
/begin CHARACTERISTIC ip_tps_sp_pvs_add_low_n__n_dif__ "IP_TPS_SP_PVS_ADD_LOW_N" MAP 0x7e07c a_36 100 LINEAR______0_000000__0H___119_9 0.0 119.99817
 /begin AXIS_DESCR COM_AXIS n_grd LINEAR_______4096_000000__0H___4 4 -4096.0 4064.0 AXIS_PTS_REF ldpm_n_grd_1 MAX_GRAD 100 MONOTONY MON_INCREASE /end AXIS_DESCR
 /begin AXIS_DESCR COM_AXIS n_dif LINEAR_______32768_000000__0H___ 4 -32768.0 32767.0 AXIS_PTS_REF ldpm_n_dif_1 MAX_GRAD 100 MONOTONY MON_INCREASE /end AXIS_DESCR
 FUNCTION_LIST Z10I /end CHARACTERISTIC
/begin CHARACTERISTIC ip_tqi_mtc_close_crlc_amt__tps_a "IP_TQI_MTC_CLOSE_CRLC_AMT" CURVE 0x78dd9 a_7 100 LINEAR______0_000000__0H___0_996 0.0 0.99609375
 /begin AXIS_DESCR COM_AXIS tps_av_prj LINEAR______0_000000__0H___119_9 6 0.0 119.99817 AXIS_PTS_REF ldpm_tps_av_3 MAX_GRAD 100 MONOTONY MON_INCREASE /end AXIS_DESCR
 FUNCTION_LIST Z1S1 /end CHARACTERISTIC
/begin CHARACTERISTIC ip_tqi_mtc_close_crlc_etc__tps_a "IP_TQI_MTC_CLOSE_CRLC_ETC" CURVE 0x78ddf a_7 100 LINEAR______0_000000__0H___0_996 0.0 0.99609375
 /begin AXIS_DESCR COM_AXIS tps_av_prj LINEAR______0_000000__0H___119_9 6 0.0 119.99817 AXIS_PTS_REF ldpm_tps_av_3 MAX_GRAD 100 MONOTONY MON_INCREASE /end AXIS_DESCR
/end CHARACTERISTIC
/begin CHARACTERISTIC ip_tqi_mtc_close_crlc_lim__tps_a "IP_TQI_MTC_CLOSE_CRLC_LIM" CURVE 0x78de5 a_7 100 LINEAR______0_000000__0H___0_996 0.0 0.99609375
 /begin AXIS_DESCR COM_AXIS tps_av_1 LINEAR______0_000000__0H___119_9 6 0.0 119.99817 AXIS_PTS_REF ldpm_tps_av_1 MAX_GRAD 100 MONOTONY MON_INCREASE /end AXIS_DESCR
/end CHARACTERISTIC
/begin CHARACTERISTIC ip_isapwm_sp_amp_cor_st__fac_amp "IP_ISAPWM_SP_AMP_COR_ST" MAP 0x7a3d6 a_50 100 LINEAR_______50_000000__0H___440 -50.0 49.998471
 /begin AXIS_DESCR COM_AXIS n LINEAR______0_000000__0H___81612 4 0.0 8160.0 AXIS_PTS_REF ldpm_n_22 MAX_GRAD 100 MONOTONY MON_INCREASE /end AXIS_DESCR
 /begin AXIS_DESCR COM_AXIS fac_amp LINEAR______0_000000__0H___1_992 6 0.0 1.9921875 AXIS_PTS_REF ldp_fac_amp__isapwm_sp_amp_cor_s MAX_GRAD 100 MONOTONY MON_INCREASE /end AXIS_DESCR
/end CHARACTERISTIC
/begin CHARACTERISTIC ip_isapwm_cha_cdn_bat__n_sp_dif_ "IP_ISAPWM_CHA_CDN_BAT" CURVE 0x7a172 a_24 100 LINEAR______0_000000__0H___399_9 0.0 399.9938
 /begin AXIS_DESCR COM_AXIS n_sp_dif_bat LINEAR______0_000000__0H___81605 4 0.0 8160.0 AXIS_PTS_REF ldp_n_sp_dif_bat__isapwm_cha_cdn MAX_GRAD 100 /end AXIS_DESCR
/end CHARACTERISTIC
/begin CHARACTERISTIC ip_isapwm_dri_cha_cdn_bat__n_sp_ "IP_ISAPWM_DRI_CHA_CDN_BAT" CURVE 0x7a202 a_24 100 LINEAR______0_000000__0H___399_9 0.0 399.9938
 /begin AXIS_DESCR COM_AXIS n_sp_dif_bat LINEAR______0_000000__0H___81605 4 0.0 8160.0 AXIS_PTS_REF ldp_n_sp_dif_bat__isapwm_dri_cha MAX_GRAD 100 /end AXIS_DESCR
/end CHARACTERISTIC
/begin CHARACTERISTIC ip_fac_isapwm_accin_cor__pvs_cor "IP_FAC_ISAPWM_ACCIN_COR" MAP 0x79d4a a_28 100 LINEAR______0_000000__0H___0_999 0.0 0.99998474
 /begin AXIS_DESCR COM_AXIS n LINEAR______0_000000__0H___81612 4 0.0 8160.0 AXIS_PTS_REF ldp_n__fac_isapwm_accin_cor MAX_GRAD 100 MONOTONY MON_INCREASE /end AXIS_DESCR
 /begin AXIS_DESCR COM_AXIS pvs_cor_rpl LINEAR______0_000000__0H___119_8 4 0.0 119.8828 AXIS_PTS_REF ldp_pvs_cor_rpl__fac_isapwm_acci MAX_GRAD 100 MONOTONY MON_INCREASE /end AXIS_DESCR
/end CHARACTERISTIC
/begin CHARACTERISTIC ip_egy_dew_end_st_down__tco_st__ "IP_EGY_DEW_END_ST_DOWN" MAP 0x79bca a_50 100 LINEAR______0_000000__0H___7456_ 0.0 7456.426
 /begin AXIS_DESCR COM_AXIS dummy_w LINEAR_______33_000000__0H___989 8 -33.0 989.9844 AXIS_PTS_REF ldp_temp_mmv_sub_wall_down_1__eg MAX_GRAD 100 MONOTONY MON_INCREASE /end AXIS_DESCR
 /begin AXIS_DESCR COM_AXIS tco_st LINEAR_______48_000000__0H___142 8 -48.0 142.5 AXIS_PTS_REF ldpm_tco_st_9 MAX_GRAD 100 MONOTONY MON_INCREASE /end AXIS_DESCR
 FUNCTION_LIST DPM /end CHARACTERISTIC
/begin CHARACTERISTIC ip_egy_dew_end_st_up__tco_st__te "IP_EGY_DEW_END_ST_UP" MAP 0x79c4a a_50 100 LINEAR______0_000000__0H___7456_ 0.0 7456.426
 /begin AXIS_DESCR COM_AXIS dummy_w LINEAR_______33_000000__0H___989 8 -33.0 989.9844 AXIS_PTS_REF ldp_temp_mmv_sub_wall_up_1__egy_ MAX_GRAD 100 MONOTONY MON_INCREASE /end AXIS_DESCR
 /begin AXIS_DESCR COM_AXIS tco_st LINEAR_______48_000000__0H___142 8 -48.0 142.5 AXIS_PTS_REF ldpm_tco_st_9 MAX_GRAD 100 MONOTONY MON_INCREASE /end AXIS_DESCR
 FUNCTION_LIST DPM /end CHARACTERISTIC
/begin CHARACTERISTIC ip_isapwm_add_tq_conv__tqconvcan "IP_ISAPWM_ADD_TQ_CONV" MAP 0x7a02a a_50 100 LINEAR______0_000000__0H___399_9 0.0 399.9938
 /begin AXIS_DESCR COM_AXIS pvs_av LINEAR______0_000000__0H___119_9 6 0.0 119.99817 AXIS_PTS_REF ldp_pvs_av__isapwm_add_tq_conv MAX_GRAD 100 MONOTONY MON_INCREASE /end AXIS_DESCR
 /begin AXIS_DESCR COM_AXIS tq_conv_can LINEAR______0_000000__0H___99_60 6 0.0 99.609375 AXIS_PTS_REF ldp_tq_conv_can__isapwm_add_tqco MAX_GRAD 100 MONOTONY MON_INCREASE /end AXIS_DESCR
/end CHARACTERISTIC
/begin CHARACTERISTIC ip_o2_cat_int_max__vls_cat_o2_su "IP_O2_CAT_INT_MAX" CURVE 0x779a9 a_7 100 LINEAR______0_000000__0H___0_996 0.0 0.99609375
 /begin AXIS_DESCR COM_AXIS dummy_b LINEAR______0_000000__0H___42949 6 0.0 4.2949673e+009 AXIS_PTS_REF ldp_vls_cat_o2_sum__o2_cat_int_m MAX_GRAD 100 MONOTONY MON_INCREASE /end AXIS_DESCR
/end CHARACTERISTIC
/begin CHARACTERISTIC ip_fac_cyc_ratio_1_cyl_lam__vls_ "IP_FAC_CYC_RATIO_1_CYL_LAM" CURVE 0x7661a a_7 100 LINEAR______0_000000__0H___1_992 0.0 1.9921875
 /begin AXIS_DESCR COM_AXIS vls_cyc_ratio_mv_1 LINEAR______0_000000__0H___1_284 6 0.0 1.275 AXIS_PTS_REF ldp_vls_cyc_ratio_mv_1__fac_frq_ MAX_GRAD 100 MONOTONY MON_INCREASE /end AXIS_DESCR
 FUNCTION_LIST CSCM /end CHARACTERISTIC
/begin CHARACTERISTIC ip_fac_cyc_ratio_2_cyl_lam__vls_ "IP_FAC_CYC_RATIO_2_CYL_LAM" CURVE 0x76620 a_7 100 LINEAR______0_000000__0H___1_992 0.0 1.9921875
 /begin AXIS_DESCR COM_AXIS vls_cyc_ratio_mv_2 LINEAR______0_000000__0H___1_284 6 0.0 1.275 AXIS_PTS_REF ldp_vls_cyc_ratio_mv_2__fac_frq_ MAX_GRAD 100 MONOTONY MON_INCREASE /end AXIS_DESCR
 FUNCTION_LIST CSCM /end CHARACTERISTIC
/begin CHARACTERISTIC ip_fac_cur_dmtl_ref__cur_dmtl "IP_FAC_CUR_DMTL_REF" CURVE 0x79cde a_24 100 LINEAR______0_000000__0H___0_999 0.0 0.99998474
 /begin AXIS_DESCR COM_AXIS cur_dmtl_dif_ref_rough_leak LINEAR______0_000000__0H___400_0 8 0.0 400.0 AXIS_PTS_REF ldpm_cur_dmtl_dif_ref_rough_leak MAX_GRAD 100 MONOTONY MON_INCREASE /end AXIS_DESCR
 FUNCTION_LIST DMTL /end CHARACTERISTIC
/begin CHARACTERISTIC ip_fac_cur_dmtl_rough__cur_dmtl "IP_FAC_CUR_DMTL_ROUGH" CURVE 0x79cee a_24 100 LINEAR______0_000000__0H___0_999 0.0 0.99998474
 /begin AXIS_DESCR COM_AXIS cur_dmtl_dif_ref_rough_leak LINEAR______0_000000__0H___400_0 8 0.0 400.0 AXIS_PTS_REF ldpm_cur_dmtl_dif_ref_rough_leak MAX_GRAD 100 MONOTONY MON_INCREASE /end AXIS_DESCR
 FUNCTION_LIST DMTL /end CHARACTERISTIC
/begin CHARACTERISTIC ip_t_cur_dmtl_stat__cur_dmtl__ft "IP_T_CUR_DMTL_STAT" MAP 0x7b78c a_36 10 LINEAR______0_000000__0H___6553_ 0.0 6553.5
 /begin AXIS_DESCR COM_AXIS ftl LINEAR______0_000000__0H___126_0 8 0.0 126.0 AXIS_PTS_REF ldp_ftl__t_cur_dmtl_stat MAX_GRAD 100 MONOTONY MON_INCREASE /end AXIS_DESCR
 /begin AXIS_DESCR COM_AXIS cur_dmtl_dif_ref_rough_leak LINEAR______0_000000__0H___400_0 8 0.0 400.0 AXIS_PTS_REF ldpm_cur_dmtl_dif_ref_rough_leak MAX_GRAD 100 MONOTONY MON_INCREASE /end AXIS_DESCR
 FUNCTION_LIST DMTL /end CHARACTERISTIC
/begin CHARACTERISTIC anz_a_ftp_min "C_SUM_A_FTP_MIN" VALUE 0x700aa a_85 100 LINEAR______0_000000__0H___200_0 0.0 200.0 BIT_MASK 0xffffffff /end CHARACTERISTIC
/begin CHARACTERISTIC c_abc_inc_ad_mec_ref_ivvt "C_ABC_INC_AD_MEC_REF_IVVT" VALUE 0x709e2 a_86 4 LINEAR______0_000000__0H___255_0 0.0 255.0 BIT_MASK 0xffffffff /end CHARACTERISTIC
/begin CHARACTERISTIC c_abc_inc_amp "C_ABC_INC_AMP" VALUE 0x709e3 a_86 4 LINEAR______0_000000__0H___255_0 0.0 255.0 BIT_MASK 0xffffffff /end CHARACTERISTIC
/begin CHARACTERISTIC c_abc_inc_amt_mon "C_ABC_INC_AMT_MON" VALUE 0x71250 a_86 100 LINEAR______0_000000__0H___255_0 0.0 255.0 BIT_MASK 0xffffffff FUNCTION_LIST Z1S1 /end CHARACTERISTIC
/begin CHARACTERISTIC c_abc_inc_bls "C_ABC_INC_BLS" VALUE 0x709e4 a_86 4 LINEAR______0_000000__0H___255_0 0.0 255.0 BIT_MASK 0xffffffff /end CHARACTERISTIC
/begin CHARACTERISTIC c_abc_inc_cam "C_ABC_INC_CAM" VALUE 0x709e5 a_86 4 LINEAR______0_000000__0H___255_0 0.0 255.0 BIT_MASK 0xffffffff /end CHARACTERISTIC
/begin CHARACTERISTIC c_abc_inc_cam_ex "C_ABC_INC_CAM_EX" VALUE 0x709e6 a_86 4 LINEAR______0_000000__0H___255_0 0.0 255.0 BIT_MASK 0xffffffff /end CHARACTERISTIC
/begin CHARACTERISTIC c_abc_inc_can_boff "C_ABC_INC_CAN_BOFF" VALUE 0x709e7 a_86 4 LINEAR______0_000000__0H___255_0 0.0 255.0 BIT_MASK 0xffffffff /end CHARACTERISTIC
/begin CHARACTERISTIC c_abc_inc_conv_mon "C_ABC_INC_CONV_MON" VALUE 0x71251 a_86 10 LINEAR______0_000000__0H___255_0 0.0 255.0 BIT_MASK 0xffffffff /end CHARACTERISTIC
/begin CHARACTERISTIC c_abc_inc_cps "C_ABC_INC_CPS" VALUE 0x709e8 a_86 4 LINEAR______0_000000__0H___255_0 0.0 255.0 BIT_MASK 0xffffffff /end CHARACTERISTIC
/begin CHARACTERISTIC c_abc_inc_crk "C_ABC_INC_CRK" VALUE 0x709e9 a_86 4 LINEAR______0_000000__0H___255_0 0.0 255.0 BIT_MASK 0xffffffff /end CHARACTERISTIC
/begin CHARACTERISTIC c_abc_inc_cru_mon "C_ABC_INC_CRU_MON" VALUE 0x71252 a_86 100 LINEAR______0_000000__0H___255_0 0.0 255.0 BIT_MASK 0xffffffff /end CHARACTERISTIC
/begin CHARACTERISTIC c_abc_inc_dly_ad_diag "C_ABC_INC_DLY_AD_DIAG" VALUE 0x709ea a_86 100 LINEAR______0_000000__0H___255_0 0.0 255.0 BIT_MASK 0xffffffff /end CHARACTERISTIC
/begin CHARACTERISTIC c_abc_inc_dmtl "C_ABC_INC_DMTL" VALUE 0x709eb a_86 10 LINEAR______0_000000__0H___255_0 0.0 255.0 BIT_MASK 0xffffffff FUNCTION_LIST DMTL /end CHARACTERISTIC
/begin CHARACTERISTIC c_abc_inc_ecf "C_ABC_INC_ECF" VALUE 0x709ec a_86 4 LINEAR______0_000000__0H___255_0 0.0 255.0 BIT_MASK 0xffffffff /end CHARACTERISTIC
/begin CHARACTERISTIC c_abc_inc_ect "C_ABC_INC_ECT" VALUE 0x709ed a_86 4 LINEAR______0_000000__0H___255_0 0.0 255.0 BIT_MASK 0xffffffff /end CHARACTERISTIC
/begin CHARACTERISTIC c_abc_inc_ect_mec "C_ABC_INC_ECT_MEC" VALUE 0x709ee a_86 4 LINEAR______0_000000__0H___255_0 0.0 255.0 BIT_MASK 0xffffffff /end CHARACTERISTIC
/begin CHARACTERISTIC c_abc_inc_ef "C_ABC_INC_EF" VALUE 0x709ef a_86 10 LINEAR______0_000000__0H___255_0 0.0 255.0 BIT_MASK 0xffffffff /end CHARACTERISTIC
/begin CHARACTERISTIC c_abc_inc_igcfb "C_ABC_INC_IGCFB" VALUE 0x709f0 a_86 5 LINEAR______0_000000__0H___255_0 0.0 255.0 BIT_MASK 0xffffffff /end CHARACTERISTIC
/begin CHARACTERISTIC c_abc_inc_imob "C_ABC_INC_IMOB" VALUE 0x709f1 a_86 4 LINEAR______1_000000__1H___255_0 1.0 255.0 BIT_MASK 0xffffffff /end CHARACTERISTIC
/begin CHARACTERISTIC c_abc_inc_isa_1 "C_ABC_INC_ISA_1" VALUE 0x709f2 a_86 4 LINEAR______0_000000__0H___255_0 0.0 255.0 BIT_MASK 0xffffffff /end CHARACTERISTIC
/begin CHARACTERISTIC c_abc_inc_isa_2 "C_ABC_INC_ISA_2" VALUE 0x709f3 a_86 4 LINEAR______0_000000__0H___255_0 0.0 255.0 BIT_MASK 0xffffffff /end CHARACTERISTIC
/begin CHARACTERISTIC c_abc_inc_iv "C_ABC_INC_IV" VALUE 0x709f4 a_86 4 LINEAR______0_000000__0H___255_0 0.0 255.0 BIT_MASK 0xffffffff /end CHARACTERISTIC
/begin CHARACTERISTIC c_abc_inc_ivvt "C_ABC_INC_IVVT" VALUE 0x709f5 a_86 4 LINEAR______0_000000__0H___255_0 0.0 255.0 BIT_MASK 0xffffffff /end CHARACTERISTIC
/begin CHARACTERISTIC c_abc_inc_knk "C_ABC_INC_KNK" VALUE 0x709f6 a_86 100 LINEAR______0_000000__0H___255_0 0.0 255.0 BIT_MASK 0xffffffff /end CHARACTERISTIC
/begin CHARACTERISTIC c_abc_inc_lsh_down "C_ABC_INC_LSH_DOWN" VALUE 0x709f7 a_86 4 LINEAR______0_000000__0H___255_0 0.0 255.0 BIT_MASK 0xffffffff /end CHARACTERISTIC
/begin CHARACTERISTIC c_abc_inc_lsh_up "C_ABC_INC_LSH_UP" VALUE 0x709f8 a_86 4 LINEAR______0_000000__0H___255_0 0.0 255.0 BIT_MASK 0xffffffff /end CHARACTERISTIC
/begin CHARACTERISTIC c_abc_inc_maf "C_ABC_INC_MAF" VALUE 0x709f9 a_86 4 LINEAR______0_000000__0H___255_0 0.0 255.0 BIT_MASK 0xffffffff /end CHARACTERISTIC
/begin CHARACTERISTIC c_abc_inc_maf_mon "C_ABC_INC_MAF_MON" VALUE 0x71253 a_86 100 LINEAR______0_000000__0H___255_0 0.0 255.0 BIT_MASK 0xffffffff /end CHARACTERISTIC
/begin CHARACTERISTIC c_abc_inc_msr_mon "C_ABC_INC_MSR_MON" VALUE 0x71254 a_86 100 LINEAR______0_000000__0H___255_0 0.0 255.0 BIT_MASK 0xffffffff /end CHARACTERISTIC
/begin CHARACTERISTIC c_abc_inc_msw_2 "C_ABC_INC_MSW_2" VALUE 0x709fa a_86 10 LINEAR______0_000000__0H___255_0 0.0 255.0 BIT_MASK 0xffffffff /end CHARACTERISTIC
/begin CHARACTERISTIC c_abc_inc_msw_3 "C_ABC_INC_MSW_3" VALUE 0x709fb a_86 10 LINEAR______0_000000__0H___255_0 0.0 255.0 BIT_MASK 0xffffffff /end CHARACTERISTIC
/begin CHARACTERISTIC c_abc_inc_msw_tog "C_ABC_INC_MSW_TOG" VALUE 0x709fc a_86 4 LINEAR______0_000000__0H___255_0 0.0 255.0 BIT_MASK 0xffffffff /end CHARACTERISTIC
/begin CHARACTERISTIC c_abc_inc_mtc_dr "C_ABC_INC_MTC_DR" VALUE 0x709fd a_86 100 LINEAR______0_000000__0H___255_0 0.0 255.0 BIT_MASK 0xffffffff /end CHARACTERISTIC
/begin CHARACTERISTIC c_abc_inc_n_32_mon "C_ABC_INC_N_32_MON" VALUE 0x71255 a_86 100 LINEAR______0_000000__0H___255_0 0.0 255.0 BIT_MASK 0xffffffff /end CHARACTERISTIC
/begin CHARACTERISTIC c_abc_inc_pvs_ratio "C_ABC_INC_PVS_RATIO" VALUE 0x709fe a_86 100 LINEAR______0_000000__0H___255_0 0.0 255.0 BIT_MASK 0xffffffff /end CHARACTERISTIC
/begin CHARACTERISTIC c_abc_inc_pvs_ratio_mon "C_ABC_INC_PVS_RATIO_MON" VALUE 0x71256 a_86 100 LINEAR______0_000000__0H___255_0 0.0 255.0 BIT_MASK 0xffffffff /end CHARACTERISTIC
/begin CHARACTERISTIC c_abc_inc_pvs_sp_1 "C_ABC_INC_PVS_SP_1" VALUE 0x709ff a_86 100 LINEAR______0_000000__0H___255_0 0.0 255.0 BIT_MASK 0xffffffff /end CHARACTERISTIC
/begin CHARACTERISTIC c_abc_inc_pvs_sp_2 "C_ABC_INC_PVS_SP_2" VALUE 0x70a00 a_86 100 LINEAR______0_000000__0H___255_0 0.0 255.0 BIT_MASK 0xffffffff /end CHARACTERISTIC
/begin CHARACTERISTIC c_abc_inc_r_igcfb "C_ABC_INC_R_IGCFB" VALUE 0x70a01 a_86 5 LINEAR______0_000000__0H___255_0 0.0 255.0 BIT_MASK 0xffffffff /end CHARACTERISTIC
/begin CHARACTERISTIC c_abc_inc_rly_accout "C_ABC_INC_RLY_ACCOUT" VALUE 0x70a02 a_86 4 LINEAR______0_000000__0H___255_0 0.0 255.0 BIT_MASK 0xffffffff /end CHARACTERISTIC
/begin CHARACTERISTIC c_abc_inc_rly_efp "C_ABC_INC_RLY_EFP" VALUE 0x70a03 a_86 4 LINEAR______0_000000__0H___255_0 0.0 255.0 BIT_MASK 0xffffffff /end CHARACTERISTIC
/begin CHARACTERISTIC c_abc_inc_rly_main "C_ABC_INC_RLY_MAIN" VALUE 0x70a04 a_86 10 LINEAR______0_000000__0H___255_0 0.0 255.0 BIT_MASK 0xffffffff /end CHARACTERISTIC
/begin CHARACTERISTIC c_abc_inc_sap "C_ABC_INC_SAP" VALUE 0x70a05 a_86 10 LINEAR______0_000000__0H___255_0 0.0 255.0 BIT_MASK 0xffffffff /end CHARACTERISTIC
/begin CHARACTERISTIC c_abc_inc_sav "C_ABC_INC_SAV" VALUE 0x70a06 a_86 10 LINEAR______0_000000__0H___255_0 0.0 255.0 BIT_MASK 0xffffffff /end CHARACTERISTIC
/begin CHARACTERISTIC c_abc_inc_spi "C_ABC_INC_SPI" VALUE 0x70a07 a_86 10 LINEAR______0_000000__0H___255_0 0.0 255.0 BIT_MASK 0xffffffff /end CHARACTERISTIC
/begin CHARACTERISTIC c_abc_inc_t_seg_diag "C_ABC_INC_T_SEG_DIAG" VALUE 0x70a08 a_86 4 LINEAR______0_000000__0H___255_0 0.0 255.0 BIT_MASK 0xffffffff /end CHARACTERISTIC
/begin CHARACTERISTIC c_abc_inc_tco "C_ABC_INC_TCO" VALUE 0x70a09 a_86 10 LINEAR______0_000000__0H___255_0 0.0 255.0 BIT_MASK 0xffffffff /end CHARACTERISTIC
/begin CHARACTERISTIC c_abc_inc_tco_ex "C_ABC_INC_TCO_EX" VALUE 0x70a0a a_86 4 LINEAR______0_000000__0H___255_0 0.0 255.0 BIT_MASK 0xffffffff /end CHARACTERISTIC
/begin CHARACTERISTIC c_abc_inc_teg "C_ABC_INC_TEG" VALUE 0x70a0b a_86 4 LINEAR______0_000000__0H___255_0 0.0 255.0 BIT_MASK 0xffffffff /end CHARACTERISTIC
/begin CHARACTERISTIC c_abc_inc_tia "C_ABC_INC_TIA" VALUE 0x70a0c a_86 10 LINEAR______0_000000__0H___255_0 0.0 255.0 BIT_MASK 0xffffffff /end CHARACTERISTIC
/begin CHARACTERISTIC c_abc_inc_toil "C_ABC_INC_TOIL" VALUE 0x70a0d a_86 10 LINEAR______0_000000__0H___255_0 0.0 255.0 BIT_MASK 0xffffffff /end CHARACTERISTIC
/begin CHARACTERISTIC c_abc_inc_tout_amt_1 "C_ABC_INC_TOUT_AMT_1" VALUE 0x70a0e a_86 100 LINEAR______0_000000__0H___255_0 0.0 255.0 BIT_MASK 0xffffffff FUNCTION_LIST Z1S1 /end CHARACTERISTIC
/begin CHARACTERISTIC c_abc_inc_tout_asr_1 "C_ABC_INC_TOUT_ASR_1" VALUE 0x70a0f a_86 100 LINEAR______0_000000__0H___255_0 0.0 255.0 BIT_MASK 0xffffffff /end CHARACTERISTIC
/begin CHARACTERISTIC c_abc_inc_tout_asr_3 "C_ABC_INC_TOUT_ASR_3" VALUE 0x70a10 a_86 100 LINEAR______0_000000__0H___255_0 0.0 255.0 BIT_MASK 0xffffffff /end CHARACTERISTIC
/begin CHARACTERISTIC c_abc_inc_tout_etcu_1 "C_ABC_INC_TOUT_ETCU_1" VALUE 0x70a11 a_86 4 LINEAR______0_000000__0H___255_0 0.0 255.0 BIT_MASK 0xffffffff /end CHARACTERISTIC
/begin CHARACTERISTIC c_abc_inc_tout_icl_2 "C_ABC_INC_TOUT_ICL_2" VALUE 0x70a12 a_86 100 LINEAR______0_000000__0H___255_0 0.0 255.0 BIT_MASK 0xffffffff /end CHARACTERISTIC
/begin CHARACTERISTIC c_abc_inc_tout_icl_3 "C_ABC_INC_TOUT_ICL_3" VALUE 0x70a13 a_86 4 LINEAR______0_000000__0H___255_0 0.0 255.0 BIT_MASK 0xffffffff /end CHARACTERISTIC
/begin CHARACTERISTIC c_abc_inc_tout_imob "C_ABC_INC_TOUT_IMOB" VALUE 0x70a14 a_86 4 LINEAR______0_000000__0H___255_0 0.0 255.0 BIT_MASK 0xffffffff /end CHARACTERISTIC
/begin CHARACTERISTIC c_abc_inc_tout_pste_1 "C_ABC_INC_TOUT_PSTE_1" VALUE 0x70a15 a_86 100 LINEAR______0_000000__0H___255_0 0.0 255.0 BIT_MASK 0xffffffff /end CHARACTERISTIC
/begin CHARACTERISTIC c_abc_inc_tps_1 "C_ABC_INC_TPS_1" VALUE 0x70a16 a_86 100 LINEAR______0_000000__0H___255_0 0.0 255.0 BIT_MASK 0xffffffff /end CHARACTERISTIC
/begin CHARACTERISTIC c_abc_inc_tps_2 "C_ABC_INC_TPS_2" VALUE 0x70a17 a_86 100 LINEAR______0_000000__0H___255_0 0.0 255.0 BIT_MASK 0xffffffff /end CHARACTERISTIC
/begin CHARACTERISTIC c_abc_inc_tps_ad_bol "C_ABC_INC_TPS_AD_BOL" VALUE 0x70a18 a_86 100 LINEAR______0_000000__0H___255_0 0.0 255.0 BIT_MASK 0xffffffff /end CHARACTERISTIC
/begin CHARACTERISTIC c_abc_inc_tps_ratio_mon "C_ABC_INC_TPS_RATIO_MON" VALUE 0x71257 a_86 100 LINEAR______0_000000__0H___255_0 0.0 255.0 BIT_MASK 0xffffffff /end CHARACTERISTIC
/begin CHARACTERISTIC c_abc_inc_tqi_amt_1 "C_ABC_INC_TQI_AMT_1" VALUE 0x70a19 a_86 4 LINEAR______0_000000__0H___255_0 0.0 255.0 BIT_MASK 0xffffffff FUNCTION_LIST Z1S1 /end CHARACTERISTIC
/begin CHARACTERISTIC c_abc_inc_tqi_av_mon "C_ABC_INC_TQI_AV_MON" VALUE 0x71258 a_86 100 LINEAR______0_000000__0H___255_0 0.0 255.0 BIT_MASK 0xffffffff /end CHARACTERISTIC
/begin CHARACTERISTIC c_abc_inc_tqi_av_mon2 "C_ABC_INC_TQI_AV_MON2" VALUE 0x70a1a a_86 100 LINEAR______0_000000__0H___255_0 0.0 255.0 BIT_MASK 0xffffffff FUNCTION_LIST MON2 /end CHARACTERISTIC
/begin CHARACTERISTIC c_abc_inc_tqi_n_max_mon "C_ABC_INC_TQI_N_MAX_MON" VALUE 0x71259 a_86 100 LINEAR______0_000000__0H___255_0 0.0 255.0 BIT_MASK 0xffffffff /end CHARACTERISTIC
/begin CHARACTERISTIC c_abc_inc_tqi_n_max_mon2 "C_ABC_INC_TQI_N_MAX_MON2" VALUE 0x70a1b a_86 100 LINEAR______0_000000__0H___255_0 0.0 255.0 BIT_MASK 0xffffffff FUNCTION_LIST MON2 /end CHARACTERISTIC
/begin CHARACTERISTIC c_abc_inc_vcc_poti "C_ABC_INC_VCC_POTI" VALUE 0x70a1c a_86 100 LINEAR______0_000000__0H___255_0 0.0 255.0 BIT_MASK 0xffffffff /end CHARACTERISTIC
/begin CHARACTERISTIC c_abc_inc_vdmtl "C_ABC_INC_VDMTL" VALUE 0x70a1d a_86 10 LINEAR______0_000000__0H___255_0 0.0 255.0 BIT_MASK 0xffffffff FUNCTION_LIST DMTL /end CHARACTERISTIC
/begin CHARACTERISTIC c_abc_inc_vim "C_ABC_INC_VIM" VALUE 0x70a1e a_86 4 LINEAR______0_000000__0H___255_0 0.0 255.0 BIT_MASK 0xffffffff /end CHARACTERISTIC
/begin CHARACTERISTIC c_abc_inc_vls_down "C_ABC_INC_VLS_DOWN" VALUE 0x70a1f a_86 100 LINEAR______0_000000__0H___255_0 0.0 255.0 BIT_MASK 0xffffffff /end CHARACTERISTIC
/begin CHARACTERISTIC c_abc_inc_vls_down_post_puc "C_ABC_INC_VLS_DOWN_POST_PUC" VALUE 0x70a20 a_86 100 LINEAR______0_000000__0H___255_0 0.0 255.0 BIT_MASK 0xffffffff /end CHARACTERISTIC
/begin CHARACTERISTIC c_abc_inc_vls_down_t "C_ABC_INC_VLS_DOWN_T" VALUE 0x70a21 a_86 100 LINEAR______0_000000__0H___255_0 0.0 255.0 BIT_MASK 0xffffffff /end CHARACTERISTIC
/begin CHARACTERISTIC c_abc_inc_vls_up "C_ABC_INC_VLS_UP" VALUE 0x70a22 a_86 100 LINEAR______0_000000__0H___255_0 0.0 255.0 BIT_MASK 0xffffffff /end CHARACTERISTIC
/begin CHARACTERISTIC c_abc_max_ad_mec_ref_ivvt "C_ABC_MAX_AD_MEC_REF_IVVT" VALUE 0x70a23 a_86 4 LINEAR______1_000000__1H___255_0 1.0 255.0 BIT_MASK 0xffffffff /end CHARACTERISTIC
/begin CHARACTERISTIC c_abc_max_amp "C_ABC_MAX_AMP" VALUE 0x70a24 a_86 10 LINEAR______1_000000__1H___255_0 1.0 255.0 BIT_MASK 0xffffffff /end CHARACTERISTIC
/begin CHARACTERISTIC c_abc_max_amt_mon "C_ABC_MAX_AMT_MON" VALUE 0x7125a a_86 100 LINEAR______1_000000__1H___255_0 1.0 255.0 BIT_MASK 0xffffffff FUNCTION_LIST Z1S1 /end CHARACTERISTIC
/begin CHARACTERISTIC c_abc_max_bls "C_ABC_MAX_BLS" VALUE 0x70a25 a_86 4 LINEAR______1_000000__1H___255_0 1.0 255.0 BIT_MASK 0xffffffff /end CHARACTERISTIC
/begin CHARACTERISTIC c_abc_max_bts_1 "C_ABC_MAX_BTS_1" VALUE 0x70d9d a_87 100 LINEAR______1_000000__1H___127_0 1.0 127.0 BIT_MASK 0xffffffff /end CHARACTERISTIC
/begin CHARACTERISTIC c_abc_max_bts_2 "C_ABC_MAX_BTS_2" VALUE 0x70d9e a_87 100 LINEAR_______128_000000__FFFFFF8 -128.0 -1.0 BIT_MASK 0xffffffff /end CHARACTERISTIC
/begin CHARACTERISTIC c_abc_max_cam "C_ABC_MAX_CAM" VALUE 0x70a26 a_86 8 LINEAR______1_000000__1H___255_0 1.0 255.0 BIT_MASK 0xffffffff /end CHARACTERISTIC
/begin CHARACTERISTIC c_abc_max_cam_ex "C_ABC_MAX_CAM_EX" VALUE 0x70a27 a_86 8 LINEAR______1_000000__1H___255_0 1.0 255.0 BIT_MASK 0xffffffff /end CHARACTERISTIC
/begin CHARACTERISTIC c_abc_max_can_boff "C_ABC_MAX_CAN_BOFF" VALUE 0x70a28 a_86 4 LINEAR______1_000000__1H___255_0 1.0 255.0 BIT_MASK 0xffffffff /end CHARACTERISTIC
/begin CHARACTERISTIC c_abc_max_conv_mon "C_ABC_MAX_CONV_MON" VALUE 0x7125b a_86 100 LINEAR______1_000000__1H___255_0 1.0 255.0 BIT_MASK 0xffffffff /end CHARACTERISTIC
/begin CHARACTERISTIC c_abc_max_cps "C_ABC_MAX_CPS" VALUE 0x70a29 a_86 4 LINEAR______1_000000__1H___255_0 1.0 255.0 BIT_MASK 0xffffffff /end CHARACTERISTIC
/begin CHARACTERISTIC c_abc_max_crk "C_ABC_MAX_CRK" VALUE 0x70a2a a_86 8 LINEAR______1_000000__1H___255_0 1.0 255.0 BIT_MASK 0xffffffff /end CHARACTERISTIC
/begin CHARACTERISTIC c_abc_max_cru_mon "C_ABC_MAX_CRU_MON" VALUE 0x7125c a_86 10 LINEAR______1_000000__1H___255_0 1.0 255.0 BIT_MASK 0xffffffff /end CHARACTERISTIC
/begin CHARACTERISTIC c_abc_max_cs "C_ABC_MAX_CS" VALUE 0x70a2b a_86 100 LINEAR______1_000000__1H___255_0 1.0 255.0 BIT_MASK 0xffffffff /end CHARACTERISTIC
/begin CHARACTERISTIC c_abc_max_diag "C_abc_max_diag" VALUE 0x70a2c a_86 100 LINEAR______1_000000__1H___255_0 1.0 255.0 BIT_MASK 0xffffffff /end CHARACTERISTIC
/begin CHARACTERISTIC c_abc_max_dly_ad_diag "C_ABC_MAX_DLY_AD_DIAG" VALUE 0x70a2d a_86 100 LINEAR______1_000000__1H___255_0 1.0 255.0 BIT_MASK 0xffffffff /end CHARACTERISTIC
/begin CHARACTERISTIC c_abc_max_dmtl "C_ABC_MAX_DMTL" VALUE 0x70a2e a_86 4 LINEAR______1_000000__1H___255_0 1.0 255.0 BIT_MASK 0xffffffff FUNCTION_LIST DMTL /end CHARACTERISTIC
/begin CHARACTERISTIC c_abc_max_ecf "C_ABC_MAX_ECF" VALUE 0x70a2f a_86 4 LINEAR______1_000000__1H___255_0 1.0 255.0 BIT_MASK 0xffffffff /end CHARACTERISTIC
/begin CHARACTERISTIC c_abc_max_ect "C_ABC_MAX_ECT" VALUE 0x70a30 a_86 4 LINEAR______1_000000__1H___255_0 1.0 255.0 BIT_MASK 0xffffffff /end CHARACTERISTIC
/begin CHARACTERISTIC c_abc_max_ect_mec "C_ABC_MAX_ECT_MEC" VALUE 0x70a31 a_86 4 LINEAR______1_000000__1H___255_0 1.0 255.0 BIT_MASK 0xffffffff /end CHARACTERISTIC
/begin CHARACTERISTIC c_abc_max_ef "C_ABC_MAX_EF" VALUE 0x70a32 a_86 10 LINEAR______1_000000__1H___255_0 1.0 255.0 BIT_MASK 0xffffffff /end CHARACTERISTIC
/begin CHARACTERISTIC c_abc_max_igcfb "C_ABC_MAX_IGCFB" VALUE 0x70a33 a_86 5 LINEAR______1_000000__1H___255_0 1.0 255.0 BIT_MASK 0xffffffff /end CHARACTERISTIC
/begin CHARACTERISTIC c_abc_max_imob "C_ABC_MAX_IMOB" VALUE 0x70a34 a_86 4 LINEAR______1_000000__1H___255_0 1.0 255.0 BIT_MASK 0xffffffff /end CHARACTERISTIC
/begin CHARACTERISTIC c_abc_max_isa_1 "C_ABC_MAX_ISA_1" VALUE 0x70a35 a_86 4 LINEAR______1_000000__1H___255_0 1.0 255.0 BIT_MASK 0xffffffff /end CHARACTERISTIC
/begin CHARACTERISTIC c_abc_max_isa_2 "C_ABC_MAX_ISA_2" VALUE 0x70a36 a_86 4 LINEAR______1_000000__1H___255_0 1.0 255.0 BIT_MASK 0xffffffff /end CHARACTERISTIC
/begin CHARACTERISTIC c_abc_max_iv "C_ABC_MAX_IV" VALUE 0x70a37 a_86 4 LINEAR______1_000000__1H___255_0 1.0 255.0 BIT_MASK 0xffffffff /end CHARACTERISTIC
/begin CHARACTERISTIC c_abc_max_ivvt "C_ABC_MAX_IVVT" VALUE 0x70a38 a_86 4 LINEAR______1_000000__1H___255_0 1.0 255.0 BIT_MASK 0xffffffff /end CHARACTERISTIC
/begin CHARACTERISTIC c_abc_max_knk "C_ABC_MAX_KNK" VALUE 0x70a39 a_86 100 LINEAR______1_000000__1H___255_0 1.0 255.0 BIT_MASK 0xffffffff /end CHARACTERISTIC
/begin CHARACTERISTIC c_abc_max_lam "C_ABC_MAX_LAM" VALUE 0x70a3a a_86 2 LINEAR______1_000000__1H___255_0 1.0 255.0 BIT_MASK 0xffffffff /end CHARACTERISTIC
/begin CHARACTERISTIC c_abc_max_lsh_down "C_ABC_MAX_LSH_DOWN" VALUE 0x70a3b a_86 4 LINEAR______1_000000__1H___255_0 1.0 255.0 BIT_MASK 0xffffffff /end CHARACTERISTIC
/begin CHARACTERISTIC c_abc_max_lsh_up "C_ABC_MAX_LSH_UP" VALUE 0x70a3c a_86 4 LINEAR______1_000000__1H___255_0 1.0 255.0 BIT_MASK 0xffffffff /end CHARACTERISTIC
/begin CHARACTERISTIC c_abc_max_maf "C_ABC_MAX_MAF" VALUE 0x70a3d a_86 4 LINEAR______1_000000__1H___255_0 1.0 255.0 BIT_MASK 0xffffffff /end CHARACTERISTIC
/begin CHARACTERISTIC c_abc_max_maf_mon "C_ABC_MAX_MAF_MON" VALUE 0x7125d a_86 10 LINEAR______1_000000__1H___255_0 1.0 255.0 BIT_MASK 0xffffffff /end CHARACTERISTIC
/begin CHARACTERISTIC c_abc_max_mis "C_ABC_MAX_MIS" VALUE 0x70a3e a_86 4 LINEAR______1_000000__1H___255_0 1.0 255.0 BIT_MASK 0xffffffff /end CHARACTERISTIC
/begin CHARACTERISTIC c_abc_max_msr_mon "C_ABC_MAX_MSR_MON" VALUE 0x7125e a_86 100 LINEAR______1_000000__1H___255_0 1.0 255.0 BIT_MASK 0xffffffff /end CHARACTERISTIC
/begin CHARACTERISTIC c_abc_max_msw_2 "C_ABC_MAX_MSW_2" VALUE 0x70a3f a_86 10 LINEAR______1_000000__1H___255_0 1.0 255.0 BIT_MASK 0xffffffff /end CHARACTERISTIC
/begin CHARACTERISTIC c_abc_max_msw_3 "C_ABC_MAX_MSW_3" VALUE 0x70a40 a_86 10 LINEAR______1_000000__1H___255_0 1.0 255.0 BIT_MASK 0xffffffff /end CHARACTERISTIC
/begin CHARACTERISTIC c_abc_max_msw_tog "C_ABC_MAX_MSW_TOG" VALUE 0x70a41 a_86 4 LINEAR______1_000000__1H___255_0 1.0 255.0 BIT_MASK 0xffffffff /end CHARACTERISTIC
/begin CHARACTERISTIC c_abc_max_mtc_dr "C_ABC_MAX_MTC_DR" VALUE 0x70a42 a_86 100 LINEAR______1_000000__1H___255_0 1.0 255.0 BIT_MASK 0xffffffff /end CHARACTERISTIC
/begin CHARACTERISTIC c_abc_max_n_32_mon "C_ABC_MAX_N_32_MON" VALUE 0x7125f a_86 10 LINEAR______1_000000__1H___255_0 1.0 255.0 BIT_MASK 0xffffffff /end CHARACTERISTIC
/begin CHARACTERISTIC c_abc_max_pvs_h_r_1 "C_ABC_MAX_PVS_H_R_1" VALUE 0x70a43 a_86 4 LINEAR______1_000000__1H___255_0 1.0 255.0 BIT_MASK 0xffffffff /end CHARACTERISTIC
/begin CHARACTERISTIC c_abc_max_pvs_h_r_2 "C_ABC_MAX_PVS_H_R_2" VALUE 0x70a44 a_86 4 LINEAR______1_000000__1H___255_0 1.0 255.0 BIT_MASK 0xffffffff /end CHARACTERISTIC
/begin CHARACTERISTIC c_abc_max_pvs_ratio "C_ABC_MAX_PVS_RATIO" VALUE 0x70a45 a_86 100 LINEAR______1_000000__1H___255_0 1.0 255.0 BIT_MASK 0xffffffff /end CHARACTERISTIC
/begin CHARACTERISTIC c_abc_max_pvs_ratio_mon "C_ABC_MAX_PVS_RATIO_MON" VALUE 0x71260 a_86 100 LINEAR______1_000000__1H___255_0 1.0 255.0 BIT_MASK 0xffffffff /end CHARACTERISTIC
/begin CHARACTERISTIC c_abc_max_pvs_sp_1 "C_ABC_MAX_PVS_SP_1" VALUE 0x70a46 a_86 100 LINEAR______1_000000__1H___255_0 1.0 255.0 BIT_MASK 0xffffffff /end CHARACTERISTIC
/begin CHARACTERISTIC c_abc_max_pvs_sp_2 "C_ABC_MAX_PVS_SP_2" VALUE 0x70a47 a_86 100 LINEAR______1_000000__1H___255_0 1.0 255.0 BIT_MASK 0xffffffff /end CHARACTERISTIC
/begin CHARACTERISTIC c_abc_max_r_igcfb "C_ABC_MAX_R_IGCFB" VALUE 0x70a48 a_86 5 LINEAR______1_000000__1H___255_0 1.0 255.0 BIT_MASK 0xffffffff /end CHARACTERISTIC
/begin CHARACTERISTIC c_abc_max_rly_accout "C_ABC_MAX_RLY_ACCOUT" VALUE 0x70a49 a_86 4 LINEAR______1_000000__1H___255_0 1.0 255.0 BIT_MASK 0xffffffff /end CHARACTERISTIC
/begin CHARACTERISTIC c_abc_max_rly_efp "C_ABC_MAX_RLY_EFP" VALUE 0x70a4a a_86 4 LINEAR______1_000000__1H___255_0 1.0 255.0 BIT_MASK 0xffffffff /end CHARACTERISTIC
/begin CHARACTERISTIC c_abc_max_rly_main "C_ABC_MAX_RLY_MAIN" VALUE 0x70a4b a_86 10 LINEAR______1_000000__1H___255_0 1.0 255.0 BIT_MASK 0xffffffff /end CHARACTERISTIC
/begin CHARACTERISTIC c_abc_max_sap "C_ABC_MAX_SAP" VALUE 0x70a4c a_86 10 LINEAR______1_000000__1H___255_0 1.0 255.0 BIT_MASK 0xffffffff /end CHARACTERISTIC
/begin CHARACTERISTIC c_abc_max_sav "C_ABC_MAX_SAV" VALUE 0x70a4d a_86 10 LINEAR______1_000000__1H___255_0 1.0 255.0 BIT_MASK 0xffffffff /end CHARACTERISTIC
/begin CHARACTERISTIC c_abc_max_spi "C_ABC_MAX_SPI" VALUE 0x70a4e a_86 10 LINEAR______1_000000__1H___255_0 1.0 255.0 BIT_MASK 0xffffffff /end CHARACTERISTIC
/begin CHARACTERISTIC c_abc_max_t_seg_diag "C_ABC_MAX_T_SEG_DIAG" VALUE 0x70a4f a_86 4 LINEAR______1_000000__1H___255_0 1.0 255.0 BIT_MASK 0xffffffff /end CHARACTERISTIC
/begin CHARACTERISTIC c_abc_max_tco "C_ABC_MAX_TCO" VALUE 0x70a50 a_86 10 LINEAR______1_000000__1H___255_0 1.0 255.0 BIT_MASK 0xffffffff /end CHARACTERISTIC
/begin CHARACTERISTIC c_abc_max_tco_ex "C_ABC_MAX_TCO_EX" VALUE 0x70a51 a_86 4 LINEAR______1_000000__1H___255_0 1.0 255.0 BIT_MASK 0xffffffff /end CHARACTERISTIC
/begin CHARACTERISTIC c_abc_max_teg "C_ABC_MAX_TEG" VALUE 0x70a52 a_86 10 LINEAR______1_000000__1H___255_0 1.0 255.0 BIT_MASK 0xffffffff /end CHARACTERISTIC
/begin CHARACTERISTIC c_abc_max_tia "C_ABC_MAX_TIA" VALUE 0x70a53 a_86 10 LINEAR______1_000000__1H___255_0 1.0 255.0 BIT_MASK 0xffffffff /end CHARACTERISTIC
/begin CHARACTERISTIC c_abc_max_toil "C_ABC_MAX_TOIL" VALUE 0x70a54 a_86 10 LINEAR______1_000000__1H___255_0 1.0 255.0 BIT_MASK 0xffffffff /end CHARACTERISTIC
/begin CHARACTERISTIC c_abc_max_tout_amt_1 "C_ABC_MAX_TOUT_AMT_1" VALUE 0x70a55 a_86 10 LINEAR______1_000000__1H___255_0 1.0 255.0 BIT_MASK 0xffffffff FUNCTION_LIST Z1S1 /end CHARACTERISTIC
/begin CHARACTERISTIC c_abc_max_tout_asr_1 "C_ABC_MAX_TOUT_ASR_1" VALUE 0x70a56 a_86 100 LINEAR______1_000000__1H___255_0 1.0 255.0 BIT_MASK 0xffffffff /end CHARACTERISTIC
/begin CHARACTERISTIC c_abc_max_tout_asr_3 "C_ABC_MAX_TOUT_ASR_3" VALUE 0x70a57 a_86 100 LINEAR______1_000000__1H___255_0 1.0 255.0 BIT_MASK 0xffffffff /end CHARACTERISTIC
/begin CHARACTERISTIC c_abc_max_tout_etcu_1 "C_ABC_MAX_TOUT_ETCU_1" VALUE 0x70a58 a_86 4 LINEAR______1_000000__1H___255_0 1.0 255.0 BIT_MASK 0xffffffff /end CHARACTERISTIC
/begin CHARACTERISTIC c_abc_max_tout_icl_2 "C_ABC_MAX_TOUT_ICL_2" VALUE 0x70a59 a_86 100 LINEAR______1_000000__1H___255_0 1.0 255.0 BIT_MASK 0xffffffff /end CHARACTERISTIC
/begin CHARACTERISTIC c_abc_max_tout_icl_3 "C_ABC_MAX_TOUT_ICL_3" VALUE 0x70a5a a_86 4 LINEAR______1_000000__1H___255_0 1.0 255.0 BIT_MASK 0xffffffff /end CHARACTERISTIC
/begin CHARACTERISTIC c_abc_max_tout_imob "C_ABC_MAX_TOUT_IMOB" VALUE 0x70a5b a_86 4 LINEAR______1_000000__1H___255_0 1.0 255.0 BIT_MASK 0xffffffff /end CHARACTERISTIC
/begin CHARACTERISTIC c_abc_max_tout_pste_1 "C_ABC_MAX_TOUT_PSTE_1" VALUE 0x70a5c a_86 10 LINEAR______1_000000__1H___255_0 1.0 255.0 BIT_MASK 0xffffffff /end CHARACTERISTIC
/begin CHARACTERISTIC c_abc_max_tps_1 "C_ABC_MAX_TPS_1" VALUE 0x70a5d a_86 100 LINEAR______1_000000__1H___255_0 1.0 255.0 BIT_MASK 0xffffffff /end CHARACTERISTIC
/begin CHARACTERISTIC c_abc_max_tps_2 "C_ABC_MAX_TPS_2" VALUE 0x70a5e a_86 100 LINEAR______1_000000__1H___255_0 1.0 255.0 BIT_MASK 0xffffffff /end CHARACTERISTIC
/begin CHARACTERISTIC c_abc_max_tps_ad_bol "C_ABC_MAX_TPS_AD_BOL" VALUE 0x70a5f a_86 10 LINEAR______1_000000__1H___255_0 1.0 255.0 BIT_MASK 0xffffffff /end CHARACTERISTIC
/begin CHARACTERISTIC c_abc_max_tps_ratio_mon "C_ABC_MAX_TPS_RATIO_MON" VALUE 0x71261 a_86 100 LINEAR______1_000000__1H___255_0 1.0 255.0 BIT_MASK 0xffffffff /end CHARACTERISTIC
/begin CHARACTERISTIC c_abc_max_tqi_amt_1 "C_ABC_MAX_TQI_AMT_1" VALUE 0x70a60 a_86 10 LINEAR______1_000000__1H___255_0 1.0 255.0 BIT_MASK 0xffffffff FUNCTION_LIST Z1S1 /end CHARACTERISTIC
/begin CHARACTERISTIC c_abc_max_tqi_av_mon "C_ABC_MAX_TQI_AV_MON" VALUE 0x71262 a_86 10 LINEAR______1_000000__1H___255_0 1.0 255.0 BIT_MASK 0xffffffff /end CHARACTERISTIC
/begin CHARACTERISTIC c_abc_max_tqi_av_mon2 "C_ABC_MAX_TQI_AV_MON2" VALUE 0x70a61 a_86 10 LINEAR______1_000000__1H___255_0 1.0 255.0 BIT_MASK 0xffffffff FUNCTION_LIST MON2 /end CHARACTERISTIC
/begin CHARACTERISTIC c_abc_max_tqi_n_max_mon "C_ABC_MAX_TQI_N_MAX_MON" VALUE 0x71263 a_86 10 LINEAR______1_000000__1H___255_0 1.0 255.0 BIT_MASK 0xffffffff /end CHARACTERISTIC
/begin CHARACTERISTIC c_abc_max_tqi_n_max_mon2 "C_ABC_MAX_TQI_N_MAX_MON2" VALUE 0x70a62 a_86 10 LINEAR______1_000000__1H___255_0 1.0 255.0 BIT_MASK 0xffffffff FUNCTION_LIST MON2 /end CHARACTERISTIC
/begin CHARACTERISTIC c_abc_max_vcc_poti "C_ABC_MAX_VCC_POTI" VALUE 0x70a63 a_86 4 LINEAR______1_000000__1H___255_0 1.0 255.0 BIT_MASK 0xffffffff /end CHARACTERISTIC
/begin CHARACTERISTIC c_abc_max_vdmtl "C_ABC_MAX_VDMTL" VALUE 0x70a64 a_86 4 LINEAR______1_000000__1H___255_0 1.0 255.0 BIT_MASK 0xffffffff FUNCTION_LIST DMTL /end CHARACTERISTIC
/begin CHARACTERISTIC c_abc_max_vim "C_ABC_MAX_VIM" VALUE 0x70a65 a_86 4 LINEAR______1_000000__1H___255_0 1.0 255.0 BIT_MASK 0xffffffff /end CHARACTERISTIC
/begin CHARACTERISTIC c_abc_max_vls_down "C_ABC_MAX_VLS_DOWN" VALUE 0x70a66 a_86 100 LINEAR______1_000000__1H___255_0 1.0 255.0 BIT_MASK 0xffffffff /end CHARACTERISTIC
/begin CHARACTERISTIC c_abc_max_vls_down_post_puc "C_ABC_MAX_VLS_DOWN_POST_PUC" VALUE 0x70a67 a_86 100 LINEAR______0_000000__0H___255_0 0.0 255.0 BIT_MASK 0xffffffff /end CHARACTERISTIC
/begin CHARACTERISTIC c_abc_max_vls_down_t "C_ABC_MAX_VLS_DOWN_T" VALUE 0x70a68 a_86 100 LINEAR______0_000000__0H___255_0 0.0 255.0 BIT_MASK 0xffffffff /end CHARACTERISTIC
/begin CHARACTERISTIC c_abc_max_vls_up "C_ABC_MAX_VLS_UP" VALUE 0x70a69 a_86 100 LINEAR______1_000000__1H___255_0 1.0 255.0 BIT_MASK 0xffffffff /end CHARACTERISTIC
/begin CHARACTERISTIC c_ac_max_cru "C_AC_MAX_CRU" VALUE 0x700ac a_85 100 LINEAR______0_000000__0H___1777_ 0.0 1777.7235 BIT_MASK 0xffffffff /end CHARACTERISTIC
/begin CHARACTERISTIC c_ac_neg_cru_ac "C_AC_NEG_CRU_AC" VALUE 0x70d9f a_87 100 LINEAR_______6_944444__FFFFFF80H -6.944444 0.0 BIT_MASK 0xffffffff /end CHARACTERISTIC
/begin CHARACTERISTIC c_ac_neg_cru_deacc "C_AC_NEG_CRU_DEACC" VALUE 0x700ae a_85 100 LINEAR______0_000000__0H___51119 0.0 511.9789 BIT_MASK 0xffffffff /end CHARACTERISTIC
/begin CHARACTERISTIC c_ac_neg_cru_tip "C_AC_NEG_CRU_TIP" VALUE 0x700b0 a_85 100 LINEAR______0_000000__0H___51119 0.0 511.9789 BIT_MASK 0xffffffff /end CHARACTERISTIC
/begin CHARACTERISTIC c_ac_pos_cru_ac "C_AC_POS_CRU_AC" VALUE 0x700b2 a_85 100 LINEAR______0_000000__0H___51119 0.0 511.9789 BIT_MASK 0xffffffff /end CHARACTERISTIC
/begin CHARACTERISTIC c_ac_pos_cru_deacc "C_AC_POS_CRU_DEACC" VALUE 0x700b4 a_85 100 LINEAR______0_000000__0H___51119 0.0 511.9789 BIT_MASK 0xffffffff /end CHARACTERISTIC
/begin CHARACTERISTIC c_ac_pos_cru_resu "C_AC_POS_CRU_RESU" VALUE 0x700b6 a_85 100 LINEAR______0_000000__0H___51119 0.0 511.9789 BIT_MASK 0xffffffff /end CHARACTERISTIC
/begin CHARACTERISTIC c_ac_pos_cru_tip "C_AC_POS_CRU_TIP" VALUE 0x700b8 a_85 100 LINEAR______0_000000__0H___51119 0.0 511.9789 BIT_MASK 0xffffffff /end CHARACTERISTIC
/begin CHARACTERISTIC c_accin_dly_1 "C_ACCIN_DLY_1" VALUE 0x70a6a a_86 1 LINEAR______0_100000__1H___25_50 0.1 25.5 BIT_MASK 0xffffffff /end CHARACTERISTIC
/begin CHARACTERISTIC c_accin_dly_1_lock_fl "C_ACCIN_DLY_1_LOCK_FL" VALUE 0x70a6b a_86 100 LINEAR______0_000000__0H___25514 0.0 255.0 BIT_MASK 0xffffffff /end CHARACTERISTIC
/begin CHARACTERISTIC c_accin_dly_4 "C_ACCIN_DLY_4" VALUE 0x70a6c a_86 1 LINEAR______0_100000__1H___25_50 0.1 25.5 BIT_MASK 0xffffffff /end CHARACTERISTIC
/begin CHARACTERISTIC c_accin_dly_5 "C_ACCIN_DLY_5" VALUE 0x70a6d a_86 1 LINEAR______0_100000__1H___25_50 0.1 25.5 BIT_MASK 0xffffffff /end CHARACTERISTIC
/begin CHARACTERISTIC c_accout_dly_er "C_ACCOUT_DLY_ER" VALUE 0x700ba a_85 5 LINEAR______0_010000__1H___655_3 0.01 655.34998 BIT_MASK 0xffffffff /end CHARACTERISTIC
/begin CHARACTERISTIC c_acr_diag_can_icl_max "C_ACR_DIAG_CAN_ICL_MAX" VALUE 0x70a6e a_86 100 LINEAR_______48_000000__0H___142 -48.0 142.5 BIT_MASK 0xffffffff /end CHARACTERISTIC
/begin CHARACTERISTIC c_acr_diag_cppwm_max "C_ACR_DIAG_CPPWM_MAX" VALUE 0x70a6f a_86 100 LINEAR______0_000000__0H___99_88 0.0 99.609375 BIT_MASK 0xffffffff /end CHARACTERISTIC
/begin CHARACTERISTIC c_acr_diag_cppwm_min "C_ACR_DIAG_CPPWM_MIN" VALUE 0x70a70 a_86 100 LINEAR______0_000000__0H___99_88 0.0 99.609375 BIT_MASK 0xffffffff /end CHARACTERISTIC
/begin CHARACTERISTIC c_acr_diag_ecfpwm_max "C_ACR_DIAG_ECFPWM_MAX" VALUE 0x70a71 a_86 100 LINEAR______0_000000__0H___99_88 0.0 99.609375 BIT_MASK 0xffffffff /end CHARACTERISTIC
/begin CHARACTERISTIC c_acr_diag_ecfpwm_min "C_ACR_DIAG_ECFPWM_MIN" VALUE 0x70a72 a_86 100 LINEAR______0_000000__0H___99_88 0.0 99.609375 BIT_MASK 0xffffffff /end CHARACTERISTIC
/begin CHARACTERISTIC c_acr_diag_ectpwm_max "C_ACR_DIAG_ECTPWM_MAX" VALUE 0x70a73 a_86 100 LINEAR______0_000000__0H___99_88 0.0 99.609375 BIT_MASK 0xffffffff /end CHARACTERISTIC
/begin CHARACTERISTIC c_acr_diag_ectpwm_min "C_ACR_DIAG_ECTPWM_MIN" VALUE 0x70a74 a_86 100 LINEAR______0_000000__0H___99_88 0.0 99.609375 BIT_MASK 0xffffffff /end CHARACTERISTIC
/begin CHARACTERISTIC c_acr_diag_isapwm_max "C_ACR_DIAG_ISAPWM_MAX" VALUE 0x70a75 a_86 100 LINEAR______0_000000__0H___99_88 0.0 99.609375 BIT_MASK 0xffffffff /end CHARACTERISTIC
/begin CHARACTERISTIC c_acr_diag_isapwm_min "C_ACR_DIAG_ISAPWM_MIN" VALUE 0x70a76 a_86 100 LINEAR______0_000000__0H___99_88 0.0 99.609375 BIT_MASK 0xffffffff /end CHARACTERISTIC
/begin CHARACTERISTIC c_acr_diag_iv_max "C_ACR_DIAG_IV_MAX" VALUE 0x70a77 a_86 100 LINEAR______0_000000__0H___2_720 0.0 2.72 BIT_MASK 0xffffffff /end CHARACTERISTIC
/begin CHARACTERISTIC c_acr_diag_iv_min "C_ACR_DIAG_IV_MIN" VALUE 0x70a78 a_86 100 LINEAR______0_000000__0H___2_720 0.0 2.72 BIT_MASK 0xffffffff /end CHARACTERISTIC
/begin CHARACTERISTIC c_acr_diag_iv_t_per_max "C_ACR_DIAG_IV_T_PER_MAX" VALUE 0x70a79 a_86 100 LINEAR______0_000000__0H___2550_ 0.0 2550.0 BIT_MASK 0xffffffff /end CHARACTERISTIC
/begin CHARACTERISTIC c_acr_diag_iv_t_per_min "C_ACR_DIAG_IV_T_PER_MIN" VALUE 0x70a7a a_86 100 LINEAR______0_000000__0H___2550_ 0.0 2550.0 BIT_MASK 0xffffffff /end CHARACTERISTIC
/begin CHARACTERISTIC c_acr_diag_ivvt_ducy_ex_max "C_ACR_DIAG_IVVT_DUCY_EX_MAX" VALUE 0x70a7b a_86 100 LINEAR______0_000000__0H___99_60 0.0 99.609375 BIT_MASK 0xffffffff /end CHARACTERISTIC
/begin CHARACTERISTIC c_acr_diag_ivvt_ducy_ex_min "C_ACR_DIAG_IVVT_DUCY_EX_MIN" VALUE 0x70a7c a_86 100 LINEAR______0_000000__0H___99_60 0.0 99.609375 BIT_MASK 0xffffffff /end CHARACTERISTIC
/begin CHARACTERISTIC c_acr_diag_ivvt_ducy_in_max "C_ACR_DIAG_IVVT_DUCY_IN_MAX" VALUE 0x70a7d a_86 100 LINEAR______0_000000__0H___99_60 0.0 99.609375 BIT_MASK 0xffffffff /end CHARACTERISTIC
/begin CHARACTERISTIC c_acr_diag_ivvt_ducy_in_min "C_ACR_DIAG_IVVT_DUCY_IN_MIN" VALUE 0x70a7e a_86 100 LINEAR______0_000000__0H___99_60 0.0 99.609375 BIT_MASK 0xffffffff /end CHARACTERISTIC
/begin CHARACTERISTIC c_acr_diag_ivvt_n_max "C_ACR_DIAG_IVVT_N_MAX" VALUE 0x70a7f a_86 100 LINEAR______0_000000__0H___8160_ 0.0 8160.0 BIT_MASK 0xffffffff /end CHARACTERISTIC
/begin CHARACTERISTIC c_acr_diag_ivvt_n_min "C_ACR_DIAG_IVVT_N_MIN" VALUE 0x70a80 a_86 100 LINEAR______0_000000__0H___8160_ 0.0 8160.0 BIT_MASK 0xffffffff /end CHARACTERISTIC
/begin CHARACTERISTIC c_acr_diag_ivvt_pos_ex_max "C_ACR_DIAG_IVVT_POS_EX_MAX" VALUE 0x70a81 a_86 100 LINEAR_______155_625000__FFH____ -155.625 -60.0 BIT_MASK 0xffffffff /end CHARACTERISTIC
/begin CHARACTERISTIC c_acr_diag_ivvt_pos_ex_min "C_ACR_DIAG_IVVT_POS_EX_MIN" VALUE 0x70a82 a_86 100 LINEAR_______155_625000__FFH____ -155.625 -60.0 BIT_MASK 0xffffffff /end CHARACTERISTIC
/begin CHARACTERISTIC c_acr_diag_ivvt_pos_in_max "C_ACR_DIAG_IVVT_POS_IN_MAX" VALUE 0x70a83 a_86 100 LINEAR______60_000000__0H___155_ 60.0 155.625 BIT_MASK 0xffffffff /end CHARACTERISTIC
/begin CHARACTERISTIC c_acr_diag_ivvt_pos_in_min "C_ACR_DIAG_IVVT_POS_IN_MIN" VALUE 0x70a84 a_86 100 LINEAR______60_000000__0H___155_ 60.0 155.625 BIT_MASK 0xffffffff /end CHARACTERISTIC
/begin CHARACTERISTIC c_acr_diag_ivvt_t_ex_hld_pos "C_ACR_DIAG_IVVT_T_EX_HLD_POS" VALUE 0x700bc a_85 100 LINEAR______0_010000__1H___10_00 0.01 10.0 BIT_MASK 0xffffffff /end CHARACTERISTIC
/begin CHARACTERISTIC c_acr_diag_ivvt_t_ex_max "C_ACR_DIAG_IVVT_T_EX_MAX" VALUE 0x70a85 a_86 100 LINEAR_______155_625000__FFH____ -155.625 -60.0 BIT_MASK 0xffffffff /end CHARACTERISTIC
/begin CHARACTERISTIC c_acr_diag_ivvt_t_ex_min "C_ACR_DIAG_IVVT_T_EX_MIN" VALUE 0x70a86 a_86 100 LINEAR_______155_625000__FFH____ -155.625 -60.0 BIT_MASK 0xffffffff /end CHARACTERISTIC
/begin CHARACTERISTIC c_acr_diag_ivvt_t_in_hld_pos "C_ACR_DIAG_IVVT_T_IN_HLD_POS" VALUE 0x700be a_85 100 LINEAR______0_010000__1H___10_00 0.01 10.0 BIT_MASK 0xffffffff /end CHARACTERISTIC
/begin CHARACTERISTIC c_acr_diag_ivvt_t_in_max "C_ACR_DIAG_IVVT_T_IN_MAX" VALUE 0x70a87 a_86 100 LINEAR______60_000000__0H___155_ 60.0 155.625 BIT_MASK 0xffffffff /end CHARACTERISTIC
/begin CHARACTERISTIC c_acr_diag_ivvt_t_in_min "C_ACR_DIAG_IVVT_T_IN_MIN" VALUE 0x70a88 a_86 100 LINEAR______60_000000__0H___155_ 60.0 155.625 BIT_MASK 0xffffffff /end CHARACTERISTIC
/begin CHARACTERISTIC c_acr_diag_ivvt_tgt_ex_max "C_ACR_DIAG_IVVT_TGT_EX_MAX" VALUE 0x70a89 a_86 100 LINEAR_______155_625000__FFH____ -155.625 -60.0 BIT_MASK 0xffffffff /end CHARACTERISTIC
/begin CHARACTERISTIC c_acr_diag_ivvt_tgt_ex_min "C_ACR_DIAG_IVVT_TGT_EX_MIN" VALUE 0x70a8a a_86 100 LINEAR_______155_625000__FFH____ -155.625 -60.0 BIT_MASK 0xffffffff /end CHARACTERISTIC
/begin CHARACTERISTIC c_acr_diag_ivvt_tgt_in_max "C_ACR_DIAG_IVVT_TGT_IN_MAX" VALUE 0x70a8b a_86 100 LINEAR______60_000000__0H___155_ 60.0 155.625 BIT_MASK 0xffffffff /end CHARACTERISTIC
/begin CHARACTERISTIC c_acr_diag_ivvt_tgt_in_min "C_ACR_DIAG_IVVT_TGT_IN_MIN" VALUE 0x70a8c a_86 100 LINEAR______60_000000__0H___155_ 60.0 155.625 BIT_MASK 0xffffffff /end CHARACTERISTIC
/begin CHARACTERISTIC c_acr_diag_ivvt_tgt_t_ex_max "C_ACR_DIAG_IVVT_TGT_T_EX_MAX" VALUE 0x70a8d a_86 100 LINEAR______0_000000__0H___25514 0.0 255.0 BIT_MASK 0xffffffff /end CHARACTERISTIC
/begin CHARACTERISTIC c_acr_diag_ivvt_tgt_t_ex_min "C_ACR_DIAG_IVVT_TGT_T_EX_MIN" VALUE 0x70a8e a_86 100 LINEAR______0_000000__0H___25514 0.0 255.0 BIT_MASK 0xffffffff /end CHARACTERISTIC
/begin CHARACTERISTIC c_acr_diag_ivvt_tgt_t_in_max "C_ACR_DIAG_IVVT_TGT_T_IN_MAX" VALUE 0x70a8f a_86 100 LINEAR______0_000000__0H___25514 0.0 255.0 BIT_MASK 0xffffffff /end CHARACTERISTIC
/begin CHARACTERISTIC c_acr_diag_ivvt_tgt_t_in_min "C_ACR_DIAG_IVVT_TGT_T_IN_MIN" VALUE 0x70a90 a_86 100 LINEAR______0_000000__0H___25514 0.0 255.0 BIT_MASK 0xffffffff /end CHARACTERISTIC
/begin CHARACTERISTIC c_acr_diag_ivvt_toil_max "C_ACR_DIAG_IVVT_TOIL_MAX" VALUE 0x70a91 a_86 100 LINEAR_______48_000000__0H___155 -48.0 155.0 BIT_MASK 0xffffffff /end CHARACTERISTIC
/begin CHARACTERISTIC c_acr_diag_ivvt_toil_min "C_ACR_DIAG_IVVT_TOIL_MIN" VALUE 0x70a92 a_86 100 LINEAR_______48_000000__0H___155 -48.0 155.0 BIT_MASK 0xffffffff /end CHARACTERISTIC
/begin CHARACTERISTIC c_acr_diag_lshpwm_max "C_ACR_DIAG_LSHPWM_MAX" VALUE 0x70a93 a_86 100 LINEAR______0_000000__0H___99_88 0.0 99.609375 BIT_MASK 0xffffffff /end CHARACTERISTIC
/begin CHARACTERISTIC c_acr_diag_lshpwm_min "C_ACR_DIAG_LSHPWM_MIN" VALUE 0x70a94 a_86 100 LINEAR______0_000000__0H___99_88 0.0 99.609375 BIT_MASK 0xffffffff /end CHARACTERISTIC
/begin CHARACTERISTIC c_acr_diag_mtc_max "C_ACR_DIAG_MTC_MAX" VALUE 0x700c0 a_85 100 LINEAR______0_000000__0H___11989 0.0 119.5 BIT_MASK 0xffffffff /end CHARACTERISTIC
/begin CHARACTERISTIC c_acr_diag_mtc_min "C_ACR_DIAG_MTC_MIN" VALUE 0x700c2 a_85 100 LINEAR______0_000000__0H___11989 0.0 119.5 BIT_MASK 0xffffffff /end CHARACTERISTIC
/begin CHARACTERISTIC c_acr_diag_n_max "C_ACR_DIAG_N_MAX" VALUE 0x70a95 a_86 100 LINEAR______0_000000__0H___8160_ 0.0 8160.0 BIT_MASK 0xffffffff /end CHARACTERISTIC
/begin CHARACTERISTIC c_acr_diag_set_is_max "ACR_DIAG_SET_IS_MAX" VALUE 0x70a96 a_86 100 LINEAR______0_000000__0H___8160_ 0.0 8160.0 BIT_MASK 0xffffffff /end CHARACTERISTIC
/begin CHARACTERISTIC c_acr_diag_set_is_min "C_ACR_DIAG_SET_IS_MIN" VALUE 0x70a97 a_86 100 LINEAR______0_000000__0H___8160_ 0.0 8160.0 BIT_MASK 0xffffffff /end CHARACTERISTIC
/begin CHARACTERISTIC c_acr_diag_vs_fil_max "C_ACR_DIAG_VS_FIL_MAX" VALUE 0x700c4 a_85 100 LINEAR______0_000000__0H___51151 0.0 511.99218 BIT_MASK 0xffffffff /end CHARACTERISTIC
/begin CHARACTERISTIC c_ad_mmv_isa_lgrd_diag "C_AD_MMV_ISA_LGRD_DIAG" VALUE 0x70a98 a_86 100 LINEAR______0_015625__1H___3_984 0.015625 3.984375 BIT_MASK 0xffffffff /end CHARACTERISTIC
/begin CHARACTERISTIC c_amp_crlc "C_AMP_CRLC" VALUE 0x70a99 a_86 100 LINEAR______0_000000__0H___0_996 0.0 0.99609375 BIT_MASK 0xffffffff /end CHARACTERISTIC
/begin CHARACTERISTIC c_amp_dmtl_max "C_AMP_DMTL_MAX" VALUE 0x700c6 a_85 100 LINEAR______0_000000__0H___5434_ 0.0 5434.2598 BIT_MASK 0xffffffff FUNCTION_LIST DMTL /end CHARACTERISTIC
/begin CHARACTERISTIC c_amp_hys "C_AMP_HYS" VALUE 0x700c8 a_85 100 LINEAR______0_000000__0H___5434_ 0.0 5434.2598 BIT_MASK 0xffffffff /end CHARACTERISTIC
/begin CHARACTERISTIC c_amp_ref "C_AMP_REF" VALUE 0x700ca a_85 100 LINEAR______0_000000__0H___5434_ 0.0 5434.2598 BIT_MASK 0xffffffff /end CHARACTERISTIC
/begin CHARACTERISTIC c_amt_1_cycnr_max "C_AMT_1_CYCNR_MAX" VALUE 0x70a9a a_86 100 LINEAR______1_000000__1H___255_0 1.0 255.0 BIT_MASK 0xffffffff FUNCTION_LIST Z1S1 /end CHARACTERISTIC
/begin CHARACTERISTIC c_amt_gs_dly_er "C_AMT_GS_DLY_ER" VALUE 0x700cc a_85 100 LINEAR______0_010000__1H___655_3 0.01 655.34998 BIT_MASK 0xffffffff FUNCTION_LIST Z1S1 /end CHARACTERISTIC
/begin CHARACTERISTIC c_asr_1_cycnr_max "C_ASR_1_CYCNR_MAX" VALUE 0x70a9b a_86 100 LINEAR______1_000000__1H___255_0 1.0 255.0 BIT_MASK 0xffffffff /end CHARACTERISTIC
/begin CHARACTERISTIC c_asr_3_cycnr_max "C_ASR_3_CYCNR_MAX" VALUE 0x70a9c a_86 100 LINEAR______1_000000__1H___255_0 1.0 255.0 BIT_MASK 0xffffffff /end CHARACTERISTIC
/begin CHARACTERISTIC c_bd_ign_mpl_300 "C_BD_IGN_MPL_300" VALUE 0x70a9d a_86 20 LINEAR______0_000000__0H___1_360 0.0 1.36 BIT_MASK 0xffffffff /end CHARACTERISTIC
/begin CHARACTERISTIC c_bd_ign_mpl_pc "C_BD_IGN_MPL_PC" VALUE 0x70a9e a_86 20 LINEAR______0_000000__0H___1_360 0.0 1.36 BIT_MASK 0xffffffff /end CHARACTERISTIC
/begin CHARACTERISTIC c_cam_adj_dif_adh_ex "C_CAM_ADJ_DIF_ADH_EX" VALUE 0x70a9f a_86 100 LINEAR______0_000000__0H___95_22 0.0 95.625 BIT_MASK 0xffffffff /end CHARACTERISTIC
/begin CHARACTERISTIC c_cam_adj_dif_adh_in "C_CAM_ADJ_DIF_ADH_IN" VALUE 0x70aa0 a_86 100 LINEAR______0_000000__0H___95_22 0.0 95.625 BIT_MASK 0xffffffff /end CHARACTERISTIC
/begin CHARACTERISTIC c_cam_adj_rng_max_ex "C_CAM_ADJ_RNG_MAX_EX" VALUE 0x70aa1 a_86 100 LINEAR______0_000000__0H___48_00 0.0 48.0 BIT_MASK 0xffffffff /end CHARACTERISTIC
/begin CHARACTERISTIC c_cam_adj_rng_max_in "C_CAM_ADJ_RNG_MAX_IN" VALUE 0x70aa2 a_86 100 LINEAR______0_000000__0H___48_00 0.0 48.0 BIT_MASK 0xffffffff /end CHARACTERISTIC
/begin CHARACTERISTIC c_cam_dif_ad_max_knk "C_CAM_DIF_AD_MAX_KNK" VALUE 0x70aa3 a_86 100 LINEAR______0_000000__0H___95_22 0.0 95.625 BIT_MASK 0xffffffff /end CHARACTERISTIC
/begin CHARACTERISTIC c_cam_dif_min_dly "C_CAM_DIF_MIN_DLY" VALUE 0x70aa4 a_86 100 LINEAR______0_000000__0H___48_00 0.0 48.0 BIT_MASK 0xffffffff /end CHARACTERISTIC
/begin CHARACTERISTIC c_cam_grd_ad_max "C_CAM_GRD_AD_MAX" VALUE 0x70aa5 a_86 100 LINEAR______0_000000__0H___95_90 0.0 95.625 BIT_MASK 0xffffffff /end CHARACTERISTIC
/begin CHARACTERISTIC c_cam_grd_max_st "C_CAM_GRD_MAX_ST" VALUE 0x70aa6 a_86 100 LINEAR______0_000000__0H___95_90 0.0 95.625 BIT_MASK 0xffffffff /end CHARACTERISTIC
/begin CHARACTERISTIC c_cam_hys_ad_ivvt "C_CAM_HYS_AD_IVVT" VALUE 0x70aa7 a_86 100 LINEAR______0_000000__0H___47_62 0.0 47.625 BIT_MASK 0xffffffff /end CHARACTERISTIC
/begin CHARACTERISTIC c_cam_hys_add_ivvt_adh "C_CAM_HYS_ADD_IVVT_ADH" VALUE 0x70aa8 a_86 100 LINEAR______0_000000__0H___47_62 0.0 47.625 BIT_MASK 0xffffffff /end CHARACTERISTIC
/begin CHARACTERISTIC c_cam_hys_ref "C_CAM_HYS_REF" VALUE 0x70aa9 a_86 100 LINEAR______0_000000__0H___47_62 0.0 47.625 BIT_MASK 0xffffffff /end CHARACTERISTIC
/begin CHARACTERISTIC c_cam_ini_ex "C_CAM_INI_EX" VALUE 0x70aaa a_86 100 LINEAR_______155_625000__FFH____ -155.625 -60.0 BIT_MASK 0xffffffff /end CHARACTERISTIC
/begin CHARACTERISTIC c_cam_ini_in "C_CAM_INI_IN" VALUE 0x70aab a_86 100 LINEAR______60_000000__0H___155_ 60.0 155.625 BIT_MASK 0xffffffff /end CHARACTERISTIC
/begin CHARACTERISTIC c_cam_op_ex "C_CAM_OP_EX" VALUE 0x70aac a_86 100 LINEAR______175_000000__0H___270 175.0 270.625 BIT_MASK 0xffffffff /end CHARACTERISTIC
/begin CHARACTERISTIC c_cam_op_in "C_CAM_OP_IN" VALUE 0x70aad a_86 100 LINEAR______175_000000__0H___270 175.0 270.625 BIT_MASK 0xffffffff /end CHARACTERISTIC
/begin CHARACTERISTIC c_cam_sp_dif_max "C_CAM_SP_DIF_MAX" VALUE 0x70aae a_86 100 LINEAR______0_000000__0H___47_62 0.0 47.625 BIT_MASK 0xffffffff /end CHARACTERISTIC
/begin CHARACTERISTIC c_cam_sp_in_isapwm_min_lgrd "C_CAM_SP_IN_ISAPWM_MIN_LGRD" VALUE 0x700ce a_85 100 LINEAR______0_001465__1H___47_99 0.001465 47.99854 BIT_MASK 0xffffffff /end CHARACTERISTIC
/begin CHARACTERISTIC c_can_vb_min_diag_mon "C_CAN_VB_MIN_DIAG_MON" VALUE 0x71264 a_86 100 LINEAR______0_000000__0H___26_00 0.0 26.0 BIT_MASK 0xffffffff /end CHARACTERISTIC
/begin CHARACTERISTIC c_cast_puc_cycnr_st_ast "C_CAST_PUC_CYCNR_ST_AST" VALUE 0x70aaf a_86 100 LINEAR______1_000000__1H___255_0 1.0 255.0 BIT_MASK 0xffffffff /end CHARACTERISTIC
/begin CHARACTERISTIC c_cat_diag_max_dly "C_CAT_DIAG_MAX_DLY" VALUE 0x700d0 a_85 100 LINEAR______0_000000__0H___255_9 0.0 255.9961 BIT_MASK 0xffffffff /end CHARACTERISTIC
/begin CHARACTERISTIC c_cat_diag_temp_dif "C_CAT_DIAG_TEMP_DIF" VALUE 0x70ab0 a_86 100 LINEAR______0_000000__0H___63_91 0.0 63.75 BIT_MASK 0xffffffff /end CHARACTERISTIC
/begin CHARACTERISTIC c_cat_diag_thd "C_CAT_DIAG_THD" VALUE 0x700d2 a_85 100 LINEAR______0_000000__0H___63_99 0.0 63.999023 BIT_MASK 0xffffffff /end CHARACTERISTIC
/begin CHARACTERISTIC c_cat_max_diag "C_CAT_MAX_DIAG" VALUE 0x700d4 a_85 100 LINEAR______0_000000__0H___2559_ 0.0 2559.9609 BIT_MASK 0xffffffff /end CHARACTERISTIC
/begin CHARACTERISTIC c_cha_cdn_bat_hys "C_CHA_CDN_BAT_HYS" VALUE 0x70ab1 a_86 100 LINEAR______0_000000__0H___12779 0.0 127.5 BIT_MASK 0xffffffff /end CHARACTERISTIC
/begin CHARACTERISTIC c_cha_cdn_bat_ini "C_CHA_CDN_BAT_INI" VALUE 0x70ab2 a_86 100 LINEAR______0_000000__0H___12779 0.0 127.5 BIT_MASK 0xffffffff /end CHARACTERISTIC
/begin CHARACTERISTIC c_cha_cdn_bat_max "C_CHA_CDN_BAT_MAX" VALUE 0x70ab3 a_86 100 LINEAR______0_000000__0H___12779 0.0 127.5 BIT_MASK 0xffffffff /end CHARACTERISTIC
/begin CHARACTERISTIC c_cha_cdn_bat_min "C_CHA_CDN_BAT_MIN" VALUE 0x70ab4 a_86 100 LINEAR______0_000000__0H___12779 0.0 127.5 BIT_MASK 0xffffffff /end CHARACTERISTIC
/begin CHARACTERISTIC c_cng_ram_adr "C_CNG_RAM_ADR" VALUE 0x700d6 a_85 100 LINEAR______0_000000__0H___65535 0.0 65535.0 BIT_MASK 0xffffffff FUNCTION_LIST CNG /end CHARACTERISTIC
/begin CHARACTERISTIC c_cod_2_dmtl "C_COD_2_DMTL" VALUE 0x70ab5 a_86 100 LINEAR______0_000000__0H___255_0 0.0 255.0 BIT_MASK 0xffffffff FUNCTION_LIST DMTL /end CHARACTERISTIC
/begin CHARACTERISTIC c_cod_dmtl "C_COD_DMTL" VALUE 0x70ab6 a_86 100 LINEAR______0_000000__0H___255_0 0.0 255.0 BIT_MASK 0xffffffff FUNCTION_LIST DMTL /end CHARACTERISTIC
/begin CHARACTERISTIC c_cod_hdmtl "C_COD_HDMTL" VALUE 0x70ab7 a_86 100 LINEAR______0_000000__0H___1_000 0.0 1.0 BIT_MASK 0xffffffff FUNCTION_LIST DMTL /end CHARACTERISTIC
/begin CHARACTERISTIC c_conf_aj_maf "C_CONF_AJ_MAF" VALUE 0x70ab8 a_86 100 LINEAR______0_000000__0H___1_000 0.0 1.0 BIT_MASK 0xffffffff /end CHARACTERISTIC
/begin CHARACTERISTIC c_conf_bts "C_CONF_BTS" VALUE 0x70ab9 a_86 100 LINEAR______0_000000__0H___1_000 0.0 1.0 BIT_MASK 0xffffffff /end CHARACTERISTIC
/begin CHARACTERISTIC c_conf_can_cal "C_CONF_CAN_CAL" VALUE 0x70aba a_86 100 LINEAR______0_000000__0H___1_000 0.0 1.0 BIT_MASK 0xffffffff /end CHARACTERISTIC
/begin CHARACTERISTIC c_conf_cat "C_CONF_CAT" VALUE 0x70abb a_86 100 LINEAR______0_000000__0H___4_000 0.0 4.0 BIT_MASK 0xffffffff /end CHARACTERISTIC
/begin CHARACTERISTIC c_conf_cha_cdn_bat "C_CONF_CHA_CDN_BAT" VALUE 0x70abc a_86 100 LINEAR______0_000000__0H___3_000 0.0 3.0 BIT_MASK 0xffffffff /end CHARACTERISTIC
/begin CHARACTERISTIC c_conf_cru_main_swi "C_CONF_CRU_MAIN_SWI" VALUE 0x70abd a_86 100 LINEAR______0_000000__0H___1_000 0.0 1.0 BIT_MASK 0xffffffff /end CHARACTERISTIC
/begin CHARACTERISTIC c_conf_dmtl "C_CONF_DMTL" VALUE 0x70abe a_86 100 LINEAR______0_000000__0H___1_000 0.0 1.0 BIT_MASK 0xffffffff FUNCTION_LIST DMTL /end CHARACTERISTIC
/begin CHARACTERISTIC c_conf_ecf "C_CONF_ECF" VALUE 0x70abf a_86 100 LINEAR______0_000000__0H___1_000 0.0 1.0 BIT_MASK 0xffffffff /end CHARACTERISTIC
/begin CHARACTERISTIC c_conf_ef "C_CONF_EF" VALUE 0x70ac0 a_86 100 LINEAR______0_000000__0H___1_000 0.0 1.0 BIT_MASK 0xffffffff /end CHARACTERISTIC
/begin CHARACTERISTIC c_conf_eobd "C_CONF_EOBD" VALUE 0x70ac1 a_86 100 LINEAR______0_000000__0H___1_000 0.0 1.0 BIT_MASK 0xffffffff /end CHARACTERISTIC
/begin CHARACTERISTIC c_conf_lam_sav_diag "C_CONF_LAM_SAV_DIAG" VALUE 0x70ac2 a_86 100 LINEAR______0_000000__0H___1_000 0.0 1.0 BIT_MASK 0xffffffff /end CHARACTERISTIC
/begin CHARACTERISTIC c_conf_mil "C_CONF_MIL" VALUE 0x70ac3 a_86 100 LINEAR______0_000000__0H___3_000 0.0 3.0 BIT_MASK 0xffffffff /end CHARACTERISTIC
/begin CHARACTERISTIC c_conf_mil_eu2 "C_CONF_MIL_EU2" VALUE 0x70ac4 a_86 100 LINEAR______0_000000__0H___3_000 0.0 3.0 BIT_MASK 0xffffffff /end CHARACTERISTIC
/begin CHARACTERISTIC c_conf_n_hys_puc "C_CONF_N_HYS_PUC" VALUE 0x70ac5 a_86 100 LINEAR______0_000000__0H___1_000 0.0 1.0 BIT_MASK 0xffffffff /end CHARACTERISTIC
/begin CHARACTERISTIC c_conf_n_hys_puc_dri "C_CONF_N_HYS_PUC_DRI" VALUE 0x70ac6 a_86 100 LINEAR______0_000000__0H___1_000 0.0 1.0 BIT_MASK 0xffffffff /end CHARACTERISTIC
/begin CHARACTERISTIC c_conf_sap "C_CONF_SAP" VALUE 0x70ac7 a_86 100 LINEAR______0_000000__0H___3_000 0.0 3.0 BIT_MASK 0xffffffff /end CHARACTERISTIC
/begin CHARACTERISTIC c_conf_sav_diag "C_CONF_SAV_DIAG" VALUE 0x70ac8 a_86 100 LINEAR______0_000000__0H___1_000 0.0 1.0 BIT_MASK 0xffffffff /end CHARACTERISTIC
/begin CHARACTERISTIC c_conf_tco_ex "C_CONF_TCO_EX" VALUE 0x70ac9 a_86 100 LINEAR______0_000000__0H___1_000 0.0 1.0 BIT_MASK 0xffffffff /end CHARACTERISTIC
/begin CHARACTERISTIC c_conf_teg "C_CONF_TEG" VALUE 0x70aca a_86 100 LINEAR______0_000000__0H___2_000 0.0 2.0 BIT_MASK 0xffffffff /end CHARACTERISTIC
/begin CHARACTERISTIC c_conf_tipr_end "C_CONF_TIPR_END" VALUE 0x70acb a_86 100 LINEAR______0_000000__0H___1_000 0.0 1.0 BIT_MASK 0xffffffff /end CHARACTERISTIC
/begin CHARACTERISTIC c_conf_tq_lim_gear "C_CONF_TQ_LIM_GEAR" VALUE 0x70acc a_86 100 LINEAR______0_000000__0H___1_000 0.0 1.0 BIT_MASK 0xffffffff /end CHARACTERISTIC
/begin CHARACTERISTIC c_cor_cam_ex_ref "C_COR_CAM_EX_REF" VALUE 0x70da0 a_87 100 LINEAR_______18_000000__FFFFFFD0 -18.0 18.0 BIT_MASK 0xffffffff /end CHARACTERISTIC
/begin CHARACTERISTIC c_cor_cam_in_ref "C_COR_CAM_IN_REF" VALUE 0x70da1 a_87 100 LINEAR_______18_000000__FFFFFFD0 -18.0 18.0 BIT_MASK 0xffffffff /end CHARACTERISTIC
/begin CHARACTERISTIC c_cppwm_diagcps_maf "C_CPPWM_DIAGCPS_MAF" VALUE 0x700d8 a_85 10 LINEAR______0_000000__0H___99_97 0.0 99.97559 BIT_MASK 0xffffffff /end CHARACTERISTIC
/begin CHARACTERISTIC c_cppwm_diagcps_n "C_CPPWM_DIAGCPS_N" VALUE 0x700da a_85 10 LINEAR______0_000000__0H___99_97 0.0 99.97559 BIT_MASK 0xffffffff /end CHARACTERISTIC
/begin CHARACTERISTIC c_cppwm_max_ad "C_CPPWM_MAX_AD" VALUE 0x700dc a_85 10 LINEAR______0_000000__0H___800_0 0.0 800.0 BIT_MASK 0xffffffff /end CHARACTERISTIC
/begin CHARACTERISTIC c_cppwm_max_cor_max "C_CPPWM_MAX_COR_MAX" VALUE 0x700de a_85 10 LINEAR______0_000000__0H___800_0 0.0 800.0 BIT_MASK 0xffffffff /end CHARACTERISTIC
/begin CHARACTERISTIC c_cppwm_max_is_diag "C_CPPWM_MAX_IS_DIAG" VALUE 0x700e0 a_85 10 LINEAR______0_000000__0H___99_97 0.0 99.97559 BIT_MASK 0xffffffff /end CHARACTERISTIC
/begin CHARACTERISTIC c_cppwm_min_ad "C_CPPWM_MIN_AD" VALUE 0x700e2 a_85 10 LINEAR______0_000000__0H___99_97 0.0 99.97559 BIT_MASK 0xffffffff /end CHARACTERISTIC
/begin CHARACTERISTIC c_crk_dif_max_er "C_CRK_DIF_MAX_ER" VALUE 0x700e4 a_85 5 LINEAR______0_000000__0H___7_812 0.0 7.8125 BIT_MASK 0xffffffff /end CHARACTERISTIC
/begin CHARACTERISTIC c_crk_vld_tooth "C_CRK_VLD_TOOTH" VALUE 0x70acd a_86 100 LINEAR______4_000000__4H___56_00 4.0 56.0 BIT_MASK 0xffffffff /end CHARACTERISTIC
/begin CHARACTERISTIC c_crlc_ad_is "C_CRLC_AD_IS" VALUE 0x70ace a_86 10 LINEAR______0_000000__0H___0_996 0.0 0.99609375 BIT_MASK 0xffffffff /end CHARACTERISTIC
/begin CHARACTERISTIC c_crlc_cam_ad_ivvt "C_CRLC_CAM_AD_IVVT" VALUE 0x70acf a_86 100 LINEAR______0_000000__0H___0_996 0.0 0.99609375 BIT_MASK 0xffffffff /end CHARACTERISTIC
/begin CHARACTERISTIC c_crlc_cam_ad_st_ivvt "C_CRLC_CAM_AD_ST_IVVT" VALUE 0x70ad0 a_86 100 LINEAR______0_000000__0H___0_996 0.0 0.99609375 BIT_MASK 0xffffffff /end CHARACTERISTIC
/begin CHARACTERISTIC c_crlc_cur_dmtl_fil "C_CRLC_CUR_DMTL_FIL" VALUE 0x700e6 a_85 100 LINEAR______0_000000__0H___0_999 0.0 0.99998474 BIT_MASK 0xffffffff FUNCTION_LIST DMTL /end CHARACTERISTIC
/begin CHARACTERISTIC c_crlc_cur_dmtl_fil_lim "C_CRLC_CUR_DMTL_FIL_LIM" VALUE 0x700e8 a_85 100 LINEAR______0_000000__0H___0_999 0.0 0.99998474 BIT_MASK 0xffffffff FUNCTION_LIST DMTL /end CHARACTERISTIC
/begin CHARACTERISTIC c_crlc_cur_dmtl_fil_refu "C_CRLC_CUR_DMTL_FIL_REFU" VALUE 0x700ea a_85 100 LINEAR______0_000000__0H___1_027 0.0 1.0 BIT_MASK 0xffffffff FUNCTION_LIST DMTL /end CHARACTERISTIC
/begin CHARACTERISTIC c_crlc_dec_cat_ecf "C_CRLC_DEC_CAT_ECF" VALUE 0x700ec a_85 100 LINEAR______0_000000__0H___0_999 0.0 0.99998474 BIT_MASK 0xffffffff /end CHARACTERISTIC
/begin CHARACTERISTIC c_crlc_dly_ad "C_CRLC_DLY_AD" VALUE 0x700ee a_85 100 LINEAR______0_000000__0H___0_999 0.0 0.99998474 BIT_MASK 0xffffffff /end CHARACTERISTIC
/begin CHARACTERISTIC c_crlc_dly_ad_mmv "C_CRLC_DLY_AD_MMV" VALUE 0x700f0 a_85 100 LINEAR______0_000000__0H___0_999 0.0 0.99998474 BIT_MASK 0xffffffff /end CHARACTERISTIC
/begin CHARACTERISTIC c_crlc_fac_gr "C_CRLC_FAC_GR" VALUE 0x70ad1 a_86 100 LINEAR______0_000000__0H___0_996 0.0 0.99609375 BIT_MASK 0xffffffff /end CHARACTERISTIC
/begin CHARACTERISTIC c_crlc_inc_cat_ecf "C_CRLC_INC_CAT_ECF" VALUE 0x700f2 a_85 100 LINEAR______0_000000__0H___0_999 0.0 0.99998474 BIT_MASK 0xffffffff /end CHARACTERISTIC
/begin CHARACTERISTIC c_crlc_is_er_diag "C_CRLC_IS_ER_DIAG" VALUE 0x70ad2 a_86 100 LINEAR______0_000000__0H___0_996 0.0 0.99609375 BIT_MASK 0xffffffff /end CHARACTERISTIC
/begin CHARACTERISTIC c_crlc_isa_diag "C_CRLC_ISA_DIAG" VALUE 0x70ad3 a_86 100 LINEAR______0_000000__0H___0_996 0.0 0.99609375 BIT_MASK 0xffffffff /end CHARACTERISTIC
/begin CHARACTERISTIC c_crlc_isapwm_diagcps "C_CRLC_ISAPWM_DIAGCPS" VALUE 0x700f4 a_85 10 LINEAR______0_000000__0H___0_999 0.0 0.99998474 BIT_MASK 0xffffffff /end CHARACTERISTIC
/begin CHARACTERISTIC c_crlc_isapwm_n_dif "C_CRLC_ISAPWM_N_DIF" VALUE 0x700f6 a_85 100 LINEAR______0_000000__0H___0_999 0.0 0.99998474 BIT_MASK 0xffffffff /end CHARACTERISTIC
/begin CHARACTERISTIC c_crlc_lam_mv_dly "C_CRLC_LAM_MV_DLY" VALUE 0x700f8 a_85 100 LINEAR______0_000000__0H___0_999 0.0 0.99998474 BIT_MASK 0xffffffff /end CHARACTERISTIC
/begin CHARACTERISTIC c_crlc_maf_dly "C_CRLC_MAF_DLY" VALUE 0x700fa a_85 100 LINEAR______0_000000__0H___0_999 0.0 0.99998474 BIT_MASK 0xffffffff /end CHARACTERISTIC
/begin CHARACTERISTIC c_crlc_maf_ivvt "C_CRLC_MAF_IVVT" VALUE 0x70ad4 a_86 100 LINEAR______0_000000__0H___0_996 0.0 0.99609375 BIT_MASK 0xffffffff /end CHARACTERISTIC
/begin CHARACTERISTIC c_crlc_n_dly "C_CRLC_N_DLY" VALUE 0x700fc a_85 100 LINEAR______0_000000__0H___0_999 0.0 0.99998474 BIT_MASK 0xffffffff /end CHARACTERISTIC
/begin CHARACTERISTIC c_crlc_n_sp_min_vb "C_CRLC_N_SP_MIN_VB" VALUE 0x70ad5 a_86 10 LINEAR______0_000000__0H___0_996 0.0 0.99609375 BIT_MASK 0xffffffff /end CHARACTERISTIC
/begin CHARACTERISTIC c_crlc_ref_ivvt "C_CRLC_REF_IVVT" VALUE 0x70ad6 a_86 100 LINEAR______0_000000__0H___0_996 0.0 0.99609375 BIT_MASK 0xffffffff /end CHARACTERISTIC
/begin CHARACTERISTIC c_crlc_saf "C_CRLC_SAF" VALUE 0x70ad7 a_86 100 LINEAR______0_000000__0H___0_996 0.0 0.99609375 BIT_MASK 0xffffffff /end CHARACTERISTIC
/begin CHARACTERISTIC c_crlc_saf_kgh "C_CRLC_SAF_KGH" VALUE 0x70ad8 a_86 100 LINEAR______0_000000__0H___0_996 0.0 0.99609375 BIT_MASK 0xffffffff /end CHARACTERISTIC
/begin CHARACTERISTIC c_crlc_saf_st "C_CRLC_SAF_ST" VALUE 0x70ad9 a_86 100 LINEAR______0_000000__0H___0_996 0.0 0.99609375 BIT_MASK 0xffffffff /end CHARACTERISTIC
/begin CHARACTERISTIC c_crlc_scc_asr "C_CRLC_SCC_ASR" VALUE 0x700fe a_85 100 LINEAR______0_000000__0H___0_999 0.0 0.99998474 BIT_MASK 0xffffffff /end CHARACTERISTIC
/begin CHARACTERISTIC c_crlc_sum_ti_ad_add "C_CRLC_SUM_TI_AD_ADD" VALUE 0x70100 a_85 100 LINEAR______0_000000__0H___25592 0.0 255.0 BIT_MASK 0xffffffff /end CHARACTERISTIC
/begin CHARACTERISTIC c_crlc_sum_ti_ad_fac "C_CRLC_SUM_TI_AD_FAC" VALUE 0x70102 a_85 100 LINEAR______0_000000__0H___25592 0.0 255.0 BIT_MASK 0xffffffff /end CHARACTERISTIC
/begin CHARACTERISTIC c_crlc_vb_dmtl_fil "C_CRLC_VB_DMTL_FIL" VALUE 0x70104 a_85 100 LINEAR______0_000000__0H___0_999 0.0 0.99998474 BIT_MASK 0xffffffff FUNCTION_LIST DMTL /end CHARACTERISTIC
/begin CHARACTERISTIC c_crlc_vb_dmtl_fil_lim "C_CRLC_VB_DMTL_FIL_LIM" VALUE 0x70106 a_85 100 LINEAR______0_000000__0H___0_999 0.0 0.99998474 BIT_MASK 0xffffffff FUNCTION_LIST DMTL /end CHARACTERISTIC
/begin CHARACTERISTIC c_ctr_dly_sa_act "C_CTR_DLY_SA_ACT" VALUE 0x70108 a_85 100 LINEAR______0_000000__0H___65593 0.0 65534.0 BIT_MASK 0xffffffff /end CHARACTERISTIC
/begin CHARACTERISTIC c_ctr_max_pvs_av_con "C_CTR_MAX_PVS_AV_CON" VALUE 0x70ada a_86 100 LINEAR______0_000000__0H___255_0 0.0 255.0 BIT_MASK 0xffffffff /end CHARACTERISTIC
/begin CHARACTERISTIC c_ctr_max_pvs_bls_bts_plaus "C_CTR_MAX_PVS_BLS_BTS_PLAUS" VALUE 0x70adb a_86 100 LINEAR______0_000000__0H___255_0 0.0 255.0 BIT_MASK 0xffffffff /end CHARACTERISTIC
/begin CHARACTERISTIC c_cur_cns "C_CUR_CNS" VALUE 0x70da2 a_87 100 LINEAR_______128_000000__FFFFF94 -128.0 127.0 BIT_MASK 0xffffffff /end CHARACTERISTIC
/begin CHARACTERISTIC c_cur_cns_ltg "C_CUR_CNS_LTG" VALUE 0x70da3 a_87 100 LINEAR_______128_000000__FFFFF94 -128.0 127.0 BIT_MASK 0xffffffff /end CHARACTERISTIC
/begin CHARACTERISTIC c_cur_dmtl_cor_fil_ofs_amp "C_CUR_DMTL_COR_FIL_OFS_AMP" VALUE 0x70db6 a_95 100 LINEAR_______200_000000__FFFF800 -200.0 199.9938 BIT_MASK 0xffffffff FUNCTION_LIST DMTL /end CHARACTERISTIC
/begin CHARACTERISTIC c_cur_dmtl_dif_cur_dmtl_stat "C_CUR_DMTL_DIF_CUR_DMTL_STAT" VALUE 0x7010a a_85 100 LINEAR______0_000000__0H___400_0 0.0 400.0 BIT_MASK 0xffffffff FUNCTION_LIST DMTL /end CHARACTERISTIC
/begin CHARACTERISTIC c_cur_dmtl_ref_dif_max "C_CUR_DMTL_REF_DIF_MAX" VALUE 0x7010c a_85 100 LINEAR______0_000000__0H___400_0 0.0 400.0 BIT_MASK 0xffffffff FUNCTION_LIST DMTL /end CHARACTERISTIC
/begin AXIS_PTS ldpm_n_11 "N" 0x74b0e n a_743 100 LINEAR______0_000000__0H___81612 16 0.0 8160.0 /end AXIS_PTS
/begin AXIS_PTS ldpm_isapwm_1 "ISAPWM" 0x741f7 isapwm a_742 10 LINEAR______0_000000__0H___99_60 4 0.0 99.609375 /end AXIS_PTS
/begin AXIS_PTS ldpm_n_5 "N" 0x74b9a n a_743 100 LINEAR______0_000000__0H___81612 16 0.0 8160.0 /end AXIS_PTS
/begin AXIS_PTS ldpm_maf_kgh_17 "MAF_KGH" 0x74c10 maf_kgh a_743 10 LINEAR______0_000000__0H___16383 8 0.0 16383.75 FUNCTION_LIST ETM /end AXIS_PTS
/begin AXIS_PTS ldpm_maf_17 "MAF" 0x74c34 maf a_743 10 LINEAR______0_000000__0H___13818 8 0.0 1389.0 /end AXIS_PTS
/begin AXIS_PTS ldpm_n_17 "N" 0x74c22 n a_743 10 LINEAR______0_000000__0H___81612 8 0.0 8160.0 FUNCTION_LIST ETM /end AXIS_PTS
/begin AXIS_PTS ldpm_maf_kgh_18 "MAF_KGH" 0x74c46 maf_kgh a_743 10 LINEAR______0_000000__0H___16383 6 0.0 16383.75 FUNCTION_LIST ETM /end AXIS_PTS
/begin AXIS_PTS ldpm_temp_sp_toil_dif_1 "TEMP_SP_TOIL_DIF" 0x74c62 toil_dif a_743 10 LINEAR_______203_000000__0H___20 8 -203.0 203.0 FUNCTION_LIST ETM /end AXIS_PTS
/begin AXIS_PTS ldpm_temp_mmv_sub_ex_up_i_1 "TEMP_MMV_SUB_EX_UP_I" 0x74c74 dummy_w a_743 100 LINEAR_______33_000000__0H___989 8 -33.0 989.9844 FUNCTION_LIST ETM /end AXIS_PTS
/begin AXIS_PTS ldpm_n_12 "N" 0x74ca6 n a_743 100 LINEAR______0_000000__0H___81612 8 0.0 8160.0 FUNCTION_LIST CSCM /end AXIS_PTS
/begin AXIS_PTS ldpm_tco_3 "TCO" 0x74308 tco a_742 15 LINEAR_______48_000000__0H___142 8 -48.0 142.5 /end AXIS_PTS
/begin AXIS_PTS ldpm_n_32_22 "N" 0x74329 n a_742 100 LINEAR______0_000000__0H___8160_ 6 0.0 8160.0 /end AXIS_PTS
/begin AXIS_PTS ldpm_maf_4 "MAF" 0x7438a maf a_742 5 LINEAR______0_000000__0H___1389_ 8 0.0 1389.0 /end AXIS_PTS
/begin AXIS_PTS ldpm_n_7 "N" 0x74daa n a_743 10 LINEAR______0_000000__0H___81612 8 0.0 8160.0 /end AXIS_PTS
/begin AXIS_PTS ldpm_n_2 "N" 0x74fde n a_743 100 LINEAR______0_000000__0H___81612 6 0.0 8160.0 /end AXIS_PTS
/begin AXIS_PTS ldpm_tco_13 "TCO" 0x74568 tco a_742 100 LINEAR_______48_000000__0H___142 8 -48.0 142.5 /end AXIS_PTS
/begin AXIS_PTS ldpm_n_32_3 "N" 0x7459a n a_742 100 LINEAR______0_000000__0H___8160_ 12 0.0 8160.0 /end AXIS_PTS
/begin AXIS_PTS ldpm_n_22 "N" 0x750e2 n a_743 10 LINEAR______0_000000__0H___81612 4 0.0 8160.0 /end AXIS_PTS
/begin AXIS_PTS ldpm_vo_2 "VO" 0x750ec vo a_743 100 LINEAR______0_000000__0H___120_0 8 0.0 120.0 /end AXIS_PTS
/begin AXIS_PTS ldpm_tco_16 "TCO" 0x745cb tco a_742 100 LINEAR_______48_000000__0H___142 8 -48.0 142.5 /end AXIS_PTS
/begin AXIS_PTS ldpm_n_32_6 "N" 0x745fd n a_742 100 LINEAR______0_000000__0H___8160_ 16 0.0 8160.0 /end AXIS_PTS
/begin AXIS_PTS ldpm_tco_10 "TCO" 0x74676 tco a_742 15 LINEAR_______48_000000__0H___142 8 -48.0 142.5 /end AXIS_PTS
/begin AXIS_PTS ldpm_km_ctr_1 "KM_CTR" 0x74b90 km_ctr a_743 100 LINEAR______0_000000__0H___65534 4 0.0 655340.0 /end AXIS_PTS
/begin AXIS_PTS ldpm_tco_st_3 "TCO_ST" 0x742cd tco_st a_742 100 LINEAR_______48_000000__0H___142 8 -48.0 142.5 /end AXIS_PTS
/begin AXIS_PTS ldpm_vs_sp_cru_1 "VS_SP_CRU" 0x74e32 vs_sp_cru a_743 100 LINEAR______0_000000__0H___51151 5 0.0 511.99218 /end AXIS_PTS
/begin AXIS_PTS ldpm_n_32_14 "N" 0x74749 n_32 a_742 100 LINEAR______0_000000__0H___8160_ 12 0.0 8160.0 /end AXIS_PTS
/begin AXIS_PTS ldpm_dly_ivvt_y_1 "TOTZ_VANOS_Y" 0x74780 dummy_b a_742 100 LINEAR______0_000000__0H___2550_ 6 0.0 2550.0 /end AXIS_PTS
/begin AXIS_PTS ldpm_cam_dif_ctl_x_1 "NW_DIF_REG_X" 0x74777 dummy_b a_742 100 LINEAR______0_000000__0H___48_00 8 0.0 48.0 /end AXIS_PTS
/begin AXIS_PTS ldpm_tco_st_7 "TCO_ST" 0x7479d tco_st a_742 15 LINEAR_______48_000000__0H___142 8 -48.0 142.5 /end AXIS_PTS
/begin AXIS_PTS ldpm_iga_dif_1 "IGA_DIF" 0x7480a dummy_b a_742 100 LINEAR______0_000000__0H___95_22 6 0.0 95.625 /end AXIS_PTS
/begin AXIS_PTS ldp_saf_kgh__temp_sap_up "SAF_KGH" 0x75584 saf_kgh a_743 100 LINEAR______0_000000__0H___10269 6 0.0 1023.9844 FUNCTION_LIST ETM /end AXIS_PTS
/begin AXIS_PTS ldpm_maf_9 "MAF" 0x74895 maf a_742 5 LINEAR______0_000000__0H___1389_ 8 0.0 1389.0 /end AXIS_PTS
/begin AXIS_PTS ldpm_n_32_20 "N" 0x7488c n a_742 10 LINEAR______0_000000__0H___8160_ 8 0.0 8160.0 /end AXIS_PTS
/begin AXIS_PTS ldpm_n_32_9 "N" 0x7489e n a_742 100 LINEAR______0_000000__0H___8160_ 8 0.0 8160.0 /end AXIS_PTS
/begin AXIS_PTS ldpm_tco_7 "TCO" 0x748ae tco a_742 15 LINEAR_______48_000000__0H___142 8 -48.0 142.5 /end AXIS_PTS
/begin AXIS_PTS ldpm_tco_1 "TCO" 0x748d2 tco a_742 15 LINEAR_______48_000000__0H___142 8 -48.0 142.5 /end AXIS_PTS
/begin AXIS_PTS ldpm_tco_18 "TCO" 0x748ed tco a_742 100 LINEAR_______48_000000__0H___142 4 -48.0 142.5 /end AXIS_PTS
/begin AXIS_PTS ldpm_vo_1 "VO" 0x75656 vo a_743 100 LINEAR______0_000000__0H___120_0 8 0.0 120.0 /end AXIS_PTS
/begin AXIS_PTS ldp_maf__ti_sawup "MAF" 0x74912 maf a_742 5 LINEAR______0_000000__0H___1389_ 8 0.0 1389.0 /end AXIS_PTS
/begin AXIS_PTS ldp_n_32__ti_sawup "N" 0x74909 n a_742 10 LINEAR______0_000000__0H___8160_ 8 0.0 8160.0 /end AXIS_PTS
/begin AXIS_PTS ldpm_maf_3 "MAF" 0x75668 maf a_743 100 LINEAR______0_000000__0H___13818 6 0.0 1389.0 /end AXIS_PTS
/begin AXIS_PTS ldpm_maf_8 "MAF" 0x75676 maf a_743 100 LINEAR______0_000000__0H___13818 12 0.0 1389.0 /end AXIS_PTS
/begin AXIS_PTS ldpm_tco_st_10 "TCO_ST" 0x74924 tco_st a_742 15 LINEAR_______48_000000__0H___142 3 -48.0 142.5 /end AXIS_PTS
/begin AXIS_PTS ldpm_tco_14 "TCO" 0x7491b tco a_742 15 LINEAR_______48_000000__0H___142 8 -48.0 142.5 /end AXIS_PTS
/begin AXIS_PTS ldp_tia__ti_tra_fac "TIA" 0x7492d tia a_742 100 LINEAR_______48_000000__0H___142 4 -48.0 142.5 /end AXIS_PTS
/begin AXIS_PTS ldp_tco__ti_tra_fac "TCO" 0x74928 tco a_742 100 LINEAR_______48_000000__0H___142 4 -48.0 142.5 /end AXIS_PTS
/begin AXIS_PTS ldp_v_tia__tia "V_TIA" 0x74932 dummy_b a_742 90 LINEAR______0_039000__2H___4_986 16 0.039 4.986 /end AXIS_PTS
/begin AXIS_PTS ldp_tco__tmag "TCO" 0x7494e tco a_742 100 LINEAR_______48_000000__0H___142 10 -48.0 142.5 /end AXIS_PTS
/begin AXIS_PTS ldp_toil__tmag "TOIL" 0x74943 toil a_742 100 LINEAR_______48_000000__0H___155 10 -48.0 155.0 /end AXIS_PTS
/begin AXIS_PTS ldp_v_toil__toil "V_TOIL" 0x74959 dummy_b a_742 100 LINEAR______0_000000__0H___5_074 16 0.0 5.0 /end AXIS_PTS
/begin AXIS_PTS ldpm_n_32_47 "N" 0x7496a n_32 a_742 10 LINEAR______0_000000__0H___8160_ 4 0.0 8160.0 /end AXIS_PTS
/begin AXIS_PTS ldpm_n_32_31 "N" 0x7496f n_32 a_742 100 LINEAR______0_000000__0H___8160_ 6 0.0 8160.0 /end AXIS_PTS
/begin AXIS_PTS ldp_maf__tors_0_at_er "MAF" 0x74976 maf a_742 100 LINEAR______0_000000__0H___1389_ 6 0.0 1389.0 /end AXIS_PTS
/begin AXIS_PTS ldpm_n_32_32 "N" 0x7497d n_32 a_742 100 LINEAR______0_000000__0H___8160_ 6 0.0 8160.0 /end AXIS_PTS
/begin AXIS_PTS ldp_maf__tors_0_mt_er "MAF" 0x74984 maf a_742 100 LINEAR______0_000000__0H___1389_ 6 0.0 1389.0 /end AXIS_PTS
/begin AXIS_PTS ldpm_n_32_33 "N" 0x7498b n_32 a_742 100 LINEAR______0_000000__0H___8160_ 6 0.0 8160.0 /end AXIS_PTS
/begin AXIS_PTS ldp_maf__tors_1_at_er "MAF" 0x74992 maf a_742 100 LINEAR______0_000000__0H___1389_ 6 0.0 1389.0 /end AXIS_PTS
/begin AXIS_PTS ldpm_n_32_34 "N" 0x74999 n_32 a_742 100 LINEAR______0_000000__0H___8160_ 6 0.0 8160.0 /end AXIS_PTS
/begin AXIS_PTS ldp_maf__tors_1_mt_er "MAF" 0x749a0 maf a_742 100 LINEAR______0_000000__0H___1389_ 6 0.0 1389.0 /end AXIS_PTS
/begin AXIS_PTS ldpm_n_32_35 "N" 0x749a7 n_32 a_742 100 LINEAR______0_000000__0H___8160_ 6 0.0 8160.0 /end AXIS_PTS
/begin AXIS_PTS ldp_maf__tors_2_at_er "MAF" 0x749ae maf a_742 100 LINEAR______0_000000__0H___1389_ 6 0.0 1389.0 /end AXIS_PTS
/begin AXIS_PTS ldpm_n_32_36 "N" 0x749b5 n_32 a_742 100 LINEAR______0_000000__0H___8160_ 6 0.0 8160.0 /end AXIS_PTS
/begin AXIS_PTS ldp_maf__tors_2_mt_er "MAF" 0x749bc maf a_742 100 LINEAR______0_000000__0H___1389_ 6 0.0 1389.0 /end AXIS_PTS
/begin AXIS_PTS ldpm_n_32_37 "N" 0x749c3 n_32 a_742 100 LINEAR______0_000000__0H___8160_ 6 0.0 8160.0 /end AXIS_PTS
/begin AXIS_PTS ldp_maf__tors_3_at_er "MAF" 0x749ca maf a_742 100 LINEAR______0_000000__0H___1389_ 6 0.0 1389.0 /end AXIS_PTS
/begin AXIS_PTS ldpm_n_32_38 "N" 0x749d1 n_32 a_742 100 LINEAR______0_000000__0H___8160_ 6 0.0 8160.0 /end AXIS_PTS
/begin AXIS_PTS ldp_maf__tors_3_mt_er "MAF" 0x749d8 maf a_742 100 LINEAR______0_000000__0H___1389_ 6 0.0 1389.0 /end AXIS_PTS
/begin AXIS_PTS ldpm_n_32_39 "N" 0x749df n_32 a_742 100 LINEAR______0_000000__0H___8160_ 6 0.0 8160.0 /end AXIS_PTS
/begin AXIS_PTS ldp_maf__tors_4_at_er "MAF" 0x749e6 maf a_742 100 LINEAR______0_000000__0H___1389_ 6 0.0 1389.0 /end AXIS_PTS
/begin AXIS_PTS ldpm_n_32_40 "N" 0x749ed n_32 a_742 100 LINEAR______0_000000__0H___8160_ 6 0.0 8160.0 /end AXIS_PTS
/begin AXIS_PTS ldp_maf__tors_4_mt_er "MAF" 0x749f4 maf a_742 100 LINEAR______0_000000__0H___1389_ 6 0.0 1389.0 /end AXIS_PTS
/begin AXIS_PTS ldpm_n_32_41 "N" 0x749fb n_32 a_742 100 LINEAR______0_000000__0H___8160_ 6 0.0 8160.0 /end AXIS_PTS
/begin AXIS_PTS ldp_maf__tors_5_at_er "MAF" 0x74a02 maf a_742 100 LINEAR______0_000000__0H___1389_ 6 0.0 1389.0 /end AXIS_PTS
/begin AXIS_PTS ldpm_n_32_42 "N" 0x74a09 n_32 a_742 100 LINEAR______0_000000__0H___8160_ 6 0.0 8160.0 /end AXIS_PTS
/begin AXIS_PTS ldp_maf__tors_5_mt_er "MAF" 0x74a10 maf a_742 100 LINEAR______0_000000__0H___1389_ 6 0.0 1389.0 /end AXIS_PTS
/begin AXIS_PTS ldp_n__tps_max_tps_ratio_diag "N_32" 0x74a17 n_32 a_742 100 LINEAR______0_000000__0H___8160_ 4 0.0 8160.0 /end AXIS_PTS
/begin AXIS_PTS ldpm_maf_mmv_1 "MAF_MMV" 0x756b6 maf_mmv a_743 10 LINEAR______0_000000__0H___13818 4 0.0 1389.0 /end AXIS_PTS
/begin AXIS_PTS ldpm_n_24 "N" 0x756a8 n a_743 10 LINEAR______0_000000__0H___81612 6 0.0 8160.0 /end AXIS_PTS
/begin AXIS_PTS ldp_fac_amp__tps_sp_amp_cor_st "FAC_AMP" 0x74a1c fac_amp a_742 100 LINEAR______0_000000__0H___1_992 6 0.0 1.9921875 /end AXIS_PTS
/begin AXIS_PTS ldpm_pvs_3 "PVS" 0x756c0 dummy_b a_743 100 LINEAR______0_000000__0H___119_8 12 0.0 119.8828 /end AXIS_PTS
/begin AXIS_PTS ldp_pvs_av__tps_sp_st_pvs "PVS_AV" 0x756da pvs_av a_743 100 LINEAR______0_000000__0H___119_9 4 0.0 119.99817 /end AXIS_PTS
/begin AXIS_PTS ldp_t_ast__tq_ast_ofs "T_AST" 0x756e4 t_ast a_743 100 LINEAR______0_000000__0H___6553_ 4 0.0 6553.5 /end AXIS_PTS
/begin AXIS_PTS ldp_tq_accin_can__tq_loss_acc "TQI_ACCIN_CAN" 0x74a2a tq_accin_can a_742 100 LINEAR______0_000000__0H___31_00 6 0.0 31.0 /end AXIS_PTS
/begin AXIS_PTS ldp_n_32__tq_loss_acc "N_32" 0x74a23 n_32 a_742 100 LINEAR______0_000000__0H___8160_ 6 0.0 8160.0 /end AXIS_PTS
/begin AXIS_PTS ldp_tco_mon__tq_loss_mon "TCO_MON" 0x7e6bf tco_mon a_742 100 LINEAR_______48_000000__0H___176 8 -48.0 142.5 /end AXIS_PTS
/begin AXIS_PTS ldp_n_32_mon__tq_loss_mon "N" 0x7e6b6 n_32 a_742 100 LINEAR______0_000000__0H___8160_ 8 0.0 8160.0 /end AXIS_PTS
/begin AXIS_PTS ldp_tco_mon__tq_loss_mon2 "TCO_MON2" 0x7e6d1 tco_mon2 a_742 100 LINEAR_______48_000000__0H___176 8 -48.0 142.5 FUNCTION_LIST MON2 /end AXIS_PTS
/begin AXIS_PTS ldp_n_32_mon__tq_loss_mon2 "N_32_MON2" 0x7e6c8 n_32_mon2 a_742 100 LINEAR______0_000000__0H___8160_ 8 0.0 8160.0 FUNCTION_LIST MON2 /end AXIS_PTS
/begin AXIS_PTS ldp_pvs_cor_rpl__tq_max "PVS_COR_RPL" 0x756ee pvs_cor_rpl a_743 100 LINEAR______0_000000__0H___11960 8 0.0 119.9982 /end AXIS_PTS
/begin AXIS_PTS ldp_n_32__tq_max "N_32" 0x74a31 n_32 a_742 100 LINEAR______0_000000__0H___8160_ 8 0.0 8160.0 /end AXIS_PTS
/begin AXIS_PTS ldp_pvs_max_mon__tqi_max_mon "PVS_MAX_MON" 0x7e6e3 dummy_b a_742 100 LINEAR______0_000000__0H___119_5 8 0.0 119.53125 /end AXIS_PTS
/begin AXIS_PTS ldp_n_32_mon__tqi_max_mon "N_32_MON" 0x7e6da n_32_mon a_742 100 LINEAR______0_000000__0H___8160_ 8 0.0 8160.0 /end AXIS_PTS
/begin AXIS_PTS ldp_pvs_max_mon__tqi_max_mon2 "PVS_MAX_MON2" 0x7e6f5 pvs_max_mon2 a_742 100 LINEAR______0_000000__0H___119_5 8 0.0 119.53125 FUNCTION_LIST MON2 /end AXIS_PTS
/begin AXIS_PTS ldp_n_32_mon__tqi_max_mon2 "N_32_MON2" 0x7e6ec n_32_mon2 a_742 100 LINEAR______0_000000__0H___8160_ 8 0.0 8160.0 FUNCTION_LIST MON2 /end AXIS_PTS
/begin AXIS_PTS ldp_maf__tqfr "MAF" 0x75700 maf a_743 100 LINEAR______0_000000__0H___13818 4 0.0 1389.0 /end AXIS_PTS
/begin AXIS_PTS ldp_n_32__tqfr "N" 0x74a3a n_32 a_742 100 LINEAR______0_000000__0H___8160_ 8 0.0 8160.0 /end AXIS_PTS
/begin AXIS_PTS ldp_toil__tqfr "TOIL" 0x74a4c toil a_742 100 LINEAR_______48_000000__0H___155 8 -48.0 155.0 /end AXIS_PTS
/begin AXIS_PTS ldp_tco__tqfr "TCO" 0x74a43 tco a_742 100 LINEAR_______48_000000__0H___142 8 -48.0 142.5 /end AXIS_PTS
/begin AXIS_PTS ldp_tco_st__tqfr_st "TCO_ST" 0x74a55 tco_st a_742 100 LINEAR_______48_000000__0H___142 4 -48.0 142.5 /end AXIS_PTS
/begin AXIS_PTS ldp_n_32__tqi_ctl_dif_max "N" 0x74a5a n_32 a_742 100 LINEAR______0_000000__0H___8160_ 4 0.0 8160.0 /end AXIS_PTS
/begin AXIS_PTS ldpm_tqi_dif_1 "TQI_DIF" 0x7570a tqi_dif a_743 100 LINEAR_______1023_000000__0H___1 8 -1023.0 1022.9688 /end AXIS_PTS
/begin AXIS_PTS ldp_tqi_sp__tqi_dif_max_mon "TQI_SP_MON" 0x7e703 tqi_sp_mon a_742 100 LINEAR______0_000000__0H___510_0 4 0.0 510.0 /end AXIS_PTS
/begin AXIS_PTS ldp_n_32__tqi_dif_max_mon "N_32_MON" 0x7e6fe n_32_mon a_742 100 LINEAR______0_000000__0H___8160_ 4 0.0 8160.0 /end AXIS_PTS
/begin AXIS_PTS ldp_tqi_sp__tqi_dif_max_mon2 "TQI_SP_MON2" 0x74a64 tqi_sp_mon2 a_742 100 LINEAR______0_000000__0H___510_0 4 0.0 510.0 FUNCTION_LIST MON2 /end AXIS_PTS
/begin AXIS_PTS ldp_n_32__tqi_dif_max_mon2 "N_32_MON2" 0x74a5f n_32_mon2 a_742 100 LINEAR______0_000000__0H___8160_ 4 0.0 8160.0 FUNCTION_LIST MON2 /end AXIS_PTS
/begin AXIS_PTS ldpm_tqi_lim_dif_1 "TQI_LIM_DIF" 0x7571c tqi_lim_dif a_743 100 LINEAR_______1023_000000__0H___1 8 -1023.0 1022.9688 /end AXIS_PTS
/begin AXIS_PTS ldp_maf__tqi_maf "MAF" 0x74a69 maf a_742 100 LINEAR______0_000000__0H___1389_ 4 0.0 1389.0 /end AXIS_PTS
/begin AXIS_PTS ldpm_tps_av_3 "TPS_AV" 0x7572e tps_av_prj a_743 100 LINEAR______0_000000__0H___119_9 6 0.0 119.99817 /end AXIS_PTS
/begin AXIS_PTS ldpm_tps_av_1 "LDPM_TPS_AV" 0x7573c tps_av_1 a_743 100 LINEAR______0_000000__0H___119_9 6 0.0 119.99817 /end AXIS_PTS
/begin AXIS_PTS ldpm_pvs_1 "PVS" 0x74a6e dummy_b a_742 100 LINEAR______0_000000__0H___11913 12 0.0 119.5 /end AXIS_PTS
/begin AXIS_PTS ldp_maf__tqi_ref_mon "MAF" 0x7e719 maf a_742 100 LINEAR______0_000000__0H___1389_ 4 0.0 1389.0 /end AXIS_PTS
/begin AXIS_PTS ldp_n_32__tqi_ref_mon "N" 0x7e708 n_32 a_742 100 LINEAR______0_000000__0H___8160_ 16 0.0 8160.0 /end AXIS_PTS
/begin AXIS_PTS ldp_maf__tqi_ref_mon2 "MAF_MON2" 0x74a8c maf_mon2 a_742 100 LINEAR______0_000000__0H___1389_ 4 0.0 1389.0 FUNCTION_LIST MON2 /end AXIS_PTS
/begin AXIS_PTS ldp_n_32__tqi_ref_mon2 "N_32_MON2" 0x74a7b n_32_mon2 a_742 100 LINEAR______0_000000__0H___8160_ 16 0.0 8160.0 FUNCTION_LIST MON2 /end AXIS_PTS
/begin AXIS_PTS ldp_maf_kgh__vls_cat_max_cycnr "MAF_KGH" 0x7574a maf_kgh a_743 100 LINEAR______0_000000__0H___16383 8 0.0 16383.75 /end AXIS_PTS
/begin AXIS_PTS ldp_maf__vls_dif_val "MAF" 0x7575c maf a_743 10 LINEAR______0_000000__0H___13818 8 0.0 1389.0 FUNCTION_LIST CSCM /end AXIS_PTS
/begin AXIS_PTS ldpm_maf_mes_1 "MAF_MES" 0x74a9a maf_mes a_742 100 LINEAR______0_000000__0H___1389_ 6 0.0 1389.0 /end AXIS_PTS
/begin AXIS_PTS ldpm_n_32_13 "N_32" 0x74a91 n_32 a_742 100 LINEAR______0_000000__0H___8160_ 8 0.0 8160.0 /end AXIS_PTS
/begin AXIS_PTS ldpm_maf_mes_2 "MAF_MES" 0x74aaa maf_mes a_742 100 LINEAR______0_000000__0H___1389_ 6 0.0 1389.0 FUNCTION_LIST Z10I /end AXIS_PTS
/begin AXIS_PTS ldpm_n_32_55 "N" 0x74aa1 n_32 a_742 100 LINEAR______0_000000__0H___8160_ 8 0.0 8160.0 FUNCTION_LIST Z10I /end AXIS_PTS
/begin AXIS_PTS ldp_vs__wheel_grd_thd_rr "VS" 0x74ab1 vs a_742 100 LINEAR______0_000000__0H___25511 8 0.0 255.0 /end AXIS_PTS
/begin AXIS_PTS ldp_tco__t_tooth_max "TCO" 0x74ac1 tco a_742 100 LINEAR_______48_000000__0H___142 6 -48.0 142.5 /end AXIS_PTS
/begin AXIS_PTS ldp_vb__t_tooth_max "VB" 0x74aba vb a_742 100 LINEAR______0_000000__0H___26_00 6 0.0 26.0 /end AXIS_PTS
/begin AXIS_PTS ldp_fac_tqr_scc_asr_mmv__nr_pat "FAC_TQR_SCC_ASR_MMV_TOT" 0x74af0 fac_tqr_scc_asr_mmv_tot a_743 100 LINEAR______0_000000__0H___0_999 14 0.0 0.99998474 /end AXIS_PTS
/begin AXIS_PTS ldpm_cha_cdn_bat_1 "CHA_CDN_BAT" 0x741e9 cha_cdn_bat a_742 100 LINEAR______0_000000__0H___12779 6 0.0 127.5 /end AXIS_PTS
/begin AXIS_PTS ldp_tco_st__cam_sp_add_cat_pl_ex "TCO_ST" 0x74213 tco_st a_742 100 LINEAR_______48_000000__0H___142 8 -48.0 142.5 /end AXIS_PTS
/begin AXIS_PTS ldpm_tco_st_6 "TCO_ST" 0x7421c tco_st a_742 100 LINEAR_______48_000000__0H___142 8 -48.0 142.5 /end AXIS_PTS
/begin AXIS_PTS ldpm_maf_16 "MAF" 0x7422b maf a_742 100 LINEAR______0_000000__0H___1389_ 2 0.0 1389.0 /end AXIS_PTS
/begin AXIS_PTS ldpm_isapwm_2 "ISAPWM" 0x74225 isapwm a_742 100 LINEAR______0_000000__0H___99_60 5 0.0 99.609375 /end AXIS_PTS
/begin AXIS_PTS ldpm_maf_ivvt_1 "MAF_IVVT" 0x74bca maf_ivvt a_743 100 LINEAR______0_000000__0H___13818 6 0.0 1389.0 /end AXIS_PTS
/begin AXIS_PTS ldpm_n_13 "N" 0x74bbc n a_743 100 LINEAR______0_000000__0H___81612 6 0.0 8160.0 /end AXIS_PTS
/begin AXIS_PTS ldpm_maf_ivvt_2 "LM_VANOS" 0x74bd8 maf_ivvt a_743 100 LINEAR______0_000000__0H___13818 12 0.0 1389.0 /end AXIS_PTS
/begin AXIS_PTS ldpm_maf_int_puc_temp_sub_1 "MAF_INT_PUC_TEMP_SUB" 0x74bfe maf_int_puc_temp_sub a_743 10 LINEAR______0_000000__0H___36400 8 0.0 36400.0 FUNCTION_LIST ETM /end AXIS_PTS
/begin AXIS_PTS ldp_maf_sub_diag__crlc_maf_ivvt "MAF_SUB_DIAG" 0x74289 dummy_b a_742 100 LINEAR______0_000000__0H___1389_ 6 0.0 1389.0 /end AXIS_PTS
/begin AXIS_PTS ldp_n_32__crlc_maf_ivvt "N" 0x74282 n a_742 100 LINEAR______0_000000__0H___8160_ 6 0.0 8160.0 /end AXIS_PTS
/begin AXIS_PTS ldp_temp_mmv_sub_ex_up_i "TEMP_MMV_SUB_EX_UP_I" 0x74c86 dummy_w a_743 100 LINEAR_______33_000000__0H___989 8 -33.0 989.9844 FUNCTION_LIST ETM /end AXIS_PTS
/begin AXIS_PTS ldp_n__fac_isapwm_cor "N" 0x74d8c n a_743 100 LINEAR______0_000000__0H___81612 4 0.0 8160.0 /end AXIS_PTS
/begin AXIS_PTS ldp_pvs_cor_rpl__fac_isapwm_cor "PVS_COR_RPL" 0x74d7a pvs_cor_rpl a_743 100 LINEAR______0_000000__0H___119_8 8 0.0 119.8828 /end AXIS_PTS
/begin AXIS_PTS ldp_maf_sub_diag__fac_maf_ivvt "MAF_SUB_DIAG" 0x74397 maf_sub_diag a_742 100 LINEAR______0_000000__0H___1389_ 6 0.0 1389.0 /end AXIS_PTS
/begin AXIS_PTS ldp_vs_dif_cru "VS_DIF_CRU" 0x74e3e vs_dif_cru a_743 100 LINEAR_______256_000000__0H___25 4 -256.0 255.99218 /end AXIS_PTS
/begin AXIS_PTS ldp_cycnr_st__iga_lgrd_fac_st "CYCNR_ST" 0x744bc cycnr_st a_742 100 LINEAR______0_000000__0H___25580 6 0.0 255.0 /end AXIS_PTS
/begin AXIS_PTS ldp_tco__iga_lgrd_fac_st "TCO" 0x744b7 tco a_742 100 LINEAR_______48_000000__0H___142 4 -48.0 142.5 /end AXIS_PTS
/begin AXIS_PTS ldp_pvs_av__isapwm_add_at "PVS_AV" 0x7502a pvs_av a_743 100 LINEAR______0_000000__0H___119_9 6 0.0 119.99817 /end AXIS_PTS
/begin AXIS_PTS ldp_tq_conv_can__isapwm_add_at "TQ_CONV_CAN" 0x7454e tq_conv_can a_742 100 LINEAR______0_000000__0H___99_60 6 0.0 99.609375 /end AXIS_PTS
/begin AXIS_PTS ldp_toil__isapwm_add_pste "TOIL" 0x74555 toil a_742 100 LINEAR_______48_000000__0H___155 4 -48.0 155.0 /end AXIS_PTS
/begin AXIS_PTS ldp_ang_pste__isapwm_add_pste "ANG_PSTE" 0x75038 ang_pste a_743 100 LINEAR_______1439_956055__0H___1 6 -1439.9561 1439.9121 /end AXIS_PTS
/begin AXIS_PTS ldpm_n_dif_ch_2_1 "NDIF_CH_2" 0x75054 n_dif_ch_2 a_743 100 LINEAR______0_000000__0H___81605 6 0.0 8160.0 /end AXIS_PTS
/begin AXIS_PTS ldp_n_dif_spi__isapwm_n_sp_add_s "N_DIF_SIF" 0x7458e n_sp_is_sif a_742 100 LINEAR_______256_000000__0H___81 6 -256.0 254.0 /end AXIS_PTS
/begin AXIS_PTS ldpm_n_grd_1 "N_GRD" 0x745a7 n_grd a_742 100 LINEAR_______4096_000000__0H___4 4 -4096.0 4064.0 FUNCTION_LIST Z10I /end AXIS_PTS
/begin AXIS_PTS ldpm_n_dif_1 "N_DIF" 0x750d8 n_dif a_743 100 LINEAR_______32768_000000__0H___ 4 -32768.0 32767.0 FUNCTION_LIST Z10I /end AXIS_PTS
/begin AXIS_PTS ldp_pvs_av__pvs_fac_shift_ssg "PVS_AV" 0x75376 pvs_av a_743 10 LINEAR______0_000000__0H___119_9 4 0.0 119.99817 FUNCTION_LIST Z1S1 /end AXIS_PTS
/begin AXIS_PTS ldp_vs_fil__pvs_fac_shift_ssg "VS_FIL" 0x7536c vs_fil a_743 100 LINEAR______0_000000__0H___51151 4 0.0 511.99218 FUNCTION_LIST Z1S1 /end AXIS_PTS
/begin AXIS_PTS ldpm_toil_4 "TOIL" 0x747c8 toil a_742 100 LINEAR_______48_000000__0H___155 3 -48.0 155.0 /end AXIS_PTS
/begin AXIS_PTS ldpm_n_32_50 "N" 0x747c4 n_32 a_742 100 LINEAR______0_000000__0H___8160_ 3 0.0 8160.0 /end AXIS_PTS
/begin AXIS_PTS ldpm_maf_mmv_2 "MAF_MMV" 0x754e4 maf_mmv a_743 10 LINEAR______0_000000__0H___13818 4 0.0 1389.0 /end AXIS_PTS
/begin AXIS_PTS ldpm_n_25 "N" 0x754d6 n a_743 10 LINEAR______0_000000__0H___81612 6 0.0 8160.0 /end AXIS_PTS
/begin AXIS_PTS ldp_ecfpwm_ecf__temp_ecf_up_1 "ecfpwm_ecf" 0x747d8 ecfpwm_ecf a_742 100 LINEAR______0_000000__0H___99_60 6 0.0 99.609375 FUNCTION_LIST ETM /end AXIS_PTS
/begin AXIS_PTS ldp_ecfpwm_ecf__temp_ecf_up_2 "ecfpwm_ecf" 0x747df ecfpwm_ecf a_742 100 LINEAR______0_000000__0H___99_60 6 0.0 99.609375 FUNCTION_LIST ETM /end AXIS_PTS
/begin AXIS_PTS ldpm_fac_ti_dif_i_1 "FAC_TI_DIF_I" 0x747fd dummy_b a_742 10 LINEAR_______0_500000__0H___0_49 12 -0.5 0.49599999 FUNCTION_LIST ETM /end AXIS_PTS
/begin AXIS_PTS ldp_iga_dif__tmpsubcatmincopron "IGA_DIF" 0x74816 dummy_b a_742 20 LINEAR______0_000000__0H___95_22 4 0.0 95.625 /end AXIS_PTS
/begin AXIS_PTS ldpm_maf_mmv_3 "MAF_MMV" 0x7569e maf_mmv a_743 10 LINEAR______0_000000__0H___13818 4 0.0 1389.0 /end AXIS_PTS
/begin AXIS_PTS ldpm_n_26 "N" 0x75690 n a_743 10 LINEAR______0_000000__0H___81612 6 0.0 8160.0 /end AXIS_PTS
/begin AXIS_PTS ldp_fac_amp__isapwm_sp_amp_cor_s "FAC_AMP" 0x745b1 fac_amp a_742 100 LINEAR______0_000000__0H___1_992 6 0.0 1.9921875 /end AXIS_PTS
/begin AXIS_PTS ldp_n_sp_dif_bat__isapwm_cha_cdn "N_SP_DIF_BAT" 0x75062 n_sp_dif_bat a_743 100 LINEAR______0_000000__0H___81605 4 0.0 8160.0 /end AXIS_PTS
/begin AXIS_PTS ldp_n_sp_dif_bat__isapwm_dri_cha "N_SP_DIF_BAT" 0x7507e n_sp_dif_bat a_743 100 LINEAR______0_000000__0H___81605 4 0.0 8160.0 /end AXIS_PTS
/begin AXIS_PTS ldp_n__fac_isapwm_accin_cor "N" 0x74d70 n a_743 100 LINEAR______0_000000__0H___81612 4 0.0 8160.0 /end AXIS_PTS
/begin AXIS_PTS ldp_pvs_cor_rpl__fac_isapwm_acci "PVS_COR_RPL" 0x74d66 pvs_cor_rpl a_743 100 LINEAR______0_000000__0H___119_8 4 0.0 119.8828 /end AXIS_PTS
/begin AXIS_PTS ldp_temp_mmv_sub_wall_down_1__eg "TEMP_MMV_SUB_WALL_DOWN_1" 0x74cca dummy_w a_743 100 LINEAR_______33_000000__0H___989 8 -33.0 989.9844 FUNCTION_LIST DPM /end AXIS_PTS
/begin AXIS_PTS ldpm_tco_st_9 "TCO_ST" 0x742f1 tco_st a_742 100 LINEAR_______48_000000__0H___142 8 -48.0 142.5 /end AXIS_PTS
/begin AXIS_PTS ldp_temp_mmv_sub_wall_up_1__egy_ "TEMP_MMV_SUB_WALL_UP_1" 0x74cdc dummy_w a_743 100 LINEAR_______33_000000__0H___989 8 -33.0 989.9844 FUNCTION_LIST DPM /end AXIS_PTS
/begin AXIS_PTS ldp_pvs_av__isapwm_add_tq_conv "PVS_AV" 0x75046 pvs_av a_743 100 LINEAR______0_000000__0H___119_9 6 0.0 119.99817 /end AXIS_PTS
/begin AXIS_PTS ldp_tq_conv_can__isapwm_add_tqco "TQ_CONV_CAN" 0x7455a tq_conv_can a_742 100 LINEAR______0_000000__0H___99_60 6 0.0 99.609375 /end AXIS_PTS
/begin AXIS_PTS ldp_vls_cat_o2_sum__o2_cat_int_m "VLS_CAT_O2_SUM" 0x75270 dummy_b a_743 10 LINEAR______0_000000__0H___42949 6 0.0 4.2949673e+009 /end AXIS_PTS
/begin AXIS_PTS ldp_vls_cyc_ratio_mv_1__fac_frq_ "LDP_VLS_CYC_RATIO_MV_1" 0x74d1c vls_cyc_ratio_mv_1 a_743 10 LINEAR______0_000000__0H___1_284 6 0.0 1.275 /end AXIS_PTS
/begin AXIS_PTS ldp_vls_cyc_ratio_mv_2__fac_frq_ "LDP_VLS_CYC_RATIO_MV_2" 0x74d2a vls_cyc_ratio_mv_2 a_743 10 LINEAR______0_000000__0H___1_284 6 0.0 1.275 /end AXIS_PTS
/begin AXIS_PTS ldpm_cur_dmtl_dif_ref_rough_leak "CUR_DMTL_DIF_REF_ROUGH_LEAK" 0x74d0a cur_dmtl_dif_ref_rough_leak a_743 100 LINEAR______0_000000__0H___400_0 8 0.0 400.0 /end AXIS_PTS
/begin AXIS_PTS ldp_ftl__t_cur_dmtl_stat "FTL" 0x74787 ftl a_742 100 LINEAR______0_000000__0H___126_0 8 0.0 126.0 FUNCTION_LIST DMTL /end AXIS_PTS
/begin COMPU_METHOD LINEAR______0_000000__0H___255_0 "" FORM "%3.0" "-" FORMULA "1.0*X" FORMULA_INV "1.0*X" /end COMPU_METHOD
/begin COMPU_METHOD LINEAR______0_000000__0H___8160_ "" FORM "%4.0" "rpm" FORMULA "32.0*X" FORMULA_INV "0.03125*X" /end COMPU_METHOD
/begin COMPU_METHOD LINEAR______0_000000__0H___65535 "" FORM "%5.0" "-" FORMULA "1.0*X" FORMULA_INV "1.0*X" /end COMPU_METHOD
/begin COMPU_METHOD LINEAR______0_000000__0H___0_996 "" FORM "%5.3" "-" FORMULA "0.00390625*X" FORMULA_INV "256.0*X" /end COMPU_METHOD
/begin COMPU_METHOD LINEAR______0_000000__0H___1_000 "" FORM "%2.0" "-" FORMULA "1.0*X" FORMULA_INV "1.0*X" /end COMPU_METHOD
/begin COMPU_METHOD LINEAR_______48_000000__0H___155 "" FORM "%5.1" "°C" FORMULA "0.79607843*X-48.0" FORMULA_INV "1.2561576*X+60.295567" /end COMPU_METHOD
/begin COMPU_METHOD LINEAR______0_000000__0H___81605 "" FORM "%4.0" "rpm" FORMULA "0.25*X" FORMULA_INV "4.0*X" /end COMPU_METHOD
/begin COMPU_METHOD LINEAR______0_000000__0H___26_00 "" FORM "%4.1" "V" FORMULA "0.10196078*X" FORMULA_INV "9.8076923*X" /end COMPU_METHOD
/begin COMPU_METHOD LINEAR______0_000000__0H___99_60 "" FORM "%4.1" "%" FORMULA "0.390625*X" FORMULA_INV "2.56*X" /end COMPU_METHOD
/begin COMPU_METHOD LINEAR_______33_000000__0H___987 "" FORM "%3.0" "°C" FORMULA "4.0*X-33.0" FORMULA_INV "0.25*X+8.25" /end COMPU_METHOD
/begin COMPU_METHOD LINEAR_______48_000000__0H___142 "" FORM "%5.1" "°C" FORMULA "0.75*X-48.0" FORMULA_INV "1.3333333*X+64.0" /end COMPU_METHOD
/begin COMPU_METHOD LINEAR______0_000000__0H___65534 "" FORM "%6.0" "km" FORMULA "10.0*X" FORMULA_INV "0.1*X" /end COMPU_METHOD
/begin COMPU_METHOD LINEAR______0_000000__0H___1_992 "" FORM "%5.3" "-" FORMULA "0.0078125*X" FORMULA_INV "128.0*X" /end COMPU_METHOD
/begin COMPU_METHOD LINEAR_______48_000000__0H___47_ "" FORM "%6.2" "°CRK" FORMULA "0.375*X-48.0" FORMULA_INV "2.6666667*X+128.0" /end COMPU_METHOD
/begin COMPU_METHOD LINEAR______0_001465__1H___47_99 "" FORM "%6.3" "°CRK/seg" FORMULA "0.0014648439*X+1.5610694e-007" FORMULA_INV "682.6666*X-0.00010656899" /end COMPU_METHOD
/begin COMPU_METHOD LINEAR______0_000000__0H___399_9 "" FORM "%7.3" "%" FORMULA "0.0061035142*X" FORMULA_INV "163.84004*X" /end COMPU_METHOD
/begin COMPU_METHOD LINEAR______0_000000__0H___1389_ "" FORM "%4.0" "mg/stk" FORMULA "5.4470588*X" FORMULA_INV "0.18358531*X" /end COMPU_METHOD
/begin COMPU_METHOD LINEAR______0_000000__0H___2_000 "" FORM "%2.0" "-" FORMULA "1.0*X" FORMULA_INV "1.0*X" /end COMPU_METHOD
/begin COMPU_METHOD LINEAR______0_000000__0H___25511 "" FORM "%3.0" "km/h" FORMULA "1.0*X" FORMULA_INV "1.0*X" /end COMPU_METHOD
/begin COMPU_METHOD LINEAR______1_000000__1H___255_0 "" FORM "%3.0" "-" FORMULA "1.0*X" FORMULA_INV "1.0*X" /end COMPU_METHOD
/begin COMPU_METHOD LINEAR______0_000000__0H___81612 "" FORM "%4.0" "rpm" FORMULA "1.0*X" FORMULA_INV "1.0*X" /end COMPU_METHOD
/begin COMPU_METHOD LINEAR______0_000000__0H___13_00 "" FORM "%2.0" "-" FORMULA "1.0*X" FORMULA_INV "1.0*X" /end COMPU_METHOD
/begin COMPU_METHOD LINEAR______0_000000__0H___119_5 "" FORM "%5.1" "°PVS" FORMULA "0.46875*X" FORMULA_INV "2.1333333*X" /end COMPU_METHOD
/begin COMPU_METHOD LINEAR______0_000000__0H___11913 "" FORM "%5.1" "°TPS" FORMULA "0.46862745*X" FORMULA_INV "2.1338912*X" /end COMPU_METHOD
/begin COMPU_METHOD LINEAR______0_000000__0H___6553_ "" FORM "%6.1" "s" FORMULA "0.1*X" FORMULA_INV "10.0*X" /end COMPU_METHOD
/begin COMPU_METHOD LINEAR______0_000000__0H___349_5 "" FORM "%7.3" "ms" FORMULA "0.0053333333*X" FORMULA_INV "187.5*X" /end COMPU_METHOD
/begin COMPU_METHOD LINEAR______0_000000__0H___25514 "" FORM "%3.0" "s" FORMULA "1.0*X" FORMULA_INV "1.0*X" /end COMPU_METHOD
/begin COMPU_METHOD LINEAR______0_100000__1H___6553_ "" FORM "%6.1" "0.1s" FORMULA "0.1*X+1.3877788e-017" FORMULA_INV "10.0*X-1.3877788e-016" /end COMPU_METHOD
/begin COMPU_METHOD LINEAR______0_100000__1H___25_50 "" FORM "%4.1" "s" FORMULA "0.1*X+1.3877788e-017" FORMULA_INV "10.0*X-1.3877788e-016" /end COMPU_METHOD
/begin COMPU_METHOD LINEAR______0_000000__0H___510_0 "" FORM "%3.0" "Nm" FORMULA "2.0*X" FORMULA_INV "0.5*X" /end COMPU_METHOD
/begin COMPU_METHOD LINEAR______0_000000__0H___13818 "" FORM "%5.1" "mg/stk" FORMULA "0.021194781*X" FORMULA_INV "47.181425*X" /end COMPU_METHOD
/begin COMPU_METHOD LINEAR______0_000000__0H___16383 "" FORM "%8.2" "kg/h" FORMULA "0.25*X" FORMULA_INV "4.0*X" /end COMPU_METHOD
/begin COMPU_METHOD LINEAR______0_000000__0H___51119 "" FORM "%6.2" "m/s^2" FORMULA "0.021701378*X" FORMULA_INV "46.080024*X" /end COMPU_METHOD
/begin COMPU_METHOD LINEAR______0_010000__1H___655_3 "" FORM "%6.2" "s" FORMULA "0.0099999996*X+3.7247841e-010" FORMULA_INV "100.0*X-3.7247842e-008" /end COMPU_METHOD
/begin COMPU_METHOD LINEAR______0_000000__0H___95_22 "" FORM "%5.2" "°CRK" FORMULA "0.375*X" FORMULA_INV "2.6666667*X" /end COMPU_METHOD
/begin COMPU_METHOD LINEAR______0_000000__0H___31_00 "" FORM "%3.0" "Nm" FORMULA "1.0*X" FORMULA_INV "1.0*X" /end COMPU_METHOD
/begin COMPU_METHOD LINEAR______0_000000__0H___5434_ "" FORM "%7.2" "hPa" FORMULA "0.082921489*X" FORMULA_INV "12.0596*X" /end COMPU_METHOD
/begin COMPU_METHOD LINEAR_______155_625000__FFH____ "" FORM "%6.1" "°CRK" FORMULA "-0.375*X-60.0" FORMULA_INV "-2.6666667*X-160.0" /end COMPU_METHOD
/begin COMPU_METHOD LINEAR______60_000000__0H___155_ "" FORM "%6.2" "°CRK" FORMULA "0.375*X+60.0" FORMULA_INV "2.6666667*X-160.0" /end COMPU_METHOD
/begin COMPU_METHOD LINEAR______0_000000__0H___99_97 "" FORM "%5.2" "%" FORMULA "0.024414063*X" FORMULA_INV "40.959998*X" /end COMPU_METHOD
/begin COMPU_METHOD LINEAR______0_000000__0H___800_0 "" FORM "%6.2" "%" FORMULA "0.024414063*X" FORMULA_INV "40.96*X" /end COMPU_METHOD
/begin COMPU_METHOD LINEAR______0_000000__0H___0_999 "" FORM "%7.5" "-" FORMULA "1.5258789e-005*X" FORMULA_INV "65536.0*X" /end COMPU_METHOD
/begin COMPU_METHOD LINEAR______0_000000__0H___1_027 "" FORM "%7.5" "-" FORMULA "1.5259022e-005*X" FORMULA_INV "65535.0*X" /end COMPU_METHOD
/begin COMPU_METHOD LINEAR______0_000000__0H___7_968 "" FORM "%5.3" "-" FORMULA "0.03125*X" FORMULA_INV "32.0*X" /end COMPU_METHOD
/begin COMPU_METHOD LINEAR_______203_000000__0H___20 "" FORM "%5.1" "°C" FORMULA "0.79607843*X-203.0" FORMULA_INV "1.2561576*X+255.0" /end COMPU_METHOD
/begin COMPU_METHOD LINEAR_______33_000000__0H___989 "" FORM "%6.2" "°C" FORMULA "0.015609741*X-33.0" FORMULA_INV "64.06256*X+2114.0645" /end COMPU_METHOD
/begin COMPU_METHOD LINEAR______0_000000__0H___2550_ "" FORM "%4.0" "ms" FORMULA "10.0*X" FORMULA_INV "0.1*X" /end COMPU_METHOD
/begin COMPU_METHOD LINEAR______0_000000__0H___2559_ "" FORM "%7.2" "-" FORMULA "0.0390625*X" FORMULA_INV "25.6*X" /end COMPU_METHOD
/begin COMPU_METHOD LINEAR_______32768_000000__0H___ "" FORM "%6.0" "rpm" FORMULA "1.0*X-32768.0" FORMULA_INV "1.0*X+32768.0" /end COMPU_METHOD
/begin COMPU_METHOD LINEAR_______256_000000__0H___25 "" FORM "%7.3" "km/h" FORMULA "0.0078124999*X-256.0" FORMULA_INV "128.0*X+32768.0" /end COMPU_METHOD
/begin COMPU_METHOD LINEAR______0_000000__0H___99_99 "" FORM "%6.3" "%" FORMULA "0.0015258789*X" FORMULA_INV "655.36*X" /end COMPU_METHOD
/begin COMPU_METHOD LINEAR______0_000000__0H___119_8 "" FORM "%7.3" "°TPS" FORMULA "0.0018310545*X" FORMULA_INV "546.13339*X" /end COMPU_METHOD
/begin COMPU_METHOD LINEAR_______50_000000__0H___440 "" FORM "%7.3" "%" FORMULA "0.0015258789*X-50.0" FORMULA_INV "655.36002*X+32768.001" /end COMPU_METHOD
/begin COMPU_METHOD LINEAR_______48_000000__0H___041 "" FORM "%5.1" "°CRK" FORMULA "0.375*X-48.0" FORMULA_INV "2.6666667*X+128.0" /end COMPU_METHOD
/begin COMPU_METHOD LINEAR______0_000000__0H___119_9 "" FORM "%7.3" "°TPS" FORMULA "0.0018310547*X" FORMULA_INV "546.13333*X" /end COMPU_METHOD
/begin COMPU_METHOD LINEAR______0_000000__0H___1023_ "" FORM "%4.0" "Nm" FORMULA "1.0*X" FORMULA_INV "1.0*X" /end COMPU_METHOD
/begin COMPU_METHOD LINEAR_______1439_956055__0H___1 "" FORM "%8.1" "°pste" FORMULA "0.043943971*X-1439.9561" FORMULA_INV "22.75625*X+32768.0" /end COMPU_METHOD
/begin COMPU_METHOD LINEAR_______4096_000000__0H___4 "" FORM "%5.0" "rpm/s" FORMULA "32.0*X-4096.0" FORMULA_INV "0.03125*X+128.0" /end COMPU_METHOD
/begin COMPU_METHOD LINEAR______0_000000__0H___120_0 "" FORM "%5.1" "°CRK" FORMULA "0.375*X" FORMULA_INV "2.6666667*X" /end COMPU_METHOD
/begin COMPU_METHOD LINEAR______0_000000__0H___51151 "" FORM "%7.3" "km/h" FORMULA "0.0078124999*X" FORMULA_INV "128.0*X" /end COMPU_METHOD
/begin COMPU_METHOD LINEAR______0_000000__0H___10253 "" FORM "%7.2" "°C" FORMULA "0.015625*X" FORMULA_INV "64.0*X" /end COMPU_METHOD
/begin COMPU_METHOD LINEAR______0_000000__0H___36400 "" FORM "%7.1" "g" FORMULA "0.5554284*X" FORMULA_INV "1.8004121*X" /end COMPU_METHOD
/begin COMPU_METHOD LINEAR______0_000000__0H___10059 "" FORM "%7.2" "rpm" FORMULA "0.03125*X" FORMULA_INV "32.0*X" /end COMPU_METHOD
/begin COMPU_METHOD LINEAR______0_000000__0H___1_275 "" FORM "%5.3" "V" FORMULA "0.005*X" FORMULA_INV "200.0*X" /end COMPU_METHOD
/begin COMPU_METHOD LINEAR______0_000000__0H___11960 "" FORM "%7.3" "°PVS" FORMULA "0.0018310552*X" FORMULA_INV "546.13319*X" /end COMPU_METHOD
/begin COMPU_METHOD LINEAR______0_000000__0H___159_3 "" FORM "%5.1" "ms" FORMULA "0.625*X" FORMULA_INV "1.6*X" /end COMPU_METHOD
/begin COMPU_METHOD LINEAR______0_000000__0H___48_00 "" FORM "%5.2" "°CRK" FORMULA "0.375*X" FORMULA_INV "2.6666667*X" /end COMPU_METHOD
/begin COMPU_METHOD LINEAR______0_000000__0H___126_0 "" FORM "%3.0" "L" FORMULA "1.0*X" FORMULA_INV "1.0*X" /end COMPU_METHOD
/begin COMPU_METHOD LINEAR______0_000000__0H___51068 "" FORM "%4.0" "ms" FORMULA "20.0*X" FORMULA_INV "0.05*X" /end COMPU_METHOD
/begin COMPU_METHOD LINEAR_______1023_984375__FFFFH_ "" FORM "%8.2" "°C" FORMULA "-0.015625005*X" FORMULA_INV "-63.999977*X" /end COMPU_METHOD
/begin COMPU_METHOD LINEAR______0_000000__0H___10269 "" FORM "%7.2" "kg/h" FORMULA "0.015625*X" FORMULA_INV "64.0*X" /end COMPU_METHOD
/begin COMPU_METHOD LINEAR______0_500000__80H___0_99 "" FORM "%5.3" "-" FORMULA "0.0039062993*X-6.3092913e-006" FORMULA_INV "255.99677*X+0.0016151582" /end COMPU_METHOD
/begin COMPU_METHOD LINEAR_______0_500000__0H___0_49 "" FORM "%5.3" "-" FORMULA "0.0039058823*X-0.5" FORMULA_INV "256.0241*X+128.01205" /end COMPU_METHOD
/begin COMPU_METHOD LINEAR______0_000000__0H___127_5 "" FORM "%5.1" "s" FORMULA "0.5*X" FORMULA_INV "2.0*X" /end COMPU_METHOD
/begin COMPU_METHOD LINEAR______0_500000__40H___1_50 "" FORM "%5.3" "-" FORMULA "0.0078125*X" FORMULA_INV "128.0*X" /end COMPU_METHOD
/begin COMPU_METHOD LINEAR______0_039000__2H___4_986 "" FORM "%5.3" "V" FORMULA "0.01955336*X-0.00010671937" FORMULA_INV "51.142106*X+0.0054578532" /end COMPU_METHOD
/begin COMPU_METHOD LINEAR______0_000000__0H___5_074 "" FORM "%4.2" "V" FORMULA "0.019607843*X" FORMULA_INV "51.0*X" /end COMPU_METHOD
/begin COMPU_METHOD LINEAR______0_000000__0H___1_996 "" FORM "%5.3" "-" FORMULA "0.0039062622*X" FORMULA_INV "255.9992*X" /end COMPU_METHOD
/begin COMPU_METHOD LINEAR_______21844_000000__1H___ "" FORM "%7.1" "us" FORMULA "0.66664632*X-21844.667" FORMULA_INV "1.5000458*X+32768.0" /end COMPU_METHOD
/begin COMPU_METHOD LINEAR______0_000000__0H___11975 "" FORM "%7.3" "°TPS" FORMULA "0.0072941464*X" FORMULA_INV "137.09623*X" /end COMPU_METHOD
/begin COMPU_METHOD LINEAR_______60_000000__0H___59_ "" FORM "%6.3" "%" FORMULA "0.0018310547*X-60.0" FORMULA_INV "546.13333*X+32768.0" /end COMPU_METHOD
/begin COMPU_METHOD LINEAR______0_000000__0H___1022_ "" FORM "%7.2" "Nm" FORMULA "0.031219482*X" FORMULA_INV "32.031281*X" /end COMPU_METHOD
/begin COMPU_METHOD LINEAR_______48_000000__0H___176 "" FORM "%4.0" "°C" FORMULA "0.75*X-48.0" FORMULA_INV "1.3333333*X+64.0" /end COMPU_METHOD
/begin COMPU_METHOD LINEAR_______1023_000000__0H___1 "" FORM "%8.2" "Nm" FORMULA "0.031219482*X-1023.0" FORMULA_INV "32.031281*X+32768.0" /end COMPU_METHOD
/begin COMPU_METHOD LINEAR______0_000000__0H___1_077 "" FORM "%5.3" "-" FORMULA "0.0039215686*X" FORMULA_INV "255.0*X" /end COMPU_METHOD
/begin COMPU_METHOD LINEAR______1_000000__1H___20_33 "" FORM "%6.3" "dm^3" FORMULA "0.0093476789*X+0.99065232" FORMULA_INV "106.97843*X-105.97843" /end COMPU_METHOD
/begin COMPU_METHOD LINEAR______0_000000__0H___25578 "" FORM "%6.2" "%" FORMULA "0.015203911*X" FORMULA_INV "65.772549*X" /end COMPU_METHOD
/begin COMPU_METHOD LINEAR______0_000000__0H___12779 "" FORM "%5.1" "Ah" FORMULA "0.5*X" FORMULA_INV "2.0*X" /end COMPU_METHOD
/begin COMPU_METHOD LINEAR______47_625000__1H____47_ "" FORM "%6.2" "°CRK" FORMULA "-0.375*X+48.0" FORMULA_INV "-2.6666667*X+128.0" /end COMPU_METHOD
/begin COMPU_METHOD LINEAR_______47_625000__1H___47_ "" FORM "%6.2" "°CRK" FORMULA "0.375*X-48.0" FORMULA_INV "2.6666667*X+128.0" /end COMPU_METHOD
/begin COMPU_METHOD LINEAR______0_014648__1H___959_9 "" FORM "%6.2" "-" FORMULA "0.014646433*X+1.5668203e-006" FORMULA_INV "68.276009*X-0.00010697623" /end COMPU_METHOD
/begin COMPU_METHOD LINEAR______0_000000__0H___25580 "" FORM "%3.0" "seg" FORMULA "1.0*X" FORMULA_INV "1.0*X" /end COMPU_METHOD
/begin COMPU_METHOD LINEAR_______25_000000__0H___24_ "" FORM "%5.2" "%" FORMULA "0.1953125*X-25.0" FORMULA_INV "5.1199999*X+128.0" /end COMPU_METHOD
/begin COMPU_METHOD LINEAR_______256_000000__0H___81 "" FORM "%4.0" "rpm" FORMULA "2.0*X-256.0" FORMULA_INV "0.5*X+128.0" /end COMPU_METHOD
/begin COMPU_METHOD LINEAR______0_625000__1H___159_3 "" FORM "%5.1" "ms" FORMULA "0.625*X" FORMULA_INV "1.6*X" /end COMPU_METHOD
/begin COMPU_METHOD LINEAR______0_000000__0H___65582 "" FORM "%7.3" "s" FORMULA "0.01*X" FORMULA_INV "100.0*X" /end COMPU_METHOD
/begin COMPU_METHOD LINEAR_______1024_000000__0H__83 "" FORM "%8.2" "°C" FORMULA "0.03125*X-1024.0" FORMULA_INV "32.0*X+32768.0" /end COMPU_METHOD
/begin COMPU_METHOD LINEAR______0_000000__0H___7456_ "" FORM "%8.3" "kJ" FORMULA "0.11377777*X" FORMULA_INV "8.7890633*X" /end COMPU_METHOD
/begin COMPU_METHOD LINEAR______0_000000__0H___42949 "" FORM "%10.0" "-" FORMULA "65537.0*X" FORMULA_INV "1.5258556e-005*X" /end COMPU_METHOD
/begin COMPU_METHOD LINEAR______0_000000__0H___1_284 "" FORM "%7.5" "V" FORMULA "1.9455253e-005*X" FORMULA_INV "51400.0*X" /end COMPU_METHOD
/begin COMPU_METHOD LINEAR______0_000000__0H___400_0 "" FORM "%7.3" "mA" FORMULA "0.0061036088*X" FORMULA_INV "163.8375*X" /end COMPU_METHOD
/begin COMPU_METHOD LINEAR______0_000000__0H___200_0 "" FORM "%4.1" "200rev" FORMULA "0.33333333*X" FORMULA_INV "3.0*X" /end COMPU_METHOD
/begin COMPU_METHOD LINEAR______1_000000__1H___127_0 "" FORM "%3.0" "-" FORMULA "1.0*X" FORMULA_INV "1.0*X" /end COMPU_METHOD
/begin COMPU_METHOD LINEAR_______128_000000__FFFFFF8 "" FORM "%4.0" "-" FORMULA "1.0*X" FORMULA_INV "1.0*X" /end COMPU_METHOD
/begin COMPU_METHOD LINEAR______0_000000__0H___1777_ "" FORM "%7.2" "m/s^2" FORMULA "0.054253471*X" FORMULA_INV "18.432*X" /end COMPU_METHOD
/begin COMPU_METHOD LINEAR_______6_944444__FFFFFF80H "" FORM "%6.2" "m/s^2" FORMULA "0.054253469*X" FORMULA_INV "18.432001*X" /end COMPU_METHOD
/begin COMPU_METHOD LINEAR______0_000000__0H___99_88 "" FORM "%4.1" "%pwm" FORMULA "0.390625*X" FORMULA_INV "2.56*X" /end COMPU_METHOD
/begin COMPU_METHOD LINEAR______0_000000__0H___2_720 "" FORM "%5.3" "ms" FORMULA "0.010666667*X" FORMULA_INV "93.75*X" /end COMPU_METHOD
/begin COMPU_METHOD LINEAR______0_010000__1H___10_00 "" FORM "%5.2" "s" FORMULA "0.01*X" FORMULA_INV "100.0*X" /end COMPU_METHOD
/begin COMPU_METHOD LINEAR______0_000000__0H___11989 "" FORM "%5.1" "°TPS" FORMULA "0.0072941464*X" FORMULA_INV "137.09623*X" /end COMPU_METHOD
/begin COMPU_METHOD LINEAR______0_015625__1H___3_984 "" FORM "%4.2" "-" FORMULA "0.015625*X" FORMULA_INV "64.0*X" /end COMPU_METHOD
/begin COMPU_METHOD LINEAR______0_000000__0H___1_360 "" FORM "%5.3" "ms" FORMULA "0.0053333333*X" FORMULA_INV "187.5*X" /end COMPU_METHOD
/begin COMPU_METHOD LINEAR______0_000000__0H___95_90 "" FORM "%5.2" "°CRK/rev" FORMULA "0.375*X" FORMULA_INV "2.6666667*X" /end COMPU_METHOD
/begin COMPU_METHOD LINEAR______0_000000__0H___47_62 "" FORM "%5.2" "°CRK" FORMULA "0.375*X" FORMULA_INV "2.6666667*X" /end COMPU_METHOD
/begin COMPU_METHOD LINEAR______175_000000__0H___270 "" FORM "%5.1" "°CRK" FORMULA "0.375*X+175.0" FORMULA_INV "2.6666667*X-466.66667" /end COMPU_METHOD
/begin COMPU_METHOD LINEAR______0_000000__0H___255_9 "" FORM "%7.3" "-" FORMULA "0.0039062501*X" FORMULA_INV "255.99999*X" /end COMPU_METHOD
/begin COMPU_METHOD LINEAR______0_000000__0H___63_91 "" FORM "%4.1" "°C" FORMULA "0.25*X" FORMULA_INV "4.0*X" /end COMPU_METHOD
/begin COMPU_METHOD LINEAR______0_000000__0H___63_99 "" FORM "%7.4" "°C*kJ/s" FORMULA "0.0009765625*X" FORMULA_INV "1024.0*X" /end COMPU_METHOD
/begin COMPU_METHOD LINEAR______0_000000__0H___4_000 "" FORM "%2.0" "-" FORMULA "1.0*X" FORMULA_INV "1.0*X" /end COMPU_METHOD
/begin COMPU_METHOD LINEAR______0_000000__0H___3_000 "" FORM "%2.0" "-" FORMULA "1.0*X" FORMULA_INV "1.0*X" /end COMPU_METHOD
/begin COMPU_METHOD LINEAR_______18_000000__FFFFFFD0 "" FORM "%5.1" "°CRK" FORMULA "0.375*X" FORMULA_INV "2.6666667*X" /end COMPU_METHOD
/begin COMPU_METHOD LINEAR______0_000000__0H___7_812 "" FORM "%5.3" "%." FORMULA "0.01528865*X" FORMULA_INV "65.408*X" /end COMPU_METHOD
/begin COMPU_METHOD LINEAR______4_000000__4H___56_00 "" FORM "%2.0" "-" FORMULA "1.0*X" FORMULA_INV "1.0*X" /end COMPU_METHOD
/begin COMPU_METHOD LINEAR______0_000000__0H___25592 "" FORM "%7.3" "-" FORMULA "0.00390625*X" FORMULA_INV "256.0*X" /end COMPU_METHOD
/begin COMPU_METHOD LINEAR______0_000000__0H___65593 "" FORM "%5.0" "-" FORMULA "1.0*X" FORMULA_INV "1.0*X" /end COMPU_METHOD
/begin COMPU_METHOD LINEAR_______128_000000__FFFFF94 "" FORM "%4.0" "A" FORMULA "1.0*X" FORMULA_INV "1.0*X" /end COMPU_METHOD
/begin COMPU_METHOD LINEAR_______200_000000__FFFF800 "" FORM "%8.3" "mA" FORMULA "0.0061035142*X-4.8242924e-005" FORMULA_INV "163.84004*X+0.0079041225" /end COMPU_METHOD
/begin RECORD_LAYOUT a_1 FNC_VALUES 1 UBYTE COLUMN_DIR DIRECT /end RECORD_LAYOUT
/begin RECORD_LAYOUT a_3 FNC_VALUES 1 UWORD COLUMN_DIR DIRECT /end RECORD_LAYOUT
/begin RECORD_LAYOUT a_6 FNC_VALUES 1 UBYTE COLUMN_DIR DIRECT /end RECORD_LAYOUT
/begin RECORD_LAYOUT a_7 FNC_VALUES 1 UBYTE COLUMN_DIR DIRECT /end RECORD_LAYOUT
/begin RECORD_LAYOUT a_9 FNC_VALUES 1 UWORD COLUMN_DIR DIRECT /end RECORD_LAYOUT
/begin RECORD_LAYOUT a_17 FNC_VALUES 1 UBYTE COLUMN_DIR DIRECT /end RECORD_LAYOUT
/begin RECORD_LAYOUT a_24 FNC_VALUES 1 UWORD COLUMN_DIR DIRECT /end RECORD_LAYOUT
/begin RECORD_LAYOUT a_28 FNC_VALUES 1 UWORD COLUMN_DIR DIRECT /end RECORD_LAYOUT
/begin RECORD_LAYOUT a_31 FNC_VALUES 1 UBYTE COLUMN_DIR DIRECT /end RECORD_LAYOUT
/begin RECORD_LAYOUT a_36 FNC_VALUES 1 UWORD COLUMN_DIR DIRECT /end RECORD_LAYOUT
/begin RECORD_LAYOUT a_39 FNC_VALUES 1 UBYTE COLUMN_DIR DIRECT /end RECORD_LAYOUT
/begin RECORD_LAYOUT a_50 FNC_VALUES 1 UWORD COLUMN_DIR DIRECT /end RECORD_LAYOUT
/begin RECORD_LAYOUT a_85 FNC_VALUES 1 UWORD ROW_DIR DIRECT /end RECORD_LAYOUT
/begin RECORD_LAYOUT a_86 FNC_VALUES 1 UBYTE ROW_DIR DIRECT /end RECORD_LAYOUT
/begin RECORD_LAYOUT a_87 FNC_VALUES 1 SBYTE ROW_DIR DIRECT /end RECORD_LAYOUT
/begin RECORD_LAYOUT a_95 FNC_VALUES 1 SWORD ROW_DIR DIRECT /end RECORD_LAYOUT
/begin RECORD_LAYOUT a_742 AXIS_PTS_X 1 UBYTE INDEX_INCR DIRECT /end RECORD_LAYOUT
/begin RECORD_LAYOUT a_743 AXIS_PTS_X 1 UWORD INDEX_INCR DIRECT /end RECORD_LAYOUT
/end MODULE
/end PROJECT
