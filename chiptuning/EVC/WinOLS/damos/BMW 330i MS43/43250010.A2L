ASAP2_VERSION 1 2
/begin PROJECT Z432 "430"
/begin HEADER "" VERSION "056.03" PROJECT_NO Z430 /end HEADER
/begin MODULE BMW-EASY ""
/begin MOD_PAR "memory layout" VERSION "ASAP2 V1.2 for BMW-EASY" SUPPLIER "SIEMENS Automotive" CUSTOMER "BMW" CUSTOMER_NO "116" USER "Dr. Woeniger" CPU_TYPE "SIEMENS 80C167 CR" MEMORY_SEGMENT PRG_DATA 0x108000 0x8000 -1 -1 -1 -1 -1 MEMORY_SEGMENT PRG_CODE 0x110000 0x8000 -1 -1 -1 -1 -1 MEMORY_SEGMENT PRG_CODE 0x118000 0x8000 -1 -1 -1 -1 -1 MEMORY_SEGMENT PRG_CODE 0x120000 0x8000 -1 -1 -1 -1 -1 MEMORY_SEGMENT PRG_CODE 0x128000 0x8000 -1 -1 -1 -1 -1 MEMORY_SEGMENT PRG_CODE 0x130000 0x8000 -1 -1 -1 -1 -1 MEMORY_SEGMENT PRG_CODE 0x138000 0x8000 -1 -1 -1 -1 -1 /end MOD_PAR
/begin MOD_COMMON "common attributes" DEPOSIT ABSOLUT BYTE_ORDER BIG_ENDIAN /end MOD_COMMON
/include "if_ccp_MS43.a2l"
/begin CHARACTERISTIC id_abc_tqi_av_mon2__idx "ID_ABC_TQI_AV_MON2" CURVE 0x7576c a_1 100 LINEAR______0_000000__0H___255_0 0.0 255.0
 /begin AXIS_DESCR COM_AXIS tst_rec_idx_mon2 LINEAR______0_000000__0H___9_000 10 0.0 9.0 AXIS_PTS_REF ldpm_tst_rec_idx_mon2 MAX_GRAD 100 MONOTONY MON_INCREASE /end AXIS_DESCR
/end CHARACTERISTIC
/begin CHARACTERISTIC id_abc_tqi_n_max_mon2__idx "ID_ABC_TQI_N_MAX_MON2" CURVE 0x75776 a_1 100 LINEAR______0_000000__0H___255_0 0.0 255.0
 /begin AXIS_DESCR COM_AXIS tst_rec_idx_mon2 LINEAR______0_000000__0H___9_000 10 0.0 9.0 AXIS_PTS_REF ldpm_tst_rec_idx_mon2 MAX_GRAD 100 MONOTONY MON_INCREASE /end AXIS_DESCR
/end CHARACTERISTIC
/begin CHARACTERISTIC id_add_knk__n "ID_ADD_KNK" CURVE 0x78ecb a_2 10 LINEAR_______2_560000__FFFFFF80H -2.5599999 2.54
 /begin AXIS_DESCR COM_AXIS n_knk LINEAR______0_000000__0H___8160_ 16 0.0 8160.0 AXIS_PTS_REF ldpm_n_32_8 MAX_GRAD 100 MONOTONY MON_INCREASE /end AXIS_DESCR
/end CHARACTERISTIC
/begin CHARACTERISTIC id_ans_mon2__idx "ID_ANS_MON2" CURVE 0x70e26 a_3 10 LINEAR______0_000000__0H___65535 0.0 65535.0
 /begin AXIS_DESCR COM_AXIS dummy_b LINEAR______0_000000__0H___9_000 10 0.0 9.0 AXIS_PTS_REF ldpm_tst_rec MAX_GRAD 100 MONOTONY MON_INCREASE /end AXIS_DESCR
/end CHARACTERISTIC
/begin CHARACTERISTIC id_crlc_maf_diag__n "ID_CRLC_MAF_DIAG" CURVE 0x75780 a_1 100 LINEAR______0_000000__0H___0_996 0.0 0.99609375
 /begin AXIS_DESCR COM_AXIS n_32 LINEAR______0_000000__0H___8160_ 4 0.0 8160.0 AXIS_PTS_REF ldp_n_32__crlc_maf_diag MAX_GRAD 100 MONOTONY MON_INCREASE /end AXIS_DESCR
/end CHARACTERISTIC
/begin CHARACTERISTIC id_cycnr_dly_iga_tra__n "ID_CYCNR_DLY_IGA_TRA" CURVE 0x75784 a_1 10 LINEAR______0_000000__0H___255_0 0.0 255.0
 /begin AXIS_DESCR COM_AXIS n LINEAR______0_000000__0H___8160_ 4 0.0 8160.0 AXIS_PTS_REF ldpm_n_32_16 MAX_GRAD 100 MONOTONY MON_INCREASE /end AXIS_DESCR
/end CHARACTERISTIC
/begin CHARACTERISTIC id_cycnr_n_grd_tra_knk__n "ID_CYCNR_N_GRD_TRA_KNK" CURVE 0x75788 a_1 20 LINEAR______0_000000__0H___255_4 0.0 255.0
 /begin AXIS_DESCR COM_AXIS n_knk LINEAR______0_000000__0H___8160_ 16 0.0 8160.0 AXIS_PTS_REF ldpm_n_32_8 MAX_GRAD 100 MONOTONY MON_INCREASE /end AXIS_DESCR
/end CHARACTERISTIC
/begin CHARACTERISTIC id_deacc_n__n "ID_DEACC_N__N" CURVE 0x75798 a_1 100 LINEAR______0_000000__0H___1_000 0.0 1.0
 /begin AXIS_DESCR COM_AXIS n_32 LINEAR______0_000000__0H___8160_ 4 0.0 8160.0 AXIS_PTS_REF ldp_n_32__deacc_n MAX_GRAD 100 MONOTONY MON_INCREASE /end AXIS_DESCR
/end CHARACTERISTIC
/begin CHARACTERISTIC id_dly_st_ivvt__toil "ID_DLY_ST_IVVT" CURVE 0x7579c a_1 100 LINEAR______100_000000__1H___255 100.0 25500.0
 /begin AXIS_DESCR COM_AXIS toil LINEAR_______48_000000__0H___155 6 -48.0 155.0 AXIS_PTS_REF ldpm_toil_3 MAX_GRAD 100 MONOTONY MON_INCREASE /end AXIS_DESCR
/end CHARACTERISTIC
/begin CHARACTERISTIC id_dri_n_sp_min_vb__vb_mmv "ID_DRI_N_SP_MIN_VB" CURVE 0x78ee8 a_3 1 LINEAR______0_000000__0H___81605 0.0 8160.0
 /begin AXIS_DESCR COM_AXIS vb_mmv LINEAR______0_000000__0H___26_00 2 0.0 26.0 AXIS_PTS_REF ldpm_vb_mmv_1 MAX_GRAD 15 /end AXIS_DESCR
/end CHARACTERISTIC
/begin CHARACTERISTIC id_ecfpwm_igk_off__temp_cat "ID_ECFPWM_IGK_OFF" CURVE 0x757a2 a_1 100 LINEAR______0_000000__0H___99_60 0.0 99.609375
 /begin AXIS_DESCR COM_AXIS temp_mmv_sub_cat LINEAR_______33_000000__0H___987 6 -33.0 987.0 AXIS_PTS_REF ldpm_temp_mmv_sub_cat_1 MAX_GRAD 100 MONOTONY MON_INCREASE /end AXIS_DESCR
/end CHARACTERISTIC
/begin CHARACTERISTIC id_ectpwm_add__n__tco_sp "ID_ECTPWM_ADD" MAP 0x757a8 a_6 100 LINEAR______0_000000__0H___99_60 0.0 99.609375
 /begin AXIS_DESCR COM_AXIS dummy_b LINEAR_______48_000000__0H___142 8 -48.0 142.5 AXIS_PTS_REF ldp_tco_sp__ectpwm_add MAX_GRAD 100 MONOTONY MON_INCREASE /end AXIS_DESCR
 /begin AXIS_DESCR COM_AXIS n LINEAR______0_000000__0H___8160_ 8 0.0 8160.0 AXIS_PTS_REF ldp_n_32__ectpwm_add MAX_GRAD 100 MONOTONY MON_INCREASE /end AXIS_DESCR
/end CHARACTERISTIC
/begin CHARACTERISTIC id_fac_iga_ch_2_km__km_ctr "ID_FAC_IGA_CH_2_KM" CURVE 0x757e8 a_7 100 LINEAR______0_000000__0H___0_996 0.0 0.99609375
 /begin AXIS_DESCR COM_AXIS km_ctr LINEAR______0_000000__0H___65534 4 0.0 655340.0 AXIS_PTS_REF ldpm_km_ctr_2 MAX_GRAD 100 MONOTONY MON_INCREASE /end AXIS_DESCR
/end CHARACTERISTIC
/begin CHARACTERISTIC id_fac_iga_ch_is_km__km_ctr "ID_FAC_IGA_CH_IS_KM" CURVE 0x757ec a_7 100 LINEAR______0_000000__0H___0_996 0.0 0.99609375
 /begin AXIS_DESCR COM_AXIS km_ctr LINEAR______0_000000__0H___65534 4 0.0 655340.0 AXIS_PTS_REF ldpm_km_ctr_2 MAX_GRAD 100 MONOTONY MON_INCREASE /end AXIS_DESCR
/end CHARACTERISTIC
/begin CHARACTERISTIC id_fac_iga_ch_km__km_ctr "ID_FAC_IGA_CH_KM" CURVE 0x757f0 a_7 100 LINEAR______0_000000__0H___0_996 0.0 0.99609375
 /begin AXIS_DESCR COM_AXIS km_ctr LINEAR______0_000000__0H___65534 4 0.0 655340.0 AXIS_PTS_REF ldpm_km_ctr_2 MAX_GRAD 100 MONOTONY MON_INCREASE /end AXIS_DESCR
/end CHARACTERISTIC
/begin CHARACTERISTIC id_fac_knks_thd__tia "ID_FAC_KNKS_THD" CURVE 0x757f4 a_1 100 LINEAR______0_000000__0H___1_992 0.0 1.9921875
 /begin AXIS_DESCR COM_AXIS tia LINEAR_______48_000000__0H___142 6 -48.0 142.5 AXIS_PTS_REF ldp_tia__fac_knks_thd MAX_GRAD 100 MONOTONY MON_INCREASE /end AXIS_DESCR
/end CHARACTERISTIC
/begin CHARACTERISTIC id_fac_ti_ris__cycnr "ID_FAC_TI_RIS" CURVE 0x757fa a_1 100 LINEAR______0_000000__0H___1_992 0.0 1.9921875
 /begin AXIS_DESCR COM_AXIS dummy_b LINEAR______1_000000__1H___16_00 16 1.0 16.0 AXIS_PTS_REF ldpm_cycnr_1 MAX_GRAD 100 MONOTONY MON_INCREASE /end AXIS_DESCR
/end CHARACTERISTIC
/begin CHARACTERISTIC id_fac_ti_rpl__cycnr "ID_FAC_TI_RPL" CURVE 0x7580a a_1 100 LINEAR______0_000000__0H___1_992 0.0 1.9921875
 /begin AXIS_DESCR COM_AXIS dummy_b LINEAR______1_000000__1H___16_00 16 1.0 16.0 AXIS_PTS_REF ldpm_cycnr_1 MAX_GRAD 100 MONOTONY MON_INCREASE /end AXIS_DESCR
/end CHARACTERISTIC
/begin CHARACTERISTIC id_fac_tra_n_cycnr_knk "ID_FAC_TRA_CYCNR_KNK" CURVE 0x7581a a_1 10 LINEAR______0_000000__0H___255_0 0.0 255.0
 /begin AXIS_DESCR COM_AXIS n LINEAR______0_000000__0H___8160_ 4 0.0 8160.0 AXIS_PTS_REF ldpm_n_32_23 MAX_GRAD 100 MONOTONY MON_INCREASE /end AXIS_DESCR
/end CHARACTERISTIC
/begin CHARACTERISTIC id_gear__n_vs_cru "ID_GEAR" CURVE 0x7581e a_7 100 LINEAR______0_000000__0H___5_000 0.0 5.0
 /begin AXIS_DESCR COM_AXIS n_vs_cru LINEAR______0_000000__0H___81608 6 0.0 8160.0 AXIS_PTS_REF ldp_n_vs_cru__gear MAX_GRAD 100 MONOTONY MON_INCREASE /end AXIS_DESCR
/end CHARACTERISTIC
/begin CHARACTERISTIC id_iga_cycnr_tra_knk__n "ID_IGA_CYCNR_TRA_KNK" CURVE 0x75824 a_1 10 LINEAR______0_000000__0H___255_0 0.0 255.0
 /begin AXIS_DESCR COM_AXIS n LINEAR______0_000000__0H___8160_ 4 0.0 8160.0 AXIS_PTS_REF ldpm_n_32_16 MAX_GRAD 100 MONOTONY MON_INCREASE /end AXIS_DESCR
/end CHARACTERISTIC
/begin CHARACTERISTIC id_iga_dec_knk_1__n "ID_IGA_DEC_KNK_1" CURVE 0x78edb a_2 10 LINEAR______47_625000__FFFFFF81H 0.0 47.625
 /begin AXIS_DESCR COM_AXIS n_knk LINEAR______0_000000__0H___8160_ 6 0.0 8160.0 AXIS_PTS_REF ldpm_n_32_18 MAX_GRAD 100 MONOTONY MON_INCREASE /end AXIS_DESCR
/end CHARACTERISTIC
/begin CHARACTERISTIC id_iga_dec_knk_2__n "ID_IGA_DEC_KNK_2" CURVE 0x78ee1 a_2 10 LINEAR______47_625000__FFFFFF81H 0.0 47.625
 /begin AXIS_DESCR COM_AXIS n_knk LINEAR______0_000000__0H___8160_ 6 0.0 8160.0 AXIS_PTS_REF ldpm_n_32_18 MAX_GRAD 100 MONOTONY MON_INCREASE /end AXIS_DESCR
/end CHARACTERISTIC
/begin CHARACTERISTIC id_iga_egr_mon2__idx "ID_IGA_EGR_MON2" CURVE 0x75828 a_1 100 LINEAR_______48_000000__0H___47_ -48.0 47.625
 /begin AXIS_DESCR COM_AXIS tst_rec_idx_mon2 LINEAR______0_000000__0H___9_000 10 0.0 9.0 AXIS_PTS_REF ldpm_tst_rec_idx_mon2 MAX_GRAD 100 MONOTONY MON_INCREASE /end AXIS_DESCR
/end CHARACTERISTIC
/begin CHARACTERISTIC id_iga_igc_mon2__idx "ID_IGA_IGC_MON2" CURVE 0x75832 a_1 100 LINEAR_______23_625000__0H___72_ -23.625 72.0
 /begin AXIS_DESCR COM_AXIS tst_rec_idx_mon2 LINEAR______0_000000__0H___9_000 10 0.0 9.0 AXIS_PTS_REF ldpm_tst_rec_idx_mon2 MAX_GRAD 100 MONOTONY MON_INCREASE /end AXIS_DESCR
/end CHARACTERISTIC
/begin CHARACTERISTIC id_iga_inc_knk__n "ID_IGA_INC_KNK" CURVE 0x78eec a_3 5 LINEAR______0_001465__1H___47_99 0.001465 47.99854
 /begin AXIS_DESCR COM_AXIS n_knk LINEAR______0_000000__0H___8160_ 16 0.0 8160.0 AXIS_PTS_REF ldpm_n_32_8 MAX_GRAD 100 MONOTONY MON_INCREASE /end AXIS_DESCR
/end CHARACTERISTIC
/begin CHARACTERISTIC id_iga_lgrd_st_aj__n "ID_IGA_LGRD_ST_AJ" CURVE 0x7583c a_1 100 LINEAR______0_375000__1H___95_62 0.375 95.625
 /begin AXIS_DESCR COM_AXIS n LINEAR______0_000000__0H___8160_ 8 0.0 8160.0 AXIS_PTS_REF ldpm_n_32_2 MAX_GRAD 100 /end AXIS_DESCR
/end CHARACTERISTIC
/begin CHARACTERISTIC id_iga_tra_dec__n "ID_IGA_TRA_DEC" CURVE 0x78f0c a_3 100 LINEAR______0_001465__1H___47_99 0.001465 47.99854
 /begin AXIS_DESCR COM_AXIS n LINEAR______0_000000__0H___8160_ 4 0.0 8160.0 AXIS_PTS_REF ldpm_n_32_16 MAX_GRAD 100 MONOTONY MON_INCREASE /end AXIS_DESCR
/end CHARACTERISTIC
/begin CHARACTERISTIC id_iga_tra_inc__n "ID_IGA_TRA_INC" CURVE 0x78f14 a_3 100 LINEAR______0_001465__1H___47_99 0.001465 47.99854
 /begin AXIS_DESCR COM_AXIS n LINEAR______0_000000__0H___8160_ 4 0.0 8160.0 AXIS_PTS_REF ldpm_n_32_16 MAX_GRAD 100 MONOTONY MON_INCREASE /end AXIS_DESCR
/end CHARACTERISTIC
/begin CHARACTERISTIC id_isapwm_slow_pu__n "ID_ISAPWM_SLOW_PU" CURVE 0x78f1c a_3 15 LINEAR______0_000000__0H___399_9 0.0 399.9938
 /begin AXIS_DESCR COM_AXIS n_32 LINEAR______0_000000__0H___8160_ 6 0.0 8160.0 AXIS_PTS_REF ldpm_n_32_45 MAX_GRAD 100 MONOTONY MON_INCREASE /end AXIS_DESCR
/end CHARACTERISTIC
/begin CHARACTERISTIC id_ivvthpwm_ad_ex__tmag "ID_IVVTHPWM_AD_EX" CURVE 0x401f1 a_1 100 LINEAR_______50_000000__0H___49_ -50.0 49.6094
 /begin AXIS_DESCR COM_AXIS tmag LINEAR_______48_000000__0H___155 6 -48.0 155.0 AXIS_PTS_REF ldpm_tmag_1 MAX_GRAD 100 MONOTONY MON_INCREASE /end AXIS_DESCR
/end CHARACTERISTIC
/begin CHARACTERISTIC id_ivvthpwm_ad_in__tmag "ID_IVVTHPWM_AD_IN" CURVE 0x401f7 a_1 100 LINEAR_______50_000000__0H___49_ -50.0 49.6094
 /begin AXIS_DESCR COM_AXIS tmag LINEAR_______48_000000__0H___155 6 -48.0 155.0 AXIS_PTS_REF ldpm_tmag_1 MAX_GRAD 100 MONOTONY MON_INCREASE /end AXIS_DESCR
/end CHARACTERISTIC
/begin CHARACTERISTIC id_ivvthpwm_cor_ad__vel_drift "ID_IVVTHPWM_COR_AD" CURVE 0x75844 a_1 100 LINEAR______0_000000__0H___49_60 0.0 49.609375
 /begin AXIS_DESCR COM_AXIS dummy_b LINEAR______0_000000__0H___95_62 6 0.0 95.625 AXIS_PTS_REF ldp_vel_drift__ivvthpwm_cor_ad MAX_GRAD 100 MONOTONY MON_INCREASE /end AXIS_DESCR
/end CHARACTERISTIC
/begin CHARACTERISTIC id_knkwb_0__n__maf "Zylinder 1" MAP 0x7584a a_6 11 LINEAR______0_375000__1H___95_62 0.375 95.625
 /begin AXIS_DESCR COM_AXIS maf_knk LINEAR______0_000000__0H___1389_ 4 0.0 1389.0 AXIS_PTS_REF ldpm_maf_5 MAX_GRAD 100 MONOTONY MON_INCREASE /end AXIS_DESCR
 /begin AXIS_DESCR COM_AXIS n_knk LINEAR______0_000000__0H___8160_ 16 0.0 8160.0 AXIS_PTS_REF ldpm_n_32_8 MAX_GRAD 100 MONOTONY MON_INCREASE /end AXIS_DESCR
/end CHARACTERISTIC
/begin CHARACTERISTIC id_knkwb_1__n__maf "ID_KNKWB_1 (Cyl5)" MAP 0x7588a a_6 11 LINEAR______0_375000__1H___95_62 0.375 95.625
 /begin AXIS_DESCR COM_AXIS maf_knk LINEAR______0_000000__0H___1389_ 4 0.0 1389.0 AXIS_PTS_REF ldpm_maf_5 MAX_GRAD 100 MONOTONY MON_INCREASE /end AXIS_DESCR
 /begin AXIS_DESCR COM_AXIS n_knk LINEAR______0_000000__0H___8160_ 16 0.0 8160.0 AXIS_PTS_REF ldpm_n_32_8 MAX_GRAD 100 MONOTONY MON_INCREASE /end AXIS_DESCR
/end CHARACTERISTIC
/begin CHARACTERISTIC id_knkwb_2__n__maf "ID_KNKWB_2 (Cyl3)" MAP 0x758ca a_6 11 LINEAR______0_375000__1H___95_62 0.375 95.625
 /begin AXIS_DESCR COM_AXIS maf_knk LINEAR______0_000000__0H___1389_ 4 0.0 1389.0 AXIS_PTS_REF ldpm_maf_5 MAX_GRAD 100 MONOTONY MON_INCREASE /end AXIS_DESCR
 /begin AXIS_DESCR COM_AXIS n_knk LINEAR______0_000000__0H___8160_ 16 0.0 8160.0 AXIS_PTS_REF ldpm_n_32_8 MAX_GRAD 100 MONOTONY MON_INCREASE /end AXIS_DESCR
/end CHARACTERISTIC
/begin CHARACTERISTIC id_knkwb_3__n__maf "ID_KNKWB_3 (Cyl6)" MAP 0x7590a a_6 11 LINEAR______0_375000__1H___95_62 0.375 95.625
 /begin AXIS_DESCR COM_AXIS maf_knk LINEAR______0_000000__0H___1389_ 4 0.0 1389.0 AXIS_PTS_REF ldpm_maf_5 MAX_GRAD 100 MONOTONY MON_INCREASE /end AXIS_DESCR
 /begin AXIS_DESCR COM_AXIS n_knk LINEAR______0_000000__0H___8160_ 16 0.0 8160.0 AXIS_PTS_REF ldpm_n_32_8 MAX_GRAD 100 MONOTONY MON_INCREASE /end AXIS_DESCR
/end CHARACTERISTIC
/begin CHARACTERISTIC id_knkwb_4__n__maf "ID_KNKWB_4 (Cyl2)" MAP 0x7594a a_6 11 LINEAR______0_375000__1H___95_62 0.375 95.625
 /begin AXIS_DESCR COM_AXIS maf_knk LINEAR______0_000000__0H___1389_ 4 0.0 1389.0 AXIS_PTS_REF ldpm_maf_5 MAX_GRAD 100 MONOTONY MON_INCREASE /end AXIS_DESCR
 /begin AXIS_DESCR COM_AXIS n_knk LINEAR______0_000000__0H___8160_ 16 0.0 8160.0 AXIS_PTS_REF ldpm_n_32_8 MAX_GRAD 100 MONOTONY MON_INCREASE /end AXIS_DESCR
/end CHARACTERISTIC
/begin CHARACTERISTIC id_knkwb_5__n__maf "ID_KNKWB_5 (Cyl4)" MAP 0x7598a a_6 11 LINEAR______0_375000__1H___95_62 0.375 95.625
 /begin AXIS_DESCR COM_AXIS maf_knk LINEAR______0_000000__0H___1389_ 4 0.0 1389.0 AXIS_PTS_REF ldpm_maf_5 MAX_GRAD 100 MONOTONY MON_INCREASE /end AXIS_DESCR
 /begin AXIS_DESCR COM_AXIS n_knk LINEAR______0_000000__0H___8160_ 16 0.0 8160.0 AXIS_PTS_REF ldpm_n_32_8 MAX_GRAD 100 MONOTONY MON_INCREASE /end AXIS_DESCR
/end CHARACTERISTIC
/begin CHARACTERISTIC id_knkwe_0__n__maf "ID_KNKWE_0 (Cyl1)" MAP 0x759ca a_6 11 LINEAR______12_000000__0H___107_ 12.0 107.625
 /begin AXIS_DESCR COM_AXIS maf_knk LINEAR______0_000000__0H___1389_ 4 0.0 1389.0 AXIS_PTS_REF ldpm_maf_5 MAX_GRAD 100 MONOTONY MON_INCREASE /end AXIS_DESCR
 /begin AXIS_DESCR COM_AXIS n_knk LINEAR______0_000000__0H___8160_ 16 0.0 8160.0 AXIS_PTS_REF ldpm_n_32_8 MAX_GRAD 100 MONOTONY MON_INCREASE /end AXIS_DESCR
/end CHARACTERISTIC
/begin CHARACTERISTIC id_knkwe_1__n__maf "ID_KNKWE_1 (Cyl5)" MAP 0x75a0a a_6 11 LINEAR______12_000000__0H___107_ 12.0 107.625
 /begin AXIS_DESCR COM_AXIS maf_knk LINEAR______0_000000__0H___1389_ 4 0.0 1389.0 AXIS_PTS_REF ldpm_maf_5 MAX_GRAD 100 MONOTONY MON_INCREASE /end AXIS_DESCR
 /begin AXIS_DESCR COM_AXIS n_knk LINEAR______0_000000__0H___8160_ 16 0.0 8160.0 AXIS_PTS_REF ldpm_n_32_8 MAX_GRAD 100 MONOTONY MON_INCREASE /end AXIS_DESCR
/end CHARACTERISTIC
/begin CHARACTERISTIC id_knkwe_2__n__maf "ID_KNKWE_2 (Cyl3)" MAP 0x75a4a a_6 11 LINEAR______12_000000__0H___107_ 12.0 107.625
 /begin AXIS_DESCR COM_AXIS maf_knk LINEAR______0_000000__0H___1389_ 4 0.0 1389.0 AXIS_PTS_REF ldpm_maf_5 MAX_GRAD 100 MONOTONY MON_INCREASE /end AXIS_DESCR
 /begin AXIS_DESCR COM_AXIS n_knk LINEAR______0_000000__0H___8160_ 16 0.0 8160.0 AXIS_PTS_REF ldpm_n_32_8 MAX_GRAD 100 MONOTONY MON_INCREASE /end AXIS_DESCR
/end CHARACTERISTIC
/begin CHARACTERISTIC id_knkwe_3__n__maf "ID_KNKWE_3 (Cyl6)" MAP 0x75a8a a_6 11 LINEAR______12_000000__0H___107_ 12.0 107.625
 /begin AXIS_DESCR COM_AXIS maf_knk LINEAR______0_000000__0H___1389_ 4 0.0 1389.0 AXIS_PTS_REF ldpm_maf_5 MAX_GRAD 100 MONOTONY MON_INCREASE /end AXIS_DESCR
 /begin AXIS_DESCR COM_AXIS n_knk LINEAR______0_000000__0H___8160_ 16 0.0 8160.0 AXIS_PTS_REF ldpm_n_32_8 MAX_GRAD 100 MONOTONY MON_INCREASE /end AXIS_DESCR
/end CHARACTERISTIC
/begin CHARACTERISTIC id_knkwe_4__n__maf "ID_KNKWE_4 (Cyl2)" MAP 0x75aca a_6 11 LINEAR______12_000000__0H___107_ 12.0 107.625
 /begin AXIS_DESCR COM_AXIS maf_knk LINEAR______0_000000__0H___1389_ 4 0.0 1389.0 AXIS_PTS_REF ldpm_maf_5 MAX_GRAD 100 MONOTONY MON_INCREASE /end AXIS_DESCR
 /begin AXIS_DESCR COM_AXIS n_knk LINEAR______0_000000__0H___8160_ 16 0.0 8160.0 AXIS_PTS_REF ldpm_n_32_8 MAX_GRAD 100 MONOTONY MON_INCREASE /end AXIS_DESCR
/end CHARACTERISTIC
/begin CHARACTERISTIC id_knkwe_5__n__maf "ID_KNKWE_5 (Cyl4)" MAP 0x75b0a a_6 11 LINEAR______12_000000__0H___107_ 12.0 107.625
 /begin AXIS_DESCR COM_AXIS maf_knk LINEAR______0_000000__0H___1389_ 4 0.0 1389.0 AXIS_PTS_REF ldpm_maf_5 MAX_GRAD 100 MONOTONY MON_INCREASE /end AXIS_DESCR
 /begin AXIS_DESCR COM_AXIS n_knk LINEAR______0_000000__0H___8160_ 16 0.0 8160.0 AXIS_PTS_REF ldpm_n_32_8 MAX_GRAD 100 MONOTONY MON_INCREASE /end AXIS_DESCR
/end CHARACTERISTIC
/begin CHARACTERISTIC id_lam_tco_min__tco_st "ID_LAM_TCO_MIN" CURVE 0x75b4a a_1 14 LINEAR_______48_000000__0H___142 -48.0 142.5
 /begin AXIS_DESCR COM_AXIS tco_st LINEAR_______48_000000__0H___142 6 -48.0 142.5 AXIS_PTS_REF ldpm_tco_st_8 MAX_GRAD 100 MONOTONY MON_INCREASE /end AXIS_DESCR
/end CHARACTERISTIC
/begin CHARACTERISTIC id_maf_min_knk_ad__n "ID_MAF_MIN_KNK_AD" CURVE 0x75b50 a_1 7 LINEAR______0_000000__0H___1389_ 0.0 1389.0
 /begin AXIS_DESCR COM_AXIS n_knk LINEAR______0_000000__0H___8160_ 16 0.0 8160.0 AXIS_PTS_REF ldpm_n_32_8 MAX_GRAD 100 MONOTONY MON_INCREASE /end AXIS_DESCR
/end CHARACTERISTIC
/begin CHARACTERISTIC id_maf_min_knk_ad_2__n "ID_MAF_MIN_KNK_AD_2" CURVE 0x75b60 a_1 7 LINEAR______0_000000__0H___1389_ 0.0 1389.0
 /begin AXIS_DESCR COM_AXIS n_knk LINEAR______0_000000__0H___8160_ 16 0.0 8160.0 AXIS_PTS_REF ldpm_n_32_8 MAX_GRAD 100 MONOTONY MON_INCREASE /end AXIS_DESCR
/end CHARACTERISTIC
/begin CHARACTERISTIC id_maf_mon2__idx "ID_MAF_MON2" CURVE 0x75b70 a_1 100 LINEAR______0_000000__0H___1389_ 0.0 1389.0
 /begin AXIS_DESCR COM_AXIS tst_rec_idx_mon2 LINEAR______0_000000__0H___9_000 10 0.0 9.0 AXIS_PTS_REF ldpm_tst_rec_idx_mon2 MAX_GRAD 100 MONOTONY MON_INCREASE /end AXIS_DESCR
/end CHARACTERISTIC
/begin CHARACTERISTIC id_maf_tab "ID_MAF_TAB" MAP 0x70e3a a_9 100 LINEAR______0_000000__0H___65535 0.0 65535.0
 /begin AXIS_DESCR COM_AXIS dummy_b LINEAR______0_000000__0H___255_0 16 0.0 255.0 AXIS_PTS_REF ldp_id_maf_tab_2 MAX_GRAD 100 MONOTONY MON_INCREASE /end AXIS_DESCR
 /begin AXIS_DESCR COM_AXIS dummy_b LINEAR______0_000000__0H___255_0 16 0.0 255.0 AXIS_PTS_REF ldp_id_maf_tab_1 MAX_GRAD 100 MONOTONY MON_INCREASE /end AXIS_DESCR
/end CHARACTERISTIC
/begin CHARACTERISTIC id_map_grd_iga_tra__n "ID_MAP_GRD_IGA_TRA" CURVE 0x7e64c a_10 100 LINEAR_______5434_259766__FFFF80 -5434.2598 5434.1768
 /begin AXIS_DESCR COM_AXIS n LINEAR______0_000000__0H___8160_ 4 0.0 8160.0 AXIS_PTS_REF ldpm_n_32_16 MAX_GRAD 100 MONOTONY MON_INCREASE /end AXIS_DESCR
/end CHARACTERISTIC
/begin CHARACTERISTIC id_map_grd_tra_knk__n "ID_MAP_GRD_TRA_KNK" CURVE 0x7e654 a_10 100 LINEAR_______5434_259766__FFFF80 -5434.2598 5434.1768
 /begin AXIS_DESCR COM_AXIS n LINEAR______0_000000__0H___8160_ 4 0.0 8160.0 AXIS_PTS_REF ldpm_n_32_16 MAX_GRAD 100 MONOTONY MON_INCREASE /end AXIS_DESCR
/end CHARACTERISTIC
/begin CHARACTERISTIC id_mis_a_obd_cat__temp_sub_cat "TAB_AUSS_OBD_KAT" CURVE 0x75b7a a_7 100 LINEAR______0_000000__0H___2_000 0.0 2.0
 /begin AXIS_DESCR COM_AXIS temp_mmv_sub_cat LINEAR_______33_000000__0H___991 6 -33.0 991.0 AXIS_PTS_REF ldp_temp_sub_cat__mis_a_obd MAX_GRAD 100 MONOTONY MON_INCREASE /end AXIS_DESCR
/end CHARACTERISTIC
/begin CHARACTERISTIC id_n_32_mon2__idx "ID_N_32_MON2" CURVE 0x75b80 a_1 100 LINEAR______0_000000__0H___8160_ 0.0 8160.0
 /begin AXIS_DESCR COM_AXIS tst_rec_idx_mon2 LINEAR______0_000000__0H___9_000 10 0.0 9.0 AXIS_PTS_REF ldpm_tst_rec_idx_mon2 MAX_GRAD 100 MONOTONY MON_INCREASE /end AXIS_DESCR
/end CHARACTERISTIC
/begin CHARACTERISTIC id_n_ecf_min_accin__n_ecf "ID_N_ECF_MIN_ACCIN" CURVE 0x75b8a a_1 100 LINEAR______0_000000__0H___15_94 0.0 15.94
 /begin AXIS_DESCR COM_AXIS n_ecf LINEAR______0_000000__0H___15_00 16 0.0 15.0 AXIS_PTS_REF ldp_n_ecf__n_ecf_min_accin MAX_GRAD 100 MONOTONY MON_INCREASE /end AXIS_DESCR
/end CHARACTERISTIC
/begin CHARACTERISTIC id_n_grd_max_knk__n "ID_N_GRD_MAX_KNK" CURVE 0x75b9a a_1 5 LINEAR______0_000000__0H___4064_ 0.0 4064.0
 /begin AXIS_DESCR COM_AXIS n_knk LINEAR______0_000000__0H___8160_ 16 0.0 8160.0 AXIS_PTS_REF ldpm_n_32_8 MAX_GRAD 100 MONOTONY MON_INCREASE /end AXIS_DESCR
/end CHARACTERISTIC
/begin CHARACTERISTIC id_n_hys_min_puc__vs__gear "ID_N_HYS_MIN_PUC" MAP 0x75baa a_6 100 LINEAR______0_000000__0H___8160_ 0.0 8160.0
 /begin AXIS_DESCR COM_AXIS gear LINEAR______0_000000__0H___7_000 6 0.0 7.0 AXIS_PTS_REF ldpm_gear_2 MAX_GRAD 100 MONOTONY MON_INCREASE /end AXIS_DESCR
 /begin AXIS_DESCR COM_AXIS vs LINEAR______0_000000__0H___25511 4 0.0 255.0 AXIS_PTS_REF ldpm_vs_2 MAX_GRAD 100 MONOTONY MON_INCREASE /end AXIS_DESCR
/end CHARACTERISTIC
/begin CHARACTERISTIC id_n_hys_min_puc_dri__vs__gear "ID_N_HYS_MIN_PUC_DRI" MAP 0x75bc2 a_6 100 LINEAR______0_000000__0H___8160_ 0.0 8160.0
 /begin AXIS_DESCR COM_AXIS gear LINEAR______0_000000__0H___7_000 6 0.0 7.0 AXIS_PTS_REF ldpm_gear_2 MAX_GRAD 100 MONOTONY MON_INCREASE /end AXIS_DESCR
 /begin AXIS_DESCR COM_AXIS vs LINEAR______0_000000__0H___25511 4 0.0 255.0 AXIS_PTS_REF ldpm_vs_2 MAX_GRAD 100 MONOTONY MON_INCREASE /end AXIS_DESCR
/end CHARACTERISTIC
/begin CHARACTERISTIC id_n_max_at__gear "ID_N_MAX_AT" CURVE 0x75bda a_1 10 LINEAR______0_000000__0H___8160_ 0.0 8160.0
 /begin AXIS_DESCR COM_AXIS gear LINEAR______0_000000__0H___7_000 6 0.0 7.0 AXIS_PTS_REF ldpm_gear_3 MAX_GRAD 100 MONOTONY MON_INCREASE /end AXIS_DESCR
/end CHARACTERISTIC
/begin CHARACTERISTIC id_n_max_cycnr__vs "ID_NMAX_CYCNR" CURVE 0x75be0 a_1 4 LINEAR______1_000000__1H___255_0 1.0 255.0
 /begin AXIS_DESCR COM_AXIS vs LINEAR______0_000000__0H___25511 5 0.0 255.0 AXIS_PTS_REF ldp_vs__n_max_cycnr MAX_GRAD 100 MONOTONY MON_INCREASE /end AXIS_DESCR
/end CHARACTERISTIC
/begin CHARACTERISTIC id_n_max_cycnr_diag__n "ID_N_MAX_CYCNR_DIAG" CURVE 0x75be5 a_1 100 LINEAR______1_000000__1H___255_0 1.0 255.0
 /begin AXIS_DESCR COM_AXIS n_32 LINEAR______0_000000__0H___8160_ 4 0.0 8160.0 AXIS_PTS_REF ldp_n_32__n_max_cycnr_diag MAX_GRAD 100 MONOTONY MON_INCREASE /end AXIS_DESCR
/end CHARACTERISTIC
/begin CHARACTERISTIC id_n_max_lgrd__gear "ID_N_MAX_LGRD" CURVE 0x78f28 a_3 100 LINEAR______0_12500000__1H___816 0.125 8160.0
 /begin AXIS_DESCR COM_AXIS gear LINEAR______0_000000__0H___7_000 6 0.0 7.0 AXIS_PTS_REF ldpm_gear_1 MAX_GRAD 100 MONOTONY MON_INCREASE /end AXIS_DESCR
/end CHARACTERISTIC
/begin CHARACTERISTIC id_n_max_lgrd_at__gear "ID_N_MAX_LGRD_AT" CURVE 0x78f34 a_3 100 LINEAR______0_12500000__1H___816 0.125 8160.0
 /begin AXIS_DESCR COM_AXIS gear LINEAR______0_000000__0H___7_000 6 0.0 7.0 AXIS_PTS_REF ldpm_gear_1 MAX_GRAD 100 MONOTONY MON_INCREASE /end AXIS_DESCR
/end CHARACTERISTIC
/begin CHARACTERISTIC id_n_max_max_at__gear "ID_N_MAX_MAX_AT" CURVE 0x75be9 a_1 10 LINEAR______0_000000__0H___8160_ 0.0 8160.0
 /begin AXIS_DESCR COM_AXIS gear LINEAR______0_000000__0H___7_000 6 0.0 7.0 AXIS_PTS_REF ldpm_gear_3 MAX_GRAD 100 MONOTONY MON_INCREASE /end AXIS_DESCR
/end CHARACTERISTIC
/begin CHARACTERISTIC id_n_max_max_mt__gear "ID_N_MAX_MAX_MT" CURVE 0x75bef a_1 10 LINEAR______0_000000__0H___8160_ 0.0 8160.0
 /begin AXIS_DESCR COM_AXIS gear LINEAR______0_000000__0H___7_000 6 0.0 7.0 AXIS_PTS_REF ldpm_gear_3 MAX_GRAD 100 MONOTONY MON_INCREASE /end AXIS_DESCR
/end CHARACTERISTIC
/begin CHARACTERISTIC id_n_max_mt__gear "ID_N_MAX_MT" CURVE 0x75bf5 a_1 10 LINEAR______0_000000__0H___8160_ 0.0 8160.0
 /begin AXIS_DESCR COM_AXIS gear LINEAR______0_000000__0H___7_000 6 0.0 7.0 AXIS_PTS_REF ldpm_gear_3 MAX_GRAD 100 MONOTONY MON_INCREASE /end AXIS_DESCR
/end CHARACTERISTIC
/begin CHARACTERISTIC id_n_max_vs_max_at__gear "ID_N_MAX_VS_MAX_AT" CURVE 0x78f40 a_3 10 LINEAR______0_000000__0H___81612 0.0 8160.0
 /begin AXIS_DESCR COM_AXIS gear LINEAR______0_000000__0H___7_000 6 0.0 7.0 AXIS_PTS_REF ldpm_gear_3 MAX_GRAD 100 MONOTONY MON_INCREASE /end AXIS_DESCR
/end CHARACTERISTIC
/begin CHARACTERISTIC id_n_max_vs_max_mt__gear "ID_N_MAX_VS_MAX_MT" CURVE 0x78f4c a_3 10 LINEAR______0_000000__0H___81612 0.0 8160.0
 /begin AXIS_DESCR COM_AXIS gear LINEAR______0_000000__0H___7_000 6 0.0 7.0 AXIS_PTS_REF ldpm_gear_3 MAX_GRAD 100 MONOTONY MON_INCREASE /end AXIS_DESCR
/end CHARACTERISTIC
/begin CHARACTERISTIC id_n_sp_min_vb__vb_mmv "ID_N_SP_MIN_VB" CURVE 0x78f58 a_3 1 LINEAR______0_000000__0H___81605 0.0 8160.0
 /begin AXIS_DESCR COM_AXIS vb_mmv LINEAR______0_000000__0H___26_00 2 0.0 26.0 AXIS_PTS_REF ldpm_vb_mmv_1 MAX_GRAD 15 /end AXIS_DESCR
/end CHARACTERISTIC
/begin CHARACTERISTIC id_o2_int_max_at__n__maf "ID_O2_INT_MAX_AT" MAP 0x78f5c a_9 100 LINEAR______0_000000__0H___511_9 0.0 511.99218
 /begin AXIS_DESCR COM_AXIS maf LINEAR______0_000000__0H___1389_ 6 0.0 1389.0 AXIS_PTS_REF ldp_maf__o2_int_max_at MAX_GRAD 100 MONOTONY MON_INCREASE /end AXIS_DESCR
 /begin AXIS_DESCR COM_AXIS n_32 LINEAR______0_000000__0H___8160_ 6 0.0 8160.0 AXIS_PTS_REF ldp_n__o2_int_max_at MAX_GRAD 100 MONOTONY MON_INCREASE /end AXIS_DESCR
/end CHARACTERISTIC
/begin CHARACTERISTIC id_o2_int_max_mt__n__maf "ID_O2_INT_MAX_MT" MAP 0x78fa4 a_9 100 LINEAR______0_000000__0H___511_9 0.0 511.99218
 /begin AXIS_DESCR COM_AXIS maf LINEAR______0_000000__0H___1389_ 6 0.0 1389.0 AXIS_PTS_REF ldp_maf__o2_int_max_mt MAX_GRAD 100 MONOTONY MON_INCREASE /end AXIS_DESCR
 /begin AXIS_DESCR COM_AXIS n_32 LINEAR______0_000000__0H___8160_ 6 0.0 8160.0 AXIS_PTS_REF ldp_n__o2_int_max_mt MAX_GRAD 100 MONOTONY MON_INCREASE /end AXIS_DESCR
/end CHARACTERISTIC
/begin CHARACTERISTIC id_pat_fcut__nr_pat "ID_PAT_FCUT" CURVE 0x78fec a_3 100 LINEAR______0_000000__0H___8191_ 0.0 8191.0
 /begin AXIS_DESCR COM_AXIS dummy_b LINEAR______0_000000__0H___13_00 14 0.0 13.0 AXIS_PTS_REF ldp_nr_pat__pat_fcut MAX_GRAD 100 MONOTONY MON_INCREASE /end AXIS_DESCR
/end CHARACTERISTIC
/begin CHARACTERISTIC id_pvs_av_mon2__idx "ID_PVS_AV_MON2" CURVE 0x75c09 a_1 100 LINEAR______0_000000__0H___119_5 0.0 119.53125
 /begin AXIS_DESCR COM_AXIS tst_rec_idx_mon2 LINEAR______0_000000__0H___9_000 10 0.0 9.0 AXIS_PTS_REF ldpm_tst_rec_idx_mon2 MAX_GRAD 100 MONOTONY MON_INCREASE /end AXIS_DESCR
/end CHARACTERISTIC
/begin CHARACTERISTIC id_pvs_cru_mon2__idx "ID_PVS_CRU_MON2" CURVE 0x75c13 a_1 100 LINEAR______0_000000__0H___119_5 0.0 119.53125
 /begin AXIS_DESCR COM_AXIS tst_rec_idx_mon2 LINEAR______0_000000__0H___9_000 10 0.0 9.0 AXIS_PTS_REF ldpm_tst_rec_idx_mon2 MAX_GRAD 100 MONOTONY MON_INCREASE /end AXIS_DESCR
/end CHARACTERISTIC
/begin CHARACTERISTIC id_pvs_fl__n "ID_PVS_FL" CURVE 0x75c1d a_7 10 LINEAR______0_000000__0H___11913 0.0 119.5
 /begin AXIS_DESCR COM_AXIS n LINEAR______0_000000__0H___81612 16 0.0 8160.0 AXIS_PTS_REF ldpm_n_11 MAX_GRAD 100 MONOTONY MON_INCREASE /end AXIS_DESCR
/end CHARACTERISTIC
/begin CHARACTERISTIC id_pvs_fl_ivvt__n "ID_PVS_FL_IVVT" CURVE 0x75c2d a_7 10 LINEAR______0_000000__0H___11913 0.0 119.5
 /begin AXIS_DESCR COM_AXIS n LINEAR______0_000000__0H___81612 16 0.0 8160.0 AXIS_PTS_REF ldpm_n_11 MAX_GRAD 100 MONOTONY MON_INCREASE /end AXIS_DESCR
/end CHARACTERISTIC
/begin CHARACTERISTIC id_pvs_fl_vim__n_vim "ID_PVS_FL_VIM" CURVE 0x75c3d a_7 10 LINEAR______0_000000__0H___11913 0.0 119.5
 /begin AXIS_DESCR COM_AXIS n LINEAR______0_000000__0H___81612 8 0.0 8160.0 AXIS_PTS_REF ldp_n_vim__pvs_fl_vim MAX_GRAD 100 MONOTONY MON_INCREASE /end AXIS_DESCR
/end CHARACTERISTIC
/begin CHARACTERISTIC id_pvs_grd_iga_tra__n "ID_PVS_GRD_IGA_TRA" CURVE 0x75c45 a_1 10 LINEAR______0_000000__0H___2988_ 0.0 2988.0
 /begin AXIS_DESCR COM_AXIS n LINEAR______0_000000__0H___8160_ 4 0.0 8160.0 AXIS_PTS_REF ldpm_n_32_16 MAX_GRAD 100 MONOTONY MON_INCREASE /end AXIS_DESCR
/end CHARACTERISTIC
/begin CHARACTERISTIC id_pvs_grd_tra_knk__n "ID_PVS_GRD_TRA_KNK" CURVE 0x75c49 a_1 10 LINEAR______0_000000__0H___2988_ 0.0 2988.0
 /begin AXIS_DESCR COM_AXIS n LINEAR______0_000000__0H___8160_ 4 0.0 8160.0 AXIS_PTS_REF ldpm_n_32_23 MAX_GRAD 100 MONOTONY MON_INCREASE /end AXIS_DESCR
/end CHARACTERISTIC
/begin CHARACTERISTIC id_saf_kgh_diag_max__n__maf "ID_SAF_KGH_DIAG_MAX" MAP 0x75c4d a_6 100 LINEAR______0_000000__0H___63_75 0.0 63.75
 /begin AXIS_DESCR COM_AXIS maf LINEAR______0_000000__0H___1389_ 8 0.0 1389.0 AXIS_PTS_REF ldpm_maf_15 MAX_GRAD 100 MONOTONY MON_INCREASE /end AXIS_DESCR
 /begin AXIS_DESCR COM_AXIS n_32 LINEAR______0_000000__0H___8160_ 8 0.0 8160.0 AXIS_PTS_REF ldpm_n_32_51 MAX_GRAD 100 MONOTONY MON_INCREASE /end AXIS_DESCR
/end CHARACTERISTIC
/begin CHARACTERISTIC id_saf_kgh_diag_min__n__maf "ID_SAF_KGH_DIAG_MIN" MAP 0x75c8d a_6 100 LINEAR______0_000000__0H___63_75 0.0 63.75
 /begin AXIS_DESCR COM_AXIS maf LINEAR______0_000000__0H___1389_ 8 0.0 1389.0 AXIS_PTS_REF ldpm_maf_15 MAX_GRAD 100 MONOTONY MON_INCREASE /end AXIS_DESCR
 /begin AXIS_DESCR COM_AXIS n_32 LINEAR______0_000000__0H___8160_ 8 0.0 8160.0 AXIS_PTS_REF ldpm_n_32_51 MAX_GRAD 100 MONOTONY MON_INCREASE /end AXIS_DESCR
/end CHARACTERISTIC
/begin CHARACTERISTIC id_saf_tab__v_saf_1__v_saf_2 "ID_SAF_TAB" MAP 0x7103a a_9 100 LINEAR______0_000000__0H___65535 0.0 65535.0
 /begin AXIS_DESCR COM_AXIS dummy_b LINEAR______0_000000__0H___255_0 16 0.0 255.0 AXIS_PTS_REF ldp_v_saf_2 MAX_GRAD 100 MONOTONY MON_INCREASE /end AXIS_DESCR
 /begin AXIS_DESCR COM_AXIS dummy_b LINEAR______0_000000__0H___255_0 16 0.0 255.0 AXIS_PTS_REF ldp_v_saf_1 MAX_GRAD 100 MONOTONY MON_INCREASE /end AXIS_DESCR
/end CHARACTERISTIC
/begin CHARACTERISTIC id_sf_1_mon2__idx "ID_SF_1_MON2" CURVE 0x79008 a_3 100 LINEAR______0_000000__0H___65535 0.0 65535.0
 /begin AXIS_DESCR COM_AXIS tst_rec_idx_mon2 LINEAR______0_000000__0H___9_000 10 0.0 9.0 AXIS_PTS_REF ldpm_tst_rec_idx_mon2 MAX_GRAD 100 MONOTONY MON_INCREASE /end AXIS_DESCR
/end CHARACTERISTIC
/begin CHARACTERISTIC id_sf_2_mon2__idx "ID_SF_2_MON2" CURVE 0x7901c a_3 100 LINEAR______0_000000__0H___65535 0.0 65535.0
 /begin AXIS_DESCR COM_AXIS tst_rec_idx_mon2 LINEAR______0_000000__0H___9_000 10 0.0 9.0 AXIS_PTS_REF ldpm_tst_rec_idx_mon2 MAX_GRAD 100 MONOTONY MON_INCREASE /end AXIS_DESCR
/end CHARACTERISTIC
/begin CHARACTERISTIC id_state_iv_mon2__idx "ID_STATE_IV_MON2" CURVE 0x79030 a_3 100 LINEAR______0_000000__0H___65535 0.0 65535.0
 /begin AXIS_DESCR COM_AXIS tst_rec_idx_mon2 LINEAR______0_000000__0H___9_000 10 0.0 9.0 AXIS_PTS_REF ldpm_tst_rec_idx_mon2 MAX_GRAD 100 MONOTONY MON_INCREASE /end AXIS_DESCR
/end CHARACTERISTIC
/begin CHARACTERISTIC id_stop_dec_fsd__toil_max "ID_STOP_DEC_FSD" CURVE 0x75ccd a_1 100 LINEAR______0_000000__0H___255_0 0.0 255.0
 /begin AXIS_DESCR COM_AXIS toil_max LINEAR_______48_000000__0H___155 4 -48.0 155.0 AXIS_PTS_REF ldp_toil_max__stop_dec_fsd MAX_GRAD 100 MONOTONY MON_INCREASE /end AXIS_DESCR
/end CHARACTERISTIC
/begin CHARACTERISTIC id_stop_inc_fsd__tco_st "ID_STOP_INC_FSD" CURVE 0x75cd1 a_1 100 LINEAR______0_000000__0H___255_0 0.0 255.0
 /begin AXIS_DESCR COM_AXIS tco_st LINEAR_______48_000000__0H___142 4 -48.0 142.5 AXIS_PTS_REF ldp_tco_st MAX_GRAD 100 MONOTONY MON_INCREASE /end AXIS_DESCR
/end CHARACTERISTIC
/begin CHARACTERISTIC id_sum_cam_ad__toil "ID_SUM_CAM_AD" CURVE 0x75cd5 a_1 100 LINEAR______0_000000__0H___254_0 0.0 254.0
 /begin AXIS_DESCR COM_AXIS toil LINEAR_______48_000000__0H___155 6 -48.0 155.0 AXIS_PTS_REF ldpm_toil_3 MAX_GRAD 100 MONOTONY MON_INCREASE /end AXIS_DESCR
/end CHARACTERISTIC
/begin CHARACTERISTIC id_t_ch_2_cat_var__tco_st "ID_T_CH_2_CAT_VAR" CURVE 0x79044 a_3 10 LINEAR______0_000000__0H___6553_ 0.0 6553.5
 /begin AXIS_DESCR COM_AXIS tco_st LINEAR_______48_000000__0H___142 8 -48.0 142.5 AXIS_PTS_REF ldpm_tco_st_2 MAX_GRAD 100 MONOTONY MON_INCREASE /end AXIS_DESCR
/end CHARACTERISTIC
/begin CHARACTERISTIC id_t_ch_ti_cat_var__tco_st "ID_T_CH_TI_CAT_VAR" CURVE 0x79054 a_3 10 LINEAR______0_000000__0H___6553_ 0.0 6553.5
 /begin AXIS_DESCR COM_AXIS tco_st LINEAR_______48_000000__0H___142 8 -48.0 142.5 AXIS_PTS_REF ldpm_tco_st_5 MAX_GRAD 100 MONOTONY MON_INCREASE /end AXIS_DESCR
/end CHARACTERISTIC
/begin CHARACTERISTIC id_t_dly_iga_aj_at__gear "ID_T_DLY_IGA_AJ_AT" CURVE 0x75cdb a_1 100 LINEAR______10_000000__1H___2550 10.0 2550.0
 /begin AXIS_DESCR COM_AXIS gear LINEAR______0_000000__0H___7_000 6 0.0 7.0 AXIS_PTS_REF ldpm_gear_1 MAX_GRAD 100 MONOTONY MON_INCREASE /end AXIS_DESCR
/end CHARACTERISTIC
/begin CHARACTERISTIC id_t_dly_iga_aj_mt__gear "ID_T_DLY_IGA_AJ_MT" CURVE 0x75ce1 a_1 100 LINEAR______10_000000__1H___2550 10.0 2550.0
 /begin AXIS_DESCR COM_AXIS gear LINEAR______0_000000__0H___7_000 6 0.0 7.0 AXIS_PTS_REF ldpm_gear_1 MAX_GRAD 100 MONOTONY MON_INCREASE /end AXIS_DESCR
/end CHARACTERISTIC
/begin CHARACTERISTIC id_t_iga_ch_cat_var__tco_st "ID_T_IGA_CH_CAT_VAR" CURVE 0x79064 a_3 10 LINEAR______0_000000__0H___6553_ 0.0 6553.5
 /begin AXIS_DESCR COM_AXIS tco_st LINEAR_______48_000000__0H___142 8 -48.0 142.5 AXIS_PTS_REF ldpm_tco_st_2 MAX_GRAD 100 MONOTONY MON_INCREASE /end AXIS_DESCR
/end CHARACTERISTIC
/begin CHARACTERISTIC id_t_iga_ch_mon2__idx "ID_T_IGA_CH_MON2" CURVE 0x79074 a_3 100 LINEAR______0_000000__0H___2621_ 0.0 2621.4
 /begin AXIS_DESCR COM_AXIS tst_rec_idx_mon2 LINEAR______0_000000__0H___9_000 10 0.0 9.0 AXIS_PTS_REF ldpm_tst_rec_idx_mon2 MAX_GRAD 100 MONOTONY MON_INCREASE /end AXIS_DESCR
/end CHARACTERISTIC
/begin CHARACTERISTIC id_t_iga_inc_aj_at__gear "ID_T_IGA_INC_AJ_AT" CURVE 0x75ce7 a_1 100 LINEAR______0_000000__0H___2796_ 0.0 2796.16
 /begin AXIS_DESCR COM_AXIS gear LINEAR______0_000000__0H___7_000 6 0.0 7.0 AXIS_PTS_REF ldpm_gear_1 MAX_GRAD 100 MONOTONY MON_INCREASE /end AXIS_DESCR
/end CHARACTERISTIC
/begin CHARACTERISTIC id_t_iga_inc_aj_mt__gear "ID_T_IGA_INC_AJ_MT" CURVE 0x75ced a_1 100 LINEAR______0_000000__0H___2796_ 0.0 2796.16
 /begin AXIS_DESCR COM_AXIS gear LINEAR______0_000000__0H___7_000 6 0.0 7.0 AXIS_PTS_REF ldpm_gear_1 MAX_GRAD 100 MONOTONY MON_INCREASE /end AXIS_DESCR
/end CHARACTERISTIC
/begin CHARACTERISTIC id_t_igcfb_min_300__n__maf "ID_T_IGCFB_MIN_300" MAP 0x79088 a_9 100 LINEAR______0_000000__0H___349_5 0.0 349.52
 /begin AXIS_DESCR COM_AXIS maf LINEAR______0_000000__0H___1389_ 6 0.0 1389.0 AXIS_PTS_REF ldpm_maf_18 MAX_GRAD 100 MONOTONY MON_INCREASE /end AXIS_DESCR
 /begin AXIS_DESCR COM_AXIS n_32 LINEAR______0_000000__0H___8160_ 8 0.0 8160.0 AXIS_PTS_REF ldpm_n_32_46 MAX_GRAD 100 MONOTONY MON_INCREASE /end AXIS_DESCR
/end CHARACTERISTIC
/begin CHARACTERISTIC id_t_igcfb_min_pc__n__maf "ID_T_IGCFB_MIN_PC" MAP 0x790e8 a_9 100 LINEAR______0_000000__0H___349_5 0.0 349.52
 /begin AXIS_DESCR COM_AXIS maf LINEAR______0_000000__0H___1389_ 6 0.0 1389.0 AXIS_PTS_REF ldpm_maf_18 MAX_GRAD 100 MONOTONY MON_INCREASE /end AXIS_DESCR
 /begin AXIS_DESCR COM_AXIS n_32 LINEAR______0_000000__0H___8160_ 8 0.0 8160.0 AXIS_PTS_REF ldpm_n_32_46 MAX_GRAD 100 MONOTONY MON_INCREASE /end AXIS_DESCR
/end CHARACTERISTIC
/begin CHARACTERISTIC id_t_max_aj_at__gear "ID_T_MAX_AJ_AT" CURVE 0x75cf3 a_1 100 LINEAR______10_000000__1H___2550 10.0 2550.0
 /begin AXIS_DESCR COM_AXIS gear LINEAR______0_000000__0H___7_000 6 0.0 7.0 AXIS_PTS_REF ldpm_gear_1 MAX_GRAD 100 MONOTONY MON_INCREASE /end AXIS_DESCR
/end CHARACTERISTIC
/begin CHARACTERISTIC id_t_max_aj_mt__gear "ID_T_MAX_AJ_MT" CURVE 0x75cf9 a_1 100 LINEAR______10_000000__1H___2550 10.0 2550.0
 /begin AXIS_DESCR COM_AXIS gear LINEAR______0_000000__0H___7_000 6 0.0 7.0 AXIS_PTS_REF ldpm_gear_1 MAX_GRAD 100 MONOTONY MON_INCREASE /end AXIS_DESCR
/end CHARACTERISTIC
/begin CHARACTERISTIC id_t_max_fl__gear "ID_T_MAX_FL" CURVE 0x75cff a_1 100 LINEAR______0_000000__0H___25514 0.0 255.0
 /begin AXIS_DESCR COM_AXIS gear LINEAR______0_000000__0H___7_000 6 0.0 7.0 AXIS_PTS_REF ldpm_gear_1 MAX_GRAD 100 MONOTONY MON_INCREASE /end AXIS_DESCR
/end CHARACTERISTIC
/begin CHARACTERISTIC id_t_max_fl_at__gear "ID_T_MAX_FL_AT" CURVE 0x75d05 a_1 100 LINEAR______0_000000__0H___25514 0.0 255.0
 /begin AXIS_DESCR COM_AXIS gear LINEAR______0_000000__0H___7_000 6 0.0 7.0 AXIS_PTS_REF ldpm_gear_1 MAX_GRAD 100 MONOTONY MON_INCREASE /end AXIS_DESCR
/end CHARACTERISTIC
/begin CHARACTERISTIC id_t_max_ls__tco_st "ID_T_MAX_LS" CURVE 0x75d0b a_1 100 LINEAR______0_000000__0H___25514 0.0 255.0
 /begin AXIS_DESCR COM_AXIS tco_st LINEAR_______48_000000__0H___142 6 -48.0 142.5 AXIS_PTS_REF ldpm_tco_st_8 MAX_GRAD 100 MONOTONY MON_INCREASE /end AXIS_DESCR
/end CHARACTERISTIC
/begin CHARACTERISTIC id_t_sap_on__tco_st "ID_T_SAP_ON" CURVE 0x79148 a_3 10 LINEAR______0_100000__1H___6553_ 0.1 6553.5
 /begin AXIS_DESCR COM_AXIS tco LINEAR_______48_000000__0H___142 8 -48.0 142.5 AXIS_PTS_REF ldp_tco__t_sap_on MAX_GRAD 100 MONOTONY MON_INCREASE /end AXIS_DESCR
/end CHARACTERISTIC
/begin CHARACTERISTIC id_t_sav_on__tco_st "ID_T_SAV_ON" CURVE 0x79158 a_3 10 LINEAR______0_100000__1H___6553_ 0.1 6553.5
 /begin AXIS_DESCR COM_AXIS tco LINEAR_______48_000000__0H___142 8 -48.0 142.5 AXIS_PTS_REF ldp_tco__t_sav_on MAX_GRAD 100 MONOTONY MON_INCREASE /end AXIS_DESCR
/end CHARACTERISTIC
/begin CHARACTERISTIC id_t_slow_pu_iga__n "ID_T_SLOW_PU_IGA" CURVE 0x75d11 a_1 100 LINEAR______0_100000__1H___25_50 0.1 25.5
 /begin AXIS_DESCR COM_AXIS n_32 LINEAR______0_000000__0H___8160_ 6 0.0 8160.0 AXIS_PTS_REF ldpm_n_32_45 MAX_GRAD 100 MONOTONY MON_INCREASE /end AXIS_DESCR
/end CHARACTERISTIC
/begin CHARACTERISTIC id_t_slow_pu_isa__n "ID_T_SLOW_PU_ISA" CURVE 0x75d17 a_1 100 LINEAR______0_100000__1H___25_50 0.1 25.5
 /begin AXIS_DESCR COM_AXIS n_32 LINEAR______0_000000__0H___8160_ 6 0.0 8160.0 AXIS_PTS_REF ldpm_n_32_45 MAX_GRAD 100 MONOTONY MON_INCREASE /end AXIS_DESCR
/end CHARACTERISTIC
/begin CHARACTERISTIC id_t_tco_min__tco_st "ID_T_TCO_MIN" CURVE 0x75d1d a_1 100 LINEAR______10_000000__1H___2515 10.0 2550.0
 /begin AXIS_DESCR COM_AXIS tco_st LINEAR_______48_000000__0H___142 6 -48.0 142.5 AXIS_PTS_REF ldpm_tco_st_8 MAX_GRAD 100 MONOTONY MON_INCREASE /end AXIS_DESCR
/end CHARACTERISTIC
/begin CHARACTERISTIC id_t_tco_puc_deacc__tco "ID_T_TCO_PUC_DEACC" CURVE 0x79168 a_3 100 LINEAR_______5_592320__0H___5_59 -5.59232 5.592149
 /begin AXIS_DESCR COM_AXIS tco LINEAR_______48_000000__0H___142 4 -48.0 142.5 AXIS_PTS_REF ldp_tco__t_tco_puc_deacc MAX_GRAD 100 MONOTONY MON_INCREASE /end AXIS_DESCR
/end CHARACTERISTIC
/begin CHARACTERISTIC id_t_tqi_mon2__idx "ID_T_TQI_MON2" CURVE 0x75d23 a_1 100 LINEAR______0_000000__0H___10_20 0.0 10.2
 /begin AXIS_DESCR COM_AXIS tst_rec_idx_mon2 LINEAR______0_000000__0H___9_000 10 0.0 9.0 AXIS_PTS_REF ldpm_tst_rec_idx_mon2 MAX_GRAD 100 MONOTONY MON_INCREASE /end AXIS_DESCR
/end CHARACTERISTIC
/begin CHARACTERISTIC id_t_wait_diag_sa__tco "ID_T_WAIT_DIAG_SA" CURVE 0x79170 a_3 10 LINEAR______0_020000__1H___1310_ 0.02 1310.0
 /begin AXIS_DESCR COM_AXIS tco LINEAR_______48_000000__0H___142 8 -48.0 142.5 AXIS_PTS_REF ldp_tco__t_wait_diag_sa MAX_GRAD 100 MONOTONY MON_INCREASE /end AXIS_DESCR
/end CHARACTERISTIC
/begin CHARACTERISTIC id_tco_min_diag_sa__tam_mon_sa "ID_TCO_MIN_DIAG_SA" CURVE 0x75d2d a_1 100 LINEAR_______48_000000__0H___142 -48.0 142.5
 /begin AXIS_DESCR COM_AXIS tam_mon_sa LINEAR_______128_000000__0H___12 6 -128.0 127.0 AXIS_PTS_REF ldp_tam_mon_sa__tco_min_diag_sa MAX_GRAD 100 MONOTONY MON_INCREASE /end AXIS_DESCR
/end CHARACTERISTIC
/begin CHARACTERISTIC id_tco_mon2__idx "ID_TCO_MON2" CURVE 0x75d33 a_1 100 LINEAR_______48_000000__0H___142 -48.0 142.5
 /begin AXIS_DESCR COM_AXIS tst_rec_idx_mon2 LINEAR______0_000000__0H___9_000 10 0.0 9.0 AXIS_PTS_REF ldpm_tst_rec_idx_mon2 MAX_GRAD 100 MONOTONY MON_INCREASE /end AXIS_DESCR
/end CHARACTERISTIC
/begin CHARACTERISTIC id_tco_sp_ect__n__maf_sub "ID_TCO_SP_ECT" MAP 0x75d3d a_6 100 LINEAR_______48_000000__0H___142 -48.0 142.5
 /begin AXIS_DESCR COM_AXIS maf_sub_diag LINEAR______0_000000__0H___1389_ 6 0.0 1389.0 AXIS_PTS_REF ldpm_maf_sub_diag_1 MAX_GRAD 100 MONOTONY MON_INCREASE /end AXIS_DESCR
 /begin AXIS_DESCR COM_AXIS n_32 LINEAR______0_000000__0H___8160_ 12 0.0 8160.0 AXIS_PTS_REF ldpm_n_32_28 MAX_GRAD 100 MONOTONY MON_INCREASE /end AXIS_DESCR
/end CHARACTERISTIC
/begin CHARACTERISTIC id_tco_sp_ect_acin__n__maf_sub "ID_TCO_SP_ACIN_ECT" MAP 0x75d85 a_6 100 LINEAR_______48_000000__0H___142 -48.0 142.5
 /begin AXIS_DESCR COM_AXIS maf_sub_diag LINEAR______0_000000__0H___1389_ 6 0.0 1389.0 AXIS_PTS_REF ldpm_maf_sub_diag_1 MAX_GRAD 100 MONOTONY MON_INCREASE /end AXIS_DESCR
 /begin AXIS_DESCR COM_AXIS n_32 LINEAR______0_000000__0H___8160_ 12 0.0 8160.0 AXIS_PTS_REF ldpm_n_32_28 MAX_GRAD 100 MONOTONY MON_INCREASE /end AXIS_DESCR
/end CHARACTERISTIC
/begin CHARACTERISTIC id_ti_cor_cyl_off__n "ID_TI_COR_CYL_OFF" CURVE 0x79180 a_3 100 LINEAR______0_000000__0H___1_016 0.0 1.0
 /begin AXIS_DESCR COM_AXIS n_32 LINEAR______0_000000__0H___8160_ 4 0.0 8160.0 AXIS_PTS_REF ldp_n_32__ti_cor_cyl_off MAX_GRAD 100 MONOTONY MON_INCREASE /end AXIS_DESCR
/end CHARACTERISTIC
/begin CHARACTERISTIC id_ti_dec_wf__n "ID_TI_DEC_WF" CURVE 0x79188 a_3 100 LINEAR______0_000000__0H___349_5 0.0 349.52
 /begin AXIS_DESCR COM_AXIS n_32 LINEAR______0_000000__0H___8160_ 8 0.0 8160.0 AXIS_PTS_REF ldpm_n_32_49 MAX_GRAD 100 MONOTONY MON_INCREASE /end AXIS_DESCR
/end CHARACTERISTIC
/begin CHARACTERISTIC id_ti_inc_wf__n "ID_TI_INC_WF" CURVE 0x79198 a_3 100 LINEAR______0_000000__0H___349_5 0.0 349.52
 /begin AXIS_DESCR COM_AXIS n_32 LINEAR______0_000000__0H___8160_ 8 0.0 8160.0 AXIS_PTS_REF ldpm_n_32_49 MAX_GRAD 100 MONOTONY MON_INCREASE /end AXIS_DESCR
/end CHARACTERISTIC
/begin CHARACTERISTIC id_ti_tco_neg_wf__tco "ID_TI_TCO_NEG_WF" CURVE 0x75dcd a_1 100 LINEAR______0_000000__0H___3_984 0.0 3.984375
 /begin AXIS_DESCR COM_AXIS tco LINEAR_______48_000000__0H___142 8 -48.0 142.5 AXIS_PTS_REF ldpm_tco_21 MAX_GRAD 100 MONOTONY MON_INCREASE /end AXIS_DESCR
/end CHARACTERISTIC
/begin CHARACTERISTIC id_ti_tco_pos_wf__tco "ID_TI_TCO_POS_WF" CURVE 0x75dd5 a_1 100 LINEAR______0_000000__0H___3_984 0.0 3.984375
 /begin AXIS_DESCR COM_AXIS tco LINEAR_______48_000000__0H___142 8 -48.0 142.5 AXIS_PTS_REF ldpm_tco_21 MAX_GRAD 100 MONOTONY MON_INCREASE /end AXIS_DESCR
/end CHARACTERISTIC
/begin CHARACTERISTIC id_tps_req_ltc_gear_at__gear "ID_TPS_REQ_LTC_GEAR_AT" CURVE 0x75ddd a_1 100 LINEAR______0_000000__0H___1_000 0.0 1.0
 /begin AXIS_DESCR COM_AXIS gear LINEAR______0_000000__0H___7_000 6 0.0 7.0 AXIS_PTS_REF ldpm_gear_4 MAX_GRAD 100 MONOTONY MON_INCREASE /end AXIS_DESCR
/end CHARACTERISTIC
/begin CHARACTERISTIC id_tps_req_ltc_gear_mt__gear "ID_TPS_REQ_LTC_GEAR_MT" CURVE 0x75de3 a_1 100 LINEAR______0_000000__0H___1_000 0.0 1.0
 /begin AXIS_DESCR COM_AXIS gear LINEAR______0_000000__0H___7_000 6 0.0 7.0 AXIS_PTS_REF ldpm_gear_4 MAX_GRAD 100 MONOTONY MON_INCREASE /end AXIS_DESCR
/end CHARACTERISTIC
/begin CHARACTERISTIC id_tqi_amt_mon2__idx "ID_TQI_AMT_MON2" CURVE 0x75de9 a_1 100 LINEAR______0_000000__0H___510_0 0.0 510.0
 /begin AXIS_DESCR COM_AXIS tst_rec_idx_mon2 LINEAR______0_000000__0H___9_000 10 0.0 9.0 AXIS_PTS_REF ldpm_tst_rec_idx_mon2 MAX_GRAD 100 MONOTONY MON_INCREASE /end AXIS_DESCR
 FUNCTION_LIST MON2 /end CHARACTERISTIC
/begin CHARACTERISTIC id_tqi_msr_mon2__idx "ID_TQI_MSR_MON2" CURVE 0x75df3 a_1 100 LINEAR______0_000000__0H___510_0 0.0 510.0
 /begin AXIS_DESCR COM_AXIS tst_rec_idx_mon2 LINEAR______0_000000__0H___9_000 10 0.0 9.0 AXIS_PTS_REF ldpm_tst_rec_idx_mon2 MAX_GRAD 100 MONOTONY MON_INCREASE /end AXIS_DESCR
 FUNCTION_LIST MON2 /end CHARACTERISTIC
/begin CHARACTERISTIC id_tqi_sp_mon2__idx "ID_TQI_SP_MON2" CURVE 0x75dfd a_1 100 LINEAR______0_000000__0H___510_0 0.0 510.0
 /begin AXIS_DESCR COM_AXIS tst_rec_idx_mon2 LINEAR______0_000000__0H___9_000 10 0.0 9.0 AXIS_PTS_REF ldpm_tst_rec_idx_mon2 MAX_GRAD 100 MONOTONY MON_INCREASE /end AXIS_DESCR
/end CHARACTERISTIC
/begin CHARACTERISTIC id_vim_fl__n_vim "ID_VIM_FL" CURVE 0x75e07 a_7 10 LINEAR______0_000000__0H___1_000 0.0 1.0
 /begin AXIS_DESCR COM_AXIS n LINEAR______0_000000__0H___81612 8 0.0 8160.0 AXIS_PTS_REF ldpm_n_vim_1 MAX_GRAD 100 MONOTONY MON_INCREASE /end AXIS_DESCR
/end CHARACTERISTIC
/begin CHARACTERISTIC id_vim_pl__n_vim__maf "ID_VIM_PL" MAP 0x75e0f a_17 10 LINEAR______0_000000__0H___1_000 0.0 1.0
 /begin AXIS_DESCR COM_AXIS maf LINEAR______0_000000__0H___13818 6 0.0 1389.0 AXIS_PTS_REF ldp_maf__vim_pl MAX_GRAD 100 MONOTONY MON_INCREASE /end AXIS_DESCR
 /begin AXIS_DESCR COM_AXIS n LINEAR______0_000000__0H___81612 8 0.0 8160.0 AXIS_PTS_REF ldpm_n_vim_1 MAX_GRAD 100 MONOTONY MON_INCREASE /end AXIS_DESCR
/end CHARACTERISTIC
/begin CHARACTERISTIC id_vls_down_crlc__maf_kgh "ID_VLS_DOWN_CRLC" CURVE 0x75e3f a_7 100 LINEAR______0_000000__0H___0_996 0.0 0.99609375
 /begin AXIS_DESCR COM_AXIS maf_kgh LINEAR______0_000000__0H___16383 4 0.0 16383.75 AXIS_PTS_REF ldp_maf_kgh__vls_down_crlc MAX_GRAD 100 MONOTONY MON_INCREASE /end AXIS_DESCR
/end CHARACTERISTIC
/begin CHARACTERISTIC iga_ad_0__n__maf "ID_IGA_AD_0 (Cyl1)" MAP 0x40218 a_6 100 LINEAR_______48_000000__0H___0_0 -48.0 0.0
 /begin AXIS_DESCR COM_AXIS maf_knk LINEAR______0_000000__0H___1389_ 4 0.0 1389.0 AXIS_PTS_REF ldpm_maf_5 MAX_GRAD 100 MONOTONY MON_INCREASE /end AXIS_DESCR
 /begin AXIS_DESCR COM_AXIS n_knk LINEAR______0_000000__0H___8160_ 16 0.0 8160.0 AXIS_PTS_REF ldpm_n_32_8 MAX_GRAD 100 MONOTONY MON_INCREASE /end AXIS_DESCR
/end CHARACTERISTIC
/begin CHARACTERISTIC iga_ad_1__n__maf "ID_IGA_AD_1 (Cyl5)" MAP 0x40258 a_6 100 LINEAR_______48_000000__0H___0_0 -48.0 0.0
 /begin AXIS_DESCR COM_AXIS maf_knk LINEAR______0_000000__0H___1389_ 4 0.0 1389.0 AXIS_PTS_REF ldpm_maf_5 MAX_GRAD 100 MONOTONY MON_INCREASE /end AXIS_DESCR
 /begin AXIS_DESCR COM_AXIS n_knk LINEAR______0_000000__0H___8160_ 16 0.0 8160.0 AXIS_PTS_REF ldpm_n_32_8 MAX_GRAD 100 MONOTONY MON_INCREASE /end AXIS_DESCR
/end CHARACTERISTIC
/begin CHARACTERISTIC iga_ad_2__n__maf "ID_IGA_AD_2 (Cyl3)" MAP 0x40298 a_6 100 LINEAR_______48_000000__0H___0_0 -48.0 0.0
 /begin AXIS_DESCR COM_AXIS maf_knk LINEAR______0_000000__0H___1389_ 4 0.0 1389.0 AXIS_PTS_REF ldpm_maf_5 MAX_GRAD 100 MONOTONY MON_INCREASE /end AXIS_DESCR
 /begin AXIS_DESCR COM_AXIS n_knk LINEAR______0_000000__0H___8160_ 16 0.0 8160.0 AXIS_PTS_REF ldpm_n_32_8 MAX_GRAD 100 MONOTONY MON_INCREASE /end AXIS_DESCR
/end CHARACTERISTIC
/begin CHARACTERISTIC iga_ad_3__n__maf "ID_IGA_AD_3 (Cyl6)" MAP 0x402d8 a_6 100 LINEAR_______48_000000__0H___0_0 -48.0 0.0
 /begin AXIS_DESCR COM_AXIS maf_knk LINEAR______0_000000__0H___1389_ 4 0.0 1389.0 AXIS_PTS_REF ldpm_maf_5 MAX_GRAD 100 MONOTONY MON_INCREASE /end AXIS_DESCR
 /begin AXIS_DESCR COM_AXIS n_knk LINEAR______0_000000__0H___8160_ 16 0.0 8160.0 AXIS_PTS_REF ldpm_n_32_8 MAX_GRAD 100 MONOTONY MON_INCREASE /end AXIS_DESCR
/end CHARACTERISTIC
/begin CHARACTERISTIC iga_ad_4__n__maf "ID_IGA_AD_4 (Cyl2)" MAP 0x40318 a_6 100 LINEAR_______48_000000__0H___0_0 -48.0 0.0
 /begin AXIS_DESCR COM_AXIS maf_knk LINEAR______0_000000__0H___1389_ 4 0.0 1389.0 AXIS_PTS_REF ldpm_maf_5 MAX_GRAD 100 MONOTONY MON_INCREASE /end AXIS_DESCR
 /begin AXIS_DESCR COM_AXIS n_knk LINEAR______0_000000__0H___8160_ 16 0.0 8160.0 AXIS_PTS_REF ldpm_n_32_8 MAX_GRAD 100 MONOTONY MON_INCREASE /end AXIS_DESCR
/end CHARACTERISTIC
/begin CHARACTERISTIC iga_ad_5__n__maf "ID_IGA_AD_5 (Cyl4)" MAP 0x40358 a_6 100 LINEAR_______48_000000__0H___0_0 -48.0 0.0
 /begin AXIS_DESCR COM_AXIS maf_knk LINEAR______0_000000__0H___1389_ 4 0.0 1389.0 AXIS_PTS_REF ldpm_maf_5 MAX_GRAD 100 MONOTONY MON_INCREASE /end AXIS_DESCR
 /begin AXIS_DESCR COM_AXIS n_knk LINEAR______0_000000__0H___8160_ 16 0.0 8160.0 AXIS_PTS_REF ldpm_n_32_8 MAX_GRAD 100 MONOTONY MON_INCREASE /end AXIS_DESCR
/end CHARACTERISTIC
/begin CHARACTERISTIC ip_ac_neg_cru_ac__n__pvs_cru "IP_AC_NEG_CRU_AC" MAP 0x791a8 a_9 100 LINEAR______0_000000__0H___51119 0.0 511.9789
 /begin AXIS_DESCR COM_AXIS pvs_cru LINEAR______0_000000__0H___11920 3 0.0 119.53125 AXIS_PTS_REF ldpm_pvs_cru_1 MAX_GRAD 100 MONOTONY MON_INCREASE /end AXIS_DESCR
 /begin AXIS_DESCR COM_AXIS n LINEAR______0_000000__0H___8160_ 3 0.0 8160.0 AXIS_PTS_REF ldpm_n_21 MAX_GRAD 100 MONOTONY MON_INCREASE /end AXIS_DESCR
/end CHARACTERISTIC
/begin CHARACTERISTIC ip_ac_neg_cru_resu__n__pvs_cru "IP_AC_NEG_CRU_RESU" MAP 0x791ba a_9 100 LINEAR______0_000000__0H___51119 0.0 511.9789
 /begin AXIS_DESCR COM_AXIS pvs_cru LINEAR______0_000000__0H___11920 3 0.0 119.53125 AXIS_PTS_REF ldpm_pvs_cru_1 MAX_GRAD 100 MONOTONY MON_INCREASE /end AXIS_DESCR
 /begin AXIS_DESCR COM_AXIS n LINEAR______0_000000__0H___8160_ 3 0.0 8160.0 AXIS_PTS_REF ldpm_n_21 MAX_GRAD 100 MONOTONY MON_INCREASE /end AXIS_DESCR
/end CHARACTERISTIC
/begin CHARACTERISTIC ip_accin_dly_2__n "IP_ACCIN_DLY_2" CURVE 0x791cc a_3 1 LINEAR______0_010000__1H___655_3 0.01 655.34998
 /begin AXIS_DESCR COM_AXIS n LINEAR______0_000000__0H___8160_ 3 0.0 8160.0 AXIS_PTS_REF ldpm_n_32_17 MAX_GRAD 100 MONOTONY MON_INCREASE /end AXIS_DESCR
/end CHARACTERISTIC
/begin CHARACTERISTIC ip_accin_dly_3__n "IP_ACCIN_DLY_3" CURVE 0x791d2 a_3 1 LINEAR______0_010000__1H___655_3 0.01 655.34998
 /begin AXIS_DESCR COM_AXIS n LINEAR______0_000000__0H___8160_ 3 0.0 8160.0 AXIS_PTS_REF ldpm_n_32_17 MAX_GRAD 100 MONOTONY MON_INCREASE /end AXIS_DESCR
/end CHARACTERISTIC
/begin CHARACTERISTIC ip_acin_n_sp_add_heat__tco "IP_ACIN_N_SP_ADD_HEAT" CURVE 0x791e4 a_3 100 LINEAR______0_000000__0H___1000_ 0.0 1000.0
 /begin AXIS_DESCR COM_AXIS tco LINEAR_______48_000000__0H___142 6 -48.0 142.5 AXIS_PTS_REF ldpm_tco_4 MAX_GRAD 100 MONOTONY MON_INCREASE /end AXIS_DESCR
/end CHARACTERISTIC
/begin CHARACTERISTIC ip_acin_n_sp_is__tco "IP_ACIN_N_SP_IS" CURVE 0x791f0 a_3 3 LINEAR______0_000000__0H___81605 0.0 8160.0
 /begin AXIS_DESCR COM_AXIS tco LINEAR_______48_000000__0H___142 6 -48.0 142.5 AXIS_PTS_REF ldpm_tco_4 MAX_GRAD 100 MONOTONY MON_INCREASE /end AXIS_DESCR
/end CHARACTERISTIC
/begin CHARACTERISTIC ip_ad_mmv_max_isa_diag__isapwm "IP_AD_MMV_MAX_ISA_DIAG" CURVE 0x75e43 a_1 10 LINEAR______0_000000__0H___3_921 0.0 3.984375
 /begin AXIS_DESCR COM_AXIS isapwm LINEAR______0_000000__0H___99_60 4 0.0 99.609375 AXIS_PTS_REF ldpm_isapwm_1 MAX_GRAD 100 MONOTONY MON_INCREASE /end AXIS_DESCR
/end CHARACTERISTIC
/begin CHARACTERISTIC ip_ad_mmv_min_isa_diag__isapwm "IP_AD_MMV_MIN_ISA_DIAG" CURVE 0x75e47 a_1 10 LINEAR______0_000000__0H___3_921 0.0 3.984375
 /begin AXIS_DESCR COM_AXIS isapwm LINEAR______0_000000__0H___99_60 4 0.0 99.609375 AXIS_PTS_REF ldpm_isapwm_1 MAX_GRAD 100 MONOTONY MON_INCREASE /end AXIS_DESCR
/end CHARACTERISTIC
/begin CHARACTERISTIC ip_add_cop_ron__iga_dif "IP_ADD_COP_RON" CURVE 0x791fc a_3 100 LINEAR______0_000000__0H___1_016 0.0 1.0
 /begin AXIS_DESCR COM_AXIS dummy_b LINEAR______0_000000__0H___95_22 4 0.0 95.625 AXIS_PTS_REF ldpm_iga_dif_3 MAX_GRAD 100 MONOTONY MON_INCREASE /end AXIS_DESCR
/end CHARACTERISTIC
/begin CHARACTERISTIC ip_add_iga_dif__n_32 "IP_IGA_AST" CURVE 0x75e4b a_1 100 LINEAR_______48_000000__0H___47_ -48.0 47.625
 /begin AXIS_DESCR COM_AXIS n_32 LINEAR______0_000000__0H___8160_ 3 0.0 8160.0 AXIS_PTS_REF ldp_n_32__add_iga_dif MAX_GRAD 100 MONOTONY MON_INCREASE /end AXIS_DESCR
/end CHARACTERISTIC
/begin CHARACTERISTIC ip_add_tqfr_accin__tq_accin_can "IP_ADD_TQFR_ACCIN" CURVE 0x75e4e a_1 100 LINEAR______0_000000__0H___25523 0.0 255.0
 /begin AXIS_DESCR COM_AXIS dummy_b LINEAR______0_000000__0H___31_00 4 0.0 31.0 AXIS_PTS_REF ldpm_tq_accin_can_1 MAX_GRAD 100 MONOTONY MON_INCREASE /end AXIS_DESCR
/end CHARACTERISTIC
/begin CHARACTERISTIC ip_amp_raw_1__v_amp "IP_AMP_RAW_1" CURVE 0x79204 a_24 100 LINEAR______0_000000__0H___5434_ 0.0 5434.2598
 /begin AXIS_DESCR COM_AXIS v_amp LINEAR______0_000000__0H___4_995 8 0.0 4.9951172 AXIS_PTS_REF ldp_v_amp__amp_raw_1 MAX_GRAD 100 MONOTONY MON_INCREASE /end AXIS_DESCR
/end CHARACTERISTIC
/begin CHARACTERISTIC ip_amp_raw_2__v_amp "IP_AMP_RAW_2" CURVE 0x79214 a_24 100 LINEAR______0_000000__0H___5434_ 0.0 5434.2598
 /begin AXIS_DESCR COM_AXIS v_amp LINEAR______0_000000__0H___4_995 8 0.0 4.9951172 AXIS_PTS_REF ldp_v_amp__amp_raw_2 MAX_GRAD 100 MONOTONY MON_INCREASE /end AXIS_DESCR
/end CHARACTERISTIC
/begin CHARACTERISTIC ip_amp_raw_cor__vs "IP_AMP_RAW_COR" CURVE 0x79224 a_3 100 LINEAR_______2717_171319__0H___2 -2717.1713 2717.0884
 /begin AXIS_DESCR COM_AXIS vs LINEAR______0_000000__0H___25511 8 0.0 255.0 AXIS_PTS_REF ldp_vs__amp_raw_cor MAX_GRAD 100 MONOTONY MON_INCREASE /end AXIS_DESCR
/end CHARACTERISTIC
/begin CHARACTERISTIC ip_cam_sp_tco_1_ex_fl__n "IP_CAM_SP_TCO_1_EX_FL" CURVE 0x75efc a_7 100 LINEAR_______155_625000__FFH____ -155.625 -60.0
 /begin AXIS_DESCR COM_AXIS n LINEAR______0_000000__0H___81612 16 0.0 8160.0 AXIS_PTS_REF ldpm_n_5 MAX_GRAD 100 MONOTONY MON_INCREASE /end AXIS_DESCR
/end CHARACTERISTIC
/begin CHARACTERISTIC ip_cam_sp_tco_1_in_fl__n "IP_CAM_SP_TCO_1_IN_FL" CURVE 0x75ff0 a_7 100 LINEAR______60_000000__0H___155_ 60.0 155.625
 /begin AXIS_DESCR COM_AXIS n LINEAR______0_000000__0H___81612 16 0.0 8160.0 AXIS_PTS_REF ldpm_n_5 MAX_GRAD 100 MONOTONY MON_INCREASE /end AXIS_DESCR
/end CHARACTERISTIC
/begin CHARACTERISTIC ip_cam_sp_tco_2_ex_fl__n "IP_CAM_SP_TCO_2_EX_FL" CURVE 0x760e4 a_7 100 LINEAR_______155_625000__FFH____ -155.625 -60.0
 /begin AXIS_DESCR COM_AXIS n LINEAR______0_000000__0H___81612 16 0.0 8160.0 AXIS_PTS_REF ldpm_n_5 MAX_GRAD 100 MONOTONY MON_INCREASE /end AXIS_DESCR
/end CHARACTERISTIC
/begin CHARACTERISTIC ip_cam_sp_tco_2_in_fl__n "IP_CAM_SP_TCO_2_IN_FL" CURVE 0x761d8 a_7 100 LINEAR______60_000000__0H___155_ 60.0 155.625
 /begin AXIS_DESCR COM_AXIS n LINEAR______0_000000__0H___81612 16 0.0 8160.0 AXIS_PTS_REF ldpm_n_5 MAX_GRAD 100 MONOTONY MON_INCREASE /end AXIS_DESCR
/end CHARACTERISTIC
/begin CHARACTERISTIC ip_cast_cycnr_st_ast__n__maf "IP_CAST_CYCNR_ST_AST" MAP 0x762cc a_6 100 LINEAR______1_000000__1H___255_0 1.0 255.0
 /begin AXIS_DESCR COM_AXIS maf LINEAR______0_000000__0H___1389_ 6 0.0 1389.0 AXIS_PTS_REF ldp_maf__cast_cycnr_st_ast MAX_GRAD 100 MONOTONY MON_INCREASE /end AXIS_DESCR
 /begin AXIS_DESCR COM_AXIS n_32 LINEAR______0_000000__0H___8160_ 6 0.0 8160.0 AXIS_PTS_REF ldp_n_32__cast_cycnr_st_ast MAX_GRAD 100 MONOTONY MON_INCREASE /end AXIS_DESCR
/end CHARACTERISTIC
/begin CHARACTERISTIC ip_cha_bat__tam__vb "IP_CHA_BAT" MAP 0x762f0 a_6 100 LINEAR_______128_000000__0H___25 -128.0 127.0
 /begin AXIS_DESCR COM_AXIS vb LINEAR______0_000000__0H___26_00 6 0.0 26.0 AXIS_PTS_REF ldp_vb__cha_bat MAX_GRAD 100 MONOTONY MON_INCREASE /end AXIS_DESCR
 /begin AXIS_DESCR COM_AXIS tam LINEAR_______128_000000__0H___12 6 -128.0 127.0 AXIS_PTS_REF ldp_tam__cha_bat MAX_GRAD 100 MONOTONY MON_INCREASE /end AXIS_DESCR
/end CHARACTERISTIC
/begin CHARACTERISTIC ip_cppwm_cps__cppwm "IP_CPPWM_CPS" CURVE 0x79234 a_24 100 LINEAR______0_000000__0H___99_97 0.0 99.97559
 /begin AXIS_DESCR COM_AXIS cppwm LINEAR______0_000000__0H___99_97 5 0.0 99.97559 AXIS_PTS_REF ldp_cppwm__cppwm_cps MAX_GRAD 100 MONOTONY MON_INCREASE /end AXIS_DESCR
/end CHARACTERISTIC
/begin CHARACTERISTIC ip_cppwm_max__n__maf "IP_CPPWM_MAX" MAP 0x7923e a_9 10 LINEAR______0_000000__0H___800_0 0.0 800.0
 /begin AXIS_DESCR COM_AXIS maf LINEAR______0_000000__0H___1389_ 12 0.0 1389.0 AXIS_PTS_REF ldpm_maf_1 MAX_GRAD 100 MONOTONY MON_INCREASE /end AXIS_DESCR
 /begin AXIS_DESCR COM_AXIS n LINEAR______0_000000__0H___8160_ 10 0.0 8160.0 AXIS_PTS_REF ldpm_n_32_7 MAX_GRAD 100 MONOTONY MON_INCREASE /end AXIS_DESCR
/end CHARACTERISTIC
/begin CHARACTERISTIC ip_cppwm_min__n__maf "IP_CPPWM_MIN" MAP 0x7932e a_9 10 LINEAR______0_000000__0H___99_97 0.0 99.97559
 /begin AXIS_DESCR COM_AXIS maf LINEAR______0_000000__0H___1389_ 12 0.0 1389.0 AXIS_PTS_REF ldpm_maf_1 MAX_GRAD 100 MONOTONY MON_INCREASE /end AXIS_DESCR
 /begin AXIS_DESCR COM_AXIS n LINEAR______0_000000__0H___8160_ 10 0.0 8160.0 AXIS_PTS_REF ldpm_n_32_7 MAX_GRAD 100 MONOTONY MON_INCREASE /end AXIS_DESCR
/end CHARACTERISTIC
/begin CHARACTERISTIC ip_cppwm_min_cat_var__n__maf "IP_CPPWM_MIN_CAT_VAR" MAP 0x7941e a_9 10 LINEAR______0_000000__0H___99_97 0.0 99.97559
 /begin AXIS_DESCR COM_AXIS maf LINEAR______0_000000__0H___1389_ 12 0.0 1389.0 AXIS_PTS_REF ldpm_maf_1 MAX_GRAD 100 MONOTONY MON_INCREASE /end AXIS_DESCR
 /begin AXIS_DESCR COM_AXIS n LINEAR______0_000000__0H___8160_ 10 0.0 8160.0 AXIS_PTS_REF ldpm_n_32_7 MAX_GRAD 100 MONOTONY MON_INCREASE /end AXIS_DESCR
/end CHARACTERISTIC
/begin CHARACTERISTIC ip_cps_dif_map__n__maf_cor "IP_CPS_DIF_MAP" MAP 0x7950e a_9 100 LINEAR______0_000000__0H___0_999 0.0 0.99998474
 /begin AXIS_DESCR COM_AXIS maf_cor LINEAR______0_000000__0H___1389_ 12 0.0 1389.0 AXIS_PTS_REF ldpm_maf_add_cor_1 MAX_GRAD 100 MONOTONY MON_INCREASE /end AXIS_DESCR
 /begin AXIS_DESCR COM_AXIS n LINEAR______0_000000__0H___8160_ 10 0.0 8160.0 AXIS_PTS_REF ldpm_n_32_7 MAX_GRAD 100 MONOTONY MON_INCREASE /end AXIS_DESCR
/end CHARACTERISTIC
/begin CHARACTERISTIC ip_cps_vb_add__vb "IP_CPS_VB_ADD" CURVE 0x795fe a_3 10 LINEAR_______50_000000__0H___426 -50.0 49.97559
 /begin AXIS_DESCR COM_AXIS vb LINEAR______0_000000__0H___26_00 8 0.0 26.0 AXIS_PTS_REF ldpm_vb_1 MAX_GRAD 100 MONOTONY MON_INCREASE /end AXIS_DESCR
/end CHARACTERISTIC
/begin CHARACTERISTIC ip_crlc_dec_puc_up_1__maf_kgh "IP_CRLC_DEC_PUC_UP_1" CURVE 0x7961e a_24 100 LINEAR______0_000000__0H___1_027 0.0 1.0
 /begin AXIS_DESCR COM_AXIS maf_kgh LINEAR______0_000000__0H___16383 8 0.0 16383.75 AXIS_PTS_REF ldpm_maf_kgh_17 MAX_GRAD 100 MONOTONY MON_INCREASE /end AXIS_DESCR
 FUNCTION_LIST ETM /end CHARACTERISTIC
/begin CHARACTERISTIC ip_crlc_dec_puc_up_2__maf_kgh "IP_CRLC_DEC_PUC_UP_2" CURVE 0x7963e a_24 100 LINEAR______0_000000__0H___1_027 0.0 1.0
 /begin AXIS_DESCR COM_AXIS maf_kgh LINEAR______0_000000__0H___16383 8 0.0 16383.75 AXIS_PTS_REF ldpm_maf_kgh_17 MAX_GRAD 100 MONOTONY MON_INCREASE /end AXIS_DESCR
 FUNCTION_LIST ETM /end CHARACTERISTIC
/begin CHARACTERISTIC ip_crlc_dec_up_1__n__maf "IP_CRLC_DEC_UP_1" MAP 0x7964e a_28 100 LINEAR______0_000000__0H___1_027 0.0 1.0
 /begin AXIS_DESCR COM_AXIS maf LINEAR______0_000000__0H___13818 8 0.0 1389.0 AXIS_PTS_REF ldpm_maf_17 MAX_GRAD 100 MONOTONY MON_INCREASE /end AXIS_DESCR
 /begin AXIS_DESCR COM_AXIS n LINEAR______0_000000__0H___81612 8 0.0 8160.0 AXIS_PTS_REF ldpm_n_17 MAX_GRAD 100 MONOTONY MON_INCREASE /end AXIS_DESCR
 FUNCTION_LIST ETM /end CHARACTERISTIC
/begin CHARACTERISTIC ip_crlc_dec_up_2__n__maf "IP_CRLC_DEC_UP_2" MAP 0x796ce a_28 100 LINEAR______0_000000__0H___1_027 0.0 1.0
 /begin AXIS_DESCR COM_AXIS maf LINEAR______0_000000__0H___13818 8 0.0 1389.0 AXIS_PTS_REF ldpm_maf_17 MAX_GRAD 100 MONOTONY MON_INCREASE /end AXIS_DESCR
 /begin AXIS_DESCR COM_AXIS n LINEAR______0_000000__0H___81612 8 0.0 8160.0 AXIS_PTS_REF ldpm_n_17 MAX_GRAD 100 MONOTONY MON_INCREASE /end AXIS_DESCR
 FUNCTION_LIST ETM /end CHARACTERISTIC
/begin CHARACTERISTIC ip_crlc_dew_wall_down__maf_kgh "IP_CRLC_DEW_WALL_down" CURVE 0x76314 a_7 100 LINEAR______0_000000__0H___0_996 0.0 0.99609375
 /begin AXIS_DESCR COM_AXIS maf_kgh LINEAR______0_000000__0H___16383 6 0.0 16383.75 AXIS_PTS_REF ldpm_maf_kgh_18 MAX_GRAD 100 MONOTONY MON_INCREASE /end AXIS_DESCR
 FUNCTION_LIST ETM /end CHARACTERISTIC
/begin CHARACTERISTIC ip_crlc_dew_wall_up__maf_kgh "IP_CRLC_DEW_WALL_UP" CURVE 0x7631a a_7 100 LINEAR______0_000000__0H___0_996 0.0 0.99609375
 /begin AXIS_DESCR COM_AXIS maf_kgh LINEAR______0_000000__0H___16383 6 0.0 16383.75 AXIS_PTS_REF ldpm_maf_kgh_18 MAX_GRAD 100 MONOTONY MON_INCREASE /end AXIS_DESCR
 FUNCTION_LIST ETM /end CHARACTERISTIC
/begin CHARACTERISTIC ip_crlc_dly_i__maf_kgh "IP_CRLC_DLY_I" CURVE 0x7974e a_24 100 LINEAR______0_000000__0H___0_999 0.0 0.99998474
 /begin AXIS_DESCR COM_AXIS maf_kgh LINEAR______0_000000__0H___16383 6 0.0 16383.75 AXIS_PTS_REF ldpm_maf_kgh_3 MAX_GRAD 100 MONOTONY MON_INCREASE /end AXIS_DESCR
/end CHARACTERISTIC
/begin CHARACTERISTIC ip_crlc_drv2_at_er__n_32 "IP_CRLC_DRV2_AT_ER" CURVE 0x7975a a_3 100 LINEAR______0_000000__0H___0_999 0.0 0.99998474
 /begin AXIS_DESCR COM_AXIS n_32 LINEAR______0_000000__0H___8160_ 4 0.0 8160.0 AXIS_PTS_REF ldpm_n_32_43 MAX_GRAD 100 MONOTONY MON_INCREASE /end AXIS_DESCR
/end CHARACTERISTIC
/begin CHARACTERISTIC ip_crlc_drv2_mt_er__n_32 "IP_CRLC_DRV2_MT_ER" CURVE 0x79762 a_3 100 LINEAR______0_000000__0H___0_999 0.0 0.99998474
 /begin AXIS_DESCR COM_AXIS n_32 LINEAR______0_000000__0H___8160_ 4 0.0 8160.0 AXIS_PTS_REF ldpm_n_32_44 MAX_GRAD 100 MONOTONY MON_INCREASE /end AXIS_DESCR
/end CHARACTERISTIC
/begin CHARACTERISTIC ip_crlc_fac_toil__tempsptoildif "IP_CRLC_FAC_TOIL" CURVE 0x76320 a_7 100 LINEAR______0_000000__0H___7_968 0.0 7.96875
 /begin AXIS_DESCR COM_AXIS toil_dif LINEAR_______203_000000__0H___20 8 -203.0 203.0 AXIS_PTS_REF ldpm_temp_sp_toil_dif_1 MAX_GRAD 100 MONOTONY MON_INCREASE /end AXIS_DESCR
 FUNCTION_LIST ETM /end CHARACTERISTIC
/begin CHARACTERISTIC ip_crlc_inc_up_1__n__maf "IP_CRLC_INC_UP_1" MAP 0x7976a a_28 100 LINEAR______0_000000__0H___1_027 0.0 1.0
 /begin AXIS_DESCR COM_AXIS maf LINEAR______0_000000__0H___13818 8 0.0 1389.0 AXIS_PTS_REF ldpm_maf_17 MAX_GRAD 100 MONOTONY MON_INCREASE /end AXIS_DESCR
 /begin AXIS_DESCR COM_AXIS n LINEAR______0_000000__0H___81612 8 0.0 8160.0 AXIS_PTS_REF ldpm_n_17 MAX_GRAD 100 MONOTONY MON_INCREASE /end AXIS_DESCR
 FUNCTION_LIST ETM /end CHARACTERISTIC
/begin CHARACTERISTIC ip_crlc_inc_up_2__n__maf "IP_CRLC_INC_UP_2" MAP 0x797ea a_28 100 LINEAR______0_000000__0H___1_027 0.0 1.0
 /begin AXIS_DESCR COM_AXIS maf LINEAR______0_000000__0H___13818 8 0.0 1389.0 AXIS_PTS_REF ldpm_maf_17 MAX_GRAD 100 MONOTONY MON_INCREASE /end AXIS_DESCR
 /begin AXIS_DESCR COM_AXIS n LINEAR______0_000000__0H___81612 8 0.0 8160.0 AXIS_PTS_REF ldpm_n_17 MAX_GRAD 100 MONOTONY MON_INCREASE /end AXIS_DESCR
 FUNCTION_LIST ETM /end CHARACTERISTIC
/begin CHARACTERISTIC ip_crlc_sap_fac__tempmmvexupi "IP_CRLC_SAP_FAC" CURVE 0x7634c a_7 100 LINEAR______0_000000__0H___7_968 0.0 7.96875
 /begin AXIS_DESCR COM_AXIS dummy_w LINEAR_______33_000000__0H___989 8 -33.0 989.9844 AXIS_PTS_REF ldpm_temp_mmv_sub_ex_up_i_1 MAX_GRAD 100 MONOTONY MON_INCREASE /end AXIS_DESCR
 FUNCTION_LIST ETM /end CHARACTERISTIC
/begin CHARACTERISTIC ip_crlc_wall_dec_up_1__n__maf "IP_CRLC_WALL_DEC_UP_1" MAP 0x798aa a_28 100 LINEAR______0_000000__0H___1_027 0.0 1.0
 /begin AXIS_DESCR COM_AXIS maf LINEAR______0_000000__0H___13818 8 0.0 1389.0 AXIS_PTS_REF ldpm_maf_17 MAX_GRAD 100 MONOTONY MON_INCREASE /end AXIS_DESCR
 /begin AXIS_DESCR COM_AXIS n LINEAR______0_000000__0H___81612 8 0.0 8160.0 AXIS_PTS_REF ldpm_n_17 MAX_GRAD 100 MONOTONY MON_INCREASE /end AXIS_DESCR
 FUNCTION_LIST ETM /end CHARACTERISTIC
/begin CHARACTERISTIC ip_crlc_wall_dec_up_2__n__maf "IP_CRLC_WALL_DEC_UP_2" MAP 0x7992a a_28 100 LINEAR______0_000000__0H___1_027 0.0 1.0
 /begin AXIS_DESCR COM_AXIS maf LINEAR______0_000000__0H___13818 8 0.0 1389.0 AXIS_PTS_REF ldpm_maf_17 MAX_GRAD 100 MONOTONY MON_INCREASE /end AXIS_DESCR
 /begin AXIS_DESCR COM_AXIS n LINEAR______0_000000__0H___81612 8 0.0 8160.0 AXIS_PTS_REF ldpm_n_17 MAX_GRAD 100 MONOTONY MON_INCREASE /end AXIS_DESCR
 FUNCTION_LIST ETM /end CHARACTERISTIC
/begin CHARACTERISTIC ip_crlc_wall_inc_up_1__n__maf "IP_CRLC_WALL_INC_UP_1" MAP 0x799aa a_28 100 LINEAR______0_000000__0H___1_027 0.0 1.0
 /begin AXIS_DESCR COM_AXIS maf LINEAR______0_000000__0H___13818 8 0.0 1389.0 AXIS_PTS_REF ldpm_maf_17 MAX_GRAD 100 MONOTONY MON_INCREASE /end AXIS_DESCR
 /begin AXIS_DESCR COM_AXIS n LINEAR______0_000000__0H___81612 8 0.0 8160.0 AXIS_PTS_REF ldpm_n_17 MAX_GRAD 100 MONOTONY MON_INCREASE /end AXIS_DESCR
 FUNCTION_LIST ETM /end CHARACTERISTIC
/begin CHARACTERISTIC ip_crlc_wall_inc_up_2__n__maf "IP_CRLC_WALL_INC_UP_2" MAP 0x79a2a a_28 100 LINEAR______0_000000__0H___1_027 0.0 1.0
 /begin AXIS_DESCR COM_AXIS maf LINEAR______0_000000__0H___13818 8 0.0 1389.0 AXIS_PTS_REF ldpm_maf_17 MAX_GRAD 100 MONOTONY MON_INCREASE /end AXIS_DESCR
 /begin AXIS_DESCR COM_AXIS n LINEAR______0_000000__0H___81612 8 0.0 8160.0 AXIS_PTS_REF ldpm_n_17 MAX_GRAD 100 MONOTONY MON_INCREASE /end AXIS_DESCR
 FUNCTION_LIST ETM /end CHARACTERISTIC
/begin CHARACTERISTIC ip_cur_alter__n "IP_CUR_ALTER" CURVE 0x76374 a_7 100 LINEAR_______128_000000__0H___25 -128.0 127.0
 /begin AXIS_DESCR COM_AXIS n LINEAR______0_000000__0H___81612 6 0.0 8160.0 AXIS_PTS_REF ldp_n__cur_alter MAX_GRAD 100 MONOTONY MON_INCREASE /end AXIS_DESCR
/end CHARACTERISTIC
/begin CHARACTERISTIC ip_cur_cns_ecf__ecfpwm_ecf "IP_CUR_CNS_ECF" CURVE 0x7637a a_1 100 LINEAR_______128_000000__0H___25 -128.0 127.0
 /begin AXIS_DESCR COM_AXIS ecfpwm_ecf LINEAR______0_000000__0H___99_60 5 0.0 99.609375 AXIS_PTS_REF ldp_ecfpwm_ecf__cur_cnf_ecf MAX_GRAD 100 MONOTONY MON_INCREASE /end AXIS_DESCR
/end CHARACTERISTIC
/begin CHARACTERISTIC ip_cur_cns_st__toil "IP_CUR_CNS_ST" CURVE 0x79aaa a_3 100 LINEAR_______500_000000__7E0BH__ -500.0 500.0
 /begin AXIS_DESCR COM_AXIS toil LINEAR_______48_000000__0H___155 4 -48.0 155.0 AXIS_PTS_REF ldp_toil__cur_cns_st MAX_GRAD 100 MONOTONY MON_INCREASE /end AXIS_DESCR
/end CHARACTERISTIC
/begin CHARACTERISTIC ip_cur_igc_sp__n__maf "IP_CUR_IGC_SP" MAP 0x7637f a_6 8 LINEAR______0_000000__0H___143_8 0.0 143.8
 /begin AXIS_DESCR COM_AXIS maf LINEAR______0_000000__0H___1389_ 6 0.0 1389.0 AXIS_PTS_REF ldp_maf__cur_igc_sp MAX_GRAD 100 MONOTONY MON_INCREASE /end AXIS_DESCR
 /begin AXIS_DESCR COM_AXIS n LINEAR______0_000000__0H___8160_ 6 0.0 8160.0 AXIS_PTS_REF ldp_n_32__cur_igc_sp MAX_GRAD 100 MONOTONY MON_INCREASE /end AXIS_DESCR
/end CHARACTERISTIC
/begin CHARACTERISTIC ip_cycnr_dly_st_er__tco_st "IP_CYCNR_DLY_ST_ER__TCO_ST" CURVE 0x763a3 a_1 100 LINEAR______0_000000__0H___255_4 0.0 255.0
 /begin AXIS_DESCR COM_AXIS tco_st LINEAR_______48_000000__0H___142 8 -48.0 142.5 AXIS_PTS_REF ldp_tco_st__cycnr_dly_st_er MAX_GRAD 100 MONOTONY MON_INCREASE /end AXIS_DESCR
/end CHARACTERISTIC
/begin CHARACTERISTIC ip_dist_min__tco_st "IP_DIST_MIN" CURVE 0x79ab2 a_3 100 LINEAR______0_000000__0H___65529 0.0 65535.0
 /begin AXIS_DESCR COM_AXIS dummy_b LINEAR_______48_000000__0H___142 8 -48.0 142.5 AXIS_PTS_REF ldp_tco_st__dist MAX_GRAD 100 MONOTONY MON_INCREASE /end AXIS_DESCR
/end CHARACTERISTIC
/begin CHARACTERISTIC ip_dly_adc_ivvt_ex__n__toil "IP_DLY_ADC_IVVT_EX" MAP 0x763ab a_6 100 LINEAR______0_000000__0H___2550_ 0.0 2550.0
 /begin AXIS_DESCR COM_AXIS toil LINEAR_______48_000000__0H___155 8 -48.0 155.0 AXIS_PTS_REF ldpm_toil_2 MAX_GRAD 100 MONOTONY MON_INCREASE /end AXIS_DESCR
 /begin AXIS_DESCR COM_AXIS n LINEAR______0_000000__0H___8160_ 8 0.0 8160.0 AXIS_PTS_REF ldpm_n_32_24 MAX_GRAD 100 MONOTONY MON_INCREASE /end AXIS_DESCR
/end CHARACTERISTIC
/begin CHARACTERISTIC ip_dly_adc_ivvt_in__n__toil "IP_DLY_ADC_IVVT_IN" MAP 0x763eb a_6 100 LINEAR______0_000000__0H___2550_ 0.0 2550.0
 /begin AXIS_DESCR COM_AXIS toil LINEAR_______48_000000__0H___155 8 -48.0 155.0 AXIS_PTS_REF ldpm_toil_2 MAX_GRAD 100 MONOTONY MON_INCREASE /end AXIS_DESCR
 /begin AXIS_DESCR COM_AXIS n LINEAR______0_000000__0H___8160_ 8 0.0 8160.0 AXIS_PTS_REF ldpm_n_32_24 MAX_GRAD 100 MONOTONY MON_INCREASE /end AXIS_DESCR
/end CHARACTERISTIC
/begin CHARACTERISTIC ip_dly_cyl_lam__n__maf "IP_DLY_CYL_LAM" MAP 0x79ac2 a_28 100 LINEAR______0_000000__0H___720_0 0.0 720.0
 /begin AXIS_DESCR COM_AXIS maf LINEAR______0_000000__0H___13818 8 0.0 1389.0 AXIS_PTS_REF ldp_maf__dly_cyl_lam MAX_GRAD 100 MONOTONY MON_INCREASE /end AXIS_DESCR
 /begin AXIS_DESCR COM_AXIS n LINEAR______0_000000__0H___81612 8 0.0 8160.0 AXIS_PTS_REF ldpm_n_12 MAX_GRAD 100 MONOTONY MON_INCREASE /end AXIS_DESCR
 FUNCTION_LIST CSCM /end CHARACTERISTIC
/begin CHARACTERISTIC ip_dly_rtd_ivvt_ex__n__toil "IP_DLY_RTD_IVVT_EX" MAP 0x7642b a_6 100 LINEAR______0_000000__0H___2550_ 0.0 2550.0
 /begin AXIS_DESCR COM_AXIS toil LINEAR_______48_000000__0H___155 8 -48.0 155.0 AXIS_PTS_REF ldpm_toil_2 MAX_GRAD 100 MONOTONY MON_INCREASE /end AXIS_DESCR
 /begin AXIS_DESCR COM_AXIS n LINEAR______0_000000__0H___8160_ 8 0.0 8160.0 AXIS_PTS_REF ldpm_n_32_24 MAX_GRAD 100 MONOTONY MON_INCREASE /end AXIS_DESCR
/end CHARACTERISTIC
/begin CHARACTERISTIC ip_dly_rtd_ivvt_in__n__toil "IP_DLY_RTD_IVVT_IN" MAP 0x7646b a_6 100 LINEAR______0_000000__0H___2550_ 0.0 2550.0
 /begin AXIS_DESCR COM_AXIS toil LINEAR_______48_000000__0H___155 8 -48.0 155.0 AXIS_PTS_REF ldpm_toil_2 MAX_GRAD 100 MONOTONY MON_INCREASE /end AXIS_DESCR
 /begin AXIS_DESCR COM_AXIS n LINEAR______0_000000__0H___8160_ 8 0.0 8160.0 AXIS_PTS_REF ldpm_n_32_24 MAX_GRAD 100 MONOTONY MON_INCREASE /end AXIS_DESCR
/end CHARACTERISTIC
/begin CHARACTERISTIC ip_dri_acin_n_sp_add_heat__tco "IP_DRI_ACIN_N_SP_ADD_HEAT" CURVE 0x79b4e a_3 100 LINEAR______0_000000__0H___1000_ 0.0 1000.0
 /begin AXIS_DESCR COM_AXIS tco LINEAR_______48_000000__0H___142 6 -48.0 142.5 AXIS_PTS_REF ldpm_tco_4 MAX_GRAD 100 MONOTONY MON_INCREASE /end AXIS_DESCR
/end CHARACTERISTIC
/begin CHARACTERISTIC ip_dri_acin_n_sp_is__tco "IP_DRI_ACIN_N_SP_IS" CURVE 0x79b5a a_3 3 LINEAR______0_000000__0H___81605 0.0 8160.0
 /begin AXIS_DESCR COM_AXIS tco LINEAR_______48_000000__0H___142 6 -48.0 142.5 AXIS_PTS_REF ldpm_tco_4 MAX_GRAD 100 MONOTONY MON_INCREASE /end AXIS_DESCR
/end CHARACTERISTIC
/begin CHARACTERISTIC ip_dri_n_sp_add_heat__tco "IP_DRI_N_SP_ADD_HEAT" CURVE 0x79bb2 a_3 100 LINEAR______0_000000__0H___1000_ 0.0 1000.0
 /begin AXIS_DESCR COM_AXIS tco LINEAR_______48_000000__0H___142 6 -48.0 142.5 AXIS_PTS_REF ldpm_tco_4 MAX_GRAD 100 MONOTONY MON_INCREASE /end AXIS_DESCR
/end CHARACTERISTIC
/begin CHARACTERISTIC ip_dri_n_sp_is__tco "IP_DRI_N_SP_IS" CURVE 0x79bbe a_3 3 LINEAR______0_000000__0H___81605 0.0 8160.0
 /begin AXIS_DESCR COM_AXIS tco LINEAR_______48_000000__0H___142 6 -48.0 142.5 AXIS_PTS_REF ldpm_tco_4 MAX_GRAD 100 MONOTONY MON_INCREASE /end AXIS_DESCR
/end CHARACTERISTIC
/begin CHARACTERISTIC ip_ectpwm_i__tco_dif "IP_ECTPWM_I" CURVE 0x764ab a_1 100 LINEAR_______6_250000__0H___6_20 -6.25 6.2
 /begin AXIS_DESCR COM_AXIS dummy_b LINEAR_______96_000000__0H___95_ 8 -96.0 95.25 AXIS_PTS_REF ldp_tco_dif__ectpwm_i MAX_GRAD 100 MONOTONY MON_INCREASE /end AXIS_DESCR
/end CHARACTERISTIC
/begin CHARACTERISTIC ip_ectpwm_p__tco_dif "IP_ECTPWM_P" CURVE 0x764b3 a_1 100 LINEAR_______50_000000__0H___49_ -50.0 49.6094
 /begin AXIS_DESCR COM_AXIS dummy_b LINEAR_______96_000000__0H___95_ 8 -96.0 95.25 AXIS_PTS_REF ldp_tco_dif__ectpwm_p MAX_GRAD 100 MONOTONY MON_INCREASE /end AXIS_DESCR
/end CHARACTERISTIC
/begin CHARACTERISTIC ip_eff_iga_mon "IP_EFF_IGA_MON" CURVE 0x7e728 a_1 100 LINEAR______0_000000__0H___1_992 0.0 1.9921875
 /begin AXIS_DESCR COM_AXIS dummy_b LINEAR______0_000000__0H____95_6 8 -95.625 0.0 AXIS_PTS_REF ldp_iga_dif_av__eff_iga_mon MAX_GRAD 100 MONOTONY MON_INCREASE /end AXIS_DESCR
/end CHARACTERISTIC
/begin CHARACTERISTIC ip_eff_iga_mon2 "IP_EFF_IGA_MON2" CURVE 0x764bb a_1 100 LINEAR______0_000000__0H___1_992 0.0 1.9921875
 /begin AXIS_DESCR COM_AXIS dummy_b LINEAR______0_000000__0H____95_6 8 -95.625 0.0 AXIS_PTS_REF ldp_iga_dif_av__eff_iga_mon2 MAX_GRAD 100 MONOTONY MON_INCREASE /end AXIS_DESCR
/end CHARACTERISTIC
/begin CHARACTERISTIC ip_eoi_ti_tra_ivvt__n__cam_av_in "IP_EOI_TI_TRA_IVVT" MAP 0x764c3 a_6 20 LINEAR______300_000000__14H___54 300.0 540.0
 /begin AXIS_DESCR COM_AXIS ivvt_ivcam_av LINEAR______60_000000__0H___155_ 6 60.0 155.625 AXIS_PTS_REF ldp_cam_av_in__eoi_ti_tra_ivvt MAX_GRAD 100 MONOTONY MON_INCREASE /end AXIS_DESCR
 /begin AXIS_DESCR COM_AXIS n LINEAR______0_000000__0H___8160_ 6 0.0 8160.0 AXIS_PTS_REF ldpm_n_32_5 MAX_GRAD 100 MONOTONY MON_INCREASE /end AXIS_DESCR
/end CHARACTERISTIC
/begin CHARACTERISTIC ip_eoi_tipr__tco "IP_EOI_TIPR" CURVE 0x764e7 a_1 10 LINEAR______540_000000__0H___300 300.0 540.0
 /begin AXIS_DESCR COM_AXIS tco LINEAR_______48_000000__0H___142 8 -48.0 142.5 AXIS_PTS_REF ldpm_tco_3 MAX_GRAD 100 MONOTONY MON_INCREASE /end AXIS_DESCR
/end CHARACTERISTIC
/begin CHARACTERISTIC ip_fac_cam_sp_ex_is__tco__tco_st "IP_CAM_SP_FAC_IS_EX" MAP 0x764ef a_6 100 LINEAR_______4_000000__0H___3_96 -4.0 3.96875
 /begin AXIS_DESCR COM_AXIS tco_st LINEAR_______48_000000__0H___142 8 -48.0 142.5 AXIS_PTS_REF ldpm_tco_st_4 MAX_GRAD 100 MONOTONY MON_INCREASE /end AXIS_DESCR
 /begin AXIS_DESCR COM_AXIS tco LINEAR_______48_000000__0H___142 8 -48.0 142.5 AXIS_PTS_REF ldpm_tco_17 MAX_GRAD 100 MONOTONY MON_INCREASE /end AXIS_DESCR
/end CHARACTERISTIC
/begin CHARACTERISTIC ip_fac_cam_sp_ex_pl__tco__tco_st "IP_CAM_SP_FAC_PL_EX" MAP 0x7652f a_6 100 LINEAR_______4_000000__0H___3_96 -4.0 3.96875
 /begin AXIS_DESCR COM_AXIS tco_st LINEAR_______48_000000__0H___142 8 -48.0 142.5 AXIS_PTS_REF ldpm_tco_st_4 MAX_GRAD 100 MONOTONY MON_INCREASE /end AXIS_DESCR
 /begin AXIS_DESCR COM_AXIS tco LINEAR_______48_000000__0H___142 8 -48.0 142.5 AXIS_PTS_REF ldpm_tco_17 MAX_GRAD 100 MONOTONY MON_INCREASE /end AXIS_DESCR
/end CHARACTERISTIC
/begin CHARACTERISTIC ip_fac_cam_sp_in_is__tco__tco_st "IP_CAM_SP_FAC_IS_IN" MAP 0x7656f a_6 100 LINEAR_______4_000000__0H___3_96 -4.0 3.96875
 /begin AXIS_DESCR COM_AXIS tco_st LINEAR_______48_000000__0H___142 8 -48.0 142.5 AXIS_PTS_REF ldpm_tco_st_4 MAX_GRAD 100 MONOTONY MON_INCREASE /end AXIS_DESCR
 /begin AXIS_DESCR COM_AXIS tco LINEAR_______48_000000__0H___142 8 -48.0 142.5 AXIS_PTS_REF ldpm_tco_17 MAX_GRAD 100 MONOTONY MON_INCREASE /end AXIS_DESCR
/end CHARACTERISTIC
/begin CHARACTERISTIC ip_fac_cam_sp_in_pl__tco__tco_st "IP_CAM_SP_FAC_PL_IN" MAP 0x765af a_6 100 LINEAR_______4_000000__0H___3_96 -4.0 3.96875
 /begin AXIS_DESCR COM_AXIS tco_st LINEAR_______48_000000__0H___142 8 -48.0 142.5 AXIS_PTS_REF ldpm_tco_st_4 MAX_GRAD 100 MONOTONY MON_INCREASE /end AXIS_DESCR
 /begin AXIS_DESCR COM_AXIS tco LINEAR_______48_000000__0H___142 8 -48.0 142.5 AXIS_PTS_REF ldpm_tco_17 MAX_GRAD 100 MONOTONY MON_INCREASE /end AXIS_DESCR
/end CHARACTERISTIC
/begin CHARACTERISTIC ip_fac_cat_dly__cat_diag "IP_FAC_CAT_DLY" CURVE 0x79cca a_24 100 LINEAR______0_000000__0H___0_999 0.0 0.99998474
 /begin AXIS_DESCR COM_AXIS dummy_b LINEAR______0_000000__0H___2559_ 6 0.0 2559.9609 AXIS_PTS_REF ldp_cat_diag__fac_cat_diag MAX_GRAD 100 MONOTONY MON_INCREASE /end AXIS_DESCR
/end CHARACTERISTIC
/begin CHARACTERISTIC ip_fac_cop_ron__iga_dif "IP_FAC_COP_RON" CURVE 0x79cd6 a_3 100 LINEAR______1_000000__8000H___1_ 1.0 1.99997
 /begin AXIS_DESCR COM_AXIS dummy_b LINEAR______0_000000__0H___95_22 4 0.0 95.625 AXIS_PTS_REF ldpm_iga_dif_3 MAX_GRAD 100 MONOTONY MON_INCREASE /end AXIS_DESCR
/end CHARACTERISTIC
/begin CHARACTERISTIC ip_fac_ctl_cc_cru_ac__t_ctl_cru "IP_FAC_CTL_CC_CRU_AC" CURVE 0x765ef a_1 10 LINEAR______0_000000__0H___1_992 0.0 1.9921875
 /begin AXIS_DESCR COM_AXIS t_ctl_cru LINEAR______0_000000__0H___25_50 5 0.0 25.5 AXIS_PTS_REF ldpm_t_ctl_cru_1 MAX_GRAD 100 MONOTONY MON_INCREASE /end AXIS_DESCR
/end CHARACTERISTIC
/begin CHARACTERISTIC ip_fac_ctl_cc_cru_deacc__tctlcru "IP_FAC_CTL_CC_CRU_DEACC" CURVE 0x765f4 a_1 10 LINEAR______0_000000__0H___1_992 0.0 1.9921875
 /begin AXIS_DESCR COM_AXIS t_ctl_cru LINEAR______0_000000__0H___25_50 5 0.0 25.5 AXIS_PTS_REF ldpm_t_ctl_cru_1 MAX_GRAD 100 MONOTONY MON_INCREASE /end AXIS_DESCR
/end CHARACTERISTIC
/begin CHARACTERISTIC ip_fac_ctl_cru_ac__t_ctl_cru "IP_FAC_CTL_CRU_AC" CURVE 0x765f9 a_1 10 LINEAR______0_000000__0H___1_992 0.0 1.9921875
 /begin AXIS_DESCR COM_AXIS t_ctl_cru LINEAR______0_000000__0H___25_50 5 0.0 25.5 AXIS_PTS_REF ldpm_t_ctl_cru_1 MAX_GRAD 100 MONOTONY MON_INCREASE /end AXIS_DESCR
/end CHARACTERISTIC
/begin CHARACTERISTIC ip_fac_ctl_cru_deacc__t_ctl_cru "IP_FAC_CTL_CRU_DEACC" CURVE 0x765fe a_1 10 LINEAR______0_000000__0H___1_992 0.0 1.9921875
 /begin AXIS_DESCR COM_AXIS t_ctl_cru LINEAR______0_000000__0H___25_50 5 0.0 25.5 AXIS_PTS_REF ldpm_t_ctl_cru_1 MAX_GRAD 100 MONOTONY MON_INCREASE /end AXIS_DESCR
/end CHARACTERISTIC
/begin CHARACTERISTIC ip_fac_ctl_cru_rest__t_ctl_cru "IP_FAC_CTL_CRU_REST" CURVE 0x76603 a_1 10 LINEAR______0_000000__0H___1_992 0.0 1.9921875
 /begin AXIS_DESCR COM_AXIS t_ctl_cru LINEAR______0_000000__0H___25_50 5 0.0 25.5 AXIS_PTS_REF ldpm_t_ctl_cru_1 MAX_GRAD 100 MONOTONY MON_INCREASE /end AXIS_DESCR
/end CHARACTERISTIC
/begin CHARACTERISTIC ip_fac_ctl_ivvt_ex__n "IP_FAC_CTL_IVVT_EX" CURVE 0x76608 a_1 10 LINEAR______0_000000__0H___3_984 0.0 3.984375
 /begin AXIS_DESCR COM_AXIS n LINEAR______0_000000__0H___8160_ 6 0.0 8160.0 AXIS_PTS_REF ldpm_n_32_22 MAX_GRAD 100 MONOTONY MON_INCREASE /end AXIS_DESCR
/end CHARACTERISTIC
/begin CHARACTERISTIC ip_fac_ctl_ivvt_in__n "IP_FAC_CTL_IVVT_IN" CURVE 0x7660e a_1 10 LINEAR______0_000000__0H___3_984 0.0 3.984375
 /begin AXIS_DESCR COM_AXIS n LINEAR______0_000000__0H___8160_ 6 0.0 8160.0 AXIS_PTS_REF ldpm_n_32_22 MAX_GRAD 100 MONOTONY MON_INCREASE /end AXIS_DESCR
/end CHARACTERISTIC
/begin CHARACTERISTIC ip_fac_cur_dmtl__vb_dmtl_fil "IP_FAC_CUR_DMTL" CURVE 0x76614 a_7 100 LINEAR______0_000000__0H___1_992 0.0 1.9921875
 /begin AXIS_DESCR COM_AXIS vb_dmtl_filvwordC1D LINEAR______0_000000__0H___26_30 6 0.0 26.0 AXIS_PTS_REF ldp_vb_dmtl_fil__fac_cur_dmtl MAX_GRAD 100 MONOTONY MON_INCREASE /end AXIS_DESCR
 FUNCTION_LIST DMTL /end CHARACTERISTIC
/begin CHARACTERISTIC ip_fac_dec_cp__maf_kgh "IP_FAC_DEC_CP" CURVE 0x79cfe a_24 10 LINEAR______0_000000__0H___0_999 0.0 0.99998474
 /begin AXIS_DESCR COM_AXIS maf_kgh LINEAR______0_000000__0H___16383 8 0.0 16383.75 AXIS_PTS_REF ldpm_maf_kgh_1 MAX_GRAD 100 MONOTONY MON_INCREASE /end AXIS_DESCR
/end CHARACTERISTIC
/begin CHARACTERISTIC ip_fac_dly_p__maf_kgh "IP_FAC_DLY_P" CURVE 0x79d0e a_24 100 LINEAR______0_000000__0H___3_999 0.0 3.999939
 /begin AXIS_DESCR COM_AXIS maf_kgh LINEAR______0_000000__0H___16383 6 0.0 16383.75 AXIS_PTS_REF ldpm_maf_kgh_3 MAX_GRAD 100 MONOTONY MON_INCREASE /end AXIS_DESCR
/end CHARACTERISTIC
/begin CHARACTERISTIC ip_fac_drv2_at_er__n_32 "IP_FAC_DRV2_AT_ER" CURVE 0x79d1a a_3 100 LINEAR______0_000000__0H___3_996 0.0 3.9960001
 /begin AXIS_DESCR COM_AXIS n_32 LINEAR______0_000000__0H___8160_ 4 0.0 8160.0 AXIS_PTS_REF ldpm_n_32_43 MAX_GRAD 100 MONOTONY MON_INCREASE /end AXIS_DESCR
/end CHARACTERISTIC
/begin CHARACTERISTIC ip_fac_drv2_mt_er__n_32 "IP_FAC_DRV2_MT_ER" CURVE 0x79d22 a_3 100 LINEAR______0_000000__0H___3_996 0.0 3.9960001
 /begin AXIS_DESCR COM_AXIS n_32 LINEAR______0_000000__0H___8160_ 4 0.0 8160.0 AXIS_PTS_REF ldpm_n_32_44 MAX_GRAD 100 MONOTONY MON_INCREASE /end AXIS_DESCR
/end CHARACTERISTIC
/begin CHARACTERISTIC ip_fac_er__n__maf "IP_FAC_ER" MAP 0x76626 a_6 10 LINEAR______0_000000__0H___2_550 0.0 2.55
 /begin AXIS_DESCR COM_AXIS maf LINEAR______0_000000__0H___1389_ 6 0.0 1389.0 AXIS_PTS_REF ldp_maf__fac_er MAX_GRAD 100 MONOTONY MON_INCREASE /end AXIS_DESCR
 /begin AXIS_DESCR COM_AXIS n_32 LINEAR______0_000000__0H___8160_ 6 0.0 8160.0 AXIS_PTS_REF ldp_n_32__fac_er MAX_GRAD 100 MONOTONY MON_INCREASE /end AXIS_DESCR
/end CHARACTERISTIC
/begin CHARACTERISTIC ip_fac_iga_ch_2__tco__t_ast "IP_FAC_IGA_CH_2" MAP 0x7664a a_31 15 LINEAR______0_000000__0H___0_996 0.0 0.99609375
 /begin AXIS_DESCR COM_AXIS t_ast LINEAR______0_000000__0H___6553_ 8 0.0 6553.5 AXIS_PTS_REF ldpm_t_ast_1 MAX_GRAD 100 MONOTONY MON_INCREASE /end AXIS_DESCR
 /begin AXIS_DESCR COM_AXIS dummy_b LINEAR_______48_000000__0H___142 8 -48.0 142.5 AXIS_PTS_REF ldpm_tco_6 MAX_GRAD 100 MONOTONY MON_INCREASE /end AXIS_DESCR
/end CHARACTERISTIC
/begin CHARACTERISTIC ip_fac_iga_cs_is__n_dif "IP_FAC_IGA_CS_IS" CURVE 0x7668a a_7 100 LINEAR______0_000000__0H___1_032 0.0 1.0
 /begin AXIS_DESCR COM_AXIS n_dif LINEAR_______32768_000000__0H___ 4 -32768.0 32767.0 AXIS_PTS_REF ldp_n_dif__fac_iga_cs_is MAX_GRAD 100 MONOTONY MON_INCREASE /end AXIS_DESCR
 FUNCTION_LIST Z10I /end CHARACTERISTIC
/begin CHARACTERISTIC ip_fac_iga_tqr__iga_dif "IP_FAC_IGA_TQR" CURVE 0x79d2a a_3 20 LINEAR______0_000000__0H___0_999 0.0 0.99998474
 /begin AXIS_DESCR COM_AXIS dummy_b LINEAR_______48_000000__80H___0_ 8 -48.0 0.0 AXIS_PTS_REF ldp_iga_dif__fac_iga_tqr MAX_GRAD 100 MONOTONY MON_INCREASE /end AXIS_DESCR
/end CHARACTERISTIC
/begin CHARACTERISTIC ip_fac_iga_tra__tia__fac_ron "IP_FAC_IGA_TRA" MAP 0x7668e a_6 10 LINEAR______0_000000__0H___0_996 0.0 0.99609375
 /begin AXIS_DESCR COM_AXIS fac_ron_ad LINEAR______0_000000__0H___1_033 3 0.0 1.0 AXIS_PTS_REF ldp_fac_ron__fac_iga_tra MAX_GRAD 100 MONOTONY MON_INCREASE /end AXIS_DESCR
 /begin AXIS_DESCR COM_AXIS tia LINEAR_______48_000000__0H___142 4 -48.0 142.5 AXIS_PTS_REF ldp_tia__fac_iga_tra MAX_GRAD 100 MONOTONY MON_INCREASE /end AXIS_DESCR
/end CHARACTERISTIC
/begin CHARACTERISTIC ip_fac_iga_tra_gear__gear__vs "IP_FAC_IGA_TRA_GEAR" MAP 0x7669a a_6 100 LINEAR______0_000000__0H___0_996 0.0 0.99609375
 /begin AXIS_DESCR COM_AXIS vs LINEAR______0_000000__0H___25511 6 0.0 255.0 AXIS_PTS_REF ldp_vs__fac_iga_tra_gear MAX_GRAD 100 MONOTONY MON_INCREASE /end AXIS_DESCR
 /begin AXIS_DESCR COM_AXIS gear LINEAR______0_000000__0H___7_000 6 0.0 7.0 AXIS_PTS_REF ldpm_gear_1 MAX_GRAD 100 MONOTONY MON_INCREASE /end AXIS_DESCR
/end CHARACTERISTIC
/begin CHARACTERISTIC ip_fac_igcfb__n__maf "IP_FAC_IGCFB" MAP 0x766be a_6 10 LINEAR______0_000000__0H___2_550 0.0 2.55
 /begin AXIS_DESCR COM_AXIS maf LINEAR______0_000000__0H___1389_ 6 0.0 1389.0 AXIS_PTS_REF ldp_maf__fac_igcfb MAX_GRAD 100 MONOTONY MON_INCREASE /end AXIS_DESCR
 /begin AXIS_DESCR COM_AXIS n_32 LINEAR______0_000000__0H___8160_ 6 0.0 8160.0 AXIS_PTS_REF ldp_n_32__fac_igcfb MAX_GRAD 100 MONOTONY MON_INCREASE /end AXIS_DESCR
/end CHARACTERISTIC
/begin CHARACTERISTIC ip_fac_inc_cp__maf_kgh "IP_FAC_INC_CP" CURVE 0x79d3a a_24 10 LINEAR______0_000000__0H___0_999 0.0 0.99998474
 /begin AXIS_DESCR COM_AXIS maf_kgh LINEAR______0_000000__0H___16383 8 0.0 16383.75 AXIS_PTS_REF ldpm_maf_kgh_1 MAX_GRAD 100 MONOTONY MON_INCREASE /end AXIS_DESCR
/end CHARACTERISTIC
/begin CHARACTERISTIC ip_fac_is_ivvt__tco__tco_st "IP_FAC_IS_IVVT" MAP 0x766e2 a_6 100 LINEAR_______4_000000__0H___3_96 -4.0 3.96875
 /begin AXIS_DESCR COM_AXIS tco_st LINEAR_______48_000000__0H___142 8 -48.0 142.5 AXIS_PTS_REF ldpm_tco_st_4 MAX_GRAD 100 MONOTONY MON_INCREASE /end AXIS_DESCR
 /begin AXIS_DESCR COM_AXIS tco LINEAR_______48_000000__0H___142 8 -48.0 142.5 AXIS_PTS_REF ldpm_tco_17 MAX_GRAD 100 MONOTONY MON_INCREASE /end AXIS_DESCR
/end CHARACTERISTIC
/begin CHARACTERISTIC ip_fac_isapwm_load_cor "IP_FAC_ISAPWM_LOAD_COR" MAP 0x79daa a_28 100 LINEAR______0_000000__0H___15_99 0.0 15.999756
 /begin AXIS_DESCR COM_AXIS isapwm_load LINEAR______0_000000__0H___399_9 4 0.0 399.9938 AXIS_PTS_REF ldp_isapwm_load__fac_isapwm_cor MAX_GRAD 100 MONOTONY MON_INCREASE /end AXIS_DESCR
 /begin AXIS_DESCR COM_AXIS n LINEAR______0_000000__0H___81612 4 0.0 8160.0 AXIS_PTS_REF ldp_n__fac_isapwm_load_cor MAX_GRAD 100 MONOTONY MON_INCREASE /end AXIS_DESCR
/end CHARACTERISTIC
/begin CHARACTERISTIC ip_fac_isapwm_n_sp_add_sif__tco "IP_FAC_ISAPWM_N_SP_ADD_SIF" CURVE 0x76722 a_1 100 LINEAR______0_000000__0H___0_996 0.0 0.99609375
 /begin AXIS_DESCR COM_AXIS tco LINEAR_______48_000000__0H___142 6 -48.0 142.5 AXIS_PTS_REF ldpm_tco_4 MAX_GRAD 100 MONOTONY MON_INCREASE /end AXIS_DESCR
/end CHARACTERISTIC
/begin CHARACTERISTIC ip_fac_isapwm_vb__vb "IP_FAC_ISAPWM_VB" CURVE 0x76728 a_1 10 LINEAR______0_000000__0H___1_992 0.0 1.9921875
 /begin AXIS_DESCR COM_AXIS vb LINEAR______0_000000__0H___26_00 8 0.0 26.0 AXIS_PTS_REF ldpm_vb_1 MAX_GRAD 100 MONOTONY MON_INCREASE /end AXIS_DESCR
/end CHARACTERISTIC
/begin CHARACTERISTIC ip_fac_ivvt_ch__n__maf_ivvt "IP_FAC_IVVT_CH" MAP 0x76730 a_6 100 LINEAR______0_000000__0H___0_934 0.0 0.99609375
 /begin AXIS_DESCR COM_AXIS maf_ivvt LINEAR______0_000000__0H___1389_ 6 0.0 1389.0 AXIS_PTS_REF ldp_maf_ivvt__cam_fac_ch MAX_GRAD 100 MONOTONY MON_INCREASE /end AXIS_DESCR
 /begin AXIS_DESCR COM_AXIS n_32 LINEAR______0_000000__0H___8160_ 6 0.0 8160.0 AXIS_PTS_REF ldp_n_32__cam_fac_ch MAX_GRAD 100 MONOTONY MON_INCREASE /end AXIS_DESCR
/end CHARACTERISTIC
/begin CHARACTERISTIC ip_fac_ivvtpwm_vb__vb "IP_FAC_IVVTPWM_VB" CURVE 0x76754 a_1 100 LINEAR______0_000000__0H___1_992 0.0 1.9921875
 /begin AXIS_DESCR COM_AXIS vb LINEAR______0_000000__0H___26_00 3 0.0 26.0 AXIS_PTS_REF ldp_vb__fac_ivvtpwm_vb MAX_GRAD 100 MONOTONY MON_INCREASE /end AXIS_DESCR
/end CHARACTERISTIC
/begin CHARACTERISTIC ip_fac_knk_0__n__maf "IP_FAK_KNK_0 (Cyl1)" MAP 0x76757 a_6 3 LINEAR______0_000000__0H___7_935 0.0 7.9679999
 /begin AXIS_DESCR COM_AXIS maf_knk LINEAR______0_000000__0H___1389_ 4 0.0 1389.0 AXIS_PTS_REF ldpm_maf_5 MAX_GRAD 100 MONOTONY MON_INCREASE /end AXIS_DESCR
 /begin AXIS_DESCR COM_AXIS n_knk LINEAR______0_000000__0H___8160_ 16 0.0 8160.0 AXIS_PTS_REF ldpm_n_32_8 MAX_GRAD 100 MONOTONY MON_INCREASE /end AXIS_DESCR
/end CHARACTERISTIC
/begin CHARACTERISTIC ip_fac_knk_1__n__maf "IP_FAK_KNK_1 (Cyl5)" MAP 0x76797 a_6 3 LINEAR______0_000000__0H___7_935 0.0 7.9679999
 /begin AXIS_DESCR COM_AXIS maf_knk LINEAR______0_000000__0H___1389_ 4 0.0 1389.0 AXIS_PTS_REF ldpm_maf_5 MAX_GRAD 100 MONOTONY MON_INCREASE /end AXIS_DESCR
 /begin AXIS_DESCR COM_AXIS n_knk LINEAR______0_000000__0H___8160_ 16 0.0 8160.0 AXIS_PTS_REF ldpm_n_32_8 MAX_GRAD 100 MONOTONY MON_INCREASE /end AXIS_DESCR
/end CHARACTERISTIC
/begin CHARACTERISTIC ip_fac_knk_2__n__maf "IP_FAK_KNK_3 (Cyl2)" MAP 0x767d7 a_6 3 LINEAR______0_000000__0H___7_935 0.0 7.9679999
 /begin AXIS_DESCR COM_AXIS maf_knk LINEAR______0_000000__0H___1389_ 4 0.0 1389.0 AXIS_PTS_REF ldpm_maf_5 MAX_GRAD 100 MONOTONY MON_INCREASE /end AXIS_DESCR
 /begin AXIS_DESCR COM_AXIS n_knk LINEAR______0_000000__0H___8160_ 16 0.0 8160.0 AXIS_PTS_REF ldpm_n_32_8 MAX_GRAD 100 MONOTONY MON_INCREASE /end AXIS_DESCR
/end CHARACTERISTIC
/begin CHARACTERISTIC ip_fac_knk_3__n__maf "IP_FAK_KNK_3 (Cyl6)" MAP 0x76817 a_6 3 LINEAR______0_000000__0H___7_935 0.0 7.9679999
 /begin AXIS_DESCR COM_AXIS maf_knk LINEAR______0_000000__0H___1389_ 4 0.0 1389.0 AXIS_PTS_REF ldpm_maf_5 MAX_GRAD 100 MONOTONY MON_INCREASE /end AXIS_DESCR
 /begin AXIS_DESCR COM_AXIS n_knk LINEAR______0_000000__0H___8160_ 16 0.0 8160.0 AXIS_PTS_REF ldpm_n_32_8 MAX_GRAD 100 MONOTONY MON_INCREASE /end AXIS_DESCR
/end CHARACTERISTIC
/begin CHARACTERISTIC ip_fac_knk_4__n__maf "IP_FAK_KNK_4 (Cyl2)" MAP 0x76857 a_6 3 LINEAR______0_000000__0H___7_935 0.0 7.9679999
 /begin AXIS_DESCR COM_AXIS maf_knk LINEAR______0_000000__0H___1389_ 4 0.0 1389.0 AXIS_PTS_REF ldpm_maf_5 MAX_GRAD 100 MONOTONY MON_INCREASE /end AXIS_DESCR
 /begin AXIS_DESCR COM_AXIS n_knk LINEAR______0_000000__0H___8160_ 16 0.0 8160.0 AXIS_PTS_REF ldpm_n_32_8 MAX_GRAD 100 MONOTONY MON_INCREASE /end AXIS_DESCR
/end CHARACTERISTIC
/begin CHARACTERISTIC ip_fac_knk_5__n__maf "IP_FAK_KNK_5 (Cyl4)" MAP 0x76897 a_6 3 LINEAR______0_000000__0H___7_935 0.0 7.9679999
 /begin AXIS_DESCR COM_AXIS maf_knk LINEAR______0_000000__0H___1389_ 4 0.0 1389.0 AXIS_PTS_REF ldpm_maf_5 MAX_GRAD 100 MONOTONY MON_INCREASE /end AXIS_DESCR
 /begin AXIS_DESCR COM_AXIS n_knk LINEAR______0_000000__0H___8160_ 16 0.0 8160.0 AXIS_PTS_REF ldpm_n_32_8 MAX_GRAD 100 MONOTONY MON_INCREASE /end AXIS_DESCR
/end CHARACTERISTIC
/begin CHARACTERISTIC ip_fac_knk_diag__tia__tco "IP_FAC_KNK_DIAG" MAP 0x768d7 a_6 100 LINEAR______0_003906__0H___1_000 0.00390625 1.0
 /begin AXIS_DESCR COM_AXIS tco LINEAR_______48_000000__0H___142 4 -48.0 142.5 AXIS_PTS_REF ldp_tco__fac_knk_diag MAX_GRAD 100 MONOTONY MON_INCREASE /end AXIS_DESCR
 /begin AXIS_DESCR COM_AXIS tia LINEAR_______48_000000__0H___142 4 -48.0 142.5 AXIS_PTS_REF ldp_tia__fac_knk_diag MAX_GRAD 100 MONOTONY MON_INCREASE /end AXIS_DESCR
/end CHARACTERISTIC
/begin CHARACTERISTIC ip_fac_lam_dly__n__maf "IP_FAC_LAM_DLY" MAP 0x79dca a_36 100 LINEAR______0_000000__0H___1_999 0.0 1.99997
 /begin AXIS_DESCR COM_AXIS maf LINEAR______0_000000__0H___1389_ 8 0.0 1389.0 AXIS_PTS_REF ldpm_maf_4 MAX_GRAD 100 MONOTONY MON_INCREASE /end AXIS_DESCR
 /begin AXIS_DESCR COM_AXIS n LINEAR______0_000000__0H___81612 8 0.0 8160.0 AXIS_PTS_REF ldpm_n_7 MAX_GRAD 100 MONOTONY MON_INCREASE /end AXIS_DESCR
/end CHARACTERISTIC
/begin CHARACTERISTIC ip_fac_lam_pu__tco "IP_FAC_LAM_PU" CURVE 0x768e7 a_1 100 LINEAR______0_000000__0H___0_996 0.0 0.99609375
 /begin AXIS_DESCR COM_AXIS tco LINEAR_______48_000000__0H___142 3 -48.0 142.5 AXIS_PTS_REF ldp_tco__fac_lam_pu MAX_GRAD 100 MONOTONY MON_INCREASE /end AXIS_DESCR
/end CHARACTERISTIC
/begin CHARACTERISTIC ip_fac_lgrd_cru_rest__vs_sp_dif "IP_FAC_LGRD_CRU_REST" CURVE 0x768ea a_7 10 LINEAR______0_000000__0H___0_996 0.0 0.99609375
 /begin AXIS_DESCR COM_AXIS vs_sp_dif_cru LINEAR_______256_000000__0H___25 5 -256.0 255.99218 AXIS_PTS_REF ldpm_vs_sp_dif_cru_1 MAX_GRAD 100 MONOTONY MON_INCREASE /end AXIS_DESCR
/end CHARACTERISTIC
/begin CHARACTERISTIC ip_fac_lgrd_cru_tip__vs_sp_dif "IP_FAC_LGRD_CRU_TIP" CURVE 0x768ef a_7 10 LINEAR______0_000000__0H___0_996 0.0 0.99609375
 /begin AXIS_DESCR COM_AXIS vs_sp_dif_cru LINEAR_______256_000000__0H___25 5 -256.0 255.99218 AXIS_PTS_REF ldpm_vs_sp_dif_cru_1 MAX_GRAD 100 MONOTONY MON_INCREASE /end AXIS_DESCR
/end CHARACTERISTIC
/begin CHARACTERISTIC ip_fac_maf_1_cyl_lam__maf_kgh "IP_FAC_MAF_1_CYL_LAM" CURVE 0x768f4 a_7 100 LINEAR______0_000000__0H___1_992 0.0 1.9921875
 /begin AXIS_DESCR COM_AXIS maf_kgh LINEAR______0_000000__0H___16383 6 0.0 16383.75 AXIS_PTS_REF ldp_maf_kgh__fac_maf_1_cyl_lam MAX_GRAD 100 MONOTONY MON_INCREASE /end AXIS_DESCR
 FUNCTION_LIST CSCM /end CHARACTERISTIC
/begin CHARACTERISTIC ip_fac_maf_2_cyl_lam__maf_kgh "IP_FAC_MAF_2_CYL_LAM" CURVE 0x768fa a_7 100 LINEAR______0_000000__0H___1_992 0.0 1.9921875
 /begin AXIS_DESCR COM_AXIS maf_kgh LINEAR______0_000000__0H___16383 6 0.0 16383.75 AXIS_PTS_REF ldp_maf_kgh__fac_maf_2_cyl_lam MAX_GRAD 100 MONOTONY MON_INCREASE /end AXIS_DESCR
 FUNCTION_LIST CSCM /end CHARACTERISTIC
/begin CHARACTERISTIC ip_fac_mtcpwm_vb__vb "IP_FAC_MTCPWM_VB" CURVE 0x76906 a_1 10 LINEAR______0_000000__0H___1_937 0.0 1.9921875
 /begin AXIS_DESCR COM_AXIS vb LINEAR______0_000000__0H___26_00 8 0.0 26.0 AXIS_PTS_REF ldpm_vb_1 MAX_GRAD 100 MONOTONY MON_INCREASE /end AXIS_DESCR
/end CHARACTERISTIC
/begin CHARACTERISTIC ip_fac_n_sp_add_sif__tco "IP_FAC_N_SP_ADD_SIF" CURVE 0x7690e a_1 100 LINEAR______0_000000__0H___0_996 0.0 0.99609375
 /begin AXIS_DESCR COM_AXIS tco LINEAR_______48_000000__0H___142 6 -48.0 142.5 AXIS_PTS_REF ldpm_tco_4 MAX_GRAD 100 MONOTONY MON_INCREASE /end AXIS_DESCR
/end CHARACTERISTIC
/begin CHARACTERISTIC ip_fac_pgas_l_ti "FAC_PGAS_L_TI" CURVE 0x79e4a a_24 100 LINEAR______0_000000__0H___7_999 0.0 7.999878
 /begin AXIS_DESCR COM_AXIS dummy_w LINEAR______0_000000__0H___16338 16 0.0 16383.75 AXIS_PTS_REF ldp_pgas_l__fac_pgas_l_ti MAX_GRAD 100 MONOTONY MON_INCREASE /end AXIS_DESCR
 FUNCTION_LIST CNG /end CHARACTERISTIC
/begin CHARACTERISTIC ip_fac_pl_ivvt__tco__tco_st "IP_FAC_PL_IVVT" MAP 0x76914 a_6 100 LINEAR_______4_000000__0H___3_96 -4.0 3.96875
 /begin AXIS_DESCR COM_AXIS tco_st LINEAR_______48_000000__0H___142 8 -48.0 142.5 AXIS_PTS_REF ldpm_tco_st_4 MAX_GRAD 100 MONOTONY MON_INCREASE /end AXIS_DESCR
 /begin AXIS_DESCR COM_AXIS tco LINEAR_______48_000000__0H___142 8 -48.0 142.5 AXIS_PTS_REF ldpm_tco_17 MAX_GRAD 100 MONOTONY MON_INCREASE /end AXIS_DESCR
/end CHARACTERISTIC
/begin CHARACTERISTIC ip_fac_pq_gas_ti "FAC_PQ_GAS_TI" CURVE 0x79e6a a_24 100 LINEAR______0_000000__0H___7_999 0.0 7.999878
 /begin AXIS_DESCR COM_AXIS dummy_w LINEAR______0_000000__0H___0_999 16 0.0 0.99998474 AXIS_PTS_REF ldp_pq_gas__fac_pq_gas_ti MAX_GRAD 100 MONOTONY MON_INCREASE /end AXIS_DESCR
 FUNCTION_LIST CNG /end CHARACTERISTIC
/begin CHARACTERISTIC ip_fac_pq_isa__isapwm "IP_FAC_PQ_ISA" CURVE 0x76954 a_7 10 LINEAR______0_000000__0H___1_992 0.0 1.9921875
 /begin AXIS_DESCR COM_AXIS isapwm LINEAR______0_000000__0H___99_99 4 0.0 99.998474 AXIS_PTS_REF ldp_isapwm__fac_pq_isa MAX_GRAD 100 MONOTONY MON_INCREASE /end AXIS_DESCR
/end CHARACTERISTIC
/begin CHARACTERISTIC ip_fac_pq_isa_mon "IP_FAC_PQ_ISA_MON" CURVE 0x7e730 a_7 10 LINEAR______0_000000__0H___1_992 0.0 1.9921875
 /begin AXIS_DESCR COM_AXIS isapwm LINEAR______0_000000__0H___99_99 4 0.0 99.998474 AXIS_PTS_REF ldp_isapwm__fac_pq_isa_mon MAX_GRAD 100 MONOTONY MON_INCREASE /end AXIS_DESCR
/end CHARACTERISTIC
/begin CHARACTERISTIC ip_fac_pvs_isa__pvs_cor_rpl__n "IP_FAC_PVS_ISA" MAP 0x76958 a_39 100 LINEAR______0_000000__0H___3_984 0.0 3.984375
 /begin AXIS_DESCR COM_AXIS n LINEAR______0_000000__0H___8160_ 12 0.0 8160.0 AXIS_PTS_REF ldp_n_32__fac_pvs_isa MAX_GRAD 100 MONOTONY MON_INCREASE /end AXIS_DESCR
 /begin AXIS_DESCR COM_AXIS pvs_cor_rpl LINEAR______0_000000__0H___119_8 12 0.0 119.8828 AXIS_PTS_REF ldp_pvs_cor_rpl__fac_pvs_isa MAX_GRAD 100 MONOTONY MON_INCREASE /end AXIS_DESCR
/end CHARACTERISTIC
/begin CHARACTERISTIC ip_fac_ramp_cp__lamvdifcp__faccp "IP_FAC_RAMP_CP" MAP 0x769e8 a_39 100 LINEAR______0_000000__0H___15_94 0.0 15.94
 /begin AXIS_DESCR COM_AXIS fac_cp LINEAR______0_000000__0H___0_996 3 0.0 0.99609375 AXIS_PTS_REF ldp_fac_cp__fac_ramp_cp MAX_GRAD 100 MONOTONY MON_INCREASE /end AXIS_DESCR
 /begin AXIS_DESCR COM_AXIS lrvlam_mv_dif_cp LINEAR_______50_000000__0H___440 3 -50.0 49.998471 AXIS_PTS_REF ldp_lam_mv_dif_cp__fac_ramp_cp MAX_GRAD 100 MONOTONY MON_INCREASE /end AXIS_DESCR
/end CHARACTERISTIC
/begin CHARACTERISTIC ip_fac_rest__t_ast__tco_stop "IP_FAC_REST" MAP 0x769f1 a_39 100 LINEAR______0_000000__0H___0_996 0.0 0.99609375
 /begin AXIS_DESCR COM_AXIS tco_stop LINEAR_______48_000000__0H___142 8 -48.0 142.5 AXIS_PTS_REF ldp_tco_stop__fac_rest MAX_GRAD 100 MONOTONY MON_INCREASE /end AXIS_DESCR
 /begin AXIS_DESCR COM_AXIS t_ast_rest LINEAR______0_000000__0H___6553_ 8 0.0 6553.5 AXIS_PTS_REF ldp_t_ast_rest__fac_rest MAX_GRAD 100 MONOTONY MON_INCREASE /end AXIS_DESCR
/end CHARACTERISTIC
/begin CHARACTERISTIC ip_fac_ron_ad_max__tia__tco "IP_FAC_RON_AD_MAX" MAP 0x76a31 a_6 20 LINEAR______0_000000__0H___0_996 0.0 0.99609375
 /begin AXIS_DESCR COM_AXIS tco LINEAR_______48_000000__0H___142 4 -48.0 142.5 AXIS_PTS_REF ldp_tco_ip_fac_ron_ad_max MAX_GRAD 100 MONOTONY MON_INCREASE /end AXIS_DESCR
 /begin AXIS_DESCR COM_AXIS tia LINEAR_______48_000000__0H___142 4 -48.0 142.5 AXIS_PTS_REF ldp_tia_ip_fac_ron_ad_max MAX_GRAD 100 MONOTONY MON_INCREASE /end AXIS_DESCR
/end CHARACTERISTIC
/begin CHARACTERISTIC ip_fac_ron_dec__n "IP_FAC_RON_DEC" CURVE 0x79eb2 a_3 10 LINEAR______0_000000__0H___0_999 0.0 0.99998474
 /begin AXIS_DESCR COM_AXIS n_32 LINEAR______0_000000__0H___8160_ 4 0.0 8160.0 AXIS_PTS_REF ldpm_n_32_52 MAX_GRAD 100 MONOTONY MON_INCREASE /end AXIS_DESCR
/end CHARACTERISTIC
/begin CHARACTERISTIC ip_fac_ron_inc__n "IP_FAC_RON_INC" CURVE 0x79eba a_3 10 LINEAR______0_000000__0H___0_999 0.0 0.99998474
 /begin AXIS_DESCR COM_AXIS n_32 LINEAR______0_000000__0H___8160_ 4 0.0 8160.0 AXIS_PTS_REF ldpm_n_32_52 MAX_GRAD 100 MONOTONY MON_INCREASE /end AXIS_DESCR
/end CHARACTERISTIC
/begin CHARACTERISTIC ip_fac_t_accin_inc__n "IP_FAC_T_ACCIN_INC" CURVE 0x79ec2 a_24 5 LINEAR______0_000200__1H___0_062 0.0002 0.06248
 /begin AXIS_DESCR COM_AXIS n LINEAR______0_000000__0H___81612 4 0.0 8160.0 AXIS_PTS_REF ldp_n__fac_t_accin_inc MAX_GRAD 25 /end AXIS_DESCR
/end CHARACTERISTIC
/begin CHARACTERISTIC ip_fac_t_dly__tco__tco_st "IP_FAC_T_DLY" MAP 0x76a41 a_6 100 LINEAR_______4_000000__0H___3_96 -4.0 3.96875
 /begin AXIS_DESCR COM_AXIS tco_st LINEAR_______48_000000__0H___142 8 -48.0 142.5 AXIS_PTS_REF ldpm_tco_st_4 MAX_GRAD 100 MONOTONY MON_INCREASE /end AXIS_DESCR
 /begin AXIS_DESCR COM_AXIS tco LINEAR_______48_000000__0H___142 8 -48.0 142.5 AXIS_PTS_REF ldpm_tco_17 MAX_GRAD 100 MONOTONY MON_INCREASE /end AXIS_DESCR
/end CHARACTERISTIC
/begin CHARACTERISTIC ip_fac_tco_tqi__tco "IP_FAC_TCO_TQI" CURVE 0x76a81 a_1 5 LINEAR______0_000000__0H___1_992 0.0 1.9921875
 /begin AXIS_DESCR COM_AXIS tco LINEAR_______48_000000__0H___142 6 -48.0 142.5 AXIS_PTS_REF ldp_tco__fac_tco_tqi MAX_GRAD 100 MONOTONY MON_INCREASE /end AXIS_DESCR
/end CHARACTERISTIC
/begin CHARACTERISTIC ip_fac_tgas_l_ti "FAC_TGAS_L_TI" CURVE 0x79eca a_3 100 LINEAR______0_000000__0H___1_999 0.0 1.99997
 /begin AXIS_DESCR COM_AXIS dummy_b LINEAR_______48_000000__0H___143 10 -48.0 143.25 AXIS_PTS_REF ldpm_tgas_l MAX_GRAD 100 MONOTONY MON_INCREASE /end AXIS_DESCR
 FUNCTION_LIST CNG /end CHARACTERISTIC
/begin CHARACTERISTIC ip_fac_thd_er__tco "IP_FAC_THD_ER" CURVE 0x79ede a_3 5 LINEAR______1_000000__100H___1_9 1.0 1.9961
 /begin AXIS_DESCR COM_AXIS tco LINEAR_______48_000000__0H___142 8 -48.0 142.5 AXIS_PTS_REF ldp_tco__thd_er MAX_GRAD 100 MONOTONY MON_INCREASE /end AXIS_DESCR
/end CHARACTERISTIC
/begin CHARACTERISTIC ip_fac_thd_er_ch_2__iga_ch_2 "IP_FAC_THD_ER_CH_2" CURVE 0x76a87 a_1 100 LINEAR______0_000000__0H___1_992 0.0 1.9921875
 /begin AXIS_DESCR COM_AXIS iga_ch_2 LINEAR_______48_000000__0H___041 4 -48.0 0.0 AXIS_PTS_REF ldp_iga_ch_2__fac_thd_er_ch_2 MAX_GRAD 100 MONOTONY MON_INCREASE /end AXIS_DESCR
/end CHARACTERISTIC
/begin CHARACTERISTIC ip_fac_thd_er_ch_3__iga_ch_3 "IP_FAC_THD_ER_CH_3" CURVE 0x76a8b a_1 100 LINEAR______0_000000__0H___1_992 0.0 1.9921875
 /begin AXIS_DESCR COM_AXIS iga_ch_3vbyteC1D LINEAR_______48_000000__0H___041 4 -48.0 0.0 AXIS_PTS_REF ldp_iga_ch_3__fac_thd_er_ch_3 MAX_GRAD 100 MONOTONY MON_INCREASE /end AXIS_DESCR
/end CHARACTERISTIC
/begin CHARACTERISTIC ip_fac_thd_er_is__iga_mv_12 "IP_FAC_THD_ER_IS" CURVE 0x76a8f a_1 100 LINEAR______0_000000__0H___1_992 0.0 1.9921875
 /begin AXIS_DESCR COM_AXIS iga_mv_12 LINEAR_______23_625000__0H___72_ 6 -23.625 72.0 AXIS_PTS_REF ldp_iga_mv_12__fac_thd_er_is MAX_GRAD 100 MONOTONY MON_INCREASE /end AXIS_DESCR
/end CHARACTERISTIC
/begin CHARACTERISTIC ip_fac_thd_er_is_diag__tco "IP_FAC_THD_ER_IS_DIAG" CURVE 0x76a95 a_1 10 LINEAR______1_000000__80H___1_99 1.0 1.992
 /begin AXIS_DESCR COM_AXIS tco LINEAR_______48_000000__0H___142 8 -48.0 142.5 AXIS_PTS_REF ldp_tco__tco_fac_thd_is_er_diag MAX_GRAD 25 MONOTONY MON_INCREASE /end AXIS_DESCR
/end CHARACTERISTIC
/begin CHARACTERISTIC ip_fac_ti_cat_var__tco "IP_FAC_TI_CAT_VAR" CURVE 0x76a9d a_1 100 LINEAR______0_000000__0H___0_996 0.0 0.99609375
 /begin AXIS_DESCR COM_AXIS tco LINEAR_______48_000000__0H___142 2 -48.0 142.5 AXIS_PTS_REF ldp_tco__fac_ti_cat_var MAX_GRAD 100 MONOTONY MON_INCREASE /end AXIS_DESCR
/end CHARACTERISTIC
/begin CHARACTERISTIC ip_fac_ti_map_wf__map "IP_FAC_TI_MAP_WF" CURVE 0x76a9f a_7 100 LINEAR______0_000000__0H___0_996 0.0 0.99609375
 /begin AXIS_DESCR COM_AXIS map LINEAR______0_000000__0H___5434_ 4 0.0 5434.2598 AXIS_PTS_REF ldp_map__fac_ti_map_wf MAX_GRAD 100 MONOTONY MON_INCREASE /end AXIS_DESCR
/end CHARACTERISTIC
/begin CHARACTERISTIC ip_fac_tia_tco__tco__tia "IP_FAC_TIA_TCO" MAP 0x76aa3 a_6 5 LINEAR______0_000000__0H___0_996 0.0 0.99609375
 /begin AXIS_DESCR COM_AXIS tia LINEAR_______48_000000__0H___142 6 -48.0 142.5 AXIS_PTS_REF ldp_tia__fac_tia_tco MAX_GRAD 100 MONOTONY MON_INCREASE /end AXIS_DESCR
 /begin AXIS_DESCR COM_AXIS tia LINEAR_______48_000000__0H___142 6 -48.0 142.5 AXIS_PTS_REF ldp_tco__fac_tia_tco MAX_GRAD 100 MONOTONY MON_INCREASE /end AXIS_DESCR
/end CHARACTERISTIC
/begin CHARACTERISTIC ip_fac_tia_tco_is__tco__tia "IP_FAC_TIA_TCO_IS" MAP 0x76ac7 a_6 10 LINEAR______0_000000__0H___0_996 0.0 0.99609375
 /begin AXIS_DESCR COM_AXIS tia LINEAR_______48_000000__0H___142 4 -48.0 142.5 AXIS_PTS_REF ldp_tia__fac_tia_tco_is MAX_GRAD 100 MONOTONY MON_INCREASE /end AXIS_DESCR
 /begin AXIS_DESCR COM_AXIS tco LINEAR_______48_000000__0H___142 4 -48.0 142.5 AXIS_PTS_REF ldp_tco__fac_tia_tco_is MAX_GRAD 100 MONOTONY MON_INCREASE /end AXIS_DESCR
/end CHARACTERISTIC
/begin CHARACTERISTIC ip_fac_toil_facron__toil__facron "IP_FAC_TOIL_FACRON" MAP 0x76ad7 a_31 10 LINEAR______0_000000__0H___0_996 0.0 0.99609375
 /begin AXIS_DESCR COM_AXIS fac_ron_ad LINEAR______0_000000__0H___0_999 4 0.0 0.99998474 AXIS_PTS_REF ldp_fac_ron_ad__fac_toil_facron MAX_GRAD 100 MONOTONY MON_INCREASE /end AXIS_DESCR
 /begin AXIS_DESCR COM_AXIS toil LINEAR_______48_000000__0H___155 4 -48.0 155.0 AXIS_PTS_REF ldp_toil__fac_toil_facron MAX_GRAD 100 MONOTONY MON_INCREASE /end AXIS_DESCR
/end CHARACTERISTIC
/begin CHARACTERISTIC ip_fac_tps_isa__tps_av "IP_FAC_TPS_ISA" CURVE 0x76ae7 a_7 100 LINEAR______0_000000__0H___106_2 0.0 106.24
 /begin AXIS_DESCR COM_AXIS tps_av_prj LINEAR______0_000000__0H___119_9 6 0.0 119.99817 AXIS_PTS_REF ldp_tps_av__fac_tps_isa MAX_GRAD 100 MONOTONY MON_INCREASE /end AXIS_DESCR
/end CHARACTERISTIC
/begin CHARACTERISTIC ip_fac_tps_isa_mon "IP_FAC_TPS_ISA_MON" CURVE 0x7e734 a_1 100 LINEAR______0_000000__0H___106_2 0.0 106.24
 /begin AXIS_DESCR COM_AXIS tps_av_mon LINEAR______0_000000__0H___11942 6 0.0 119.53125 AXIS_PTS_REF ldp_tps_av_mon__fac_tps_isa_mon MAX_GRAD 100 MONOTONY MON_INCREASE /end AXIS_DESCR
/end CHARACTERISTIC
/begin CHARACTERISTIC ip_fac_tq_loss_acc_off__t_acc "IP_FAC_TQ_LOSS_ACC_OFF" CURVE 0x76aed a_1 100 LINEAR______0_000000__0H___2_043 0.0 2.0
 /begin AXIS_DESCR COM_AXIS dummy_b LINEAR______0_000000__0H___2_544 8 0.0 2.55 AXIS_PTS_REF ldp_t_acc__fac_tq_loss_acc_off MAX_GRAD 100 MONOTONY MON_INCREASE /end AXIS_DESCR
/end CHARACTERISTIC
/begin CHARACTERISTIC ip_fac_tq_loss_acc_on__t_acc "IP_FAC_TQ_LOSS_ACC_ON" CURVE 0x76af5 a_1 100 LINEAR______0_000000__0H___2_043 0.0 2.0
 /begin AXIS_DESCR COM_AXIS dummy_b LINEAR______0_000000__0H___2_544 8 0.0 2.55 AXIS_PTS_REF ldp_t_acc__fac_tq_loss_acc_on MAX_GRAD 100 MONOTONY MON_INCREASE /end AXIS_DESCR
/end CHARACTERISTIC
/begin CHARACTERISTIC ip_fac_tqd_cat__pvs_av "IP_FAC_TQD_CAT" CURVE 0x79eee a_3 100 LINEAR______0_000000__0H___0_999 0.0 0.99998474
 /begin AXIS_DESCR COM_AXIS pvs_av LINEAR______0_000000__0H___11913 4 0.0 119.5 AXIS_PTS_REF ldpm_pvs_av_1 MAX_GRAD 100 MONOTONY MON_INCREASE /end AXIS_DESCR
/end CHARACTERISTIC
/begin CHARACTERISTIC ip_fac_tqd_cor__tqi_asr_can "IP_FAC_TQD_COR" CURVE 0x79ef6 a_3 100 LINEAR______0_000000__0H___0_999 0.0 0.99998474
 /begin AXIS_DESCR COM_AXIS tqi_asr_can LINEAR______0_000000__0H___100_0 4 0.0 100.0 AXIS_PTS_REF ldp_tqi_asr_can__fac_tqd_cor MAX_GRAD 100 MONOTONY MON_INCREASE /end AXIS_DESCR
/end CHARACTERISTIC
/begin CHARACTERISTIC ip_fac_tqd_cor_amt__tqi_amt_can "IP_FAC_TQD_COR_AMT" CURVE 0x79efe a_3 100 LINEAR______0_000000__0H___0_999 0.0 0.99998474
 /begin AXIS_DESCR COM_AXIS tqi_amt_can LINEAR______0_000000__0H___99_60 4 0.0 99.609375 AXIS_PTS_REF ldp_tqi_amt_can__fac_tqd_cor MAX_GRAD 100 MONOTONY MON_INCREASE /end AXIS_DESCR
 FUNCTION_LIST Z1S1 /end CHARACTERISTIC
/begin CHARACTERISTIC ip_fac_tqd_cor_lim__tqi_lim "IP_FAC_TQD_COR_LIM" CURVE 0x79f06 a_24 5 LINEAR______0_000000__0H___0_945 0.0 0.99998474
 /begin AXIS_DESCR COM_AXIS tqi_lim LINEAR______0_000000__0H___1023_ 4 0.0 1023.0 AXIS_PTS_REF ldp_tqi_lim__fac_tqd_cor_lim MAX_GRAD 100 MONOTONY MON_INCREASE /end AXIS_DESCR
/end CHARACTERISTIC
/begin CHARACTERISTIC ip_fac_turb__isapwm__pq_turb_sys "IP_FAC_TURB" MAP 0x76afd a_39 100 LINEAR______0_000000__0H___0_996 0.0 0.99609375
 /begin AXIS_DESCR COM_AXIS pq_turb_sys LINEAR______0_000000__0H___0_996 6 0.0 0.99609375 AXIS_PTS_REF ldp_pq_turb_sys__fac_turb MAX_GRAD 100 MONOTONY MON_INCREASE /end AXIS_DESCR
 /begin AXIS_DESCR COM_AXIS isapwm LINEAR______0_000000__0H___99_46 6 0.0 99.998474 AXIS_PTS_REF ldp_isapwm__fac_turb MAX_GRAD 100 MONOTONY MON_INCREASE /end AXIS_DESCR
/end CHARACTERISTIC
/begin CHARACTERISTIC ip_fco_map_cor__pq_main_col "IP_FCO_MAP_COR" CURVE 0x79f0e a_3 100 LINEAR______0_000000__0H___16_00 0.0 16.0
 /begin AXIS_DESCR COM_AXIS pq_main_col LINEAR______0_000000__0H___0_996 6 0.0 0.99609375 AXIS_PTS_REF ldp_pq_main_col__fco_map_cor MAX_GRAD 100 MONOTONY MON_INCREASE /end AXIS_DESCR
/end CHARACTERISTIC
/begin CHARACTERISTIC ip_gain_knk__n "IP_GAIN_KNK" CURVE 0x76b21 a_1 10 LINEAR______0_003906__0H___1_000 0.00390625 1.0
 /begin AXIS_DESCR COM_AXIS n LINEAR______0_000000__0H___8160_ 8 0.0 8160.0 AXIS_PTS_REF ldpm_n_32_12 MAX_GRAD 100 MONOTONY MON_INCREASE /end AXIS_DESCR
/end CHARACTERISTIC
/begin CHARACTERISTIC ip_iga_accin_puc__n__tco "IP_IGA_ACCIN_PUC" MAP 0x76b29 a_39 10 LINEAR_______23_625000__0H___72_ -23.625 72.0
 /begin AXIS_DESCR COM_AXIS tco LINEAR_______48_000000__0H___142 4 -48.0 142.5 AXIS_PTS_REF ldpm_tco_15 MAX_GRAD 100 MONOTONY MON_INCREASE /end AXIS_DESCR
 /begin AXIS_DESCR COM_AXIS n LINEAR______0_000000__0H___81612 6 0.0 8160.0 AXIS_PTS_REF ldpm_n_8 MAX_GRAD 100 MONOTONY MON_INCREASE /end AXIS_DESCR
/end CHARACTERISTIC
/begin CHARACTERISTIC ip_iga_add_pste__ang_pste__toil "IP_IGA_ADD_PSTE" MAP 0x76b41 a_39 100 LINEAR_______48_000000__0H___041 -48.0 0.0
 /begin AXIS_DESCR COM_AXIS toil LINEAR_______48_000000__0H___155 4 -48.0 155.0 AXIS_PTS_REF ldp_toil__iga_add_pste MAX_GRAD 100 MONOTONY MON_INCREASE /end AXIS_DESCR
 /begin AXIS_DESCR COM_AXIS ang_pste LINEAR_______1439_956055__0H___1 6 -1439.9561 1439.9121 AXIS_PTS_REF ldp_ang_pste__iga_add_pste MAX_GRAD 100 MONOTONY MON_INCREASE /end AXIS_DESCR
/end CHARACTERISTIC
/begin CHARACTERISTIC ip_iga_aj_ron_91__n__maf "IP_IGA_AJ_RON_91" MAP 0x76b59 a_31 5 LINEAR_______48_000000__0H___041 -48.0 0.0
 /begin AXIS_DESCR COM_AXIS maf LINEAR______0_000000__0H___13818 6 0.0 1389.0 AXIS_PTS_REF ldpm_maf_19 MAX_GRAD 100 MONOTONY MON_INCREASE /end AXIS_DESCR
 /begin AXIS_DESCR COM_AXIS n_32 LINEAR______0_000000__0H___8160_ 8 0.0 8160.0 AXIS_PTS_REF ldpm_n_32_53 MAX_GRAD 100 MONOTONY MON_INCREASE /end AXIS_DESCR
/end CHARACTERISTIC
/begin CHARACTERISTIC ip_iga_aj_ron_98__n__maf "IP_IGA_AJ_RON_98" MAP 0x76b89 a_31 5 LINEAR_______48_000000__0H___041 -48.0 0.0
 /begin AXIS_DESCR COM_AXIS maf LINEAR______0_000000__0H___13818 6 0.0 1389.0 AXIS_PTS_REF ldpm_maf_19 MAX_GRAD 100 MONOTONY MON_INCREASE /end AXIS_DESCR
 /begin AXIS_DESCR COM_AXIS n_32 LINEAR______0_000000__0H___8160_ 8 0.0 8160.0 AXIS_PTS_REF ldpm_n_32_53 MAX_GRAD 100 MONOTONY MON_INCREASE /end AXIS_DESCR
/end CHARACTERISTIC
/begin CHARACTERISTIC ip_iga_ast__n_dif_cor "IP_IGA_AST" CURVE 0x76bb9 a_7 5 LINEAR_______48_000000__0H___47_ -48.0 47.625
 /begin AXIS_DESCR COM_AXIS n_dif_cor LINEAR_______1024_000000__7C00H_ 4 -1024.0 1016.0 AXIS_PTS_REF ldp_n_dif_cor__iga_ast MAX_GRAD 100 MONOTONY MON_INCREASE /end AXIS_DESCR
/end CHARACTERISTIC
/begin CHARACTERISTIC ip_iga_ch__n__maf "IP_IGA_CH" MAP 0x76bbd a_6 15 LINEAR_______48_000000__0H___47_ -48.0 47.625
 /begin AXIS_DESCR COM_AXIS maf LINEAR______0_000000__0H___1389_ 8 0.0 1389.0 AXIS_PTS_REF ldpm_maf_10 MAX_GRAD 100 MONOTONY MON_INCREASE /end AXIS_DESCR
 /begin AXIS_DESCR COM_AXIS n LINEAR______0_000000__0H___8160_ 8 0.0 8160.0 AXIS_PTS_REF ldpm_n_32_26 MAX_GRAD 100 MONOTONY MON_INCREASE /end AXIS_DESCR
/end CHARACTERISTIC
/begin CHARACTERISTIC ip_iga_ch_2__n__pvs_av "IP_IGA_CH_2" MAP 0x76bfd a_6 15 LINEAR_______48_000000__0H___041 -48.0 0.0
 /begin AXIS_DESCR COM_AXIS pvs_av LINEAR______0_000000__0H___11913 8 0.0 119.5 AXIS_PTS_REF ldp_pvs_av__iga_ch_2 MAX_GRAD 100 MONOTONY MON_INCREASE /end AXIS_DESCR
 /begin AXIS_DESCR COM_AXIS n_32 LINEAR______0_000000__0H___8160_ 8 0.0 8160.0 AXIS_PTS_REF ldp_n_32__iga_ch_2 MAX_GRAD 100 MONOTONY MON_INCREASE /end AXIS_DESCR
/end CHARACTERISTIC
/begin CHARACTERISTIC ip_iga_ch_cat_var__n__maf "IP_IGA_CH_CAT_VAR" MAP 0x76c3d a_6 15 LINEAR_______48_000000__0H___47_ -48.0 47.625
 /begin AXIS_DESCR COM_AXIS maf LINEAR______0_000000__0H___1389_ 8 0.0 1389.0 AXIS_PTS_REF ldpm_maf_10 MAX_GRAD 100 MONOTONY MON_INCREASE /end AXIS_DESCR
 /begin AXIS_DESCR COM_AXIS n LINEAR______0_000000__0H___8160_ 8 0.0 8160.0 AXIS_PTS_REF ldpm_n_32_26 MAX_GRAD 100 MONOTONY MON_INCREASE /end AXIS_DESCR
/end CHARACTERISTIC
/begin CHARACTERISTIC ip_iga_ch_is__n "IP_IGA_CH_IS" CURVE 0x76c7d a_1 15 LINEAR_______48_000000__0H___47_ -48.0 47.625
 /begin AXIS_DESCR COM_AXIS n LINEAR______0_000000__0H___8160_ 4 0.0 8160.0 AXIS_PTS_REF ldp_n_32__iga_ch_is MAX_GRAD 100 MONOTONY MON_INCREASE /end AXIS_DESCR
/end CHARACTERISTIC
/begin CHARACTERISTIC ip_iga_cor_cam_dif_ex__cam_dif "IP_IGA_COR_CAM_DIF_EX" CURVE 0x76c81 a_1 15 LINEAR_______48_000000__0H___47_ -48.0 47.625
 /begin AXIS_DESCR COM_AXIS dummy_b LINEAR_______48_000000__0H___47_ 10 -48.0 47.625 AXIS_PTS_REF ldpm_cam_dif_1 MAX_GRAD 100 MONOTONY MON_INCREASE /end AXIS_DESCR
/end CHARACTERISTIC
/begin CHARACTERISTIC ip_iga_cor_cam_dif_in__cam_dif "IP_IGA_COR_CAM_DIF_IN" CURVE 0x76c8b a_1 15 LINEAR_______48_000000__0H___47_ -48.0 47.625
 /begin AXIS_DESCR COM_AXIS dummy_b LINEAR_______48_000000__0H___47_ 10 -48.0 47.625 AXIS_PTS_REF ldpm_cam_dif_1 MAX_GRAD 100 MONOTONY MON_INCREASE /end AXIS_DESCR
/end CHARACTERISTIC
/begin CHARACTERISTIC ip_iga_cs_is__toil "IP_IGA_CS_IS" CURVE 0x76c95 a_1 10 LINEAR_______48_000000__0H___041 -48.0 0.0
 /begin AXIS_DESCR COM_AXIS toil LINEAR_______48_000000__0H___155 6 -48.0 155.0 AXIS_PTS_REF ldpm_toil_6 MAX_GRAD 100 MONOTONY MON_INCREASE /end AXIS_DESCR
/end CHARACTERISTIC
/begin CHARACTERISTIC ip_iga_cs_is_amt__toil "IP_IGA_CS_IS_AMT" CURVE 0x76c9b a_1 10 LINEAR_______48_000000__0H___041 -48.0 0.0
 /begin AXIS_DESCR COM_AXIS toil LINEAR_______48_000000__0H___155 6 -48.0 155.0 AXIS_PTS_REF ldpm_toil_6 MAX_GRAD 100 MONOTONY MON_INCREASE /end AXIS_DESCR
/end CHARACTERISTIC
/begin CHARACTERISTIC ip_iga_dif_tqr__tqd_fac "IP_IGA_DIF_TQR" CURVE 0x76ca1 a_7 20 LINEAR_______48_000000__80H___0_ -48.0 0.0
 /begin AXIS_DESCR COM_AXIS dummy_b LINEAR______0_000000__0H___1_047 8 0.0 1.0 AXIS_PTS_REF ldp_tqd_fac__iga_dif_tqr MAX_GRAD 100 MONOTONY MON_INCREASE /end AXIS_DESCR
/end CHARACTERISTIC
/begin CHARACTERISTIC ip_iga_fac_amp_st__fac_amp "IP_IGA_FAC_AMP_ST" CURVE 0x76ca9 a_1 100 LINEAR_______48_000000__0H___47_ -48.0 47.625
 /begin AXIS_DESCR COM_AXIS fac_amp LINEAR______0_000000__0H___2_043 6 0.0 2.0 AXIS_PTS_REF ldp_fac_amp__iga_fac_amp_st MAX_GRAD 100 MONOTONY MON_INCREASE /end AXIS_DESCR
/end CHARACTERISTIC
/begin CHARACTERISTIC ip_iga_fac_is__tco "IP_IGA_FAC_IS" CURVE 0x76caf a_1 10 LINEAR______0_000000__0H___0_996 0.0 0.99609375
 /begin AXIS_DESCR COM_AXIS tco LINEAR_______48_000000__0H___142 4 -48.0 142.5 AXIS_PTS_REF ldpm_tco_8 MAX_GRAD 100 MONOTONY MON_INCREASE /end AXIS_DESCR
/end CHARACTERISTIC
/begin CHARACTERISTIC ip_iga_knk_diag__n__maf "IP_IGA_KNK_DIAG" MAP 0x76cbd a_6 100 LINEAR_______23_625000__0H___72_ -23.625 72.0
 /begin AXIS_DESCR COM_AXIS maf_knk LINEAR______0_000000__0H___1389_ 8 0.0 1389.0 AXIS_PTS_REF ldpm_maf_14 MAX_GRAD 100 MONOTONY MON_INCREASE /end AXIS_DESCR
 /begin AXIS_DESCR COM_AXIS n LINEAR______0_000000__0H___8160_ 8 0.0 8160.0 AXIS_PTS_REF ldpm_n_32_12 MAX_GRAD 100 MONOTONY MON_INCREASE /end AXIS_DESCR
/end CHARACTERISTIC
/begin CHARACTERISTIC ip_iga_knk_diag_ron__n__maf "IP_IGA_KNK_DIAG_RON" MAP 0x76cfd a_6 100 LINEAR_______23_625000__0H___72_ -23.625 72.0
 /begin AXIS_DESCR COM_AXIS maf_knk LINEAR______0_000000__0H___1389_ 8 0.0 1389.0 AXIS_PTS_REF ldpm_maf_14 MAX_GRAD 100 MONOTONY MON_INCREASE /end AXIS_DESCR
 /begin AXIS_DESCR COM_AXIS n LINEAR______0_000000__0H___8160_ 8 0.0 8160.0 AXIS_PTS_REF ldpm_n_32_12 MAX_GRAD 100 MONOTONY MON_INCREASE /end AXIS_DESCR
/end CHARACTERISTIC
/begin CHARACTERISTIC ip_iga_lgrd_max_puc__n "IP_IGA_LGRD_MAX_PUC" CURVE 0x76d55 a_7 10 LINEAR______0_375000__1H___47_62 0.375 47.625
 /begin AXIS_DESCR COM_AXIS n LINEAR______0_000000__0H___81612 4 0.0 8160.0 AXIS_PTS_REF ldpm_n_10 MAX_GRAD 100 MONOTONY MON_INCREASE /end AXIS_DESCR
/end CHARACTERISTIC
/begin CHARACTERISTIC ip_iga_lgrd_max_puc_accin__n "IP_IGA_LGRD_MAX_PUC_ACCIN" CURVE 0x76d59 a_7 10 LINEAR______0_375000__1H___47_62 0.375 47.625
 /begin AXIS_DESCR COM_AXIS n LINEAR______0_000000__0H___81612 4 0.0 8160.0 AXIS_PTS_REF ldpm_n_10 MAX_GRAD 100 MONOTONY MON_INCREASE /end AXIS_DESCR
/end CHARACTERISTIC
/begin CHARACTERISTIC ip_iga_lgrd_ris__n_grd "IP_IGA_LGRD_RIS" CURVE 0x79f1a a_3 10 LINEAR______0_001465__1H___48_00 0.001465 48.0
 /begin AXIS_DESCR COM_AXIS dummy_b LINEAR_______4096_000000__0H___4 4 -4096.0 4064.0 AXIS_PTS_REF ldp_n_grd__iga_lgrd_ris MAX_GRAD 100 MONOTONY MON_INCREASE /end AXIS_DESCR
/end CHARACTERISTIC
/begin CHARACTERISTIC ip_iga_lgrd_rpl__n "IP_IGA_LGRD_RPL" CURVE 0x79f22 a_3 1 LINEAR______0_001465__1H___47_99 0.001465 47.99854
 /begin AXIS_DESCR COM_AXIS n LINEAR______0_000000__0H___8160_ 4 0.0 8160.0 AXIS_PTS_REF ldpm_n_32_54 MAX_GRAD 100 MONOTONY MON_INCREASE /end AXIS_DESCR
/end CHARACTERISTIC
/begin CHARACTERISTIC ip_iga_maf_n__n__maf "IP_IGA_MAF_N" MAP 0x76d5d a_6 5 LINEAR_______48_000000__0H___47_ -48.0 47.625
 /begin AXIS_DESCR COM_AXIS maf_iga LINEAR______0_000000__0H___1389_ 6 0.0 1389.0 AXIS_PTS_REF ldp_maf__iga_maf_n MAX_GRAD 100 MONOTONY MON_INCREASE /end AXIS_DESCR
 /begin AXIS_DESCR COM_AXIS n_32 LINEAR______0_000000__0H___8160_ 8 0.0 8160.0 AXIS_PTS_REF ldp_n_32__iga_maf_n MAX_GRAD 100 MONOTONY MON_INCREASE /end AXIS_DESCR
/end CHARACTERISTIC
/begin CHARACTERISTIC ip_iga_maf_n_is__n__maf "IP_IGA_MAF_N_IS" MAP 0x76d8d a_6 10 LINEAR_______48_000000__0H___47_ -48.0 47.625
 /begin AXIS_DESCR COM_AXIS maf_iga LINEAR______0_000000__0H___1389_ 4 0.0 1389.0 AXIS_PTS_REF ldp_maf_iga__iga_maf_n_is MAX_GRAD 100 MONOTONY MON_INCREASE /end AXIS_DESCR
 /begin AXIS_DESCR COM_AXIS n_32 LINEAR______0_000000__0H___8160_ 4 0.0 8160.0 AXIS_PTS_REF ldp_n__iga_maf_n_is MAX_GRAD 100 MONOTONY MON_INCREASE /end AXIS_DESCR
/end CHARACTERISTIC
/begin CHARACTERISTIC ip_iga_maf_n_knk_diag__n__maf "IP_IGA_MAF_N_KNK_DIAG" MAP 0x76d9d a_6 100 LINEAR_______48_000000__0H___47_ -48.0 47.625
 /begin AXIS_DESCR COM_AXIS maf_knk LINEAR______0_000000__0H___1389_ 8 0.0 1389.0 AXIS_PTS_REF ldpm_maf_14 MAX_GRAD 100 MONOTONY MON_INCREASE /end AXIS_DESCR
 /begin AXIS_DESCR COM_AXIS n LINEAR______0_000000__0H___8160_ 8 0.0 8160.0 AXIS_PTS_REF ldpm_n_32_12 MAX_GRAD 100 MONOTONY MON_INCREASE /end AXIS_DESCR
/end CHARACTERISTIC
/begin CHARACTERISTIC ip_iga_maf_n_toil_is__n__maf "IP_IGA_MAF_N_TOIL_IS" MAP 0x76ddd a_6 100 LINEAR_______48_000000__0H___47_ -48.0 47.625
 /begin AXIS_DESCR COM_AXIS maf_iga LINEAR______0_000000__0H___1389_ 6 0.0 1389.0 AXIS_PTS_REF ldp_maf__iga_maf_n_toil_is MAX_GRAD 100 MONOTONY MON_INCREASE /end AXIS_DESCR
 /begin AXIS_DESCR COM_AXIS n_32 LINEAR______0_000000__0H___8160_ 6 0.0 8160.0 AXIS_PTS_REF ldp_n_32__iga_maf_n_toil_is MAX_GRAD 100 MONOTONY MON_INCREASE /end AXIS_DESCR
/end CHARACTERISTIC
/begin CHARACTERISTIC ip_iga_max_puc__n "IP_IGA_MAX_PUC" CURVE 0x76e01 a_7 10 LINEAR_______48_000000__0H___041 -48.0 0.0
 /begin AXIS_DESCR COM_AXIS n LINEAR______0_000000__0H___81612 4 0.0 8160.0 AXIS_PTS_REF ldpm_n_10 MAX_GRAD 100 MONOTONY MON_INCREASE /end AXIS_DESCR
/end CHARACTERISTIC
/begin CHARACTERISTIC ip_iga_max_turb__n__maf "IP_IGA_MAX_TURB" MAP 0x76e05 a_17 100 LINEAR_______48_000000__0H___47_ -48.0 47.625
 /begin AXIS_DESCR COM_AXIS maf LINEAR______0_000000__0H___13818 8 0.0 1389.0 AXIS_PTS_REF ldp_maf__iga_max_turb MAX_GRAD 100 MONOTONY MON_INCREASE /end AXIS_DESCR
 /begin AXIS_DESCR COM_AXIS n_32 LINEAR______0_000000__0H___81612 8 0.0 8160.0 AXIS_PTS_REF ldp_n__iga_max_turb MAX_GRAD 100 MONOTONY MON_INCREASE /end AXIS_DESCR
/end CHARACTERISTIC
/begin CHARACTERISTIC ip_iga_min_puc__n "IP_IGA_MIN_PUC" CURVE 0x76e45 a_7 10 LINEAR_______48_000000__0H___041 -48.0 0.0
 /begin AXIS_DESCR COM_AXIS n LINEAR______0_000000__0H___81612 4 0.0 8160.0 AXIS_PTS_REF ldpm_n_10 MAX_GRAD 100 MONOTONY MON_INCREASE /end AXIS_DESCR
/end CHARACTERISTIC
/begin CHARACTERISTIC ip_iga_n_dif_is__n_dif_cor "IP_IGA_N_DIF_IS" CURVE 0x76e49 a_7 5 LINEAR_______48_000000__0H___47_ -48.0 47.625
 /begin AXIS_DESCR COM_AXIS n_dif_cor LINEAR_______1024_000000__7C00H_ 12 -1024.0 1016.0 AXIS_PTS_REF ldp_n_dif_cor__iga_n_dif_is MAX_GRAD 100 MONOTONY MON_INCREASE /end AXIS_DESCR
/end CHARACTERISTIC
/begin CHARACTERISTIC ip_iga_optm_tco_1__n__maf "IP_IGA_OPTM_TCO_1" MAP 0x76e55 a_17 20 LINEAR_______23_625000__0H___72_ -23.625 72.0
 /begin AXIS_DESCR COM_AXIS maf_iga LINEAR______0_000000__0H___13818 12 0.0 1389.0 AXIS_PTS_REF ldpm_maf_iga_1 MAX_GRAD 100 MONOTONY MON_INCREASE /end AXIS_DESCR
 /begin AXIS_DESCR COM_AXIS n LINEAR______0_000000__0H___81612 16 0.0 8160.0 AXIS_PTS_REF ldpm_n_4 MAX_GRAD 100 MONOTONY MON_INCREASE /end AXIS_DESCR
/end CHARACTERISTIC
/begin CHARACTERISTIC ip_iga_optm_tco_2__n__maf "IP_IGA_OPTM_TCO_2" MAP 0x76f15 a_17 20 LINEAR_______23_625000__0H___72_ -23.625 72.0
 /begin AXIS_DESCR COM_AXIS maf_iga LINEAR______0_000000__0H___13818 12 0.0 1389.0 AXIS_PTS_REF ldpm_maf_iga_1 MAX_GRAD 100 MONOTONY MON_INCREASE /end AXIS_DESCR
 /begin AXIS_DESCR COM_AXIS n LINEAR______0_000000__0H___81612 16 0.0 8160.0 AXIS_PTS_REF ldpm_n_4 MAX_GRAD 100 MONOTONY MON_INCREASE /end AXIS_DESCR
/end CHARACTERISTIC
/begin CHARACTERISTIC ip_iga_pu__n__tco "IP_IGA_PU" MAP 0x76fd5 a_39 10 LINEAR_______23_625000__0H___72_ -23.625 72.0
 /begin AXIS_DESCR COM_AXIS tco LINEAR_______48_000000__0H___142 4 -48.0 142.5 AXIS_PTS_REF ldpm_tco_15 MAX_GRAD 100 MONOTONY MON_INCREASE /end AXIS_DESCR
 /begin AXIS_DESCR COM_AXIS n LINEAR______0_000000__0H___81612 6 0.0 8160.0 AXIS_PTS_REF ldpm_n_8 MAX_GRAD 100 MONOTONY MON_INCREASE /end AXIS_DESCR
/end CHARACTERISTIC
/begin CHARACTERISTIC ip_iga_puc__n__tco "IP_IGA_PUC" MAP 0x76fed a_39 10 LINEAR_______23_625000__0H___72_ -23.625 72.0
 /begin AXIS_DESCR COM_AXIS tco LINEAR_______48_000000__0H___142 4 -48.0 142.5 AXIS_PTS_REF ldpm_tco_15 MAX_GRAD 100 MONOTONY MON_INCREASE /end AXIS_DESCR
 /begin AXIS_DESCR COM_AXIS n LINEAR______0_000000__0H___81612 6 0.0 8160.0 AXIS_PTS_REF ldpm_n_8 MAX_GRAD 100 MONOTONY MON_INCREASE /end AXIS_DESCR
/end CHARACTERISTIC
/begin CHARACTERISTIC ip_iga_ref_mon "IP_IGA_REF_MON" MAP 0x7e73a a_6 100 LINEAR_______23_625000__0H___72_ -23.625 72.0
 /begin AXIS_DESCR COM_AXIS maf LINEAR______0_000000__0H___1389_ 8 0.0 1389.0 AXIS_PTS_REF ldp_maf__iga_ref_mon MAX_GRAD 100 MONOTONY MON_INCREASE /end AXIS_DESCR
 /begin AXIS_DESCR COM_AXIS n_32 LINEAR______0_000000__0H___8160_ 8 0.0 8160.0 AXIS_PTS_REF ldp_n_32__iga_ref_mon MAX_GRAD 100 MONOTONY MON_INCREASE /end AXIS_DESCR
/end CHARACTERISTIC
/begin CHARACTERISTIC ip_iga_ref_mon2 "IP_IGA_REF_MON2" MAP 0x77005 a_6 100 LINEAR_______23_625000__0H___72_ -23.625 72.0
 /begin AXIS_DESCR COM_AXIS maf_mon2 LINEAR______0_000000__0H___1389_ 8 0.0 1389.0 AXIS_PTS_REF ldp_maf__iga_ref_mon2 MAX_GRAD 100 MONOTONY MON_INCREASE /end AXIS_DESCR
 /begin AXIS_DESCR COM_AXIS n_32_mon2 LINEAR______0_000000__0H___8160_ 8 0.0 8160.0 AXIS_PTS_REF ldp_n_32__iga_ref_mon2 MAX_GRAD 100 MONOTONY MON_INCREASE /end AXIS_DESCR
/end CHARACTERISTIC
/begin CHARACTERISTIC ip_iga_ron_91_pl_ivvt__n__maf "IP_IGA_RON_91_PL_IVVT" MAP 0x77045 a_17 5 LINEAR_______23_625000__0H___72_ -23.625 72.0
 /begin AXIS_DESCR COM_AXIS maf_iga LINEAR______0_000000__0H___13818 16 0.0 1389.0 AXIS_PTS_REF ldpm_maf_iga_2 MAX_GRAD 100 MONOTONY MON_INCREASE /end AXIS_DESCR
 /begin AXIS_DESCR COM_AXIS n LINEAR______0_000000__0H___81612 20 0.0 8160.0 AXIS_PTS_REF ldpm_n_14 MAX_GRAD 100 MONOTONY MON_INCREASE /end AXIS_DESCR
/end CHARACTERISTIC
/begin CHARACTERISTIC ip_iga_ron_98_pl_ivvt__n__maf "IP_IGA_RON_98_PL_IVVT" MAP 0x77185 a_17 5 LINEAR_______23_625000__0H___72_ -23.625 72.0
 /begin AXIS_DESCR COM_AXIS maf_iga LINEAR______0_000000__0H___13818 16 0.0 1389.0 AXIS_PTS_REF ldpm_maf_iga_2 MAX_GRAD 100 MONOTONY MON_INCREASE /end AXIS_DESCR
 /begin AXIS_DESCR COM_AXIS n LINEAR______0_000000__0H___81612 20 0.0 8160.0 AXIS_PTS_REF ldpm_n_14 MAX_GRAD 100 MONOTONY MON_INCREASE /end AXIS_DESCR
/end CHARACTERISTIC
/begin CHARACTERISTIC ip_iga_rpl__n__tco "IP_IGA_RPL" MAP 0x772c5 a_6 15 LINEAR_______48_000000__0H___041 -48.0 0.0
 /begin AXIS_DESCR COM_AXIS tco LINEAR_______48_000000__0H___142 6 -48.0 142.5 AXIS_PTS_REF ldp_tco__iga_rpl MAX_GRAD 100 MONOTONY MON_INCREASE /end AXIS_DESCR
 /begin AXIS_DESCR COM_AXIS n LINEAR______0_000000__0H___8160_ 4 0.0 8160.0 AXIS_PTS_REF ldpm_n_32_54 MAX_GRAD 100 MONOTONY MON_INCREASE /end AXIS_DESCR
/end CHARACTERISTIC
/begin CHARACTERISTIC ip_iga_st__n "IP_IGA_ST" CURVE 0x772dd a_7 5 LINEAR_______23_625000__0H___72_ -23.625 72.0
 /begin AXIS_DESCR COM_AXIS n LINEAR______0_000000__0H___81612 3 0.0 8160.0 AXIS_PTS_REF ldpm_n_6 MAX_GRAD 100 MONOTONY MON_INCREASE /end AXIS_DESCR
/end CHARACTERISTIC
/begin CHARACTERISTIC ip_iga_tco_1_is_ivvt__n__maf "IP_IGA_TCO_1_IS_IVVT" MAP 0x772e0 a_17 5 LINEAR_______23_625000__0H___72_ -23.625 72.0
 /begin AXIS_DESCR COM_AXIS maf_iga LINEAR______0_000000__0H___13818 6 0.0 1389.0 AXIS_PTS_REF ldpm_maf_iga_3 MAX_GRAD 100 MONOTONY MON_INCREASE /end AXIS_DESCR
 /begin AXIS_DESCR COM_AXIS n LINEAR______0_000000__0H___81612 6 0.0 8160.0 AXIS_PTS_REF ldpm_n_2 MAX_GRAD 100 MONOTONY MON_INCREASE /end AXIS_DESCR
/end CHARACTERISTIC
/begin CHARACTERISTIC ip_iga_tco_1_pl_ivvt__n__maf "IP_IGA_TCO_1_PL_IVVT" MAP 0x77304 a_17 5 LINEAR_______23_625000__0H___72_ -23.625 72.0
 /begin AXIS_DESCR COM_AXIS maf_iga LINEAR______0_000000__0H___13818 16 0.0 1389.0 AXIS_PTS_REF ldpm_maf_iga_2 MAX_GRAD 100 MONOTONY MON_INCREASE /end AXIS_DESCR
 /begin AXIS_DESCR COM_AXIS n LINEAR______0_000000__0H___81612 20 0.0 8160.0 AXIS_PTS_REF ldpm_n_14 MAX_GRAD 100 MONOTONY MON_INCREASE /end AXIS_DESCR
/end CHARACTERISTIC
/begin CHARACTERISTIC ip_iga_tco_2_is_ivvt__n__maf "IP_IGA_TCO_2_IS_IVVT" MAP 0x77444 a_17 5 LINEAR_______23_625000__0H___72_ -23.625 72.0
 /begin AXIS_DESCR COM_AXIS maf_iga LINEAR______0_000000__0H___13818 6 0.0 1389.0 AXIS_PTS_REF ldpm_maf_iga_3 MAX_GRAD 100 MONOTONY MON_INCREASE /end AXIS_DESCR
 /begin AXIS_DESCR COM_AXIS n LINEAR______0_000000__0H___81612 6 0.0 8160.0 AXIS_PTS_REF ldpm_n_2 MAX_GRAD 100 MONOTONY MON_INCREASE /end AXIS_DESCR
/end CHARACTERISTIC
/begin CHARACTERISTIC ip_iga_tco_ch_at__tco__t_ast "IP_IGA_TCO_CH_AT" MAP 0x77468 a_31 100 LINEAR______0_000000__0H___0_996 0.0 0.99609375
 /begin AXIS_DESCR COM_AXIS t_ast LINEAR______0_000000__0H___6553_ 8 0.0 6553.5 AXIS_PTS_REF ldpm_t_ast_2 MAX_GRAD 100 MONOTONY MON_INCREASE /end AXIS_DESCR
 /begin AXIS_DESCR COM_AXIS tco LINEAR_______48_000000__0H___142 8 -48.0 142.5 AXIS_PTS_REF ldpm_tco_19 MAX_GRAD 100 MONOTONY MON_INCREASE /end AXIS_DESCR
/end CHARACTERISTIC
/begin CHARACTERISTIC ip_iga_tco_ch_is__tco__t_ast "IP_IGA_TCO_CAT_IS" MAP 0x774a8 a_31 100 LINEAR______0_000000__0H___0_996 0.0 0.99609375
 /begin AXIS_DESCR COM_AXIS t_ast LINEAR______0_000000__0H___6553_ 8 0.0 6553.5 AXIS_PTS_REF ldpm_t_ast_1 MAX_GRAD 100 MONOTONY MON_INCREASE /end AXIS_DESCR
 /begin AXIS_DESCR COM_AXIS dummy_b LINEAR_______48_000000__0H___142 8 -48.0 142.5 AXIS_PTS_REF ldpm_tco_6 MAX_GRAD 100 MONOTONY MON_INCREASE /end AXIS_DESCR
/end CHARACTERISTIC
/begin CHARACTERISTIC ip_iga_tco_ch_mt__tco__t_ast "IP_IGA_TCO_CH_MT" MAP 0x774e8 a_31 100 LINEAR______0_000000__0H___0_996 0.0 0.99609375
 /begin AXIS_DESCR COM_AXIS t_ast LINEAR______0_000000__0H___6553_ 8 0.0 6553.5 AXIS_PTS_REF ldpm_t_ast_2 MAX_GRAD 100 MONOTONY MON_INCREASE /end AXIS_DESCR
 /begin AXIS_DESCR COM_AXIS tco LINEAR_______48_000000__0H___142 8 -48.0 142.5 AXIS_PTS_REF ldpm_tco_19 MAX_GRAD 100 MONOTONY MON_INCREASE /end AXIS_DESCR
/end CHARACTERISTIC
/begin CHARACTERISTIC ip_iga_tco_is__tco "IP_IGA_TCO_IS" CURVE 0x77528 a_1 5 LINEAR_______48_000000__0H___448 -48.0 47.625
 /begin AXIS_DESCR COM_AXIS tco LINEAR_______48_000000__0H___142 6 -48.0 142.5 AXIS_PTS_REF ldpm_tco_4 MAX_GRAD 100 MONOTONY MON_INCREASE /end AXIS_DESCR
/end CHARACTERISTIC
/begin CHARACTERISTIC ip_iga_tco_st__tco "IP_IGA_TCO_ST" CURVE 0x7752e a_1 5 LINEAR_______48_000000__0H___47_ -48.0 47.625
 /begin AXIS_DESCR COM_AXIS tco LINEAR_______48_000000__0H___142 8 -48.0 142.5 AXIS_PTS_REF ldpm_tco_3 MAX_GRAD 100 MONOTONY MON_INCREASE /end AXIS_DESCR
/end CHARACTERISTIC
/begin CHARACTERISTIC ip_iga_tqr__n__maf "IP_IGA_TQR" MAP 0x77536 a_6 20 LINEAR_______23_625000__0H___72_ -23.625 72.0
 /begin AXIS_DESCR COM_AXIS maf LINEAR______0_000000__0H___1389_ 8 0.0 1389.0 AXIS_PTS_REF ldpm_maf_6 MAX_GRAD 100 MONOTONY MON_INCREASE /end AXIS_DESCR
 /begin AXIS_DESCR COM_AXIS n LINEAR______0_000000__0H___8160_ 9 0.0 8160.0 AXIS_PTS_REF ldpm_n_32_19 MAX_GRAD 100 MONOTONY MON_INCREASE /end AXIS_DESCR
/end CHARACTERISTIC
/begin CHARACTERISTIC ip_iga_tqr_amt__n__maf "IP_IGA_TQR_AMT" MAP 0x7757e a_6 20 LINEAR_______23_625000__0H___72_ -23.625 72.0
 /begin AXIS_DESCR COM_AXIS maf LINEAR______0_000000__0H___1389_ 8 0.0 1389.0 AXIS_PTS_REF ldp_maf__iga_tqr_amt MAX_GRAD 100 MONOTONY MON_INCREASE /end AXIS_DESCR
 /begin AXIS_DESCR COM_AXIS n_32 LINEAR______0_000000__0H___8160_ 9 0.0 8160.0 AXIS_PTS_REF ldp_n_32__iga_tqr_amt MAX_GRAD 100 MONOTONY MON_INCREASE /end AXIS_DESCR
/end CHARACTERISTIC
/begin CHARACTERISTIC ip_iga_tra_knk__n__maf "IP_IGA_TRA_KNK" MAP 0x775c6 a_6 10 LINEAR_______48_000000__0H___041 -48.0 0.0
 /begin AXIS_DESCR COM_AXIS maf_iga LINEAR______0_000000__0H___1389_ 4 0.0 1389.0 AXIS_PTS_REF ldp_maf_iga__iga_tra_knk MAX_GRAD 100 MONOTONY MON_INCREASE /end AXIS_DESCR
 /begin AXIS_DESCR COM_AXIS n LINEAR______0_000000__0H___8160_ 4 0.0 8160.0 AXIS_PTS_REF ldpm_n_32_16 MAX_GRAD 100 MONOTONY MON_INCREASE /end AXIS_DESCR
/end CHARACTERISTIC
/begin CHARACTERISTIC ip_igab__n__maf "IP_IGAB" MAP 0x775d6 a_17 5 LINEAR_______23_625000__0H___72_ -23.625 72.0
 /begin AXIS_DESCR COM_AXIS maf_iga LINEAR______0_000000__0H___13818 12 0.0 1389.0 AXIS_PTS_REF ldpm_maf_iga_1 MAX_GRAD 100 MONOTONY MON_INCREASE /end AXIS_DESCR
 /begin AXIS_DESCR COM_AXIS n LINEAR______0_000000__0H___81612 16 0.0 8160.0 AXIS_PTS_REF ldpm_n_4 MAX_GRAD 100 MONOTONY MON_INCREASE /end AXIS_DESCR
/end CHARACTERISTIC
/begin CHARACTERISTIC ip_igab_adc__tco "IP_IGAB_ADC" CURVE 0x77696 a_1 5 LINEAR_______23_625000__0H___72_ -23.625 72.0
 /begin AXIS_DESCR COM_AXIS tco LINEAR_______48_000000__0H___142 4 -48.0 142.5 AXIS_PTS_REF ldpm_tco_8 MAX_GRAD 100 MONOTONY MON_INCREASE /end AXIS_DESCR
/end CHARACTERISTIC
/begin CHARACTERISTIC ip_igab_is__n__maf "IP_IGAB_IS" MAP 0x7769a a_17 100 LINEAR_______23_625000__0H___72_ -23.625 72.0
 /begin AXIS_DESCR COM_AXIS maf_iga LINEAR______0_000000__0H___13818 4 0.0 1389.0 AXIS_PTS_REF ldp_maf_iga__igab_is MAX_GRAD 100 MONOTONY MON_INCREASE /end AXIS_DESCR
 /begin AXIS_DESCR COM_AXIS n LINEAR______0_000000__0H___81612 4 0.0 8160.0 AXIS_PTS_REF ldp_n__igab_is MAX_GRAD 100 MONOTONY MON_INCREASE /end AXIS_DESCR
/end CHARACTERISTIC
/begin CHARACTERISTIC ip_isapwm__tco "IP_ISAPWM" CURVE 0x79f2a a_3 10 LINEAR______0_000000__0H___399_9 0.0 399.9938
 /begin AXIS_DESCR COM_AXIS tco LINEAR_______48_000000__0H___142 6 -48.0 142.5 AXIS_PTS_REF ldpm_tco_4 MAX_GRAD 100 MONOTONY MON_INCREASE /end AXIS_DESCR
/end CHARACTERISTIC
/begin CHARACTERISTIC ip_isapwm_accin__tq_acc__tam "IP_ISAPWM_ACCIN" MAP 0x79f36 a_9 10 LINEAR______0_000000__0H___399_9 0.0 399.9938
 /begin AXIS_DESCR COM_AXIS tam LINEAR_______128_000000__0H___12 4 -128.0 127.0 AXIS_PTS_REF ldp_tam__isapwm_accin MAX_GRAD 100 MONOTONY MON_INCREASE /end AXIS_DESCR
 /begin AXIS_DESCR COM_AXIS dummy_b LINEAR______0_000000__0H___31_00 4 0.0 31.0 AXIS_PTS_REF ldpm_tq_accin_can_1 MAX_GRAD 100 MONOTONY MON_INCREASE /end AXIS_DESCR
/end CHARACTERISTIC
/begin CHARACTERISTIC ip_isapwm_accin_n_maf__n__pq "IP_ISAPWM_ACCIN_N_MAF" MAP 0x79f56 a_36 3 LINEAR______0_000000__0H___15_99 0.0 15.999756
 /begin AXIS_DESCR COM_AXIS pq_turb_sys LINEAR______0_000000__0H___0_996 6 0.0 0.99609375 AXIS_PTS_REF ldpm_pq_turb_sys_1 MAX_GRAD 100 MONOTONY MON_INCREASE /end AXIS_DESCR
 /begin AXIS_DESCR COM_AXIS n LINEAR______0_000000__0H___81612 4 0.0 8160.0 AXIS_PTS_REF ldpm_n_9 MAX_GRAD 100 MONOTONY MON_INCREASE /end AXIS_DESCR
/end CHARACTERISTIC
/begin CHARACTERISTIC ip_isapwm_accin_tra__n__tq_acc "IP_ISAPWM_ACCIN_TRA" MAP 0x79f86 a_36 10 LINEAR_______200_000000__0H___19 -200.0 199.9938
 /begin AXIS_DESCR COM_AXIS dummy_b LINEAR______0_000000__0H___31_00 4 0.0 31.0 AXIS_PTS_REF ldpm_tq_accin_can_1 MAX_GRAD 100 MONOTONY MON_INCREASE /end AXIS_DESCR
 /begin AXIS_DESCR COM_AXIS n LINEAR______0_000000__0H___81612 4 0.0 8160.0 AXIS_PTS_REF ldpm_n_9 MAX_GRAD 100 MONOTONY MON_INCREASE /end AXIS_DESCR
/end CHARACTERISTIC
/begin CHARACTERISTIC ip_isapwm_acin__tco "IP_ISAPWM_ACIN" CURVE 0x79fa6 a_3 10 LINEAR______0_000000__0H___399_9 0.0 399.9938
 /begin AXIS_DESCR COM_AXIS tco LINEAR_______48_000000__0H___142 6 -48.0 142.5 AXIS_PTS_REF ldpm_tco_4 MAX_GRAD 100 MONOTONY MON_INCREASE /end AXIS_DESCR
/end CHARACTERISTIC
/begin CHARACTERISTIC ip_isapwm_amt__tco "IP_ISAPWM_AMT" CURVE 0x7a072 a_3 100 LINEAR______0_000000__0H___399_9 0.0 399.9938
 /begin AXIS_DESCR COM_AXIS tco LINEAR_______48_000000__0H___142 6 -48.0 142.5 AXIS_PTS_REF ldpm_tco_4 MAX_GRAD 100 MONOTONY MON_INCREASE /end AXIS_DESCR
 FUNCTION_LIST Z1S1 /end CHARACTERISTIC
/begin CHARACTERISTIC ip_isapwm_ast__tco "IP_ISAPWM_AST" CURVE 0x7a07e a_3 100 LINEAR______0_000000__0H___399_9 0.0 399.9938
 /begin AXIS_DESCR COM_AXIS tco LINEAR_______48_000000__0H___142 6 -48.0 142.5 AXIS_PTS_REF ldpm_tco_25 MAX_GRAD 100 MONOTONY MON_INCREASE /end AXIS_DESCR
/end CHARACTERISTIC
/begin CHARACTERISTIC ip_isapwm_ast_lgrd_dec__tco "IP_ISAPWM_AST_LGRD_DEC" CURVE 0x7a08a a_3 100 LINEAR______0_006100__1H___24_99 0.0061 24.9938
 /begin AXIS_DESCR COM_AXIS tco LINEAR_______48_000000__0H___142 6 -48.0 142.5 AXIS_PTS_REF ldpm_tco_25 MAX_GRAD 100 MONOTONY MON_INCREASE /end AXIS_DESCR
/end CHARACTERISTIC
/begin CHARACTERISTIC ip_isapwm_at__tco "IP_ISAPWM_AT" CURVE 0x7a096 a_3 100 LINEAR______0_000000__0H___399_9 0.0 399.9938
 /begin AXIS_DESCR COM_AXIS tco LINEAR_______48_000000__0H___142 6 -48.0 142.5 AXIS_PTS_REF ldpm_tco_4 MAX_GRAD 100 MONOTONY MON_INCREASE /end AXIS_DESCR
/end CHARACTERISTIC
/begin CHARACTERISTIC ip_isapwm_ch_dec__tco "IP_ISAPWM_CH_DEC" CURVE 0x7a102 a_3 100 LINEAR______0_006100__1H___24_99 0.0061 24.9938
 /begin AXIS_DESCR COM_AXIS tco LINEAR_______48_000000__0H___142 8 -48.0 142.5 AXIS_PTS_REF ldpm_tco_13 MAX_GRAD 100 MONOTONY MON_INCREASE /end AXIS_DESCR
/end CHARACTERISTIC
/begin CHARACTERISTIC ip_isapwm_ch_iga__tco__igadifch "IP_ISAPWM_CH_IGA" MAP 0x7a112 a_9 100 LINEAR______0_000000__0H___399_9 0.0 399.9938
 /begin AXIS_DESCR COM_AXIS iga_ch_ofsvbyteC1D LINEAR_______48_000000__0H___041 6 -48.0 0.0 AXIS_PTS_REF ldp_iga_dif_ch_1__isapwm_ch_iga MAX_GRAD 100 MONOTONY MON_INCREASE /end AXIS_DESCR
 /begin AXIS_DESCR COM_AXIS tco LINEAR_______48_000000__0H___142 8 -48.0 142.5 AXIS_PTS_REF ldpm_tco_13 MAX_GRAD 100 MONOTONY MON_INCREASE /end AXIS_DESCR
/end CHARACTERISTIC
/begin CHARACTERISTIC ip_isapwm_cor_isa__isapwm_tps "IP_ISAPWM_COR_ISA" CURVE 0x7a17a a_24 100 LINEAR______0_000000__0H___99_99 0.0 99.998474
 /begin AXIS_DESCR COM_AXIS NO_INPUT_QUANTITY LINEAR______0_000000__0H___99_99 8 0.0 99.998474 AXIS_PTS_REF ldp_isapwm_tps__isapwm_cor_isa MAX_GRAD 100 MONOTONY MON_INCREASE /end AXIS_DESCR
/end CHARACTERISTIC
/begin CHARACTERISTIC ip_isapwm_crlc__pvs_grd "IP_ISAPWM_CRLC" CURVE 0x776aa a_1 100 LINEAR______0_000000__0H___0_996 0.0 0.99609375
 /begin AXIS_DESCR COM_AXIS pvs_grd LINEAR______0_000000__0H___2988_ 4 0.0 2988.0 AXIS_PTS_REF ldp_pvs_grd__isapwm_crlc MAX_GRAD 100 MONOTONY MON_INCREASE /end AXIS_DESCR
/end CHARACTERISTIC
/begin CHARACTERISTIC ip_isapwm_d_is__n_grd "IP_ISAPWM_D_IS" CURVE 0x776ae a_1 10 LINEAR_______50_000000__0H___49_ -50.0 49.6094
 /begin AXIS_DESCR COM_AXIS dummy_b LINEAR_______4096_000000__0H___4 4 -4096.0 4064.0 AXIS_PTS_REF ldp_n_grd__isapwm_d_is MAX_GRAD 100 MONOTONY MON_INCREASE /end AXIS_DESCR
/end CHARACTERISTIC
/begin AXIS_PTS ldpm_tst_rec_idx_mon2 "TEST_REC_IDX_MON2" 0x74001 tst_rec_idx_mon2 a_742 100 LINEAR______0_000000__0H___9_000 10 0.0 9.0 /end AXIS_PTS
/begin AXIS_PTS ldpm_n_32_8 "N" 0x7400c n_knk a_742 20 LINEAR______0_000000__0H___8160_ 16 0.0 8160.0 /end AXIS_PTS
/begin AXIS_PTS ldpm_tst_rec "TEST_REC" 0x7401d dummy_b a_742 100 LINEAR______0_000000__0H___9_000 10 0.0 9.0 /end AXIS_PTS
/begin AXIS_PTS ldp_n_32__crlc_maf_diag "N" 0x74028 n_32 a_742 100 LINEAR______0_000000__0H___8160_ 4 0.0 8160.0 /end AXIS_PTS
/begin AXIS_PTS ldpm_n_32_16 "N" 0x7402d n a_742 20 LINEAR______0_000000__0H___8160_ 4 0.0 8160.0 /end AXIS_PTS
/begin AXIS_PTS ldp_n_32__deacc_n "N" 0x74032 n_32 a_742 100 LINEAR______0_000000__0H___8160_ 4 0.0 8160.0 /end AXIS_PTS
/begin AXIS_PTS ldpm_toil_3 "TOIL" 0x74037 toil a_742 100 LINEAR_______48_000000__0H___155 6 -48.0 155.0 /end AXIS_PTS
/begin AXIS_PTS ldpm_vb_mmv_1 "VB_MMV" 0x7403e vb_mmv a_742 8 LINEAR______0_000000__0H___26_00 2 0.0 26.0 /end AXIS_PTS
/begin AXIS_PTS ldpm_temp_mmv_sub_cat_1 "TEMP_MMV_SUB_CAT" 0x74041 temp_mmv_sub_cat a_742 100 LINEAR_______33_000000__0H___987 6 -33.0 987.0 /end AXIS_PTS
/begin AXIS_PTS ldp_tco_sp__ectpwm_add "TCO_SP" 0x74051 dummy_b a_742 100 LINEAR_______48_000000__0H___142 8 -48.0 142.5 /end AXIS_PTS
/begin AXIS_PTS ldp_n_32__ectpwm_add "N" 0x74048 n a_742 100 LINEAR______0_000000__0H___8160_ 8 0.0 8160.0 /end AXIS_PTS
/begin AXIS_PTS ldpm_km_ctr_2 "KM_CTR" 0x74aca km_ctr a_743 100 LINEAR______0_000000__0H___65534 4 0.0 655340.0 /end AXIS_PTS
/begin AXIS_PTS ldp_tia__fac_knks_thd "TIA" 0x7405a tia a_742 100 LINEAR_______48_000000__0H___142 6 -48.0 142.5 /end AXIS_PTS
/begin AXIS_PTS ldpm_cycnr_1 "CYCNR" 0x74061 dummy_b a_742 100 LINEAR______1_000000__1H___16_00 16 1.0 16.0 /end AXIS_PTS
/begin AXIS_PTS ldpm_n_32_23 "N" 0x74072 n a_742 10 LINEAR______0_000000__0H___8160_ 4 0.0 8160.0 /end AXIS_PTS
/begin AXIS_PTS ldp_n_vs_cru__gear "N_VS_CRU" 0x74ad4 n_vs_cru a_743 100 LINEAR______0_000000__0H___81608 6 0.0 8160.0 /end AXIS_PTS
/begin AXIS_PTS ldpm_n_32_18 "N" 0x74077 n_knk a_742 10 LINEAR______0_000000__0H___8160_ 6 0.0 8160.0 /end AXIS_PTS
/begin AXIS_PTS ldpm_n_32_2 "N" 0x7407e n a_742 100 LINEAR______0_000000__0H___8160_ 8 0.0 8160.0 /end AXIS_PTS
/begin AXIS_PTS ldpm_n_32_45 "N" 0x74087 n_32 a_742 100 LINEAR______0_000000__0H___8160_ 6 0.0 8160.0 /end AXIS_PTS
/begin AXIS_PTS ldpm_tmag_1 "TMAG" 0x745d9 tmag a_742 100 LINEAR_______48_000000__0H___155 6 -48.0 155.0 /end AXIS_PTS
/begin AXIS_PTS ldp_vel_drift__ivvthpwm_cor_ad "VEL_DRIFT" 0x7408e dummy_b a_742 100 LINEAR______0_000000__0H___95_62 6 0.0 95.625 /end AXIS_PTS
/begin AXIS_PTS ldpm_maf_5 "MAF" 0x74095 maf_knk a_742 5 LINEAR______0_000000__0H___1389_ 4 0.0 1389.0 /end AXIS_PTS
/begin AXIS_PTS ldpm_tco_st_8 "TCO_ST" 0x7409a tco_st a_742 14 LINEAR_______48_000000__0H___142 6 -48.0 142.5 /end AXIS_PTS
/begin AXIS_PTS ldp_id_maf_tab_2 "" 0x740b2 dummy_b a_742 100 LINEAR______0_000000__0H___255_0 16 0.0 255.0 /end AXIS_PTS
/begin AXIS_PTS ldp_id_maf_tab_1 "" 0x740a1 dummy_b a_742 100 LINEAR______0_000000__0H___255_0 16 0.0 255.0 /end AXIS_PTS
/begin AXIS_PTS ldp_temp_sub_cat__mis_a_obd "TEMP_MMV_SUB_CAT" 0x74ae2 temp_mmv_sub_cat a_743 100 LINEAR_______33_000000__0H___991 6 -33.0 991.0 /end AXIS_PTS
/begin AXIS_PTS ldp_n_ecf__n_ecf_min_accin "N_ECF" 0x740c3 n_ecf a_742 100 LINEAR______0_000000__0H___15_00 16 0.0 15.0 /end AXIS_PTS
/begin AXIS_PTS ldpm_gear_2 "gear" 0x740d9 gear a_742 10 LINEAR______0_000000__0H___7_000 6 0.0 7.0 /end AXIS_PTS
/begin AXIS_PTS ldpm_vs_2 "VS" 0x740d4 vs a_742 100 LINEAR______0_000000__0H___25511 4 0.0 255.0 /end AXIS_PTS
/begin AXIS_PTS ldpm_gear_3 "gear" 0x740e0 gear a_742 10 LINEAR______0_000000__0H___7_000 6 0.0 7.0 /end AXIS_PTS
/begin AXIS_PTS ldp_vs__n_max_cycnr "VS" 0x740e7 vs a_742 12 LINEAR______0_000000__0H___25511 5 0.0 255.0 /end AXIS_PTS
/begin AXIS_PTS ldp_n_32__n_max_cycnr_diag "N" 0x740ed n_32 a_742 100 LINEAR______0_000000__0H___8160_ 4 0.0 8160.0 /end AXIS_PTS
/begin AXIS_PTS ldpm_gear_1 "gear" 0x740f2 gear a_742 10 LINEAR______0_000000__0H___7_000 6 0.0 7.0 /end AXIS_PTS
/begin AXIS_PTS ldp_maf__o2_int_max_at "MAF" 0x74100 maf a_742 10 LINEAR______0_000000__0H___1389_ 6 0.0 1389.0 /end AXIS_PTS
/begin AXIS_PTS ldp_n__o2_int_max_at "N" 0x740f9 n_32 a_742 10 LINEAR______0_000000__0H___8160_ 6 0.0 8160.0 /end AXIS_PTS
/begin AXIS_PTS ldp_maf__o2_int_max_mt "MAF" 0x7410e maf a_742 10 LINEAR______0_000000__0H___1389_ 6 0.0 1389.0 /end AXIS_PTS
/begin AXIS_PTS ldp_n__o2_int_max_mt "N" 0x74107 n_32 a_742 10 LINEAR______0_000000__0H___8160_ 6 0.0 8160.0 /end AXIS_PTS
/begin AXIS_PTS ldp_nr_pat__pat_fcut "NR_PAT" 0x74115 dummy_b a_742 100 LINEAR______0_000000__0H___13_00 14 0.0 13.0 /end AXIS_PTS
/begin AXIS_PTS ldpm_n_11 "N" 0x74b0e n a_743 100 LINEAR______0_000000__0H___81612 16 0.0 8160.0 /end AXIS_PTS
/begin AXIS_PTS ldp_n_vim__pvs_fl_vim "N" 0x74b30 n a_743 100 LINEAR______0_000000__0H___81612 8 0.0 8160.0 /end AXIS_PTS
/begin AXIS_PTS ldpm_maf_15 "MAF" 0x7412d maf a_742 100 LINEAR______0_000000__0H___1389_ 8 0.0 1389.0 /end AXIS_PTS
/begin AXIS_PTS ldpm_n_32_51 "N" 0x74124 n_32 a_742 100 LINEAR______0_000000__0H___8160_ 8 0.0 8160.0 /end AXIS_PTS
/begin AXIS_PTS ldp_v_saf_2 "V_SAF_2" 0x74147 dummy_b a_742 100 LINEAR______0_000000__0H___255_0 16 0.0 255.0 /end AXIS_PTS
/begin AXIS_PTS ldp_v_saf_1 "V_SAF_1" 0x74136 dummy_b a_742 100 LINEAR______0_000000__0H___255_0 16 0.0 255.0 /end AXIS_PTS
/begin AXIS_PTS ldp_toil_max__stop_dec_fsd "TOIL_MAX" 0x74158 toil_max a_742 100 LINEAR_______48_000000__0H___155 4 -48.0 155.0 /end AXIS_PTS
/begin AXIS_PTS ldp_tco_st "TCO_ST" 0x7415d tco_st a_742 100 LINEAR_______48_000000__0H___142 4 -48.0 142.5 /end AXIS_PTS
/begin AXIS_PTS ldpm_tco_st_2 "TCO_ST" 0x74162 tco_st a_742 15 LINEAR_______48_000000__0H___142 8 -48.0 142.5 /end AXIS_PTS
/begin AXIS_PTS ldpm_tco_st_5 "TCO_ST" 0x7416b tco_st a_742 15 LINEAR_______48_000000__0H___142 8 -48.0 142.5 /end AXIS_PTS
/begin AXIS_PTS ldpm_maf_18 "MAF" 0x7417d maf a_742 100 LINEAR______0_000000__0H___1389_ 6 0.0 1389.0 /end AXIS_PTS
/begin AXIS_PTS ldpm_n_32_46 "N" 0x74174 n_32 a_742 100 LINEAR______0_000000__0H___8160_ 8 0.0 8160.0 /end AXIS_PTS
/begin AXIS_PTS ldp_tco__t_sap_on "TCO" 0x74184 tco a_742 15 LINEAR_______48_000000__0H___142 8 -48.0 142.5 /end AXIS_PTS
/begin AXIS_PTS ldp_tco__t_sav_on "TCO" 0x7418d tco a_742 15 LINEAR_______48_000000__0H___142 8 -48.0 142.5 /end AXIS_PTS
/begin AXIS_PTS ldp_tco__t_tco_puc_deacc "TCO" 0x74196 tco a_742 20 LINEAR_______48_000000__0H___142 4 -48.0 142.5 /end AXIS_PTS
/begin AXIS_PTS ldp_tco__t_wait_diag_sa "TCO" 0x7419b tco a_742 15 LINEAR_______48_000000__0H___142 8 -48.0 142.5 /end AXIS_PTS
/begin AXIS_PTS ldp_tam_mon_sa__tco_min_diag_sa "TAM_MON_SA" 0x741a4 tam_mon_sa a_742 100 LINEAR_______128_000000__0H___12 6 -128.0 127.0 /end AXIS_PTS
/begin AXIS_PTS ldpm_maf_sub_diag_1 "MAF_SUB_DIAG" 0x741b8 maf_sub_diag a_742 100 LINEAR______0_000000__0H___1389_ 6 0.0 1389.0 /end AXIS_PTS
/begin AXIS_PTS ldpm_n_32_28 "N" 0x741ab n_32 a_742 100 LINEAR______0_000000__0H___8160_ 12 0.0 8160.0 /end AXIS_PTS
/begin AXIS_PTS ldp_n_32__ti_cor_cyl_off "N" 0x741bf n_32 a_742 100 LINEAR______0_000000__0H___8160_ 4 0.0 8160.0 /end AXIS_PTS
/begin AXIS_PTS ldpm_n_32_49 "N" 0x741c4 n_32 a_742 100 LINEAR______0_000000__0H___8160_ 8 0.0 8160.0 /end AXIS_PTS
/begin AXIS_PTS ldpm_tco_21 "TCO" 0x741cd tco a_742 15 LINEAR_______48_000000__0H___142 8 -48.0 142.5 /end AXIS_PTS
/begin AXIS_PTS ldpm_gear_4 "gear" 0x741d6 gear a_742 10 LINEAR______0_000000__0H___7_000 6 0.0 7.0 /end AXIS_PTS
/begin AXIS_PTS ldpm_n_vim_1 "N_VIM" 0x74b42 n a_743 100 LINEAR______0_000000__0H___81612 8 0.0 8160.0 /end AXIS_PTS
/begin AXIS_PTS ldp_maf__vim_pl "MAF" 0x74b54 maf a_743 10 LINEAR______0_000000__0H___13818 6 0.0 1389.0 /end AXIS_PTS
/begin AXIS_PTS ldp_maf_kgh__vls_down_crlc "MAF_KGH" 0x74b62 maf_kgh a_743 100 LINEAR______0_000000__0H___16383 4 0.0 16383.75 /end AXIS_PTS
/begin AXIS_PTS ldpm_pvs_cru_1 "N" 0x741e1 pvs_cru a_742 100 LINEAR______0_000000__0H___11920 3 0.0 119.53125 /end AXIS_PTS
/begin AXIS_PTS ldpm_n_21 "N" 0x741dd n a_742 100 LINEAR______0_000000__0H___8160_ 3 0.0 8160.0 /end AXIS_PTS
/begin AXIS_PTS ldpm_n_32_17 "N" 0x741e5 n a_742 25 LINEAR______0_000000__0H___8160_ 3 0.0 8160.0 /end AXIS_PTS
/begin AXIS_PTS ldpm_tco_4 "TCO" 0x741f0 tco a_742 15 LINEAR_______48_000000__0H___142 6 -48.0 142.5 /end AXIS_PTS
/begin AXIS_PTS ldpm_isapwm_1 "ISAPWM" 0x741f7 isapwm a_742 10 LINEAR______0_000000__0H___99_60 4 0.0 99.609375 /end AXIS_PTS
/begin AXIS_PTS ldpm_iga_dif_3 "IGA_DIF" 0x741fc dummy_b a_742 20 LINEAR______0_000000__0H___95_22 4 0.0 95.625 /end AXIS_PTS
/begin AXIS_PTS ldp_n_32__add_iga_dif "N_32" 0x74201 n_32 a_742 100 LINEAR______0_000000__0H___8160_ 3 0.0 8160.0 /end AXIS_PTS
/begin AXIS_PTS ldpm_tq_accin_can_1 "TQ_ACCIN_CAN" 0x74205 dummy_b a_742 100 LINEAR______0_000000__0H___31_00 4 0.0 31.0 /end AXIS_PTS
/begin AXIS_PTS ldp_v_amp__amp_raw_1 "V_AMP" 0x74b6c v_amp a_743 100 LINEAR______0_000000__0H___4_995 8 0.0 4.9951172 /end AXIS_PTS
/begin AXIS_PTS ldp_v_amp__amp_raw_2 "V_AMP" 0x74b7e v_amp a_743 100 LINEAR______0_000000__0H___4_995 8 0.0 4.9951172 /end AXIS_PTS
/begin AXIS_PTS ldp_vs__amp_raw_cor "VS" 0x7420a vs a_742 100 LINEAR______0_000000__0H___25511 8 0.0 255.0 /end AXIS_PTS
/begin AXIS_PTS ldpm_n_5 "N" 0x74b9a n a_743 100 LINEAR______0_000000__0H___81612 16 0.0 8160.0 /end AXIS_PTS
/begin AXIS_PTS ldp_maf__cast_cycnr_st_ast "MAF" 0x74235 maf a_742 100 LINEAR______0_000000__0H___1389_ 6 0.0 1389.0 /end AXIS_PTS
/begin AXIS_PTS ldp_n_32__cast_cycnr_st_ast "N" 0x7422e n_32 a_742 100 LINEAR______0_000000__0H___8160_ 6 0.0 8160.0 /end AXIS_PTS
/begin AXIS_PTS ldp_vb__cha_bat "VB" 0x74243 vb a_742 100 LINEAR______0_000000__0H___26_00 6 0.0 26.0 /end AXIS_PTS
/begin AXIS_PTS ldp_tam__cha_bat "TAM" 0x7423c tam a_742 100 LINEAR_______128_000000__0H___12 6 -128.0 127.0 /end AXIS_PTS
/begin AXIS_PTS ldp_cppwm__cppwm_cps "CPPWM" 0x74bf2 cppwm a_743 20 LINEAR______0_000000__0H___99_97 5 0.0 99.97559 /end AXIS_PTS
/begin AXIS_PTS ldpm_maf_1 "MAF" 0x74255 maf a_742 5 LINEAR______0_000000__0H___1389_ 12 0.0 1389.0 /end AXIS_PTS
/begin AXIS_PTS ldpm_n_32_7 "N" 0x7424a n a_742 10 LINEAR______0_000000__0H___8160_ 10 0.0 8160.0 /end AXIS_PTS
/begin AXIS_PTS ldpm_maf_add_cor_1 "MAF_COR" 0x74262 maf_cor a_742 10 LINEAR______0_000000__0H___1389_ 12 0.0 1389.0 /end AXIS_PTS
/begin AXIS_PTS ldpm_vb_1 "VB" 0x7426f vb a_742 12 LINEAR______0_000000__0H___26_00 8 0.0 26.0 /end AXIS_PTS
/begin AXIS_PTS ldpm_maf_kgh_17 "MAF_KGH" 0x74c10 maf_kgh a_743 10 LINEAR______0_000000__0H___16383 8 0.0 16383.75 FUNCTION_LIST ETM /end AXIS_PTS
/begin AXIS_PTS ldpm_maf_17 "MAF" 0x74c34 maf a_743 10 LINEAR______0_000000__0H___13818 8 0.0 1389.0 /end AXIS_PTS
/begin AXIS_PTS ldpm_n_17 "N" 0x74c22 n a_743 10 LINEAR______0_000000__0H___81612 8 0.0 8160.0 FUNCTION_LIST ETM /end AXIS_PTS
/begin AXIS_PTS ldpm_maf_kgh_18 "MAF_KGH" 0x74c46 maf_kgh a_743 10 LINEAR______0_000000__0H___16383 6 0.0 16383.75 FUNCTION_LIST ETM /end AXIS_PTS
/begin AXIS_PTS ldpm_maf_kgh_3 "MAF_KGH" 0x74c54 maf_kgh a_743 100 LINEAR______0_000000__0H___16383 6 0.0 16383.75 /end AXIS_PTS
/begin AXIS_PTS ldpm_n_32_43 "N" 0x74278 n_32 a_742 100 LINEAR______0_000000__0H___8160_ 4 0.0 8160.0 /end AXIS_PTS
/begin AXIS_PTS ldpm_n_32_44 "N" 0x7427d n_32 a_742 100 LINEAR______0_000000__0H___8160_ 4 0.0 8160.0 /end AXIS_PTS
/begin AXIS_PTS ldpm_temp_sp_toil_dif_1 "TEMP_SP_TOIL_DIF" 0x74c62 toil_dif a_743 10 LINEAR_______203_000000__0H___20 8 -203.0 203.0 FUNCTION_LIST ETM /end AXIS_PTS
/begin AXIS_PTS ldpm_temp_mmv_sub_ex_up_i_1 "TEMP_MMV_SUB_EX_UP_I" 0x74c74 dummy_w a_743 100 LINEAR_______33_000000__0H___989 8 -33.0 989.9844 FUNCTION_LIST ETM /end AXIS_PTS
/begin AXIS_PTS ldp_n__cur_alter "N" 0x74c98 n a_743 100 LINEAR______0_000000__0H___81612 6 0.0 8160.0 /end AXIS_PTS
/begin AXIS_PTS ldp_ecfpwm_ecf__cur_cnf_ecf "ecfpwm_ecf" 0x74290 ecfpwm_ecf a_742 100 LINEAR______0_000000__0H___99_60 5 0.0 99.609375 /end AXIS_PTS
/begin AXIS_PTS ldp_toil__cur_cns_st "TOIL" 0x74296 toil a_742 100 LINEAR_______48_000000__0H___155 4 -48.0 155.0 /end AXIS_PTS
/begin AXIS_PTS ldp_maf__cur_igc_sp "MAF" 0x742a2 maf a_742 7 LINEAR______0_000000__0H___1389_ 6 0.0 1389.0 /end AXIS_PTS
/begin AXIS_PTS ldp_n_32__cur_igc_sp "N" 0x7429b n a_742 25 LINEAR______0_000000__0H___8160_ 6 0.0 8160.0 /end AXIS_PTS
/begin AXIS_PTS ldp_tco_st__cycnr_dly_st_er "TCO_ST" 0x742a9 tco_st a_742 100 LINEAR_______48_000000__0H___142 8 -48.0 142.5 /end AXIS_PTS
/begin AXIS_PTS ldp_tco_st__dist "TCO_ST" 0x742b2 dummy_b a_742 100 LINEAR_______48_000000__0H___142 8 -48.0 142.5 /end AXIS_PTS
/begin AXIS_PTS ldpm_toil_2 "TOIL" 0x742c4 toil a_742 100 LINEAR_______48_000000__0H___155 8 -48.0 155.0 /end AXIS_PTS
/begin AXIS_PTS ldpm_n_32_24 "N" 0x742bb n a_742 100 LINEAR______0_000000__0H___8160_ 8 0.0 8160.0 /end AXIS_PTS
/begin AXIS_PTS ldp_maf__dly_cyl_lam "MAF" 0x74cb8 maf a_743 10 LINEAR______0_000000__0H___13818 8 0.0 1389.0 /end AXIS_PTS
/begin AXIS_PTS ldpm_n_12 "N" 0x74ca6 n a_743 100 LINEAR______0_000000__0H___81612 8 0.0 8160.0 FUNCTION_LIST CSCM /end AXIS_PTS
/begin AXIS_PTS ldp_tco_dif__ectpwm_i "TCO_DIF" 0x742d6 dummy_b a_742 100 LINEAR_______96_000000__0H___95_ 8 -96.0 95.25 /end AXIS_PTS
/begin AXIS_PTS ldp_tco_dif__ectpwm_p "TCO_DIF" 0x742df dummy_b a_742 100 LINEAR_______96_000000__0H___95_ 8 -96.0 95.25 /end AXIS_PTS
/begin AXIS_PTS ldp_iga_dif_av__eff_iga_mon "IGA_DIF_AV" 0x7e65f dummy_b a_742 100 LINEAR______0_000000__0H____95_6 8 -95.625 0.0 /end AXIS_PTS
/begin AXIS_PTS ldp_iga_dif_av__eff_iga_mon2 "IGA_DIF_AV_MON2" 0x742e8 dummy_b a_742 100 LINEAR______0_000000__0H____95_6 8 -95.625 0.0 FUNCTION_LIST MON2 /end AXIS_PTS
/begin AXIS_PTS ldp_cam_av_in__eoi_ti_tra_ivvt "CAM_AV_IN" 0x74301 ivvt_ivcam_av a_742 100 LINEAR______60_000000__0H___155_ 6 60.0 155.625 /end AXIS_PTS
/begin AXIS_PTS ldpm_n_32_5 "N" 0x742fa n a_742 100 LINEAR______0_000000__0H___8160_ 6 0.0 8160.0 /end AXIS_PTS
/begin AXIS_PTS ldpm_tco_3 "TCO" 0x74308 tco a_742 15 LINEAR_______48_000000__0H___142 8 -48.0 142.5 /end AXIS_PTS
/begin AXIS_PTS ldpm_tco_st_4 "TCO_ST" 0x7431a tco_st a_742 100 LINEAR_______48_000000__0H___142 8 -48.0 142.5 /end AXIS_PTS
/begin AXIS_PTS ldpm_tco_17 "TCO" 0x74311 tco a_742 100 LINEAR_______48_000000__0H___142 8 -48.0 142.5 /end AXIS_PTS
/begin AXIS_PTS ldp_cat_diag__fac_cat_diag "CAT_DIAG" 0x74cee dummy_b a_743 100 LINEAR______0_000000__0H___2559_ 6 0.0 2559.9609 /end AXIS_PTS
/begin AXIS_PTS ldpm_t_ctl_cru_1 "T_CTL_CRU" 0x74323 t_ctl_cru a_742 100 LINEAR______0_000000__0H___25_50 5 0.0 25.5 /end AXIS_PTS
/begin AXIS_PTS ldpm_n_32_22 "N" 0x74329 n a_742 100 LINEAR______0_000000__0H___8160_ 6 0.0 8160.0 /end AXIS_PTS
/begin AXIS_PTS ldp_vb_dmtl_fil__fac_cur_dmtl "VB_DMTL_FIL" 0x74cfc vb_dmtl_filvwordC1D a_743 100 LINEAR______0_000000__0H___26_30 6 0.0 26.0 /end AXIS_PTS
/begin AXIS_PTS ldpm_maf_kgh_1 "MAF_KGH" 0x74d38 maf_kgh a_743 10 LINEAR______0_000000__0H___16383 8 0.0 16383.75 /end AXIS_PTS
/begin AXIS_PTS ldp_maf__fac_er "MAF" 0x74337 maf a_742 100 LINEAR______0_000000__0H___1389_ 6 0.0 1389.0 /end AXIS_PTS
/begin AXIS_PTS ldp_n_32__fac_er "N" 0x74330 n_32 a_742 100 LINEAR______0_000000__0H___8160_ 6 0.0 8160.0 /end AXIS_PTS
/begin AXIS_PTS ldpm_t_ast_1 "T_AST" 0x74d4a t_ast a_743 15 LINEAR______0_000000__0H___6553_ 8 0.0 6553.5 /end AXIS_PTS
/begin AXIS_PTS ldpm_tco_6 "TCO" 0x7433e dummy_b a_742 10 LINEAR_______48_000000__0H___142 8 -48.0 142.5 /end AXIS_PTS
/begin AXIS_PTS ldp_n_dif__fac_iga_cs_is "N_DIF" 0x74d5c n_dif a_743 100 LINEAR_______32768_000000__0H___ 4 -32768.0 32767.0 FUNCTION_LIST Z10I /end AXIS_PTS
/begin AXIS_PTS ldp_iga_dif__fac_iga_tqr "IGA_DIF" 0x74347 dummy_b a_742 20 LINEAR_______48_000000__80H___0_ 8 -48.0 0.0 /end AXIS_PTS
/begin AXIS_PTS ldp_fac_ron__fac_iga_tra "FAC_RON_AD" 0x74355 fac_ron_ad a_742 10 LINEAR______0_000000__0H___1_033 3 0.0 1.0 /end AXIS_PTS
/begin AXIS_PTS ldp_tia__fac_iga_tra "TIA" 0x74350 tia a_742 10 LINEAR_______48_000000__0H___142 4 -48.0 142.5 /end AXIS_PTS
/begin AXIS_PTS ldp_vs__fac_iga_tra_gear "VS" 0x74359 vs a_742 100 LINEAR______0_000000__0H___25511 6 0.0 255.0 /end AXIS_PTS
/begin AXIS_PTS ldp_maf__fac_igcfb "MAF" 0x74367 maf a_742 100 LINEAR______0_000000__0H___1389_ 6 0.0 1389.0 /end AXIS_PTS
/begin AXIS_PTS ldp_n_32__fac_igcfb "N" 0x74360 n_32 a_742 100 LINEAR______0_000000__0H___8160_ 6 0.0 8160.0 /end AXIS_PTS
/begin AXIS_PTS ldp_isapwm_load__fac_isapwm_cor "ISAPWM" 0x74da0 isapwm_load a_743 10 LINEAR______0_000000__0H___399_9 4 0.0 399.9938 /end AXIS_PTS
/begin AXIS_PTS ldp_n__fac_isapwm_load_cor "N" 0x74d96 n a_743 100 LINEAR______0_000000__0H___81612 4 0.0 8160.0 /end AXIS_PTS
/begin AXIS_PTS ldp_maf_ivvt__cam_fac_ch "MAF_IVVT" 0x74375 maf_ivvt a_742 100 LINEAR______0_000000__0H___1389_ 6 0.0 1389.0 /end AXIS_PTS
/begin AXIS_PTS ldp_n_32__cam_fac_ch "N_32" 0x7436e n_32 a_742 100 LINEAR______0_000000__0H___8160_ 6 0.0 8160.0 /end AXIS_PTS
/begin AXIS_PTS ldp_vb__fac_ivvtpwm_vb "VB" 0x7437c vb a_742 100 LINEAR______0_000000__0H___26_00 3 0.0 26.0 /end AXIS_PTS
/begin AXIS_PTS ldp_tco__fac_knk_diag "TCO" 0x74385 tco a_742 10 LINEAR_______48_000000__0H___142 4 -48.0 142.5 /end AXIS_PTS
/begin AXIS_PTS ldp_tia__fac_knk_diag "TIA" 0x74380 tia a_742 15 LINEAR_______48_000000__0H___142 4 -48.0 142.5 /end AXIS_PTS
/begin AXIS_PTS ldpm_maf_4 "MAF" 0x7438a maf a_742 5 LINEAR______0_000000__0H___1389_ 8 0.0 1389.0 /end AXIS_PTS
/begin AXIS_PTS ldpm_n_7 "N" 0x74daa n a_743 10 LINEAR______0_000000__0H___81612 8 0.0 8160.0 /end AXIS_PTS
/begin AXIS_PTS ldp_tco__fac_lam_pu "TCO" 0x74393 tco a_742 100 LINEAR_______48_000000__0H___142 3 -48.0 142.5 /end AXIS_PTS
/begin AXIS_PTS ldpm_vs_sp_dif_cru_1 "VS_SP_DIF" 0x74dbc vs_sp_dif_cru a_743 100 LINEAR_______256_000000__0H___25 5 -256.0 255.99218 /end AXIS_PTS
/begin AXIS_PTS ldp_maf_kgh__fac_maf_1_cyl_lam "MAF_KGH" 0x74dc8 maf_kgh a_743 10 LINEAR______0_000000__0H___16383 6 0.0 16383.75 FUNCTION_LIST CSCM /end AXIS_PTS
/begin AXIS_PTS ldp_maf_kgh__fac_maf_2_cyl_lam "MAF_KGH" 0x74dd6 maf_kgh a_743 10 LINEAR______0_000000__0H___16383 6 0.0 16383.75 FUNCTION_LIST CSCM /end AXIS_PTS
/begin AXIS_PTS ldp_pgas_l__fac_pgas_l_ti "PGAS_L" 0x74de4 dummy_w a_743 100 LINEAR______0_000000__0H___16338 16 0.0 16383.75 FUNCTION_LIST CNG /end AXIS_PTS
/begin AXIS_PTS ldp_pq_gas__fac_pq_gas_ti "PQ_GAS" 0x74e06 dummy_w a_743 100 LINEAR______0_000000__0H___0_999 16 0.0 0.99998474 FUNCTION_LIST CNG /end AXIS_PTS
/begin AXIS_PTS ldp_isapwm__fac_pq_isa "ISAPWM" 0x74e28 isapwm a_743 15 LINEAR______0_000000__0H___99_99 4 0.0 99.998474 /end AXIS_PTS
/begin AXIS_PTS ldp_isapwm__fac_pq_isa_mon "ISAPWM" 0x7e720 isapwm a_743 15 LINEAR______0_000000__0H___99_99 4 0.0 99.998474 /end AXIS_PTS
/begin AXIS_PTS ldp_n_32__fac_pvs_isa "N" 0x7439e n a_742 100 LINEAR______0_000000__0H___8160_ 12 0.0 8160.0 /end AXIS_PTS
/begin AXIS_PTS ldp_pvs_cor_rpl__fac_pvs_isa "PVS_COR_RPL" 0x74e48 pvs_cor_rpl a_743 100 LINEAR______0_000000__0H___119_8 12 0.0 119.8828 /end AXIS_PTS
/begin AXIS_PTS ldp_fac_cp__fac_ramp_cp "FAC_CP" 0x743ab fac_cp a_742 100 LINEAR______0_000000__0H___0_996 3 0.0 0.99609375 /end AXIS_PTS
/begin AXIS_PTS ldp_lam_mv_dif_cp__fac_ramp_cp "LAMMW_DIF_TE" 0x74e62 lrvlam_mv_dif_cp a_743 100 LINEAR_______50_000000__0H___440 3 -50.0 49.998471 /end AXIS_PTS
/begin AXIS_PTS ldp_tco_stop__fac_rest "TCO_STOP" 0x743af tco_stop a_742 100 LINEAR_______48_000000__0H___142 8 -48.0 142.5 /end AXIS_PTS
/begin AXIS_PTS ldp_t_ast_rest__fac_rest "T_AST_REST" 0x74e6a t_ast_rest a_743 100 LINEAR______0_000000__0H___6553_ 8 0.0 6553.5 /end AXIS_PTS
/begin AXIS_PTS ldp_tco_ip_fac_ron_ad_max "TCO" 0x743bd tco a_742 15 LINEAR_______48_000000__0H___142 4 -48.0 142.5 /end AXIS_PTS
/begin AXIS_PTS ldp_tia_ip_fac_ron_ad_max "TIA" 0x743b8 tia a_742 15 LINEAR_______48_000000__0H___142 4 -48.0 142.5 /end AXIS_PTS
/begin AXIS_PTS ldpm_n_32_52 "N" 0x743c2 n_32 a_742 100 LINEAR______0_000000__0H___8160_ 4 0.0 8160.0 /end AXIS_PTS
/begin AXIS_PTS ldp_n__fac_t_accin_inc "N" 0x74e7c n a_743 12 LINEAR______0_000000__0H___81612 4 0.0 8160.0 /end AXIS_PTS
/begin AXIS_PTS ldp_tco__fac_tco_tqi "TCO" 0x743c7 tco a_742 100 LINEAR_______48_000000__0H___142 6 -48.0 142.5 /end AXIS_PTS
/begin AXIS_PTS ldpm_tgas_l "TGAS_L" 0x743ce dummy_b a_742 100 LINEAR_______48_000000__0H___143 10 -48.0 143.25 FUNCTION_LIST CNG /end AXIS_PTS
/begin AXIS_PTS ldp_tco__thd_er "TCO" 0x743d9 tco a_742 5 LINEAR_______48_000000__0H___142 8 -48.0 142.5 /end AXIS_PTS
/begin AXIS_PTS ldp_iga_ch_2__fac_thd_er_ch_2 "IGA_DIF_CH_2" 0x743e2 iga_ch_2 a_742 100 LINEAR_______48_000000__0H___041 4 -48.0 0.0 /end AXIS_PTS
/begin AXIS_PTS ldp_iga_ch_3__fac_thd_er_ch_3 "IGA_DIF_CH_3" 0x743e7 iga_ch_3vbyteC1D a_742 100 LINEAR_______48_000000__0H___041 4 -48.0 0.0 /end AXIS_PTS
/begin AXIS_PTS ldp_iga_mv_12__fac_thd_er_is "IGA_MV_12" 0x743ec iga_mv_12 a_742 100 LINEAR_______23_625000__0H___72_ 6 -23.625 72.0 /end AXIS_PTS
/begin AXIS_PTS ldp_tco__tco_fac_thd_is_er_diag "TCO" 0x743f3 tco a_742 11 LINEAR_______48_000000__0H___142 8 -48.0 142.5 /end AXIS_PTS
/begin AXIS_PTS ldp_tco__fac_ti_cat_var "TCO" 0x743fc tco a_742 100 LINEAR_______48_000000__0H___142 2 -48.0 142.5 /end AXIS_PTS
/begin AXIS_PTS ldp_map__fac_ti_map_wf "MAP" 0x74e86 map a_743 100 LINEAR______0_000000__0H___5434_ 4 0.0 5434.2598 /end AXIS_PTS
/begin AXIS_PTS ldp_tia__fac_tia_tco "TIA" 0x74406 tia a_742 15 LINEAR_______48_000000__0H___142 6 -48.0 142.5 /end AXIS_PTS
/begin AXIS_PTS ldp_tco__fac_tia_tco "TCO" 0x743ff tia a_742 15 LINEAR_______48_000000__0H___142 6 -48.0 142.5 /end AXIS_PTS
/begin AXIS_PTS ldp_tia__fac_tia_tco_is "TIA" 0x74412 tia a_742 10 LINEAR_______48_000000__0H___142 4 -48.0 142.5 /end AXIS_PTS
/begin AXIS_PTS ldp_tco__fac_tia_tco_is "TCO" 0x7440d tco a_742 10 LINEAR_______48_000000__0H___142 4 -48.0 142.5 /end AXIS_PTS
/begin AXIS_PTS ldp_fac_ron_ad__fac_toil_facron "FAC_RON_AD" 0x74e90 fac_ron_ad a_743 10 LINEAR______0_000000__0H___0_999 4 0.0 0.99998474 /end AXIS_PTS
/begin AXIS_PTS ldp_toil__fac_toil_facron "TOIL" 0x74417 toil a_742 100 LINEAR_______48_000000__0H___155 4 -48.0 155.0 /end AXIS_PTS
/begin AXIS_PTS ldp_tps_av__fac_tps_isa "TPS_AV" 0x74e9a tps_av_prj a_743 10 LINEAR______0_000000__0H___119_9 6 0.0 119.99817 /end AXIS_PTS
/begin AXIS_PTS ldp_tps_av_mon__fac_tps_isa_mon "TPS_AV_MON" 0x7e668 tps_av_mon a_742 10 LINEAR______0_000000__0H___11942 6 0.0 119.53125 /end AXIS_PTS
/begin AXIS_PTS ldp_t_acc__fac_tq_loss_acc_off "T_ACC" 0x7441c dummy_b a_742 100 LINEAR______0_000000__0H___2_544 8 0.0 2.55 /end AXIS_PTS
/begin AXIS_PTS ldp_t_acc__fac_tq_loss_acc_on "T_ACC" 0x74425 dummy_b a_742 100 LINEAR______0_000000__0H___2_544 8 0.0 2.55 /end AXIS_PTS
/begin AXIS_PTS ldpm_pvs_av_1 "PVS_AV" 0x7442e pvs_av a_742 100 LINEAR______0_000000__0H___11913 4 0.0 119.5 /end AXIS_PTS
/begin AXIS_PTS ldp_tqi_asr_can__fac_tqd_cor "TQI_ASR_CAN" 0x74433 tqi_asr_can a_742 10 LINEAR______0_000000__0H___100_0 4 0.0 100.0 /end AXIS_PTS
/begin AXIS_PTS ldp_tqi_amt_can__fac_tqd_cor "TQI_AMT_CAN" 0x74438 tqi_amt_can a_742 100 LINEAR______0_000000__0H___99_60 4 0.0 99.609375 FUNCTION_LIST Z1S1 /end AXIS_PTS
/begin AXIS_PTS ldp_tqi_lim__fac_tqd_cor_lim "LDP_TQI_LIM" 0x74ea8 tqi_lim a_743 100 LINEAR______0_000000__0H___1023_ 4 0.0 1023.0 /end AXIS_PTS
/begin AXIS_PTS ldp_pq_turb_sys__fac_turb "PQ_TURB_SYS" 0x7443d pq_turb_sys a_742 100 LINEAR______0_000000__0H___0_996 6 0.0 0.99609375 /end AXIS_PTS
/begin AXIS_PTS ldp_isapwm__fac_turb "ISAPWM" 0x74eb2 isapwm a_743 100 LINEAR______0_000000__0H___99_46 6 0.0 99.998474 /end AXIS_PTS
/begin AXIS_PTS ldp_pq_main_col__fco_map_cor "PQ_MAIN_COL" 0x74444 pq_main_col a_742 100 LINEAR______0_000000__0H___0_996 6 0.0 0.99609375 /end AXIS_PTS
/begin AXIS_PTS ldpm_n_32_12 "N" 0x7444b n a_742 20 LINEAR______0_000000__0H___8160_ 8 0.0 8160.0 /end AXIS_PTS
/begin AXIS_PTS ldpm_tco_15 "TCO" 0x74454 tco a_742 10 LINEAR_______48_000000__0H___142 4 -48.0 142.5 /end AXIS_PTS
/begin AXIS_PTS ldpm_n_8 "N" 0x74ec0 n a_743 10 LINEAR______0_000000__0H___81612 6 0.0 8160.0 /end AXIS_PTS
/begin AXIS_PTS ldp_toil__iga_add_pste "TOIL" 0x74459 toil a_742 100 LINEAR_______48_000000__0H___155 4 -48.0 155.0 /end AXIS_PTS
/begin AXIS_PTS ldp_ang_pste__iga_add_pste "ANG_PSTE" 0x74ece ang_pste a_743 100 LINEAR_______1439_956055__0H___1 6 -1439.9561 1439.9121 /end AXIS_PTS
/begin AXIS_PTS ldpm_maf_19 "MAF" 0x74edc maf a_743 10 LINEAR______0_000000__0H___13818 6 0.0 1389.0 /end AXIS_PTS
/begin AXIS_PTS ldpm_n_32_53 "N_32" 0x7445e n_32 a_742 10 LINEAR______0_000000__0H___8160_ 8 0.0 8160.0 /end AXIS_PTS
/begin AXIS_PTS ldp_n_dif_cor__iga_ast "N_DIF_COR" 0x74eea n_dif_cor a_743 5 LINEAR_______1024_000000__7C00H_ 4 -1024.0 1016.0 /end AXIS_PTS
/begin AXIS_PTS ldpm_maf_10 "MAF" 0x74470 maf a_742 5 LINEAR______0_000000__0H___1389_ 8 0.0 1389.0 /end AXIS_PTS
/begin AXIS_PTS ldpm_n_32_26 "N" 0x74467 n a_742 100 LINEAR______0_000000__0H___8160_ 8 0.0 8160.0 /end AXIS_PTS
/begin AXIS_PTS ldp_pvs_av__iga_ch_2 "PVS_AV" 0x74482 pvs_av a_742 5 LINEAR______0_000000__0H___11913 8 0.0 119.5 /end AXIS_PTS
/begin AXIS_PTS ldp_n_32__iga_ch_2 "N" 0x74479 n_32 a_742 10 LINEAR______0_000000__0H___8160_ 8 0.0 8160.0 /end AXIS_PTS
/begin AXIS_PTS ldp_n_32__iga_ch_is "N" 0x7448b n a_742 10 LINEAR______0_000000__0H___8160_ 4 0.0 8160.0 /end AXIS_PTS
/begin AXIS_PTS ldpm_cam_dif_1 "CAM_DIF" 0x74490 dummy_b a_742 100 LINEAR_______48_000000__0H___47_ 10 -48.0 47.625 /end AXIS_PTS
/begin AXIS_PTS ldpm_toil_6 "TOIL" 0x7449b toil a_742 100 LINEAR_______48_000000__0H___155 6 -48.0 155.0 FUNCTION_LIST ETM /end AXIS_PTS
/begin AXIS_PTS ldp_tqd_fac__iga_dif_tqr "MDZ_FAK" 0x74ef4 dummy_b a_743 20 LINEAR______0_000000__0H___1_047 8 0.0 1.0 /end AXIS_PTS
/begin AXIS_PTS ldp_fac_amp__iga_fac_amp_st "FAC_AMP" 0x744a2 fac_amp a_742 100 LINEAR______0_000000__0H___2_043 6 0.0 2.0 /end AXIS_PTS
/begin AXIS_PTS ldpm_tco_8 "TCO" 0x744a9 tco a_742 15 LINEAR_______48_000000__0H___142 4 -48.0 142.5 /end AXIS_PTS
/begin AXIS_PTS ldpm_maf_14 "MAF" 0x744ae maf_knk a_742 5 LINEAR______0_000000__0H___1389_ 8 0.0 1389.0 /end AXIS_PTS
/begin AXIS_PTS ldpm_n_10 "N" 0x74f06 n a_743 10 LINEAR______0_000000__0H___81612 4 0.0 8160.0 /end AXIS_PTS
/begin AXIS_PTS ldp_n_grd__iga_lgrd_ris "N_GRD" 0x744c3 dummy_b a_742 1 LINEAR_______4096_000000__0H___4 4 -4096.0 4064.0 /end AXIS_PTS
/begin AXIS_PTS ldpm_n_32_54 "N" 0x744c8 n a_742 10 LINEAR______0_000000__0H___8160_ 4 0.0 8160.0 /end AXIS_PTS
/begin AXIS_PTS ldp_maf__iga_maf_n "MAF_IGA" 0x744d6 maf_iga a_742 5 LINEAR______0_000000__0H___1389_ 6 0.0 1389.0 /end AXIS_PTS
/begin AXIS_PTS ldp_n_32__iga_maf_n "N" 0x744cd n_32 a_742 10 LINEAR______0_000000__0H___8160_ 8 0.0 8160.0 /end AXIS_PTS
/begin AXIS_PTS ldp_maf_iga__iga_maf_n_is "MAF_IGA" 0x744e2 maf_iga a_742 5 LINEAR______0_000000__0H___1389_ 4 0.0 1389.0 /end AXIS_PTS
/begin AXIS_PTS ldp_n__iga_maf_n_is "N" 0x744dd n_32 a_742 10 LINEAR______0_000000__0H___8160_ 4 0.0 8160.0 /end AXIS_PTS
/begin AXIS_PTS ldp_maf__iga_maf_n_toil_is "MAF_IGA" 0x744ee maf_iga a_742 10 LINEAR______0_000000__0H___1389_ 6 0.0 1389.0 /end AXIS_PTS
/begin AXIS_PTS ldp_n_32__iga_maf_n_toil_is "N_32" 0x744e7 n_32 a_742 10 LINEAR______0_000000__0H___8160_ 6 0.0 8160.0 /end AXIS_PTS
/begin AXIS_PTS ldp_maf__iga_max_turb "MAF" 0x74f22 maf a_743 100 LINEAR______0_000000__0H___13818 8 0.0 1389.0 /end AXIS_PTS
/begin AXIS_PTS ldp_n__iga_max_turb "N" 0x74f10 n_32 a_743 100 LINEAR______0_000000__0H___81612 8 0.0 8160.0 /end AXIS_PTS
/begin AXIS_PTS ldp_n_dif_cor__iga_n_dif_is "N_DIF_COR" 0x74f34 n_dif_cor a_743 5 LINEAR_______1024_000000__7C00H_ 12 -1024.0 1016.0 /end AXIS_PTS
/begin AXIS_PTS ldpm_maf_iga_1 "MAF_IGA" 0x74f70 maf_iga a_743 100 LINEAR______0_000000__0H___13818 12 0.0 1389.0 /end AXIS_PTS
/begin AXIS_PTS ldpm_n_4 "N" 0x74f4e n a_743 100 LINEAR______0_000000__0H___81612 16 0.0 8160.0 /end AXIS_PTS
/begin AXIS_PTS ldp_maf__iga_ref_mon "MAF" 0x7e678 maf a_742 100 LINEAR______0_000000__0H___1389_ 8 0.0 1389.0 /end AXIS_PTS
/begin AXIS_PTS ldp_n_32__iga_ref_mon "N" 0x7e66f n_32 a_742 100 LINEAR______0_000000__0H___8160_ 8 0.0 8160.0 /end AXIS_PTS
/begin AXIS_PTS ldp_maf__iga_ref_mon2 "MAF_MON2" 0x744fe maf_mon2 a_742 100 LINEAR______0_000000__0H___1389_ 8 0.0 1389.0 FUNCTION_LIST MON2 /end AXIS_PTS
/begin AXIS_PTS ldp_n_32__iga_ref_mon2 "N_32_MON2" 0x744f5 n_32_mon2 a_742 100 LINEAR______0_000000__0H___8160_ 8 0.0 8160.0 FUNCTION_LIST MON2 /end AXIS_PTS
/begin AXIS_PTS ldpm_maf_iga_2 "MAF_IGA" 0x74fb4 maf_iga a_743 100 LINEAR______0_000000__0H___13818 16 0.0 1389.0 /end AXIS_PTS
/begin AXIS_PTS ldpm_n_14 "N" 0x74f8a n a_743 100 LINEAR______0_000000__0H___81612 20 0.0 8160.0 /end AXIS_PTS
/begin AXIS_PTS ldp_tco__iga_rpl "TCO" 0x74507 tco a_742 15 LINEAR_______48_000000__0H___142 6 -48.0 142.5 /end AXIS_PTS
/begin AXIS_PTS ldpm_n_6 "N" 0x74fd6 n a_743 10 LINEAR______0_000000__0H___81612 3 0.0 8160.0 /end AXIS_PTS
/begin AXIS_PTS ldpm_maf_iga_3 "MAF_IGA" 0x74fec maf_iga a_743 100 LINEAR______0_000000__0H___13818 6 0.0 1389.0 /end AXIS_PTS
/begin AXIS_PTS ldpm_n_2 "N" 0x74fde n a_743 100 LINEAR______0_000000__0H___81612 6 0.0 8160.0 /end AXIS_PTS
/begin AXIS_PTS ldpm_t_ast_2 "T_AST" 0x74ffa t_ast a_743 15 LINEAR______0_000000__0H___6553_ 8 0.0 6553.5 /end AXIS_PTS
/begin AXIS_PTS ldpm_tco_19 "TCO" 0x7450e tco a_742 10 LINEAR_______48_000000__0H___142 8 -48.0 142.5 /end AXIS_PTS
/begin AXIS_PTS ldpm_maf_6 "MAF" 0x74521 maf a_742 10 LINEAR______0_000000__0H___1389_ 8 0.0 1389.0 /end AXIS_PTS
/begin AXIS_PTS ldpm_n_32_19 "N" 0x74517 n a_742 20 LINEAR______0_000000__0H___8160_ 9 0.0 8160.0 /end AXIS_PTS
/begin AXIS_PTS ldp_maf__iga_tqr_amt "MAF" 0x74534 maf a_742 10 LINEAR______0_000000__0H___1389_ 8 0.0 1389.0 FUNCTION_LIST Z1S1 /end AXIS_PTS
/begin AXIS_PTS ldp_n_32__iga_tqr_amt "N_32" 0x7452a n_32 a_742 20 LINEAR______0_000000__0H___8160_ 9 0.0 8160.0 FUNCTION_LIST Z1S1 /end AXIS_PTS
/begin AXIS_PTS ldp_maf_iga__iga_tra_knk "MAF_IGA" 0x7453d maf_iga a_742 5 LINEAR______0_000000__0H___1389_ 4 0.0 1389.0 /end AXIS_PTS
/begin AXIS_PTS ldp_maf_iga__igab_is "MAF_IGA" 0x75016 maf_iga a_743 5 LINEAR______0_000000__0H___13818 4 0.0 1389.0 /end AXIS_PTS
/begin AXIS_PTS ldp_n__igab_is "N" 0x7500c n a_743 15 LINEAR______0_000000__0H___81612 4 0.0 8160.0 /end AXIS_PTS
/begin AXIS_PTS ldp_tam__isapwm_accin "TAM" 0x74542 tam a_742 100 LINEAR_______128_000000__0H___12 4 -128.0 127.0 /end AXIS_PTS
/begin AXIS_PTS ldpm_pq_turb_sys_1 "PQ_TURB_SYS" 0x74547 pq_turb_sys a_742 100 LINEAR______0_000000__0H___0_996 6 0.0 0.99609375 /end AXIS_PTS
/begin AXIS_PTS ldpm_n_9 "N" 0x75020 n a_743 10 LINEAR______0_000000__0H___81612 4 0.0 8160.0 /end AXIS_PTS
/begin AXIS_PTS ldpm_tco_25 "TCO" 0x74561 tco a_742 100 LINEAR_______48_000000__0H___142 6 -48.0 142.5 /end AXIS_PTS
/begin AXIS_PTS ldpm_tco_13 "TCO" 0x74568 tco a_742 100 LINEAR_______48_000000__0H___142 8 -48.0 142.5 /end AXIS_PTS
/begin AXIS_PTS ldp_iga_dif_ch_1__isapwm_ch_iga "IGA_DIF_CH" 0x74571 iga_ch_ofsvbyteC1D a_742 100 LINEAR_______48_000000__0H___041 6 -48.0 0.0 /end AXIS_PTS
/begin AXIS_PTS ldp_isapwm_tps__isapwm_cor_isa "ISAPWM_COR_ISA" 0x7506c NO_INPUT_QUANTITY a_743 10 LINEAR______0_000000__0H___99_99 8 0.0 99.998474 /end AXIS_PTS
/begin AXIS_PTS ldp_pvs_grd__isapwm_crlc "PVS_GRD" 0x74578 pvs_grd a_742 100 LINEAR______0_000000__0H___2988_ 4 0.0 2988.0 /end AXIS_PTS
/begin AXIS_PTS ldp_n_grd__isapwm_d_is "N_GRD" 0x7457d dummy_b a_742 3 LINEAR_______4096_000000__0H___4 4 -4096.0 4064.0 /end AXIS_PTS
/begin COMPU_METHOD LINEAR______0_000000__0H___255_0 "" FORM "%3.0" "-" FORMULA "1.0*X" FORMULA_INV "1.0*X" /end COMPU_METHOD
/begin COMPU_METHOD LINEAR______0_000000__0H___9_000 "" FORM "%2.0" "-" FORMULA "1.0*X" FORMULA_INV "1.0*X" /end COMPU_METHOD
/begin COMPU_METHOD LINEAR_______2_560000__FFFFFF80H "" FORM "%8.3" "-" FORMULA "0.02*X+9.8039217e-009" FORMULA_INV "50.000001*X-4.9019609e-007" /end COMPU_METHOD
/begin COMPU_METHOD LINEAR______0_000000__0H___8160_ "" FORM "%4.0" "rpm" FORMULA "32.0*X" FORMULA_INV "0.03125*X" /end COMPU_METHOD
/begin COMPU_METHOD LINEAR______0_000000__0H___65535 "" FORM "%5.0" "-" FORMULA "1.0*X" FORMULA_INV "1.0*X" /end COMPU_METHOD
/begin COMPU_METHOD LINEAR______0_000000__0H___0_996 "" FORM "%5.3" "-" FORMULA "0.00390625*X" FORMULA_INV "256.0*X" /end COMPU_METHOD
/begin COMPU_METHOD LINEAR______0_000000__0H___255_4 "" FORM "%3.0" "*seg" FORMULA "1.0*X" FORMULA_INV "1.0*X" /end COMPU_METHOD
/begin COMPU_METHOD LINEAR______0_000000__0H___1_000 "" FORM "%2.0" "-" FORMULA "1.0*X" FORMULA_INV "1.0*X" /end COMPU_METHOD
/begin COMPU_METHOD LINEAR______100_000000__1H___255 "" FORM "%5.0" "ms" FORMULA "100.0*X" FORMULA_INV "0.01*X" /end COMPU_METHOD
/begin COMPU_METHOD LINEAR_______48_000000__0H___155 "" FORM "%5.1" "°C" FORMULA "0.79607843*X-48.0" FORMULA_INV "1.2561576*X+60.295567" /end COMPU_METHOD
/begin COMPU_METHOD LINEAR______0_000000__0H___81605 "" FORM "%4.0" "rpm" FORMULA "0.25*X" FORMULA_INV "4.0*X" /end COMPU_METHOD
/begin COMPU_METHOD LINEAR______0_000000__0H___26_00 "" FORM "%4.1" "V" FORMULA "0.10196078*X" FORMULA_INV "9.8076923*X" /end COMPU_METHOD
/begin COMPU_METHOD LINEAR______0_000000__0H___99_60 "" FORM "%4.1" "%" FORMULA "0.390625*X" FORMULA_INV "2.56*X" /end COMPU_METHOD
/begin COMPU_METHOD LINEAR_______33_000000__0H___987 "" FORM "%3.0" "°C" FORMULA "4.0*X-33.0" FORMULA_INV "0.25*X+8.25" /end COMPU_METHOD
/begin COMPU_METHOD LINEAR_______48_000000__0H___142 "" FORM "%5.1" "°C" FORMULA "0.75*X-48.0" FORMULA_INV "1.3333333*X+64.0" /end COMPU_METHOD
/begin COMPU_METHOD LINEAR______0_000000__0H___65534 "" FORM "%6.0" "km" FORMULA "10.0*X" FORMULA_INV "0.1*X" /end COMPU_METHOD
/begin COMPU_METHOD LINEAR______0_000000__0H___1_992 "" FORM "%5.3" "-" FORMULA "0.0078125*X" FORMULA_INV "128.0*X" /end COMPU_METHOD
/begin COMPU_METHOD LINEAR______1_000000__1H___16_00 "" FORM "%2.0" "-" FORMULA "1.0*X" FORMULA_INV "1.0*X" /end COMPU_METHOD
/begin COMPU_METHOD LINEAR______0_000000__0H___5_000 "" FORM "%2.0" "gear" FORMULA "1.0*X" FORMULA_INV "1.0*X" /end COMPU_METHOD
/begin COMPU_METHOD LINEAR______0_000000__0H___81608 "" FORM "%4.0" "rpm/(km/h)" FORMULA "1.0*X" FORMULA_INV "1.0*X" /end COMPU_METHOD
/begin COMPU_METHOD LINEAR______47_625000__FFFFFF81H "" FORM "%4.1" "°CRK" FORMULA "-0.375*X" FORMULA_INV "-2.6666667*X" /end COMPU_METHOD
/begin COMPU_METHOD LINEAR_______48_000000__0H___47_ "" FORM "%6.2" "°CRK" FORMULA "0.375*X-48.0" FORMULA_INV "2.6666667*X+128.0" /end COMPU_METHOD
/begin COMPU_METHOD LINEAR_______23_625000__0H___72_ "" FORM "%5.1" "°CRK" FORMULA "0.375*X-23.625" FORMULA_INV "2.6666667*X+63.0" /end COMPU_METHOD
/begin COMPU_METHOD LINEAR______0_001465__1H___47_99 "" FORM "%6.3" "°CRK/seg" FORMULA "0.0014648439*X+1.5610694e-007" FORMULA_INV "682.6666*X-0.00010656899" /end COMPU_METHOD
/begin COMPU_METHOD LINEAR______0_375000__1H___95_62 "" FORM "%5.2" "°CRK/seg" FORMULA "0.375*X" FORMULA_INV "2.6666667*X" /end COMPU_METHOD
/begin COMPU_METHOD LINEAR______0_000000__0H___399_9 "" FORM "%7.3" "%" FORMULA "0.0061035142*X" FORMULA_INV "163.84004*X" /end COMPU_METHOD
/begin COMPU_METHOD LINEAR_______50_000000__0H___49_ "" FORM "%5.1" "%" FORMULA "0.3906251*X-50.0" FORMULA_INV "2.5599994*X+127.99997" /end COMPU_METHOD
/begin COMPU_METHOD LINEAR______0_000000__0H___49_60 "" FORM "%5.2" "%" FORMULA "0.390625*X" FORMULA_INV "2.56*X" /end COMPU_METHOD
/begin COMPU_METHOD LINEAR______0_000000__0H___95_62 "" FORM "%5.2" "°CRK/s" FORMULA "0.375*X" FORMULA_INV "2.6666667*X" /end COMPU_METHOD
/begin COMPU_METHOD LINEAR______0_000000__0H___1389_ "" FORM "%4.0" "mg/stk" FORMULA "5.4470588*X" FORMULA_INV "0.18358531*X" /end COMPU_METHOD
/begin COMPU_METHOD LINEAR______12_000000__0H___107_ "" FORM "%6.2" "°CRK" FORMULA "0.375*X+12.0" FORMULA_INV "2.6666667*X-32.0" /end COMPU_METHOD
/begin COMPU_METHOD LINEAR_______5434_259766__FFFF80 "" FORM "%7.1" "hPa/4*seg" FORMULA "0.16584171*X+0.041460356" FORMULA_INV "6.0298461*X-0.24999957" /end COMPU_METHOD
/begin COMPU_METHOD LINEAR______0_000000__0H___2_000 "" FORM "%2.0" "-" FORMULA "1.0*X" FORMULA_INV "1.0*X" /end COMPU_METHOD
/begin COMPU_METHOD LINEAR_______33_000000__0H___991 "" FORM "%6.2" "°C" FORMULA "0.015625238*X-33.0" FORMULA_INV "63.999023*X+2111.9678" /end COMPU_METHOD
/begin COMPU_METHOD LINEAR______0_000000__0H___15_94 "" FORM "%5.2" "-" FORMULA "0.062509802*X" FORMULA_INV "15.997491*X" /end COMPU_METHOD
/begin COMPU_METHOD LINEAR______0_000000__0H___15_00 "" FORM "%2.0" "-" FORMULA "1.0*X" FORMULA_INV "1.0*X" /end COMPU_METHOD
/begin COMPU_METHOD LINEAR______0_000000__0H___4064_ "" FORM "%4.0" "rpm/s" FORMULA "32.0*X" FORMULA_INV "0.03125*X" /end COMPU_METHOD
/begin COMPU_METHOD LINEAR______0_000000__0H___7_000 "" FORM "%2.0" "-" FORMULA "1.0*X" FORMULA_INV "1.0*X" /end COMPU_METHOD
/begin COMPU_METHOD LINEAR______0_000000__0H___25511 "" FORM "%3.0" "km/h" FORMULA "1.0*X" FORMULA_INV "1.0*X" /end COMPU_METHOD
/begin COMPU_METHOD LINEAR______1_000000__1H___255_0 "" FORM "%3.0" "-" FORMULA "1.0*X" FORMULA_INV "1.0*X" /end COMPU_METHOD
/begin COMPU_METHOD LINEAR______0_12500000__1H___816 "" FORM "%7.3" "rpm/10ms" FORMULA "0.125*X" FORMULA_INV "8.0*X" /end COMPU_METHOD
/begin COMPU_METHOD LINEAR______0_000000__0H___81612 "" FORM "%4.0" "rpm" FORMULA "1.0*X" FORMULA_INV "1.0*X" /end COMPU_METHOD
/begin COMPU_METHOD LINEAR______0_000000__0H___511_9 "" FORM "%7.3" "-" FORMULA "0.0078124999*X" FORMULA_INV "128.0*X" /end COMPU_METHOD
/begin COMPU_METHOD LINEAR______0_000000__0H___8191_ "" FORM "%4.0" "-" FORMULA "1.0*X" FORMULA_INV "1.0*X" /end COMPU_METHOD
/begin COMPU_METHOD LINEAR______0_000000__0H___13_00 "" FORM "%2.0" "-" FORMULA "1.0*X" FORMULA_INV "1.0*X" /end COMPU_METHOD
/begin COMPU_METHOD LINEAR______0_000000__0H___119_5 "" FORM "%5.1" "°PVS" FORMULA "0.46875*X" FORMULA_INV "2.1333333*X" /end COMPU_METHOD
/begin COMPU_METHOD LINEAR______0_000000__0H___11913 "" FORM "%5.1" "°TPS" FORMULA "0.46862745*X" FORMULA_INV "2.1338912*X" /end COMPU_METHOD
/begin COMPU_METHOD LINEAR______0_000000__0H___2988_ "" FORM "%4.0" "°TPS/s" FORMULA "11.717647*X" FORMULA_INV "0.085341365*X" /end COMPU_METHOD
/begin COMPU_METHOD LINEAR______0_000000__0H___63_75 "" FORM "%5.2" "kg/h" FORMULA "0.25*X" FORMULA_INV "4.0*X" /end COMPU_METHOD
/begin COMPU_METHOD LINEAR______0_000000__0H___254_0 "" FORM "%3.0" "-" FORMULA "1.0*X" FORMULA_INV "1.0*X" /end COMPU_METHOD
/begin COMPU_METHOD LINEAR______0_000000__0H___6553_ "" FORM "%6.1" "s" FORMULA "0.1*X" FORMULA_INV "10.0*X" /end COMPU_METHOD
/begin COMPU_METHOD LINEAR______10_000000__1H___2550 "" FORM "%4.0" "ms" FORMULA "10.0*X" FORMULA_INV "0.1*X" /end COMPU_METHOD
/begin COMPU_METHOD LINEAR______0_000000__0H___2621_ "" FORM "%7.4" "s" FORMULA "0.04*X" FORMULA_INV "25.0*X" /end COMPU_METHOD
/begin COMPU_METHOD LINEAR______0_000000__0H___2796_ "" FORM "%7.2" "ms" FORMULA "10.965333*X" FORMULA_INV "0.091196498*X" /end COMPU_METHOD
/begin COMPU_METHOD LINEAR______0_000000__0H___349_5 "" FORM "%7.3" "ms" FORMULA "0.0053333333*X" FORMULA_INV "187.5*X" /end COMPU_METHOD
/begin COMPU_METHOD LINEAR______0_000000__0H___25514 "" FORM "%3.0" "s" FORMULA "1.0*X" FORMULA_INV "1.0*X" /end COMPU_METHOD
/begin COMPU_METHOD LINEAR______0_100000__1H___6553_ "" FORM "%6.1" "0.1s" FORMULA "0.1*X+1.3877788e-017" FORMULA_INV "10.0*X-1.3877788e-016" /end COMPU_METHOD
/begin COMPU_METHOD LINEAR______0_100000__1H___25_50 "" FORM "%4.1" "s" FORMULA "0.1*X+1.3877788e-017" FORMULA_INV "10.0*X-1.3877788e-016" /end COMPU_METHOD
/begin COMPU_METHOD LINEAR______10_000000__1H___2515 "" FORM "%4.0" "s" FORMULA "10.0*X" FORMULA_INV "0.1*X" /end COMPU_METHOD
/begin COMPU_METHOD LINEAR_______5_592320__0H___5_59 "" FORM "%7.4" "s" FORMULA "0.00017066406*X-5.59232" FORMULA_INV "5859.4646*X+32768.001" /end COMPU_METHOD
/begin COMPU_METHOD LINEAR______0_000000__0H___10_20 "" FORM "%5.2" "s" FORMULA "0.04*X" FORMULA_INV "25.0*X" /end COMPU_METHOD
/begin COMPU_METHOD LINEAR______0_020000__1H___1310_ "" FORM "%7.2" "s" FORMULA "0.02*X" FORMULA_INV "50.0*X" /end COMPU_METHOD
/begin COMPU_METHOD LINEAR_______128_000000__0H___12 "" FORM "%4.0" "°C" FORMULA "1.0*X-128.0" FORMULA_INV "1.0*X+128.0" /end COMPU_METHOD
/begin COMPU_METHOD LINEAR______0_000000__0H___1_016 "" FORM "%6.4" "-" FORMULA "0.00024414063*X" FORMULA_INV "4096.0*X" /end COMPU_METHOD
/begin COMPU_METHOD LINEAR______0_000000__0H___3_984 "" FORM "%4.2" "-" FORMULA "0.015625*X" FORMULA_INV "64.0*X" /end COMPU_METHOD
/begin COMPU_METHOD LINEAR______0_000000__0H___510_0 "" FORM "%3.0" "Nm" FORMULA "2.0*X" FORMULA_INV "0.5*X" /end COMPU_METHOD
/begin COMPU_METHOD LINEAR______0_000000__0H___13818 "" FORM "%5.1" "mg/stk" FORMULA "0.021194781*X" FORMULA_INV "47.181425*X" /end COMPU_METHOD
/begin COMPU_METHOD LINEAR______0_000000__0H___16383 "" FORM "%8.2" "kg/h" FORMULA "0.25*X" FORMULA_INV "4.0*X" /end COMPU_METHOD
/begin COMPU_METHOD LINEAR_______48_000000__0H___0_0 "" FORM "%5.1" "" FORMULA "0.375*X-48.0" FORMULA_INV "2.6666667*X+128.0" /end COMPU_METHOD
/begin COMPU_METHOD LINEAR______0_000000__0H___51119 "" FORM "%6.2" "m/s^2" FORMULA "0.021701378*X" FORMULA_INV "46.080024*X" /end COMPU_METHOD
/begin COMPU_METHOD LINEAR______0_000000__0H___11920 "" FORM "%4.0" "°PVS" FORMULA "0.46875*X" FORMULA_INV "2.1333333*X" /end COMPU_METHOD
/begin COMPU_METHOD LINEAR______0_010000__1H___655_3 "" FORM "%6.2" "s" FORMULA "0.0099999996*X+3.7247841e-010" FORMULA_INV "100.0*X-3.7247842e-008" /end COMPU_METHOD
/begin COMPU_METHOD LINEAR______0_000000__0H___1000_ "" FORM "%7.2" "rpm" FORMULA "0.25*X" FORMULA_INV "4.0*X" /end COMPU_METHOD
/begin COMPU_METHOD LINEAR______0_000000__0H___3_921 "" FORM "%4.2" "%" FORMULA "0.015625*X" FORMULA_INV "64.0*X" /end COMPU_METHOD
/begin COMPU_METHOD LINEAR______0_000000__0H___95_22 "" FORM "%5.2" "°CRK" FORMULA "0.375*X" FORMULA_INV "2.6666667*X" /end COMPU_METHOD
/begin COMPU_METHOD LINEAR______0_000000__0H___25523 "" FORM "%3.0" "Nm" FORMULA "1.0*X" FORMULA_INV "1.0*X" /end COMPU_METHOD
/begin COMPU_METHOD LINEAR______0_000000__0H___31_00 "" FORM "%3.0" "Nm" FORMULA "1.0*X" FORMULA_INV "1.0*X" /end COMPU_METHOD
/begin COMPU_METHOD LINEAR______0_000000__0H___5434_ "" FORM "%7.2" "hPa" FORMULA "0.082921489*X" FORMULA_INV "12.0596*X" /end COMPU_METHOD
/begin COMPU_METHOD LINEAR______0_000000__0H___4_995 "" FORM "%5.3" "V" FORMULA "0.0048828125*X" FORMULA_INV "204.8*X" /end COMPU_METHOD
/begin COMPU_METHOD LINEAR_______2717_171319__0H___2 "" FORM "%8.2" "hPa" FORMULA "0.082921488*X-2717.1713" FORMULA_INV "12.0596*X+32768.0" /end COMPU_METHOD
/begin COMPU_METHOD LINEAR_______155_625000__FFH____ "" FORM "%6.1" "°CRK" FORMULA "-0.375*X-60.0" FORMULA_INV "-2.6666667*X-160.0" /end COMPU_METHOD
/begin COMPU_METHOD LINEAR______60_000000__0H___155_ "" FORM "%6.2" "°CRK" FORMULA "0.375*X+60.0" FORMULA_INV "2.6666667*X-160.0" /end COMPU_METHOD
/begin COMPU_METHOD LINEAR_______128_000000__0H___25 "" FORM "%4.0" "A" FORMULA "1.0*X-128.0" FORMULA_INV "1.0*X+128.0" /end COMPU_METHOD
/begin COMPU_METHOD LINEAR______0_000000__0H___99_97 "" FORM "%5.2" "%" FORMULA "0.024414063*X" FORMULA_INV "40.959998*X" /end COMPU_METHOD
/begin COMPU_METHOD LINEAR______0_000000__0H___800_0 "" FORM "%6.2" "%" FORMULA "0.024414063*X" FORMULA_INV "40.96*X" /end COMPU_METHOD
/begin COMPU_METHOD LINEAR______0_000000__0H___0_999 "" FORM "%7.5" "-" FORMULA "1.5258789e-005*X" FORMULA_INV "65536.0*X" /end COMPU_METHOD
/begin COMPU_METHOD LINEAR_______50_000000__0H___426 "" FORM "%7.3" "%" FORMULA "0.024414063*X-50.0" FORMULA_INV "40.959998*X+2047.9999" /end COMPU_METHOD
/begin COMPU_METHOD LINEAR______0_000000__0H___1_027 "" FORM "%7.5" "-" FORMULA "1.5259022e-005*X" FORMULA_INV "65535.0*X" /end COMPU_METHOD
/begin COMPU_METHOD LINEAR______0_000000__0H___7_968 "" FORM "%5.3" "-" FORMULA "0.03125*X" FORMULA_INV "32.0*X" /end COMPU_METHOD
/begin COMPU_METHOD LINEAR_______203_000000__0H___20 "" FORM "%5.1" "°C" FORMULA "0.79607843*X-203.0" FORMULA_INV "1.2561576*X+255.0" /end COMPU_METHOD
/begin COMPU_METHOD LINEAR_______33_000000__0H___989 "" FORM "%6.2" "°C" FORMULA "0.015609741*X-33.0" FORMULA_INV "64.06256*X+2114.0645" /end COMPU_METHOD
/begin COMPU_METHOD LINEAR_______500_000000__7E0BH__ "" FORM "%4.0" "A" FORMULA "0.999001*X-32734.765" FORMULA_INV "1.001*X+32767.5" /end COMPU_METHOD
/begin COMPU_METHOD LINEAR______0_000000__0H___143_8 "" FORM "%5.1" "mA" FORMULA "0.56392157*X" FORMULA_INV "1.7732962*X" /end COMPU_METHOD
/begin COMPU_METHOD LINEAR______0_000000__0H___65529 "" FORM "%5.0" "m" FORMULA "1.0*X" FORMULA_INV "1.0*X" /end COMPU_METHOD
/begin COMPU_METHOD LINEAR______0_000000__0H___2550_ "" FORM "%4.0" "ms" FORMULA "10.0*X" FORMULA_INV "0.1*X" /end COMPU_METHOD
/begin COMPU_METHOD LINEAR______0_000000__0H___720_0 "" FORM "%5.1" "°CRK" FORMULA "0.375*X" FORMULA_INV "2.6666667*X" /end COMPU_METHOD
/begin COMPU_METHOD LINEAR_______6_250000__0H___6_20 "" FORM "%5.2" "%" FORMULA "0.048823529*X-6.25" FORMULA_INV "20.481928*X+128.01205" /end COMPU_METHOD
/begin COMPU_METHOD LINEAR_______96_000000__0H___95_ "" FORM "%6.2" "-" FORMULA "0.75*X-96.0" FORMULA_INV "1.3333333*X+128.0" /end COMPU_METHOD
/begin COMPU_METHOD LINEAR______0_000000__0H____95_6 "" FORM "%6.2" "°CRK" FORMULA "-0.375*X" FORMULA_INV "-2.6666667*X" /end COMPU_METHOD
/begin COMPU_METHOD LINEAR______300_000000__14H___54 "" FORM "%3.0" "-" FORMULA "6.0*X+180.0" FORMULA_INV "0.16666667*X-30.0" /end COMPU_METHOD
/begin COMPU_METHOD LINEAR______540_000000__0H___300 "" FORM "%3.0" "°CRK" FORMULA "-6.0*X+540.0" FORMULA_INV "-0.16666667*X+90.0" /end COMPU_METHOD
/begin COMPU_METHOD LINEAR_______4_000000__0H___3_96 "" FORM "%5.2" "-" FORMULA "0.03125*X-4.0" FORMULA_INV "32.0*X+128.0" /end COMPU_METHOD
/begin COMPU_METHOD LINEAR______0_000000__0H___2559_ "" FORM "%7.2" "-" FORMULA "0.0390625*X" FORMULA_INV "25.6*X" /end COMPU_METHOD
/begin COMPU_METHOD LINEAR______1_000000__8000H___1_ "" FORM "%7.5" "-" FORMULA "3.0517594e-005*X-5.1759392e-007" FORMULA_INV "32767.983*X+0.016960509" /end COMPU_METHOD
/begin COMPU_METHOD LINEAR______0_000000__0H___25_50 "" FORM "%4.1" "s" FORMULA "0.1*X" FORMULA_INV "10.0*X" /end COMPU_METHOD
/begin COMPU_METHOD LINEAR______0_000000__0H___26_30 "" FORM "%7.4" "V" FORMULA "0.00039828431*X" FORMULA_INV "2510.7692*X" /end COMPU_METHOD
/begin COMPU_METHOD LINEAR______0_000000__0H___3_999 "" FORM "%7.5" "-" FORMULA "6.1035157e-005*X" FORMULA_INV "16384.0*X" /end COMPU_METHOD
/begin COMPU_METHOD LINEAR______0_000000__0H___3_996 "" FORM "%5.3" "-" FORMULA "0.0039061584*X" FORMULA_INV "256.006*X" /end COMPU_METHOD
/begin COMPU_METHOD LINEAR______0_000000__0H___2_550 "" FORM "%5.3" "-" FORMULA "0.0099999998*X" FORMULA_INV "100.0*X" /end COMPU_METHOD
/begin COMPU_METHOD LINEAR______0_000000__0H___1_032 "" FORM "%5.3" "-" FORMULA "0.0078125*X" FORMULA_INV "128.0*X" /end COMPU_METHOD
/begin COMPU_METHOD LINEAR_______32768_000000__0H___ "" FORM "%6.0" "rpm" FORMULA "1.0*X-32768.0" FORMULA_INV "1.0*X+32768.0" /end COMPU_METHOD
/begin COMPU_METHOD LINEAR_______48_000000__80H___0_ "" FORM "%6.2" "°CRK" FORMULA "-0.375*X" FORMULA_INV "-2.6666667*X" /end COMPU_METHOD
/begin COMPU_METHOD LINEAR______0_000000__0H___1_033 "" FORM "%5.2" "-" FORMULA "0.0039215686*X" FORMULA_INV "255.0*X" /end COMPU_METHOD
/begin COMPU_METHOD LINEAR______0_000000__0H___15_99 "" FORM "%7.4" "-" FORMULA "0.00024414063*X" FORMULA_INV "4096.0*X" /end COMPU_METHOD
/begin COMPU_METHOD LINEAR______0_000000__0H___0_934 "" FORM "%5.2" "-" FORMULA "0.00390625*X" FORMULA_INV "256.0*X" /end COMPU_METHOD
/begin COMPU_METHOD LINEAR______0_000000__0H___7_935 "" FORM "%4.2" "-" FORMULA "0.031247059*X" FORMULA_INV "32.003012*X" /end COMPU_METHOD
/begin COMPU_METHOD LINEAR______0_003906__0H___1_000 "" FORM "%5.3" "-" FORMULA "0.00390625*X+0.00390625" FORMULA_INV "256.0*X-1.0" /end COMPU_METHOD
/begin COMPU_METHOD LINEAR______0_000000__0H___1_999 "" FORM "%7.5" "-" FORMULA "3.0517585e-005*X" FORMULA_INV "32767.992*X" /end COMPU_METHOD
/begin COMPU_METHOD LINEAR_______256_000000__0H___25 "" FORM "%7.3" "km/h" FORMULA "0.0078124999*X-256.0" FORMULA_INV "128.0*X+32768.0" /end COMPU_METHOD
/begin COMPU_METHOD LINEAR______0_000000__0H___1_937 "" FORM "%5.3" "V" FORMULA "0.0078125*X" FORMULA_INV "128.0*X" /end COMPU_METHOD
/begin COMPU_METHOD LINEAR______0_000000__0H___7_999 "" FORM "%6.4" "-" FORMULA "0.00012207031*X" FORMULA_INV "8191.9999*X" /end COMPU_METHOD
/begin COMPU_METHOD LINEAR______0_000000__0H___16338 "" FORM "%8.2" "hPa" FORMULA "0.25*X" FORMULA_INV "4.0*X" /end COMPU_METHOD
/begin COMPU_METHOD LINEAR______0_000000__0H___99_99 "" FORM "%6.3" "%" FORMULA "0.0015258789*X" FORMULA_INV "655.36*X" /end COMPU_METHOD
/begin COMPU_METHOD LINEAR______0_000000__0H___119_8 "" FORM "%7.3" "°TPS" FORMULA "0.0018310545*X" FORMULA_INV "546.13339*X" /end COMPU_METHOD
/begin COMPU_METHOD LINEAR_______50_000000__0H___440 "" FORM "%7.3" "%" FORMULA "0.0015258789*X-50.0" FORMULA_INV "655.36002*X+32768.001" /end COMPU_METHOD
/begin COMPU_METHOD LINEAR______0_000200__1H___0_062 "" FORM "%7.5" "-/10ms" FORMULA "1.5212506e-005*X+0.00018478749" FORMULA_INV "65735.389*X-12.147078" /end COMPU_METHOD
/begin COMPU_METHOD LINEAR_______48_000000__0H___143 "" FORM "%5.1" "°C" FORMULA "0.75*X-48.0" FORMULA_INV "1.3333333*X+64.0" /end COMPU_METHOD
/begin COMPU_METHOD LINEAR______1_000000__100H___1_9 "" FORM "%5.3" "-" FORMULA "0.0039062743*X-6.2243137e-006" FORMULA_INV "255.99841*X+0.0015934144" /end COMPU_METHOD
/begin COMPU_METHOD LINEAR_______48_000000__0H___041 "" FORM "%5.1" "°CRK" FORMULA "0.375*X-48.0" FORMULA_INV "2.6666667*X+128.0" /end COMPU_METHOD
/begin COMPU_METHOD LINEAR______1_000000__80H___1_99 "" FORM "%5.3" "-" FORMULA "0.0078110235*X+0.00018899654" FORMULA_INV "128.0242*X-0.02419613" /end COMPU_METHOD
/begin COMPU_METHOD LINEAR______0_000000__0H___106_2 "" FORM "%5.1" "%/°TPS" FORMULA "0.41662745*X" FORMULA_INV "2.4002259*X" /end COMPU_METHOD
/begin COMPU_METHOD LINEAR______0_000000__0H___119_9 "" FORM "%7.3" "°TPS" FORMULA "0.0018310547*X" FORMULA_INV "546.13333*X" /end COMPU_METHOD
/begin COMPU_METHOD LINEAR______0_000000__0H___11942 "" FORM "%5.1" "°TPS" FORMULA "0.46875*X" FORMULA_INV "2.1333333*X" /end COMPU_METHOD
/begin COMPU_METHOD LINEAR______0_000000__0H___2_043 "" FORM "%5.3" "-" FORMULA "0.0078431373*X" FORMULA_INV "127.5*X" /end COMPU_METHOD
/begin COMPU_METHOD LINEAR______0_000000__0H___2_544 "" FORM "%4.2" "s" FORMULA "0.0099999998*X" FORMULA_INV "100.0*X" /end COMPU_METHOD
/begin COMPU_METHOD LINEAR______0_000000__0H___100_0 "" FORM "%5.1" "%" FORMULA "0.39215686*X" FORMULA_INV "2.55*X" /end COMPU_METHOD
/begin COMPU_METHOD LINEAR______0_000000__0H___0_945 "" FORM "%7.5" "Nm" FORMULA "1.5258789e-005*X" FORMULA_INV "65536.0*X" /end COMPU_METHOD
/begin COMPU_METHOD LINEAR______0_000000__0H___1023_ "" FORM "%4.0" "Nm" FORMULA "1.0*X" FORMULA_INV "1.0*X" /end COMPU_METHOD
/begin COMPU_METHOD LINEAR______0_000000__0H___99_46 "" FORM "%7.3" "%" FORMULA "0.0015258789*X" FORMULA_INV "655.36*X" /end COMPU_METHOD
/begin COMPU_METHOD LINEAR______0_000000__0H___16_00 "" FORM "%7.4" "-" FORMULA "0.0029723203*X" FORMULA_INV "336.4375*X" /end COMPU_METHOD
/begin COMPU_METHOD LINEAR_______1439_956055__0H___1 "" FORM "%8.1" "°pste" FORMULA "0.043943971*X-1439.9561" FORMULA_INV "22.75625*X+32768.0" /end COMPU_METHOD
/begin COMPU_METHOD LINEAR_______1024_000000__7C00H_ "" FORM "%5.0" "-" FORMULA "1.0*X-32768.0" FORMULA_INV "1.0*X+32768.0" /end COMPU_METHOD
/begin COMPU_METHOD LINEAR______0_000000__0H___1_047 "" FORM "%7.5" "-" FORMULA "1.5289117e-005*X" FORMULA_INV "65406.0*X" /end COMPU_METHOD
/begin COMPU_METHOD LINEAR______0_375000__1H___47_62 "" FORM "%5.2" "°CRK/seg" FORMULA "0.375*X" FORMULA_INV "2.6666667*X" /end COMPU_METHOD
/begin COMPU_METHOD LINEAR______0_001465__1H___48_00 "" FORM "%6.3" "°CRK/seg" FORMULA "0.0014648437*X+1.5625477e-007" FORMULA_INV "682.66667*X-0.00010666992" /end COMPU_METHOD
/begin COMPU_METHOD LINEAR_______4096_000000__0H___4 "" FORM "%5.0" "rpm/s" FORMULA "32.0*X-4096.0" FORMULA_INV "0.03125*X+128.0" /end COMPU_METHOD
/begin COMPU_METHOD LINEAR_______48_000000__0H___448 "" FORM "%5.1" "°CRK" FORMULA "0.375*X-48.0" FORMULA_INV "2.6666667*X+128.0" /end COMPU_METHOD
/begin COMPU_METHOD LINEAR_______200_000000__0H___19 "" FORM "%8.4" "%" FORMULA "0.0061035142*X-200.0" FORMULA_INV "163.84004*X+32768.008" /end COMPU_METHOD
/begin COMPU_METHOD LINEAR______0_006100__1H___24_99 "" FORM "%6.3" "%/10ms" FORMULA "0.0061034929*X-3.4929165e-006" FORMULA_INV "163.84061*X+0.00057228156" /end COMPU_METHOD
/begin FUNCTION MON2 "" /end FUNCTION
/begin FUNCTION ETM "exhaust-temperature-model" /end FUNCTION
/begin FUNCTION CSCM "cylinder-specific compound-matching" /end FUNCTION
/begin FUNCTION DMTL "Diagnose Module Tank Leakage" /end FUNCTION
/begin FUNCTION Z10I "Abschnappfunktionsmuster" /end FUNCTION
/begin FUNCTION CNG "CNG from SW43020G10" /end FUNCTION
/begin FUNCTION Z1S1 "SSG-Funktionsmuster" /end FUNCTION
/begin FUNCTION DPM "dew-point-model" /end FUNCTION
/begin FUNCTION R_LS_CALC "R-LS-Calculation" /end FUNCTION
/begin FUNCTION Z41R "Ersetzte Onlinedaten" /end FUNCTION
/begin FUNCTION JOHE_OD "Ersetzte Onlinedaten" /end FUNCTION
/begin FUNCTION THKO_DMTL "" /end FUNCTION
/begin FUNCTION JS_STELL "Onlines die für SAMS Generierung herausgeschnitten werden" /end FUNCTION
/begin RECORD_LAYOUT a_1 FNC_VALUES 1 UBYTE COLUMN_DIR DIRECT /end RECORD_LAYOUT
/begin RECORD_LAYOUT a_2 FNC_VALUES 1 SBYTE COLUMN_DIR DIRECT /end RECORD_LAYOUT
/begin RECORD_LAYOUT a_3 FNC_VALUES 1 UWORD COLUMN_DIR DIRECT /end RECORD_LAYOUT
/begin RECORD_LAYOUT a_6 FNC_VALUES 1 UBYTE COLUMN_DIR DIRECT /end RECORD_LAYOUT
/begin RECORD_LAYOUT a_7 FNC_VALUES 1 UBYTE COLUMN_DIR DIRECT /end RECORD_LAYOUT
/begin RECORD_LAYOUT a_9 FNC_VALUES 1 UWORD COLUMN_DIR DIRECT /end RECORD_LAYOUT
/begin RECORD_LAYOUT a_10 FNC_VALUES 1 SWORD COLUMN_DIR DIRECT /end RECORD_LAYOUT
/begin RECORD_LAYOUT a_17 FNC_VALUES 1 UBYTE COLUMN_DIR DIRECT /end RECORD_LAYOUT
/begin RECORD_LAYOUT a_24 FNC_VALUES 1 UWORD COLUMN_DIR DIRECT /end RECORD_LAYOUT
/begin RECORD_LAYOUT a_28 FNC_VALUES 1 UWORD COLUMN_DIR DIRECT /end RECORD_LAYOUT
/begin RECORD_LAYOUT a_31 FNC_VALUES 1 UBYTE COLUMN_DIR DIRECT /end RECORD_LAYOUT
/begin RECORD_LAYOUT a_36 FNC_VALUES 1 UWORD COLUMN_DIR DIRECT /end RECORD_LAYOUT
/begin RECORD_LAYOUT a_39 FNC_VALUES 1 UBYTE COLUMN_DIR DIRECT /end RECORD_LAYOUT
/begin RECORD_LAYOUT a_742 AXIS_PTS_X 1 UBYTE INDEX_INCR DIRECT /end RECORD_LAYOUT
/begin RECORD_LAYOUT a_743 AXIS_PTS_X 1 UWORD INDEX_INCR DIRECT /end RECORD_LAYOUT
/end MODULE
/end PROJECT
