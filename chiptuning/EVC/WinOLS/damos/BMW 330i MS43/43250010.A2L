ASAP2_VERSION 1 2
/begin PROJECT Z432 "430"
/begin HEADER "" VERSION "056.03" PROJECT_NO Z430 /end HEADER
/begin MODULE BMW-EASY ""
/begin MOD_COMMON "common attributes" DEPOSIT ABSOLUT BYTE_ORDER BIG_ENDIAN /end MOD_COMMON
/begin CHARACTERISTIC c_n_dif_crlc "C_N_DIF_CRLC" VALUE 0x70b7e a_86 20 LINEAR______0_000000__0H___0_996 0.0 0.99609375 BIT_MASK 0xffffffff /end CHARACTERISTIC
/begin CHARACTERISTIC c_n_dif_diagcps "C_N_DIF_DIAGCPS" VALUE 0x7075a a_85 5 LINEAR______0_000000__0H___81612 0.0 8160.0 BIT_MASK 0xffffffff /end CHARACTERISTIC
/begin CHARACTERISTIC c_n_dif_fac "C_N_DIF_FAC" VALUE 0x70b7f a_86 20 LINEAR______0_000000__0H___0_996 0.0 0.99609375 BIT_MASK 0xffffffff /end CHARACTERISTIC
/begin CHARACTERISTIC c_n_dif_low_n "C_N_DIF_LOW_N" VALUE 0x70dea a_95 100 LINEAR_______32768_000000__FFFF8 -32768.0 32767.0 BIT_MASK 0xffffffff FUNCTION_LIST Z10I /end CHARACTERISTIC
/begin CHARACTERISTIC c_n_dif_max_diag "C_N_DIF_MAX_DIAG" VALUE 0x70b80 a_86 100 LINEAR______0_000000__0H___25127 0.0 255.0 BIT_MASK 0xffffffff /end CHARACTERISTIC
/begin CHARACTERISTIC c_n_dif_max_is "C_N_DIF_MAX_IS" VALUE 0x7075c a_85 5 LINEAR______0_000000__0H___81612 0.0 8160.0 BIT_MASK 0xffffffff /end CHARACTERISTIC
/begin CHARACTERISTIC c_n_dif_max_vs_is "C_N_DIF_MAX_VS_IS" VALUE 0x7075e a_85 5 LINEAR______0_000000__0H___81612 0.0 8160.0 BIT_MASK 0xffffffff /end CHARACTERISTIC
/begin CHARACTERISTIC c_n_dif_min_diag "C_N_DIF_MIN_DIAG" VALUE 0x70b81 a_86 100 LINEAR______0_000000__0H___25127 0.0 255.0 BIT_MASK 0xffffffff /end CHARACTERISTIC
/begin CHARACTERISTIC c_n_dif_min_mmv "C_N_DIF_MIN_MMV" VALUE 0x70dec a_95 10 LINEAR_______4080_000000__FFFFF0 -4080.0 0.0 BIT_MASK 0xffffffff /end CHARACTERISTIC
/begin CHARACTERISTIC c_n_dif_min_ris "C_N_DIF_MIN_RIS" VALUE 0x70760 a_85 10 LINEAR______0_000000__0H___81612 0.0 8160.0 BIT_MASK 0xffffffff /end CHARACTERISTIC
/begin CHARACTERISTIC c_n_dyw "C_N_DYW" VALUE 0x70762 a_85 2 LINEAR______0_000000__0H___81612 0.0 8160.0 BIT_MASK 0xffffffff /end CHARACTERISTIC
/begin CHARACTERISTIC c_n_dyw_cat "C_N_DYW_CAT" VALUE 0x70764 a_85 100 LINEAR______0_000000__0H___2040_ 0.0 2040.0 BIT_MASK 0xffffffff /end CHARACTERISTIC
/begin CHARACTERISTIC c_n_dyw_dly "C_N_DYW_DLY" VALUE 0x70766 a_85 100 LINEAR______0_000000__0H___2040_ 0.0 2040.0 BIT_MASK 0xffffffff /end CHARACTERISTIC
/begin CHARACTERISTIC c_n_ecf_hys "C_N_ECF_HYS" VALUE 0x70b82 a_86 100 LINEAR______0_000000__0H___15_94 0.0 15.94 BIT_MASK 0xffffffff /end CHARACTERISTIC
/begin CHARACTERISTIC c_n_grd_isapwm_i_add "C_N_GRD_ISAPWM_I_ADD" VALUE 0x70da9 a_87 5 LINEAR_______4096_000000__FFFFFF -4096.0 0.0 BIT_MASK 0xffffffff /end CHARACTERISTIC
/begin CHARACTERISTIC c_n_grd_low_n "C_N_GRD_LOW_N" VALUE 0x70daa a_87 100 LINEAR_______4096_000000__FFF129 -4096.0 4064.0 BIT_MASK 0xffffffff FUNCTION_LIST Z10I /end CHARACTERISTIC
/begin CHARACTERISTIC c_n_grd_min "C_N_GRD_MIN" VALUE 0x70dab a_87 5 LINEAR_______4096_000000__FFFFFF -4096.0 0.0 BIT_MASK 0xffffffff /end CHARACTERISTIC
/begin CHARACTERISTIC c_n_grd_min_d "C_N_GRD_MIN_D" VALUE 0x70dac a_87 5 LINEAR_______4096_000000__FFFFFF -4096.0 0.0 BIT_MASK 0xffffffff /end CHARACTERISTIC
/begin CHARACTERISTIC c_n_hys_max_puc "C_N_HYS_MAX_PUC" VALUE 0x70b83 a_86 10 LINEAR______0_000000__0H___8160_ 0.0 8160.0 BIT_MASK 0xffffffff /end CHARACTERISTIC
/begin CHARACTERISTIC c_n_hys_max_puc_dri "C_N_HYS_MAX_PUC_DRI" VALUE 0x70b84 a_86 10 LINEAR______0_000000__0H___8160_ 0.0 8160.0 BIT_MASK 0xffffffff /end CHARACTERISTIC
/begin CHARACTERISTIC c_n_hys_puc_st "C_N_HYS_PUC_ST" VALUE 0x70b85 a_86 10 LINEAR______0_000000__0H___8160_ 0.0 8160.0 BIT_MASK 0xffffffff /end CHARACTERISTIC
/begin CHARACTERISTIC c_n_hys_vim "C_N_HYS_VIM" VALUE 0x70768 a_85 5 LINEAR______0_000000__0H___81612 0.0 8160.0 BIT_MASK 0xffffffff /end CHARACTERISTIC
/begin CHARACTERISTIC c_n_iga_hys_knk "C_N_IGA_HYS_KNK" VALUE 0x70b86 a_86 2 LINEAR______0_000000__0H___8160_ 0.0 8160.0 BIT_MASK 0xffffffff /end CHARACTERISTIC
/begin CHARACTERISTIC c_n_isa_diag "C_N_ISA_DIAG" VALUE 0x70b87 a_86 100 LINEAR______0_000000__0H___8160_ 0.0 8160.0 BIT_MASK 0xffffffff /end CHARACTERISTIC
/begin CHARACTERISTIC c_n_isapwm_add_on "C_N_ISAPWM_ADD_ON" VALUE 0x7076a a_85 1 LINEAR______0_000000__0H___81612 0.0 8160.0 BIT_MASK 0xffffffff /end CHARACTERISTIC
/begin CHARACTERISTIC c_n_lam_dly_p_max "C_N_LAM_DLY_P_MAX" VALUE 0x70b88 a_86 100 LINEAR______0_000000__0H___8160_ 0.0 8160.0 BIT_MASK 0xffffffff /end CHARACTERISTIC
/begin CHARACTERISTIC c_n_lam_dly_p_min "C_N_LAM_DLY_P_MIN" VALUE 0x70b89 a_86 100 LINEAR______0_000000__0H___8160_ 0.0 8160.0 BIT_MASK 0xffffffff /end CHARACTERISTIC
/begin CHARACTERISTIC c_n_lim_min "C_N_LIM_MIN" VALUE 0x7076c a_85 100 LINEAR______0_000000__0H___81612 0.0 8160.0 BIT_MASK 0xffffffff /end CHARACTERISTIC
/begin CHARACTERISTIC c_n_max_aj "C_N_MAX_AJ" VALUE 0x70b8a a_86 100 LINEAR______0_000000__0H___5984_ 0.0 5984.0 BIT_MASK 0xffffffff /end CHARACTERISTIC
/begin CHARACTERISTIC c_n_max_amt_add "C_N_MAX_AMT_ADD" VALUE 0x70b8b a_86 100 LINEAR______0_000000__0H___8160_ 0.0 8160.0 BIT_MASK 0xffffffff FUNCTION_LIST Z1S1 /end CHARACTERISTIC
/begin CHARACTERISTIC c_n_max_amt_gp "C_N_MAX_AMT_GP" VALUE 0x70b8c a_86 100 LINEAR______0_000000__0H___8160_ 0.0 8160.0 BIT_MASK 0xffffffff FUNCTION_LIST Z1S1 /end CHARACTERISTIC
/begin CHARACTERISTIC c_n_max_bol_st "C_N_MAX_BOL_ST" VALUE 0x70b8d a_86 5 LINEAR______0_000000__0H___8160_ 0.0 8160.0 BIT_MASK 0xffffffff /end CHARACTERISTIC
/begin CHARACTERISTIC c_n_max_ch_3 "C_N_MAX_CH_3" VALUE 0x70b8e a_86 100 LINEAR______0_000000__0H___8160_ 0.0 8160.0 BIT_MASK 0xffffffff /end CHARACTERISTIC
/begin CHARACTERISTIC c_n_max_cp_fl "C_N_MAX_CP_FL" VALUE 0x70b8f a_86 100 LINEAR______0_000000__0H___8160_ 0.0 8160.0 BIT_MASK 0xffffffff /end CHARACTERISTIC
/begin CHARACTERISTIC c_n_max_cur_igc "C_N_MAX_CUR_IGC" VALUE 0x70b90 a_86 10 LINEAR______0_000000__0H___8160_ 0.0 8160.0 BIT_MASK 0xffffffff /end CHARACTERISTIC
/begin CHARACTERISTIC c_n_max_cyl_lam "C_N_MAX_CYL_LAM" VALUE 0x70b91 a_86 10 LINEAR______0_000000__0H___8160_ 0.0 8160.0 BIT_MASK 0xffffffff FUNCTION_LIST CSCM /end CHARACTERISTIC
/begin CHARACTERISTIC c_n_max_diag_sa "C_N_MAX_DIAG_SA" VALUE 0x70b92 a_86 10 LINEAR______0_000000__0H___8160_ 0.0 8160.0 BIT_MASK 0xffffffff /end CHARACTERISTIC
/begin CHARACTERISTIC c_n_max_dri_rvl "C_N_MAX_DRI_RVL" VALUE 0x70b93 a_86 100 LINEAR______0_000000__0H___8160_ 0.0 8160.0 BIT_MASK 0xffffffff /end CHARACTERISTIC
/begin CHARACTERISTIC c_n_max_eoi_ti_tra "C_N_MAX_EOI_TI_TRA" VALUE 0x70b94 a_86 20 LINEAR______0_000000__0H___5024_ 0.0 5024.0 BIT_MASK 0xffffffff /end CHARACTERISTIC
/begin CHARACTERISTIC c_n_max_er "C_N_MAX_ER" VALUE 0x7076e a_85 100 LINEAR______480_000000__1E0H___8 480.0 8160.0 BIT_MASK 0xffffffff /end CHARACTERISTIC
/begin CHARACTERISTIC c_n_max_etc_lih "C_N_MAX_ETC_LIH" VALUE 0x70b95 a_86 100 LINEAR______0_000000__0H___8160_ 0.0 8160.0 BIT_MASK 0xffffffff /end CHARACTERISTIC
/begin CHARACTERISTIC c_n_max_etc_lih_mon "C_N_MAX_ETC_LIH_MON" VALUE 0x71267 a_86 100 LINEAR______0_000000__0H___8160_ 0.0 8160.0 BIT_MASK 0xffffffff /end CHARACTERISTIC
/begin CHARACTERISTIC c_n_max_fl "C_N_MAX_FL" VALUE 0x70b96 a_86 10 LINEAR______0_000000__0H___8160_ 0.0 8160.0 BIT_MASK 0xffffffff /end CHARACTERISTIC
/begin CHARACTERISTIC c_n_max_hfm_diag "C_N_MAX_HFM_DIAG" VALUE 0x70b97 a_86 100 LINEAR______0_000000__0H___8160_ 0.0 8160.0 BIT_MASK 0xffffffff /end CHARACTERISTIC
/begin CHARACTERISTIC c_n_max_hys "C_N_MAX_HYS" VALUE 0x70b98 a_86 5 LINEAR______0_000000__0H___8160_ 0.0 8160.0 BIT_MASK 0xffffffff /end CHARACTERISTIC
/begin CHARACTERISTIC c_n_max_hys_diag "C_N_MAX_HYS_DIAG" VALUE 0x70b99 a_86 5 LINEAR______0_000000__0H___8160_ 0.0 8160.0 BIT_MASK 0xffffffff /end CHARACTERISTIC
/begin CHARACTERISTIC c_n_max_hys_max "C_N_MAX_HYS_MAX" VALUE 0x70b9a a_86 5 LINEAR______0_000000__0H___8160_ 0.0 8160.0 BIT_MASK 0xffffffff /end CHARACTERISTIC
/begin CHARACTERISTIC c_n_max_hys_n_max "C_N_MAX_HYS_N_MAX" VALUE 0x70b9b a_86 5 LINEAR______0_000000__0H___8160_ 0.0 8160.0 BIT_MASK 0xffffffff /end CHARACTERISTIC
/begin CHARACTERISTIC c_n_max_hys_ti_cor "C_N_MAX_HYS_TI_COR" VALUE 0x70b9c a_86 5 LINEAR______0_000000__0H___8160_ 0.0 8160.0 BIT_MASK 0xffffffff /end CHARACTERISTIC
/begin CHARACTERISTIC c_n_max_hys_ti_cor_diag "C_N_MAX_HYS_TI_COR_DIAG" VALUE 0x70b9d a_86 5 LINEAR______0_000000__0H___8160_ 0.0 8160.0 BIT_MASK 0xffffffff /end CHARACTERISTIC
/begin CHARACTERISTIC c_n_max_iga_cor_cam_dif "C_N_MAX_IGA_COR_CAM_DIF" VALUE 0x70b9e a_86 100 LINEAR______0_000000__0H___8160_ 0.0 8160.0 BIT_MASK 0xffffffff /end CHARACTERISTIC
/begin CHARACTERISTIC c_n_max_igcfb_diag "C_N_MAX_IGCFB_DIAG" VALUE 0x70b9f a_86 10 LINEAR______0_000000__0H___8160_ 0.0 8160.0 BIT_MASK 0xffffffff /end CHARACTERISTIC
/begin CHARACTERISTIC c_n_max_ign_mpl "C_N_MAX_IGN_MPL" VALUE 0x70ba0 a_86 100 LINEAR______0_000000__0H___8160_ 0.0 8160.0 BIT_MASK 0xffffffff /end CHARACTERISTIC
/begin CHARACTERISTIC c_n_max_lgrd_dec "C_N_MAX_LGRD_DEC" VALUE 0x70770 a_85 100 LINEAR______0_000000__0H___81130 0.0 8160.0 BIT_MASK 0xffffffff /end CHARACTERISTIC
/begin CHARACTERISTIC c_n_max_lgrd_diag "C_N_MAX_LGRD_DIAG" VALUE 0x70772 a_85 100 LINEAR______0_000000__0H___81130 0.0 8160.0 BIT_MASK 0xffffffff /end CHARACTERISTIC
/begin CHARACTERISTIC c_n_max_max_add "C_N_MAX_MAX_ADD" VALUE 0x70ba1 a_86 10 LINEAR______0_000000__0H___8160_ 0.0 8160.0 BIT_MASK 0xffffffff /end CHARACTERISTIC
/begin CHARACTERISTIC c_n_max_min_diag "C_N_MAX_MIN_DIAG" VALUE 0x70ba2 a_86 10 LINEAR______0_000000__0H___8160_ 0.0 8160.0 BIT_MASK 0xffffffff /end CHARACTERISTIC
/begin CHARACTERISTIC c_n_max_mtc_lih_thd_mon "C_N_MAX_MTC_LIH_THD_MON" VALUE 0x71268 a_86 100 LINEAR______0_000000__0H___8160_ 0.0 8160.0 BIT_MASK 0xffffffff /end CHARACTERISTIC
/begin CHARACTERISTIC c_n_max_mtc_lih_thd_mon2 "C_N_MAX_MTC_LIH_THD_MON2" VALUE 0x70ba3 a_86 100 LINEAR______0_000000__0H___8160_ 0.0 8160.0 BIT_MASK 0xffffffff FUNCTION_LIST MON2 /end CHARACTERISTIC
/begin CHARACTERISTIC c_n_max_n_isa "C_N_MAX_N_ISA" VALUE 0x70ba4 a_86 100 LINEAR______0_000000__0H___2048_ 0.0 2048.0 BIT_MASK 0xffffffff FUNCTION_LIST Z10I /end CHARACTERISTIC
/begin CHARACTERISTIC c_n_max_sa "C_N_MAX_SA" VALUE 0x70ba5 a_86 10 LINEAR______0_000000__0H___8160_ 0.0 8160.0 BIT_MASK 0xffffffff /end CHARACTERISTIC
/begin CHARACTERISTIC c_n_max_t_seg_ad_er "C_N_MAX_T_SEG_AD_ER" VALUE 0x70ba6 a_86 5 LINEAR______0_000000__0H___8160_ 0.0 8160.0 BIT_MASK 0xffffffff /end CHARACTERISTIC
/begin CHARACTERISTIC c_n_max_tps_ad "C_N_MAX_TPS_AD" VALUE 0x70ba7 a_86 100 LINEAR______0_000000__0H___81131 0.0 8160.0 BIT_MASK 0xffffffff /end CHARACTERISTIC
/begin CHARACTERISTIC c_n_max_vb_mmv "C_N_MAX_VB_MMV" VALUE 0x70774 a_85 10 LINEAR______0_000000__0H___81612 0.0 8160.0 BIT_MASK 0xffffffff /end CHARACTERISTIC
/begin CHARACTERISTIC c_n_max_vs_diag "C_N_MAX_VS_DIAG" VALUE 0x70ba8 a_86 10 LINEAR______0_000000__0H___8160_ 0.0 8160.0 BIT_MASK 0xffffffff /end CHARACTERISTIC
/begin CHARACTERISTIC c_n_max_vs_max_hys "C_N_MAX_VS_MAX_HYS" VALUE 0x70776 a_85 10 LINEAR______0_000000__0H___81612 0.0 8160.0 BIT_MASK 0xffffffff /end CHARACTERISTIC
/begin CHARACTERISTIC c_n_min_aj "C_N_MIN_AJ" VALUE 0x70ba9 a_86 100 LINEAR______0_000000__0H___8160_ 0.0 8160.0 BIT_MASK 0xffffffff /end CHARACTERISTIC
/begin CHARACTERISTIC c_n_min_cs_diag "C_N_MIN_CS_DIAG" VALUE 0x70baa a_86 100 LINEAR______0_000000__0H___8160_ 0.0 8160.0 BIT_MASK 0xffffffff /end CHARACTERISTIC
/begin CHARACTERISTIC c_n_min_dhp "C_N_MIN_DHP" VALUE 0x70bab a_86 12 LINEAR______0_000000__0H___8160_ 0.0 8160.0 BIT_MASK 0xffffffff /end CHARACTERISTIC
/begin CHARACTERISTIC c_n_min_ect_plaus_diag "C_N_MIN_ECT_PLAUS_DIAG" VALUE 0x70bac a_86 100 LINEAR______0_000000__0H___8160_ 0.0 8160.0 BIT_MASK 0xffffffff /end CHARACTERISTIC
/begin CHARACTERISTIC c_n_min_er "C_N_MIN_ER" VALUE 0x70778 a_85 100 LINEAR______480_000000__1E0H___8 480.0 8160.0 BIT_MASK 0xffffffff /end CHARACTERISTIC
/begin CHARACTERISTIC c_n_min_fl "C_N_MIN_FL" VALUE 0x70bad a_86 10 LINEAR______0_000000__0H___8160_ 0.0 8160.0 BIT_MASK 0xffffffff /end CHARACTERISTIC
/begin CHARACTERISTIC c_n_min_hfm_diag "C_N_MIN_HFM_DIAG" VALUE 0x70bae a_86 100 LINEAR______0_000000__0H___8160_ 0.0 8160.0 BIT_MASK 0xffffffff /end CHARACTERISTIC
/begin CHARACTERISTIC c_n_min_knk_ad_at "C_N_MIN_KNK_AD_AT" VALUE 0x70baf a_86 100 LINEAR______0_000000__0H___8160_ 0.0 8160.0 BIT_MASK 0xffffffff /end CHARACTERISTIC
/begin CHARACTERISTIC c_n_min_knk_diag "C_N_MIN_KNK_DIAG" VALUE 0x70bb0 a_86 100 LINEAR______1024_000000__20H___8 1024.0 8160.0 BIT_MASK 0xffffffff /end CHARACTERISTIC
/begin CHARACTERISTIC c_n_min_lgrd_pu "C_N_MIN_LGRD_PU" VALUE 0x70bb1 a_86 12 LINEAR______0_000000__0H___8160_ 0.0 8160.0 BIT_MASK 0xffffffff /end CHARACTERISTIC
/begin CHARACTERISTIC c_n_min_maf_diag "C_N_MIN_MAF_DIAG" VALUE 0x70bb2 a_86 30 LINEAR______0_000000__0H___8160_ 0.0 8160.0 BIT_MASK 0xffffffff /end CHARACTERISTIC
/begin CHARACTERISTIC c_n_min_maf_diag_mon "C_N_MIN_MAF_DIAG_MON" VALUE 0x71269 a_86 10 LINEAR______0_000000__0H___8160_ 0.0 8160.0 BIT_MASK 0xffffffff /end CHARACTERISTIC
/begin CHARACTERISTIC c_n_min_puc_diag "C_N_MIN_PUC_DIAG" VALUE 0x70bb3 a_86 100 LINEAR______0_000000__0H___8160_ 0.0 8160.0 BIT_MASK 0xffffffff /end CHARACTERISTIC
/begin CHARACTERISTIC c_n_min_slow_pu "C_N_MIN_SLOW_PU" VALUE 0x70bb4 a_86 10 LINEAR______0_000000__0H___8160_ 0.0 8160.0 BIT_MASK 0xffffffff /end CHARACTERISTIC
/begin CHARACTERISTIC c_n_min_t_seg_ad_er "C_N_MIN_T_SEG_AD_ER" VALUE 0x70bb5 a_86 5 LINEAR______480_000000__FH___816 480.0 8160.0 BIT_MASK 0xffffffff /end CHARACTERISTIC
/begin CHARACTERISTIC c_n_min_ti_ad_fsd "C_N_MIN_TI_AD_FSD" VALUE 0x70bb6 a_86 100 LINEAR______0_000000__0H___8160_ 0.0 8160.0 BIT_MASK 0xffffffff /end CHARACTERISTIC
/begin CHARACTERISTIC c_n_min_tra_cs "C_N_MIN_TRA_CS" VALUE 0x7077a a_85 100 LINEAR______0_000000__0H___81612 0.0 8160.0 BIT_MASK 0xffffffff /end CHARACTERISTIC
/begin CHARACTERISTIC c_n_min_vs_max "C_N_MIN_VS_MAX" VALUE 0x70bb7 a_86 100 LINEAR______0_000000__0H___8160_ 0.0 8160.0 BIT_MASK 0xffffffff /end CHARACTERISTIC
/begin CHARACTERISTIC c_n_perc_act_ecf "C_N_PERC_ACT_ECF" VALUE 0x70bb8 a_86 100 LINEAR______0_000000__0H___99_60 0.0 99.609375 BIT_MASK 0xffffffff /end CHARACTERISTIC
/begin CHARACTERISTIC c_n_perc_ecf_lgrd "C_N_PERC_ECF_LGRD" VALUE 0x70bb9 a_86 100 LINEAR______0_000000__0H___25_00 0.0 25.0 BIT_MASK 0xffffffff /end CHARACTERISTIC
/begin CHARACTERISTIC c_n_pvs_bls_bts_plaus "C_N_PVS_BLS_BTS_PLAUS" VALUE 0x70bba a_86 100 LINEAR______0_000000__0H___8160_ 0.0 8160.0 BIT_MASK 0xffffffff /end CHARACTERISTIC
/begin CHARACTERISTIC c_n_r_ls_mes_max "C_N_R_LS_MES_MAX" VALUE 0x7077c a_85 100 LINEAR______0_000000__0H___81612 0.0 8160.0 BIT_MASK 0xffffffff FUNCTION_LIST R_LS_CALC /end CHARACTERISTIC
/begin CHARACTERISTIC c_n_sp_add_max_sif "C_N_SP_ADD_MAX_SIF" VALUE 0x70bbb a_86 100 LINEAR_______256_000000__0H___81 -256.0 254.0 BIT_MASK 0xffffffff /end CHARACTERISTIC
/begin CHARACTERISTIC c_n_sp_add_min_sif "C_N_SP_ADD_MIN_SIF" VALUE 0x70bbc a_86 100 LINEAR_______256_000000__0H___81 -256.0 254.0 BIT_MASK 0xffffffff /end CHARACTERISTIC
/begin CHARACTERISTIC c_n_sp_dec_cs "C_N_SP_DEC_CS" VALUE 0x70bbd a_86 20 LINEAR______0_031250__1H___7_132 0.03125 7.96875 BIT_MASK 0xffffffff /end CHARACTERISTIC
/begin CHARACTERISTIC c_n_sp_inc_cs "C_N_SP_INC_CS" VALUE 0x70bbe a_86 20 LINEAR______0_031250__1H___7_132 0.03125 7.96875 BIT_MASK 0xffffffff /end CHARACTERISTIC
/begin CHARACTERISTIC c_n_sp_is_ivvt_diag "C_N_SP_IS_IVVT_DIAG" VALUE 0x7077e a_85 100 LINEAR______0_000000__0H___81612 0.0 8160.0 BIT_MASK 0xffffffff /end CHARACTERISTIC
/begin CHARACTERISTIC c_n_sp_is_lih "C_N_SP_IS_LIH" VALUE 0x70780 a_85 100 LINEAR______0_000000__0H___81612 0.0 8160.0 BIT_MASK 0xffffffff /end CHARACTERISTIC
/begin CHARACTERISTIC c_n_sp_lgrd_ch_2_red "C_N_SP_LGRD_CH_2_RED" VALUE 0x70bbf a_86 20 LINEAR______0_031250__1H___7_968 0.03125 7.96875 BIT_MASK 0xffffffff /end CHARACTERISTIC
/begin CHARACTERISTIC c_n_sp_lgrd_is "C_N_SP_LGRD_IS" VALUE 0x70bc0 a_86 20 LINEAR______0_250000__1H___63_75 0.25 63.75 BIT_MASK 0xffffffff /end CHARACTERISTIC
/begin CHARACTERISTIC c_n_thd_aj "C_N_THD_AJ" VALUE 0x70bc1 a_86 100 LINEAR______1824_000000__39H___8 1824.0 8160.0 BIT_MASK 0xffffffff /end CHARACTERISTIC
/begin CHARACTERISTIC c_n_ti_ad_add_max "C_N_TI_AD_ADD_MAX" VALUE 0x70782 a_85 100 LINEAR______1_000000__1H___8160_ 1.0 8160.0 BIT_MASK 0xffffffff /end CHARACTERISTIC
/begin CHARACTERISTIC c_n_ti_ad_fac_min "C_N_TI_AD_FAC_MIN" VALUE 0x70784 a_85 100 LINEAR______0_000000__0H___81612 0.0 8160.0 BIT_MASK 0xffffffff /end CHARACTERISTIC
/begin CHARACTERISTIC c_n_tps_min_diag_mon "C_N_TPS_MIN_DIAG_MON" VALUE 0x7126a a_86 10 LINEAR______0_000000__0H___8160_ 0.0 8160.0 BIT_MASK 0xffffffff /end CHARACTERISTIC
/begin CHARACTERISTIC c_n_vs_cru_gear2_puc_sp "C_N_VS_CRU_GEAR2_PUC_SP" VALUE 0x70786 a_85 100 LINEAR______0_000000__0H___81608 0.0 8160.0 BIT_MASK 0xffffffff /end CHARACTERISTIC
/begin CHARACTERISTIC c_n_vs_cru_grd_fac_gr_max "C_N_VS_CRU_GRD_FAC_GR_MAX" VALUE 0x70788 a_85 10 LINEAR______0_000000__0H___81608 0.0 8160.0 BIT_MASK 0xffffffff /end CHARACTERISTIC
/begin CHARACTERISTIC c_n_vs_max_cru "C_N_VS_MAX_CRU" VALUE 0x70bc2 a_86 10 LINEAR______0_000000__0H___99_60 0.0 99.609375 BIT_MASK 0xffffffff /end CHARACTERISTIC
/begin CHARACTERISTIC c_n_vs_min_diag "C_N_VS_MIN_DIAG" VALUE 0x70bc3 a_86 10 LINEAR______0_000000__0H___8160_ 0.0 8160.0 BIT_MASK 0xffffffff /end CHARACTERISTIC
/begin CHARACTERISTIC c_nl_crlc "C_NL_CRLC" VALUE 0x7078a a_85 5 LINEAR______0_000015__1H___0_999 1.5259e-005 0.99998474 BIT_MASK 0xffffffff /end CHARACTERISTIC
/begin CHARACTERISTIC c_nl_crlc_tra "C_NL_CRLC_TRA" VALUE 0x7078c a_85 5 LINEAR______0_000015__1H___0_999 1.5259e-005 0.99998474 BIT_MASK 0xffffffff /end CHARACTERISTIC
/begin CHARACTERISTIC c_nl_fac_crlc "C_NL_FAC_CRLC" VALUE 0x70bc4 a_86 10 LINEAR______0_000000__0H___0_124 0.0 0.1245 BIT_MASK 0xffffffff /end CHARACTERISTIC
/begin CHARACTERISTIC c_nl_fac_mmv_max "C_NL_FAC_MMV_MAX" VALUE 0x70bc5 a_86 5 LINEAR______0_000000__0H___1_992 0.0 1.9921875 BIT_MASK 0xffffffff /end CHARACTERISTIC
/begin CHARACTERISTIC c_nl_fac_mmv_min "C_NL_FAC_MMV_MIN" VALUE 0x70bc6 a_86 5 LINEAR______0_000000__0H___1_992 0.0 1.9921875 BIT_MASK 0xffffffff /end CHARACTERISTIC
/begin CHARACTERISTIC c_nl_max "C_NL_MAX" VALUE 0x7078e a_85 5 LINEAR______0_000000__0H___5_133 0.0 5.1 BIT_MASK 0xffffffff /end CHARACTERISTIC
/begin CHARACTERISTIC c_nl_min "C_NL_MIN" VALUE 0x70790 a_85 5 LINEAR______0_000000__0H___5_133 0.0 5.1 BIT_MASK 0xffffffff /end CHARACTERISTIC
/begin CHARACTERISTIC c_nr_mes_vls_down "C_NR_MES_VLS_DOWN" VALUE 0x70bc7 a_86 10 LINEAR______1_000000__1H___8_000 1.0 8.0 BIT_MASK 0xffffffff FUNCTION_LIST R_LS_CALC /end CHARACTERISTIC
/begin CHARACTERISTIC c_nr_mes_vls_up "C_NR_MES_VLS_UP" VALUE 0x70bc8 a_86 10 LINEAR______1_000000__1H___8_000 1.0 8.0 BIT_MASK 0xffffffff FUNCTION_LIST R_LS_CALC /end CHARACTERISTIC
/begin CHARACTERISTIC c_nr_r_ls_diag_mes "C_NR_R_LS_DIAG_MES" VALUE 0x70bc9 a_86 100 LINEAR______0_000000__0H___255_0 0.0 255.0 BIT_MASK 0xffffffff FUNCTION_LIST R_LS_CALC /end CHARACTERISTIC
/begin CHARACTERISTIC c_nr_r_ls_down_mes "C_NR_R_LS_DOWN_MES" VALUE 0x70bca a_86 4 LINEAR______0_000000__0H___255_0 0.0 255.0 BIT_MASK 0xffffffff FUNCTION_LIST R_LS_CALC /end CHARACTERISTIC
/begin CHARACTERISTIC c_nr_r_ls_up_mes "C_NR_R_LS_UP_MES" VALUE 0x70bcb a_86 4 LINEAR______0_000000__0H___255_0 0.0 255.0 BIT_MASK 0xffffffff FUNCTION_LIST R_LS_CALC /end CHARACTERISTIC
/begin CHARACTERISTIC c_o2_cat_mv_dif_max "C_O2_CAT_MV_DIF_MAX" VALUE 0x70bcc a_86 100 LINEAR______0_000000__0H___0_996 0.0 0.99609375 BIT_MASK 0xffffffff /end CHARACTERISTIC
/begin CHARACTERISTIC c_o2_cat_mv_max "C_O2_CAT_MV_MAX" VALUE 0x70bcd a_86 100 LINEAR______0_000000__0H___0_996 0.0 0.99609375 BIT_MASK 0xffffffff /end CHARACTERISTIC
/begin CHARACTERISTIC c_o2_cat_mv_min "C_O2_CAT_MV_MIN" VALUE 0x70bce a_86 100 LINEAR______0_000000__0H___0_996 0.0 0.99609375 BIT_MASK 0xffffffff /end CHARACTERISTIC
/begin CHARACTERISTIC c_obd_diag_state "C_OBD_DIAG_STATE" VALUE 0x70bcf a_86 100 LINEAR______0_000000__0H___255_0 0.0 255.0 BIT_MASK 0xffffffff /end CHARACTERISTIC
/begin CHARACTERISTIC c_p_sum_cp "C_P_SUM_CP" VALUE 0x70bd0 a_86 10 LINEAR______0_000000__0H___255_0 0.0 255.0 BIT_MASK 0xffffffff /end CHARACTERISTIC
/begin CHARACTERISTIC c_pgas_h_grd_max_diag "C_PGAS_H_GRD_MAX_DIAG" VALUE 0x70bd1 a_86 100 LINEAR______0_000000__0H___21134 0.0 216750.0 BIT_MASK 0xffffffff FUNCTION_LIST CNG /end CHARACTERISTIC
/begin CHARACTERISTIC c_pgas_h_min "C_PGAS_H_MIN" VALUE 0x70bd2 a_86 100 LINEAR______0_000000__0H___21675 0.0 216750.0 BIT_MASK 0xffffffff FUNCTION_LIST CNG /end CHARACTERISTIC
/begin CHARACTERISTIC c_pgas_l_grd_max_diag "C_PGAS_L_GRD_MAX_DIAG" VALUE 0x70792 a_85 100 LINEAR______0_000000__0H___16135 0.0 16383.75 BIT_MASK 0xffffffff FUNCTION_LIST CNG /end CHARACTERISTIC
/begin CHARACTERISTIC c_pgas_l_max "C_PGAS_L_MAX" VALUE 0x70794 a_85 100 LINEAR______0_000000__0H___16338 0.0 16383.75 BIT_MASK 0xffffffff FUNCTION_LIST CNG /end CHARACTERISTIC
/begin CHARACTERISTIC c_pq_turb_sys_isa_diag "C_PQ_TURB_SYS_ISA_DIAG" VALUE 0x70bd3 a_86 100 LINEAR______0_000000__0H___0_996 0.0 0.99609375 BIT_MASK 0xffffffff /end CHARACTERISTIC
/begin CHARACTERISTIC c_pste_1_cycnr_max "C_PSTE_1_CYCNR_MAX" VALUE 0x70bd4 a_86 100 LINEAR______1_000000__1H___255_0 1.0 255.0 BIT_MASK 0xffffffff /end CHARACTERISTIC
/begin CHARACTERISTIC c_pv_pvs_slop_mon "C_PV_PVS_SLOP_MON" VALUE 0x7126b a_86 100 LINEAR______0_000000__0H___2_400 0.0 2.4 BIT_MASK 0xffffffff /end CHARACTERISTIC
/begin CHARACTERISTIC c_pvs_av_bls_not_plaus "C_PVS_AV_BLS_NOT_PLAUS" VALUE 0x70796 a_85 100 LINEAR______0_000000__0H___11960 0.0 119.9982 BIT_MASK 0xffffffff /end CHARACTERISTIC
/begin CHARACTERISTIC c_pvs_av_bls_not_plaus_lgrd "C_PVS_AV_BLS_NOT_PLAUS_LGRD" VALUE 0x70798 a_85 100 LINEAR______0_000000__0H___11960 0.0 119.9982 BIT_MASK 0xffffffff /end CHARACTERISTIC
/begin CHARACTERISTIC c_pvs_av_bls_plaus "C_PVS_AV_BLS_PLAUS" VALUE 0x7079a a_85 100 LINEAR______0_000000__0H___11960 0.0 119.9982 BIT_MASK 0xffffffff /end CHARACTERISTIC
/begin CHARACTERISTIC c_pvs_av_bls_plaus_hys "C_PVS_AV_BLS_PLAUS_HYS" VALUE 0x7079c a_85 100 LINEAR______0_000000__0H___11960 0.0 119.9982 BIT_MASK 0xffffffff /end CHARACTERISTIC
/begin CHARACTERISTIC c_pvs_av_bol_at "C_PVS_AV_BOL_AT" VALUE 0x7079e a_85 100 LINEAR______0_000000__0H___119_9 0.0 119.99817 BIT_MASK 0xffffffff /end CHARACTERISTIC
/begin CHARACTERISTIC c_pvs_av_bol_mt "C_PVS_AV_BOL_MT" VALUE 0x707a0 a_85 100 LINEAR______0_000000__0H___119_9 0.0 119.99817 BIT_MASK 0xffffffff /end CHARACTERISTIC
/begin CHARACTERISTIC c_pvs_av_bol_ssg "C_PVS_AV_BOL_SSG" VALUE 0x707a2 a_85 100 LINEAR______0_000000__0H___119_9 0.0 119.99817 BIT_MASK 0xffffffff FUNCTION_LIST Z1S1 /end CHARACTERISTIC
/begin CHARACTERISTIC c_pvs_av_grd_max_rpl "C_PVS_AV_GRD_MAX_RPL" VALUE 0x707a4 a_85 100 LINEAR______0_000000__0H___59_99 0.0 59.998169 BIT_MASK 0xffffffff /end CHARACTERISTIC
/begin CHARACTERISTIC c_pvs_av_hys_bls_bts_plaus "C_PVS_AV_HYS_BLS_BTS_PLAUS" VALUE 0x707a6 a_85 100 LINEAR______0_000000__0H___11960 0.0 119.9982 BIT_MASK 0xffffffff /end CHARACTERISTIC
/begin CHARACTERISTIC c_pvs_av_low_n "C_PVS_AV_LOW_N" VALUE 0x707a8 a_85 100 LINEAR______0_000000__0H___11960 0.0 119.9982 BIT_MASK 0xffffffff FUNCTION_LIST Z10I /end CHARACTERISTIC
/begin CHARACTERISTIC c_pvs_av_pvs_bls_bts_plaus "C_PVS_AV_PVS_BLS_BTS_PLAUS" VALUE 0x707aa a_85 100 LINEAR______0_000000__0H___11960 0.0 119.9982 BIT_MASK 0xffffffff /end CHARACTERISTIC
/begin CHARACTERISTIC c_pvs_av_tol_at "C_PVS_AV_TOL_AT" VALUE 0x707ac a_85 100 LINEAR______0_000000__0H___119_9 0.0 119.99817 BIT_MASK 0xffffffff /end CHARACTERISTIC
/begin CHARACTERISTIC c_pvs_av_tol_mt "C_PVS_AV_TOL_MT" VALUE 0x707ae a_85 100 LINEAR______0_000000__0H___119_9 0.0 119.99817 BIT_MASK 0xffffffff /end CHARACTERISTIC
/begin CHARACTERISTIC c_pvs_av_tol_ssg "C_PVS_AV_TOL_SSG" VALUE 0x707b0 a_85 100 LINEAR______0_000000__0H___119_9 0.0 119.99817 BIT_MASK 0xffffffff FUNCTION_LIST Z1S1 /end CHARACTERISTIC
/begin CHARACTERISTIC c_pvs_cor_bol_at "C_PVS_COR_BOL_AT" VALUE 0x707b2 a_85 100 LINEAR______0_000000__0H___119_9 0.0 119.99817 BIT_MASK 0xffffffff /end CHARACTERISTIC
/begin CHARACTERISTIC c_pvs_cor_bol_mt "C_PVS_COR_BOL_MT" VALUE 0x707b4 a_85 100 LINEAR______0_000000__0H___119_9 0.0 119.99817 BIT_MASK 0xffffffff /end CHARACTERISTIC
/begin CHARACTERISTIC c_pvs_cor_bol_ssg "C_PVS_COR_BOL_SSG" VALUE 0x707b6 a_85 100 LINEAR______0_000000__0H___119_9 0.0 119.99817 BIT_MASK 0xffffffff FUNCTION_LIST Z1S1 /end CHARACTERISTIC
/begin CHARACTERISTIC c_pvs_cor_max_rpl "C_PVS_COR_MAX_RPL" VALUE 0x707b8 a_85 100 LINEAR______0_000000__0H___119_9 0.0 119.99817 BIT_MASK 0xffffffff /end CHARACTERISTIC
/begin CHARACTERISTIC c_pvs_fl_accin "C_PVS_FL_ACCIN" VALUE 0x70bd5 a_86 100 LINEAR______0_000000__0H___119_5 0.0 119.53125 BIT_MASK 0xffffffff /end CHARACTERISTIC
/begin CHARACTERISTIC c_pvs_grd_bol_rpl "C_PVS_GRD_BOL_RPL" VALUE 0x70bd6 a_86 10 LINEAR______0_000000__0H___2988_ 0.0 2988.0 BIT_MASK 0xffffffff /end CHARACTERISTIC
/begin CHARACTERISTIC c_pvs_grd_dec "C_PVS_GRD_DEC" VALUE 0x70bd7 a_86 100 LINEAR______0_000000__0H___29136 0.0 2988.0 BIT_MASK 0xffffffff /end CHARACTERISTIC
/begin CHARACTERISTIC c_pvs_grd_dec_dly "C_PVS_GRD_DEC_DLY" VALUE 0x70bd8 a_86 100 LINEAR______0_000000__0H___29136 0.0 2988.0 BIT_MASK 0xffffffff /end CHARACTERISTIC
/begin CHARACTERISTIC c_pvs_grd_dec_dly_sum "C_PVS_GRD_DEC_DLY_SUM" VALUE 0x70bd9 a_86 100 LINEAR______0_000000__0H___25_50 0.0 25.5 BIT_MASK 0xffffffff /end CHARACTERISTIC
/begin CHARACTERISTIC c_pvs_grd_dec_sum "C_PVS_GRD_DEC_SUM" VALUE 0x70bda a_86 100 LINEAR______0_000000__0H___5_137 0.0 5.0999999 BIT_MASK 0xffffffff /end CHARACTERISTIC
/begin CHARACTERISTIC c_pvs_grd_dly_er "C_PVS_GRD_DLY_ER" VALUE 0x707ba a_85 5 LINEAR______0_010000__1H___655_3 0.01 655.34998 BIT_MASK 0xffffffff /end CHARACTERISTIC
/begin CHARACTERISTIC c_pvs_grd_gen "C_PVS_GRD_GEN" VALUE 0x707bc a_85 10 LINEAR______0_000000__0H___29138 0.0 2988.0 BIT_MASK 0xffffffff /end CHARACTERISTIC
/begin CHARACTERISTIC c_pvs_grd_gen_ssg "C_PVS_GRD_GEN_SSG" VALUE 0x707be a_85 10 LINEAR______0_000000__0H___29138 0.0 2988.0 BIT_MASK 0xffffffff FUNCTION_LIST Z1S1 /end CHARACTERISTIC
/begin CHARACTERISTIC c_pvs_grd_lam_pu "C_PVS_GRD_LAM_PU" VALUE 0x70bdb a_86 100 LINEAR______0_000000__0H___29136 0.0 2988.0 BIT_MASK 0xffffffff /end CHARACTERISTIC
/begin CHARACTERISTIC c_pvs_grd_lih_max "C_PVS_GRD_LIH_MAX" VALUE 0x707c0 a_85 100 LINEAR______0_000000__0H___119_9 0.0 119.99817 BIT_MASK 0xffffffff /end CHARACTERISTIC
/begin CHARACTERISTIC c_pvs_grd_min_aj "C_PVS_GRD_MIN_AJ" VALUE 0x70bdc a_86 100 LINEAR______0_000000__0H___2988_ 0.0 2988.0 BIT_MASK 0xffffffff /end CHARACTERISTIC
/begin CHARACTERISTIC c_pvs_grd_min_aj_amt "C_PVS_GRD_MIN_AJ_AMT" VALUE 0x70bdd a_86 100 LINEAR______0_000000__0H___2988_ 0.0 2988.0 BIT_MASK 0xffffffff FUNCTION_LIST Z1S1 /end CHARACTERISTIC
/begin CHARACTERISTIC c_pvs_grd_min_dri_aj "C_PVS_GRD_MIN_DRI_AJ" VALUE 0x70bde a_86 100 LINEAR______0_000000__0H___2988_ 0.0 2988.0 BIT_MASK 0xffffffff /end CHARACTERISTIC
/begin CHARACTERISTIC c_pvs_grd_pu "C_PVS_GRD_PU" VALUE 0x70bdf a_86 4 LINEAR______0_000000__0H___29139 0.0 2988.0 BIT_MASK 0xffffffff /end CHARACTERISTIC
/begin CHARACTERISTIC c_pvs_grd_sum_dly_max "C_PVS_GRD_SUM_DLY_MAX" VALUE 0x707c2 a_85 100 LINEAR______0_000000__0H___76791 0.0 767916.0 BIT_MASK 0xffffffff /end CHARACTERISTIC
/begin CHARACTERISTIC c_pvs_grd_sum_dly_min "C_PVS_GRD_SUM_DLY_MIN" VALUE 0x707c4 a_85 100 LINEAR______0_000000__0H___76791 0.0 767916.0 BIT_MASK 0xffffffff /end CHARACTERISTIC
/begin CHARACTERISTIC c_pvs_grd_sum_max "C_PVS_GRD_SUM_MAX" VALUE 0x707c6 a_85 100 LINEAR______0_000000__0H___76791 0.0 767916.0 BIT_MASK 0xffffffff /end CHARACTERISTIC
/begin CHARACTERISTIC c_pvs_grd_sum_min "C_PVS_GRD_SUM_MIN" VALUE 0x707c8 a_85 100 LINEAR______0_000000__0H___76791 0.0 767916.0 BIT_MASK 0xffffffff /end CHARACTERISTIC
/begin CHARACTERISTIC c_pvs_hys_cru "C_PVS_HYS_CRU" VALUE 0x707ca a_85 100 LINEAR______0_000000__0H___119_9 0.0 119.99817 BIT_MASK 0xffffffff /end CHARACTERISTIC
/begin CHARACTERISTIC c_pvs_hys_ef "C_PVS_HYS_EF" VALUE 0x70be0 a_86 100 LINEAR______0_000000__0H___11913 0.0 119.5 BIT_MASK 0xffffffff /end CHARACTERISTIC
/begin CHARACTERISTIC c_pvs_hys_wf "C_PVS_HYS_WF" VALUE 0x707cc a_85 10 LINEAR______0_000000__0H___11140 0.0 119.9982 BIT_MASK 0xffffffff /end CHARACTERISTIC
/begin CHARACTERISTIC c_pvs_lgrd_cru "C_PVS_LGRD_CRU" VALUE 0x707ce a_85 100 LINEAR______0_000000__0H___11141 0.0 119.8828 BIT_MASK 0xffffffff /end CHARACTERISTIC
/begin CHARACTERISTIC c_pvs_lih_max_mon "C_PVS_LIH_MAX_MON" VALUE 0x7126c a_86 100 LINEAR______0_000000__0H___99_60 0.0 99.609375 BIT_MASK 0xffffffff /end CHARACTERISTIC
/begin CHARACTERISTIC c_pvs_slop_1 "C_PVS_SLOP_1" VALUE 0x707d0 a_85 10 LINEAR______0_000000__0H___96_00 0.0 96.0 BIT_MASK 0xffffffff /end CHARACTERISTIC
/begin CHARACTERISTIC c_pvs_slop_2 "C_PVS_SLOP_2" VALUE 0x707d2 a_85 10 LINEAR______0_000000__0H___96_00 0.0 96.0 BIT_MASK 0xffffffff /end CHARACTERISTIC
/begin CHARACTERISTIC c_r_dmtl "C_R_DMTL" VALUE 0x70be1 a_86 100 LINEAR______0_000000__0H___50_00 0.0 50.0 BIT_MASK 0xffffffff FUNCTION_LIST DMTL /end CHARACTERISTIC
/begin CHARACTERISTIC c_r_ls_cur_tco_min "C_R_LS_CUR_TCO_MIN" VALUE 0x70be2 a_86 100 LINEAR_______48_000000__0H___142 -48.0 142.5 BIT_MASK 0xffffffff /end CHARACTERISTIC
/begin CHARACTERISTIC c_r_ls_down_dly_max "C_R_LS_DOWN_DLY_MAX" VALUE 0x707d4 a_85 100 LINEAR______0_000000__0H___65142 0.0 65535.0 BIT_MASK 0xffffffff /end CHARACTERISTIC
/begin CHARACTERISTIC c_r_ls_gnd_down_max_diag "C_R_LS_GND_DOWN_MAX_DIAG" VALUE 0x707d6 a_85 100 LINEAR______0_000000__0H___65142 0.0 65535.0 BIT_MASK 0xffffffff /end CHARACTERISTIC
/begin CHARACTERISTIC c_r_ls_gnd_up_max_diag "C_R_LS_GND_UP_MAX_DIAG" VALUE 0x707d8 a_85 100 LINEAR______0_000000__0H___65142 0.0 65535.0 BIT_MASK 0xffffffff /end CHARACTERISTIC
/begin CHARACTERISTIC c_r_ls_max_diag "C_R_LS_MAX_DIAG" VALUE 0x707da a_85 100 LINEAR______1_000000__1H___65534 1.0 65534.0 BIT_MASK 0xffffffff /end CHARACTERISTIC
/begin CHARACTERISTIC c_r_ls_min_diag "C_R_LS_MIN_DIAG" VALUE 0x707dc a_85 100 LINEAR______1_000000__1H___65534 1.0 65534.0 BIT_MASK 0xffffffff /end CHARACTERISTIC
/begin CHARACTERISTIC c_r_ls_open_down_min_diag "C_R_LS_OPEN_DOWN_MIN_DIAG" VALUE 0x707de a_85 100 LINEAR______0_000000__0H___65142 0.0 65535.0 BIT_MASK 0xffffffff /end CHARACTERISTIC
/begin CHARACTERISTIC c_r_ls_open_up_min_diag "C_R_LS_OPEN_UP_MIN_DIAG" VALUE 0x707e0 a_85 100 LINEAR______0_000000__0H___65142 0.0 65535.0 BIT_MASK 0xffffffff /end CHARACTERISTIC
/begin CHARACTERISTIC c_ref_tam "C_REF_TAM" VALUE 0x70dad a_87 100 LINEAR_______128_000000__FFFF143 -128.0 127.0 BIT_MASK 0xffffffff FUNCTION_LIST ETM /end CHARACTERISTIC
/begin CHARACTERISTIC c_saf_diag_max "C_SAF_DIAG_MAX" VALUE 0x707e2 a_85 100 LINEAR______0_000000__0H___25144 0.0 255.0 BIT_MASK 0xffffffff /end CHARACTERISTIC
/begin CHARACTERISTIC c_saf_diag_min "C_SAF_DIAG_MIN" VALUE 0x707e4 a_85 100 LINEAR______0_000000__0H___25144 0.0 255.0 BIT_MASK 0xffffffff /end CHARACTERISTIC
/begin CHARACTERISTIC c_saf_kgh_cat_diag_max "C_SAF_KGH_CAT_DIAG_MAX" VALUE 0x707e6 a_85 100 LINEAR______0_000000__0H___16383 0.0 16383.75 BIT_MASK 0xffffffff /end CHARACTERISTIC
/begin CHARACTERISTIC c_saf_kgh_cat_diag_min "C_SAF_KGH_CAT_DIAG_MIN" VALUE 0x707e8 a_85 100 LINEAR______0_000000__0H___16383 0.0 16383.75 BIT_MASK 0xffffffff /end CHARACTERISTIC
/begin CHARACTERISTIC c_saf_kgh_dif "C_SAF_KGH_DIF" VALUE 0x707ea a_85 100 LINEAR______0_000000__0H___10269 0.0 1023.9844 BIT_MASK 0xffffffff /end CHARACTERISTIC
/begin CHARACTERISTIC c_saf_kgh_dif_sav_diag "C_SAF_KGH_DIF_SAV_DIAG" VALUE 0x707ec a_85 100 LINEAR______0_000000__0H___10269 0.0 1023.9844 BIT_MASK 0xffffffff /end CHARACTERISTIC
/begin CHARACTERISTIC c_saf_mdl_add_eol "C_SAF_MDL_ADD_EOL" VALUE 0x70dee a_95 100 LINEAR_______512_000000__FFFF800 -512.0 511.98438 BIT_MASK 0xffffffff /end CHARACTERISTIC
/begin CHARACTERISTIC c_saf_mes_thd "C_SAF_MES_THD" VALUE 0x707ee a_85 100 LINEAR______0_000000__0H___10269 0.0 1023.9844 BIT_MASK 0xffffffff /end CHARACTERISTIC
/begin CHARACTERISTIC c_soi_cam_diag "C_SOI_CAM_DIAG" VALUE 0x70be3 a_86 15 LINEAR_______180_000000__0H___50 -180.0 504.0 BIT_MASK 0xffffffff /end CHARACTERISTIC
/begin CHARACTERISTIC c_sp_cal_mon_cks "C_SP_CAL_MON_CKS" VALUE 0x72ffc a_145 100 LINEAR______0_000000__0H___42146 0.0 4.2949673e+009 BIT_MASK 0xffffffff /end CHARACTERISTIC
/begin CHARACTERISTIC c_state_ch_2_ef "C_STATE_CH_2_EF" VALUE 0x70be4 a_86 100 LINEAR______0_000000__0H___1_000 0.0 1.0 BIT_MASK 0xffffffff /end CHARACTERISTIC
/begin CHARACTERISTIC c_state_clu_amt_close "C_STATE_CLU_AMT_CLOSE" VALUE 0x70be5 a_86 100 LINEAR______0_000000__0H___1_000 0.0 1.0 BIT_MASK 0xffffffff FUNCTION_LIST Z1S1 /end CHARACTERISTIC
/begin CHARACTERISTIC c_state_clu_amt_crp "C_STATE_CLU_AMT_CRP" VALUE 0x70be6 a_86 100 LINEAR______0_000000__0H___1_000 0.0 1.0 BIT_MASK 0xffffffff FUNCTION_LIST Z1S1 /end CHARACTERISTIC
/begin CHARACTERISTIC c_state_clu_amt_dft "C_STATE_CLU_AMT_DFT" VALUE 0x70be7 a_86 100 LINEAR______0_000000__0H___1_000 0.0 1.0 BIT_MASK 0xffffffff FUNCTION_LIST Z1S1 /end CHARACTERISTIC
/begin CHARACTERISTIC c_state_clu_amt_open "C_STATE_CLU_AMT_OPEN" VALUE 0x70be8 a_86 100 LINEAR______0_000000__0H___1_000 0.0 1.0 BIT_MASK 0xffffffff FUNCTION_LIST Z1S1 /end CHARACTERISTIC
/begin CHARACTERISTIC c_state_clu_amt_st "C_STATE_CLU_AMT_ST" VALUE 0x70be9 a_86 100 LINEAR______0_000000__0H___1_000 0.0 1.0 BIT_MASK 0xffffffff /end CHARACTERISTIC
/begin CHARACTERISTIC c_state_vs_min_ef_at "C_STATE_VS_MIN_EF_AT" VALUE 0x70bea a_86 100 LINEAR______0_000000__0H___1_000 0.0 1.0 BIT_MASK 0xffffffff /end CHARACTERISTIC
/begin CHARACTERISTIC c_state_vs_min_ef_mt "C_STATE_VS_MIN_EF_MT" VALUE 0x70beb a_86 100 LINEAR______0_000000__0H___1_000 0.0 1.0 BIT_MASK 0xffffffff /end CHARACTERISTIC
/begin CHARACTERISTIC c_stop_max_fsd "C_STOP_MAX_FSD" VALUE 0x70bec a_86 100 LINEAR______0_000000__0H___255_0 0.0 255.0 BIT_MASK 0xffffffff /end CHARACTERISTIC
/begin CHARACTERISTIC c_sum_afl_vls_min "C_SUM_AFL_VLS_MIN" VALUE 0x707f0 a_85 10 LINEAR______0_000000__0H___32766 0.0 32766.0 BIT_MASK 0xffffffff /end CHARACTERISTIC
/begin CHARACTERISTIC c_sum_cnl_rough_leak_mes_fuc_max "C_SUM_CNL_ROUGH_LEAK_MES_FUC_MAX" VALUE 0x70bed a_86 100 LINEAR______0_000000__0H___255_0 0.0 255.0 BIT_MASK 0xffffffff FUNCTION_LIST DMTL /end CHARACTERISTIC
/begin CHARACTERISTIC c_sum_cnl_small_leak_mes_max "C_SUM_CNL_SMALL_LEAK_MES_MAX" VALUE 0x70bee a_86 100 LINEAR______0_000000__0H___255_0 0.0 255.0 BIT_MASK 0xffffffff /end CHARACTERISTIC
/begin CHARACTERISTIC c_sum_cnl_small_leak_mes_max_h "C_SUM_CNL_SMALL_LEAK_MES_MAX_H" VALUE 0x70bef a_86 100 LINEAR______0_000000__0H___255_0 0.0 255.0 BIT_MASK 0xffffffff /end CHARACTERISTIC
/begin CHARACTERISTIC c_sum_cppwm_diagcps_max "C_SUM_CPPWM_DIAGCPS_MAX" VALUE 0x70bf0 a_86 100 LINEAR______0_000000__0H___25147 0.0 255.0 BIT_MASK 0xffffffff /end CHARACTERISTIC
/begin CHARACTERISTIC c_sum_cyc_cam_ex_diag "C_SUM_CYC_CAM_EX_DIAG" VALUE 0x70bf1 a_86 100 LINEAR______0_000000__0H___255_0 0.0 255.0 BIT_MASK 0xffffffff /end CHARACTERISTIC
/begin CHARACTERISTIC c_sum_cyc_min_diag "C_SUM_CYC_MIN_DIAG" VALUE 0x707f2 a_85 100 LINEAR______0_000000__0H___65593 0.0 65534.0 BIT_MASK 0xffffffff /end CHARACTERISTIC
/begin CHARACTERISTIC c_sum_cycnr_min_diag "C_SUM_CYCNR_MIN_DIAG" VALUE 0x707f4 a_85 100 LINEAR______0_000000__0H___65593 0.0 65534.0 BIT_MASK 0xffffffff /end CHARACTERISTIC
/begin CHARACTERISTIC c_sum_dc_ready "C_SUM_DC_READY" VALUE 0x70bf2 a_86 100 LINEAR______0_000000__0H___255_0 0.0 255.0 BIT_MASK 0xffffffff /end CHARACTERISTIC
/begin CHARACTERISTIC c_sum_diagcps_max "C_SUM_DIAGCPS_MAX" VALUE 0x70bf3 a_86 5 LINEAR______0_000000__0H___25147 0.0 255.0 BIT_MASK 0xffffffff /end CHARACTERISTIC
/begin CHARACTERISTIC c_sum_ena_rough_leak_max "C_SUM_ENA_ROUGH_LEAK_MAX" VALUE 0x70bf4 a_86 100 LINEAR______0_000000__0H___255_0 0.0 255.0 BIT_MASK 0xffffffff FUNCTION_LIST DMTL /end CHARACTERISTIC
/begin CHARACTERISTIC c_sum_ena_rough_leak_test_max "C_SUM_ENA_ROUGH_LEAK_TEST_MAX" VALUE 0x70bf5 a_86 100 LINEAR______0_000000__0H___255_0 0.0 255.0 BIT_MASK 0xffffffff FUNCTION_LIST DMTL /end CHARACTERISTIC
/begin CHARACTERISTIC c_sum_ena_small_leak_test_max "C_SUM_ENA_SMALL_LEAK_TEST_MAX" VALUE 0x70bf6 a_86 100 LINEAR______0_000000__0H___255_0 0.0 255.0 BIT_MASK 0xffffffff FUNCTION_LIST DMTL /end CHARACTERISTIC
/begin CHARACTERISTIC c_sum_end_p_ramp "C_SUM_END_P_RAMP" VALUE 0x70bf7 a_86 100 LINEAR______0_000000__0H___255_0 0.0 255.0 BIT_MASK 0xffffffff /end CHARACTERISTIC
/begin CHARACTERISTIC c_sum_hfm_diag_max "C_SUM_HFM_DIAG_MAX" VALUE 0x70bf8 a_86 100 LINEAR______1_000000__1H___25148 1.0 255.0 BIT_MASK 0xffffffff /end CHARACTERISTIC
/begin CHARACTERISTIC c_sum_hfm_max "C_SUM_HFM_MAX" VALUE 0x70bf9 a_86 100 LINEAR______1_000000__1H___25148 1.0 255.0 BIT_MASK 0xffffffff /end CHARACTERISTIC
/begin CHARACTERISTIC c_sum_max_ld "C_SUM_MAX_LD" VALUE 0x70bfa a_86 10 LINEAR______0_000000__0H___255_0 0.0 255.0 BIT_MASK 0xffffffff /end CHARACTERISTIC
/begin CHARACTERISTIC c_sum_min_cat_diag "C_SUM_MIN_CAT_DIAG" VALUE 0x707f6 a_85 100 LINEAR______0_000000__0H___65535 0.0 65535.0 BIT_MASK 0xffffffff /end CHARACTERISTIC
/begin CHARACTERISTIC c_sum_n_dif_max "C_SUM_N_DIF_MAX" VALUE 0x70bfb a_86 100 LINEAR______0_000000__0H___255_0 0.0 255.0 BIT_MASK 0xffffffff /end CHARACTERISTIC
/begin CHARACTERISTIC c_sum_n_dif_max_diag "C_SUM_N_DIF_MAX_DIAG" VALUE 0x70bfc a_86 100 LINEAR______0_000000__0H___255_0 0.0 255.0 BIT_MASK 0xffffffff /end CHARACTERISTIC
/begin CHARACTERISTIC c_sum_p_sa_diag "C_SUM_P_SA_DIAG" VALUE 0x70bfd a_86 10 LINEAR______2_000000__2H___255_0 2.0 255.0 BIT_MASK 0xffffffff /end CHARACTERISTIC
/begin CHARACTERISTIC c_sum_p_sa_diag_1 "C_SUM_P_SA_DIAG_1" VALUE 0x70bfe a_86 100 LINEAR______2_000000__2H___255_0 2.0 255.0 BIT_MASK 0xffffffff /end CHARACTERISTIC
/begin CHARACTERISTIC c_sum_r_ls_mes_diag "C_SUM_R_LS_MES_DIAG" VALUE 0x70bff a_86 100 LINEAR______0_000000__0H___254_0 0.0 254.0 BIT_MASK 0xffffffff /end CHARACTERISTIC
/begin CHARACTERISTIC c_sum_rep_rough_leak_mes_fuc_max "C_SUM_REP_ROUGH_LEAK_MES_FUC_MAX" VALUE 0x70c00 a_86 100 LINEAR______0_000000__0H___255_0 0.0 255.0 BIT_MASK 0xffffffff FUNCTION_LIST DMTL /end CHARACTERISTIC
/begin CHARACTERISTIC c_sum_rest_max_sa "C_SUM_REST_MAX_SA" VALUE 0x70c01 a_86 10 LINEAR______0_000000__0H___255_0 0.0 255.0 BIT_MASK 0xffffffff /end CHARACTERISTIC
/begin CHARACTERISTIC c_sum_saf_diag_max "C_SUM_SAF_DIAG_MAX" VALUE 0x707f8 a_85 100 LINEAR______0_000000__0H___65593 0.0 65534.0 BIT_MASK 0xffffffff /end CHARACTERISTIC
/begin CHARACTERISTIC c_sum_saf_diag_max_eol "C_SUM_SAF_DIAG_MAX_EOL" VALUE 0x707fa a_85 100 LINEAR______0_000000__0H___65593 0.0 65534.0 BIT_MASK 0xffffffff /end CHARACTERISTIC
/begin CHARACTERISTIC c_sum_saf_diag_min "C_SUM_SAF_DIAG_MIN" VALUE 0x707fc a_85 100 LINEAR______0_000000__0H___65593 0.0 65534.0 BIT_MASK 0xffffffff /end CHARACTERISTIC
/begin CHARACTERISTIC c_sum_saf_diag_min_eol "C_SUM_SAF_DIAG_MIN_EOL" VALUE 0x707fe a_85 100 LINEAR______0_000000__0H___65593 0.0 65534.0 BIT_MASK 0xffffffff /end CHARACTERISTIC
/begin CHARACTERISTIC c_sum_safm_diag "C_SUM_SAFM_DIAG" VALUE 0x70800 a_85 100 LINEAR______0_000000__0H___65593 0.0 65534.0 BIT_MASK 0xffffffff /end CHARACTERISTIC
/begin CHARACTERISTIC c_sum_safm_diag_eol "C_SUM_SAFM_DIAG_EOL" VALUE 0x70802 a_85 100 LINEAR______0_000000__0H___65593 0.0 65534.0 BIT_MASK 0xffffffff /end CHARACTERISTIC
/begin CHARACTERISTIC c_sum_sav_thd "C_SUM_SAV_THD" VALUE 0x70c02 a_86 100 LINEAR______0_000000__0H___255_0 0.0 255.0 BIT_MASK 0xffffffff /end CHARACTERISTIC
/begin CHARACTERISTIC c_sum_sav_thd_eol "C_SUM_SAV_THD_EOL" VALUE 0x70c03 a_86 100 LINEAR______0_000000__0H___255_0 0.0 255.0 BIT_MASK 0xffffffff /end CHARACTERISTIC
/begin CHARACTERISTIC c_sum_seg_dly_ivvthpwm "C_SUM_SEG_DLY_IVVTHPWM" VALUE 0x70c04 a_86 100 LINEAR______1_000000__1H___255_0 1.0 255.0 BIT_MASK 0xffffffff /end CHARACTERISTIC
/begin CHARACTERISTIC c_sum_t_cp_2 "C_SUM_T_CP_2" VALUE 0x70c05 a_86 100 LINEAR______0_000000__0H___255_0 0.0 255.0 BIT_MASK 0xffffffff /end CHARACTERISTIC
/begin CHARACTERISTIC c_sum_trig_aj "C_SUM_TRIG_AJ" VALUE 0x70c06 a_86 100 LINEAR______1_000000__1H___10_00 1.0 10.0 BIT_MASK 0xffffffff /end CHARACTERISTIC
/begin CHARACTERISTIC c_sum_vls_cat_diag_min "C_SUM_VLS_CAT_DIAG_MIN" VALUE 0x70c07 a_86 10 LINEAR______1_000000__1H___255_0 1.0 255.0 BIT_MASK 0xffffffff /end CHARACTERISTIC
/begin CHARACTERISTIC c_t_add_min_ivvt_adh_ex_inc "C_T_ADD_MIN_IVVT_ADH_EX_INC" VALUE 0x70c08 a_86 100 LINEAR______0_000000__0H___159_3 0.0 159.375 BIT_MASK 0xffffffff /end CHARACTERISTIC
/begin CHARACTERISTIC c_t_add_min_ivvt_adh_in_inc "C_T_ADD_MIN_IVVT_ADH_IN_INC" VALUE 0x70c09 a_86 100 LINEAR______0_000000__0H___159_3 0.0 159.375 BIT_MASK 0xffffffff /end CHARACTERISTIC
/begin CHARACTERISTIC c_t_amt_inh_mon "C_T_AMT_INH_MON" VALUE 0x7126d a_86 100 LINEAR______0_000000__0H___10_20 0.0 10.2 BIT_MASK 0xffffffff FUNCTION_LIST Z1S1 /end CHARACTERISTIC
/begin CHARACTERISTIC c_t_ast_dmtl_max "C_T_AST_DMTL_MAX" VALUE 0x70804 a_85 100 LINEAR______0_300000__3H___6553_ 0.3 6553.5 BIT_MASK 0xffffffff FUNCTION_LIST DMTL /end CHARACTERISTIC
/begin CHARACTERISTIC c_t_ast_ivvt "C_T_AST_IVVT" VALUE 0x70806 a_85 100 LINEAR______0_100000__1H___65149 0.1 6553.5 BIT_MASK 0xffffffff /end CHARACTERISTIC
/begin CHARACTERISTIC c_t_ast_tam_diag_sa "C_T_AST_TAM_DIAG_SA" VALUE 0x70808 a_85 100 LINEAR______0_300000__3H___6553_ 0.3 6553.5 BIT_MASK 0xffffffff /end CHARACTERISTIC
/begin CHARACTERISTIC c_t_ast_vls_down_diag "C_T_AST_VLS_DOWN_DIAG" VALUE 0x7080a a_85 100 LINEAR______0_000000__0H___6553_ 0.0 6553.5 BIT_MASK 0xffffffff /end CHARACTERISTIC
/begin CHARACTERISTIC c_t_bts_plaus_max "C_T_BTS_PLAUS_MAX" VALUE 0x70c0a a_86 100 LINEAR______0_000000__0H___25_50 0.0 25.5 BIT_MASK 0xffffffff /end CHARACTERISTIC
/begin CHARACTERISTIC c_t_cam_sp_lgrd "C_T_CAM_SP_LGRD" VALUE 0x70c0b a_86 100 LINEAR______10_000000__1H___2550 10.0 2550.0 BIT_MASK 0xffffffff /end CHARACTERISTIC
/begin CHARACTERISTIC c_t_cam_sp_lgrd_cat "C_T_CAM_SP_LGRD_CAT" VALUE 0x70c0c a_86 100 LINEAR______10_000000__1H___2550 10.0 2550.0 BIT_MASK 0xffffffff /end CHARACTERISTIC
/begin CHARACTERISTIC c_t_cam_sp_lgrd_ch_2 "C_T_CAM_SP_LGRD_CH_2" VALUE 0x70c0d a_86 100 LINEAR______10_000000__1H___2550 10.0 2550.0 BIT_MASK 0xffffffff /end CHARACTERISTIC
/begin CHARACTERISTIC c_t_cat_diag_max "C_T_CAT_DIAG_MAX" VALUE 0x70c0e a_86 100 LINEAR______0_000000__0H___25_50 0.0 25.5 BIT_MASK 0xffffffff /end CHARACTERISTIC
/begin CHARACTERISTIC c_t_cop_step_2 "C_T_COP_STEP_2" VALUE 0x70c0f a_86 100 LINEAR______1_000000__1H___25148 1.0 255.0 BIT_MASK 0xffffffff /end CHARACTERISTIC
/begin CHARACTERISTIC c_t_cp_1 "C_T_CP_1" VALUE 0x7080c a_85 1 LINEAR______0_100000__1H___65149 0.1 6553.5 BIT_MASK 0xffffffff /end CHARACTERISTIC
/begin CHARACTERISTIC c_t_cp_2 "C_T_CP_2" VALUE 0x7080e a_85 1 LINEAR______0_100000__1H___65149 0.1 6553.5 BIT_MASK 0xffffffff /end CHARACTERISTIC
/begin CHARACTERISTIC c_t_cp_3 "C_T_CP_3" VALUE 0x70810 a_85 1 LINEAR______0_100000__1H___65149 0.1 6553.5 BIT_MASK 0xffffffff /end CHARACTERISTIC
/begin CHARACTERISTIC c_t_cp_3_cat_var "C_T_CP_3_CAT_VAR" VALUE 0x70812 a_85 1 LINEAR______0_100000__1H___65149 0.1 6553.5 BIT_MASK 0xffffffff /end CHARACTERISTIC
/begin CHARACTERISTIC c_t_cru_asr_off "C_T_CRU_ASR_OFF" VALUE 0x70c10 a_86 100 LINEAR______0_000000__0H___25_50 0.0 25.5 BIT_MASK 0xffffffff /end CHARACTERISTIC
/begin CHARACTERISTIC c_t_cru_esp_brake_off "C_T_CRU_ESP_BRAKE_OFF" VALUE 0x70c11 a_86 100 LINEAR______0_000000__0H___25_50 0.0 25.5 BIT_MASK 0xffffffff /end CHARACTERISTIC
/begin CHARACTERISTIC c_t_cru_esp_off "C_T_CRU_ESP_OFF" VALUE 0x70c12 a_86 100 LINEAR______0_000000__0H___25_50 0.0 25.5 BIT_MASK 0xffffffff /end CHARACTERISTIC
/begin CHARACTERISTIC c_t_cru_inh_mon "C_T_CRU_INH_MON" VALUE 0x7126e a_86 100 LINEAR______0_000000__0H___10_20 0.0 10.2 BIT_MASK 0xffffffff /end CHARACTERISTIC
/begin CHARACTERISTIC c_t_crus "C_T_CRUS" VALUE 0x70c13 a_86 10 LINEAR______0_000000__0H___2550_ 0.0 2550.0 BIT_MASK 0xffffffff /end CHARACTERISTIC
/begin CHARACTERISTIC c_t_crus_on "C_T_CRUS_ON" VALUE 0x70c14 a_86 10 LINEAR______0_000000__0H___2550_ 0.0 2550.0 BIT_MASK 0xffffffff /end CHARACTERISTIC
/begin CHARACTERISTIC c_t_cur_dly_ls_down "C_T_CUR_DLY_LS_DOWN" VALUE 0x70c15 a_86 100 LINEAR______0_001000__1H___0_256 0.001 0.256 BIT_MASK 0xffffffff FUNCTION_LIST R_LS_CALC /end CHARACTERISTIC
/begin CHARACTERISTIC c_t_cur_dly_ls_up "C_T_CUR_DLY_LS_UP" VALUE 0x70c16 a_86 100 LINEAR______0_001000__1H___0_256 0.001 0.256 BIT_MASK 0xffffffff FUNCTION_LIST R_LS_CALC /end CHARACTERISTIC
/begin CHARACTERISTIC c_t_cur_dly_r_down_ls_mes_max "C_T_CUR_DLY_R_DOWN_LS_MES_MAX" VALUE 0x70814 a_85 100 LINEAR______0_010000__1H___655_3 0.01 655.34998 BIT_MASK 0xffffffff FUNCTION_LIST R_LS_CALC /end CHARACTERISTIC
/begin CHARACTERISTIC c_t_cur_dly_r_up_ls_mes_max "C_T_CUR_DLY_R_UP_LS_MES_MAX" VALUE 0x70818 a_85 100 LINEAR______0_010000__1H___655_3 0.01 655.34998 BIT_MASK 0xffffffff FUNCTION_LIST R_LS_CALC /end CHARACTERISTIC
/begin CHARACTERISTIC c_t_cur_dly_r_up_ls_mes_max_max "C_T_CUR_DLY_R_UP_LS_MES_MAX_MAX" VALUE 0x7081a a_85 100 LINEAR______0_010000__1H___655_3 0.01 655.34998 BIT_MASK 0xffffffff FUNCTION_LIST R_LS_CALC /end CHARACTERISTIC
/begin CHARACTERISTIC c_t_cur_dmtl_rough_leak_max "C_T_CUR_DMTL_ROUGH_LEAK_MAX" VALUE 0x7081c a_85 100 LINEAR______0_000000__0H___6553_ 0.0 6553.5 BIT_MASK 0xffffffff FUNCTION_LIST DMTL /end CHARACTERISTIC
/begin CHARACTERISTIC c_t_cur_dmtl_rough_leak_min "C_T_CUR_DMTL_ROUGH_LEAK_MIN" VALUE 0x7081e a_85 100 LINEAR______0_000000__0H___6553_ 0.0 6553.5 BIT_MASK 0xffffffff FUNCTION_LIST DMTL /end CHARACTERISTIC
/begin CHARACTERISTIC c_t_cur_dmtl_stat "C_T_CUR_DMTL_STAT" VALUE 0x70820 a_85 100 LINEAR______0_000000__0H___6553_ 0.0 6553.5 BIT_MASK 0xffffffff FUNCTION_LIST DMTL /end CHARACTERISTIC
/begin CHARACTERISTIC c_t_cur_off_down_ls "C_T_CUR_OFF_DOWN_LS" VALUE 0x70822 a_85 100 LINEAR______0_010000__1H___655_3 0.01 655.34998 BIT_MASK 0xffffffff FUNCTION_LIST R_LS_CALC /end CHARACTERISTIC
/begin CHARACTERISTIC c_t_cur_off_up_ls "C_T_CUR_OFF_UP_LS" VALUE 0x70824 a_85 100 LINEAR______0_010000__1H___655_3 0.01 655.34998 BIT_MASK 0xffffffff /end CHARACTERISTIC
/begin CHARACTERISTIC c_t_cur_on_down_ls "C_T_CUR_ON_DOWN_LS" VALUE 0x70c17 a_86 100 LINEAR______0_001000__1H___0_008 0.001 0.008 BIT_MASK 0xffffffff FUNCTION_LIST R_LS_CALC /end CHARACTERISTIC
/begin CHARACTERISTIC c_t_cur_on_up_ls "C_T_CUR_ON_UP_LS" VALUE 0x70c18 a_86 100 LINEAR______0_001000__1H___0_008 0.001 0.008 BIT_MASK 0xffffffff /end CHARACTERISTIC
/begin CHARACTERISTIC c_t_cycnr_is "C_T_CYCNR_IS" VALUE 0x70c19 a_86 100 LINEAR______0_100000__1H___25_50 0.1 25.5 BIT_MASK 0xffffffff /end CHARACTERISTIC
/begin CHARACTERISTIC c_t_dec_low_n "C_T_DEC_LOW_N" VALUE 0x70826 a_85 100 LINEAR______0_010000__1H___655_3 0.01 655.34998 BIT_MASK 0xffffffff FUNCTION_LIST Z10I /end CHARACTERISTIC
/begin CHARACTERISTIC c_t_diag_sa "C_T_DIAG_SA" VALUE 0x70828 a_85 100 LINEAR______0_020000__1H___1310_ 0.02 1310.0 BIT_MASK 0xffffffff /end CHARACTERISTIC
/begin CHARACTERISTIC c_t_diag_sav "C_T_DIAG_SAV" VALUE 0x7082a a_85 10 LINEAR______0_100000__1H___65149 0.1 6553.5 BIT_MASK 0xffffffff /end CHARACTERISTIC
/begin CHARACTERISTIC c_t_diagcps_maf "C_T_DIAGCPS_MAF" VALUE 0x70c1a a_86 10 LINEAR______0_100000__1H___25_50 0.1 25.5 BIT_MASK 0xffffffff /end CHARACTERISTIC
/begin CHARACTERISTIC c_t_diagcps_n_1 "C_T_DIAGCPS_N_1" VALUE 0x7082c a_85 10 LINEAR______0_020000__1H___25_50 0.02 25.5 BIT_MASK 0xffffffff /end CHARACTERISTIC
/begin CHARACTERISTIC c_t_diagcps_n_2 "C_T_DIAGCPS_N_2" VALUE 0x70c1b a_86 10 LINEAR______0_100000__1H___25_50 0.1 25.5 BIT_MASK 0xffffffff /end CHARACTERISTIC
/begin CHARACTERISTIC c_t_diagcps_n_3 "C_T_DIAGCPS_N_3" VALUE 0x70c1c a_86 20 LINEAR______0_020000__1H___5_100 0.02 5.0999999 BIT_MASK 0xffffffff /end CHARACTERISTIC
/begin CHARACTERISTIC c_t_dly_ad_diag_max "C_T_DLY_AD_DIAG_MAX" VALUE 0x70df0 a_95 100 LINEAR_______640_020000__FFFF800 -640.02 639.98 BIT_MASK 0xffffffff /end CHARACTERISTIC
/begin CHARACTERISTIC c_t_dly_ad_diag_min "C_T_DLY_AD_DIAG_MIN" VALUE 0x70df2 a_95 100 LINEAR_______640_020000__FFFF800 -640.02 639.98 BIT_MASK 0xffffffff /end CHARACTERISTIC
/begin CHARACTERISTIC c_t_dly_ad_max "C_T_DLY_AD_MAX" VALUE 0x70df4 a_95 100 LINEAR_______640_020000__FFFF800 -640.02 639.98 BIT_MASK 0xffffffff /end CHARACTERISTIC
/begin CHARACTERISTIC c_t_dly_ad_min "C_T_DLY_AD_MIN" VALUE 0x70df6 a_95 100 LINEAR_______640_020000__FFFF800 -640.02 639.98 BIT_MASK 0xffffffff /end CHARACTERISTIC
/begin CHARACTERISTIC c_t_dly_aj "C_T_DLY_AJ" VALUE 0x70c1d a_86 100 LINEAR______0_000000__0H___2550_ 0.0 2550.0 BIT_MASK 0xffffffff /end CHARACTERISTIC
/begin CHARACTERISTIC c_t_dly_cat_diag "C_T_DLY_CAT_DIAG" VALUE 0x70c1e a_86 100 LINEAR______0_000000__0H___25_50 0.0 25.5 BIT_MASK 0xffffffff /end CHARACTERISTIC
/begin CHARACTERISTIC c_t_dly_cs_diag "C_T_DLY_CS_DIAG" VALUE 0x7082e a_85 100 LINEAR______1_000000__1H___65535 1.0 65535.0 BIT_MASK 0xffffffff /end CHARACTERISTIC
/begin CHARACTERISTIC c_t_dly_cur_dmtl_dif_mes "C_T_DLY_CUR_DMTL_DIF_MES" VALUE 0x70830 a_85 100 LINEAR______0_000000__0H___6553_ 0.0 6553.5 BIT_MASK 0xffffffff FUNCTION_LIST DMTL /end CHARACTERISTIC
/begin CHARACTERISTIC c_t_dly_det_refu "C_T_DLY_DET_REFU" VALUE 0x70832 a_85 100 LINEAR______0_000000__0H___655_3 0.0 655.35 BIT_MASK 0xffffffff FUNCTION_LIST DMTL /end CHARACTERISTIC
/begin CHARACTERISTIC c_t_dly_diag_sa "C_T_DLY_DIAG_SA" VALUE 0x70834 a_85 10 LINEAR______0_020000__1H___10_00 0.02 10.0 BIT_MASK 0xffffffff /end CHARACTERISTIC
/begin CHARACTERISTIC c_t_dly_diag_safm "C_T_DLY_DIAG_SAFM" VALUE 0x70836 a_85 100 LINEAR______0_000000__0H___6553_ 0.0 6553.5 BIT_MASK 0xffffffff /end CHARACTERISTIC
/begin CHARACTERISTIC c_t_dly_diag_safm_intr "C_T_DLY_DIAG_SAFM_INTR" VALUE 0x70838 a_85 100 LINEAR______0_000000__0H___10_00 0.0 10.0 BIT_MASK 0xffffffff /end CHARACTERISTIC
/begin CHARACTERISTIC c_t_dly_diag_sav "C_T_DLY_DIAG_SAV" VALUE 0x7083a a_85 10 LINEAR______0_100000__1H___65149 0.1 6553.5 BIT_MASK 0xffffffff /end CHARACTERISTIC
/begin CHARACTERISTIC c_t_dly_diag_sav_eol "C_T_DLY_DIAG_SAV_EOL" VALUE 0x7083c a_85 10 LINEAR______0_100000__1H___65149 0.1 6553.5 BIT_MASK 0xffffffff /end CHARACTERISTIC
/begin CHARACTERISTIC c_t_dly_diagcps "C_T_DLY_DIAGCPS" VALUE 0x70c1f a_86 10 LINEAR______0_100000__1H___25_50 0.1 25.5 BIT_MASK 0xffffffff /end CHARACTERISTIC
/begin CHARACTERISTIC c_t_dly_dmtls "C_T_DLY_DMTLS" VALUE 0x70c20 a_86 100 LINEAR______0_000000__0H___25_50 0.0 25.5 BIT_MASK 0xffffffff FUNCTION_LIST DMTL /end CHARACTERISTIC
/begin CHARACTERISTIC c_t_dly_es_pwl "C_T_DLY_ES_PWL" VALUE 0x70c21 a_86 100 LINEAR______0_000000__0H___25_50 0.0 25.5 BIT_MASK 0xffffffff FUNCTION_LIST DMTL /end CHARACTERISTIC
/begin CHARACTERISTIC c_t_dly_expv "C_T_DLY_EXPV" VALUE 0x70c22 a_86 100 LINEAR______1_000000__1H___25_50 1.0 25.5 BIT_MASK 0xffffffff FUNCTION_LIST CNG /end CHARACTERISTIC
/begin CHARACTERISTIC c_t_dly_fsd_pu "C_T_DLY_FSD_PU" VALUE 0x7083e a_85 100 LINEAR______0_000000__0H___655_3 0.0 655.35 BIT_MASK 0xffffffff /end CHARACTERISTIC
/begin CHARACTERISTIC c_t_dly_fuc_can_off "C_T_DLY_FUC_CAN_OFF" VALUE 0x70c23 a_86 100 LINEAR______0_000000__0H___25_50 0.0 25.5 BIT_MASK 0xffffffff FUNCTION_LIST DMTL /end CHARACTERISTIC
/begin CHARACTERISTIC c_t_dly_fuc_can_on "C_T_DLY_FUC_CAN_ON" VALUE 0x70c24 a_86 100 LINEAR______0_000000__0H___25_50 0.0 25.5 BIT_MASK 0xffffffff FUNCTION_LIST DMTL /end CHARACTERISTIC
/begin CHARACTERISTIC c_t_dly_i_max "C_T_DLY_I_MAX" VALUE 0x70e1e a_150 100 LINEAR_______640_000000__8000000 -640.0 640.0 BIT_MASK 0xffffffff /end CHARACTERISTIC
/begin CHARACTERISTIC c_t_dly_i_min "C_T_DLY_I_MIN" VALUE 0x70e22 a_150 100 LINEAR_______640_000000__8000000 -640.0 640.0 BIT_MASK 0xffffffff /end CHARACTERISTIC
/begin CHARACTERISTIC c_t_dly_iga_tra "C_T_DLY_IGA_TRA" VALUE 0x70c25 a_86 100 LINEAR______0_000000__0H___2550_ 0.0 2550.0 BIT_MASK 0xffffffff /end CHARACTERISTIC
/begin CHARACTERISTIC c_t_dly_igk_ftl "C_T_DLY_IGK_FTL" VALUE 0x70c26 a_86 4 LINEAR______0_000000__0H___25_50 0.0 25.5 BIT_MASK 0xffffffff FUNCTION_LIST DMTL /end CHARACTERISTIC
/begin CHARACTERISTIC c_t_dly_ls_diag_min "C_T_DLY_LS_DIAG_MIN" VALUE 0x70840 a_85 100 LINEAR______0_000000__0H___6553_ 0.0 6553.5 BIT_MASK 0xffffffff /end CHARACTERISTIC
/begin CHARACTERISTIC c_t_dly_lsh_diag "C_T_DLY_LSH_DIAG" VALUE 0x70842 a_85 100 LINEAR______1_000000__1H___65151 1.0 65534.0 BIT_MASK 0xffffffff /end CHARACTERISTIC
/begin CHARACTERISTIC c_t_dly_lsh_down_diag "C_T_DLY_LSH_DOWN_DIAG" VALUE 0x70844 a_85 100 LINEAR______1_000000__1H___65151 1.0 65534.0 BIT_MASK 0xffffffff /end CHARACTERISTIC
/begin CHARACTERISTIC c_t_dly_max_cru "C_T_DLY_MAX_CRU" VALUE 0x70846 a_85 10 LINEAR______0_000000__0H___655_3 0.0 655.35 BIT_MASK 0xffffffff /end CHARACTERISTIC
/begin CHARACTERISTIC c_t_dly_pvs_cor_rpl "C_T_DLY_PVS_COR_RPL" VALUE 0x70848 a_85 100 LINEAR______0_000000__0H___655_3 0.0 655.35 BIT_MASK 0xffffffff /end CHARACTERISTIC
/begin CHARACTERISTIC c_t_dly_reac_fsd "C_T_DLY_REAC_FSD" VALUE 0x7084a a_85 100 LINEAR______0_000000__0H___655_3 0.0 655.35 BIT_MASK 0xffffffff /end CHARACTERISTIC
/begin CHARACTERISTIC c_t_dly_reac_fsd_maf "C_T_DLY_REAC_FSD_MAF" VALUE 0x7084c a_85 100 LINEAR______0_000000__0H___655_3 0.0 655.35 BIT_MASK 0xffffffff /end CHARACTERISTIC
/begin CHARACTERISTIC c_t_dly_req_pwl_dmtl "C_T_DLY_REQ_PWL_DMTL" VALUE 0x70c27 a_86 100 LINEAR______0_000000__0H___25_50 0.0 25.5 BIT_MASK 0xffffffff FUNCTION_LIST DMTL /end CHARACTERISTIC
/begin CHARACTERISTIC c_t_dly_sa "C_T_DLY_SA" VALUE 0x7084e a_85 10 LINEAR______0_100000__1H___65149 0.1 6553.5 BIT_MASK 0xffffffff /end CHARACTERISTIC
/begin CHARACTERISTIC c_t_dly_stop_refu "C_T_DLY_STOP_REFU" VALUE 0x70850 a_85 100 LINEAR______0_000000__0H___65152 0.0 65535.0 BIT_MASK 0xffffffff FUNCTION_LIST DMTL /end CHARACTERISTIC
/begin CHARACTERISTIC c_t_dly_syn "C_T_DLY_SYN" VALUE 0x70852 a_85 100 LINEAR______0_000000__0H___65535 0.0 65535.0 BIT_MASK 0xffffffff /end CHARACTERISTIC
/begin CHARACTERISTIC c_t_dly_tps_req_ltc "C_T_DLY_TPS_REQ_LTC" VALUE 0x70854 a_85 100 LINEAR______0_000000__0H___655_3 0.0 655.35 BIT_MASK 0xffffffff /end CHARACTERISTIC
/begin CHARACTERISTIC c_t_dly_vs_sp_cru_max "C_T_DLY_VS_SP_CRU_MAX" VALUE 0x70c28 a_86 100 LINEAR______0_000000__0H___25514 0.0 255.0 BIT_MASK 0xffffffff /end CHARACTERISTIC
/begin CHARACTERISTIC c_t_dmtl_eol_max "C_T_DMTL_EOL_MAX" VALUE 0x70856 a_85 100 LINEAR______0_000000__0H___6553_ 0.0 6553.5 BIT_MASK 0xffffffff FUNCTION_LIST DMTL /end CHARACTERISTIC
/begin CHARACTERISTIC c_t_dmtl_max "C_T_DMTL_MAX" VALUE 0x70858 a_85 100 LINEAR______0_000000__0H___6553_ 0.0 6553.5 BIT_MASK 0xffffffff FUNCTION_LIST DMTL /end CHARACTERISTIC
/begin CHARACTERISTIC c_t_dmtl_rough_leak_test "C_T_DMTL_ROUGH_LEAK_TEST" VALUE 0x7085a a_85 100 LINEAR______0_000000__0H___6553_ 0.0 6553.5 BIT_MASK 0xffffffff FUNCTION_LIST DMTL /end CHARACTERISTIC
/begin CHARACTERISTIC c_t_dmtl_small_leak_test "C_T_DMTL_SMALL_LEAK_TEST" VALUE 0x7085c a_85 100 LINEAR______0_000000__0H___6553_ 0.0 6553.5 BIT_MASK 0xffffffff FUNCTION_LIST DMTL /end CHARACTERISTIC
/begin CHARACTERISTIC c_t_dyw_tps_lih_chk "C_T_DYW_TPS_LIH_CHK" VALUE 0x70c29 a_86 100 LINEAR______0_000000__0H___1_153 0.0 1.275 BIT_MASK 0xffffffff /end CHARACTERISTIC
/begin CHARACTERISTIC c_t_ef_ast "C_T_EF_AST" VALUE 0x70c2a a_86 20 LINEAR______0_000000__0H___25_50 0.0 25.5 BIT_MASK 0xffffffff /end CHARACTERISTIC
/begin CHARACTERISTIC c_t_efp "C_T_EFP" VALUE 0x7085e a_85 15 LINEAR______0_100000__1H___65149 0.1 6553.5 BIT_MASK 0xffffffff /end CHARACTERISTIC
/begin CHARACTERISTIC c_t_efp_prev "C_T_EFP_PREV" VALUE 0x70c2b a_86 15 LINEAR______0_100000__1H___25_50 0.1 25.5 BIT_MASK 0xffffffff /end CHARACTERISTIC
/begin CHARACTERISTIC c_t_ena_dr_dmtl_max "C_T_ENA_DR_DMTL_MAX" VALUE 0x70860 a_85 100 LINEAR______0_000000__0H___6553_ 0.0 6553.5 BIT_MASK 0xffffffff FUNCTION_LIST DMTL /end CHARACTERISTIC
/begin CHARACTERISTIC c_t_err_wheel "C_T_ERR_WHEEL" VALUE 0x70c2c a_86 100 LINEAR______0_000000__0H___2550_ 0.0 2550.0 BIT_MASK 0xffffffff /end CHARACTERISTIC
/begin CHARACTERISTIC c_t_es_dew_max "C_T_ES_DEW_MAX" VALUE 0x70862 a_85 15 LINEAR______0_000000__0H___65563 0.0 65535.0 BIT_MASK 0xffffffff FUNCTION_LIST DPM /end CHARACTERISTIC
/begin CHARACTERISTIC c_t_es_dew_min "C_T_ES_DEW_MIN" VALUE 0x70864 a_85 15 LINEAR______0_000000__0H___65563 0.0 65535.0 BIT_MASK 0xffffffff FUNCTION_LIST DPM /end CHARACTERISTIC
/begin CHARACTERISTIC c_t_es_dif_dew "C_T_ES_DIF_DEW" VALUE 0x70866 a_85 15 LINEAR______0_000000__0H___65563 0.0 65535.0 BIT_MASK 0xffffffff FUNCTION_LIST DPM /end CHARACTERISTIC
/begin CHARACTERISTIC c_t_es_dmtl_min "C_T_ES_DMTL_MIN" VALUE 0x70868 a_85 100 LINEAR______0_000000__0H___65563 0.0 65535.0 BIT_MASK 0xffffffff FUNCTION_LIST DMTL /end CHARACTERISTIC
/begin CHARACTERISTIC c_t_es_heat "C_T_ES_HEAT" VALUE 0x7086a a_85 100 LINEAR______0_000000__0H___65563 0.0 65535.0 BIT_MASK 0xffffffff /end CHARACTERISTIC
/begin CHARACTERISTIC c_t_es_sub_dmtl "C_T_ES_SUB_DMTL" VALUE 0x7086c a_85 100 LINEAR______0_000000__0H___65563 0.0 65535.0 BIT_MASK 0xffffffff FUNCTION_LIST DMTL /end CHARACTERISTIC
/begin CHARACTERISTIC c_t_es_tco_plaus_max "C_T_ES_TCO_PLAUS_MAX" VALUE 0x7086e a_85 100 LINEAR______0_000000__0H___65563 0.0 65535.0 BIT_MASK 0xffffffff /end CHARACTERISTIC
/begin CHARACTERISTIC c_t_etc_predrive "C_T_ETC_PREDRIVE" VALUE 0x70c2d a_86 100 LINEAR______0_000000__0H___10154 0.0 10.0 BIT_MASK 0xffffffff /end CHARACTERISTIC
/begin CHARACTERISTIC c_t_expv "C_T_EXPV" VALUE 0x70c2e a_86 100 LINEAR______1_000000__1H___25_50 1.0 25.5 BIT_MASK 0xffffffff FUNCTION_LIST CNG /end CHARACTERISTIC
/begin CHARACTERISTIC c_t_fuc_diag "C_T_FUC_DIAG" VALUE 0x70c2f a_86 100 LINEAR______0_000000__0H___25_50 0.0 25.5 BIT_MASK 0xffffffff /end CHARACTERISTIC
/begin CHARACTERISTIC c_t_iga_amt "C_T_IGA_AMT" VALUE 0x70870 a_85 100 LINEAR______0_010000__1H___65155 0.01 655.34998 BIT_MASK 0xffffffff FUNCTION_LIST Z1S1 /end CHARACTERISTIC
/begin CHARACTERISTIC c_t_iga_ch_mon "C_T_IGA_CH_MON" VALUE 0x71242 a_85 100 LINEAR______0_000000__0H___26156 0.0 2621.4 BIT_MASK 0xffffffff /end CHARACTERISTIC
/begin CHARACTERISTIC c_t_iga_lgrd_puc_msr "C_T_IGA_LGRD_PUC_MSR" VALUE 0x70872 a_85 100 LINEAR______0_000000__0H___11_18 0.0 11.18464 BIT_MASK 0xffffffff /end CHARACTERISTIC
/begin CHARACTERISTIC c_t_iga_min_ris "C_T_IGA_MIN_RIS" VALUE 0x70874 a_85 1 LINEAR______0_010000__1H___655_3 0.01 655.34998 BIT_MASK 0xffffffff /end CHARACTERISTIC
/begin CHARACTERISTIC c_t_is_ch_2_n_sp_red "C_T_IS_CH_2_N_SP_RED" VALUE 0x70c30 a_86 100 LINEAR______0_000000__0H___25514 0.0 255.0 BIT_MASK 0xffffffff /end CHARACTERISTIC
/begin CHARACTERISTIC c_t_is_ivvt_ch_2_red "C_T_IS_IVVT_CH_2_RED" VALUE 0x70c31 a_86 100 LINEAR______0_000000__0H___25514 0.0 255.0 BIT_MASK 0xffffffff /end CHARACTERISTIC
/begin CHARACTERISTIC c_t_is_pvs_err "C_T_IS_PVS_ERR" VALUE 0x70c32 a_86 100 LINEAR______0_000000__0H___2_544 0.0 2.55 BIT_MASK 0xffffffff /end CHARACTERISTIC
/begin CHARACTERISTIC c_t_isapwm_off "C_T_ISAPWM_OFF" VALUE 0x70c33 a_86 100 LINEAR______0_000000__0H___2550_ 0.0 2550.0 BIT_MASK 0xffffffff /end CHARACTERISTIC
/begin CHARACTERISTIC c_t_lam_pu "C_T_LAM_PU" VALUE 0x70c34 a_86 100 LINEAR______1_000000__1H___25_50 1.0 25.5 BIT_MASK 0xffffffff /end CHARACTERISTIC
/begin CHARACTERISTIC c_t_lsh_dew_max_down "C_T_LSH_DEW_MAX_DOWN" VALUE 0x70c35 a_86 15 LINEAR______0_000000__0H___25514 0.0 255.0 BIT_MASK 0xffffffff FUNCTION_LIST DPM /end CHARACTERISTIC
/begin CHARACTERISTIC c_t_lsh_dew_max_up "C_T_LSH_DEW_MAX_UP" VALUE 0x70c36 a_86 15 LINEAR______0_000000__0H___25514 0.0 255.0 BIT_MASK 0xffffffff FUNCTION_LIST DPM /end CHARACTERISTIC
/begin CHARACTERISTIC c_t_lsh_max "C_T_LSH_MAX" VALUE 0x70c37 a_86 15 LINEAR______0_000000__0H___25514 0.0 255.0 BIT_MASK 0xffffffff FUNCTION_LIST DPM /end CHARACTERISTIC
/begin CHARACTERISTIC c_t_maf_min_fsd "C_T_MAF_MIN_FSD" VALUE 0x70876 a_85 100 LINEAR______0_000000__0H___655_3 0.0 655.35 BIT_MASK 0xffffffff /end CHARACTERISTIC
/begin CHARACTERISTIC c_t_max_cs "C_T_MAX_CS" VALUE 0x70c38 a_86 100 LINEAR______0_000000__0H___2540_ 0.0 2540.0 BIT_MASK 0xffffffff /end CHARACTERISTIC
/begin CHARACTERISTIC c_t_max_ctr_amt_diag "C_T_MAX_CTR_AMT_DIAG" VALUE 0x70878 a_85 100 LINEAR______0_000000__0H___65157 0.0 655.34998 BIT_MASK 0xffffffff FUNCTION_LIST Z1S1 /end CHARACTERISTIC
/begin CHARACTERISTIC c_t_max_ctr_amt_diag_mon "C_T_MAX_CTR_AMT_DIAG_MON" VALUE 0x7126f a_86 100 LINEAR______0_000000__0H___10_20 0.0 10.2 BIT_MASK 0xffffffff FUNCTION_LIST Z1S1 /end CHARACTERISTIC
/begin CHARACTERISTIC c_t_max_diag_sav "C_T_MAX_DIAG_SAV" VALUE 0x7087a a_85 10 LINEAR______0_100000__1H___65149 0.1 6553.5 BIT_MASK 0xffffffff /end CHARACTERISTIC
/begin CHARACTERISTIC c_t_max_diag_sav_eol "C_T_MAX_DIAG_SAV_EOL" VALUE 0x7087c a_85 10 LINEAR______0_100000__1H___65149 0.1 6553.5 BIT_MASK 0xffffffff /end CHARACTERISTIC
/begin CHARACTERISTIC c_t_max_ecu "C_T_MAX_ECU" VALUE 0x7087e a_85 1 LINEAR______1_000000__1H___65535 1.0 65535.0 BIT_MASK 0xffffffff /end CHARACTERISTIC
/begin CHARACTERISTIC c_t_max_ip_aj "C_T_MAX_IP_AJ" VALUE 0x70c39 a_86 100 LINEAR______10_000000__1H___2550 10.0 2550.0 BIT_MASK 0xffffffff /end CHARACTERISTIC
/begin CHARACTERISTIC c_t_max_is "C_T_MAX_IS" VALUE 0x70880 a_85 1 LINEAR______0_010000__1H___655_3 0.01 655.34998 BIT_MASK 0xffffffff /end CHARACTERISTIC
/begin CHARACTERISTIC c_t_max_lam_ld "C_T_MAX_LAM_LD" VALUE 0x70c3a a_86 20 LINEAR______1_000000__1H___25148 1.0 255.0 BIT_MASK 0xffffffff /end CHARACTERISTIC
/begin CHARACTERISTIC c_t_max_msw_bit_diag "C_T_MAX_MSW_BIT_DIAG" VALUE 0x70c3b a_86 100 LINEAR______10_000000__0H___2560 10.0 2560.0 BIT_MASK 0xffffffff /end CHARACTERISTIC
/begin CHARACTERISTIC c_t_max_pl_ch_2 "C_T_MAX_PL_CH_2" VALUE 0x70882 a_85 100 LINEAR______0_000000__0H___6553_ 0.0 6553.5 BIT_MASK 0xffffffff /end CHARACTERISTIC
/begin CHARACTERISTIC c_t_max_rest "C_T_MAX_REST" VALUE 0x70c3c a_86 10 LINEAR______1_000000__1H___25148 1.0 255.0 BIT_MASK 0xffffffff /end CHARACTERISTIC
/begin CHARACTERISTIC c_t_max_state_amt_1_diag "C_T_MAX_STATE_AMT_1_DIAG" VALUE 0x70884 a_85 100 LINEAR______0_000000__0H___65157 0.0 655.34998 BIT_MASK 0xffffffff FUNCTION_LIST Z1S1 /end CHARACTERISTIC
/begin CHARACTERISTIC c_t_max_state_amt_1_diag_mon "C_T_MAX_STATE_AMT_1_DIAG_MON" VALUE 0x71270 a_86 100 LINEAR______0_000000__0H___10_20 0.0 10.2 BIT_MASK 0xffffffff FUNCTION_LIST Z1S1 /end CHARACTERISTIC
/begin CHARACTERISTIC c_t_max_state_amt_2_diag "C_T_MAX_STATE_AMT_2_DIAG" VALUE 0x70886 a_85 100 LINEAR______0_000000__0H___65157 0.0 655.34998 BIT_MASK 0xffffffff FUNCTION_LIST Z1S1 /end CHARACTERISTIC
/begin CHARACTERISTIC c_t_max_state_amt_2_diag_mon "C_T_MAX_STATE_AMT_2_DIAG_MON" VALUE 0x71271 a_86 100 LINEAR______0_000000__0H___10_20 0.0 10.2 BIT_MASK 0xffffffff FUNCTION_LIST Z1S1 /end CHARACTERISTIC
/begin CHARACTERISTIC c_t_max_state_amt_3_diag "C_T_MAX_STATE_AMT_3_DIAG" VALUE 0x70888 a_85 100 LINEAR______0_000000__0H___65157 0.0 655.34998 BIT_MASK 0xffffffff FUNCTION_LIST Z1S1 /end CHARACTERISTIC
/begin CHARACTERISTIC c_t_max_state_amt_3_diag_mon "C_T_MAX_STATE_AMT_3_DIAG_MON" VALUE 0x71272 a_86 100 LINEAR______0_000000__0H___10_20 0.0 10.2 BIT_MASK 0xffffffff FUNCTION_LIST Z1S1 /end CHARACTERISTIC
/begin CHARACTERISTIC c_t_max_state_clu_amt_diag "C_T_MAX_STATE_CLU_AMT_DIAG" VALUE 0x7088a a_85 100 LINEAR______0_000000__0H___65157 0.0 655.34998 BIT_MASK 0xffffffff FUNCTION_LIST Z1S1 /end CHARACTERISTIC
/begin CHARACTERISTIC c_t_max_state_clu_amt_diag_mon "C_T_MAX_STATE_CLU_AMT_DIAG_MON" VALUE 0x71273 a_86 100 LINEAR______0_000000__0H___10_20 0.0 10.2 BIT_MASK 0xffffffff FUNCTION_LIST Z1S1 /end CHARACTERISTIC
/begin CHARACTERISTIC c_t_max_tps_ad "C_T_MAX_TPS_AD" VALUE 0x70c3d a_86 100 LINEAR______0_000000__0H___1_153 0.0 1.275 BIT_MASK 0xffffffff /end CHARACTERISTIC
/begin CHARACTERISTIC c_t_max_tps_lih_chk "C_T_MAX_TPS_LIH_CHK" VALUE 0x70c3e a_86 100 LINEAR______0_000000__0H___1_153 0.0 1.275 BIT_MASK 0xffffffff /end CHARACTERISTIC
/begin CHARACTERISTIC c_t_max_tps_sp_rst_chk "C_T_MAX_TPS_SP_RST_CHK" VALUE 0x70c3f a_86 100 LINEAR______0_000000__0H___1_153 0.0 1.275 BIT_MASK 0xffffffff /end CHARACTERISTIC
/begin CHARACTERISTIC c_t_max_tqi_amt_diag "C_T_MAX_TQI_AMT_DIAG" VALUE 0x7088c a_85 100 LINEAR______0_000000__0H___65157 0.0 655.34998 BIT_MASK 0xffffffff FUNCTION_LIST Z1S1 /end CHARACTERISTIC
/begin CHARACTERISTIC c_t_max_tqi_amt_diag_mon "C_T_MAX_TQI_AMT_DIAG_MON" VALUE 0x71274 a_86 100 LINEAR______0_000000__0H___10_20 0.0 10.2 BIT_MASK 0xffffffff FUNCTION_LIST Z1S1 /end CHARACTERISTIC
/begin CHARACTERISTIC c_t_max_tqr_etcu_diag "C_T_MAX_TQR_ETCU_DIAG" VALUE 0x7088e a_85 10 LINEAR______0_010000__1H___655_3 0.01 655.34998 BIT_MASK 0xffffffff /end CHARACTERISTIC
/begin CHARACTERISTIC c_t_min_can_diag "C_T_MIN_CAN_DIAG" VALUE 0x70c40 a_86 100 LINEAR______0_000000__0H___2550_ 0.0 2550.0 BIT_MASK 0xffffffff /end CHARACTERISTIC
/begin CHARACTERISTIC c_t_min_ch_3_act_pl "C_T_MIN_CH_3_ACT_PL" VALUE 0x70890 a_85 100 LINEAR______0_000000__0H___6553_ 0.0 6553.5 BIT_MASK 0xffffffff /end CHARACTERISTIC
/begin CHARACTERISTIC c_t_min_ch_3_pas_pl "C_T_MIN_CH_3_PAS_PL" VALUE 0x70892 a_85 100 LINEAR______0_000000__0H___6553_ 0.0 6553.5 BIT_MASK 0xffffffff /end CHARACTERISTIC
/begin CHARACTERISTIC c_t_min_d_isa "C_T_MIN_D_ISA" VALUE 0x70894 a_85 10 LINEAR______0_010000__1H___655_3 0.01 655.34998 BIT_MASK 0xffffffff /end CHARACTERISTIC
/begin CHARACTERISTIC c_t_min_etc "C_T_MIN_ETC" VALUE 0x70c41 a_86 100 LINEAR______0_000000__0H___25158 0.0 255.0 BIT_MASK 0xffffffff /end CHARACTERISTIC
/begin CHARACTERISTIC c_t_min_is_ch_3 "C_T_MIN_IS_CH_3" VALUE 0x70896 a_85 100 LINEAR______0_000000__0H___6553_ 0.0 6553.5 BIT_MASK 0xffffffff /end CHARACTERISTIC
/begin CHARACTERISTIC c_t_min_msw_bit_diag "C_T_MIN_MSW_BIT_DIAG" VALUE 0x70c42 a_86 100 LINEAR______10_000000__0H___2560 10.0 2560.0 BIT_MASK 0xffffffff /end CHARACTERISTIC
/begin CHARACTERISTIC c_t_min_puc_dly "C_T_MIN_PUC_DLY" VALUE 0x70c43 a_86 100 LINEAR______0_000000__0H___2_159 0.0 2.55 BIT_MASK 0xffffffff /end CHARACTERISTIC
/begin CHARACTERISTIC c_t_min_ris "C_T_MIN_RIS" VALUE 0x70898 a_85 1 LINEAR______0_010000__1H___655_3 0.01 655.34998 BIT_MASK 0xffffffff /end CHARACTERISTIC
/begin CHARACTERISTIC c_t_min_sa_cru "C_T_MIN_SA_CRU" VALUE 0x70c44 a_86 5 LINEAR______0_000000__0H___25_50 0.0 25.5 BIT_MASK 0xffffffff /end CHARACTERISTIC
/begin CHARACTERISTIC c_t_mis_min_puc "C_T_MIS_MIN_PUC" VALUE 0x7089a a_85 5 LINEAR______100_000000__1H___100 100.0 100000.0 BIT_MASK 0xffffffff /end CHARACTERISTIC
/begin CHARACTERISTIC c_t_msr_inh_mon "C_T_MSR_INH_MON" VALUE 0x71275 a_86 100 LINEAR______0_000000__0H___10_20 0.0 10.2 BIT_MASK 0xffffffff /end CHARACTERISTIC
/begin CHARACTERISTIC c_t_mtc_isa_off "C_T_MTC_ISA_OFF" VALUE 0x70c45 a_86 100 LINEAR______0_000000__0H___25514 0.0 255.0 BIT_MASK 0xffffffff /end CHARACTERISTIC
/begin CHARACTERISTIC c_t_mtcpwm_close_act_max "C_T_MTCPWM_CLOSE_ACT_MAX" VALUE 0x7089c a_85 100 LINEAR______0_000000__0H___5_160 0.0 5.0 BIT_MASK 0xffffffff /end CHARACTERISTIC
/begin CHARACTERISTIC c_t_mtcpwm_pi_diag "C_T_MTCPWM_PI_DIAG" VALUE 0x70c46 a_86 100 LINEAR______0_000000__0H___2_544 0.0 2.55 BIT_MASK 0xffffffff /end CHARACTERISTIC
/begin CHARACTERISTIC c_t_mtcpwm_pi_diag_cur_off "C_T_MTCPWM_PI_DIAG_CUR_OFF" VALUE 0x70c47 a_86 100 LINEAR______0_000000__0H___2_544 0.0 2.55 BIT_MASK 0xffffffff /end CHARACTERISTIC
/begin CHARACTERISTIC c_t_n_diag_sa "C_T_N_DIAG_SA" VALUE 0x70c48 a_86 100 LINEAR______0_000000__0H___25161 0.0 255.0 BIT_MASK 0xffffffff /end CHARACTERISTIC
/begin CHARACTERISTIC c_t_n_dif_ast "C_T_N_DIF_AST" VALUE 0x70c49 a_86 100 LINEAR______0_000000__0H___25_50 0.0 25.5 BIT_MASK 0xffffffff /end CHARACTERISTIC
/begin CHARACTERISTIC c_t_n_ecf_ast "C_T_N_ECF_AST" VALUE 0x70c4a a_86 100 LINEAR______0_200000__0H___51_00 0.2 51.0 BIT_MASK 0xffffffff /end CHARACTERISTIC
/begin CHARACTERISTIC c_t_n_perc_ecf_act "C_T_N_PERC_ECF_ACT" VALUE 0x70c4b a_86 100 LINEAR______0_200000__1H___51_00 0.2 51.0 BIT_MASK 0xffffffff /end CHARACTERISTIC
/begin CHARACTERISTIC c_t_predrive_dly_max "C_T_PREDRIVE_DLY_MAX" VALUE 0x70c4c a_86 100 LINEAR______0_000000__0H___2_544 0.0 2.55 BIT_MASK 0xffffffff /end CHARACTERISTIC
/begin CHARACTERISTIC c_t_puc_deacc_vs "C_T_PUC_DEACC_VS" VALUE 0x7089e a_85 100 LINEAR______0_000000__0H___11_18 0.0 11.18464 BIT_MASK 0xffffffff /end CHARACTERISTIC
/begin CHARACTERISTIC c_t_puc_dly_min "C_T_PUC_DLY_MIN" VALUE 0x70c4d a_86 100 LINEAR______0_000000__0H___25_50 0.0 25.5 BIT_MASK 0xffffffff /end CHARACTERISTIC
/begin CHARACTERISTIC c_t_puc_tco_ex_plaus_diag "C_T_PUC_TCO_EX_PLAUS_DIAG" VALUE 0x708a0 a_85 100 LINEAR______0_100000__1H___65149 0.1 6553.5 BIT_MASK 0xffffffff /end CHARACTERISTIC
/begin CHARACTERISTIC c_t_pvs_fac_cs "C_T_PVS_FAC_CS" VALUE 0x70c4e a_86 20 LINEAR______1_000000__1H___25148 1.0 255.0 BIT_MASK 0xffffffff /end CHARACTERISTIC
/begin CHARACTERISTIC c_t_pvs_fac_cs_ssg "C_T_PVS_FAC_CS_SSG" VALUE 0x70c4f a_86 20 LINEAR______1_000000__1H___25148 1.0 255.0 BIT_MASK 0xffffffff FUNCTION_LIST Z1S1 /end CHARACTERISTIC
/begin CHARACTERISTIC c_t_pvs_fac_shift "C_T_PVS_FAC_SHIFT" VALUE 0x70c50 a_86 20 LINEAR______1_000000__1H___25148 1.0 255.0 BIT_MASK 0xffffffff /end CHARACTERISTIC
/begin CHARACTERISTIC c_t_pvs_fac_shift_ssg "C_T_PVS_FAC_SHIFT_SSG" VALUE 0x70c51 a_86 20 LINEAR______1_000000__1H___25148 1.0 255.0 BIT_MASK 0xffffffff FUNCTION_LIST Z1S1 /end CHARACTERISTIC
/begin CHARACTERISTIC c_t_pvs_grd_min_aj "C_T_PVS_GRD_MIN_AJ" VALUE 0x70c52 a_86 100 LINEAR______0_100000__1H___25_50 0.1 25.5 BIT_MASK 0xffffffff /end CHARACTERISTIC
/begin CHARACTERISTIC c_t_ready_cru "C_T_READY_CRU" VALUE 0x70c53 a_86 10 LINEAR______1000_000000__64H___2 1000.0 2550.0 BIT_MASK 0xffffffff /end CHARACTERISTIC
/begin CHARACTERISTIC c_t_ref_leak_mes_max "C_T_REF_LEAK_MES_MAX" VALUE 0x708a2 a_85 100 LINEAR______0_000000__0H___6553_ 0.0 6553.5 BIT_MASK 0xffffffff FUNCTION_LIST DMTL /end CHARACTERISTIC
/begin CHARACTERISTIC c_t_ref_leak_mes_rep_max "C_T_REF_LEAK_MES_REP_MAX" VALUE 0x708a4 a_85 100 LINEAR______0_000000__0H___6553_ 0.0 6553.5 BIT_MASK 0xffffffff FUNCTION_LIST DMTL /end CHARACTERISTIC
/begin CHARACTERISTIC c_t_ref_test_rough_leak "C_T_REF_TEST_ROUGH_LEAK" VALUE 0x708a6 a_85 100 LINEAR______0_000000__0H___6553_ 0.0 6553.5 BIT_MASK 0xffffffff FUNCTION_LIST DMTL /end CHARACTERISTIC
/begin CHARACTERISTIC c_t_rly_main_diag "C_T_RLY_MAIN_DIAG" VALUE 0x70c54 a_86 100 LINEAR______0_000000__0H___25_50 0.0 25.5 BIT_MASK 0xffffffff /end CHARACTERISTIC
/begin CHARACTERISTIC c_t_sap_wait_max "C_T_SAP_WAIT_MAX" VALUE 0x70c55 a_86 100 LINEAR______0_000000__0H___25514 0.0 255.0 BIT_MASK 0xffffffff /end CHARACTERISTIC
/begin CHARACTERISTIC c_t_sawup_on "C_T_SAWUP_ON" VALUE 0x708a8 a_85 10 LINEAR______0_100000__1H___65149 0.1 6553.5 BIT_MASK 0xffffffff /end CHARACTERISTIC
/begin CHARACTERISTIC c_t_sawup_on_is "C_T_SAWUP_ON_IS" VALUE 0x708aa a_85 10 LINEAR______0_100000__1H___65149 0.1 6553.5 BIT_MASK 0xffffffff /end CHARACTERISTIC
/begin CHARACTERISTIC c_t_scc_asr "C_T_SCC_ASR" VALUE 0x70c56 a_86 100 LINEAR______0_000000__0H___2_544 0.0 2.55 BIT_MASK 0xffffffff /end CHARACTERISTIC
/begin CHARACTERISTIC c_t_seg_ad_crlc_er "C_T_SEG_AD_CRLC_ER" VALUE 0x708ac a_85 100 LINEAR______0_000000__0H___0_109 0.0 0.99998474 BIT_MASK 0xffffffff /end CHARACTERISTIC
/begin CHARACTERISTIC c_t_seg_ad_crlc_er_raw "C_T_SEG_AD_CRLC_ER_RAW" VALUE 0x708ae a_85 100 LINEAR______0_000000__0H___0_109 0.0 0.99998474 BIT_MASK 0xffffffff /end CHARACTERISTIC
/begin CHARACTERISTIC c_t_sum_dif_ivvt_ex_diag "C_T_SUM_DIF_IVVT_EX_DIAG" VALUE 0x70c57 a_86 100 LINEAR______0_625000__1H___159_3 0.625 159.375 BIT_MASK 0xffffffff /end CHARACTERISTIC
/begin CHARACTERISTIC c_t_sum_dif_ivvt_in_diag "C_T_SUM_DIF_IVVT_IN_DIAG" VALUE 0x70c58 a_86 100 LINEAR______0_625000__1H___159_3 0.625 159.375 BIT_MASK 0xffffffff /end CHARACTERISTIC
/begin CHARACTERISTIC c_t_sum_max_max_fsd "C_T_SUM_MAX_MAX_FSD" VALUE 0x708b0 a_85 100 LINEAR______0_000000__0H___1310_ 0.0 1310.7 BIT_MASK 0xffffffff /end CHARACTERISTIC
/begin CHARACTERISTIC c_t_sum_min_fsd_ld "C_T_SUM_MIN_FSD_LD" VALUE 0x708b2 a_85 100 LINEAR______0_000000__0H___1310_ 0.0 1310.7 BIT_MASK 0xffffffff /end CHARACTERISTIC
/begin CHARACTERISTIC c_t_sum_min_max_fsd "C_T_SUM_MIN_MAX_FSD" VALUE 0x708b4 a_85 100 LINEAR______0_000000__0H___1310_ 0.0 1310.7 BIT_MASK 0xffffffff /end CHARACTERISTIC
/begin CHARACTERISTIC c_t_sum_rst_max_fsd "C_T_SUM_RST_MAX_FSD" VALUE 0x708b6 a_85 100 LINEAR______0_000000__0H___65152 0.0 65535.0 BIT_MASK 0xffffffff /end CHARACTERISTIC
/begin CHARACTERISTIC c_t_tco_can_ast "C_T_TCO_CAN_AST" VALUE 0x708b8 a_85 100 LINEAR______0_000000__0H___6553_ 0.0 6553.5 BIT_MASK 0xffffffff /end CHARACTERISTIC
/begin CHARACTERISTIC c_t_tco_grd_max_mon "C_T_TCO_GRD_MAX_MON" VALUE 0x71276 a_86 100 LINEAR______0_000000__0H___10_20 0.0 10.2 BIT_MASK 0xffffffff /end CHARACTERISTIC
/begin CHARACTERISTIC c_t_tco_sub_is_1 "C_T_TCO_SUB_IS_1" VALUE 0x70c59 a_86 100 LINEAR______0_000000__0H___25162 0.0 2550.0 BIT_MASK 0xffffffff /end CHARACTERISTIC
/begin CHARACTERISTIC c_t_tco_sub_is_2 "C_T_TCO_SUB_IS_2" VALUE 0x70c5a a_86 100 LINEAR______0_000000__0H___25162 0.0 2550.0 BIT_MASK 0xffffffff /end CHARACTERISTIC
/begin CHARACTERISTIC c_t_tco_sub_puc "C_T_TCO_SUB_PUC" VALUE 0x70c5b a_86 100 LINEAR______0_000000__0H___25162 0.0 2550.0 BIT_MASK 0xffffffff /end CHARACTERISTIC
/begin CHARACTERISTIC c_t_ti_ad_1 "C_T_TI_AD_1" VALUE 0x708ba a_85 1 LINEAR______0_100000__1H___65149 0.1 6553.5 BIT_MASK 0xffffffff /end CHARACTERISTIC
/begin CHARACTERISTIC c_t_ti_ad_1_cat_var "C_T_TI_AD_1_CAT_VAR" VALUE 0x708bc a_85 1 LINEAR______0_100000__1H___65149 0.1 6553.5 BIT_MASK 0xffffffff /end CHARACTERISTIC
/begin CHARACTERISTIC c_t_ti_tra_pas "C_T_TI_TRA_PAS" VALUE 0x70c5c a_86 100 LINEAR______0_000000__0H___2550_ 0.0 2550.0 BIT_MASK 0xffffffff /end CHARACTERISTIC
/begin CHARACTERISTIC c_t_tia_tco_diag "C_T_TIA_TCO_DIAG" VALUE 0x708be a_85 10 LINEAR______0_100000__1H___65149 0.1 6553.5 BIT_MASK 0xffffffff /end CHARACTERISTIC
/begin CHARACTERISTIC c_t_tooth_max "C_T_TOOTH_MAX" VALUE 0x708c0 a_85 100 LINEAR______0_000000__0H___349_5 0.0 349.52 BIT_MASK 0xffffffff FUNCTION_LIST Z10I /end CHARACTERISTIC
/begin CHARACTERISTIC c_t_tot_isa_ctl_low_n "C_T_TOT_ISA_CTL_LOW_N" VALUE 0x708c2 a_85 100 LINEAR______0_010000__0H___655_3 0.01 655.35 BIT_MASK 0xffffffff FUNCTION_LIST Z10I /end CHARACTERISTIC
/begin CHARACTERISTIC c_t_tps_ad_hys "C_T_TPS_AD_HYS" VALUE 0x70c5d a_86 100 LINEAR______0_000000__0H___1_153 0.0 1.275 BIT_MASK 0xffffffff /end CHARACTERISTIC
/begin CHARACTERISTIC c_t_tps_dif_diag "C_T_TPS_DIF_DIAG" VALUE 0x70c5e a_86 100 LINEAR______0_000000__0H___2_163 0.0 2.55 BIT_MASK 0xffffffff /end CHARACTERISTIC
/begin CHARACTERISTIC c_t_tps_dif_int "C_T_TPS_DIF_INT" VALUE 0x70c5f a_86 100 LINEAR______0_000000__0H___2_544 0.0 2.55 BIT_MASK 0xffffffff /end CHARACTERISTIC
/begin CHARACTERISTIC c_t_tps_sp_pwl "C_T_TPS_SP_PWL" VALUE 0x70c60 a_86 100 LINEAR______0_000000__0H___2_163 0.0 2.55 BIT_MASK 0xffffffff /end CHARACTERISTIC
/begin CHARACTERISTIC c_t_tqi_lim "C_T_TQI_LIM" VALUE 0x708c4 a_85 100 LINEAR______0_010000__1H___655_3 0.01 655.34998 BIT_MASK 0xffffffff /end CHARACTERISTIC
/begin CHARACTERISTIC c_t_tqi_lim_act_thd "C_T_TQI_LIM_ACT_THD" VALUE 0x708c6 a_85 100 LINEAR______0_000000__0H___655_3 0.0 655.35 BIT_MASK 0xffffffff /end CHARACTERISTIC
/begin CHARACTERISTIC c_t_tqi_mon "C_T_TQI_MON" VALUE 0x71277 a_86 100 LINEAR______0_000000__0H___10_20 0.0 10.2 BIT_MASK 0xffffffff /end CHARACTERISTIC
/begin CHARACTERISTIC c_t_tqi_mon2 "C_T_TQI_MON2" VALUE 0x70c61 a_86 100 LINEAR______0_000000__0H___10_20 0.0 10.2 BIT_MASK 0xffffffff FUNCTION_LIST MON2 /end CHARACTERISTIC
/begin CHARACTERISTIC c_t_v_dmtl_max_diag "C_T_V_DMTL_MAX_DIAG" VALUE 0x708c8 a_85 10 LINEAR______0_000000__0H___655_3 0.0 655.35 BIT_MASK 0xffffffff FUNCTION_LIST DMTL /end CHARACTERISTIC
/begin CHARACTERISTIC c_t_vb_dly_dmtl "C_T_VB_DLY_DMTL" VALUE 0x708ca a_85 100 LINEAR______0_000000__0H___6553_ 0.0 6553.5 BIT_MASK 0xffffffff FUNCTION_LIST DMTL /end CHARACTERISTIC
/begin CHARACTERISTIC c_t_vls_gnd_down_diag "C_T_VLS_GND_DOWN_DIAG" VALUE 0x708cc a_85 100 LINEAR______0_000000__0H___327_6 0.0 327.68 BIT_MASK 0xffffffff /end CHARACTERISTIC
/begin CHARACTERISTIC c_t_vls_gnd_up_diag "C_T_VLS_GND_UP_DIAG" VALUE 0x708ce a_85 100 LINEAR______0_000000__0H___327_6 0.0 327.68 BIT_MASK 0xffffffff /end CHARACTERISTIC
/begin CHARACTERISTIC c_t_vls_open_up_diag "C_T_VLS_OPEN_UP_DIAG" VALUE 0x708d0 a_85 100 LINEAR______0_000000__0H___327_6 0.0 327.68 BIT_MASK 0xffffffff /end CHARACTERISTIC
/begin CHARACTERISTIC c_t_vs_min_diag "C_T_VS_MIN_DIAG" VALUE 0x708d2 a_85 10 LINEAR______1_000000__1H___65535 1.0 65535.0 BIT_MASK 0xffffffff /end CHARACTERISTIC
/begin CHARACTERISTIC c_tam_cat_diag_max "C_TAM_CAT_DIAG_MAX" VALUE 0x70c62 a_86 100 LINEAR______0_000000__0H___127_0 0.0 127.0 BIT_MASK 0xffffffff /end CHARACTERISTIC
/begin CHARACTERISTIC c_tam_dmtl_max "C_TAM_DMTL_MAX" VALUE 0x70dae a_87 100 LINEAR_______128_000000__FFFF143 -128.0 127.0 BIT_MASK 0xffffffff FUNCTION_LIST DMTL /end CHARACTERISTIC
/begin CHARACTERISTIC c_tam_dmtl_min "C_TAM_DMTL_MIN" VALUE 0x70daf a_87 100 LINEAR_______128_000000__FFFF143 -128.0 127.0 BIT_MASK 0xffffffff FUNCTION_LIST DMTL /end CHARACTERISTIC
/begin CHARACTERISTIC c_tam_hys "C_TAM_HYS" VALUE 0x70c63 a_86 100 LINEAR______0_000000__0H___25164 0.0 255.0 BIT_MASK 0xffffffff /end CHARACTERISTIC
/begin CHARACTERISTIC c_tam_min_ect "C_TAM_MIN_ECT" VALUE 0x70db0 a_87 100 LINEAR_______128_000000__FFFF143 -128.0 127.0 BIT_MASK 0xffffffff /end CHARACTERISTIC
/begin CHARACTERISTIC c_tam_min_fsd "C_TAM_MIN_FSD" VALUE 0x70db1 a_87 100 LINEAR_______128_000000__FFFF143 -128.0 127.0 BIT_MASK 0xffffffff /end CHARACTERISTIC
/begin CHARACTERISTIC c_tam_min_hys_ect "C_TAM_MIN_HYS_ECT" VALUE 0x70c64 a_86 100 LINEAR______0_000000__0H___25164 0.0 255.0 BIT_MASK 0xffffffff /end CHARACTERISTIC
/begin CHARACTERISTIC c_tam_min_tco_ex_plaus_diag "C_TAM_MIN_TCO_EX_PLAUS_DIAG" VALUE 0x70db2 a_87 100 LINEAR_______128_000000__FFFF143 -128.0 127.0 BIT_MASK 0xffffffff /end CHARACTERISTIC
/begin CHARACTERISTIC c_tam_n_sp_add_heat "C_TAM_N_SP_ADD_HEAT" VALUE 0x70db3 a_87 100 LINEAR_______128_000000__FFFF143 -128.0 127.0 BIT_MASK 0xffffffff /end CHARACTERISTIC
/begin CHARACTERISTIC c_tam_sub "C_TAM_SUB" VALUE 0x70db4 a_87 100 LINEAR_______128_000000__FFFF143 -128.0 127.0 BIT_MASK 0xffffffff /end CHARACTERISTIC
/begin CHARACTERISTIC c_tco_accin_ad_min_is "C_TCO_ACCIN_AD_MIN_IS" VALUE 0x70c65 a_86 15 LINEAR_______48_000000__0H___142 -48.0 142.5 BIT_MASK 0xffffffff /end CHARACTERISTIC
/begin CHARACTERISTIC c_tco_ad_max_is "C_TCO_AD_MAX_IS" VALUE 0x70c66 a_86 15 LINEAR_______48_000000__0H___142 -48.0 142.5 BIT_MASK 0xffffffff /end CHARACTERISTIC
/begin CHARACTERISTIC c_tco_ad_min_is "C_TCO_AD_MIN_IS" VALUE 0x70c67 a_86 15 LINEAR_______48_000000__0H___142 -48.0 142.5 BIT_MASK 0xffffffff /end CHARACTERISTIC
/begin CHARACTERISTIC c_tco_ad_min_knk "C_TCO_AD_MIN_KNK" VALUE 0x70c68 a_86 15 LINEAR_______48_000000__0H___142 -48.0 142.5 BIT_MASK 0xffffffff /end CHARACTERISTIC
/begin CHARACTERISTIC c_tco_bol_ect "C_TCO_BOL_ECT" VALUE 0x70c69 a_86 100 LINEAR_______48_000000__0H___142 -48.0 142.5 BIT_MASK 0xffffffff /end CHARACTERISTIC
/begin CHARACTERISTIC c_tco_cat_diag_min "C_TCO_CAT_DIAG_MIN" VALUE 0x70c6a a_86 100 LINEAR_______48_000000__0H___165 -48.0 142.5 BIT_MASK 0xffffffff /end CHARACTERISTIC
/begin CHARACTERISTIC c_tco_cat_var "C_TCO_CAT_VAR" VALUE 0x70c6b a_86 20 LINEAR_______48_000000__0H___142 -48.0 142.5 BIT_MASK 0xffffffff /end CHARACTERISTIC
/begin CHARACTERISTIC c_tco_diag "C_TCO_DIAG" VALUE 0x70c6c a_86 15 LINEAR_______48_000000__0H___142 -48.0 142.5 BIT_MASK 0xffffffff /end CHARACTERISTIC
/begin CHARACTERISTIC c_tco_dif_diag_max "C_TCO_DIF_DIAG_MAX" VALUE 0x70c6d a_86 15 LINEAR______0_000000__0H___190_5 0.0 190.5 BIT_MASK 0xffffffff /end CHARACTERISTIC
/begin CHARACTERISTIC c_tco_dif_max_rest "C_TCO_DIF_MAX_REST" VALUE 0x70c6e a_86 1 LINEAR______0_000000__0H___60_00 0.0 60.0 BIT_MASK 0xffffffff /end CHARACTERISTIC
/begin CHARACTERISTIC c_tco_dif_min_sa "C_TCO_DIF_MIN_SA" VALUE 0x70c6f a_86 100 LINEAR______0_000000__0H___190_5 0.0 190.5 BIT_MASK 0xffffffff /end CHARACTERISTIC
/begin CHARACTERISTIC c_tco_dly_puc_min "C_TCO_DLY_PUC_MIN" VALUE 0x70c70 a_86 100 LINEAR_______48_000000__0H___142 -48.0 142.5 BIT_MASK 0xffffffff /end CHARACTERISTIC
/begin CHARACTERISTIC c_tco_es_dew "C_TCO_ES_DEW" VALUE 0x70c71 a_86 15 LINEAR______0_000000__0H___190_5 0.0 190.5 BIT_MASK 0xffffffff FUNCTION_LIST DPM /end CHARACTERISTIC
/begin CHARACTERISTIC c_tco_ex_dif_diag "C_TCO_EX_DIF_DIAG" VALUE 0x70db5 a_87 15 LINEAR_______48_000000__FFFFFFC0 -48.0 48.0 BIT_MASK 0xffffffff /end CHARACTERISTIC
/begin CHARACTERISTIC c_tco_ex_hys_ect "C_TCO_EX_HYS_ECT" VALUE 0x70c72 a_86 15 LINEAR______0_000000__0H___190_5 0.0 190.5 BIT_MASK 0xffffffff /end CHARACTERISTIC
/begin CHARACTERISTIC c_tco_ex_max_ect "C_TCO_EX_MAX_ECT" VALUE 0x70c73 a_86 15 LINEAR_______48_000000__0H___142 -48.0 142.5 BIT_MASK 0xffffffff /end CHARACTERISTIC
/begin CHARACTERISTIC c_tco_ex_max_vs "C_TCO_EX_MAX_VS" VALUE 0x70c74 a_86 100 LINEAR_______48_000000__0H___142 -48.0 142.5 BIT_MASK 0xffffffff /end CHARACTERISTIC
/begin CHARACTERISTIC c_tco_ex_max_vs_hys "C_TCO_EX_MAX_VS_HYS" VALUE 0x70c75 a_86 100 LINEAR______0_000000__0H___190_5 0.0 190.5 BIT_MASK 0xffffffff /end CHARACTERISTIC
/begin CHARACTERISTIC c_tco_ex_tco_ex_plaus_diag "C_TCO_EX_TCO_EX_PLAUS_DIAG" VALUE 0x70c76 a_86 100 LINEAR______0_000000__0H___190_5 0.0 190.5 BIT_MASK 0xffffffff /end CHARACTERISTIC
/begin CHARACTERISTIC c_tco_fac_ron_max "C_TCO_FAC_RON_MAX" VALUE 0x70c77 a_86 15 LINEAR_______48_000000__0H___142 -48.0 142.5 BIT_MASK 0xffffffff /end CHARACTERISTIC
/begin CHARACTERISTIC c_tco_fac_ron_min "C_TCO_FAC_RON_MIN" VALUE 0x70c78 a_86 15 LINEAR_______48_000000__0H___142 -48.0 142.5 BIT_MASK 0xffffffff /end CHARACTERISTIC
/begin CHARACTERISTIC c_tco_grd_max "C_TCO_GRD_MAX" VALUE 0x70c79 a_86 15 LINEAR______0_000000__0H___19166 0.0 190.5 BIT_MASK 0xffffffff /end CHARACTERISTIC
/begin CHARACTERISTIC c_tco_grd_max_diag "C_TCO_GRD_MAX_DIAG" VALUE 0x70c7a a_86 20 LINEAR______0_000000__0H___19166 0.0 190.5 BIT_MASK 0xffffffff /end CHARACTERISTIC
/begin CHARACTERISTIC c_tco_grd_max_mon "C_TCO_GRD_MAX_MON" VALUE 0x71278 a_86 100 LINEAR______0_000000__0H___190_5 0.0 190.5 BIT_MASK 0xffffffff /end CHARACTERISTIC
/begin CHARACTERISTIC c_tco_hys_cat "C_TCO_HYS_CAT" VALUE 0x70c7b a_86 1 LINEAR______0_000000__0H___60_00 0.0 60.0 BIT_MASK 0xffffffff /end CHARACTERISTIC
/begin CHARACTERISTIC c_tco_lsh "C_TCO_LSH" VALUE 0x70c7c a_86 100 LINEAR_______48_000000__0H___142 -48.0 142.5 BIT_MASK 0xffffffff FUNCTION_LIST DPM /end CHARACTERISTIC
/begin CHARACTERISTIC c_tco_max_accin "C_TCO_MAX_ACCIN" VALUE 0x70c7d a_86 100 LINEAR_______48_000000__0H___142 -48.0 142.5 BIT_MASK 0xffffffff /end CHARACTERISTIC
/begin CHARACTERISTIC c_tco_max_accin_hys "C_TCO_MAX_ACCIN_HYS" VALUE 0x70c7e a_86 100 LINEAR______0_000000__0H___60_00 0.0 60.0 BIT_MASK 0xffffffff /end CHARACTERISTIC
/begin CHARACTERISTIC c_tco_max_diag "C_TCO_MAX_DIAG" VALUE 0x70c7f a_86 15 LINEAR_______48_000000__0H___142 -48.0 142.5 BIT_MASK 0xffffffff /end CHARACTERISTIC
/begin CHARACTERISTIC c_tco_max_diag_sa "C_TCO_MAX_DIAG_SA" VALUE 0x70c80 a_86 10 LINEAR_______48_000000__0H___142 -48.0 142.5 BIT_MASK 0xffffffff /end CHARACTERISTIC
/begin CHARACTERISTIC c_tco_max_ign_mpl_is "C_TCO_MAX_IGN_MPL_IS" VALUE 0x70c81 a_86 100 LINEAR_______48_000000__0H___142 -48.0 142.5 BIT_MASK 0xffffffff /end CHARACTERISTIC
/begin CHARACTERISTIC c_tco_max_ign_mpl_st "C_TCO_MAX_IGN_MPL_ST" VALUE 0x70c82 a_86 100 LINEAR_______48_000000__0H___142 -48.0 142.5 BIT_MASK 0xffffffff /end CHARACTERISTIC
/begin CHARACTERISTIC c_tco_max_toil_diag "C_TCO_MAX_TOIL_DIAG" VALUE 0x70c83 a_86 15 LINEAR_______48_000000__0H___155 -48.0 155.0 BIT_MASK 0xffffffff /end CHARACTERISTIC
/begin CHARACTERISTIC c_tco_max_tps_ad "C_TCO_MAX_TPS_AD" VALUE 0x70c84 a_86 100 LINEAR_______48_000000__0H___142 -48.0 142.5 BIT_MASK 0xffffffff /end CHARACTERISTIC
/begin CHARACTERISTIC c_tco_min_aj "C_TCO_MIN_AJ" VALUE 0x70c85 a_86 100 LINEAR_______48_000000__0H___142 -48.0 142.5 BIT_MASK 0xffffffff /end CHARACTERISTIC
/begin CHARACTERISTIC c_tco_min_cat "C_TCO_MIN_CAT" VALUE 0x70c86 a_86 100 LINEAR_______48_000000__0H___142 -48.0 142.5 BIT_MASK 0xffffffff /end CHARACTERISTIC
/begin CHARACTERISTIC c_tco_min_ch_3 "C_TCO_MIN_CH_3" VALUE 0x70c87 a_86 100 LINEAR_______48_000000__0H___142 -48.0 142.5 BIT_MASK 0xffffffff /end CHARACTERISTIC
/begin CHARACTERISTIC c_tco_min_ch_3_cat_var "C_TCO_MIN_CH_3_CAT_VAR" VALUE 0x70c88 a_86 100 LINEAR_______48_000000__0H___142 -48.0 142.5 BIT_MASK 0xffffffff /end CHARACTERISTIC
/begin CHARACTERISTIC c_tco_min_cp "C_TCO_MIN_CP" VALUE 0x70c89 a_86 15 LINEAR_______48_000000__0H___142 -48.0 142.5 BIT_MASK 0xffffffff /end CHARACTERISTIC
/begin CHARACTERISTIC c_tco_min_diag "C_TCO_MIN_DIAG" VALUE 0x70c8a a_86 15 LINEAR_______48_000000__0H___142 -48.0 142.5 BIT_MASK 0xffffffff /end CHARACTERISTIC
/begin CHARACTERISTIC c_tco_min_diagcps "C_TCO_MIN_DIAGCPS" VALUE 0x70c8b a_86 15 LINEAR_______48_000000__0H___142 -48.0 142.5 BIT_MASK 0xffffffff /end CHARACTERISTIC
/begin CHARACTERISTIC c_tco_min_ect "C_TCO_MIN_ECT" VALUE 0x70c8c a_86 25 LINEAR_______48_000000__0H___142 -48.0 142.5 BIT_MASK 0xffffffff /end CHARACTERISTIC
/begin CHARACTERISTIC c_tco_min_fl "C_TCO_MIN_FL" VALUE 0x70c8d a_86 15 LINEAR_______48_000000__0H___142 -48.0 142.5 BIT_MASK 0xffffffff /end CHARACTERISTIC
/begin CHARACTERISTIC c_tco_min_fsd_pu "C_TCO_MIN_FSD_PU" VALUE 0x70c8e a_86 100 LINEAR_______48_000000__0H___142 -48.0 142.5 BIT_MASK 0xffffffff /end CHARACTERISTIC
/begin CHARACTERISTIC c_tco_min_iga_cor_cam_dif "C_TCO_MIN_IGA_COR_CAM_DIF" VALUE 0x70c8f a_86 100 LINEAR_______48_000000__0H___142 -48.0 142.5 BIT_MASK 0xffffffff /end CHARACTERISTIC
/begin CHARACTERISTIC c_tco_min_igcfb "C_TCO_MIN_IGCFB" VALUE 0x70c90 a_86 15 LINEAR_______48_000000__0H___142 -48.0 142.5 BIT_MASK 0xffffffff /end CHARACTERISTIC
/begin CHARACTERISTIC c_tco_min_ign_mpl_is "C_TCO_MIN_IGN_MPL_IS" VALUE 0x70c91 a_86 100 LINEAR_______48_000000__0H___142 -48.0 142.5 BIT_MASK 0xffffffff /end CHARACTERISTIC
/begin CHARACTERISTIC c_tco_min_ign_mpl_st "C_TCO_MIN_IGN_MPL_ST" VALUE 0x70c92 a_86 100 LINEAR_______48_000000__0H___142 -48.0 142.5 BIT_MASK 0xffffffff /end CHARACTERISTIC
/begin CHARACTERISTIC c_tco_min_n_sp_add_sif "C_TCO_MIN_N_SP_ADD_SIF" VALUE 0x70c93 a_86 100 LINEAR_______48_000000__0H___142 -48.0 142.5 BIT_MASK 0xffffffff /end CHARACTERISTIC
/begin CHARACTERISTIC c_tco_min_pu "C_TCO_MIN_PU" VALUE 0x70c94 a_86 15 LINEAR_______48_000000__0H___142 -48.0 142.5 BIT_MASK 0xffffffff /end CHARACTERISTIC
/begin CHARACTERISTIC c_tco_min_puc_st "C_TCO_MIN_PUC_ST" VALUE 0x70c95 a_86 15 LINEAR_______48_000000__0H___142 -48.0 142.5 BIT_MASK 0xffffffff /end CHARACTERISTIC
/begin CHARACTERISTIC c_tco_min_slow_pu "C_TCO_MIN_SLOW_PU" VALUE 0x70c96 a_86 15 LINEAR_______48_000000__0H___142 -48.0 142.5 BIT_MASK 0xffffffff /end CHARACTERISTIC
/begin CHARACTERISTIC c_tco_min_ti_amt "C_TCO_MIN_TI_AMT" VALUE 0x70c97 a_86 100 LINEAR_______48_000000__0H___142 -48.0 142.5 BIT_MASK 0xffffffff FUNCTION_LIST Z1S1 /end CHARACTERISTIC
/begin CHARACTERISTIC c_tco_min_ti_asr "C_TCO_MIN_TI_ASR" VALUE 0x70c98 a_86 100 LINEAR_______48_000000__0H___142 -48.0 142.5 BIT_MASK 0xffffffff /end CHARACTERISTIC
/begin CHARACTERISTIC c_tco_min_tps_ad "C_TCO_MIN_TPS_AD" VALUE 0x70c99 a_86 100 LINEAR_______48_000000__0H___142 -48.0 142.5 BIT_MASK 0xffffffff /end CHARACTERISTIC
/begin CHARACTERISTIC c_tco_min_vim "C_TCO_MIN_VIM" VALUE 0x70c9a a_86 100 LINEAR_______48_000000__0H___142 -48.0 142.5 BIT_MASK 0xffffffff /end CHARACTERISTIC
/begin CHARACTERISTIC c_tco_min_vls_eol "C_TCO_MIN_VLS_EOL" VALUE 0x70c9b a_86 100 LINEAR_______48_000000__0H___142 -48.0 142.5 BIT_MASK 0xffffffff /end CHARACTERISTIC
/begin CHARACTERISTIC c_tco_n_sp_add_heat "C_TCO_N_SP_ADD_HEAT" VALUE 0x70c9c a_86 100 LINEAR_______48_000000__0H___142 -48.0 142.5 BIT_MASK 0xffffffff /end CHARACTERISTIC
/begin CHARACTERISTIC c_tco_n_sp_add_heat_hys "C_TCO_N_SP_ADD_HEAT_HYS" VALUE 0x70c9d a_86 100 LINEAR______0_000000__0H___60167 0.0 60.0 BIT_MASK 0xffffffff /end CHARACTERISTIC
/begin CHARACTERISTIC c_tco_sp_tco_ex_max "C_TCO_SP_TCO_EX_MAX" VALUE 0x70c9e a_86 15 LINEAR_______48_000000__0H___142 -48.0 142.5 BIT_MASK 0xffffffff /end CHARACTERISTIC
/begin CHARACTERISTIC c_tco_sp_tia_max "C_TCO_SP_TIA_MAX" VALUE 0x70c9f a_86 15 LINEAR_______48_000000__0H___142 -48.0 142.5 BIT_MASK 0xffffffff /end CHARACTERISTIC
/begin CHARACTERISTIC c_tco_sp_toil_min "C_TCO_SP_TOIL_MIN" VALUE 0x70ca0 a_86 15 LINEAR_______48_000000__0H___142 -48.0 142.5 BIT_MASK 0xffffffff /end CHARACTERISTIC
/begin CHARACTERISTIC c_tco_st "C_TCO_ST" VALUE 0x70ca1 a_86 15 LINEAR_______48_000000__0H___142 -48.0 142.5 BIT_MASK 0xffffffff FUNCTION_LIST ETM /end CHARACTERISTIC
/begin CHARACTERISTIC c_tco_st_dmtl_min "C_TCO_ST_DMTL_MIN" VALUE 0x70ca2 a_86 100 LINEAR_______48_000000__0H___142 -48.0 142.5 BIT_MASK 0xffffffff FUNCTION_LIST DMTL /end CHARACTERISTIC
/begin CHARACTERISTIC c_tco_st_ect_plaus_diag "C_TCO_ST_ECT_PLAUS_DIAG" VALUE 0x70ca3 a_86 15 LINEAR_______48_000000__0H___142 -48.0 142.5 BIT_MASK 0xffffffff /end CHARACTERISTIC
/begin CHARACTERISTIC c_tco_st_min_ron "C_TCO_ST_MIN_RON" VALUE 0x70ca4 a_86 100 LINEAR_______48_000000__0H___142 -48.0 142.5 BIT_MASK 0xffffffff /end CHARACTERISTIC
/begin CHARACTERISTIC c_tco_stop_plaus_max "C_TCO_STOP_PLAUS_MAX" VALUE 0x70ca5 a_86 15 LINEAR_______48_000000__0H___142 -48.0 142.5 BIT_MASK 0xffffffff /end CHARACTERISTIC
/begin CHARACTERISTIC c_tco_sub_bol_1 "C_TCO_SUB_BOL_1" VALUE 0x70ca6 a_86 15 LINEAR_______48_000000__0H___142 -48.0 142.5 BIT_MASK 0xffffffff /end CHARACTERISTIC
/begin CHARACTERISTIC c_tco_sub_bol_2 "C_TCO_SUB_BOL_2" VALUE 0x70ca7 a_86 15 LINEAR_______48_000000__0H___142 -48.0 142.5 BIT_MASK 0xffffffff /end CHARACTERISTIC
/begin CHARACTERISTIC c_tco_sub_thd_max_mon "C_TCO_SUB_THD_MAX_MON" VALUE 0x71279 a_86 100 LINEAR_______48_000000__0H___142 -48.0 142.5 BIT_MASK 0xffffffff /end CHARACTERISTIC
/begin CHARACTERISTIC c_tco_sub_tol "C_TCO_SUB_TOL" VALUE 0x70ca8 a_86 15 LINEAR_______48_000000__0H___142 -48.0 142.5 BIT_MASK 0xffffffff /end CHARACTERISTIC
/begin CHARACTERISTIC c_tco_swi_wup "C_TCO_SWI_WUP" VALUE 0x70ca9 a_86 100 LINEAR_______48_000000__0H___142 -48.0 142.5 BIT_MASK 0xffffffff /end CHARACTERISTIC
/begin CHARACTERISTIC c_tco_tco_ex_plaus_diag "C_TCO_TCO_EX_PLAUS_DIAG" VALUE 0x70caa a_86 15 LINEAR______0_000000__0H___190_5 0.0 190.5 BIT_MASK 0xffffffff /end CHARACTERISTIC
/begin CHARACTERISTIC c_tco_tco_ex_plaus_diag_min "C_TCO_TCO_EX_PLAUS_DIAG_MIN" VALUE 0x70cab a_86 100 LINEAR_______48_000000__0H___142 -48.0 142.5 BIT_MASK 0xffffffff /end CHARACTERISTIC
/begin CHARACTERISTIC c_tco_thd_min_mon "C_TCO_THD_MIN_MON" VALUE 0x7127a a_86 100 LINEAR_______48_000000__0H___142 -48.0 142.5 BIT_MASK 0xffffffff /end CHARACTERISTIC
/begin CHARACTERISTIC c_tco_ti_ad_min "C_TCO_TI_AD_MIN" VALUE 0x70cac a_86 15 LINEAR_______48_000000__0H___142 -48.0 142.5 BIT_MASK 0xffffffff /end CHARACTERISTIC
/begin CHARACTERISTIC c_tco_tipr_syn "C_TCO_TIPR_SYN" VALUE 0x70cad a_86 15 LINEAR_______48_000000__0H___142 -48.0 142.5 BIT_MASK 0xffffffff /end CHARACTERISTIC
/begin CHARACTERISTIC c_tco_tmot_sta "C_TCO_TMOT_STA" VALUE 0x70cae a_86 100 LINEAR_______48_000000__0H___142 -48.0 142.5 BIT_MASK 0xffffffff /end CHARACTERISTIC
/begin CHARACTERISTIC c_tco_vls_down_diag_min "C_TCO_VLS_DOWN_DIAG_MIN" VALUE 0x70caf a_86 100 LINEAR_______48_000000__0H___142 -48.0 142.5 BIT_MASK 0xffffffff /end CHARACTERISTIC
/begin CHARACTERISTIC c_teg_down_mdl_cor_bk1 "C_TEG_DOWN_MDL_COR_BK1" VALUE 0x708d4 a_85 100 LINEAR______0_000000__0H___1_999 0.0 1.99997 BIT_MASK 0xffffffff /end CHARACTERISTIC
/begin CHARACTERISTIC c_teg_down_mdl_cor_bk2 "C_TEG_DOWN_MDL_COR_BK2" VALUE 0x708d6 a_85 100 LINEAR______0_000000__0H___1_999 0.0 1.99997 BIT_MASK 0xffffffff /end CHARACTERISTIC
/begin CHARACTERISTIC c_teg_down_mes_thd "C_TEG_DOWN_MES_THD" VALUE 0x708d8 a_85 100 LINEAR______0_000000__0H___10253 0.0 1023.9844 BIT_MASK 0xffffffff /end CHARACTERISTIC
/begin CHARACTERISTIC c_teg_mes_grd_max "C_TEG_MES_GRD_MAX" VALUE 0x708da a_85 100 LINEAR______0_000000__0H___10253 0.0 1023.9844 BIT_MASK 0xffffffff /end CHARACTERISTIC
/begin CHARACTERISTIC c_temp_cur_on_down_ls_max "C_TEMP_CUR_ON_DOWN_LS_MAX" VALUE 0x708dc a_85 100 LINEAR_______33_000000__0H___989 -33.0 989.9844 BIT_MASK 0xffffffff /end CHARACTERISTIC
/begin CHARACTERISTIC c_temp_cur_on_down_ls_min "C_TEMP_CUR_ON_DOWN_LS_MIN" VALUE 0x708de a_85 100 LINEAR_______33_000000__0H___989 -33.0 989.9844 BIT_MASK 0xffffffff /end CHARACTERISTIC
/begin CHARACTERISTIC c_temp_cur_on_up_ls_max "C_TEMP_CUR_ON_UP_LS_MAX" VALUE 0x708e0 a_85 100 LINEAR_______33_000000__0H___989 -33.0 989.9844 BIT_MASK 0xffffffff /end CHARACTERISTIC
/begin CHARACTERISTIC c_temp_cur_on_up_ls_min "C_TEMP_CUR_ON_UP_LS_MIN" VALUE 0x708e2 a_85 100 LINEAR_______33_000000__0H___989 -33.0 989.9844 BIT_MASK 0xffffffff /end CHARACTERISTIC
/begin CHARACTERISTIC c_temp_hys_sub_cat "C_TEMP_HYS_SUB_CAT" VALUE 0x70cb0 a_86 100 LINEAR______0_000000__0H___1020_ 0.0 1020.0 BIT_MASK 0xffffffff /end CHARACTERISTIC
/begin CHARACTERISTIC c_temp_max_sub_cat "C_TEMP_MAX_SUB_CAT" VALUE 0x70cb1 a_86 100 LINEAR_______33_000000__0H___987 -33.0 987.0 BIT_MASK 0xffffffff /end CHARACTERISTIC
/begin CHARACTERISTIC c_temp_min_cat_dly "C_TEMP_MIN_CAT_DLY" VALUE 0x70cb2 a_86 100 LINEAR_______33_000000__0H___987 -33.0 987.0 BIT_MASK 0xffffffff /end CHARACTERISTIC
/begin CHARACTERISTIC c_temp_min_mmv_sub_cat_eol "C_TEMP_MIN_MMV_SUB_CAT_EOL" VALUE 0x708e4 a_85 100 LINEAR_______33_000000__0H___991 -33.0 991.0 BIT_MASK 0xffffffff /end CHARACTERISTIC
/begin CHARACTERISTIC c_temp_min_sub_cat "C_TEMP_MIN_SUB_CAT" VALUE 0x70cb3 a_86 100 LINEAR_______33_000000__0H___987 -33.0 987.0 BIT_MASK 0xffffffff /end CHARACTERISTIC
/begin CHARACTERISTIC c_temp_min_sub_down_diag "C_TEMP_MIN_SUB_DOWN_DIAG" VALUE 0x70cb4 a_86 100 LINEAR_______33_000000__0H___987 -33.0 987.0 BIT_MASK 0xffffffff /end CHARACTERISTIC
/begin CHARACTERISTIC c_temp_wall_red "C_TEMP_WALL_RED" VALUE 0x708e6 a_85 100 LINEAR_______33_000000__0H___989 -33.0 989.9844 BIT_MASK 0xffffffff FUNCTION_LIST DPM /end CHARACTERISTIC
/begin CHARACTERISTIC c_temp_wall_red_hys "C_TEMP_WALL_RED_HYS" VALUE 0x708e8 a_85 100 LINEAR_______33_000000__0H___989 -33.0 989.9844 BIT_MASK 0xffffffff FUNCTION_LIST DPM /end CHARACTERISTIC
/begin CHARACTERISTIC c_temp_wall_st "C_TEMP_WALL_ST" VALUE 0x708ea a_85 15 LINEAR_______33_000000__0H___989 -33.0 989.9844 BIT_MASK 0xffffffff FUNCTION_LIST DPM /end CHARACTERISTIC
/begin CHARACTERISTIC c_tgas_l_grd_max_diag "C_TGAS_L_GRD_MAX_DIAG" VALUE 0x70cb5 a_86 100 LINEAR______0_000000__0H___191_2 0.0 191.25 BIT_MASK 0xffffffff FUNCTION_LIST CNG /end CHARACTERISTIC
/begin CHARACTERISTIC c_tgas_pcd_grd_max_diag "C_TGAS_PCD_GRD_MAX_DIAG" VALUE 0x70cb6 a_86 100 LINEAR______0_000000__0H___191_2 0.0 191.25 BIT_MASK 0xffffffff FUNCTION_LIST CNG /end CHARACTERISTIC
/begin CHARACTERISTIC c_tgas_pcd_on "C_TGAS_PCD_ON" VALUE 0x70cb7 a_86 100 LINEAR_______48_000000__0H___143 -48.0 143.25 BIT_MASK 0xffffffff FUNCTION_LIST CNG /end CHARACTERISTIC
/begin CHARACTERISTIC c_thd_cur_dmtl_dif_fuc "C_THD_CUR_DMTL_DIF_FUC" VALUE 0x70df8 a_95 100 LINEAR_______200_000000__FFFF168 -200.0 199.9938 BIT_MASK 0xffffffff FUNCTION_LIST DMTL /end CHARACTERISTIC
/begin CHARACTERISTIC c_thd_cur_dmtl_dif_mes "C_THD_CUR_DMTL_DIF_MES" VALUE 0x708ec a_85 100 LINEAR______0_000000__0H___400_0 0.0 400.0 BIT_MASK 0xffffffff FUNCTION_LIST DMTL /end CHARACTERISTIC
/begin CHARACTERISTIC c_thd_cur_dmtl_dif_refu "C_THD_CUR_DMTL_DIF_REFU" VALUE 0x70dfa a_95 100 LINEAR_______200_000000__FFFF168 -200.0 199.9938 BIT_MASK 0xffffffff FUNCTION_LIST DMTL /end CHARACTERISTIC
/begin CHARACTERISTIC c_thr_is "C_THR_IS" VALUE 0x708ee a_85 5 LINEAR______0_000000__0H___119_9 0.0 119.99817 BIT_MASK 0xffffffff /end CHARACTERISTIC
/begin CHARACTERISTIC c_thr_is_hys "C_THR_IS_HYS" VALUE 0x708f0 a_85 5 LINEAR______0_000000__0H___119_9 0.0 119.99817 BIT_MASK 0xffffffff /end CHARACTERISTIC
/begin CHARACTERISTIC c_thr_min_maf_diag "C_THR_MIN_MAF_DIAG" VALUE 0x70cb8 a_86 30 LINEAR______0_000000__0H___11913 0.0 119.5 BIT_MASK 0xffffffff /end CHARACTERISTIC
/begin CHARACTERISTIC c_ti_ad_add_max "C_TI_AD_ADD_MAX" VALUE 0x708f2 a_85 20 LINEAR______0_000000__8000H___5_ 0.0 5.0 BIT_MASK 0xffffffff /end CHARACTERISTIC
/begin CHARACTERISTIC c_ti_ad_add_min "C_TI_AD_ADD_MIN" VALUE 0x708f4 a_85 20 LINEAR_______5_000000__7B1EH___0 -5.0 0.0 BIT_MASK 0xffffffff /end CHARACTERISTIC
/begin CHARACTERISTIC c_ti_ad_add_mmv_dif "C_TI_AD_ADD_MMV_DIF" VALUE 0x708f6 a_85 100 LINEAR______0_000000__0H___13_33 0.0 13.333333 BIT_MASK 0xffffffff /end CHARACTERISTIC
/begin CHARACTERISTIC c_ti_ad_cor_crlc "C_TI_AD_COR_CRLC" VALUE 0x70cb9 a_86 10 LINEAR______0_000000__0H___0_996 0.0 0.99609375 BIT_MASK 0xffffffff /end CHARACTERISTIC
/begin CHARACTERISTIC c_ti_ad_cor_crlc_cp "C_TI_AD_COR_CRLC_CP" VALUE 0x70cba a_86 10 LINEAR______0_000000__0H___0_996 0.0 0.99609375 BIT_MASK 0xffffffff /end CHARACTERISTIC
/begin CHARACTERISTIC c_ti_ad_cor_crlc_is "C_TI_AD_COR_CRLC_IS" VALUE 0x70cbb a_86 10 LINEAR______0_000000__0H___0_996 0.0 0.99609375 BIT_MASK 0xffffffff /end CHARACTERISTIC
/begin CHARACTERISTIC c_ti_ad_fac_fsd_ld "C_TI_AD_FAC_FSD_LD" VALUE 0x708f8 a_85 100 LINEAR_______31_250000__3000H115 -31.25 0.0 BIT_MASK 0xffffffff /end CHARACTERISTIC
/begin CHARACTERISTIC c_ti_ad_fac_max "C_TI_AD_FAC_MAX" VALUE 0x708fa a_85 10 LINEAR______0_000000__8000H___31 0.0 31.25 BIT_MASK 0xffffffff /end CHARACTERISTIC
/begin CHARACTERISTIC c_ti_ad_fac_min "C_TI_AD_FAC_MIN" VALUE 0x708fc a_85 10 LINEAR_______31_250000__3000H115 -31.25 0.0 BIT_MASK 0xffffffff /end CHARACTERISTIC
/begin CHARACTERISTIC c_ti_ad_fac_mmv_dif "C_TI_AD_FAC_MMV_DIF" VALUE 0x708fe a_85 100 LINEAR______0_000000__0H___10169 0.0 10.0 BIT_MASK 0xffffffff /end CHARACTERISTIC
/begin CHARACTERISTIC c_ti_ad_max_cyl_lam "C_TI_AD_MAX_CYL_LAM" VALUE 0x70900 a_85 10 LINEAR_______50_000000__0H___440 -50.0 49.998471 BIT_MASK 0xffffffff FUNCTION_LIST CSCM /end CHARACTERISTIC
/begin CHARACTERISTIC c_ti_ad_min_cyl_lam "C_TI_AD_MIN_CYL_LAM" VALUE 0x70902 a_85 10 LINEAR_______50_000000__0H___440 -50.0 49.998471 BIT_MASK 0xffffffff FUNCTION_LIST CSCM /end CHARACTERISTIC
/begin CHARACTERISTIC c_ti_add_wf_max_sa_diag "C_TI_ADD_WF_MAX_SA_DIAG" VALUE 0x70904 a_85 100 LINEAR______0_000000__0H___174_7 0.0 174.75733 BIT_MASK 0xffffffff /end CHARACTERISTIC
/begin CHARACTERISTIC c_ti_add_wf_min_sa_diag "C_TI_ADD_WF_MIN_SA_DIAG" VALUE 0x70dfc a_95 100 LINEAR_______174_762666__FFFF800 -174.76267 0.0 BIT_MASK 0xffffffff /end CHARACTERISTIC
/begin CHARACTERISTIC c_ti_add_wf_tra "C_TI_ADD_WF_TRA" VALUE 0x70906 a_85 100 LINEAR______0_000000__0H___174_7 0.0 174.75733 BIT_MASK 0xffffffff /end CHARACTERISTIC
/begin CHARACTERISTIC c_ti_cor_cop "C_TI_COR_COP" VALUE 0x70908 a_85 10 LINEAR______0_000000__0H___1_016 0.0 1.0 BIT_MASK 0xffffffff /end CHARACTERISTIC
/begin CHARACTERISTIC c_ti_cor_eol "C_TI_COR_EOL" VALUE 0x7090a a_85 25 LINEAR______0_000000__0H___2_984 0.0 2.9844 BIT_MASK 0xffffffff /end CHARACTERISTIC
/begin CHARACTERISTIC c_ti_cor_vs_max "C_TI_COR_VS_MAX" VALUE 0x7090c a_85 10 LINEAR______0_000000__0H___1_016 0.0 1.0 BIT_MASK 0xffffffff /end CHARACTERISTIC
/begin CHARACTERISTIC c_ti_cr_fast_wf_is "C_TI_CR_FAST_WF_IS" VALUE 0x70cbc a_86 100 LINEAR______0_000000__0H___0_170 0.0 0.49805 BIT_MASK 0xffffffff /end CHARACTERISTIC
/begin CHARACTERISTIC c_ti_cr_neg_slow_wf "C_TI_CR_NEG_SLOW_WF" VALUE 0x70cbd a_86 100 LINEAR______0_000000__0H___0_171 0.0 0.1245 BIT_MASK 0xffffffff /end CHARACTERISTIC
/begin CHARACTERISTIC c_ti_cr_slow_wf "C_TI_CR_SLOW_WF" VALUE 0x70cbe a_86 100 LINEAR______0_000000__0H___0_171 0.0 0.1245 BIT_MASK 0xffffffff /end CHARACTERISTIC
/begin CHARACTERISTIC c_ti_dec_cop "C_TI_DEC_COP" VALUE 0x70cbf a_86 10 LINEAR______0_000000__0H___0_500 0.0 0.5 BIT_MASK 0xffffffff /end CHARACTERISTIC
/begin CHARACTERISTIC c_ti_fac_vls_afl_eol "C_TI_FAC_VLS_AFL_EOL" VALUE 0x7090e a_85 10 LINEAR_______50_000000__0H___440 -50.0 49.998471 BIT_MASK 0xffffffff /end CHARACTERISTIC
/begin CHARACTERISTIC c_ti_fac_vls_afr_eol "C_TI_FAC_VLS_AFR_EOL" VALUE 0x70910 a_85 10 LINEAR_______50_000000__0H___440 -50.0 49.998471 BIT_MASK 0xffffffff /end CHARACTERISTIC
/begin CHARACTERISTIC c_ti_lgrd_ch_wup "C_TI_LGRD_CH_WUP" VALUE 0x70cc0 a_86 100 LINEAR______0_000488__1H___0_172 0.000488 0.12451 BIT_MASK 0xffffffff /end CHARACTERISTIC
/begin CHARACTERISTIC c_ti_lgrd_cop_step_2 "C_TI_LGRD_COP_STEP_2" VALUE 0x70cc1 a_86 100 LINEAR______0_003906__0H___0_996 0.00390625 0.9961 BIT_MASK 0xffffffff /end CHARACTERISTIC
/begin CHARACTERISTIC c_ti_max_cyl_lam "C_TI_MAX_CYL_LAM" VALUE 0x70912 a_85 10 LINEAR_______50_000000__0H___440 -50.0 49.998471 BIT_MASK 0xffffffff FUNCTION_LIST CSCM /end CHARACTERISTIC
/begin CHARACTERISTIC c_ti_min_cop "C_TI_MIN_COP" VALUE 0x70cc2 a_86 100 LINEAR______0_003906__1H___0_996 0.00390625 0.99609375 BIT_MASK 0xffffffff /end CHARACTERISTIC
/begin CHARACTERISTIC c_ti_min_cyl_lam "C_TI_MIN_CYL_LAM" VALUE 0x70914 a_85 10 LINEAR_______50_000000__0H___440 -50.0 49.998471 BIT_MASK 0xffffffff FUNCTION_LIST CSCM /end CHARACTERISTIC
/begin CHARACTERISTIC c_ti_min_iv "C_TI_MIN_IV" VALUE 0x70916 a_85 10 LINEAR______0_000000__0H___349_5 0.0 349.52 BIT_MASK 0xffffffff /end CHARACTERISTIC
/begin CHARACTERISTIC c_ti_vls_down_afl_diag "C_TI_VLS_DOWN_AFL_DIAG" VALUE 0x70cc3 a_86 100 LINEAR______0_000000__0H___1_992 0.0 1.9921875 BIT_MASK 0xffffffff /end CHARACTERISTIC
/begin CHARACTERISTIC c_ti_vls_down_afr_diag "C_TI_VLS_DOWN_AFR_DIAG" VALUE 0x70cc4 a_86 100 LINEAR______0_000000__0H___1_992 0.0 1.9921875 BIT_MASK 0xffffffff /end CHARACTERISTIC
/begin CHARACTERISTIC c_tia_diag "C_TIA_DIAG" VALUE 0x70cc5 a_86 15 LINEAR_______48_000000__0H___142 -48.0 142.5 BIT_MASK 0xffffffff /end CHARACTERISTIC
/begin CHARACTERISTIC c_tia_grd_max_diag "C_TIA_GRD_MAX_DIAG" VALUE 0x70cc6 a_86 20 LINEAR______0_000000__0H___19166 0.0 190.5 BIT_MASK 0xffffffff /end CHARACTERISTIC
/begin CHARACTERISTIC c_tia_hys_ect "C_TIA_HYS_ECT" VALUE 0x70cc7 a_86 15 LINEAR______0_000000__0H___190_5 0.0 190.5 BIT_MASK 0xffffffff /end CHARACTERISTIC
/begin CHARACTERISTIC c_tia_max_diag "C_TIA_MAX_DIAG" VALUE 0x70cc8 a_86 15 LINEAR_______48_000000__0H___142 -48.0 142.5 BIT_MASK 0xffffffff /end CHARACTERISTIC
/begin CHARACTERISTIC c_tia_max_ect "C_TIA_MAX_ECT" VALUE 0x70cc9 a_86 15 LINEAR_______48_000000__0H___142 -48.0 142.5 BIT_MASK 0xffffffff /end CHARACTERISTIC
/begin CHARACTERISTIC c_tia_min_diag "C_TIA_MIN_DIAG" VALUE 0x70cca a_86 15 LINEAR_______48_000000__0H___142 -48.0 142.5 BIT_MASK 0xffffffff /end CHARACTERISTIC
/begin CHARACTERISTIC c_tia_min_ect "C_TIA_MIN_ECT" VALUE 0x70ccb a_86 100 LINEAR_______48_000000__0H___142 -48.0 142.5 BIT_MASK 0xffffffff /end CHARACTERISTIC
/begin CHARACTERISTIC c_tia_min_hys_ect "C_TIA_MIN_HYS_ECT" VALUE 0x70ccc a_86 100 LINEAR______0_000000__0H___190_5 0.0 190.5 BIT_MASK 0xffffffff /end CHARACTERISTIC
/begin CHARACTERISTIC c_tia_min_tps_ad "C_TIA_MIN_TPS_AD" VALUE 0x70ccd a_86 100 LINEAR_______48_000000__0H___142 -48.0 142.5 BIT_MASK 0xffffffff /end CHARACTERISTIC
/begin CHARACTERISTIC c_tia_n_sp_add_heat "C_TIA_N_SP_ADD_HEAT" VALUE 0x70cce a_86 100 LINEAR_______48_000000__0H___142 -48.0 142.5 BIT_MASK 0xffffffff /end CHARACTERISTIC
/begin CHARACTERISTIC c_tia_n_sp_add_heat_hys "C_TIA_N_SP_ADD_HEAT_HYS" VALUE 0x70ccf a_86 100 LINEAR______0_000000__0H___60_00 0.0 60.0 BIT_MASK 0xffffffff /end CHARACTERISTIC
/begin CHARACTERISTIC c_tia_sub_bol "C_TIA_SUB_BOL" VALUE 0x70cd0 a_86 15 LINEAR_______48_000000__0H___142 -48.0 142.5 BIT_MASK 0xffffffff /end CHARACTERISTIC
/begin CHARACTERISTIC c_tia_sub_tol "C_TIA_SUB_TOL" VALUE 0x70cd1 a_86 15 LINEAR_______48_000000__0H___142 -48.0 142.5 BIT_MASK 0xffffffff /end CHARACTERISTIC
/begin CHARACTERISTIC c_tia_tco_diag "C_TIA_TCO_DIAG" VALUE 0x70cd2 a_86 15 LINEAR_______48_000000__0H___142 -48.0 142.5 BIT_MASK 0xffffffff /end CHARACTERISTIC
/begin CHARACTERISTIC c_tia_tco_ex_diag "C_TIA_TCO_EX_DIAG" VALUE 0x70918 a_85 10 LINEAR______0_100000__1H___65149 0.1 6553.5 BIT_MASK 0xffffffff /end CHARACTERISTIC
/begin CHARACTERISTIC c_tia_ti_ad_max "C_TIA_TI_AD_MAX" VALUE 0x70cd3 a_86 15 LINEAR_______48_000000__0H___142 -48.0 142.5 BIT_MASK 0xffffffff /end CHARACTERISTIC
/begin CHARACTERISTIC c_tmc_fac_bk1_1 "C_TMC_FAC_BK1_1" VALUE 0x70dfe a_95 100 LINEAR_______1_000000__FFFF8000H -1.0 1.0 BIT_MASK 0xffffffff /end CHARACTERISTIC
/begin CHARACTERISTIC c_tmc_fac_bk1_2 "C_TMC_FAC_BK1_2" VALUE 0x7091a a_85 100 LINEAR______0_000000__0H___1_173 0.0 1.0 BIT_MASK 0xffffffff /end CHARACTERISTIC
/begin CHARACTERISTIC c_tmc_fac_bk2_1 "C_TMC_FAC_BK2_1" VALUE 0x70e00 a_95 100 LINEAR_______1_000000__FFFF8000H -1.0 1.0 BIT_MASK 0xffffffff /end CHARACTERISTIC
/begin CHARACTERISTIC c_tmc_fac_bk2_2 "C_TMC_FAC_BK2_2" VALUE 0x7091c a_85 100 LINEAR______0_000000__0H___1_173 0.0 1.0 BIT_MASK 0xffffffff /end CHARACTERISTIC
/begin CHARACTERISTIC c_tmot_sum_hys "C_TMOT_SUM_HYS" VALUE 0x70cd4 a_86 100 LINEAR______0_000000__0H___190_5 0.0 190.5 BIT_MASK 0xffffffff /end CHARACTERISTIC
/begin CHARACTERISTIC c_toil_grd_max_diag "C_TOIL_GRD_MAX_DIAG" VALUE 0x70cd5 a_86 20 LINEAR______0_000000__0H___203_0 0.0 203.0 BIT_MASK 0xffffffff /end CHARACTERISTIC
/begin CHARACTERISTIC c_toil_hys_cat "C_TOIL_HYS_CAT" VALUE 0x70cd6 a_86 1 LINEAR______0_000000__0H___60_00 0.0 60.0 BIT_MASK 0xffffffff /end CHARACTERISTIC
/begin CHARACTERISTIC c_toil_hys_ivvt "C_TOIL_HYS_IVVT" VALUE 0x70cd7 a_86 100 LINEAR______0_000000__0H___20174 0.0 203.0 BIT_MASK 0xffffffff /end CHARACTERISTIC
/begin CHARACTERISTIC c_toil_hys_max "C_TOIL_HYS_MAX" VALUE 0x70cd8 a_86 15 LINEAR______0_000000__0H___101_5 0.0 101.5 BIT_MASK 0xffffffff /end CHARACTERISTIC
/begin CHARACTERISTIC c_toil_max "C_TOIL_MAX" VALUE 0x70cd9 a_86 15 LINEAR_______48_000000__0H___155 -48.0 155.0 BIT_MASK 0xffffffff /end CHARACTERISTIC
/begin CHARACTERISTIC c_toil_max_diag "C_TOIL_MAX_DIAG" VALUE 0x70cda a_86 15 LINEAR_______48_000000__0H___155 -48.0 155.0 BIT_MASK 0xffffffff /end CHARACTERISTIC
/begin CHARACTERISTIC c_toil_min_cyl_lam "C_TOIL_MIN_CYL_LAM" VALUE 0x70cdb a_86 15 LINEAR_______48_000000__0H___155 -48.0 155.0 BIT_MASK 0xffffffff /end CHARACTERISTIC
/begin CHARACTERISTIC c_toil_min_diag "C_TOIL_MIN_DIAG" VALUE 0x70cdc a_86 15 LINEAR_______48_000000__0H___155 -48.0 155.0 BIT_MASK 0xffffffff /end CHARACTERISTIC
/begin CHARACTERISTIC c_toil_min_ivvt_at "C_TOIL_MIN_IVVT_AT" VALUE 0x70cdd a_86 100 LINEAR_______48_000000__0H___155 -48.0 155.0 BIT_MASK 0xffffffff /end CHARACTERISTIC
/begin CHARACTERISTIC c_toil_min_ivvt_mt "C_TOIL_MIN_IVVT_MT" VALUE 0x70cde a_86 100 LINEAR_______48_000000__0H___155 -48.0 155.0 BIT_MASK 0xffffffff /end CHARACTERISTIC
/begin CHARACTERISTIC c_toil_sub_diag "C_TOIL_SUB_DIAG" VALUE 0x70cdf a_86 15 LINEAR_______48_000000__0H___155 -48.0 155.0 BIT_MASK 0xffffffff /end CHARACTERISTIC
/begin CHARACTERISTIC c_toil_temp_sub_ex_dif_min "C_TOIL_TEMP_SUB_EX_DIF_MIN" VALUE 0x70ce0 a_86 15 LINEAR_______48_000000__0H___155 -48.0 155.0 BIT_MASK 0xffffffff FUNCTION_LIST ETM /end CHARACTERISTIC
/begin CHARACTERISTIC c_toil_temp_sub_level_min "C_TOIL_TEMP_SUB_LEVEL_MIN" VALUE 0x70ce1 a_86 15 LINEAR_______48_000000__0H___155 -48.0 155.0 BIT_MASK 0xffffffff FUNCTION_LIST ETM /end CHARACTERISTIC
/begin CHARACTERISTIC c_tout_efp_crash "C_TOUT_EFP_CRASH" VALUE 0x70ce2 a_86 100 LINEAR______0_000000__0H___51000 0.0 51000.0 BIT_MASK 0xffffffff /end CHARACTERISTIC
/begin CHARACTERISTIC c_tout_imob "C_TOUT_IMOB" VALUE 0x70ce3 a_86 100 LINEAR______0_100000__1H___25_50 0.1 25.5 BIT_MASK 0xffffffff /end CHARACTERISTIC
/begin CHARACTERISTIC c_tps_ad_diag_ena "C_TPS_AD_DIAG_ENA" VALUE 0x70ce4 a_86 100 LINEAR______0_000000__0H___255_0 0.0 255.0 BIT_MASK 0xffffffff /end CHARACTERISTIC
/begin CHARACTERISTIC c_tps_av_bol "C_TPS_AV_BOL" VALUE 0x7091e a_85 100 LINEAR______0_000000__0H___11975 0.0 119.5 BIT_MASK 0xffffffff /end CHARACTERISTIC
/begin CHARACTERISTIC c_tps_av_ctl_max "C_TPS_AV_CTL_MAX" VALUE 0x70920 a_85 100 LINEAR______0_468750__40H___119_ 0.46875 119.5 BIT_MASK 0xffffffff /end CHARACTERISTIC
/begin CHARACTERISTIC c_tps_av_tol_is_ad "C_TPS_AV_TOL_IS_AD" VALUE 0x70922 a_85 100 LINEAR______0_000000__0H___11175 0.0 119.8828 BIT_MASK 0xffffffff /end CHARACTERISTIC
/begin CHARACTERISTIC c_tps_can_diag "C_TPS_CAN_DIAG" VALUE 0x70ce5 a_86 5 LINEAR______0_000000__0H___99_21 0.0 99.21875 BIT_MASK 0xffffffff /end CHARACTERISTIC
/begin CHARACTERISTIC c_tps_dif_max_diag "C_TPS_DIF_MAX_DIAG" VALUE 0x70924 a_85 100 LINEAR______0_000000__0H___119_8 0.0 119.8828 BIT_MASK 0xffffffff /end CHARACTERISTIC
/begin CHARACTERISTIC c_tps_iga_dif "C_TPS_IGA_DIF" VALUE 0x70926 a_85 100 LINEAR______0_000000__0H___119_8 0.0 119.8828 BIT_MASK 0xffffffff /end CHARACTERISTIC
/begin CHARACTERISTIC c_tps_iga_dif_amt "C_TPS_IGA_DIF_AMT" VALUE 0x70928 a_85 100 LINEAR______0_000000__0H___119_8 0.0 119.8828 BIT_MASK 0xffffffff FUNCTION_LIST Z1S1 /end CHARACTERISTIC
/begin CHARACTERISTIC c_tps_iga_dif_lim "C_TPS_IGA_DIF_LIM" VALUE 0x7092a a_85 100 LINEAR______0_000000__0H___11960 0.0 119.9982 BIT_MASK 0xffffffff /end CHARACTERISTIC
/begin CHARACTERISTIC c_tps_maf_crlc_dif "C_TPS_MAF_CRLC_DIF" VALUE 0x7092c a_85 100 LINEAR______0_000000__0H___0_999 0.0 0.99998474 BIT_MASK 0xffffffff /end CHARACTERISTIC
/begin CHARACTERISTIC c_tps_maf_dif_int_thd "C_TPS_MAF_DIF_INT_THD" VALUE 0x7092e a_85 100 LINEAR______0_000000__0H___1398_ 0.0 1398.0 BIT_MASK 0xffffffff /end CHARACTERISTIC
/begin CHARACTERISTIC c_tps_maf_dif_mmv_thd "C_TPS_MAF_DIF_MMV_THD" VALUE 0x70930 a_85 100 LINEAR______0_000000__0H___13176 0.0 1398.0 BIT_MASK 0xffffffff /end CHARACTERISTIC
/begin CHARACTERISTIC c_tps_max "C_TPS_MAX" VALUE 0x70932 a_85 100 LINEAR______0_000000__0H___11975 0.0 119.5 BIT_MASK 0xffffffff /end CHARACTERISTIC
/begin CHARACTERISTIC c_tps_max_diag "C_TPS_MAX_DIAG" VALUE 0x70934 a_85 100 LINEAR______0_000000__0H___11975 0.0 119.5 BIT_MASK 0xffffffff /end CHARACTERISTIC
/begin CHARACTERISTIC c_tps_req_ltc_min "C_TPS_REQ_LTC_MIN" VALUE 0x70936 a_85 100 LINEAR______0_000000__0H___11975 0.0 119.5 BIT_MASK 0xffffffff /end CHARACTERISTIC
/begin CHARACTERISTIC c_tps_slop "C_TPS_SLOP" VALUE 0x70938 a_85 10 LINEAR______0_000000__0H___48177 0.0 48.0 BIT_MASK 0xffffffff /end CHARACTERISTIC
/begin CHARACTERISTIC c_tps_slop_mon "C_TPS_SLOP_MON" VALUE 0x71244 a_85 10 LINEAR______0_000000__0H___48178 0.0 48.0 BIT_MASK 0xffffffff /end CHARACTERISTIC
/begin CHARACTERISTIC c_tps_sp_bol "C_TPS_SP_BOL" VALUE 0x7093a a_85 100 LINEAR______0_000000__0H___11975 0.0 119.5 BIT_MASK 0xffffffff /end CHARACTERISTIC
/begin CHARACTERISTIC c_tps_sp_bol_lgrd "C_TPS_SP_BOL_LGRD" VALUE 0x70ce6 a_86 100 LINEAR______0_007294__1H___1_860 0.00729415 1.860007 BIT_MASK 0xffffffff /end CHARACTERISTIC
/begin CHARACTERISTIC c_tps_sp_ctl_max "C_TPS_SP_CTL_MAX" VALUE 0x70e02 a_95 100 LINEAR_______119_500000__FFFFC00 -119.5 0.0 BIT_MASK 0xffffffff /end CHARACTERISTIC
/begin CHARACTERISTIC c_tps_sp_lgrd_stop "C_TPS_SP_LGRD_STOP" VALUE 0x7093c a_85 100 LINEAR______0_000000__0H___11975 0.0 119.5 BIT_MASK 0xffffffff /end CHARACTERISTIC
/begin CHARACTERISTIC c_tps_sp_lgrd_tot "C_TPS_SP_LGRD_TOT" VALUE 0x7093e a_85 100 LINEAR______0_000000__0H___11975 0.0 119.5 BIT_MASK 0xffffffff /end CHARACTERISTIC
/begin CHARACTERISTIC c_tps_sp_lih_dif_hys "C_TPS_SP_LIH_DIF_HYS" VALUE 0x70940 a_85 100 LINEAR______0_000000__0H___11975 0.0 119.5 BIT_MASK 0xffffffff /end CHARACTERISTIC
/begin CHARACTERISTIC c_tps_sp_max "C_TPS_SP_MAX" VALUE 0x70942 a_85 100 LINEAR______0_000000__0H___11975 0.0 119.5 BIT_MASK 0xffffffff /end CHARACTERISTIC
/begin CHARACTERISTIC c_tps_sp_min "C_TPS_SP_MIN" VALUE 0x70944 a_85 100 LINEAR______0_000000__0H___11975 0.0 119.5 BIT_MASK 0xffffffff /end CHARACTERISTIC
/begin CHARACTERISTIC c_tps_sp_rst_chk "C_TPS_SP_RST_CHK" VALUE 0x70946 a_85 100 LINEAR______0_000000__0H___11975 0.0 119.5 BIT_MASK 0xffffffff /end CHARACTERISTIC
/begin CHARACTERISTIC c_tps_sp_rst_chk_bas "C_TPS_SP_RST_CHK_BAS" VALUE 0x70948 a_85 100 LINEAR______0_000000__0H___11975 0.0 119.5 BIT_MASK 0xffffffff /end CHARACTERISTIC
/begin CHARACTERISTIC c_tps_sp_rst_chk_hys "C_TPS_SP_RST_CHK_HYS" VALUE 0x70ce7 a_86 100 LINEAR______0_007294__1H___1_179 0.00729415 1.860007 BIT_MASK 0xffffffff /end CHARACTERISTIC
/begin CHARACTERISTIC c_tps_sp_rst_chk_lgrd "C_TPS_SP_RST_CHK_LGRD" VALUE 0x70ce8 a_86 100 LINEAR______0_007294__1H___1_860 0.00729415 1.860007 BIT_MASK 0xffffffff /end CHARACTERISTIC
/begin CHARACTERISTIC c_tps_sp_spr_chk_up "C_TPS_SP_SPR_CHK_UP" VALUE 0x7094a a_85 100 LINEAR______0_000000__0H___11975 0.0 119.5 BIT_MASK 0xffffffff /end CHARACTERISTIC
/begin CHARACTERISTIC c_tps_sp_stop_hys "C_TPS_SP_STOP_HYS" VALUE 0x7094c a_85 100 LINEAR______0_000000__0H___11975 0.0 119.5 BIT_MASK 0xffffffff /end CHARACTERISTIC
/begin CHARACTERISTIC c_tps_sp_stop_max "C_TPS_SP_STOP_MAX" VALUE 0x7094e a_85 100 LINEAR______0_000000__0H___11975 0.0 119.5 BIT_MASK 0xffffffff /end CHARACTERISTIC
/begin CHARACTERISTIC c_tps_sp_tol "C_TPS_SP_TOL" VALUE 0x70950 a_85 100 LINEAR______0_000000__0H___11975 0.0 119.5 BIT_MASK 0xffffffff /end CHARACTERISTIC
/begin CHARACTERISTIC c_tq_conv_can "C_TQ_CONV_CAN" VALUE 0x70ce9 a_86 100 LINEAR______0_000000__0H___99_60 0.0 99.609375 BIT_MASK 0xffffffff /end CHARACTERISTIC
/begin CHARACTERISTIC c_tq_loss_hpa "C_TQ_LOSS_HPA" VALUE 0x70952 a_85 100 LINEAR______0_000000__0H___1023_ 0.0 1023.0 BIT_MASK 0xffffffff FUNCTION_LIST Z1S1 /end CHARACTERISTIC
/begin CHARACTERISTIC c_tq_max_gear "C_TQ_MAX_GEAR" VALUE 0x70954 a_85 100 LINEAR______0_000000__0H___1023_ 0.0 1023.0 BIT_MASK 0xffffffff /end CHARACTERISTIC
/begin CHARACTERISTIC c_tq_max_msr "C_TQ_MAX_MSR" VALUE 0x70956 a_85 100 LINEAR______0_000000__0H___1023_ 0.0 1023.0 BIT_MASK 0xffffffff /end CHARACTERISTIC
/begin CHARACTERISTIC c_tq_stnd "C_TQ_STND" VALUE 0x70958 a_85 100 LINEAR______0_000000__0H___1023_ 0.0 1023.0 BIT_MASK 0xffffffff /end CHARACTERISTIC
/begin CHARACTERISTIC c_tqfr_dec_st "C_TQFR_DEC_ST" VALUE 0x7095a a_85 100 LINEAR______0_000000__0H___1022_ 0.0 1022.9688 BIT_MASK 0xffffffff /end CHARACTERISTIC
/begin CHARACTERISTIC c_tqi_amt_can_es "C_TQI_AMT_CAN_ES" VALUE 0x70cea a_86 100 LINEAR______0_000000__0H___99_60 0.0 99.609375 BIT_MASK 0xffffffff FUNCTION_LIST Z1S1 /end CHARACTERISTIC
/begin CHARACTERISTIC c_tqi_amt_can_es_mon "C_TQI_AMT_CAN_ES_MON" VALUE 0x7127b a_86 100 LINEAR______0_000000__0H___99_60 0.0 99.609375 BIT_MASK 0xffffffff FUNCTION_LIST Z1S1 /end CHARACTERISTIC
/begin CHARACTERISTIC c_tqi_amt_can_lgrd_neg_diag "C_TQI_AMT_CAN_LGRD_NEG_DIAG" VALUE 0x7095c a_85 100 LINEAR______0_000000__0H___99120 0.0 99.998474 BIT_MASK 0xffffffff /end CHARACTERISTIC
/begin CHARACTERISTIC c_tqi_amt_can_lgrd_pos_diag "C_TQI_AMT_CAN_LGRD_POS_DIAG" VALUE 0x7095e a_85 100 LINEAR______0_000000__0H___99120 0.0 99.998474 BIT_MASK 0xffffffff /end CHARACTERISTIC
/begin CHARACTERISTIC c_tqi_amt_cond_diag "C_TQI_AMT_COND_DIAG" VALUE 0x70960 a_85 100 LINEAR______0_000000__0H___1023_ 0.0 1023.0 BIT_MASK 0xffffffff FUNCTION_LIST Z1S1 /end CHARACTERISTIC
/begin CHARACTERISTIC c_tqi_amt_cond_diag_mon "C_TQI_AMT_COND_DIAG_MON" VALUE 0x7127c a_86 100 LINEAR______0_000000__0H___510_0 0.0 510.0 BIT_MASK 0xffffffff FUNCTION_LIST Z1S1 /end CHARACTERISTIC
/begin CHARACTERISTIC c_tqi_amt_diag "C_TQI_AMT_DIAG" VALUE 0x70962 a_85 100 LINEAR______0_000000__0H___1023_ 0.0 1023.0 BIT_MASK 0xffffffff FUNCTION_LIST Z1S1 /end CHARACTERISTIC
/begin CHARACTERISTIC c_tqi_amt_diag_mon "C_TQI_AMT_DIAG_MON" VALUE 0x7127d a_86 100 LINEAR______0_000000__0H___510_0 0.0 510.0 BIT_MASK 0xffffffff FUNCTION_LIST Z1S1 /end CHARACTERISTIC
/begin CHARACTERISTIC c_tqi_can_lgrd_diag "C_TQI_CAN_LGRD_DIAG" VALUE 0x70964 a_85 100 LINEAR______0_000000__0H___10180 0.0 100.0 BIT_MASK 0xffffffff /end CHARACTERISTIC
/begin CHARACTERISTIC c_tqi_dif "C_TQI_DIF" VALUE 0x70966 a_85 100 LINEAR______0_000000__0H___1023_ 0.0 1023.0 BIT_MASK 0xffffffff /end CHARACTERISTIC
/begin CHARACTERISTIC c_tqi_dif_amt "C_TQI_DIF_AMT" VALUE 0x70968 a_85 100 LINEAR______0_000000__0H___1023_ 0.0 1023.0 BIT_MASK 0xffffffff FUNCTION_LIST Z1S1 /end CHARACTERISTIC
/begin CHARACTERISTIC c_tqi_dif_i_max "C_TQI_DIF_I_MAX" VALUE 0x70e04 a_95 100 LINEAR_______1023_000000__FFFF80 -1023.0 1022.9688 BIT_MASK 0xffffffff /end CHARACTERISTIC
/begin CHARACTERISTIC c_tqi_dif_i_min "C_TQI_DIF_I_MIN" VALUE 0x70e06 a_95 100 LINEAR_______1023_000000__FFFF80 -1023.0 1022.9688 BIT_MASK 0xffffffff /end CHARACTERISTIC
/begin CHARACTERISTIC c_tqi_dif_lim "C_TQI_DIF_LIM" VALUE 0x7096a a_85 100 LINEAR______0_000000__0H___1023_ 0.0 1023.0 BIT_MASK 0xffffffff /end CHARACTERISTIC
/begin CHARACTERISTIC c_tqi_iga_dif "C_TQI_IGA_DIF" VALUE 0x7096c a_85 100 LINEAR______0_000000__0H___1023_ 0.0 1023.0 BIT_MASK 0xffffffff /end CHARACTERISTIC
/begin CHARACTERISTIC c_tqi_iga_dif_amt "C_TQI_IGA_DIF_AMT" VALUE 0x7096e a_85 100 LINEAR______0_000000__0H___1023_ 0.0 1023.0 BIT_MASK 0xffffffff FUNCTION_LIST Z1S1 /end CHARACTERISTIC
/begin CHARACTERISTIC c_tqi_iga_dif_lim "C_TQI_IGA_DIF_LIM" VALUE 0x70970 a_85 100 LINEAR______0_000000__0H___1023_ 0.0 1023.0 BIT_MASK 0xffffffff /end CHARACTERISTIC
/begin CHARACTERISTIC c_tqi_isa_lgrd_diag "C_TQI_ISA_LGRD_DIAG" VALUE 0x70972 a_85 100 LINEAR______0_000000__0H___1022_ 0.0 1022.9688 BIT_MASK 0xffffffff /end CHARACTERISTIC
/begin CHARACTERISTIC c_tqi_lim_dif_ctl_act_thd "C_TQI_LIM_DIF_CTL_ACT_THD" VALUE 0x70974 a_85 100 LINEAR______0_000000__0H___1023_ 0.0 1023.0 BIT_MASK 0xffffffff /end CHARACTERISTIC
/begin CHARACTERISTIC c_tqi_lim_dif_i_max "C_TQI_LIM_DIF_I_MAX" VALUE 0x70e08 a_95 100 LINEAR_______1023_000000__FFFF80 -1023.0 1022.9688 BIT_MASK 0xffffffff /end CHARACTERISTIC
/begin CHARACTERISTIC c_tqi_lim_dif_i_min "C_TQI_LIM_DIF_I_MIN" VALUE 0x70e0a a_95 100 LINEAR_______1023_000000__FFFF80 -1023.0 1022.9688 BIT_MASK 0xffffffff /end CHARACTERISTIC
/begin CHARACTERISTIC c_tqi_lim_max_dec "C_TQI_LIM_MAX_DEC" VALUE 0x70976 a_85 100 LINEAR______0_000000__0H___10181 0.0 1023.0 BIT_MASK 0xffffffff /end CHARACTERISTIC
/begin CHARACTERISTIC c_tqi_msr_cru_ad_ofs "C_TQI_MSR_CRU_AD_OFS" VALUE 0x70978 a_85 100 LINEAR______0_000000__0H___1023_ 0.0 1023.0 BIT_MASK 0xffffffff /end CHARACTERISTIC
/begin CHARACTERISTIC c_tqi_msr_ofs_mon "C_TQI_MSR_OFS_MON" VALUE 0x7127e a_86 100 LINEAR______0_000000__0H___510_0 0.0 510.0 BIT_MASK 0xffffffff /end CHARACTERISTIC
/begin CHARACTERISTIC c_tqi_msr_ofs_mon2 "C_TQI_MSR_OFS_MON2" VALUE 0x70ceb a_86 100 LINEAR______0_000000__0H___510_0 0.0 510.0 BIT_MASK 0xffffffff /end CHARACTERISTIC
/begin CHARACTERISTIC c_tqi_sp_dec_max_mon "C_TQI_SP_DEC_MAX_MON" VALUE 0x7127f a_86 100 LINEAR______0_000000__0H___31_87 0.0 31.875 BIT_MASK 0xffffffff /end CHARACTERISTIC
/begin CHARACTERISTIC c_tqi_sp_dec_max_mon2 "C_TQI_SP_DEC_MAX_MON2" VALUE 0x70cec a_86 100 LINEAR______0_000000__0H___31_87 0.0 31.875 BIT_MASK 0xffffffff FUNCTION_LIST MON2 /end CHARACTERISTIC
/begin CHARACTERISTIC c_tqi_stnd_mon "C_TQI_STND_MON" VALUE 0x71280 a_86 100 LINEAR______0_000000__0H___51182 0.0 510.0 BIT_MASK 0xffffffff /end CHARACTERISTIC
/begin CHARACTERISTIC c_trt_dmtl_eol_max "C_TRT_DMTL_EOL_MAX" VALUE 0x7097a a_85 100 LINEAR______0_000000__0H___65183 0.0 6553.5 BIT_MASK 0xffffffff FUNCTION_LIST DMTL /end CHARACTERISTIC
/begin CHARACTERISTIC c_v_amp_max_diag "C_V_AMP_MAX_DIAG" VALUE 0x7097c a_85 100 LINEAR______0_000000__0H___4_995 0.0 4.9951172 BIT_MASK 0xffffffff /end CHARACTERISTIC
/begin CHARACTERISTIC c_v_amp_min_diag "C_V_AMP_MIN_DIAG" VALUE 0x7097e a_85 100 LINEAR______0_000000__0H___4_995 0.0 4.9951172 BIT_MASK 0xffffffff /end CHARACTERISTIC
/begin CHARACTERISTIC c_v_cat_diag_max "C_V_CAT_DIAG_MAX" VALUE 0x70980 a_85 100 LINEAR______0_000000__0H___4_995 0.0 4.9951172 BIT_MASK 0xffffffff /end CHARACTERISTIC
/begin CHARACTERISTIC c_v_cat_diag_min "C_V_CAT_DIAG_MIN" VALUE 0x70982 a_85 100 LINEAR______0_000000__0H___4_995 0.0 4.9951172 BIT_MASK 0xffffffff /end CHARACTERISTIC
/begin CHARACTERISTIC c_v_conv_thd_deac_mon "C_V_CONV_THD_DEAC_MON" VALUE 0x71281 a_86 100 LINEAR______0_000000__0H___4_980 0.0 4.9804688 BIT_MASK 0xffffffff /end CHARACTERISTIC
/begin CHARACTERISTIC c_v_dif_igk_rly_main_max "C_V_DIF_IGK_RLY_MAIN_MAX" VALUE 0x70ced a_86 100 LINEAR______0_000000__0H___26_00 0.0 26.0 BIT_MASK 0xffffffff /end CHARACTERISTIC
/begin CHARACTERISTIC c_v_dmtl_max_diag "C_V_DMTL_MAX_DIAG" VALUE 0x70984 a_85 10 LINEAR______0_000000__0H___4_995 0.0 4.9951172 BIT_MASK 0xffffffff FUNCTION_LIST DMTL /end CHARACTERISTIC
/begin CHARACTERISTIC c_v_fuc_h "C_V_FUC_H" VALUE 0x70cee a_86 100 LINEAR______0_000000__0H___4_980 0.0 4.9804688 BIT_MASK 0xffffffff /end CHARACTERISTIC
/begin CHARACTERISTIC c_v_fuc_l "C_V_FUC_L" VALUE 0x70cef a_86 100 LINEAR______0_000000__0H___4_980 0.0 4.9804688 BIT_MASK 0xffffffff /end CHARACTERISTIC
/begin CHARACTERISTIC c_v_igk_rly_main_diag "C_V_IGK_RLY_MAIN_DIAG" VALUE 0x70cf0 a_86 100 LINEAR______0_000000__0H___26_00 0.0 26.0 BIT_MASK 0xffffffff /end CHARACTERISTIC
/begin CHARACTERISTIC c_v_pvs_2_conv_ratio_hys_mon "C_V_PVS_2_CONV_RATIO_HYS_MON" VALUE 0x71282 a_86 100 LINEAR______0_000000__0H___4_980 0.0 4.9804688 BIT_MASK 0xffffffff /end CHARACTERISTIC
/begin CHARACTERISTIC c_v_pvs_grd_max "C_V_PVS_GRD_MAX" VALUE 0x70986 a_85 100 LINEAR______0_000000__0H___5_184 0.0 5.0 BIT_MASK 0xffffffff /end CHARACTERISTIC
/begin CHARACTERISTIC c_v_pvs_hys_fil "C_V_PVS_HYS_FIL" VALUE 0x70cf1 a_86 100 LINEAR______0_000000__0H___1_245 0.0 1.2451172 BIT_MASK 0xffffffff /end CHARACTERISTIC
/begin CHARACTERISTIC c_v_pvs_is_thd_1_mon "C_V_PVS_IS_THD_1_MON" VALUE 0x71246 a_85 100 LINEAR______0_000000__0H___4_995 0.0 4.9951172 BIT_MASK 0xffffffff /end CHARACTERISTIC
/begin CHARACTERISTIC c_v_pvs_is_thd_2_mon "C_V_PVS_IS_THD_2_MON" VALUE 0x71248 a_85 100 LINEAR______0_000000__0H___4_995 0.0 4.9951172 BIT_MASK 0xffffffff /end CHARACTERISTIC
/begin CHARACTERISTIC c_v_pvs_max_diag_1 "C_V_PVS_MAX_DIAG_1" VALUE 0x70cf2 a_86 100 LINEAR______0_000000__0H___4_980 0.0 4.9804688 BIT_MASK 0xffffffff /end CHARACTERISTIC
/begin CHARACTERISTIC c_v_pvs_max_diag_2 "C_V_PVS_MAX_DIAG_2" VALUE 0x70cf3 a_86 100 LINEAR______0_000000__0H___4_980 0.0 4.9804688 BIT_MASK 0xffffffff /end CHARACTERISTIC
/begin CHARACTERISTIC c_v_pvs_min_diag_1 "C_V_PVS_MIN_DIAG_1" VALUE 0x70988 a_85 100 LINEAR______0_000000__0H___4_995 0.0 4.9951172 BIT_MASK 0xffffffff /end CHARACTERISTIC
/begin CHARACTERISTIC c_v_pvs_min_diag_2 "C_V_PVS_MIN_DIAG_2" VALUE 0x7098a a_85 100 LINEAR______0_000000__0H___4_995 0.0 4.9951172 BIT_MASK 0xffffffff /end CHARACTERISTIC
/begin CHARACTERISTIC c_v_pvs_min_diag_min_1 "C_V_PVS_MIN_DIAG_MIN_1" VALUE 0x7098c a_85 100 LINEAR______0_000000__0H___4_995 0.0 4.9951172 BIT_MASK 0xffffffff /end CHARACTERISTIC
/begin CHARACTERISTIC c_v_pvs_min_diag_min_2 "C_V_PVS_MIN_DIAG_MIN_2" VALUE 0x7098e a_85 100 LINEAR______0_000000__0H___4_995 0.0 4.9951172 BIT_MASK 0xffffffff /end CHARACTERISTIC
/begin CHARACTERISTIC c_v_pvs_ofs_1 "C_V_PVS_OFS_1" VALUE 0x70cf4 a_86 100 LINEAR______0_000000__0H___1_245 0.0 1.2451172 BIT_MASK 0xffffffff /end CHARACTERISTIC
/begin CHARACTERISTIC c_v_pvs_ofs_2 "C_V_PVS_OFS_2" VALUE 0x70cf5 a_86 100 LINEAR______0_000000__0H___1_245 0.0 1.2451172 BIT_MASK 0xffffffff /end CHARACTERISTIC
/begin CHARACTERISTIC c_v_pvs_slop_1_mon "C_V_PVS_SLOP_1_MON" VALUE 0x71283 a_86 100 LINEAR______0_000000__0H___79_68 0.0 79.6875 BIT_MASK 0xffffffff /end CHARACTERISTIC
/begin CHARACTERISTIC c_v_pvs_slop_2_mon "C_V_PVS_SLOP_2_MON" VALUE 0x71284 a_86 100 LINEAR______0_000000__0H___15185 0.0 159.375 BIT_MASK 0xffffffff /end CHARACTERISTIC
/begin CHARACTERISTIC c_v_pvs_thd_hys_kd "C_V_PVS_THD_HYS_KD" VALUE 0x70cf6 a_86 100 LINEAR______0_000000__0H___4_980 0.0 4.9804688 BIT_MASK 0xffffffff /end CHARACTERISTIC
/begin CHARACTERISTIC c_v_pvs_thd_kd "C_V_PVS_THD_KD" VALUE 0x70cf7 a_86 100 LINEAR______0_000000__0H___4_980 0.0 4.9804688 BIT_MASK 0xffffffff /end CHARACTERISTIC
/begin CHARACTERISTIC c_v_tps_1_lih_mon "C_V_TPS_1_LIH_MON" VALUE 0x7124a a_85 100 LINEAR______0_000000__0H___4_995 0.0 4.9951172 BIT_MASK 0xffffffff /end CHARACTERISTIC
/begin CHARACTERISTIC c_v_tps_2_lih_mon "C_V_TPS_2_LIH_MON" VALUE 0x7124c a_85 100 LINEAR______0_000000__0H___4_995 0.0 4.9951172 BIT_MASK 0xffffffff /end CHARACTERISTIC
/begin CHARACTERISTIC c_v_tps_ad_bol_ini_1 "C_V_TPS_AD_BOL_INI_1" VALUE 0x70cf8 a_86 100 LINEAR______0_000000__0H___4_980 0.0 4.9804688 BIT_MASK 0xffffffff /end CHARACTERISTIC
/begin CHARACTERISTIC c_v_tps_ad_bol_ini_2 "C_V_TPS_AD_BOL_INI_2" VALUE 0x70cf9 a_86 100 LINEAR______0_000000__0H___4_980 0.0 4.9804688 BIT_MASK 0xffffffff /end CHARACTERISTIC
/begin CHARACTERISTIC c_v_tps_ad_el_bol_1_mon "C_V_TPS_AD_EL_BOL_1_MON" VALUE 0x71285 a_86 100 LINEAR______0_000000__0H___4_980 0.0 4.9804688 BIT_MASK 0xffffffff /end CHARACTERISTIC
/begin CHARACTERISTIC c_v_tps_ad_el_bol_2_mon "C_V_TPS_AD_EL_BOL_2_MON" VALUE 0x71286 a_86 100 LINEAR______0_000000__0H___4_980 0.0 4.9804688 BIT_MASK 0xffffffff /end CHARACTERISTIC
/begin CHARACTERISTIC c_v_tps_ad_hys "C_V_TPS_AD_HYS" VALUE 0x70cfa a_86 100 LINEAR______0_000000__0H___1_245 0.0 1.2451172 BIT_MASK 0xffffffff /end CHARACTERISTIC
/begin CHARACTERISTIC c_v_tps_ad_win_2_bol "C_V_TPS_AD_WIN_2_BOL" VALUE 0x70cfb a_86 100 LINEAR______0_000000__0H___2_490 0.0 2.4902344 BIT_MASK 0xffffffff /end CHARACTERISTIC
/begin CHARACTERISTIC c_v_tps_ad_win_bol "C_V_TPS_AD_WIN_BOL" VALUE 0x70cfc a_86 100 LINEAR______0_000000__0H___2_490 0.0 2.4902344 BIT_MASK 0xffffffff /end CHARACTERISTIC
/begin CHARACTERISTIC c_v_tps_ad_win_lih "C_V_TPS_AD_WIN_LIH" VALUE 0x70cfd a_86 100 LINEAR______0_000000__0H___2_490 0.0 2.4902344 BIT_MASK 0xffffffff /end CHARACTERISTIC
/begin CHARACTERISTIC c_v_tps_grd_max "C_V_TPS_GRD_MAX" VALUE 0x70990 a_85 100 LINEAR______0_000000__0H___4_995 0.0 4.9951172 BIT_MASK 0xffffffff /end CHARACTERISTIC
/begin CHARACTERISTIC c_v_tps_lih_chk_hys "C_V_TPS_LIH_CHK_HYS" VALUE 0x70cfe a_86 100 LINEAR______0_000000__0H___1_245 0.0 1.2451172 BIT_MASK 0xffffffff /end CHARACTERISTIC
/begin CHARACTERISTIC c_v_tps_max_diag_1 "C_V_TPS_MAX_DIAG_1" VALUE 0x70992 a_85 100 LINEAR______0_000000__0H___4_995 0.0 4.9951172 BIT_MASK 0xffffffff /end CHARACTERISTIC
/begin CHARACTERISTIC c_v_tps_max_diag_2 "C_V_TPS_MAX_DIAG_2" VALUE 0x70994 a_85 100 LINEAR______0_000000__0H___4_995 0.0 4.9951172 BIT_MASK 0xffffffff /end CHARACTERISTIC
/begin CHARACTERISTIC c_v_tps_max_mon "C_V_TPS_MAX_MON" VALUE 0x71287 a_86 100 LINEAR______0_000000__0H___4_980 0.0 4.9804688 BIT_MASK 0xffffffff /end CHARACTERISTIC
/begin CHARACTERISTIC c_v_tps_min_diag_1 "C_V_TPS_MIN_DIAG_1" VALUE 0x70996 a_85 100 LINEAR______0_000000__0H___4_995 0.0 4.9951172 BIT_MASK 0xffffffff /end CHARACTERISTIC
/begin CHARACTERISTIC c_v_tps_min_diag_2 "C_V_TPS_MIN_DIAG_2" VALUE 0x70998 a_85 100 LINEAR______0_000000__0H___4_995 0.0 4.9951172 BIT_MASK 0xffffffff /end CHARACTERISTIC
/begin CHARACTERISTIC c_v_tps_ratio_hys "C_V_TPS_RATIO_HYS" VALUE 0x7099a a_85 100 LINEAR______0_000000__0H___4_995 0.0 4.9951172 BIT_MASK 0xffffffff /end CHARACTERISTIC
/begin CHARACTERISTIC c_v_tps_ratio_hys_mon "C_V_TPS_RATIO_HYS_MON" VALUE 0x71288 a_86 100 LINEAR______0_000000__0H___4_980 0.0 4.9804688 BIT_MASK 0xffffffff /end CHARACTERISTIC
/begin CHARACTERISTIC c_v_tps_sp_bol_1 "C_V_TPS_SP_BOL_1" VALUE 0x70cff a_86 100 LINEAR______0_000000__0H___4_980 0.0 4.9804688 BIT_MASK 0xffffffff /end CHARACTERISTIC
/begin CHARACTERISTIC c_v_tps_sp_bol_2 "C_V_TPS_SP_BOL_2" VALUE 0x70d00 a_86 100 LINEAR______0_000000__0H___4_980 0.0 4.9804688 BIT_MASK 0xffffffff /end CHARACTERISTIC
/begin CHARACTERISTIC c_v_tps_sp_lih_1 "C_V_TPS_SP_LIH_1" VALUE 0x70d01 a_86 100 LINEAR______0_000000__0H___4_980 0.0 4.9804688 BIT_MASK 0xffffffff /end CHARACTERISTIC
/begin CHARACTERISTIC c_v_tps_sp_lih_2 "C_V_TPS_SP_LIH_2" VALUE 0x70d02 a_86 100 LINEAR______0_000000__0H___4_980 0.0 4.9804688 BIT_MASK 0xffffffff /end CHARACTERISTIC
/begin CHARACTERISTIC c_v_var_amp "C_V_VAR_AMP" VALUE 0x7099c a_85 100 LINEAR______0_000000__0H___4_995 0.0 4.9951172 BIT_MASK 0xffffffff /end CHARACTERISTIC
/begin CHARACTERISTIC c_v_var_ign_coil_pc "C_V_VAR_IGN_COIL_PC" VALUE 0x7099e a_85 100 LINEAR______0_000000__0H___4_995 0.0 4.9951172 BIT_MASK 0xffffffff /end CHARACTERISTIC
/begin CHARACTERISTIC c_vb_dmtl_asa_max "C_VB_DMTL_ASA_MAX" VALUE 0x70d03 a_86 100 LINEAR______0_000000__0H___26_00 0.0 26.0 BIT_MASK 0xffffffff FUNCTION_LIST DMTL /end CHARACTERISTIC
/begin CHARACTERISTIC c_vb_dmtl_asa_min "C_VB_DMTL_ASA_MIN" VALUE 0x70d04 a_86 100 LINEAR______0_000000__0H___26_00 0.0 26.0 BIT_MASK 0xffffffff FUNCTION_LIST DMTL /end CHARACTERISTIC
/begin CHARACTERISTIC c_vb_dmtl_dif "C_VB_DMTL_DIF" VALUE 0x709a0 a_85 100 LINEAR______0_000000__0H___26_30 0.0 26.0 BIT_MASK 0xffffffff FUNCTION_LIST DMTL /end CHARACTERISTIC
/begin CHARACTERISTIC c_vb_dmtl_max "C_VB_DMTL_MAX" VALUE 0x70d05 a_86 100 LINEAR______0_000000__0H___26_00 0.0 26.0 BIT_MASK 0xffffffff FUNCTION_LIST DMTL /end CHARACTERISTIC
/begin CHARACTERISTIC c_vb_dmtl_min "C_VB_DMTL_MIN" VALUE 0x70d06 a_86 100 LINEAR______0_000000__0H___26_00 0.0 26.0 BIT_MASK 0xffffffff FUNCTION_LIST DMTL /end CHARACTERISTIC
/begin CHARACTERISTIC c_vb_ecf "C_VB_ECF" VALUE 0x70d07 a_86 100 LINEAR______0_000000__0H___26_00 0.0 26.0 BIT_MASK 0xffffffff /end CHARACTERISTIC
/begin CHARACTERISTIC c_vb_ivvt_diag "C_VB_IVVT_DIAG" VALUE 0x70d08 a_86 100 LINEAR______0_000000__0H___26_00 0.0 26.0 BIT_MASK 0xffffffff /end CHARACTERISTIC
/begin CHARACTERISTIC c_vb_max_ivvt "C_VB_MAX_IVVT" VALUE 0x70d09 a_86 100 LINEAR______0_000000__0H___26_00 0.0 26.0 BIT_MASK 0xffffffff /end CHARACTERISTIC
/begin CHARACTERISTIC c_vb_min_can_diag "C_VB_MIN_CAN_DIAG" VALUE 0x70d0a a_86 100 LINEAR______0_000000__0H___26_00 0.0 26.0 BIT_MASK 0xffffffff /end CHARACTERISTIC
/begin CHARACTERISTIC c_vb_min_diag "C_VB_MIN_DIAG" VALUE 0x70d0b a_86 30 LINEAR______0_000000__0H___26_00 0.0 26.0 BIT_MASK 0xffffffff /end CHARACTERISTIC
/begin CHARACTERISTIC c_vb_min_ivvt "C_VB_MIN_IVVT" VALUE 0x70d0c a_86 100 LINEAR______0_000000__0H___26_00 0.0 26.0 BIT_MASK 0xffffffff /end CHARACTERISTIC
/begin CHARACTERISTIC c_vb_min_jump "C_VB_MIN_JUMP" VALUE 0x70d0d a_86 30 LINEAR______0_000000__0H___26_00 0.0 26.0 BIT_MASK 0xffffffff /end CHARACTERISTIC
/begin CHARACTERISTIC c_vb_min_msw_diag "C_VB_MIN_MSW_DIAG" VALUE 0x70d0e a_86 30 LINEAR______0_000000__0H___26_00 0.0 26.0 BIT_MASK 0xffffffff /end CHARACTERISTIC
/begin CHARACTERISTIC c_vb_min_mtc_ctl_diag "C_VB_MIN_MTC_CTL_DIAG" VALUE 0x70d0f a_86 30 LINEAR______0_000000__0H___26_00 0.0 26.0 BIT_MASK 0xffffffff /end CHARACTERISTIC
/begin CHARACTERISTIC c_vb_min_mtc_dr_diag "C_VB_MIN_MTC_DR_DIAG" VALUE 0x70d10 a_86 30 LINEAR______0_000000__0H___26_00 0.0 26.0 BIT_MASK 0xffffffff /end CHARACTERISTIC
/begin CHARACTERISTIC c_vb_min_obd1 "C_VB_MIN_OBD1" VALUE 0x70d11 a_86 100 LINEAR______0_000000__0H___255_0 0.0 255.0 BIT_MASK 0xffffffff /end CHARACTERISTIC
/begin CHARACTERISTIC c_vb_min_obd2 "C_VB_MIN_OBD2" VALUE 0x70d12 a_86 100 LINEAR______0_000000__0H___255_0 0.0 255.0 BIT_MASK 0xffffffff /end CHARACTERISTIC
/begin CHARACTERISTIC c_vb_min_sync "C_VB_MIN_SYNC" VALUE 0x70d13 a_86 100 LINEAR______0_000000__0H___26_00 0.0 26.0 BIT_MASK 0xffffffff /end CHARACTERISTIC
/begin CHARACTERISTIC c_vb_min_tps_ad "C_VB_MIN_TPS_AD" VALUE 0x70d14 a_86 100 LINEAR______0_000000__0H___26186 0.0 26.0 BIT_MASK 0xffffffff /end CHARACTERISTIC
/begin CHARACTERISTIC c_vb_ref_dew "C_VB_REF_DEW" VALUE 0x70d15 a_86 100 LINEAR______0_000000__0H___26_00 0.0 26.0 BIT_MASK 0xffffffff FUNCTION_LIST DPM /end CHARACTERISTIC
/begin CHARACTERISTIC c_vbel_grd_max "C_VBEL_GRD_MAX" VALUE 0x70d16 a_86 100 LINEAR______0_000000__0H___26_00 0.0 26.0 BIT_MASK 0xffffffff /end CHARACTERISTIC
/begin CHARACTERISTIC c_vcc_dif_poti "C_VCC_DIF_POTI" VALUE 0x70d17 a_86 100 LINEAR______0_000000__0H___10187 0.0 10.0 BIT_MASK 0xffffffff /end CHARACTERISTIC
/begin CHARACTERISTIC c_vls_afl_down_ready "C_VLS_AFL_DOWN_READY" VALUE 0x70d18 a_86 100 LINEAR______0_000000__0H___1_275 0.0 1.275 BIT_MASK 0xffffffff /end CHARACTERISTIC
/begin CHARACTERISTIC c_vls_afl_eol "C_VLS_AFL_EOL" VALUE 0x70d19 a_86 10 LINEAR______0_000000__0H___1_275 0.0 1.275 BIT_MASK 0xffffffff /end CHARACTERISTIC
/begin CHARACTERISTIC c_vls_afl_ready_sa_diag "C_VLS_AFL_READY_SA_DIAG" VALUE 0x70d1a a_86 100 LINEAR______0_000000__0H___1_275 0.0 1.275 BIT_MASK 0xffffffff /end CHARACTERISTIC
/begin CHARACTERISTIC c_vls_afl_up_ready "C_VLS_AFL_UP_READY" VALUE 0x70d1b a_86 100 LINEAR______0_000000__0H___1_275 0.0 1.275 BIT_MASK 0xffffffff /end CHARACTERISTIC
/begin CHARACTERISTIC c_vls_afr_down_ready "C_VLS_AFR_DOWN_READY" VALUE 0x70d1c a_86 100 LINEAR______0_000000__0H___1_275 0.0 1.275 BIT_MASK 0xffffffff /end CHARACTERISTIC
/begin CHARACTERISTIC c_vls_afr_eol "C_VLS_AFR_EOL" VALUE 0x70d1d a_86 10 LINEAR______0_000000__0H___1_275 0.0 1.275 BIT_MASK 0xffffffff /end CHARACTERISTIC
/begin CHARACTERISTIC c_vls_afr_ready_sa_diag "C_VLS_AFR_READY_SA_DIAG" VALUE 0x70d1e a_86 100 LINEAR______0_000000__0H___1_275 0.0 1.275 BIT_MASK 0xffffffff /end CHARACTERISTIC
/begin CHARACTERISTIC c_vls_afr_up_ready "C_VLS_AFR_UP_READY" VALUE 0x70d1f a_86 100 LINEAR______0_000000__0H___1_275 0.0 1.275 BIT_MASK 0xffffffff /end CHARACTERISTIC
/begin CHARACTERISTIC c_vls_bol_open_diag "C_VLS_BOL_OPEN_DIAG" VALUE 0x70d20 a_86 100 LINEAR______0_000000__0H___1_275 0.0 1.275 BIT_MASK 0xffffffff /end CHARACTERISTIC
/begin CHARACTERISTIC c_vls_bol_open_down_diag "C_VLS_BOL_OPEN_DOWN_DIAG" VALUE 0x70d21 a_86 100 LINEAR______0_000000__0H___1_275 0.0 1.275 BIT_MASK 0xffffffff /end CHARACTERISTIC
/begin CHARACTERISTIC c_vls_cat_cycnr_max "C_VLS_CAT_CYCNR_MAX" VALUE 0x70d22 a_86 100 LINEAR______0_000000__0H___1_992 0.0 1.9921875 BIT_MASK 0xffffffff /end CHARACTERISTIC
/begin CHARACTERISTIC c_vls_cat_min_diag "C_VLS_CAT_MIN_DIAG" VALUE 0x70d23 a_86 100 LINEAR______0_000000__0H___1_275 0.0 1.275 BIT_MASK 0xffffffff /end CHARACTERISTIC
/begin CHARACTERISTIC c_vls_cat_min_puc_diag "C_VLS_CAT_MIN_PUC_DIAG" VALUE 0x70d24 a_86 100 LINEAR______0_000000__0H___1_275 0.0 1.275 BIT_MASK 0xffffffff /end CHARACTERISTIC
/begin CHARACTERISTIC c_vls_crlc "C_VLS_CRLC" VALUE 0x70d25 a_86 10 LINEAR______0_000000__0H___0_250 0.0 0.25 BIT_MASK 0xffffffff /end CHARACTERISTIC
/begin CHARACTERISTIC c_vls_cur_on_max_down "C_VLS_CUR_ON_MAX_DOWN" VALUE 0x709a2 a_85 100 LINEAR______0_000000__0H___4_995 0.0 4.9951172 BIT_MASK 0xffffffff FUNCTION_LIST R_LS_CALC /end CHARACTERISTIC
/begin CHARACTERISTIC c_vls_cur_on_max_up "C_VLS_CUR_ON_MAX_UP" VALUE 0x709a4 a_85 100 LINEAR______0_000000__0H___4_995 0.0 4.9951172 BIT_MASK 0xffffffff FUNCTION_LIST R_LS_CALC /end CHARACTERISTIC
/begin CHARACTERISTIC c_vls_cur_on_min_down "C_VLS_CUR_ON_MIN_DOWN" VALUE 0x709a6 a_85 100 LINEAR______0_000000__0H___4_995 0.0 4.9951172 BIT_MASK 0xffffffff FUNCTION_LIST R_LS_CALC /end CHARACTERISTIC
/begin CHARACTERISTIC c_vls_cur_on_min_up "C_VLS_CUR_ON_MIN_UP" VALUE 0x709a8 a_85 100 LINEAR______0_000000__0H___4_995 0.0 4.9951172 BIT_MASK 0xffffffff FUNCTION_LIST R_LS_CALC /end CHARACTERISTIC
/begin CHARACTERISTIC c_vls_cyc_afl_ratio_mv_max "C_VLS_CYC_AFL_RATIO_MV_MAX" VALUE 0x709aa a_85 100 LINEAR______0_000000__0H___255_9 0.0 255.9961 BIT_MASK 0xffffffff /end CHARACTERISTIC
/begin CHARACTERISTIC c_vls_cyc_afr_ratio_mv_max "C_VLS_CYC_AFR_RATIO_MV_MAX" VALUE 0x709ac a_85 100 LINEAR______0_000000__0H___255_9 0.0 255.9961 BIT_MASK 0xffffffff /end CHARACTERISTIC
/begin CHARACTERISTIC c_vls_cyc_ratio_mv_max "C_VLS_CYC_RATIO_MV_MAX" VALUE 0x709ae a_85 10 LINEAR______0_000000__0H___255_9 0.0 255.9961 BIT_MASK 0xffffffff FUNCTION_LIST CSCM /end CHARACTERISTIC
/begin CHARACTERISTIC c_vls_cycnr_afl_ratio_mv_max "C_VLS_CYCNR_AFL_RATIO_MV_MAX" VALUE 0x709b0 a_85 100 LINEAR______0_000000__0H___255_9 0.0 255.9961 BIT_MASK 0xffffffff /end CHARACTERISTIC
/begin CHARACTERISTIC c_vls_cycnr_afr_ratio_mv_max "C_VLS_CYCNR_AFR_RATIO_MV_MAX" VALUE 0x709b2 a_85 100 LINEAR______0_000000__0H___255_9 0.0 255.9961 BIT_MASK 0xffffffff /end CHARACTERISTIC
/begin CHARACTERISTIC c_vls_dew_afl_ready_down "C_VLS_DEW_AFL_READY_DOWN" VALUE 0x70d26 a_86 15 LINEAR______0_000000__0H___1_275 0.0 1.275 BIT_MASK 0xffffffff FUNCTION_LIST DPM /end CHARACTERISTIC
/begin CHARACTERISTIC c_vls_dew_afl_ready_up "C_VLS_DEW_AFL_READY_UP" VALUE 0x70d27 a_86 15 LINEAR______0_000000__0H___1_275 0.0 1.275 BIT_MASK 0xffffffff FUNCTION_LIST DPM /end CHARACTERISTIC
/begin CHARACTERISTIC c_vls_dew_afr_ready_down "C_VLS_DEW_AFR_READY_DOWN" VALUE 0x70d28 a_86 15 LINEAR______0_000000__0H___1_275 0.0 1.275 BIT_MASK 0xffffffff FUNCTION_LIST DPM /end CHARACTERISTIC
/begin CHARACTERISTIC c_vls_dew_afr_ready_up "C_VLS_DEW_AFR_READY_UP" VALUE 0x70d29 a_86 15 LINEAR______0_000000__0H___1_275 0.0 1.275 BIT_MASK 0xffffffff FUNCTION_LIST DPM /end CHARACTERISTIC
/begin CHARACTERISTIC c_vls_dif_cat_diag_min "C_VLS_DIF_CAT_DIAG_MIN" VALUE 0x70d2a a_86 100 LINEAR______0_000000__0H___1_275 0.0 1.275 BIT_MASK 0xffffffff /end CHARACTERISTIC
/begin CHARACTERISTIC c_vls_dif_cur_off_down "C_VLS_DIF_CUR_OFF_DOWN" VALUE 0x709b4 a_85 100 LINEAR______0_000000__0H___4_995 0.0 4.9951172 BIT_MASK 0xffffffff FUNCTION_LIST R_LS_CALC /end CHARACTERISTIC
/begin CHARACTERISTIC c_vls_dif_cur_off_up "C_VLS_DIF_CUR_OFF_UP" VALUE 0x709b6 a_85 100 LINEAR______0_000000__0H___4_995 0.0 4.9951172 BIT_MASK 0xffffffff FUNCTION_LIST R_LS_CALC /end CHARACTERISTIC
/begin CHARACTERISTIC c_vls_dif_down_1 "C_VLS_DIF_DOWN_1" VALUE 0x709b8 a_85 100 LINEAR______0_000000__0H___4_995 0.0 4.9951172 BIT_MASK 0xffffffff /end CHARACTERISTIC
/begin CHARACTERISTIC c_vls_dif_down_2 "C_VLS_DIF_DOWN_2" VALUE 0x709ba a_85 100 LINEAR______0_000000__0H___4_995 0.0 4.9951172 BIT_MASK 0xffffffff /end CHARACTERISTIC
/begin CHARACTERISTIC c_vls_dif_max_cyl_lam "C_VLS_DIF_MAX_CYL_LAM" VALUE 0x70d2b a_86 10 LINEAR______0_000000__0H___1_275 0.0 1.275 BIT_MASK 0xffffffff FUNCTION_LIST CSCM /end CHARACTERISTIC
/begin CHARACTERISTIC c_vls_dif_max_min_diag "C_VLS_DIF_MAX_MIN_DIAG" VALUE 0x70d2c a_86 100 LINEAR______0_000000__0H___1_275 0.0 1.275 BIT_MASK 0xffffffff /end CHARACTERISTIC
/begin CHARACTERISTIC c_vls_dif_up_1 "C_VLS_DIF_UP_1" VALUE 0x709bc a_85 100 LINEAR______0_000000__0H___4_995 0.0 4.9951172 BIT_MASK 0xffffffff /end CHARACTERISTIC
/begin CHARACTERISTIC c_vls_dif_up_2 "C_VLS_DIF_UP_2" VALUE 0x709be a_85 100 LINEAR______0_000000__0H___4_995 0.0 4.9951172 BIT_MASK 0xffffffff /end CHARACTERISTIC
/begin CHARACTERISTIC c_vls_down_dly_puc_max "C_VLS_DOWN_DLY_PUC_MAX" VALUE 0x70d2d a_86 100 LINEAR______0_000000__0H___1_275 0.0 1.275 BIT_MASK 0xffffffff /end CHARACTERISTIC
/begin CHARACTERISTIC c_vls_down_thd_afl_diag "C_VLS_DOWN_THD_AFL_DIAG" VALUE 0x70d2e a_86 10 LINEAR______0_005000__1H___1_240 0.005 1.24 BIT_MASK 0xffffffff /end CHARACTERISTIC
/begin CHARACTERISTIC c_vls_down_thd_afr_diag "C_VLS_DOWN_THD_AFR_DIAG" VALUE 0x70d2f a_86 10 LINEAR______0_005000__1H___1_240 0.005 1.24 BIT_MASK 0xffffffff /end CHARACTERISTIC
/begin CHARACTERISTIC c_vls_hst_dly_max_down "C_VLS_HST_DLY_MAX_DOWN" VALUE 0x70d30 a_86 100 LINEAR______0_000000__0H___1_275 0.0 1.275 BIT_MASK 0xffffffff /end CHARACTERISTIC
/begin CHARACTERISTIC c_vls_hys "C_VLS_HYS" VALUE 0x70d31 a_86 100 LINEAR______0_000000__0H___4_188 0.0 4.9804688 BIT_MASK 0xffffffff /end CHARACTERISTIC
/begin CHARACTERISTIC c_vls_hys_cat "C_VLS_HYS_CAT" VALUE 0x70d32 a_86 100 LINEAR______0_000000__0H___1_275 0.0 1.275 BIT_MASK 0xffffffff /end CHARACTERISTIC
/begin CHARACTERISTIC c_vls_ini_max "C_VLS_INI_MAX" VALUE 0x70d33 a_86 10 LINEAR______0_000000__0H___1_275 0.0 1.275 BIT_MASK 0xffffffff /end CHARACTERISTIC
/begin CHARACTERISTIC c_vls_ini_min "C_VLS_INI_MIN" VALUE 0x70d34 a_86 10 LINEAR______0_000000__0H___1_275 0.0 1.275 BIT_MASK 0xffffffff /end CHARACTERISTIC
/begin CHARACTERISTIC c_vls_lam_afl "C_VLS_LAM_AFL" VALUE 0x70d35 a_86 100 LINEAR______0_000000__0H___1_275 0.0 1.275 BIT_MASK 0xffffffff /end CHARACTERISTIC
/begin CHARACTERISTIC c_vls_lam_afr "C_VLS_LAM_AFR" VALUE 0x70d36 a_86 100 LINEAR______0_000000__0H___1_275 0.0 1.275 BIT_MASK 0xffffffff /end CHARACTERISTIC
/begin CHARACTERISTIC c_vls_max_cycnr "C_VLS_MAX_CYCNR" VALUE 0x70d37 a_86 100 LINEAR______0_000000__0H___2550_ 0.0 2550.0 BIT_MASK 0xffffffff /end CHARACTERISTIC
/begin CHARACTERISTIC c_vls_max_cycnr_afr "C_VLS_MAX_CYCNR_AFR" VALUE 0x70d38 a_86 100 LINEAR______0_000000__0H___51068 0.0 5100.0 BIT_MASK 0xffffffff /end CHARACTERISTIC
/begin CHARACTERISTIC c_vls_max_cyl_lam "C_VLS_MAX_CYL_LAM" VALUE 0x70d39 a_86 10 LINEAR______0_000000__0H___1_275 0.0 1.275 BIT_MASK 0xffffffff FUNCTION_LIST CSCM /end CHARACTERISTIC
/begin CHARACTERISTIC c_vls_max_down_diag "C_VLS_MAX_DOWN_DIAG" VALUE 0x70d3a a_86 100 LINEAR______0_000000__0H___1_275 0.0 1.275 BIT_MASK 0xffffffff /end CHARACTERISTIC
/begin CHARACTERISTIC c_vls_max_up_diag "C_VLS_MAX_UP_DIAG" VALUE 0x70d3b a_86 100 LINEAR______0_000000__0H___1_275 0.0 1.275 BIT_MASK 0xffffffff /end CHARACTERISTIC
/begin CHARACTERISTIC c_vls_min_cyl_lam "C_VLS_MIN_CYL_LAM" VALUE 0x70d3c a_86 10 LINEAR______0_000000__0H___1_275 0.0 1.275 BIT_MASK 0xffffffff FUNCTION_LIST CSCM /end CHARACTERISTIC
/begin CHARACTERISTIC c_vls_min_diag "C_VLS_MIN_DIAG" VALUE 0x70d3d a_86 10 LINEAR______0_000000__0H___1_275 0.0 1.275 BIT_MASK 0xffffffff /end CHARACTERISTIC
/begin CHARACTERISTIC c_vls_min_down_diag "C_VLS_MIN_DOWN_DIAG" VALUE 0x70d3e a_86 10 LINEAR______0_000000__0H___1_275 0.0 1.275 BIT_MASK 0xffffffff /end CHARACTERISTIC
/begin CHARACTERISTIC c_vls_mmv_hys "C_VLS_MMV_HYS" VALUE 0x70d3f a_86 10 LINEAR______0_000000__0H___1_275 0.0 1.275 BIT_MASK 0xffffffff /end CHARACTERISTIC
/begin CHARACTERISTIC c_vls_sap_dly_max_down "C_VLS_SAP_DLY_MAX_DOWN" VALUE 0x70d40 a_86 100 LINEAR______0_000000__0H___1_275 0.0 1.275 BIT_MASK 0xffffffff /end CHARACTERISTIC
/begin CHARACTERISTIC c_vls_tol_open_diag "C_VLS_TOL_OPEN_DIAG" VALUE 0x70d41 a_86 100 LINEAR______0_000000__0H___1_275 0.0 1.275 BIT_MASK 0xffffffff /end CHARACTERISTIC
/begin CHARACTERISTIC c_vls_tol_open_down_diag "C_VLS_TOL_OPEN_DOWN_DIAG" VALUE 0x70d42 a_86 100 LINEAR______0_000000__0H___1_275 0.0 1.275 BIT_MASK 0xffffffff /end CHARACTERISTIC
/begin CHARACTERISTIC c_vs_ac_max_cru "C_VS_AC_MAX_CRU" VALUE 0x70d43 a_86 10 LINEAR______0_000000__0H___25511 0.0 255.0 BIT_MASK 0xffffffff /end CHARACTERISTIC
/begin CHARACTERISTIC c_vs_ac_min_cru "C_VS_AC_MIN_CRU" VALUE 0x70d44 a_86 10 LINEAR______0_000000__0H___25511 0.0 255.0 BIT_MASK 0xffffffff /end CHARACTERISTIC
/begin CHARACTERISTIC c_vs_dif_delta_i "C_VS_DIF_DELTA_I" VALUE 0x70d45 a_86 10 LINEAR______0_000000__0H___63189 0.0 63.75 BIT_MASK 0xffffffff /end CHARACTERISTIC
/begin CHARACTERISTIC c_vs_dif_dly_cru_neg "C_VS_DIF_DLY_CRU_NEG" VALUE 0x70e0c a_95 100 LINEAR______0_000000__0H___25190 0.0 255.99218 BIT_MASK 0xffffffff /end CHARACTERISTIC
/begin CHARACTERISTIC c_vs_dif_dly_cru_pos "C_VS_DIF_DLY_CRU_POS" VALUE 0x70e0e a_95 100 LINEAR_______256_000000__FFFF800 -256.0 0.0 BIT_MASK 0xffffffff /end CHARACTERISTIC
/begin CHARACTERISTIC c_vs_dif_max_ac_cru "C_VS_DIF_MAX_AC_CRU" VALUE 0x70e10 a_95 10 LINEAR_______256_000000__FFFF191 -256.0 255.99218 BIT_MASK 0xffffffff /end CHARACTERISTIC
/begin CHARACTERISTIC c_vs_dif_max_cru "C_VS_DIF_MAX_CRU" VALUE 0x70d46 a_86 10 LINEAR______0_000000__0H___31192 0.0 31.875 BIT_MASK 0xffffffff /end CHARACTERISTIC
/begin CHARACTERISTIC c_vs_dif_max_is_cru "C_VS_DIF_MAX_IS_CRU" VALUE 0x70e12 a_95 10 LINEAR_______256_000000__FFFF191 -256.0 255.99218 BIT_MASK 0xffffffff /end CHARACTERISTIC
/begin CHARACTERISTIC c_vs_dif_min_ac_cru "C_VS_DIF_MIN_AC_CRU" VALUE 0x70e14 a_95 10 LINEAR_______256_000000__FFFF191 -256.0 255.99218 BIT_MASK 0xffffffff /end CHARACTERISTIC
/begin CHARACTERISTIC c_vs_dif_min_is_cru "C_VS_DIF_MIN_IS_CRU" VALUE 0x70e16 a_95 10 LINEAR_______256_000000__FFFF191 -256.0 255.99218 BIT_MASK 0xffffffff /end CHARACTERISTIC
/begin CHARACTERISTIC c_vs_dif_rng_cru "C_VS_DIF_RNG_CRU" VALUE 0x709c0 a_85 10 LINEAR______0_000000__0H___51151 0.0 511.99218 BIT_MASK 0xffffffff /end CHARACTERISTIC
/begin CHARACTERISTIC c_vs_dmtl_max "C_VS_DMTL_MAX" VALUE 0x70d47 a_86 100 LINEAR______0_000000__0H___25511 0.0 255.0 BIT_MASK 0xffffffff /end CHARACTERISTIC
/begin CHARACTERISTIC c_vs_fac "C_VS_FAC" VALUE 0x709c2 a_85 10 LINEAR______1000_000000__3E8H___ 1000.0 30000.0 BIT_MASK 0xffffffff /end CHARACTERISTIC
/begin CHARACTERISTIC c_vs_fil_amt "C_VS_FIL_AMT" VALUE 0x709c4 a_85 100 LINEAR______0_000000__0H___51151 0.0 511.99218 BIT_MASK 0xffffffff FUNCTION_LIST Z1S1 /end CHARACTERISTIC
/begin CHARACTERISTIC c_vs_fil_amt_mon "C_VS_FIL_AMT_MON" VALUE 0x7124e a_85 100 LINEAR______0_000000__0H___51151 0.0 511.99218 BIT_MASK 0xffffffff FUNCTION_LIST Z1S1 /end CHARACTERISTIC
/begin CHARACTERISTIC c_vs_ftl_diag_max "C_VS_FTL_DIAG_MAX" VALUE 0x70d48 a_86 100 LINEAR______0_000000__0H___25511 0.0 255.0 BIT_MASK 0xffffffff FUNCTION_LIST DMTL /end CHARACTERISTIC
/begin CHARACTERISTIC c_vs_fuc_can_min "C_VS_FUC_CAN_MIN" VALUE 0x70d49 a_86 100 LINEAR______0_000000__0H___25511 0.0 255.0 BIT_MASK 0xffffffff FUNCTION_LIST DMTL /end CHARACTERISTIC
/begin CHARACTERISTIC c_vs_i_ac_max_fgr "C_VS_I_AC_MAX_FGR" VALUE 0x709c6 a_85 100 LINEAR______0_000000__0H___1777_ 0.0 1777.7235 BIT_MASK 0xffffffff /end CHARACTERISTIC
/begin CHARACTERISTIC c_vs_i_fac_max_cru "C_VS_I_FAC_MAX_CRU" VALUE 0x70d4a a_86 10 LINEAR______0_000000__0H___1_992 0.0 1.9921875 BIT_MASK 0xffffffff /end CHARACTERISTIC
/begin CHARACTERISTIC c_vs_i_fac_max_cru_vs_lim "C_VS_I_FAC_MAX_CRU_VS_LIM" VALUE 0x70d4b a_86 10 LINEAR______0_000000__0H___1_992 0.0 1.9921875 BIT_MASK 0xffffffff /end CHARACTERISTIC
/begin CHARACTERISTIC c_vs_iga_is_cor "C_VS_IGA_IS_COR" VALUE 0x70d4c a_86 100 LINEAR______0_000000__0H___25511 0.0 255.0 BIT_MASK 0xffffffff /end CHARACTERISTIC
/begin CHARACTERISTIC c_vs_low_n "C_VS_LOW_N" VALUE 0x70d4d a_86 100 LINEAR______0_000000__0H___25511 0.0 255.0 BIT_MASK 0xffffffff FUNCTION_LIST Z10I /end CHARACTERISTIC
/begin CHARACTERISTIC c_vs_max_accin "C_VS_MAX_ACCIN" VALUE 0x70d4e a_86 10 LINEAR______0_000000__0H___25511 0.0 255.0 BIT_MASK 0xffffffff /end CHARACTERISTIC
/begin CHARACTERISTIC c_vs_max_add "C_VS_MAX_ADD" VALUE 0x70d4f a_86 10 LINEAR______0_000000__0H___31192 0.0 31.875 BIT_MASK 0xffffffff /end CHARACTERISTIC
/begin CHARACTERISTIC c_vs_max_aj "C_VS_MAX_AJ" VALUE 0x70d50 a_86 100 LINEAR______0_000000__0H___25511 0.0 255.0 BIT_MASK 0xffffffff /end CHARACTERISTIC
/begin CHARACTERISTIC c_vs_max_amt "C_VS_MAX_AMT" VALUE 0x70d51 a_86 100 LINEAR______0_000000__0H___25511 0.0 255.0 BIT_MASK 0xffffffff FUNCTION_LIST Z1S1 /end CHARACTERISTIC
/begin CHARACTERISTIC c_vs_max_at_1 "C_VS_MAX_AT_1" VALUE 0x70d52 a_86 100 LINEAR______0_000000__0H___25511 0.0 255.0 BIT_MASK 0xffffffff /end CHARACTERISTIC
/begin CHARACTERISTIC c_vs_max_cat "C_VS_MAX_CAT" VALUE 0x70d53 a_86 100 LINEAR______0_000000__0H___25511 0.0 255.0 BIT_MASK 0xffffffff /end CHARACTERISTIC
/begin CHARACTERISTIC c_vs_max_ch_2 "C_VS_MAX_CH_2" VALUE 0x70d54 a_86 100 LINEAR______0_000000__0H___25511 0.0 255.0 BIT_MASK 0xffffffff /end CHARACTERISTIC
/begin CHARACTERISTIC c_vs_max_ch_2_intr "C_VS_MAX_CH_2_INTR" VALUE 0x70d55 a_86 100 LINEAR______0_000000__0H___25511 0.0 255.0 BIT_MASK 0xffffffff /end CHARACTERISTIC
/begin CHARACTERISTIC c_vs_max_ch_3 "C_VS_MAX_CH_3" VALUE 0x70d56 a_86 100 LINEAR______0_000000__0H___25511 0.0 255.0 BIT_MASK 0xffffffff /end CHARACTERISTIC
/begin CHARACTERISTIC c_vs_max_cycnr "C_VS_MAX_CYCNR" VALUE 0x70d57 a_86 2 LINEAR______0_000000__0H___25514 0.0 255.0 BIT_MASK 0xffffffff /end CHARACTERISTIC
/begin CHARACTERISTIC c_vs_max_diag "C_VS_MAX_DIAG" VALUE 0x709c8 a_85 100 LINEAR______0_000000__0H___25193 0.0 255.99218 BIT_MASK 0xffffffff /end CHARACTERISTIC
/begin CHARACTERISTIC c_vs_max_fl "C_VS_MAX_FL" VALUE 0x70d58 a_86 100 LINEAR______0_000000__0H___25511 0.0 255.0 BIT_MASK 0xffffffff /end CHARACTERISTIC
/begin CHARACTERISTIC c_vs_max_hys "C_VS_MAX_HYS" VALUE 0x70d59 a_86 100 LINEAR______0_000000__0H___25511 0.0 255.0 BIT_MASK 0xffffffff /end CHARACTERISTIC
/begin CHARACTERISTIC c_vs_max_hys_1 "C_VS_MAX_HYS_1" VALUE 0x70d5a a_86 10 LINEAR______0_000000__0H___31192 0.0 31.875 BIT_MASK 0xffffffff /end CHARACTERISTIC
/begin CHARACTERISTIC c_vs_max_mt_1 "C_VS_MAX_MT_1" VALUE 0x70d5b a_86 10 LINEAR______0_000000__0H___25511 0.0 255.0 BIT_MASK 0xffffffff /end CHARACTERISTIC
/begin CHARACTERISTIC c_vs_max_pvs_fac "C_VS_MAX_PVS_FAC" VALUE 0x709ca a_85 100 LINEAR______0_000000__0H___51151 0.0 511.99218 BIT_MASK 0xffffffff /end CHARACTERISTIC
/begin CHARACTERISTIC c_vs_max_pvs_fac_ssg "C_VS_MAX_PVS_FAC_SSG" VALUE 0x709cc a_85 100 LINEAR______0_000000__0H___51151 0.0 511.99218 BIT_MASK 0xffffffff FUNCTION_LIST Z1S1 /end CHARACTERISTIC
/begin CHARACTERISTIC c_vs_max_rr "C_VS_MAX_RR" VALUE 0x70d5c a_86 100 LINEAR______0_000000__0H___25511 0.0 255.0 BIT_MASK 0xffffffff /end CHARACTERISTIC
/begin CHARACTERISTIC c_vs_max_toil_max "C_VS_MAX_TOIL_MAX" VALUE 0x70d5d a_86 10 LINEAR______0_000000__0H___25511 0.0 255.0 BIT_MASK 0xffffffff /end CHARACTERISTIC
/begin CHARACTERISTIC c_vs_max_tps_ad "C_VS_MAX_TPS_AD" VALUE 0x70d5e a_86 100 LINEAR______0_000000__0H___25511 0.0 255.0 BIT_MASK 0xffffffff /end CHARACTERISTIC
/begin CHARACTERISTIC c_vs_min_aj "C_VS_MIN_AJ" VALUE 0x70d5f a_86 100 LINEAR______0_000000__0H___25511 0.0 255.0 BIT_MASK 0xffffffff /end CHARACTERISTIC
/begin CHARACTERISTIC c_vs_min_aj_amt "C_VS_MIN_AJ_AMT" VALUE 0x70d60 a_86 100 LINEAR______0_000000__0H___25511 0.0 255.0 BIT_MASK 0xffffffff FUNCTION_LIST Z1S1 /end CHARACTERISTIC
/begin CHARACTERISTIC c_vs_min_cat "C_VS_MIN_CAT" VALUE 0x70d61 a_86 100 LINEAR______0_000000__0H___25511 0.0 255.0 BIT_MASK 0xffffffff /end CHARACTERISTIC
/begin CHARACTERISTIC c_vs_min_cru "C_VS_MIN_CRU" VALUE 0x709ce a_85 100 LINEAR______0_000000__0H___51151 0.0 511.99218 BIT_MASK 0xffffffff /end CHARACTERISTIC
/begin CHARACTERISTIC c_vs_min_cru_mon "C_VS_MIN_CRU_MON" VALUE 0x71289 a_86 100 LINEAR______0_000000__0H___51194 0.0 510.0 BIT_MASK 0xffffffff /end CHARACTERISTIC
/begin CHARACTERISTIC c_vs_min_ef_at "C_VS_MIN_EF_AT" VALUE 0x70d62 a_86 100 LINEAR______0_000000__0H___25511 0.0 255.0 BIT_MASK 0xffffffff /end CHARACTERISTIC
/begin CHARACTERISTIC c_vs_min_ef_mt "C_VS_MIN_EF_MT" VALUE 0x70d63 a_86 100 LINEAR______0_000000__0H___25511 0.0 255.0 BIT_MASK 0xffffffff /end CHARACTERISTIC
/begin CHARACTERISTIC c_vs_min_fl "C_VS_MIN_FL" VALUE 0x70d64 a_86 10 LINEAR______0_000000__0H___25511 0.0 255.0 BIT_MASK 0xffffffff /end CHARACTERISTIC
/begin CHARACTERISTIC c_vs_min_gear_1 "C_VS_MIN_GEAR_1" VALUE 0x709d0 a_85 100 LINEAR______0_000000__0H___51151 0.0 511.99218 BIT_MASK 0xffffffff /end CHARACTERISTIC
/begin CHARACTERISTIC c_vs_min_plaus_cru "C_VS_MIN_PLAUS_CRU" VALUE 0x709d2 a_85 100 LINEAR______0_000000__0H___51151 0.0 511.99218 BIT_MASK 0xffffffff /end CHARACTERISTIC
/begin CHARACTERISTIC c_vs_min_rr "C_VS_MIN_RR" VALUE 0x70d65 a_86 100 LINEAR______0_000000__0H___25511 0.0 255.0 BIT_MASK 0xffffffff /end CHARACTERISTIC
/begin CHARACTERISTIC c_vs_min_slow_pu "C_VS_MIN_SLOW_PU" VALUE 0x70d66 a_86 10 LINEAR______0_000000__0H___25511 0.0 255.0 BIT_MASK 0xffffffff /end CHARACTERISTIC
/begin CHARACTERISTIC c_vs_min_tra_drv "C_VS_MIN_TRA_DRV" VALUE 0x70d67 a_86 100 LINEAR______0_000000__0H___25511 0.0 255.0 BIT_MASK 0xffffffff /end CHARACTERISTIC
/begin CHARACTERISTIC c_vs_n_end_is "C_VS_N_END_IS" VALUE 0x70d68 a_86 10 LINEAR______0_000000__0H___25511 0.0 255.0 BIT_MASK 0xffffffff /end CHARACTERISTIC
/begin CHARACTERISTIC c_vs_pvs_bls_bts_plaus "C_VS_PVS_BLS_BTS_PLAUS" VALUE 0x70d69 a_86 100 LINEAR______0_000000__0H___25511 0.0 255.0 BIT_MASK 0xffffffff /end CHARACTERISTIC
/begin CHARACTERISTIC c_vs_sp_cru_max "C_VS_SP_CRU_MAX" VALUE 0x709d4 a_85 100 LINEAR______0_000000__0H___51151 0.0 511.99218 BIT_MASK 0xffffffff /end CHARACTERISTIC
/begin CHARACTERISTIC c_vs_sp_dif_max_cru "C_VS_SP_DIF_MAX_CRU" VALUE 0x70e18 a_95 100 LINEAR_______256_000000__FFFF191 -256.0 255.99218 BIT_MASK 0xffffffff /end CHARACTERISTIC
/begin CHARACTERISTIC c_vs_sp_dif_min_cru "C_VS_SP_DIF_MIN_CRU" VALUE 0x70e1a a_95 100 LINEAR_______256_000000__FFFF191 -256.0 255.99218 BIT_MASK 0xffffffff /end CHARACTERISTIC
/begin CHARACTERISTIC c_wheel_grd_crlc_rr "C_WHEEL_GRD_CRLC_RR" VALUE 0x709d6 a_85 100 LINEAR______0_000000__0H___0_999 0.0 0.99998474 BIT_MASK 0xffffffff /end CHARACTERISTIC
/begin CHARACTERISTIC c_write_ad_ena "C_WRITE_AD_ENA" VALUE 0x70d6a a_86 100 LINEAR______0_000000__0H___255_0 0.0 255.0 BIT_MASK 0xffffffff /end CHARACTERISTIC
/begin CHARACTERISTIC cam_sp_as_ex "CAM_SP_AS_EX" VALUE 0x400de a_87 100 LINEAR______48_000000__FFFFFF80H -47.625 48.0 BIT_MASK 0xffffffff /end CHARACTERISTIC
/begin CHARACTERISTIC cam_sp_as_in "CAM_SP_AS_IN" VALUE 0x400df a_87 100 LINEAR______48_000000__FFFFFF195 -47.625 48.0 BIT_MASK 0xffffffff /end CHARACTERISTIC
/begin CHARACTERISTIC cppwm_as "CPPWM_AS" VALUE 0x400e0 a_87 100 LINEAR_______50_000000__FFFFFF80 -50.0 49.61 BIT_MASK 0xffffffff /end CHARACTERISTIC
/begin CHARACTERISTIC DES_VERSIONC0D "" VALUE 0x0 a_86 100 defaultConversion 0 255 BIT_MASK 0xffffffff /end CHARACTERISTIC
/begin CHARACTERISTIC DES_VERSIONC1D "" VALUE 0x1 a_86 100 defaultConversion196 0 255 BIT_MASK 0xffffffff /end CHARACTERISTIC
/begin CHARACTERISTIC DES_VERSIONC2D "" VALUE 0x2 a_86 100 defaultConversion197 0 255 BIT_MASK 0xffffffff /end CHARACTERISTIC
/begin COMPU_METHOD LINEAR______0_000000__0H___255_0 "" FORM "%3.0" "-" FORMULA "1.0*X" FORMULA_INV "1.0*X" /end COMPU_METHOD
/begin COMPU_METHOD LINEAR______0_000000__0H___8160_ "" FORM "%4.0" "rpm" FORMULA "32.0*X" FORMULA_INV "0.03125*X" /end COMPU_METHOD
/begin COMPU_METHOD LINEAR______0_000000__0H___65535 "" FORM "%5.0" "-" FORMULA "1.0*X" FORMULA_INV "1.0*X" /end COMPU_METHOD
/begin COMPU_METHOD LINEAR______0_000000__0H___0_996 "" FORM "%5.3" "-" FORMULA "0.00390625*X" FORMULA_INV "256.0*X" /end COMPU_METHOD
/begin COMPU_METHOD LINEAR______0_000000__0H___1_000 "" FORM "%2.0" "-" FORMULA "1.0*X" FORMULA_INV "1.0*X" /end COMPU_METHOD
/begin COMPU_METHOD LINEAR_______48_000000__0H___155 "" FORM "%5.1" "°C" FORMULA "0.79607843*X-48.0" FORMULA_INV "1.2561576*X+60.295567" /end COMPU_METHOD
/begin COMPU_METHOD LINEAR______0_000000__0H___26_00 "" FORM "%4.1" "V" FORMULA "0.10196078*X" FORMULA_INV "9.8076923*X" /end COMPU_METHOD
/begin COMPU_METHOD LINEAR______0_000000__0H___99_60 "" FORM "%4.1" "%" FORMULA "0.390625*X" FORMULA_INV "2.56*X" /end COMPU_METHOD
/begin COMPU_METHOD LINEAR_______33_000000__0H___987 "" FORM "%3.0" "°C" FORMULA "4.0*X-33.0" FORMULA_INV "0.25*X+8.25" /end COMPU_METHOD
/begin COMPU_METHOD LINEAR_______48_000000__0H___142 "" FORM "%5.1" "°C" FORMULA "0.75*X-48.0" FORMULA_INV "1.3333333*X+64.0" /end COMPU_METHOD
/begin COMPU_METHOD LINEAR______0_000000__0H___1_992 "" FORM "%5.3" "-" FORMULA "0.0078125*X" FORMULA_INV "128.0*X" /end COMPU_METHOD
/begin COMPU_METHOD LINEAR______0_000000__0H___81608 "" FORM "%4.0" "rpm/(km/h)" FORMULA "1.0*X" FORMULA_INV "1.0*X" /end COMPU_METHOD
/begin COMPU_METHOD LINEAR_______33_000000__0H___991 "" FORM "%6.2" "°C" FORMULA "0.015625238*X-33.0" FORMULA_INV "63.999023*X+2111.9678" /end COMPU_METHOD
/begin COMPU_METHOD LINEAR______0_000000__0H___15_94 "" FORM "%5.2" "-" FORMULA "0.062509802*X" FORMULA_INV "15.997491*X" /end COMPU_METHOD
/begin COMPU_METHOD LINEAR______0_000000__0H___25511 "" FORM "%3.0" "km/h" FORMULA "1.0*X" FORMULA_INV "1.0*X" /end COMPU_METHOD
/begin COMPU_METHOD LINEAR______1_000000__1H___255_0 "" FORM "%3.0" "-" FORMULA "1.0*X" FORMULA_INV "1.0*X" /end COMPU_METHOD
/begin COMPU_METHOD LINEAR______0_000000__0H___81612 "" FORM "%4.0" "rpm" FORMULA "1.0*X" FORMULA_INV "1.0*X" /end COMPU_METHOD
/begin COMPU_METHOD LINEAR______0_000000__0H___119_5 "" FORM "%5.1" "°PVS" FORMULA "0.46875*X" FORMULA_INV "2.1333333*X" /end COMPU_METHOD
/begin COMPU_METHOD LINEAR______0_000000__0H___11913 "" FORM "%5.1" "°TPS" FORMULA "0.46862745*X" FORMULA_INV "2.1338912*X" /end COMPU_METHOD
/begin COMPU_METHOD LINEAR______0_000000__0H___2988_ "" FORM "%4.0" "°TPS/s" FORMULA "11.717647*X" FORMULA_INV "0.085341365*X" /end COMPU_METHOD
/begin COMPU_METHOD LINEAR______0_000000__0H___254_0 "" FORM "%3.0" "-" FORMULA "1.0*X" FORMULA_INV "1.0*X" /end COMPU_METHOD
/begin COMPU_METHOD LINEAR______0_000000__0H___6553_ "" FORM "%6.1" "s" FORMULA "0.1*X" FORMULA_INV "10.0*X" /end COMPU_METHOD
/begin COMPU_METHOD LINEAR______10_000000__1H___2550 "" FORM "%4.0" "ms" FORMULA "10.0*X" FORMULA_INV "0.1*X" /end COMPU_METHOD
/begin COMPU_METHOD LINEAR______0_000000__0H___349_5 "" FORM "%7.3" "ms" FORMULA "0.0053333333*X" FORMULA_INV "187.5*X" /end COMPU_METHOD
/begin COMPU_METHOD LINEAR______0_000000__0H___25514 "" FORM "%3.0" "s" FORMULA "1.0*X" FORMULA_INV "1.0*X" /end COMPU_METHOD
/begin COMPU_METHOD LINEAR______0_100000__1H___25_50 "" FORM "%4.1" "s" FORMULA "0.1*X+1.3877788e-017" FORMULA_INV "10.0*X-1.3877788e-016" /end COMPU_METHOD
/begin COMPU_METHOD LINEAR______0_000000__0H___10_20 "" FORM "%5.2" "s" FORMULA "0.04*X" FORMULA_INV "25.0*X" /end COMPU_METHOD
/begin COMPU_METHOD LINEAR______0_020000__1H___1310_ "" FORM "%7.2" "s" FORMULA "0.02*X" FORMULA_INV "50.0*X" /end COMPU_METHOD
/begin COMPU_METHOD LINEAR______0_000000__0H___1_016 "" FORM "%6.4" "-" FORMULA "0.00024414063*X" FORMULA_INV "4096.0*X" /end COMPU_METHOD
/begin COMPU_METHOD LINEAR______0_000000__0H___510_0 "" FORM "%3.0" "Nm" FORMULA "2.0*X" FORMULA_INV "0.5*X" /end COMPU_METHOD
/begin COMPU_METHOD LINEAR______0_000000__0H___16383 "" FORM "%8.2" "kg/h" FORMULA "0.25*X" FORMULA_INV "4.0*X" /end COMPU_METHOD
/begin COMPU_METHOD LINEAR______0_010000__1H___655_3 "" FORM "%6.2" "s" FORMULA "0.0099999996*X+3.7247841e-010" FORMULA_INV "100.0*X-3.7247842e-008" /end COMPU_METHOD
/begin COMPU_METHOD LINEAR______0_000000__0H___4_995 "" FORM "%5.3" "V" FORMULA "0.0048828125*X" FORMULA_INV "204.8*X" /end COMPU_METHOD
/begin COMPU_METHOD LINEAR______0_000000__0H___0_999 "" FORM "%7.5" "-" FORMULA "1.5258789e-005*X" FORMULA_INV "65536.0*X" /end COMPU_METHOD
/begin COMPU_METHOD LINEAR_______33_000000__0H___989 "" FORM "%6.2" "°C" FORMULA "0.015609741*X-33.0" FORMULA_INV "64.06256*X+2114.0645" /end COMPU_METHOD
/begin COMPU_METHOD LINEAR______0_000000__0H___2550_ "" FORM "%4.0" "ms" FORMULA "10.0*X" FORMULA_INV "0.1*X" /end COMPU_METHOD
/begin COMPU_METHOD LINEAR______0_000000__0H___25_50 "" FORM "%4.1" "s" FORMULA "0.1*X" FORMULA_INV "10.0*X" /end COMPU_METHOD
/begin COMPU_METHOD LINEAR______0_000000__0H___26_30 "" FORM "%7.4" "V" FORMULA "0.00039828431*X" FORMULA_INV "2510.7692*X" /end COMPU_METHOD
/begin COMPU_METHOD LINEAR______0_000000__0H___1_999 "" FORM "%7.5" "-" FORMULA "3.0517585e-005*X" FORMULA_INV "32767.992*X" /end COMPU_METHOD
/begin COMPU_METHOD LINEAR______0_000000__0H___16338 "" FORM "%8.2" "hPa" FORMULA "0.25*X" FORMULA_INV "4.0*X" /end COMPU_METHOD
/begin COMPU_METHOD LINEAR______0_000000__0H___119_8 "" FORM "%7.3" "°TPS" FORMULA "0.0018310545*X" FORMULA_INV "546.13339*X" /end COMPU_METHOD
/begin COMPU_METHOD LINEAR_______50_000000__0H___440 "" FORM "%7.3" "%" FORMULA "0.0015258789*X-50.0" FORMULA_INV "655.36002*X+32768.001" /end COMPU_METHOD
/begin COMPU_METHOD LINEAR_______48_000000__0H___143 "" FORM "%5.1" "°C" FORMULA "0.75*X-48.0" FORMULA_INV "1.3333333*X+64.0" /end COMPU_METHOD
/begin COMPU_METHOD LINEAR______0_000000__0H___119_9 "" FORM "%7.3" "°TPS" FORMULA "0.0018310547*X" FORMULA_INV "546.13333*X" /end COMPU_METHOD
/begin COMPU_METHOD LINEAR______0_000000__0H___2_544 "" FORM "%4.2" "s" FORMULA "0.0099999998*X" FORMULA_INV "100.0*X" /end COMPU_METHOD
/begin COMPU_METHOD LINEAR______0_000000__0H___1023_ "" FORM "%4.0" "Nm" FORMULA "1.0*X" FORMULA_INV "1.0*X" /end COMPU_METHOD
/begin COMPU_METHOD LINEAR______0_000000__0H___51151 "" FORM "%7.3" "km/h" FORMULA "0.0078124999*X" FORMULA_INV "128.0*X" /end COMPU_METHOD
/begin COMPU_METHOD LINEAR______0_000000__0H___10253 "" FORM "%7.2" "°C" FORMULA "0.015625*X" FORMULA_INV "64.0*X" /end COMPU_METHOD
/begin COMPU_METHOD LINEAR______0_031250__1H___7_968 "" FORM "%5.3" "rpm/100ms" FORMULA "0.03125*X" FORMULA_INV "32.0*X" /end COMPU_METHOD
/begin COMPU_METHOD LINEAR______0_000000__0H___1_275 "" FORM "%5.3" "V" FORMULA "0.005*X" FORMULA_INV "200.0*X" /end COMPU_METHOD
/begin COMPU_METHOD LINEAR______0_000000__0H___21675 "" FORM "%6.0" "hPa" FORMULA "850.0*X" FORMULA_INV "0.0011764706*X" /end COMPU_METHOD
/begin COMPU_METHOD LINEAR______0_000000__0H___4_980 "" FORM "%5.3" "V" FORMULA "0.01953125*X" FORMULA_INV "51.2*X" /end COMPU_METHOD
/begin COMPU_METHOD LINEAR______0_000000__0H___11960 "" FORM "%7.3" "°PVS" FORMULA "0.0018310552*X" FORMULA_INV "546.13319*X" /end COMPU_METHOD
/begin COMPU_METHOD LINEAR______0_000000__0H___65563 "" FORM "%5.0" "min" FORMULA "1.0*X" FORMULA_INV "1.0*X" /end COMPU_METHOD
/begin COMPU_METHOD LINEAR_______180_000000__0H___50 "" FORM "%4.0" "°CRK" FORMULA "6.0*X-180.0" FORMULA_INV "0.16666667*X+30.0" /end COMPU_METHOD
/begin COMPU_METHOD LINEAR______0_000000__0H___159_3 "" FORM "%5.1" "ms" FORMULA "0.625*X" FORMULA_INV "1.6*X" /end COMPU_METHOD
/begin COMPU_METHOD LINEAR______0_000000__0H___11_18 "" FORM "%7.4" "s" FORMULA "0.00017066667*X" FORMULA_INV "5859.375*X" /end COMPU_METHOD
/begin COMPU_METHOD LINEAR______0_000000__0H___655_3 "" FORM "%6.2" "s" FORMULA "0.01*X" FORMULA_INV "100.0*X" /end COMPU_METHOD
/begin COMPU_METHOD LINEAR______0_000000__0H___51068 "" FORM "%4.0" "ms" FORMULA "20.0*X" FORMULA_INV "0.05*X" /end COMPU_METHOD
/begin COMPU_METHOD LINEAR______0_000000__0H___10269 "" FORM "%7.2" "kg/h" FORMULA "0.015625*X" FORMULA_INV "64.0*X" /end COMPU_METHOD
/begin COMPU_METHOD LINEAR______0_000000__0H___11975 "" FORM "%7.3" "°TPS" FORMULA "0.0072941464*X" FORMULA_INV "137.09623*X" /end COMPU_METHOD
/begin COMPU_METHOD LINEAR______0_000000__0H___1022_ "" FORM "%7.2" "Nm" FORMULA "0.031219482*X" FORMULA_INV "32.031281*X" /end COMPU_METHOD
/begin COMPU_METHOD LINEAR_______256_000000__0H___81 "" FORM "%4.0" "rpm" FORMULA "2.0*X-256.0" FORMULA_INV "0.5*X+128.0" /end COMPU_METHOD
/begin COMPU_METHOD LINEAR______0_625000__1H___159_3 "" FORM "%5.1" "ms" FORMULA "0.625*X" FORMULA_INV "1.6*X" /end COMPU_METHOD
/begin COMPU_METHOD LINEAR______0_000000__0H___400_0 "" FORM "%7.3" "mA" FORMULA "0.0061036088*X" FORMULA_INV "163.8375*X" /end COMPU_METHOD
/begin COMPU_METHOD LINEAR______0_000000__0H___1777_ "" FORM "%7.2" "m/s^2" FORMULA "0.054253471*X" FORMULA_INV "18.432*X" /end COMPU_METHOD
/begin COMPU_METHOD LINEAR______0_000000__0H___255_9 "" FORM "%7.3" "-" FORMULA "0.0039062501*X" FORMULA_INV "255.99999*X" /end COMPU_METHOD
/begin COMPU_METHOD LINEAR______0_000000__0H___65593 "" FORM "%5.0" "-" FORMULA "1.0*X" FORMULA_INV "1.0*X" /end COMPU_METHOD
/begin COMPU_METHOD LINEAR______0_000000__0H___0_109 "" FORM "%7.5" "-/wcyc" FORMULA "1.5258789e-005*X" FORMULA_INV "65536.0*X" /end COMPU_METHOD
/begin COMPU_METHOD LINEAR______1_000000__1H___8160_ "" FORM "%4.0" "rpm" FORMULA "1.0*X" FORMULA_INV "1.0*X" /end COMPU_METHOD
/begin COMPU_METHOD LINEAR_______50_000000__FFFFFF80 "" FORM "%6.2" "%" FORMULA "0.39062745*X+0.00031372549" FORMULA_INV "2.5599839*X-0.00080313222" /end COMPU_METHOD
/begin COMPU_METHOD LINEAR______0_000000__8000H___31 "" FORM "%5.2" "%" FORMULA "0.0015258789*X-50.0" FORMULA_INV "655.36*X+32768.0" /end COMPU_METHOD
/begin COMPU_METHOD LINEAR_______31_250000__3000H115 "" FORM "%7.3" "%" FORMULA "0.0015258789*X-50.0" FORMULA_INV "655.36*X+32768.0" /end COMPU_METHOD
/begin COMPU_METHOD LINEAR______0_000000__0H___99120 "" FORM "%6.3" "%/10ms" FORMULA "0.0015258789*X" FORMULA_INV "655.36*X" /end COMPU_METHOD
/begin COMPU_METHOD LINEAR______0_000000__0H___25127 "" FORM "%3.0" "rpm" FORMULA "1.0*X" FORMULA_INV "1.0*X" /end COMPU_METHOD
/begin COMPU_METHOD LINEAR_______32768_000000__FFFF8 "" FORM "%6.0" "rpm" FORMULA "1.0*X" FORMULA_INV "1.0*X" /end COMPU_METHOD
/begin COMPU_METHOD LINEAR_______4080_000000__FFFFF0 "" FORM "%5.0" "rpm" FORMULA "1.0*X" FORMULA_INV "1.0*X" /end COMPU_METHOD
/begin COMPU_METHOD LINEAR______0_000000__0H___2040_ "" FORM "%4.0" "rpm" FORMULA "1.0*X" FORMULA_INV "1.0*X" /end COMPU_METHOD
/begin COMPU_METHOD LINEAR_______4096_000000__FFFFFF "" FORM "%5.0" "rpm/s" FORMULA "32.0*X" FORMULA_INV "0.03125*X" /end COMPU_METHOD
/begin COMPU_METHOD LINEAR_______4096_000000__FFF129 "" FORM "%5.0" "rpm/s" FORMULA "32.0*X" FORMULA_INV "0.03125*X" /end COMPU_METHOD
/begin COMPU_METHOD LINEAR______0_000000__0H___5984_ "" FORM "%4.0" "rpm" FORMULA "32.0*X" FORMULA_INV "0.03125*X" /end COMPU_METHOD
/begin COMPU_METHOD LINEAR______0_000000__0H___5024_ "" FORM "%4.0" "rpm" FORMULA "32.0*X" FORMULA_INV "0.03125*X" /end COMPU_METHOD
/begin COMPU_METHOD LINEAR______480_000000__1E0H___8 "" FORM "%4.0" "rpm" FORMULA "1.0*X" FORMULA_INV "1.0*X" /end COMPU_METHOD
/begin COMPU_METHOD LINEAR______0_000000__0H___81130 "" FORM "%8.3" "rpm/10ms" FORMULA "0.125*X" FORMULA_INV "8.0*X" /end COMPU_METHOD
/begin COMPU_METHOD LINEAR______0_000000__0H___2048_ "" FORM "%4.0" "rpm" FORMULA "32.0*X" FORMULA_INV "0.03125*X" /end COMPU_METHOD
/begin COMPU_METHOD LINEAR______0_000000__0H___81131 "" FORM "%4.0" "rev" FORMULA "32.0*X" FORMULA_INV "0.03125*X" /end COMPU_METHOD
/begin COMPU_METHOD LINEAR______1024_000000__20H___8 "" FORM "%4.0" "rpm" FORMULA "32.0*X" FORMULA_INV "0.03125*X" /end COMPU_METHOD
/begin COMPU_METHOD LINEAR______480_000000__FH___816 "" FORM "%4.0" "rpm" FORMULA "32.0*X" FORMULA_INV "0.03125*X" /end COMPU_METHOD
/begin COMPU_METHOD LINEAR______0_000000__0H___25_00 "" FORM "%4.1" "%/200ms" FORMULA "0.098039216*X" FORMULA_INV "10.2*X" /end COMPU_METHOD
/begin COMPU_METHOD LINEAR______0_031250__1H___7_132 "" FORM "%5.3" "rpm/10ms" FORMULA "0.03125*X" FORMULA_INV "32.0*X" /end COMPU_METHOD
/begin COMPU_METHOD LINEAR______0_250000__1H___63_75 "" FORM "%5.2" "rpm/10ms" FORMULA "0.25*X" FORMULA_INV "4.0*X" /end COMPU_METHOD
/begin COMPU_METHOD LINEAR______1824_000000__39H___8 "" FORM "%4.0" "rpm" FORMULA "32.0*X" FORMULA_INV "0.03125*X" /end COMPU_METHOD
/begin COMPU_METHOD LINEAR______0_000015__1H___0_999 "" FORM "%8.6" "-" FORMULA "1.5258789e-005*X+2.109592e-010" FORMULA_INV "65536.0*X-1.3825422e-005" /end COMPU_METHOD
/begin COMPU_METHOD LINEAR______0_000000__0H___0_124 "" FORM "%6.4" "-" FORMULA "0.00048823529*X" FORMULA_INV "2048.1928*X" /end COMPU_METHOD
/begin COMPU_METHOD LINEAR______0_000000__0H___5_133 "" FORM "%7.5" "V" FORMULA "7.7821012e-005*X" FORMULA_INV "12850.0*X" /end COMPU_METHOD
/begin COMPU_METHOD LINEAR______1_000000__1H___8_000 "" FORM "%2.0" "-" FORMULA "1.0*X" FORMULA_INV "1.0*X" /end COMPU_METHOD
/begin COMPU_METHOD LINEAR______0_000000__0H___21134 "" FORM "%6.0" "hPa/10ms" FORMULA "850.0*X" FORMULA_INV "0.0011764706*X" /end COMPU_METHOD
/begin COMPU_METHOD LINEAR______0_000000__0H___16135 "" FORM "%8.2" "hPa/10ms" FORMULA "0.25*X" FORMULA_INV "4.0*X" /end COMPU_METHOD
/begin COMPU_METHOD LINEAR______0_000000__0H___2_400 "" FORM "%5.3" "°TPS/%" FORMULA "0.0094117647*X" FORMULA_INV "106.25*X" /end COMPU_METHOD
/begin COMPU_METHOD LINEAR______0_000000__0H___59_99 "" FORM "%6.3" "°TPS" FORMULA "0.0018310547*X" FORMULA_INV "546.13333*X" /end COMPU_METHOD
/begin COMPU_METHOD LINEAR______0_000000__0H___29136 "" FORM "%4.0" "°TPS" FORMULA "11.717647*X" FORMULA_INV "0.085341365*X" /end COMPU_METHOD
/begin COMPU_METHOD LINEAR______0_000000__0H___5_137 "" FORM "%4.2" "s" FORMULA "0.02*X" FORMULA_INV "50.000001*X" /end COMPU_METHOD
/begin COMPU_METHOD LINEAR______0_000000__0H___29138 "" FORM "%4.0" "°TPS/s" FORMULA "0.045593957*X" FORMULA_INV "21.932731*X" /end COMPU_METHOD
/begin COMPU_METHOD LINEAR______0_000000__0H___29139 "" FORM "%4.0" "°TPS/s" FORMULA "11.717647*X" FORMULA_INV "0.085341365*X" /end COMPU_METHOD
/begin COMPU_METHOD LINEAR______0_000000__0H___76791 "" FORM "%6.0" "°TPS/s" FORMULA "11.717647*X" FORMULA_INV "0.085341365*X" /end COMPU_METHOD
/begin COMPU_METHOD LINEAR______0_000000__0H___11140 "" FORM "%7.3" "°TPS" FORMULA "0.0018310552*X" FORMULA_INV "546.13319*X" /end COMPU_METHOD
/begin COMPU_METHOD LINEAR______0_000000__0H___11141 "" FORM "%7.3" "°TPS/100ms" FORMULA "0.0018310545*X" FORMULA_INV "546.13339*X" /end COMPU_METHOD
/begin COMPU_METHOD LINEAR______0_000000__0H___96_00 "" FORM "%6.3" "°TPS/V" FORMULA "0.0014648661*X" FORMULA_INV "682.65625*X" /end COMPU_METHOD
/begin COMPU_METHOD LINEAR______0_000000__0H___50_00 "" FORM "%6.3" "ohm" FORMULA "0.19607843*X" FORMULA_INV "5.1*X" /end COMPU_METHOD
/begin COMPU_METHOD LINEAR______0_000000__0H___65142 "" FORM "%5.0" "ohm" FORMULA "1.0*X" FORMULA_INV "1.0*X" /end COMPU_METHOD
/begin COMPU_METHOD LINEAR______1_000000__1H___65534 "" FORM "%5.0" "ohm" FORMULA "1.0*X" FORMULA_INV "1.0*X" /end COMPU_METHOD
/begin COMPU_METHOD LINEAR_______128_000000__FFFF143 "" FORM "%4.0" "°C" FORMULA "1.0*X" FORMULA_INV "1.0*X" /end COMPU_METHOD
/begin COMPU_METHOD LINEAR______0_000000__0H___25144 "" FORM "%7.3" "kg/h" FORMULA "0.00390625*X" FORMULA_INV "256.0*X" /end COMPU_METHOD
/begin COMPU_METHOD LINEAR_______512_000000__FFFF800 "" FORM "%7.2" "kg/h" FORMULA "0.015625*X" FORMULA_INV "64.0*X" /end COMPU_METHOD
/begin COMPU_METHOD LINEAR______0_000000__0H___42146 "" FORM "%10.0" "-" FORMULA "1.0*X" FORMULA_INV "1.0*X" /end COMPU_METHOD
/begin COMPU_METHOD LINEAR______0_000000__0H___32766 "" FORM "%5.0" "-" FORMULA "1.0*X" FORMULA_INV "1.0*X" /end COMPU_METHOD
/begin COMPU_METHOD LINEAR______0_000000__0H___25147 "" FORM "%3.0" "cyc" FORMULA "1.0*X" FORMULA_INV "1.0*X" /end COMPU_METHOD
/begin COMPU_METHOD LINEAR______1_000000__1H___25148 "" FORM "%3.0" "s" FORMULA "1.0*X" FORMULA_INV "1.0*X" /end COMPU_METHOD
/begin COMPU_METHOD LINEAR______2_000000__2H___255_0 "" FORM "%3.0" "-" FORMULA "1.0*X" FORMULA_INV "1.0*X" /end COMPU_METHOD
/begin COMPU_METHOD LINEAR______1_000000__1H___10_00 "" FORM "%2.0" "-" FORMULA "1.0*X" FORMULA_INV "1.0*X" /end COMPU_METHOD
/begin COMPU_METHOD LINEAR______0_300000__3H___6553_ "" FORM "%6.1" "s" FORMULA "0.1*X" FORMULA_INV "10.0*X" /end COMPU_METHOD
/begin COMPU_METHOD LINEAR______0_100000__1H___65149 "" FORM "%6.1" "s" FORMULA "0.1*X+1.3877788e-017" FORMULA_INV "10.0*X-1.3877788e-016" /end COMPU_METHOD
/begin COMPU_METHOD LINEAR______0_001000__1H___0_256 "" FORM "%5.3" "s" FORMULA "0.001003937*X-3.9370079e-006" FORMULA_INV "996.07843*X+0.0039215686" /end COMPU_METHOD
/begin COMPU_METHOD LINEAR______0_001000__1H___0_008 "" FORM "%5.3" "s" FORMULA "0.001*X" FORMULA_INV "1000.0*X" /end COMPU_METHOD
/begin COMPU_METHOD LINEAR______0_020000__1H___25_50 "" FORM "%5.2" "s" FORMULA "0.02*X" FORMULA_INV "50.0*X" /end COMPU_METHOD
/begin COMPU_METHOD LINEAR______0_020000__1H___5_100 "" FORM "%4.2" "s" FORMULA "0.02*X+3.9370078e-010" FORMULA_INV "50.000001*X-1.968504e-008" /end COMPU_METHOD
/begin COMPU_METHOD LINEAR_______640_020000__FFFF800 "" FORM "%7.2" "ms" FORMULA "0.019531548*X-0.010234226" FORMULA_INV "51.199219*X+0.52398437" /end COMPU_METHOD
/begin COMPU_METHOD LINEAR______1_000000__1H___65535 "" FORM "%5.0" "s" FORMULA "1.0*X" FORMULA_INV "1.0*X" /end COMPU_METHOD
/begin COMPU_METHOD LINEAR______0_020000__1H___10_00 "" FORM "%5.2" "s" FORMULA "0.02*X" FORMULA_INV "50.0*X" /end COMPU_METHOD
/begin COMPU_METHOD LINEAR______0_000000__0H___10_00 "" FORM "%4.2" "s" FORMULA "0.01*X" FORMULA_INV "100.0*X" /end COMPU_METHOD
/begin COMPU_METHOD LINEAR______1_000000__1H___25_50 "" FORM "%4.1" "s" FORMULA "0.096456693*X+0.90354331" FORMULA_INV "10.367347*X-9.3673469" /end COMPU_METHOD
/begin COMPU_METHOD LINEAR_______640_000000__8000000 "" FORM "%12.7" "ms" FORMULA "2.9802322e-007*X-1.509884e-007" FORMULA_INV "3355443.2*X+0.506633" /end COMPU_METHOD
/begin COMPU_METHOD LINEAR______1_000000__1H___65151 "" FORM "%5.0" "s" FORMULA "1.0*X" FORMULA_INV "1.0*X" /end COMPU_METHOD
/begin COMPU_METHOD LINEAR______0_000000__0H___65152 "" FORM "%5.0" "s" FORMULA "1.0*X" FORMULA_INV "1.0*X" /end COMPU_METHOD
/begin COMPU_METHOD LINEAR______0_000000__0H___1_153 "" FORM "%4.3" "s" FORMULA "0.005*X" FORMULA_INV "200.0*X" /end COMPU_METHOD
/begin COMPU_METHOD LINEAR______0_000000__0H___10154 "" FORM "%2.0" "s" FORMULA "1.0*X" FORMULA_INV "1.0*X" /end COMPU_METHOD
/begin COMPU_METHOD LINEAR______0_010000__1H___65155 "" FORM "%6.2" "s" FORMULA "0.0099999996*X+3.7247841e-010" FORMULA_INV "100.0*X-3.7247842e-008" /end COMPU_METHOD
/begin COMPU_METHOD LINEAR______0_000000__0H___26156 "" FORM "%7.2" "s" FORMULA "0.04*X" FORMULA_INV "25.0*X" /end COMPU_METHOD
/begin COMPU_METHOD LINEAR______0_000000__0H___2540_ "" FORM "%4.0" "ms" FORMULA "10.0*X" FORMULA_INV "0.1*X" /end COMPU_METHOD
/begin COMPU_METHOD LINEAR______0_000000__0H___65157 "" FORM "%6.2" "s" FORMULA "0.0099999996*X" FORMULA_INV "100.0*X" /end COMPU_METHOD
/begin COMPU_METHOD LINEAR______10_000000__0H___2560 "" FORM "%4.0" "ms" FORMULA "10.0*X+10.0" FORMULA_INV "0.1*X-1.0" /end COMPU_METHOD
/begin COMPU_METHOD LINEAR______0_000000__0H___25158 "" FORM "%4.0" "*100ms" FORMULA "1.0*X" FORMULA_INV "1.0*X" /end COMPU_METHOD
/begin COMPU_METHOD LINEAR______0_000000__0H___2_159 "" FORM "%4.1" "s" FORMULA "0.0099999998*X" FORMULA_INV "100.0*X" /end COMPU_METHOD
/begin COMPU_METHOD LINEAR______100_000000__1H___100 "" FORM "%6.0" "ms" FORMULA "100.0*X" FORMULA_INV "0.01*X" /end COMPU_METHOD
/begin COMPU_METHOD LINEAR______0_000000__0H___5_160 "" FORM "%4.3" "s" FORMULA "0.005*X" FORMULA_INV "200.0*X" /end COMPU_METHOD
/begin COMPU_METHOD LINEAR______0_000000__0H___25161 "" FORM "%3.0" "*100ms" FORMULA "1.0*X" FORMULA_INV "1.0*X" /end COMPU_METHOD
/begin COMPU_METHOD LINEAR______0_200000__0H___51_00 "" FORM "%4.1" "s" FORMULA "0.2*X+0.2" FORMULA_INV "5.0*X-1.0" /end COMPU_METHOD
/begin COMPU_METHOD LINEAR______0_200000__1H___51_00 "" FORM "%4.1" "s" FORMULA "0.2*X+2.7755576e-017" FORMULA_INV "5.0*X-1.3877788e-016" /end COMPU_METHOD
/begin COMPU_METHOD LINEAR______1000_000000__64H___2 "" FORM "%4.0" "ms" FORMULA "10.0*X" FORMULA_INV "0.1*X" /end COMPU_METHOD
/begin COMPU_METHOD LINEAR______0_000000__0H___1310_ "" FORM "%7.2" "s" FORMULA "0.019999999*X" FORMULA_INV "50.000002*X" /end COMPU_METHOD
/begin COMPU_METHOD LINEAR______0_000000__0H___25162 "" FORM "%4.0" "s" FORMULA "10.0*X" FORMULA_INV "0.1*X" /end COMPU_METHOD
/begin COMPU_METHOD LINEAR______0_010000__0H___655_3 "" FORM "%6.2" "s" FORMULA "0.01*X+0.01" FORMULA_INV "100.0*X-1.0" /end COMPU_METHOD
/begin COMPU_METHOD LINEAR______0_000000__0H___2_163 "" FORM "%3.2" "s" FORMULA "0.0099999998*X" FORMULA_INV "100.0*X" /end COMPU_METHOD
/begin COMPU_METHOD LINEAR______0_000000__0H___327_6 "" FORM "%6.2" "s" FORMULA "0.01*X" FORMULA_INV "100.0*X" /end COMPU_METHOD
/begin COMPU_METHOD LINEAR______0_000000__0H___127_0 "" FORM "%3.0" "°C" FORMULA "1.0*X" FORMULA_INV "1.0*X" /end COMPU_METHOD
/begin COMPU_METHOD LINEAR______0_000000__0H___25164 "" FORM "%3.0" "°C" FORMULA "1.0*X" FORMULA_INV "1.0*X" /end COMPU_METHOD
/begin COMPU_METHOD LINEAR_______48_000000__0H___165 "" FORM "%3.0" "°C" FORMULA "0.75*X-48.0" FORMULA_INV "1.3333333*X+64.0" /end COMPU_METHOD
/begin COMPU_METHOD LINEAR______0_000000__0H___190_5 "" FORM "%5.1" "°C" FORMULA "0.75*X" FORMULA_INV "1.3333333*X" /end COMPU_METHOD
/begin COMPU_METHOD LINEAR______0_000000__0H___60_00 "" FORM "%5.2" "°C" FORMULA "0.75*X" FORMULA_INV "1.3333333*X" /end COMPU_METHOD
/begin COMPU_METHOD LINEAR_______48_000000__FFFFFFC0 "" FORM "%5.1" "°C" FORMULA "0.75*X" FORMULA_INV "1.3333333*X" /end COMPU_METHOD
/begin COMPU_METHOD LINEAR______0_000000__0H___19166 "" FORM "%5.1" "°C/500ms" FORMULA "0.75*X" FORMULA_INV "1.3333333*X" /end COMPU_METHOD
/begin COMPU_METHOD LINEAR______0_000000__0H___60167 "" FORM "%3.0" "°C" FORMULA "0.75*X" FORMULA_INV "1.3333333*X" /end COMPU_METHOD
/begin COMPU_METHOD LINEAR______0_000000__0H___1020_ "" FORM "%4.0" "°C" FORMULA "4.0*X" FORMULA_INV "0.25*X" /end COMPU_METHOD
/begin COMPU_METHOD LINEAR______0_000000__0H___191_2 "" FORM "%6.2" "°C/500ms" FORMULA "0.75*X" FORMULA_INV "1.3333333*X" /end COMPU_METHOD
/begin COMPU_METHOD LINEAR_______200_000000__FFFF168 "" FORM "%7.3" "mA" FORMULA "0.0061035142*X-4.8242924e-005" FORMULA_INV "163.84004*X+0.0079041225" /end COMPU_METHOD
/begin COMPU_METHOD LINEAR______0_000000__8000H___5_ "" FORM "%5.2" "ms" FORMULA "0.004*X-131.072" FORMULA_INV "250.0*X+32768.0" /end COMPU_METHOD
/begin COMPU_METHOD LINEAR_______5_000000__7B1EH___0 "" FORM "%6.3" "ms" FORMULA "0.004*X-131.072" FORMULA_INV "250.0*X+32768.0" /end COMPU_METHOD
/begin COMPU_METHOD LINEAR______0_000000__0H___13_33 "" FORM "%6.3" "ms" FORMULA "0.0053333333*X" FORMULA_INV "187.5*X" /end COMPU_METHOD
/begin COMPU_METHOD LINEAR______0_000000__0H___10169 "" FORM "%6.4" "%" FORMULA "0.0015260186*X" FORMULA_INV "655.3*X" /end COMPU_METHOD
/begin COMPU_METHOD LINEAR______0_000000__0H___174_7 "" FORM "%7.3" "ms" FORMULA "0.0053333333*X" FORMULA_INV "187.5*X" /end COMPU_METHOD
/begin COMPU_METHOD LINEAR_______174_762666__FFFF800 "" FORM "%7.2" "ms" FORMULA "0.0053333333*X" FORMULA_INV "187.5*X" /end COMPU_METHOD
/begin COMPU_METHOD LINEAR______0_000000__0H___2_984 "" FORM "%6.4" "-" FORMULA "0.00024414267*X" FORMULA_INV "4095.9657*X" /end COMPU_METHOD
/begin COMPU_METHOD LINEAR______0_000000__0H___0_170 "" FORM "%5.3" "-/seg" FORMULA "0.0019531373*X" FORMULA_INV "511.99679*X" /end COMPU_METHOD
/begin COMPU_METHOD LINEAR______0_000000__0H___0_171 "" FORM "%6.4" "-/seg" FORMULA "0.00048823529*X" FORMULA_INV "2048.1928*X" /end COMPU_METHOD
/begin COMPU_METHOD LINEAR______0_000000__0H___0_500 "" FORM "%5.3" "-" FORMULA "0.00390625*X" FORMULA_INV "256.0*X" /end COMPU_METHOD
/begin COMPU_METHOD LINEAR______0_000488__1H___0_172 "" FORM "%5.3" "-/100ms" FORMULA "0.00048827559*X-2.7559055e-007" FORMULA_INV "2048.0237*X+0.00056441599" /end COMPU_METHOD
/begin COMPU_METHOD LINEAR______0_003906__0H___0_996 "" FORM "%5.3" "-" FORMULA "0.0039062746*X-2.4606299e-008" FORMULA_INV "255.99839*X+6.2991729e-006" /end COMPU_METHOD
/begin COMPU_METHOD LINEAR______0_003906__1H___0_996 "" FORM "%5.3" "-" FORMULA "0.00390625*X" FORMULA_INV "256.0*X" /end COMPU_METHOD
/begin COMPU_METHOD LINEAR_______1_000000__FFFF8000H "" FORM "%8.5" "-" FORMULA "3.0518044e-005*X+1.5259022e-005" FORMULA_INV "32767.5*X-0.5" /end COMPU_METHOD
/begin COMPU_METHOD LINEAR______0_000000__0H___1_173 "" FORM "%7.5" "s/kg" FORMULA "1.5259022e-005*X" FORMULA_INV "65535.0*X" /end COMPU_METHOD
/begin COMPU_METHOD LINEAR______0_000000__0H___203_0 "" FORM "%5.1" "°C/500ms" FORMULA "0.79607843*X" FORMULA_INV "1.2561576*X" /end COMPU_METHOD
/begin COMPU_METHOD LINEAR______0_000000__0H___20174 "" FORM "%5.1" "°C" FORMULA "0.79607843*X" FORMULA_INV "1.2561576*X" /end COMPU_METHOD
/begin COMPU_METHOD LINEAR______0_000000__0H___101_5 "" FORM "%5.1" "°C" FORMULA "0.79296875*X" FORMULA_INV "1.2610837*X" /end COMPU_METHOD
/begin COMPU_METHOD LINEAR______0_000000__0H___51000 "" FORM "%5.0" "ms" FORMULA "200.0*X" FORMULA_INV "0.005*X" /end COMPU_METHOD
/begin COMPU_METHOD LINEAR______0_468750__40H___119_ "" FORM "%6.3" "°TPS" FORMULA "0.0072940284*X+0.0019321803" FORMULA_INV "137.09845*X-0.26489892" /end COMPU_METHOD
/begin COMPU_METHOD LINEAR______0_000000__0H___11175 "" FORM "%7.3" "-" FORMULA "0.0018310545*X" FORMULA_INV "546.13339*X" /end COMPU_METHOD
/begin COMPU_METHOD LINEAR______0_000000__0H___99_21 "" FORM "%4.1" "%" FORMULA "0.390625*X" FORMULA_INV "2.56*X" /end COMPU_METHOD
/begin COMPU_METHOD LINEAR______0_000000__0H___1398_ "" FORM "%7.2" "-" FORMULA "0.021332113*X" FORMULA_INV "46.877682*X" /end COMPU_METHOD
/begin COMPU_METHOD LINEAR______0_000000__0H___13176 "" FORM "%5.1" "-" FORMULA "0.021332113*X" FORMULA_INV "46.877682*X" /end COMPU_METHOD
/begin COMPU_METHOD LINEAR______0_000000__0H___48177 "" FORM "%6.3" "°TPS/V" FORMULA "0.00073243305*X" FORMULA_INV "1365.3125*X" /end COMPU_METHOD
/begin COMPU_METHOD LINEAR______0_000000__0H___48178 "" FORM "%5.2" "°TPS/V" FORMULA "0.011764706*X" FORMULA_INV "85.0*X" /end COMPU_METHOD
/begin COMPU_METHOD LINEAR______0_007294__1H___1_860 "" FORM "%4.3" "°TPS/5ms" FORMULA "0.0072941451*X+4.9212598e-009" FORMULA_INV "137.09626*X-6.7468631e-007" /end COMPU_METHOD
/begin COMPU_METHOD LINEAR_______119_500000__FFFFC00 "" FORM "%8.3" "°TPS" FORMULA "0.0072941464*X" FORMULA_INV "137.09623*X" /end COMPU_METHOD
/begin COMPU_METHOD LINEAR______0_007294__1H___1_179 "" FORM "%4.3" "°TPS" FORMULA "0.0072941451*X+4.9212598e-009" FORMULA_INV "137.09626*X-6.7468631e-007" /end COMPU_METHOD
/begin COMPU_METHOD LINEAR______0_000000__0H___10180 "" FORM "%7.3" "%/10ms" FORMULA "0.0015259022*X" FORMULA_INV "655.35*X" /end COMPU_METHOD
/begin COMPU_METHOD LINEAR_______1023_000000__FFFF80 "" FORM "%8.2" "Nm" FORMULA "0.031219482*X+2.4121459e-007" FORMULA_INV "32.031281*X-7.7264123e-006" /end COMPU_METHOD
/begin COMPU_METHOD LINEAR______0_000000__0H___10181 "" FORM "%7.3" "Nm/10ms" FORMULA "0.015625*X" FORMULA_INV "64.0*X" /end COMPU_METHOD
/begin COMPU_METHOD LINEAR______0_000000__0H___31_87 "" FORM "%5.2" "Nm" FORMULA "0.125*X" FORMULA_INV "8.0*X" /end COMPU_METHOD
/begin COMPU_METHOD LINEAR______0_000000__0H___51182 "" FORM "%4.0" "Nm" FORMULA "2.0*X" FORMULA_INV "0.5*X" /end COMPU_METHOD
/begin COMPU_METHOD LINEAR______0_000000__0H___65183 "" FORM "%6.1" "h" FORMULA "0.1*X" FORMULA_INV "10.0*X" /end COMPU_METHOD
/begin COMPU_METHOD LINEAR______0_000000__0H___5_184 "" FORM "%5.3" "V" FORMULA "0.0048875855*X" FORMULA_INV "204.6*X" /end COMPU_METHOD
/begin COMPU_METHOD LINEAR______0_000000__0H___1_245 "" FORM "%5.3" "V" FORMULA "0.0048828125*X" FORMULA_INV "204.8*X" /end COMPU_METHOD
/begin COMPU_METHOD LINEAR______0_000000__0H___79_68 "" FORM "%4.1" "%/V" FORMULA "0.3125*X" FORMULA_INV "3.2*X" /end COMPU_METHOD
/begin COMPU_METHOD LINEAR______0_000000__0H___15185 "" FORM "%5.1" "%/V" FORMULA "0.625*X" FORMULA_INV "1.6*X" /end COMPU_METHOD
/begin COMPU_METHOD LINEAR______0_000000__0H___2_490 "" FORM "%5.3" "V" FORMULA "0.009765625*X" FORMULA_INV "102.4*X" /end COMPU_METHOD
/begin COMPU_METHOD LINEAR______0_000000__0H___26186 "" FORM "%3.1" "V" FORMULA "0.10196078*X" FORMULA_INV "9.8076923*X" /end COMPU_METHOD
/begin COMPU_METHOD LINEAR______0_000000__0H___10187 "" FORM "%4.1" "V" FORMULA "0.039215686*X" FORMULA_INV "25.5*X" /end COMPU_METHOD
/begin COMPU_METHOD LINEAR______0_000000__0H___0_250 "" FORM "%6.4" "-" FORMULA "0.00098039216*X" FORMULA_INV "1020.0*X" /end COMPU_METHOD
/begin COMPU_METHOD LINEAR______0_005000__1H___1_240 "" FORM "%5.3" "V" FORMULA "0.0048814229*X+0.00011857708" FORMULA_INV "204.8583*X-0.024291498" /end COMPU_METHOD
/begin COMPU_METHOD LINEAR______0_000000__0H___4_188 "" FORM "%5.2" "V" FORMULA "0.01953125*X" FORMULA_INV "51.2*X" /end COMPU_METHOD
/begin COMPU_METHOD LINEAR______0_000000__0H___63189 "" FORM "%5.2" "km/h" FORMULA "0.25*X" FORMULA_INV "4.0*X" /end COMPU_METHOD
/begin COMPU_METHOD LINEAR______0_000000__0H___25190 "" FORM "%7.3" "km/h" FORMULA "0.0078124998*X" FORMULA_INV "128.0*X" /end COMPU_METHOD
/begin COMPU_METHOD LINEAR_______256_000000__FFFF800 "" FORM "%8.3" "km/h" FORMULA "0.0078125*X" FORMULA_INV "128.0*X" /end COMPU_METHOD
/begin COMPU_METHOD LINEAR_______256_000000__FFFF191 "" FORM "%6.2" "km/h" FORMULA "0.0078124999*X-3.7500572e-006" FORMULA_INV "128.0*X+0.00048000733" /end COMPU_METHOD
/begin COMPU_METHOD LINEAR______0_000000__0H___31192 "" FORM "%5.2" "km/h" FORMULA "0.125*X" FORMULA_INV "8.0*X" /end COMPU_METHOD
/begin COMPU_METHOD LINEAR______1000_000000__3E8H___ "" FORM "%5.0" "imp/km" FORMULA "1.0*X" FORMULA_INV "1.0*X" /end COMPU_METHOD
/begin COMPU_METHOD LINEAR______0_000000__0H___25193 "" FORM "%7.3" "km/h" FORMULA "0.0078124998*X" FORMULA_INV "128.0*X" /end COMPU_METHOD
/begin COMPU_METHOD LINEAR______0_000000__0H___51194 "" FORM "%3.0" "km/h" FORMULA "2.0*X" FORMULA_INV "0.5*X" /end COMPU_METHOD
/begin COMPU_METHOD LINEAR______48_000000__FFFFFF80H "" FORM "%4.1" "°CRK" FORMULA "-0.375*X" FORMULA_INV "-2.6666667*X" /end COMPU_METHOD
/begin COMPU_METHOD LINEAR______48_000000__FFFFFF195 "" FORM "%6.2" "°CRK" FORMULA "-0.375*X" FORMULA_INV "-2.6666667*X" /end COMPU_METHOD
/begin COMPU_METHOD defaultConversion "" FORM "%8.4" "[]" FORMULA "1.0*X" FORMULA_INV "1.0*X" /end COMPU_METHOD
/begin COMPU_METHOD defaultConversion196 "" FORM "%8.4" "[]" FORMULA "1.0*X" FORMULA_INV "1.0*X" /end COMPU_METHOD
/begin COMPU_METHOD defaultConversion197 "" FORM "%8.4" "[]" FORMULA "1.0*X" FORMULA_INV "1.0*X" /end COMPU_METHOD
/begin RECORD_LAYOUT a_85 FNC_VALUES 1 UWORD ROW_DIR DIRECT /end RECORD_LAYOUT
/begin RECORD_LAYOUT a_86 FNC_VALUES 1 UBYTE ROW_DIR DIRECT /end RECORD_LAYOUT
/begin RECORD_LAYOUT a_87 FNC_VALUES 1 SBYTE ROW_DIR DIRECT /end RECORD_LAYOUT
/begin RECORD_LAYOUT a_95 FNC_VALUES 1 SWORD ROW_DIR DIRECT /end RECORD_LAYOUT
/begin RECORD_LAYOUT a_145 FNC_VALUES 1 ULONG ROW_DIR DIRECT /end RECORD_LAYOUT
/begin RECORD_LAYOUT a_150 FNC_VALUES 1 SLONG ROW_DIR DIRECT /end RECORD_LAYOUT
/end MODULE
/end PROJECT
