ASAP2_VERSION 1 2
/begin PROJECT Z42D "011"
/begin HEADER "" VERSION "0AD.03" PROJECT_NO Z011 /end HEADER
/begin MODULE BMW-EASY ""
/begin MOD_COMMON "common attributes" DEPOSIT ABSOLUT BYTE_ORDER BIG_ENDIAN /end MOD_COMMON
/begin CHARACTERISTIC ID_ECU_SAM_TIME2C241D "" VALUE 0x4febe a_174 100 defaultConversion707 0 65535 BIT_MASK 0xffffffff /end CHARACTERISTIC
/begin CHARACTERISTIC ID_ECU_SAM_TIME2C242D "" VALUE 0x4fec0 a_174 100 defaultConversion708 0 65535 BIT_MASK 0xffffffff /end CHARACTERISTIC
/begin CHARACTERISTIC ID_ECU_SAM_TIME2C243D "" VALUE 0x4fec2 a_174 100 defaultConversion709 0 65535 BIT_MASK 0xffffffff /end CHARACTERISTIC
/begin CHARACTERISTIC ID_ECU_SAM_TIME2C244D "" VALUE 0x4fec4 a_174 100 defaultConversion710 0 65535 BIT_MASK 0xffffffff /end CHARACTERISTIC
/begin CHARACTERISTIC ID_ECU_SAM_TIME2C245D "" VALUE 0x4fec6 a_174 100 defaultConversion711 0 65535 BIT_MASK 0xffffffff /end CHARACTERISTIC
/begin CHARACTERISTIC ID_ECU_SAM_TIME2C246D "" VALUE 0x4fec8 a_174 100 defaultConversion712 0 65535 BIT_MASK 0xffffffff /end CHARACTERISTIC
/begin CHARACTERISTIC ID_ECU_SAM_TIME2C247D "" VALUE 0x4feca a_174 100 defaultConversion713 0 65535 BIT_MASK 0xffffffff /end CHARACTERISTIC
/begin CHARACTERISTIC ID_ECU_SAM_TIME2C248D "" VALUE 0x4fecc a_174 100 defaultConversion714 0 65535 BIT_MASK 0xffffffff /end CHARACTERISTIC
/begin CHARACTERISTIC ID_ECU_SAM_TIME2C249D "" VALUE 0x4fece a_174 100 defaultConversion715 0 65535 BIT_MASK 0xffffffff /end CHARACTERISTIC
/begin CHARACTERISTIC ID_ECU_SAM_TIME2C250D "" VALUE 0x4fed0 a_174 100 defaultConversion716 0 65535 BIT_MASK 0xffffffff /end CHARACTERISTIC
/begin CHARACTERISTIC ID_ECU_SAM_TIME2C251D "" VALUE 0x4fed2 a_174 100 defaultConversion717 0 65535 BIT_MASK 0xffffffff /end CHARACTERISTIC
/begin CHARACTERISTIC ID_ECU_SAM_TIME2C252D "" VALUE 0x4fed4 a_174 100 defaultConversion718 0 65535 BIT_MASK 0xffffffff /end CHARACTERISTIC
/begin CHARACTERISTIC ID_ECU_SAM_TIME2C253D "" VALUE 0x4fed6 a_174 100 defaultConversion719 0 65535 BIT_MASK 0xffffffff /end CHARACTERISTIC
/begin CHARACTERISTIC ID_ECU_SAM_TIME2C254D "" VALUE 0x4fed8 a_174 100 defaultConversion720 0 65535 BIT_MASK 0xffffffff /end CHARACTERISTIC
/begin CHARACTERISTIC ID_ECU_SAM_TIME2C255D "" VALUE 0x4feda a_174 100 defaultConversion721 0 65535 BIT_MASK 0xffffffff /end CHARACTERISTIC
/begin CHARACTERISTIC ID_ECU_SAM_TIME2C256D "" VALUE 0x4fedc a_174 100 defaultConversion722 0 65535 BIT_MASK 0xffffffff /end CHARACTERISTIC
/begin CHARACTERISTIC ID_ECU_SAM_TIME2C257D "" VALUE 0x4fede a_174 100 defaultConversion723 0 65535 BIT_MASK 0xffffffff /end CHARACTERISTIC
/begin CHARACTERISTIC IN_RANGE_PERIOD_COUNT_LIMIT "IN_RANGE_PERIOD_COUNT_LIMIT" VALUE 0x487ea a_175 100 SIGNEDCHAR -128.0 127.0 BIT_MASK 0xffffffff /end CHARACTERISTIC
/begin CHARACTERISTIC IN_RANGE_PERIOD_HIGH "IN_RANGE_PERIOD_HIGH" VALUE 0x4848e a_174 100 LINEAR______0_000000__0H___65163 0.0 65535.0 BIT_MASK 0xffffffff /end CHARACTERISTIC
/begin CHARACTERISTIC IN_RANGE_PERIOD_LOW "IN_RANGE_PERIOD_LOW" VALUE 0x48490 a_174 100 LINEAR______0_000000__0H___65163 0.0 65535.0 BIT_MASK 0xffffffff /end CHARACTERISTIC
/begin CHARACTERISTIC IN_RANGE_PERIOD_START "IN_RANGE_PERIOD_START" VALUE 0x487eb a_175 100 SIGNEDCHAR -128.0 127.0 BIT_MASK 0xffffffff /end CHARACTERISTIC
/begin CHARACTERISTIC INCREASE_LIMIT "INCREASE_LIMIT" VALUE 0x480de a_172 100 LINEAR_______32768_000000__FF180 -32768.0 32767.0 BIT_MASK 0xffffffff /end CHARACTERISTIC
/begin CHARACTERISTIC instr2_zyka_max "INSTR2_ZYKA_MAX" VALUE 0x48238 a_173 100 LINEAR______1_000000__1H___255_0 1.0 255.0 BIT_MASK 0xffffffff /end CHARACTERISTIC
/begin CHARACTERISTIC instr3_zyka_max "INSTR3_ZYKA_MAX" VALUE 0x48239 a_173 19 LINEAR______1_000000__1H___255_0 1.0 255.0 BIT_MASK 0xffffffff /end CHARACTERISTIC
/begin CHARACTERISTIC k_anz_frq_diag_min "K_ANZ_FRQ_DIAG_MIN" VALUE 0x48492 a_174 100 LINEAR______0_000000__0H___65164 0.0 65534.0 BIT_MASK 0xffffffff /end CHARACTERISTIC
/begin CHARACTERISTIC k_anz_kat_diag_max "K_ANZ_KAT_DIAG_MAX" VALUE 0x48494 a_174 100 LINEAR______0_000000__0H___65163 0.0 65535.0 BIT_MASK 0xffffffff /end CHARACTERISTIC
/begin CHARACTERISTIC k_anz_uls_kat_diag_min "K_ANZ_ULS_KAT_DIAG_MIN" VALUE 0x4823a a_173 10 LINEAR______1_000000__1H___25186 1.0 255.0 BIT_MASK 0xffffffff /end CHARACTERISTIC
/begin CHARACTERISTIC k_delta_uls_kat_diag_min "K_DELTA_ULS_KAT_DIAG_MIN" VALUE 0x4823b a_173 100 LINEAR______0_000000__0H___1_275 0.0 1.275 BIT_MASK 0xffffffff /end CHARACTERISTIC
/begin CHARACTERISTIC k_dk_grd_dec "K_DK_GRD_DEC" VALUE 0x4823c a_173 100 LINEAR______0_000000__0H___29724 0.0 2988.0 BIT_MASK 0xffffffff /end CHARACTERISTIC
/begin CHARACTERISTIC k_dk_grd_dec_anz "K_DK_GRD_DEC_ANZ" VALUE 0x4823d a_173 100 LINEAR______0_000000__0H___5_725 0.0 5.0999999 BIT_MASK 0xffffffff /end CHARACTERISTIC
/begin CHARACTERISTIC k_dk_grd_dec_anz_zv "K_DK_GRD_DEC_ANZ_ZV" VALUE 0x4823e a_173 100 LINEAR______0_000000__0H___25726 0.0 25.5 BIT_MASK 0xffffffff /end CHARACTERISTIC
/begin CHARACTERISTIC k_dk_grd_dec_zv "K_DK_GRD_DEC_ZV" VALUE 0x4823f a_173 100 LINEAR______0_000000__0H___29724 0.0 2988.0 BIT_MASK 0xffffffff /end CHARACTERISTIC
/begin CHARACTERISTIC k_dk_grd_sum_max "K_DK_GRD_SUM_MAX" VALUE 0x48496 a_174 100 LINEAR______0_000000__0H___76791 0.0 767916.0 BIT_MASK 0xffffffff /end CHARACTERISTIC
/begin CHARACTERISTIC k_dk_grd_sum_max_zv "K_DK_GRD_SUM_MAX_ZV" VALUE 0x48498 a_174 100 LINEAR______0_000000__0H___76791 0.0 767916.0 BIT_MASK 0xffffffff /end CHARACTERISTIC
/begin CHARACTERISTIC k_dk_grd_sum_min "K_DK_GRD_SUM_MIN" VALUE 0x4849a a_174 100 LINEAR______0_000000__0H___76791 0.0 767916.0 BIT_MASK 0xffffffff /end CHARACTERISTIC
/begin CHARACTERISTIC k_dk_grd_sum_min_zv "K_DK_GRD_SUM_MIN_ZV" VALUE 0x4849c a_174 100 LINEAR______0_000000__0H___76791 0.0 767916.0 BIT_MASK 0xffffffff /end CHARACTERISTIC
/begin CHARACTERISTIC k_dtc_ak "K_DTC_AK" VALUE 0x4849e a_174 100 LINEAR______0_000000__0H___65163 0.0 65535.0 BIT_MASK 0xffffffff /end CHARACTERISTIC
/begin CHARACTERISTIC k_dtc_bls_plaus "K_DTC_BLS_PLAUS" VALUE 0x484a0 a_174 100 LINEAR______0_000000__0H___65163 0.0 65535.0 BIT_MASK 0xffffffff /end CHARACTERISTIC
/begin CHARACTERISTIC k_dtc_bls_pwg "K_DTC_BLS_PWG" VALUE 0x484a2 a_174 100 LINEAR______0_000000__0H___65163 0.0 65535.0 BIT_MASK 0xffffffff /end CHARACTERISTIC
/begin CHARACTERISTIC k_dtc_can_b_o "K_DTC_CAN_B_O" VALUE 0x484a4 a_174 100 LINEAR______0_000000__0H___65163 0.0 65535.0 BIT_MASK 0xffffffff /end CHARACTERISTIC
/begin CHARACTERISTIC k_dtc_ct "K_DTC_CT" VALUE 0x484a6 a_174 100 LINEAR______0_000000__0H___65163 0.0 65535.0 BIT_MASK 0xffffffff /end CHARACTERISTIC
/begin CHARACTERISTIC k_dtc_cu "K_DTC_CU" VALUE 0x484a8 a_174 100 LINEAR______0_000000__0H___65163 0.0 65535.0 BIT_MASK 0xffffffff /end CHARACTERISTIC
/begin CHARACTERISTIC k_dtc_disa "K_DTC_DISA" VALUE 0x484aa a_174 100 LINEAR______0_000000__0H___65163 0.0 65535.0 BIT_MASK 0xffffffff /end CHARACTERISTIC
/begin CHARACTERISTIC k_dtc_elm "K_DTC_ELM" VALUE 0x484ac a_174 100 LINEAR______0_000000__0H___65163 0.0 65535.0 BIT_MASK 0xffffffff /end CHARACTERISTIC
/begin CHARACTERISTIC k_dtc_ev_0 "K_DTC_EV_0" VALUE 0x484ae a_174 100 LINEAR______0_000000__0H___65163 0.0 65535.0 BIT_MASK 0xffffffff /end CHARACTERISTIC
/begin CHARACTERISTIC k_dtc_ev_1 "K_DTC_EV_1" VALUE 0x484b0 a_174 100 LINEAR______0_000000__0H___65163 0.0 65535.0 BIT_MASK 0xffffffff /end CHARACTERISTIC
/begin CHARACTERISTIC k_dtc_ev_2 "K_DTC_EV_2" VALUE 0x484b2 a_174 100 LINEAR______0_000000__0H___65163 0.0 65535.0 BIT_MASK 0xffffffff /end CHARACTERISTIC
/begin CHARACTERISTIC k_dtc_ev_3 "K_DTC_EV_3" VALUE 0x484b4 a_174 100 LINEAR______0_000000__0H___65163 0.0 65535.0 BIT_MASK 0xffffffff /end CHARACTERISTIC
/begin CHARACTERISTIC k_dtc_ev_4 "K_DTC_EV_4" VALUE 0x484b6 a_174 100 LINEAR______0_000000__0H___65163 0.0 65535.0 BIT_MASK 0xffffffff /end CHARACTERISTIC
/begin CHARACTERISTIC k_dtc_ev_5 "K_DTC_EV_5" VALUE 0x484b8 a_174 100 LINEAR______0_000000__0H___65163 0.0 65535.0 BIT_MASK 0xffffffff /end CHARACTERISTIC
/begin CHARACTERISTIC k_dtc_fc_tev "K_DTC_FC_TEV" VALUE 0x484ba a_174 100 LINEAR______0_000000__0H___65163 0.0 65535.0 BIT_MASK 0xffffffff /end CHARACTERISTIC
/begin CHARACTERISTIC k_dtc_h_bridge "K_DTC_H_BRIDGE" VALUE 0x484bc a_174 100 LINEAR______0_000000__0H___65163 0.0 65535.0 BIT_MASK 0xffffffff /end CHARACTERISTIC
/begin CHARACTERISTIC k_dtc_immob "K_DTC_IMMOB" VALUE 0x484be a_174 100 LINEAR______0_000000__0H___65163 0.0 65535.0 BIT_MASK 0xffffffff /end CHARACTERISTIC
/begin CHARACTERISTIC k_dtc_immob_n "K_DTC_IMMOB_N" VALUE 0x484c0 a_174 100 LINEAR______0_000000__0H___65163 0.0 65535.0 BIT_MASK 0xffffffff /end CHARACTERISTIC
/begin CHARACTERISTIC k_dtc_immob_pe "K_DTC_IMMOB_PE" VALUE 0x484c2 a_174 100 LINEAR______0_000000__0H___65163 0.0 65535.0 BIT_MASK 0xffffffff /end CHARACTERISTIC
/begin CHARACTERISTIC k_dtc_katw_1 "K_DTC_KATW_1" VALUE 0x484c4 a_174 100 LINEAR______0_000000__0H___65163 0.0 65535.0 BIT_MASK 0xffffffff /end CHARACTERISTIC
/begin CHARACTERISTIC k_dtc_katw_2 "K_DTC_KATW_2" VALUE 0x484c6 a_174 100 LINEAR______0_000000__0H___65163 0.0 65535.0 BIT_MASK 0xffffffff /end CHARACTERISTIC
/begin CHARACTERISTIC k_dtc_kfk "K_DTC_KFK" VALUE 0x484c8 a_174 100 LINEAR______0_000000__0H___65163 0.0 65535.0 BIT_MASK 0xffffffff /end CHARACTERISTIC
/begin CHARACTERISTIC k_dtc_kr1 "K_DTC_KR1" VALUE 0x484ca a_174 100 LINEAR______0_000000__0H___65163 0.0 65535.0 BIT_MASK 0xffffffff /end CHARACTERISTIC
/begin CHARACTERISTIC k_dtc_kr2 "K_DTC_KR2" VALUE 0x484cc a_174 100 LINEAR______0_000000__0H___65163 0.0 65535.0 BIT_MASK 0xffffffff /end CHARACTERISTIC
/begin CHARACTERISTIC k_dtc_kw "K_DTC_KW" VALUE 0x484ce a_174 100 LINEAR______0_000000__0H___65163 0.0 65535.0 BIT_MASK 0xffffffff /end CHARACTERISTIC
/begin CHARACTERISTIC k_dtc_ldp "K_DTC_LDP" VALUE 0x484d0 a_174 100 LINEAR______0_000000__0H___65163 0.0 65535.0 BIT_MASK 0xffffffff /end CHARACTERISTIC
/begin CHARACTERISTIC k_dtc_leck_gr "K_DTC_LECK_GR" VALUE 0x484d2 a_174 100 LINEAR______0_000000__0H___65163 0.0 65535.0 BIT_MASK 0xffffffff /end CHARACTERISTIC
/begin CHARACTERISTIC k_dtc_leck_kl "K_DTC_LECK_KL" VALUE 0x484d4 a_174 100 LINEAR______0_000000__0H___65163 0.0 65535.0 BIT_MASK 0xffffffff /end CHARACTERISTIC
/begin CHARACTERISTIC k_dtc_ll "K_DTC_LL" VALUE 0x484d6 a_174 100 LINEAR______0_000000__0H___65163 0.0 65535.0 BIT_MASK 0xffffffff /end CHARACTERISTIC
/begin CHARACTERISTIC k_dtc_llfs_1 "K_DTC_LLFS_1" VALUE 0x484d8 a_174 100 LINEAR______0_000000__0H___65163 0.0 65535.0 BIT_MASK 0xffffffff /end CHARACTERISTIC
/begin CHARACTERISTIC k_dtc_llfs_2 "K_DTC_LLFS_2" VALUE 0x484da a_174 100 LINEAR______0_000000__0H___65163 0.0 65535.0 BIT_MASK 0xffffffff /end CHARACTERISTIC
/begin CHARACTERISTIC k_dtc_llfs_mech "K_DTC_LLFS_MECH" VALUE 0x484dc a_174 100 LINEAR______0_000000__0H___65163 0.0 65535.0 BIT_MASK 0xffffffff /end CHARACTERISTIC
/begin CHARACTERISTIC k_dtc_lm "K_DTC_LM" VALUE 0x484de a_174 100 LINEAR______0_000000__0H___65163 0.0 65535.0 BIT_MASK 0xffffffff /end CHARACTERISTIC
/begin CHARACTERISTIC k_dtc_lm_hfm "K_DTC_LM_HFM" VALUE 0x484e0 a_174 100 LINEAR______0_000000__0H___65163 0.0 65535.0 BIT_MASK 0xffffffff /end CHARACTERISTIC
/begin CHARACTERISTIC k_dtc_lr_anschl_1 "K_DTC_LR_ANSCHL_1" VALUE 0x484e2 a_174 100 LINEAR______0_000000__0H___65163 0.0 65535.0 BIT_MASK 0xffffffff /end CHARACTERISTIC
/begin CHARACTERISTIC k_dtc_lr_anschl_2 "K_DTC_LR_ANSCHL_2" VALUE 0x484e4 a_174 100 LINEAR______0_000000__0H___65163 0.0 65535.0 BIT_MASK 0xffffffff /end CHARACTERISTIC
/begin CHARACTERISTIC k_dtc_lr_grz_1 "K_DTC_LR_GRZ_1" VALUE 0x484e6 a_174 100 LINEAR______0_000000__0H___65163 0.0 65535.0 BIT_MASK 0xffffffff /end CHARACTERISTIC
/begin CHARACTERISTIC k_dtc_lr_grz_2 "K_DTC_LR_GRZ_2" VALUE 0x484e8 a_174 100 LINEAR______0_000000__0H___65163 0.0 65535.0 BIT_MASK 0xffffffff /end CHARACTERISTIC
/begin CHARACTERISTIC k_dtc_lr_trim_nk_1 "K_DTC_LR_TRIM_NK_1" VALUE 0x484ea a_174 100 LINEAR______0_000000__0H___65163 0.0 65535.0 BIT_MASK 0xffffffff /end CHARACTERISTIC
/begin CHARACTERISTIC k_dtc_lr_trim_nk_2 "K_DTC_LR_TRIM_NK_2" VALUE 0x484ec a_174 100 LINEAR______0_000000__0H___65163 0.0 65535.0 BIT_MASK 0xffffffff /end CHARACTERISTIC
/begin CHARACTERISTIC k_dtc_lr_trim_vk_1 "K_DTC_LR_TRIM_VK_1" VALUE 0x484ee a_174 100 LINEAR______0_000000__0H___65163 0.0 65535.0 BIT_MASK 0xffffffff /end CHARACTERISTIC
/begin CHARACTERISTIC k_dtc_lr_trim_vk_2 "K_DTC_LR_TRIM_VK_2" VALUE 0x484f0 a_174 100 LINEAR______0_000000__0H___65163 0.0 65535.0 BIT_MASK 0xffffffff /end CHARACTERISTIC
/begin CHARACTERISTIC k_dtc_ls_freq_1 "K_DTC_LS_FREQ_1" VALUE 0x484f2 a_174 100 LINEAR______0_000000__0H___65163 0.0 65535.0 BIT_MASK 0xffffffff /end CHARACTERISTIC
/begin CHARACTERISTIC k_dtc_ls_freq_2 "K_DTC_LS_FREQ_2" VALUE 0x484f4 a_174 100 LINEAR______0_000000__0H___65163 0.0 65535.0 BIT_MASK 0xffffffff /end CHARACTERISTIC
/begin CHARACTERISTIC k_dtc_lsh_down_1 "K_DTC_LSH_DOWN_1" VALUE 0x484f6 a_174 100 LINEAR______0_000000__0H___65163 0.0 65535.0 BIT_MASK 0xffffffff /end CHARACTERISTIC
/begin CHARACTERISTIC k_dtc_lsh_down_2 "K_DTC_LSH_DOWN_2" VALUE 0x484f8 a_174 100 LINEAR______0_000000__0H___65163 0.0 65535.0 BIT_MASK 0xffffffff /end CHARACTERISTIC
/begin CHARACTERISTIC k_dtc_lsh_obd_down_1 "K_DTC_LSH_OBD_DOWN_1" VALUE 0x484fa a_174 100 LINEAR______0_000000__0H___65163 0.0 65535.0 BIT_MASK 0xffffffff /end CHARACTERISTIC
/begin CHARACTERISTIC k_dtc_lsh_obd_down_2 "K_DTC_LSH_OBD_DOWN_2" VALUE 0x484fc a_174 100 LINEAR______0_000000__0H___65163 0.0 65535.0 BIT_MASK 0xffffffff /end CHARACTERISTIC
/begin CHARACTERISTIC k_dtc_lsh_obd_up_1 "K_DTC_LSH_OBD_UP_1" VALUE 0x484fe a_174 100 LINEAR______0_000000__0H___65163 0.0 65535.0 BIT_MASK 0xffffffff /end CHARACTERISTIC
/begin CHARACTERISTIC k_dtc_lsh_obd_up_2 "K_DTC_LSH_OBD_UP_2" VALUE 0x48500 a_174 100 LINEAR______0_000000__0H___65163 0.0 65535.0 BIT_MASK 0xffffffff /end CHARACTERISTIC
/begin CHARACTERISTIC k_dtc_lsh_up_1 "K_DTC_LSH_UP_1" VALUE 0x48502 a_174 100 LINEAR______0_000000__0H___65163 0.0 65535.0 BIT_MASK 0xffffffff /end CHARACTERISTIC
/begin CHARACTERISTIC k_dtc_lsh_up_2 "K_DTC_LSH_UP_2" VALUE 0x48504 a_174 100 LINEAR______0_000000__0H___65163 0.0 65535.0 BIT_MASK 0xffffffff /end CHARACTERISTIC
/begin CHARACTERISTIC k_dtc_lu_adap "K_DTC_LU_ADAP" VALUE 0x48506 a_174 100 LINEAR______0_000000__0H___65163 0.0 65535.0 BIT_MASK 0xffffffff /end CHARACTERISTIC
/begin CHARACTERISTIC k_dtc_mccu_comm "K_DTC_MCCU_COMM" VALUE 0x48508 a_174 100 LINEAR______0_000000__0H___65163 0.0 65535.0 BIT_MASK 0xffffffff /end CHARACTERISTIC
/begin CHARACTERISTIC k_dtc_mdk_adap "K_DTC_MDK_ADAP" VALUE 0x4850a a_174 100 LINEAR______0_000000__0H___65163 0.0 65535.0 BIT_MASK 0xffffffff /end CHARACTERISTIC
/begin CHARACTERISTIC k_dtc_mdk_mech_kl "K_DTC_MDK_MECH_KL" VALUE 0x4850c a_174 100 LINEAR______0_000000__0H___65163 0.0 65535.0 BIT_MASK 0xffffffff /end CHARACTERISTIC
/begin CHARACTERISTIC k_dtc_mdk_mech_ko "K_DTC_MDK_MECH_KO" VALUE 0x4850e a_174 100 LINEAR______0_000000__0H___65163 0.0 65535.0 BIT_MASK 0xffffffff /end CHARACTERISTIC
/begin CHARACTERISTIC k_dtc_mdk_plau "K_DTC_MDK_PLAU" VALUE 0x48510 a_174 100 LINEAR______0_000000__0H___65163 0.0 65535.0 BIT_MASK 0xffffffff /end CHARACTERISTIC
/begin CHARACTERISTIC k_dtc_mdk1 "K_DTC_MDK1" VALUE 0x48512 a_174 100 LINEAR______0_000000__0H___65163 0.0 65535.0 BIT_MASK 0xffffffff /end CHARACTERISTIC
/begin CHARACTERISTIC k_dtc_mdk1_supply "K_DTC_MDK1_SUPPLY" VALUE 0x48514 a_174 100 LINEAR______0_000000__0H___65163 0.0 65535.0 BIT_MASK 0xffffffff /end CHARACTERISTIC
/begin CHARACTERISTIC k_dtc_mdk2 "K_DTC_MDK2" VALUE 0x48516 a_174 100 LINEAR______0_000000__0H___65163 0.0 65535.0 BIT_MASK 0xffffffff /end CHARACTERISTIC
/begin CHARACTERISTIC k_dtc_mdk2_supply "K_DTC_MDK2_SUPPLY" VALUE 0x48518 a_174 100 LINEAR______0_000000__0H___65163 0.0 65535.0 BIT_MASK 0xffffffff /end CHARACTERISTIC
/begin CHARACTERISTIC k_dtc_mfl_rc "K_DTC_MFL_RC" VALUE 0x4851a a_174 100 LINEAR______0_000000__0H___65163 0.0 65535.0 BIT_MASK 0xffffffff /end CHARACTERISTIC
/begin CHARACTERISTIC k_dtc_mfl_tb "K_DTC_MFL_TB" VALUE 0x4851c a_174 100 LINEAR______0_000000__0H___65163 0.0 65535.0 BIT_MASK 0xffffffff /end CHARACTERISTIC
/begin CHARACTERISTIC k_dtc_mfl_wp "K_DTC_MFL_WP" VALUE 0x4851e a_174 100 LINEAR______0_000000__0H___65163 0.0 65535.0 BIT_MASK 0xffffffff /end CHARACTERISTIC
/begin CHARACTERISTIC k_dtc_nw "K_DTC_NW" VALUE 0x48520 a_174 100 LINEAR______0_000000__0H___65163 0.0 65535.0 BIT_MASK 0xffffffff /end CHARACTERISTIC
/begin CHARACTERISTIC k_dtc_nwa "K_DTC_NWA" VALUE 0x48522 a_174 100 LINEAR______0_000000__0H___65163 0.0 65535.0 BIT_MASK 0xffffffff /end CHARACTERISTIC
/begin CHARACTERISTIC k_dtc_pwg_mdk_plau "K_DTC_PWG_MDK_PLAU" VALUE 0x48524 a_174 100 LINEAR______0_000000__0H___65163 0.0 65535.0 BIT_MASK 0xffffffff /end CHARACTERISTIC
/begin CHARACTERISTIC k_dtc_pwg_plau "K_DTC_PWG_PLAU" VALUE 0x48526 a_174 100 LINEAR______0_000000__0H___65163 0.0 65535.0 BIT_MASK 0xffffffff /end CHARACTERISTIC
/begin CHARACTERISTIC k_dtc_pwg1 "K_DTC_PWG1" VALUE 0x48528 a_174 100 LINEAR______0_000000__0H___65163 0.0 65535.0 BIT_MASK 0xffffffff /end CHARACTERISTIC
/begin CHARACTERISTIC k_dtc_pwg1_adap "K_DTC_PWG1_ADAP" VALUE 0x4852a a_174 100 LINEAR______0_000000__0H___65163 0.0 65535.0 BIT_MASK 0xffffffff /end CHARACTERISTIC
/begin CHARACTERISTIC k_dtc_pwg2 "K_DTC_PWG2" VALUE 0x4852c a_174 100 LINEAR______0_000000__0H___65163 0.0 65535.0 BIT_MASK 0xffffffff /end CHARACTERISTIC
/begin CHARACTERISTIC k_dtc_pwg2_adap "K_DTC_PWG2_ADAP" VALUE 0x4852e a_174 100 LINEAR______0_000000__0H___65163 0.0 65535.0 BIT_MASK 0xffffffff /end CHARACTERISTIC
/begin CHARACTERISTIC k_dtc_rl_kk "K_DTC_RL_KK" VALUE 0x48530 a_174 100 LINEAR______0_000000__0H___65163 0.0 65535.0 BIT_MASK 0xffffffff /end CHARACTERISTIC
/begin CHARACTERISTIC k_dtc_rl_kp "K_DTC_RL_KP" VALUE 0x48532 a_174 100 LINEAR______0_000000__0H___65163 0.0 65535.0 BIT_MASK 0xffffffff /end CHARACTERISTIC
/begin CHARACTERISTIC k_dtc_rs_cc "K_DTC_RS_CC" VALUE 0x48534 a_174 100 LINEAR______0_000000__0H___65163 0.0 65535.0 BIT_MASK 0xffffffff /end CHARACTERISTIC
/begin CHARACTERISTIC k_dtc_rs_ctoc "K_DTC_RS_CTOC" VALUE 0x48536 a_174 100 LINEAR______0_000000__0H___65163 0.0 65535.0 BIT_MASK 0xffffffff /end CHARACTERISTIC
/begin CHARACTERISTIC k_dtc_rs_otcc "K_DTC_RS_OTCC" VALUE 0x48538 a_174 100 LINEAR______0_000000__0H___65163 0.0 65535.0 BIT_MASK 0xffffffff /end CHARACTERISTIC
/begin CHARACTERISTIC k_dtc_rul "K_DTC_RUL" VALUE 0x4853a a_174 100 LINEAR______0_000000__0H___65163 0.0 65535.0 BIT_MASK 0xffffffff /end CHARACTERISTIC
/begin CHARACTERISTIC k_dtc_rv_ad_mech_ref_a "K_DTC_RV_AD_MECH_REF_A" VALUE 0x4853c a_174 100 LINEAR______0_000000__0H___65163 0.0 65535.0 BIT_MASK 0xffffffff /end CHARACTERISTIC
/begin CHARACTERISTIC k_dtc_rv_ad_mech_ref_e "K_DTC_RV_AD_MECH_REF_E" VALUE 0x4853e a_174 100 LINEAR______0_000000__0H___65163 0.0 65535.0 BIT_MASK 0xffffffff /end CHARACTERISTIC
/begin CHARACTERISTIC k_dtc_sk_mdk "K_DTC_SK_MDK" VALUE 0x48540 a_174 100 LINEAR______0_000000__0H___65163 0.0 65535.0 BIT_MASK 0xffffffff /end CHARACTERISTIC
/begin CHARACTERISTIC k_dtc_sk_pwg "K_DTC_SK_PWG" VALUE 0x48542 a_174 100 LINEAR______0_000000__0H___65163 0.0 65535.0 BIT_MASK 0xffffffff /end CHARACTERISTIC
/begin CHARACTERISTIC k_dtc_slp "K_DTC_SLP" VALUE 0x48544 a_174 100 LINEAR______0_000000__0H___65163 0.0 65535.0 BIT_MASK 0xffffffff /end CHARACTERISTIC
/begin CHARACTERISTIC k_dtc_sls_1 "K_DTC_SLS_1" VALUE 0x48546 a_174 100 LINEAR______0_000000__0H___65163 0.0 65535.0 BIT_MASK 0xffffffff /end CHARACTERISTIC
/begin CHARACTERISTIC k_dtc_sls_2 "K_DTC_SLS_2" VALUE 0x48548 a_174 100 LINEAR______0_000000__0H___65163 0.0 65535.0 BIT_MASK 0xffffffff /end CHARACTERISTIC
/begin CHARACTERISTIC k_dtc_slv "K_DTC_SLV" VALUE 0x4854a a_174 100 LINEAR______0_000000__0H___65163 0.0 65535.0 BIT_MASK 0xffffffff /end CHARACTERISTIC
/begin CHARACTERISTIC k_dtc_slv_mech "K_DTC_SLV_MECH" VALUE 0x4854c a_174 100 LINEAR______0_000000__0H___65163 0.0 65535.0 BIT_MASK 0xffffffff /end CHARACTERISTIC
/begin CHARACTERISTIC k_dtc_stg "K_DTC_STG" VALUE 0x4854e a_174 100 LINEAR______0_000000__0H___65163 0.0 65535.0 BIT_MASK 0xffffffff /end CHARACTERISTIC
/begin CHARACTERISTIC k_dtc_t_lr_akt "K_DTC_T_LR_AKT" VALUE 0x48550 a_174 100 LINEAR______0_000000__0H___65163 0.0 65535.0 BIT_MASK 0xffffffff /end CHARACTERISTIC
/begin CHARACTERISTIC k_dtc_t_zsr_0 "K_DTC_T_ZSR_0" VALUE 0x48552 a_174 100 LINEAR______0_000000__0H___65163 0.0 65535.0 BIT_MASK 0xffffffff /end CHARACTERISTIC
/begin CHARACTERISTIC k_dtc_t_zsr_1 "K_DTC_T_ZSR_1" VALUE 0x48554 a_174 100 LINEAR______0_000000__0H___65163 0.0 65535.0 BIT_MASK 0xffffffff /end CHARACTERISTIC
/begin CHARACTERISTIC k_dtc_t_zsr_2 "K_DTC_T_ZSR_2" VALUE 0x48556 a_174 100 LINEAR______0_000000__0H___65163 0.0 65535.0 BIT_MASK 0xffffffff /end CHARACTERISTIC
/begin CHARACTERISTIC k_dtc_t_zsr_3 "K_DTC_T_ZSR_3" VALUE 0x48558 a_174 100 LINEAR______0_000000__0H___65163 0.0 65535.0 BIT_MASK 0xffffffff /end CHARACTERISTIC
/begin CHARACTERISTIC k_dtc_t_zsr_4 "K_DTC_T_ZSR_4" VALUE 0x4855a a_174 100 LINEAR______0_000000__0H___65163 0.0 65535.0 BIT_MASK 0xffffffff /end CHARACTERISTIC
/begin CHARACTERISTIC k_dtc_t_zsr_5 "K_DTC_T_ZSR_5" VALUE 0x4855c a_174 100 LINEAR______0_000000__0H___65163 0.0 65535.0 BIT_MASK 0xffffffff /end CHARACTERISTIC
/begin CHARACTERISTIC k_dtc_t_zsr_m2 "K_DTC_T_ZSR_M2" VALUE 0x4855e a_174 100 LINEAR______0_000000__0H___65163 0.0 65535.0 BIT_MASK 0xffffffff /end CHARACTERISTIC
/begin CHARACTERISTIC k_dtc_tal "K_DTC_TAL" VALUE 0x48560 a_174 100 LINEAR______0_000000__0H___65163 0.0 65535.0 BIT_MASK 0xffffffff /end CHARACTERISTIC
/begin CHARACTERISTIC k_dtc_tev "K_DTC_TEV" VALUE 0x48562 a_174 100 LINEAR______0_000000__0H___65163 0.0 65535.0 BIT_MASK 0xffffffff /end CHARACTERISTIC
/begin CHARACTERISTIC k_dtc_timeout_asc1 "K_DTC_TIMEOUT_ASC1" VALUE 0x48564 a_174 100 LINEAR______0_000000__0H___65163 0.0 65535.0 BIT_MASK 0xffffffff /end CHARACTERISTIC
/begin CHARACTERISTIC k_dtc_timeout_asc3 "K_DTC_TIMEOUT_ASC3" VALUE 0x48566 a_174 100 LINEAR______0_000000__0H___65163 0.0 65535.0 BIT_MASK 0xffffffff /end CHARACTERISTIC
/begin CHARACTERISTIC k_dtc_timeout_egs1 "K_DTC_TIMEOUT_EGS1" VALUE 0x48568 a_174 100 LINEAR______0_000000__0H___65163 0.0 65535.0 BIT_MASK 0xffffffff /end CHARACTERISTIC
/begin CHARACTERISTIC k_dtc_timeout_instr2 "K_DTC_TIMEOUT_INSTR2" VALUE 0x4856a a_174 100 LINEAR______0_000000__0H___65163 0.0 65535.0 BIT_MASK 0xffffffff /end CHARACTERISTIC
/begin CHARACTERISTIC k_dtc_timeout_instr3 "K_DTC_TIMEOUT_INSTR3" VALUE 0x4856c a_174 100 LINEAR______0_000000__0H___65163 0.0 65535.0 BIT_MASK 0xffffffff /end CHARACTERISTIC
/begin CHARACTERISTIC k_dtc_tka "K_DTC_TKA" VALUE 0x4856e a_174 100 LINEAR______0_000000__0H___65163 0.0 65535.0 BIT_MASK 0xffffffff /end CHARACTERISTIC
/begin CHARACTERISTIC k_dtc_tkw "K_DTC_TKW" VALUE 0x48570 a_174 100 LINEAR______0_000000__0H___65163 0.0 65535.0 BIT_MASK 0xffffffff /end CHARACTERISTIC
/begin CHARACTERISTIC k_dtc_toel "K_DTC_TOEL" VALUE 0x48572 a_174 100 LINEAR______0_000000__0H___65163 0.0 65535.0 BIT_MASK 0xffffffff /end CHARACTERISTIC
/begin CHARACTERISTIC k_dtc_tv "K_DTC_TV" VALUE 0x48574 a_174 100 LINEAR______0_000000__0H___65163 0.0 65535.0 BIT_MASK 0xffffffff /end CHARACTERISTIC
/begin CHARACTERISTIC k_dtc_uls_hub_1 "K_DTC_ULS_HUB_1" VALUE 0x48576 a_174 100 LINEAR______0_000000__0H___65163 0.0 65535.0 BIT_MASK 0xffffffff /end CHARACTERISTIC
/begin CHARACTERISTIC k_dtc_uls_hub_2 "K_DTC_ULS_HUB_2" VALUE 0x48578 a_174 100 LINEAR______0_000000__0H___65163 0.0 65535.0 BIT_MASK 0xffffffff /end CHARACTERISTIC
/begin CHARACTERISTIC k_dtc_uls_ksma_down_1 "K_DTC_ULS_KSMA_DOWN_1" VALUE 0x4857a a_174 100 LINEAR______0_000000__0H___65163 0.0 65535.0 BIT_MASK 0xffffffff /end CHARACTERISTIC
/begin CHARACTERISTIC k_dtc_uls_ksma_down_2 "K_DTC_ULS_KSMA_DOWN_2" VALUE 0x4857c a_174 100 LINEAR______0_000000__0H___65163 0.0 65535.0 BIT_MASK 0xffffffff /end CHARACTERISTIC
/begin CHARACTERISTIC k_dtc_uls_ksma_up_1 "K_DTC_ULS_KSMA_UP_1" VALUE 0x4857e a_174 100 LINEAR______0_000000__0H___65163 0.0 65535.0 BIT_MASK 0xffffffff /end CHARACTERISTIC
/begin CHARACTERISTIC k_dtc_uls_ksma_up_2 "K_DTC_ULS_KSMA_UP_2" VALUE 0x48580 a_174 100 LINEAR______0_000000__0H___65163 0.0 65535.0 BIT_MASK 0xffffffff /end CHARACTERISTIC
/begin CHARACTERISTIC k_dtc_uls_ksub_down_1 "K_DTC_ULS_KSUB_DOWN_1" VALUE 0x48582 a_174 100 LINEAR______0_000000__0H___65163 0.0 65535.0 BIT_MASK 0xffffffff /end CHARACTERISTIC
/begin CHARACTERISTIC k_dtc_uls_ksub_down_2 "K_DTC_ULS_KSUB_DOWN_2" VALUE 0x48584 a_174 100 LINEAR______0_000000__0H___65163 0.0 65535.0 BIT_MASK 0xffffffff /end CHARACTERISTIC
/begin CHARACTERISTIC k_dtc_uls_ksub_up_1 "K_DTC_ULS_KSUB_UP_1" VALUE 0x48586 a_174 100 LINEAR______0_000000__0H___65163 0.0 65535.0 BIT_MASK 0xffffffff /end CHARACTERISTIC
/begin CHARACTERISTIC k_dtc_uls_ksub_up_2 "K_DTC_ULS_KSUB_UP_2" VALUE 0x48588 a_174 100 LINEAR______0_000000__0H___65163 0.0 65535.0 BIT_MASK 0xffffffff /end CHARACTERISTIC
/begin CHARACTERISTIC k_dtc_uls_lb_up_1 "K_DTC_ULS_LB_UP_1" VALUE 0x4858a a_174 100 LINEAR______0_000000__0H___65163 0.0 65535.0 BIT_MASK 0xffffffff /end CHARACTERISTIC
/begin CHARACTERISTIC k_dtc_uls_lb_up_2 "K_DTC_ULS_LB_UP_2" VALUE 0x4858c a_174 100 LINEAR______0_000000__0H___65163 0.0 65535.0 BIT_MASK 0xffffffff /end CHARACTERISTIC
/begin CHARACTERISTIC k_dtc_uls_nkat_fm_1 "K_DTC_ULS_NKAT_FM_1" VALUE 0x4858e a_174 100 LINEAR______0_000000__0H___65163 0.0 65535.0 BIT_MASK 0xffffffff /end CHARACTERISTIC
/begin CHARACTERISTIC k_dtc_uls_nkat_fm_2 "K_DTC_ULS_NKAT_FM_2" VALUE 0x48590 a_174 100 LINEAR______0_000000__0H___65163 0.0 65535.0 BIT_MASK 0xffffffff /end CHARACTERISTIC
/begin CHARACTERISTIC k_dtc_uls_nkat_nsa_1 "K_DTC_ULS_NKAT_NSA_1" VALUE 0x48592 a_174 100 LINEAR______0_000000__0H___65163 0.0 65535.0 BIT_MASK 0xffffffff /end CHARACTERISTIC
/begin CHARACTERISTIC k_dtc_uls_nkat_nsa_2 "K_DTC_ULS_NKAT_NSA_2" VALUE 0x48594 a_174 100 LINEAR______0_000000__0H___65163 0.0 65535.0 BIT_MASK 0xffffffff /end CHARACTERISTIC
/begin CHARACTERISTIC k_dtc_uls_nkat_sa_1 "K_DTC_ULS_NKAT_SA_1" VALUE 0x48596 a_174 100 LINEAR______0_000000__0H___65163 0.0 65535.0 BIT_MASK 0xffffffff /end CHARACTERISTIC
/begin CHARACTERISTIC k_dtc_uls_nkat_sa_2 "K_DTC_ULS_NKAT_SA_2" VALUE 0x48598 a_174 100 LINEAR______0_000000__0H___65163 0.0 65535.0 BIT_MASK 0xffffffff /end CHARACTERISTIC
/begin CHARACTERISTIC k_dtc_uls_nkat_time_1 "K_DTC_ULS_NKAT_TIME_1" VALUE 0x4859a a_174 100 LINEAR______0_000000__0H___65163 0.0 65535.0 BIT_MASK 0xffffffff /end CHARACTERISTIC
/begin CHARACTERISTIC k_dtc_uls_nkat_time_2 "K_DTC_ULS_NKAT_TIME_2" VALUE 0x4859c a_174 100 LINEAR______0_000000__0H___65163 0.0 65535.0 BIT_MASK 0xffffffff /end CHARACTERISTIC
/begin CHARACTERISTIC k_dtc_uls_sprung_1 "K_DTC_ULS_SPRUNG_1" VALUE 0x4859e a_174 100 LINEAR______0_000000__0H___65163 0.0 65535.0 BIT_MASK 0xffffffff /end CHARACTERISTIC
/begin CHARACTERISTIC k_dtc_uls_sprung_2 "K_DTC_ULS_SPRUNG_2" VALUE 0x485a0 a_174 100 LINEAR______0_000000__0H___65163 0.0 65535.0 BIT_MASK 0xffffffff /end CHARACTERISTIC
/begin CHARACTERISTIC k_dtc_van_mech_a "K_DTC_VAN_MECH_A" VALUE 0x485a2 a_174 100 LINEAR______0_000000__0H___65163 0.0 65535.0 BIT_MASK 0xffffffff /end CHARACTERISTIC
/begin CHARACTERISTIC k_dtc_van_mech_e "K_DTC_VAN_MECH_E" VALUE 0x485a4 a_174 100 LINEAR______0_000000__0H___65163 0.0 65535.0 BIT_MASK 0xffffffff /end CHARACTERISTIC
/begin CHARACTERISTIC k_dtc_vepu "K_DTC_VEPU" VALUE 0x485a6 a_174 100 LINEAR______0_000000__0H___65163 0.0 65535.0 BIT_MASK 0xffffffff /end CHARACTERISTIC
/begin CHARACTERISTIC k_dtc_verb_auss_0 "K_DTC_VERB_AUSS_0" VALUE 0x485a8 a_174 100 LINEAR______0_000000__0H___65163 0.0 65535.0 BIT_MASK 0xffffffff /end CHARACTERISTIC
/begin CHARACTERISTIC k_dtc_verb_auss_1 "K_DTC_VERB_AUSS_1" VALUE 0x485aa a_174 100 LINEAR______0_000000__0H___65163 0.0 65535.0 BIT_MASK 0xffffffff /end CHARACTERISTIC
/begin CHARACTERISTIC k_dtc_verb_auss_2 "K_DTC_VERB_AUSS_2" VALUE 0x485ac a_174 100 LINEAR______0_000000__0H___65163 0.0 65535.0 BIT_MASK 0xffffffff /end CHARACTERISTIC
/begin CHARACTERISTIC k_dtc_verb_auss_3 "K_DTC_VERB_AUSS_3" VALUE 0x485ae a_174 100 LINEAR______0_000000__0H___65163 0.0 65535.0 BIT_MASK 0xffffffff /end CHARACTERISTIC
/begin CHARACTERISTIC k_dtc_verb_auss_4 "K_DTC_VERB_AUSS_4" VALUE 0x485b0 a_174 100 LINEAR______0_000000__0H___65163 0.0 65535.0 BIT_MASK 0xffffffff /end CHARACTERISTIC
/begin CHARACTERISTIC k_dtc_verb_auss_5 "K_DTC_VERB_AUSS_5" VALUE 0x485b2 a_174 100 LINEAR______0_000000__0H___65163 0.0 65535.0 BIT_MASK 0xffffffff /end CHARACTERISTIC
/begin CHARACTERISTIC k_dtc_vnwa "K_DTC_VNWA" VALUE 0x485b4 a_174 100 LINEAR______0_000000__0H___65163 0.0 65535.0 BIT_MASK 0xffffffff /end CHARACTERISTIC
/begin CHARACTERISTIC k_dtc_vnwe "K_DTC_VNWE" VALUE 0x485b6 a_174 100 LINEAR______0_000000__0H___65163 0.0 65535.0 BIT_MASK 0xffffffff /end CHARACTERISTIC
/begin CHARACTERISTIC k_dtc_zsr_wi "K_DTC_ZSR_WI" VALUE 0x485b8 a_174 100 LINEAR______0_000000__0H___65163 0.0 65535.0 BIT_MASK 0xffffffff /end CHARACTERISTIC
/begin CHARACTERISTIC k_epz_zv_ad_diag_inc "K_EPZ_ZV_AD_DIAG_INC" VALUE 0x48240 a_173 100 LINEAR______0_000000__0H___25142 0.0 255.0 BIT_MASK 0xffffffff /end CHARACTERISTIC
/begin CHARACTERISTIC k_epz_zv_ad_diag_max "K_EPZ_ZV_AD_DIAG_MAX" VALUE 0x48241 a_173 100 LINEAR______0_000000__0H___25142 0.0 255.0 BIT_MASK 0xffffffff /end CHARACTERISTIC
/begin CHARACTERISTIC k_fak_uls_frq_bk_2 "K_FAK_ULS_FRQ_BK_2" VALUE 0x485ba a_174 100 LINEAR______0_000000__0H___1_727 0.0 1.999985 BIT_MASK 0xffffffff /end CHARACTERISTIC
/begin CHARACTERISTIC k_fak_uls_spr_bk_2 "K_FAK_ULS_SPR_BK_2" VALUE 0x485bc a_174 100 LINEAR______0_000000__0H___1_727 0.0 1.999985 BIT_MASK 0xffffffff /end CHARACTERISTIC
/begin CHARACTERISTIC k_imob_eng_sp_plau "K_IMOB_ENG_SP_PLAU" VALUE 0x485be a_174 100 LINEAR______0_000000__0H___300_0 0.0 300.0 BIT_MASK 0xffffffff /end CHARACTERISTIC
/begin CHARACTERISTIC k_kat_diag_max_zv "K_KAT_DIAG_MAX_ZV" VALUE 0x485c0 a_174 100 LINEAR______0_000000__0H___255_9 0.0 255.996 BIT_MASK 0xffffffff /end CHARACTERISTIC
/begin CHARACTERISTIC k_lammw_dif_te_lam_ll "K_LAMMW_DIF_TE_LAM_LL" VALUE 0x480e0 a_172 100 LINEAR_______31_250000__FFFFB000 -31.25 0.0 BIT_MASK 0xffffffff /end CHARACTERISTIC
/begin CHARACTERISTIC k_lammw_dif_te_zv "K_LAMMW_DIF_TE_ZV" VALUE 0x485c2 a_174 100 LINEAR_______31_250000__3000H728 -31.25 31.25 BIT_MASK 0xffffffff /end CHARACTERISTIC
/begin CHARACTERISTIC k_lammw_dif_te_zv_diag "K_LAMMW_DIF_TE_ZV_DIAG" VALUE 0x485c4 a_174 100 LINEAR_______31_250000__3000H729 -31.25 31.25 BIT_MASK 0xffffffff /end CHARACTERISTIC
/begin CHARACTERISTIC k_lammw_dyf_kat "K_LAMMW_DYF_KAT" VALUE 0x485c6 a_174 100 LINEAR______0_000000__0H___31_25 0.0 31.25 BIT_MASK 0xffffffff /end CHARACTERISTIC
/begin CHARACTERISTIC k_lammw_dyf_zv "K_LAMMW_DYF_ZV" VALUE 0x485c8 a_174 100 LINEAR______0_000000__0H___31_25 0.0 31.25 BIT_MASK 0xffffffff /end CHARACTERISTIC
/begin CHARACTERISTIC k_lm_dyf_kat "K_LM_DYF_KAT" VALUE 0x485ca a_174 100 MAF_16_RES730 0.0 1389.0 BIT_MASK 0xffffffff /end CHARACTERISTIC
/begin CHARACTERISTIC k_lm_dyf_zv "K_LM_DYF_ZV" VALUE 0x485cc a_174 100 MAF_16_RES730 0.0 1389.0 BIT_MASK 0xffffffff /end CHARACTERISTIC
/begin CHARACTERISTIC k_lm_int_min_kat "K_LM_INT_MIN_KAT" VALUE 0x485ce a_174 100 LM_INT_SA_RANGE731 0.0 1820.42 BIT_MASK 0xffffffff /end CHARACTERISTIC
/begin CHARACTERISTIC k_lm_int_min_zv "K_LM_INT_MIN_ZV" VALUE 0x485d0 a_174 100 LM_INT_SA_RANGE732 0.0 1820.42 BIT_MASK 0xffffffff /end CHARACTERISTIC
/begin CHARACTERISTIC k_lm_int_min_zv_sa "K_LM_INT_MIN_ZV_SA" VALUE 0x485d2 a_174 100 LM_INT_SA_RANGE732 0.0 1820.42 BIT_MASK 0xffffffff /end CHARACTERISTIC
/begin CHARACTERISTIC k_lm_int_sa_min "K_LM_INT_SA_MIN" VALUE 0x485d4 a_174 100 LM_INT_SA_RANGE733 0.0 1820.42 BIT_MASK 0xffffffff /end CHARACTERISTIC
/begin CHARACTERISTIC k_lm_int_uls_kat_nsa "K_LM_INT_ULS_KAT_NSA" VALUE 0x485d6 a_174 100 LM_INT_SA_RANGE733 0.0 1820.42 BIT_MASK 0xffffffff /end CHARACTERISTIC
/begin CHARACTERISTIC k_lm_int_uls_kat_sa "K_LM_INT_ULS_KAT_SA" VALUE 0x485d8 a_174 100 LM_INT_SA_RANGE733 0.0 1820.42 BIT_MASK 0xffffffff /end CHARACTERISTIC
/begin CHARACTERISTIC k_lm_int_zv_pi "K_LM_INT_ZV_PI" VALUE 0x485da a_174 100 LM_INT_SA_RANGE731 0.0 1820.42 BIT_MASK 0xffffffff /end CHARACTERISTIC
/begin CHARACTERISTIC k_lm_int_zv_sa_max "K_LM_INT_ZV_SA_MAX" VALUE 0x485dc a_174 100 LM_INT_SA_RANGE732 0.0 1820.42 BIT_MASK 0xffffffff /end CHARACTERISTIC
/begin CHARACTERISTIC k_lm_kgh_max_sa_nkat_diag "K_LM_KGH_MAX_SA_NKAT_DIAG" VALUE 0x485de a_174 100 MAF_KGH_16_RES117 0.0 16383.75 BIT_MASK 0xffffffff /end CHARACTERISTIC
/begin CHARACTERISTIC k_lm_kgh_min_sa_nkat_diag "K_LM_KGH_MIN_SA_NKAT_DIAG" VALUE 0x485e0 a_174 100 MAF_KGH_16_RES117 0.0 16383.75 BIT_MASK 0xffffffff /end CHARACTERISTIC
/begin CHARACTERISTIC k_lm_zv_p_max "K_LM_ZV_P_MAX" VALUE 0x485e2 a_174 100 MAF_16_RES47 0.0 1389.0 BIT_MASK 0xffffffff /end CHARACTERISTIC
/begin CHARACTERISTIC k_lm_zv_p_min "K_LM_ZV_P_MIN" VALUE 0x485e4 a_174 100 MAF_16_RES47 0.0 1389.0 BIT_MASK 0xffffffff /end CHARACTERISTIC
/begin CHARACTERISTIC k_max_kat_diag "K_MAX_KAT_DIAG" VALUE 0x485e6 a_174 100 LINEAR______0_000000__0H___255_9 0.0 255.996 BIT_MASK 0xffffffff /end CHARACTERISTIC
/begin CHARACTERISTIC k_mitko_fwl_kat "K_MITKO_FWL_KAT" VALUE 0x485e8 a_174 100 LINEAR______0_000000__0H___0_983 0.0 0.98303002 BIT_MASK 0xffffffff /end CHARACTERISTIC
/begin CHARACTERISTIC k_mitko_kh_kat "K_MITKO_KH_KAT" VALUE 0x485ea a_174 100 LINEAR______0_000000__0H___0_983 0.0 0.98303002 BIT_MASK 0xffffffff /end CHARACTERISTIC
/begin CHARACTERISTIC k_mitko_lammw_kat "K_MITKO_LAMMW_KAT" VALUE 0x485ec a_174 100 LINEAR______0_000000__0H___0_924 0.0 0.99997997 BIT_MASK 0xffffffff /end CHARACTERISTIC
/begin CHARACTERISTIC k_mitko_lammw_zv "K_MITKO_LAMMW_ZV" VALUE 0x485ee a_174 100 LINEAR______0_000000__0H___0_924 0.0 0.99997997 BIT_MASK 0xffffffff /end CHARACTERISTIC
/begin CHARACTERISTIC k_mitko_lm_kat "K_MITKO_LM_KAT" VALUE 0x485f0 a_174 100 LINEAR______0_000000__0H___0_924 0.0 0.99997997 BIT_MASK 0xffffffff /end CHARACTERISTIC
/begin CHARACTERISTIC k_mitko_lm_zv "K_MITKO_LM_ZV" VALUE 0x485f2 a_174 100 LINEAR______0_000000__0H___0_924 0.0 0.99997997 BIT_MASK 0xffffffff /end CHARACTERISTIC
/begin CHARACTERISTIC k_mitko_n_kat "K_MITKO_N_KAT" VALUE 0x485f4 a_174 100 LINEAR______0_000000__0H___0_924 0.0 0.99997997 BIT_MASK 0xffffffff /end CHARACTERISTIC
/begin CHARACTERISTIC k_mitko_n_zv "K_MITKO_N_ZV" VALUE 0x485f6 a_174 100 LINEAR______0_000000__0H___0_924 0.0 0.99997997 BIT_MASK 0xffffffff /end CHARACTERISTIC
/begin CHARACTERISTIC k_mitko_zv_ad "K_MITKO_ZV_AD" VALUE 0x485f8 a_174 100 LINEAR______0_000000__0H___0_956 0.0 0.99998474 BIT_MASK 0xffffffff /end CHARACTERISTIC
/begin CHARACTERISTIC k_mitko_zv_ad_gmw "K_MITKO_ZV_AD_GMW" VALUE 0x485fa a_174 100 LINEAR______0_000000__0H___1_734 0.0 1.0 BIT_MASK 0xffffffff /end CHARACTERISTIC
/begin CHARACTERISTIC k_n_dyf_kat "K_N_DYF_KAT" VALUE 0x485fc a_174 100 LINEAR______0_000000__0H___2040_ 0.0 2040.0 BIT_MASK 0xffffffff /end CHARACTERISTIC
/begin CHARACTERISTIC k_n_dyf_zv "K_N_DYF_ZV" VALUE 0x485fe a_174 100 LINEAR______0_000000__0H___2040_ 0.0 2040.0 BIT_MASK 0xffffffff /end CHARACTERISTIC
/begin CHARACTERISTIC k_n_zv_p_max "K_N_ZV_P_MAX" VALUE 0x48242 a_173 100 ES_8_RES17 0.0 8160.0 BIT_MASK 0xffffffff /end CHARACTERISTIC
/begin CHARACTERISTIC k_n_zv_p_min "K_N_ZV_P_MIN" VALUE 0x48243 a_173 100 ES_8_RES17 0.0 8160.0 BIT_MASK 0xffffffff /end CHARACTERISTIC
/begin CHARACTERISTIC k_o2_kat_mw_dif_max "K_O2_KAT_MW_DIF_MAX" VALUE 0x48244 a_173 100 LINEAR______0_000000__0H___0_965 0.0 0.99609375 BIT_MASK 0xffffffff /end CHARACTERISTIC
/begin CHARACTERISTIC k_o2_kat_mw_max "K_O2_KAT_MW_MAX" VALUE 0x48245 a_173 100 LINEAR______0_000000__0H___0_965 0.0 0.99609375 BIT_MASK 0xffffffff /end CHARACTERISTIC
/begin CHARACTERISTIC k_o2_kat_mw_min "K_O2_KAT_MW_MIN" VALUE 0x48246 a_173 100 LINEAR______0_000000__0H___0_965 0.0 0.99609375 BIT_MASK 0xffffffff /end CHARACTERISTIC
/begin CHARACTERISTIC k_t_sa_zv_min "K_T_SA_ZV_MIN" VALUE 0x48247 a_173 100 LINEAR______0_000000__0H___25735 0.0 25.5 BIT_MASK 0xffffffff /end CHARACTERISTIC
/begin CHARACTERISTIC k_t_zv_ad_diag_max "K_T_ZV_AD_DIAG_MAX" VALUE 0x480e2 a_172 100 LINEAR_______640_020000__FFFF800 -640.02 639.98 BIT_MASK 0xffffffff /end CHARACTERISTIC
/begin CHARACTERISTIC k_t_zv_ad_diag_min "K_T_ZV_AD_DIAG_MIN" VALUE 0x480e4 a_172 100 LINEAR_______640_020000__FFFF800 -640.02 639.98 BIT_MASK 0xffffffff /end CHARACTERISTIC
/begin CHARACTERISTIC k_t_zv_ad_max "K_T_ZV_AD_MAX" VALUE 0x480e6 a_172 100 LINEAR_______640_020000__FFFF800 -640.02 639.98 BIT_MASK 0xffffffff /end CHARACTERISTIC
/begin CHARACTERISTIC k_t_zv_ad_min "K_T_ZV_AD_MIN" VALUE 0x480e8 a_172 100 LINEAR_______640_020000__FFFF800 -640.02 639.98 BIT_MASK 0xffffffff /end CHARACTERISTIC
/begin CHARACTERISTIC k_t_zv_i_max "K_T_ZV_I_MAX" VALUE 0x48810 a_189 100 LINEAR_______640_000000__8000000 -640.0 640.0 BIT_MASK 0xffffffff /end CHARACTERISTIC
/begin CHARACTERISTIC k_t_zv_i_min "K_T_ZV_I_MIN" VALUE 0x48814 a_189 100 LINEAR_______640_000000__8000000 -640.0 640.0 BIT_MASK 0xffffffff /end CHARACTERISTIC
/begin CHARACTERISTIC k_temp_ers_kat_sa "K_TEMP_ERS_KAT_SA" VALUE 0x48248 a_173 100 LINEAR_______33_000000__0H___736 -33.0 990.0 BIT_MASK 0xffffffff /end CHARACTERISTIC
/begin CHARACTERISTIC k_temp_hys_ers_kat "K_TEMP_HYS_ERS_KAT" VALUE 0x48249 a_173 100 LINEAR_______33_000000__0H___736 -33.0 990.0 BIT_MASK 0xffffffff /end CHARACTERISTIC
/begin CHARACTERISTIC k_temp_max_ers_kat "K_TEMP_MAX_ERS_KAT" VALUE 0x4824a a_173 100 LINEAR_______33_000000__0H___736 -33.0 990.0 BIT_MASK 0xffffffff /end CHARACTERISTIC
/begin CHARACTERISTIC k_temp_min_ers_kat "K_TEMP_MIN_ERS_KAT" VALUE 0x4824b a_173 100 LINEAR_______33_000000__0H___736 -33.0 990.0 BIT_MASK 0xffffffff /end CHARACTERISTIC
/begin CHARACTERISTIC k_temp_min_ers_lam_zv "K_TEMP_MIN_ERS_LAM_ZV" VALUE 0x4824c a_173 100 LINEAR_______33_000000__0H___737 -33.0 990.0 BIT_MASK 0xffffffff /end CHARACTERISTIC
/begin CHARACTERISTIC k_temp_min_ers_nkat_diag "K_TEMP_MIN_ERS_NKAT_DIAG" VALUE 0x4824d a_173 100 LINEAR_______33_000000__0H___736 -33.0 990.0 BIT_MASK 0xffffffff /end CHARACTERISTIC
/begin CHARACTERISTIC k_tkw_min_kat "K_TKW_MIN_KAT" VALUE 0x4824e a_173 100 LINEAR_______48_000000__0H___142 -48.0 142.5 BIT_MASK 0xffffffff /end CHARACTERISTIC
/begin CHARACTERISTIC k_tkw_zv_sa_min "K_TKW_ZV_SA_MIN" VALUE 0x4824f a_173 100 LINEAR_______48_000000__0H___142 -48.0 142.5 BIT_MASK 0xffffffff /end CHARACTERISTIC
/begin CHARACTERISTIC k_tv_max_kat "K_TV_MAX_KAT" VALUE 0x48250 a_173 100 LINEAR______0_000000__0H___25738 0.0 255.0 BIT_MASK 0xffffffff /end CHARACTERISTIC
/begin CHARACTERISTIC k_tv_min_kat "K_TV_MIN_KAT" VALUE 0x48251 a_173 100 LINEAR______0_000000__0H___25738 0.0 255.0 BIT_MASK 0xffffffff /end CHARACTERISTIC
/begin CHARACTERISTIC k_uls_fak_zv_frq_fett "K_ULS_FAK_ZV_FRQ_FETT" VALUE 0x48600 a_174 100 LINEAR______0_000000__0H___1_739 0.0 1.99997 BIT_MASK 0xffffffff /end CHARACTERISTIC
/begin CHARACTERISTIC k_uls_fak_zv_frq_mager "K_ULS_FAK_ZV_FRQ_MAGER" VALUE 0x48602 a_174 100 LINEAR______0_000000__0H___1_739 0.0 1.99997 BIT_MASK 0xffffffff /end CHARACTERISTIC
/begin CHARACTERISTIC k_uls_frq_fett_quo_max "K_ULS_FRQ_FETT_QUO_MAX" VALUE 0x48604 a_174 100 LINEAR______0_000000__0H___255_9 0.0 255.996 BIT_MASK 0xffffffff /end CHARACTERISTIC
/begin CHARACTERISTIC k_uls_frq_mager_quo_max "K_ULS_FRQ_MAGER_QUO_MAX" VALUE 0x48606 a_174 100 LINEAR______0_000000__0H___255_9 0.0 255.996 BIT_MASK 0xffffffff /end CHARACTERISTIC
/begin CHARACTERISTIC k_uls_hst_zv_max_nkat "K_ULS_HST_ZV_MAX_NKAT" VALUE 0x48252 a_173 100 LINEAR______0_000000__0H___1_275 0.0 1.275 BIT_MASK 0xffffffff /end CHARACTERISTIC
/begin CHARACTERISTIC k_uls_kat_diag_fak_max "K_ULS_KAT_DIAG_FAK_MAX" VALUE 0x48253 a_173 100 LINEAR______0_000000__0H___0_967 0.0 0.99609375 BIT_MASK 0xffffffff /end CHARACTERISTIC
/begin CHARACTERISTIC k_uls_kat_diag_fak_min "K_ULS_KAT_DIAG_FAK_MIN" VALUE 0x48254 a_173 100 LINEAR______0_000000__0H___0_967 0.0 0.99609375 BIT_MASK 0xffffffff /end CHARACTERISTIC
/begin CHARACTERISTIC k_uls_kat_min_diag "K_ULS_KAT_MIN_DIAG" VALUE 0x48255 a_173 100 LINEAR______0_000000__0H___1_275 0.0 1.275 BIT_MASK 0xffffffff /end CHARACTERISTIC
/begin CHARACTERISTIC k_uls_kat_min_sa_diag "K_ULS_KAT_MIN_SA_DIAG" VALUE 0x48256 a_173 100 LINEAR______0_000000__0H___1_275 0.0 1.275 BIT_MASK 0xffffffff /end CHARACTERISTIC
/begin CHARACTERISTIC k_uls_kat_zyka_max "K_ULS_KAT_ZYKA_MAX" VALUE 0x48257 a_173 100 LINEAR______0_000000__0H___1_155 0.0 1.9961 BIT_MASK 0xffffffff /end CHARACTERISTIC
/begin CHARACTERISTIC k_uls_max_zyka "K_ULS_MAX_ZYKA" VALUE 0x48258 a_173 100 LINEAR______0_000000__0H___2550_ 0.0 2550.0 BIT_MASK 0xffffffff /end CHARACTERISTIC
/begin CHARACTERISTIC k_uls_max_zyka_fett "K_ULS_MAX_ZYKA_FETT" VALUE 0x48259 a_173 100 LINEAR______0_000000__0H___51740 0.0 5100.0 BIT_MASK 0xffffffff /end CHARACTERISTIC
/begin CHARACTERISTIC k_uls_sa_zv_max_nkat "K_ULS_SA_ZV_MAX_NKAT" VALUE 0x4825a a_173 100 LINEAR______0_000000__0H___1_275 0.0 1.275 BIT_MASK 0xffffffff /end CHARACTERISTIC
/begin CHARACTERISTIC k_uls_slp_zv_max_nkat "K_ULS_SLP_ZV_MAX_NKAT" VALUE 0x4825b a_173 100 LINEAR______0_000000__0H___1_275 0.0 1.275 BIT_MASK 0xffffffff /end CHARACTERISTIC
/begin CHARACTERISTIC k_uls_zyka_fett_quo_max "K_ULS_ZYKA_FETT_QUO_MAX" VALUE 0x48608 a_174 100 LINEAR______0_000000__0H___25741 0.0 255.996 BIT_MASK 0xffffffff /end CHARACTERISTIC
/begin CHARACTERISTIC k_uls_zyka_mager_quo_max "K_ULS_ZYKA_MAGER_QUO_MAX" VALUE 0x4860a a_174 100 LINEAR______0_000000__0H___25741 0.0 255.996 BIT_MASK 0xffffffff /end CHARACTERISTIC
/begin CHARACTERISTIC kfdirC0D "" VALUE 0x4825c a_173 100 defaultConversion742 0 255 BIT_MASK 0xffffffff /end CHARACTERISTIC
/begin CHARACTERISTIC kfdirC1D "" VALUE 0x4825d a_173 100 defaultConversion743 0 255 BIT_MASK 0xffffffff /end CHARACTERISTIC
/begin CHARACTERISTIC kfdirC2D "" VALUE 0x4825e a_173 100 defaultConversion744 0 255 BIT_MASK 0xffffffff /end CHARACTERISTIC
/begin CHARACTERISTIC kfdirC3D "" VALUE 0x4825f a_173 100 defaultConversion745 0 255 BIT_MASK 0xffffffff /end CHARACTERISTIC
/begin CHARACTERISTIC kfdirC4D "" VALUE 0x48260 a_173 100 defaultConversion746 0 255 BIT_MASK 0xffffffff /end CHARACTERISTIC
/begin CHARACTERISTIC kfdirC5D "" VALUE 0x48261 a_173 100 defaultConversion747 0 255 BIT_MASK 0xffffffff /end CHARACTERISTIC
/begin CHARACTERISTIC kfdirC6D "" VALUE 0x48262 a_173 100 defaultConversion748 0 255 BIT_MASK 0xffffffff /end CHARACTERISTIC
/begin CHARACTERISTIC kfdirC7D "" VALUE 0x48263 a_173 100 defaultConversion749 0 255 BIT_MASK 0xffffffff /end CHARACTERISTIC
/begin CHARACTERISTIC kfversionC0D "" VALUE 0x48264 a_173 100 defaultConversion750 0 255 BIT_MASK 0xffffffff /end CHARACTERISTIC
/begin CHARACTERISTIC kfversionC1D "" VALUE 0x48265 a_173 100 defaultConversion751 0 255 BIT_MASK 0xffffffff /end CHARACTERISTIC
/begin CHARACTERISTIC kfversionC2D "" VALUE 0x48266 a_173 100 defaultConversion752 0 255 BIT_MASK 0xffffffff /end CHARACTERISTIC
/begin CHARACTERISTIC kfversionC3D "" VALUE 0x48267 a_173 100 defaultConversion753 0 255 BIT_MASK 0xffffffff /end CHARACTERISTIC
/begin CHARACTERISTIC kk_totz_1 "KK_TOTZ_1" VALUE 0x48268 a_173 1 LINEAR______0_100000__1H___25754 0.1 25.5 BIT_MASK 0xffffffff /end CHARACTERISTIC
/begin CHARACTERISTIC kk_totz_1_vl_sperr "KK_TOTZ_1_VL_SPERR" VALUE 0x48269 a_173 100 LINEAR______0_000000__0H___25755 0.0 255.0 BIT_MASK 0xffffffff /end CHARACTERISTIC
/begin CHARACTERISTIC kk_totz_4 "KK_TOTZ_4" VALUE 0x4826a a_173 1 LINEAR______0_100000__1H___25754 0.1 25.5 BIT_MASK 0xffffffff /end CHARACTERISTIC
/begin CHARACTERISTIC kk_totz_5 "KK_TOTZ_5" VALUE 0x4826b a_173 1 LINEAR______0_100000__1H___25754 0.1 25.5 BIT_MASK 0xffffffff /end CHARACTERISTIC
/begin CHARACTERISTIC kns_sa_zyka_stns "KNS_SA_ZYKA_STNS" VALUE 0x4826c a_173 100 LINEAR______1_000000__1H___255_0 1.0 255.0 BIT_MASK 0xffffffff /end CHARACTERISTIC
/begin CHARACTERISTIC konf_abgasanlage "KONF_ABGASANLAGE" VALUE 0x4826d a_173 100 LINEAR______0_000000__0H___3_000 0.0 3.0 BIT_MASK 0xffffffff /end CHARACTERISTIC
/begin CHARACTERISTIC konf_agk "KONF_AGK" VALUE 0x4826e a_173 100 LINEAR______0_000000__0H___1_167 0.0 1.0 BIT_MASK 0xffffffff /end CHARACTERISTIC
/begin CHARACTERISTIC konf_bts "KONF_BTS" VALUE 0x4826f a_173 100 LINEAR______0_000000__0H___1_167 0.0 1.0 BIT_MASK 0xffffffff /end CHARACTERISTIC
/begin CHARACTERISTIC konf_eluefter "KONF_ELUEFTER" VALUE 0x48270 a_173 100 LINEAR______0_000000__0H___1_167 0.0 1.0 BIT_MASK 0xffffffff /end CHARACTERISTIC
/begin CHARACTERISTIC konf_main_switch "KONF_MAIN_SWITCH" VALUE 0x48417 a_173 100 LINEAR______0_000000__0H___1_167 0.0 1.0 BIT_MASK 0xffffffff /end CHARACTERISTIC
/begin CHARACTERISTIC konf_mil "KONF_MIL" VALUE 0x48271 a_173 100 LINEAR______0_000000__0H___3_000 0.0 3.0 BIT_MASK 0xffffffff /end CHARACTERISTIC
/begin CHARACTERISTIC konf_mil_fus "KONF_MIL_FUS" VALUE 0x48272 a_173 100 LINEAR______0_000000__0H___1_167 0.0 1.0 BIT_MASK 0xffffffff /end CHARACTERISTIC
/begin CHARACTERISTIC konf_ssp "KONF_SSP" VALUE 0x48273 a_173 100 LINEAR______0_000000__0H___1_167 0.0 1.0 BIT_MASK 0xffffffff /end CHARACTERISTIC
/begin CHARACTERISTIC konf_vti_end "KONF_VTI_END" VALUE 0x48274 a_173 100 LINEAR______0_000000__0H___1_167 0.0 1.0 BIT_MASK 0xffffffff /end CHARACTERISTIC
/begin CHARACTERISTIC konfig_lr "KONFIG_LR" VALUE 0x48275 a_173 100 LINEAR______0_000000__0H___1_167 0.0 1.0 BIT_MASK 0xffffffff /end CHARACTERISTIC
/begin CHARACTERISTIC konfig_lr_diag_slv "KONFIG_LR_DIAG_SLV" VALUE 0x48276 a_173 100 LINEAR______0_000000__0H___1_756 0.0 1.0 BIT_MASK 0xffffffff /end CHARACTERISTIC
/begin CHARACTERISTIC konfig_slv_diag "KONFIG_SLV_DIAG" VALUE 0x48277 a_173 100 LINEAR______0_000000__0H___1_756 0.0 1.0 BIT_MASK 0xffffffff /end CHARACTERISTIC
/begin CHARACTERISTIC kor_fak_inc_te "KOR_FAK_INC_TE" VALUE 0x48278 a_173 20 LINEAR______0_000000__0H___0_920 0.0 0.99599999 BIT_MASK 0xffffffff /end CHARACTERISTIC
/begin CHARACTERISTIC kor_nwa_ref "KOR_NW_A_REF" VALUE 0x487ec a_175 100 LINEAR_______18_000000__FFFFFFD0 -18.0 18.0 BIT_MASK 0xffffffff /end CHARACTERISTIC
/begin CHARACTERISTIC kor_nwe_ref "KOR_NW_E_REF" VALUE 0x487ed a_175 100 LINEAR_______18_000000__FFFFFFD0 -18.0 18.0 BIT_MASK 0xffffffff /end CHARACTERISTIC
/begin CHARACTERISTIC ksd_lam_max "KSD_LAM_MAX" VALUE 0x4860c a_174 100 LINEAR_______31_250000__3000H757 -31.25 31.25 BIT_MASK 0xffffffff /end CHARACTERISTIC
/begin CHARACTERISTIC ksd_lam_min "KSD_LAM_MIN" VALUE 0x4860e a_174 100 LINEAR_______31_250000__3000H757 -31.25 31.25 BIT_MASK 0xffffffff /end CHARACTERISTIC
/begin CHARACTERISTIC ksd_lm_min_ti_ad "KSD_LM_MIN_TI_AD" VALUE 0x48279 a_173 100 MAF_8_RES37 0.0 1389.0 BIT_MASK 0xffffffff /end CHARACTERISTIC
/begin CHARACTERISTIC ksd_n_min_ti_ad "KSD_N_MIN_TI_AD" VALUE 0x4827a a_173 100 ES_8_RES 0.0 8160.0 BIT_MASK 0xffffffff /end CHARACTERISTIC
/begin CHARACTERISTIC ksd_sperr_max "KSD_SPERR_MAX" VALUE 0x4827b a_173 100 LINEAR______0_000000__0H___25182 0.0 255.0 BIT_MASK 0xffffffff /end CHARACTERISTIC
/begin CHARACTERISTIC kw_dif_max_lu "KW_DIF_MAX_LU" VALUE 0x48610 a_174 5 LINEAR______0_000000__0H___7_812 0.0 7.8125 BIT_MASK 0xffffffff /end CHARACTERISTIC
/begin CHARACTERISTIC lam_ad_anz_p "LAM_AD_ANZ_P" VALUE 0x4827c a_173 2 LINEAR______0_000000__0H___25758 0.0 255.0 BIT_MASK 0xffffffff /end CHARACTERISTIC
/begin CHARACTERISTIC lam_ad_anz_p_ll "LAM_AD_ANZ_P_LL" VALUE 0x4827d a_173 2 LINEAR______1_000000__1H___25759 1.0 255.0 BIT_MASK 0xffffffff /end CHARACTERISTIC
/begin CHARACTERISTIC lam_anz_p_diag "LAM_ANZ_P_DIAG" VALUE 0x4827e a_173 10 LINEAR______1_000000__1H___255_0 1.0 255.0 BIT_MASK 0xffffffff /end CHARACTERISTIC
/begin CHARACTERISTIC lam_anz_p_ll "LAM_ANZ_P_LL" VALUE 0x4827f a_173 2 LINEAR______0_000000__0H___25758 0.0 255.0 BIT_MASK 0xffffffff /end CHARACTERISTIC
/begin CHARACTERISTIC lam_diag_slv_schw "LAM_DIAG_SLV_SCHW" VALUE 0x48612 a_174 100 LINEAR______0_000000__8000H___31 0.0 31.25 BIT_MASK 0xffffffff /end CHARACTERISTIC
/begin CHARACTERISTIC lam_dif_diag_slv_min "LAM_DIF_DIAG_SLV_MIN" VALUE 0x48614 a_174 100 LINEAR______0_000000__0H___31760 0.0 31.25 BIT_MASK 0xffffffff /end CHARACTERISTIC
/begin CHARACTERISTIC lam_dif_hys_te "LAM_DIF_HYS_TE" VALUE 0x48616 a_174 100 LINEAR______0_000000__0H___31761 0.0 31.25 BIT_MASK 0xffffffff /end CHARACTERISTIC
/begin CHARACTERISTIC lam_dif_max_inst_1 "LAM_DIF_MAX_INST_1" VALUE 0x48618 a_174 5 LINEAR______0_000000__8000H___31 0.0 31.25 BIT_MASK 0xffffffff /end CHARACTERISTIC
/begin CHARACTERISTIC lam_dif_max_inst_2 "LAM_DIF_MAX_INST_2" VALUE 0x4861a a_174 5 LINEAR______0_000000__8000H___31 0.0 31.25 BIT_MASK 0xffffffff /end CHARACTERISTIC
/begin CHARACTERISTIC lam_fak_i_1 "LAM_FAK_I_1" VALUE 0x48280 a_173 2 LINEAR______0_000000__0H___0_996 0.0 0.99610001 BIT_MASK 0xffffffff /end CHARACTERISTIC
/begin CHARACTERISTIC lam_fak_i_2 "LAM_FAK_I_2" VALUE 0x48281 a_173 2 LINEAR______0_000000__0H___0_996 0.0 0.99610001 BIT_MASK 0xffffffff /end CHARACTERISTIC
/begin CHARACTERISTIC lam_fak_p "LAM_FAK_P" VALUE 0x48282 a_173 4 LINEAR______0_000000__0H___0_996 0.0 0.99610001 BIT_MASK 0xffffffff /end CHARACTERISTIC
/begin CHARACTERISTIC lam_inst_be_min "LAM_INST_BE_MIN" VALUE 0x4861c a_174 20 LINEAR______0_000015__1H___0_762 1.53e-005 0.25 BIT_MASK 0xffffffff /end CHARACTERISTIC
/begin CHARACTERISTIC lam_lm_min_diag "LAM_LM_MIN_DIAG" VALUE 0x4861e a_174 1 MAF_KGH_16_RES763 0.0 16383.75 BIT_MASK 0xffffffff /end CHARACTERISTIC
/begin CHARACTERISTIC lam_max "LAM_MAX" VALUE 0x48620 a_174 100 LINEAR______0_000000__8000H___31 0.0 31.25 BIT_MASK 0xffffffff /end CHARACTERISTIC
/begin CHARACTERISTIC lam_max_zyka "LAM_MAX_ZYKA" VALUE 0x48283 a_173 10 LINEAR______0_000000__0H___25764 0.0 255.0 BIT_MASK 0xffffffff /end CHARACTERISTIC
/begin CHARACTERISTIC lam_min "LAM_MIN" VALUE 0x48622 a_174 100 LINEAR_______31_250000__3000H765 -31.25 0.0 BIT_MASK 0xffffffff /end CHARACTERISTIC
/begin CHARACTERISTIC lam_min_te "LAM_MIN_TE" VALUE 0x48624 a_174 20 LINEAR_______31_250000__3000H766 -31.25 0.0 BIT_MASK 0xffffffff /end CHARACTERISTIC
/begin CHARACTERISTIC lam_neg_i_ll "LAM_NEG_I_LL" VALUE 0x48284 a_173 5 LINEAR______0_000000__0H___0_767 0.0 0.49608999 BIT_MASK 0xffffffff /end CHARACTERISTIC
/begin CHARACTERISTIC lam_neg_p_ll "LAM_NEG_P_LL" VALUE 0x48285 a_173 5 LINEAR______0_000000__0H___0_767 0.0 0.49608999 BIT_MASK 0xffffffff /end CHARACTERISTIC
/begin CHARACTERISTIC lam_nmin "LAM_NMIN" VALUE 0x48286 a_173 5 ES_8_RES116 0.0 8160.0 BIT_MASK 0xffffffff /end CHARACTERISTIC
/begin CHARACTERISTIC lam_pos_i_ll "LAM_POS_I_LL" VALUE 0x48287 a_173 5 LINEAR______0_000000__0H___0_767 0.0 0.49608999 BIT_MASK 0xffffffff /end CHARACTERISTIC
/begin CHARACTERISTIC lam_pos_p_ll "LAM_POS_P_LL" VALUE 0x48288 a_173 5 LINEAR______0_000000__0H___0_767 0.0 0.49608999 BIT_MASK 0xffffffff /end CHARACTERISTIC
/begin CHARACTERISTIC lam_zyka "LAM_ZYKA" VALUE 0x48626 a_174 1 LINEAR______0_010000__1H___65768 0.01 655.34998 BIT_MASK 0xffffffff /end CHARACTERISTIC
/begin CHARACTERISTIC lam_zyka_diag "LAM_ZYKA_DIAG" VALUE 0x48628 a_174 100 LINEAR______0_000000__0H___65769 0.0 65535.0 BIT_MASK 0xffffffff /end CHARACTERISTIC
/begin CHARACTERISTIC lammw_dif_max_te_1 "LAMMW_DIF_MAX_TE_1" VALUE 0x480ea a_172 20 LINEAR______0_000000__0H___31770 0.0 31.25 BIT_MASK 0xffffffff /end CHARACTERISTIC
/begin CHARACTERISTIC lammw_dif_te_fc "LAMMW_DIF_TE_FC" VALUE 0x4862a a_174 20 LINEAR______0_000000__0H___31771 0.0 31.25 BIT_MASK 0xffffffff /end CHARACTERISTIC
/begin CHARACTERISTIC lammw_dif_te_kor_max "LAMMW_DIF_TE_KOR_MAX" VALUE 0x4862c a_174 20 LINEAR______0_000000__8000H__772 0.0 31.25 BIT_MASK 0xffffffff /end CHARACTERISTIC
/begin CHARACTERISTIC lammw_dif_te_ksd "LAMMW_DIF_TE_KSD" VALUE 0x4862e a_174 100 LINEAR_______31_250000__3000H757 -31.25 31.25 BIT_MASK 0xffffffff /end CHARACTERISTIC
/begin CHARACTERISTIC lammw_dif_te_ldp "LAMMW_DIF_TE_LDP" VALUE 0x48630 a_174 10 LINEAR______0_000000__0H___31771 0.0 31.25 BIT_MASK 0xffffffff /end CHARACTERISTIC
/begin CHARACTERISTIC lammw_dif_te_vl "LAMMW_DIF_TE_VL" VALUE 0x48632 a_174 100 LINEAR_______31_250000__3000H773 -31.25 0.0 BIT_MASK 0xffffffff /end CHARACTERISTIC
/begin CHARACTERISTIC lammw_dyf "LAMMW_DYF" VALUE 0x48289 a_173 2 LINEAR______0_000000__0H___99_61 0.0 99.610001 BIT_MASK 0xffffffff /end CHARACTERISTIC
/begin CHARACTERISTIC lammw_gmw_dif_te "LAMMW_GMW_DIF_TE" VALUE 0x48634 a_174 20 LINEAR______0_000000__8000H__772 0.0 31.25 BIT_MASK 0xffffffff /end CHARACTERISTIC
/begin CHARACTERISTIC lammw_mitko "LAMMW_MITKO" VALUE 0x4828a a_173 5 LINEAR______0_000000__0H___0_920 0.0 0.99599999 BIT_MASK 0xffffffff /end CHARACTERISTIC
/begin CHARACTERISTIC LARGE_OSZ_LIMIT "LARGE_OSZ_LIMIT" VALUE 0x480ec a_172 100 LINEAR_______32768_000000__FF180 -32768.0 32767.0 BIT_MASK 0xffffffff /end CHARACTERISTIC
/begin CHARACTERISTIC lm_ad_llfs "LM_AD_LLFS" VALUE 0x4828b a_173 10 LINEAR______0_000000__0H___63_75 0.0 63.75 BIT_MASK 0xffffffff /end CHARACTERISTIC
/begin CHARACTERISTIC lm_dif_min_s "LM_DIF_MIN_S" VALUE 0x4828c a_173 30 MAF_8_RES37 0.0 1389.0 BIT_MASK 0xffffffff /end CHARACTERISTIC
/begin CHARACTERISTIC lm_dif_totz_lu "LM_DIF_TOTZ_LU" VALUE 0x48636 a_174 5 LINEAR______0_010000__1H___65768 0.01 655.34998 BIT_MASK 0xffffffff /end CHARACTERISTIC
/begin CHARACTERISTIC lm_dyf "LM_DYF" VALUE 0x4828d a_173 5 MAF_8_RES40 0.0 1389.0 BIT_MASK 0xffffffff /end CHARACTERISTIC
/begin CHARACTERISTIC lm_fc_3 "LM_FC_3" VALUE 0x48638 a_174 5 MAF_16_RES49 0.0 1389.0 BIT_MASK 0xffffffff /end CHARACTERISTIC
/begin CHARACTERISTIC lm_ftp_max "LM_FTP_MAX" VALUE 0x4828e a_173 100 MAF_8_RES37 0.0 1389.0 BIT_MASK 0xffffffff /end CHARACTERISTIC
/begin CHARACTERISTIC lm_gmw_dif_mitko "LM_GMW_DIF_MITKO" VALUE 0x4828f a_173 10 LINEAR______0_000000__0H___0_996 0.0 0.99610001 BIT_MASK 0xffffffff /end CHARACTERISTIC
/begin CHARACTERISTIC lm_gmw_hys "LM_GMW_HYS" VALUE 0x48290 a_173 100 LINEAR______0_000000__0H___5_426 0.0 5.426 BIT_MASK 0xffffffff /end CHARACTERISTIC
/begin CHARACTERISTIC lm_hys_disa "LM_HYS_DISA" VALUE 0x48291 a_173 2 MAF_8_RES40 0.0 1389.0 BIT_MASK 0xffffffff /end CHARACTERISTIC
/begin CHARACTERISTIC lm_hys_ks "LM_HYS_KS" VALUE 0x48292 a_173 2 MAF_8_RES40 0.0 1389.0 BIT_MASK 0xffffffff /end CHARACTERISTIC
/begin CHARACTERISTIC lm_inc_hys "LM_INC_HYS" VALUE 0x4863a a_174 100 MAF_16_RES774 0.0 1389.0 BIT_MASK 0xffffffff /end CHARACTERISTIC
/begin CHARACTERISTIC lm_int_zv_hst_max "LM_INT_ZV_HST_MAX" VALUE 0x4863c a_174 100 LM_INT_SA_RANGE733 0.0 1820.42 BIT_MASK 0xffffffff /end CHARACTERISTIC
/begin CHARACTERISTIC lm_int_zv_slp_max "LM_INT_ZV_SLP_MAX" VALUE 0x4863e a_174 100 LM_INT_SA_RANGE733 0.0 1820.42 BIT_MASK 0xffffffff /end CHARACTERISTIC
/begin CHARACTERISTIC lm_kg_h_min_tal_ref "LM_KG_H_MIN_TAL_REF" VALUE 0x48640 a_174 10 MAF_KGH_16_RES763 0.0 16383.75 BIT_MASK 0xffffffff /end CHARACTERISTIC
/begin CHARACTERISTIC lm_kg_h_sl_max "LM_KG_H_SL_MAX" VALUE 0x48642 a_174 10 MAF_KGH_16_RES28 0.0 16383.75 BIT_MASK 0xffffffff /end CHARACTERISTIC
/begin CHARACTERISTIC lm_kgh_diag_ini "LM_KGH_DIAG_INI" VALUE 0x48644 a_174 30 MAF_KGH_16_RES117 0.0 16383.75 BIT_MASK 0xffffffff /end CHARACTERISTIC
/begin CHARACTERISTIC lm_kgh_max_lsh_diag "LM_KGH_MAX_LSH_DIAG" VALUE 0x48646 a_174 10 MAF_KGH_16_RES117 0.0 16383.75 BIT_MASK 0xffffffff /end CHARACTERISTIC
/begin CHARACTERISTIC lm_max "LM_MAX" VALUE 0x48293 a_173 5 MAF_8_RES40 0.0 1389.0 BIT_MASK 0xffffffff /end CHARACTERISTIC
/begin CHARACTERISTIC lm_max_diag "LM_MAX_DIAG" VALUE 0x48648 a_174 30 MAF_KGH_16_RES775 0.0 16383.75 BIT_MASK 0xffffffff /end CHARACTERISTIC
/begin CHARACTERISTIC lm_max_diag_ll "LM_MAX_DIAG_LL" VALUE 0x48294 a_173 10 MAF_8_RES40 0.0 1389.0 BIT_MASK 0xffffffff /end CHARACTERISTIC
/begin CHARACTERISTIC lm_max_fc_2 "LM_MAX_FC_2" VALUE 0x48295 a_173 100 MAF_8_RES37 0.0 1389.0 BIT_MASK 0xffffffff /end CHARACTERISTIC
/begin CHARACTERISTIC lm_max_hfm_diag "LM_MAX_HFM_DIAG" VALUE 0x48296 a_173 100 MAF_8_RES37 0.0 1389.0 BIT_MASK 0xffffffff /end CHARACTERISTIC
/begin CHARACTERISTIC lm_max_kat3 "LM_MAX_KAT3" VALUE 0x48297 a_173 100 MAF_8_RES37 0.0 1389.0 BIT_MASK 0xffffffff /end CHARACTERISTIC
/begin CHARACTERISTIC lm_min_diag "LM_MIN_DIAG" VALUE 0x4864a a_174 30 MAF_KGH_16_RES775 0.0 16383.75 BIT_MASK 0xffffffff /end CHARACTERISTIC
/begin CHARACTERISTIC lm_min_hfm_diag "LM_MIN_HFM_DIAG" VALUE 0x48298 a_173 100 MAF_8_RES37 0.0 1389.0 BIT_MASK 0xffffffff /end CHARACTERISTIC
/begin CHARACTERISTIC lm_min_kr_ll "LM_MIN_KR_LL" VALUE 0x48299 a_173 100 MAF_8_RES37 0.0 1389.0 BIT_MASK 0xffffffff /end CHARACTERISTIC
/begin CHARACTERISTIC lm_min_uls_diag "LM_MIN_ULS_DIAG" VALUE 0x4864c a_174 100 MAF_16_RES46 0.0 1389.0 BIT_MASK 0xffffffff /end CHARACTERISTIC
/begin CHARACTERISTIC lm_ob_lam_inst "LM_OB_LAM_INST" VALUE 0x4864e a_174 1 MAF_KGH_16_RES763 0.0 16383.75 BIT_MASK 0xffffffff /end CHARACTERISTIC
/begin CHARACTERISTIC lm_ti_ad_add_max "LM_TI_AD_ADD_MAX" VALUE 0x4829a a_173 5 MAF_8_RES40 0.0 1389.0 BIT_MASK 0xffffffff /end CHARACTERISTIC
/begin CHARACTERISTIC lm_ti_ad_fak_min "LM_TI_AD_FAK_MIN" VALUE 0x4829b a_173 5 MAF_8_RES40 0.0 1389.0 BIT_MASK 0xffffffff /end CHARACTERISTIC
/begin CHARACTERISTIC lm_ti_ad_max "LM_TI_AD_MAX" VALUE 0x48650 a_174 100 MAF_KGH_16_RES28 0.0 16383.75 BIT_MASK 0xffffffff /end CHARACTERISTIC
/begin CHARACTERISTIC lm_tv_min_diag "LM_TV_MIN_DIAG" VALUE 0x4829c a_173 10 MAF_8_RES40 0.0 1389.0 BIT_MASK 0xffffffff /end CHARACTERISTIC
/begin CHARACTERISTIC lm_unt_lam_inst "LM_UNT_LAM_INST" VALUE 0x48652 a_174 1 MAF_KGH_16_RES763 0.0 16383.75 BIT_MASK 0xffffffff /end CHARACTERISTIC
/begin CHARACTERISTIC lm_zw_hys "LM_ZW_HYS" VALUE 0x48654 a_174 10 LINEAR______0_000000__0H___694_5 0.0 694.5 BIT_MASK 0xffffffff /end CHARACTERISTIC
/begin CHARACTERISTIC lm_zw_hys_kr "LM_ZW_HYS_KR" VALUE 0x4829d a_173 2 MAF_8_RES40 0.0 1389.0 BIT_MASK 0xffffffff /end CHARACTERISTIC
/begin CHARACTERISTIC lm_zw_passiv "LM_ZW_PASSIV" VALUE 0x48656 a_174 10 MAF_16_RES49 0.0 1389.0 BIT_MASK 0xffffffff /end CHARACTERISTIC
/begin CHARACTERISTIC m_ind_asc_as "M_IND_ASC_AS" VALUE 0x48658 a_174 100 LINEAR______0_000000__0H___1023_ 0.0 1023.0 BIT_MASK 0xffffffff /end CHARACTERISTIC
/begin CHARACTERISTIC m_ind_asc_lm_as "M_IND_ASC_LM_AS" VALUE 0x4865a a_174 100 LINEAR______0_000000__0H___1023_ 0.0 1023.0 BIT_MASK 0xffffffff /end CHARACTERISTIC
/begin CHARACTERISTIC m_ind_dif "M_IND_DIF" VALUE 0x4865c a_174 100 LINEAR______0_000000__0H___1023_ 0.0 1023.0 BIT_MASK 0xffffffff /end CHARACTERISTIC
/begin CHARACTERISTIC m_ind_msr_max "M_IND_MSR_MAX" VALUE 0x4865e a_174 100 LINEAR______0_000000__0H___1023_ 0.0 1023.0 BIT_MASK 0xffffffff /end CHARACTERISTIC
/begin CHARACTERISTIC m_ldp_mitko "M_LDP_MITKO" VALUE 0x4829e a_173 100 LINEAR______0_000000__0H___0_920 0.0 0.99599999 BIT_MASK 0xffffffff /end CHARACTERISTIC
/begin CHARACTERISTIC m_norm "M_NORM" VALUE 0x48660 a_174 100 LINEAR______0_000000__0H___1023_ 0.0 1023.0 BIT_MASK 0xffffffff /end CHARACTERISTIC
/begin CHARACTERISTIC m_zw_dif "M_ZW_DIF" VALUE 0x48662 a_174 100 LINEAR______0_000000__0H___1023_ 0.0 1023.0 BIT_MASK 0xffffffff /end CHARACTERISTIC
/begin CHARACTERISTIC md_ind_diag_aebg "MD_IND_DIAG_AEBG" VALUE 0x48664 a_174 100 LINEAR______0_000000__0H___10776 0.0 100.0 BIT_MASK 0xffffffff /end CHARACTERISTIC
/begin CHARACTERISTIC mdk_ad_max "MDK_AD_MAX" VALUE 0x48666 a_174 10 MTC_IN_DK_16_RES202 0.0 239.99634 BIT_MASK 0xffffffff /end CHARACTERISTIC
/begin CHARACTERISTIC mdk_ad_min "MDK_AD_MIN" VALUE 0x48668 a_174 100 MTC_IN_DK_16_RES202 0.0 239.99634 BIT_MASK 0xffffffff /end CHARACTERISTIC
/begin CHARACTERISTIC mdk_ad_mitko "MDK_AD_MITKO" VALUE 0x4829f a_173 10 LINEAR______0_000000__0H___0_920 0.0 0.99599999 BIT_MASK 0xffffffff /end CHARACTERISTIC
/begin CHARACTERISTIC mdk_dif_akt "MDK_DIF_AKT" VALUE 0x4866a a_174 10 MTC_NORM_16_RES10 0.0 119.99817 BIT_MASK 0xffffffff /end CHARACTERISTIC
/begin CHARACTERISTIC mdk_dif_pas "MDK_DIF_PAS" VALUE 0x4866c a_174 10 MTC_NORM_16_RES10 0.0 119.99817 BIT_MASK 0xffffffff /end CHARACTERISTIC
/begin CHARACTERISTIC mdk_fest "MDK_FEST" VALUE 0x4866e a_174 5 MTC_NORM_16_RES10 0.0 119.99817 BIT_MASK 0xffffffff /end CHARACTERISTIC
/begin CHARACTERISTIC mdk_ist_fest "MDK_IST_FEST" VALUE 0x48670 a_174 5 MTC_NORM_16_RES10 0.0 119.99817 BIT_MASK 0xffffffff /end CHARACTERISTIC
/begin CHARACTERISTIC mdk_ist_ob_ll_ad "MDK_IST_OB_LL_AD" VALUE 0x48672 a_174 100 LINEAR______0_000000__0H___11777 0.0 119.5 BIT_MASK 0xffffffff /end CHARACTERISTIC
/begin CHARACTERISTIC mdk_ll "MDK_LL" VALUE 0x48674 a_174 100 MTC_NORM_16_RES10 0.0 119.99817 BIT_MASK 0xffffffff /end CHARACTERISTIC
/begin CHARACTERISTIC mdk_ll_end "MDK_LL_END" VALUE 0x48676 a_174 100 MTC_NORM_16_RES10 0.0 119.99817 BIT_MASK 0xffffffff /end CHARACTERISTIC
/begin CHARACTERISTIC mdk_min_vl "MDK_MIN_VL" VALUE 0x48678 a_174 10 MTC_NORM_16_RES10 0.0 119.99817 BIT_MASK 0xffffffff /end CHARACTERISTIC
/begin CHARACTERISTIC mdk_notl_max "MDK_NOTL_MAX" VALUE 0x4867a a_174 100 MTC_NORM_16_RES778 0.0 119.99817 BIT_MASK 0xffffffff /end CHARACTERISTIC
/begin CHARACTERISTIC mdk_soll_ad_min "MDK_SOLL_AD_MIN" VALUE 0x4867c a_174 10 MTC_NORM_16_RES10 0.0 119.99817 BIT_MASK 0xffffffff /end CHARACTERISTIC
/begin CHARACTERISTIC mdk_soll_diag_aebg "MDK_SOLL_DIAG_AEBG" VALUE 0x4867e a_174 100 MTC_NORM_16_RES779 0.0 119.99817 BIT_MASK 0xffffffff /end CHARACTERISTIC
/begin CHARACTERISTIC mdk_zw_dif "MDK_ZW_DIF" VALUE 0x48680 a_174 100 LINEAR______0_000000__0H___11780 0.0 119.5 BIT_MASK 0xffffffff /end CHARACTERISTIC
/begin CHARACTERISTIC mitko_ll_diag_lu "MITKO_LL_DIAG_LU" VALUE 0x482a0 a_173 100 LINEAR______0_000000__0H___0_920 0.0 0.99599999 BIT_MASK 0xffffffff /end CHARACTERISTIC
/begin CHARACTERISTIC mitko_lm_van "MITKO_LM_VAN" VALUE 0x482a1 a_173 100 LINEAR______0_000000__0H___0_203 0.0 0.99599999 BIT_MASK 0xffffffff /end CHARACTERISTIC
/begin CHARACTERISTIC mitko_nsoll_min_ub "MITKO_NSOLL_MIN_UB" VALUE 0x482a2 a_173 10 LINEAR______0_000000__0H___0_781 0.0 0.99599999 BIT_MASK 0xffffffff /end CHARACTERISTIC
/begin CHARACTERISTIC mitko_nw_ad_st_vanos "MITKO_NW_AD_ST_VANOS" VALUE 0x482a3 a_173 100 LINEAR______0_000000__0H___0_920 0.0 0.99599999 BIT_MASK 0xffffffff /end CHARACTERISTIC
/begin CHARACTERISTIC mitko_nw_ad_vanos "MITKO_NW_AD_VANOS" VALUE 0x482a4 a_173 100 LINEAR______0_000000__0H___0_920 0.0 0.99599999 BIT_MASK 0xffffffff /end CHARACTERISTIC
/begin CHARACTERISTIC mitko_pwg_kor_fak "MITKO_PWG_KOR_FAK" VALUE 0x48682 a_174 100 LINEAR______0_000000__0H___0_924 0.0 0.99997997 BIT_MASK 0xffffffff /end CHARACTERISTIC
/begin CHARACTERISTIC mitko_ref_vanos "MITKO_REF_VANOS" VALUE 0x482a5 a_173 100 LINEAR______0_000000__0H___0_782 0.0 0.99599999 BIT_MASK 0xffffffff /end CHARACTERISTIC
/begin CHARACTERISTIC mitko_sum_ti_ad_add "MITKO_SUM_TI_AD_ADD" VALUE 0x48684 a_174 100 LINEAR______0_000000__0H___25783 0.0 255.0 BIT_MASK 0xffffffff /end CHARACTERISTIC
/begin CHARACTERISTIC mitko_sum_ti_ad_fak "MITKO_SUM_TI_AD_FAK" VALUE 0x48686 a_174 100 LINEAR______0_000000__0H___25783 0.0 255.0 BIT_MASK 0xffffffff /end CHARACTERISTIC
/begin CHARACTERISTIC mitko_tallfs_fc "MITKO_TALLFS_FC" VALUE 0x48688 a_174 10 LINEAR______0_000000__0H___1_784 0.0 1.0 BIT_MASK 0xffffffff /end CHARACTERISTIC
/begin CHARACTERISTIC mitko_tallfs_ndif "MITKO_TALLFS_NDIF" VALUE 0x4868a a_174 100 LINEAR______0_000000__0H___0_993 0.0 0.99997997 BIT_MASK 0xffffffff /end CHARACTERISTIC
/begin CHARACTERISTIC MOTION_GRAD_ACT_LIMIT "MOTION_GRAD_ACT_LIMIT" VALUE 0x487ee a_175 100 SIGNEDCHAR -128.0 127.0 BIT_MASK 0xffffffff /end CHARACTERISTIC
/begin CHARACTERISTIC MUL_RK_MAX "MUL_RK_MAX" VALUE 0x4868c a_174 100 LINEAR______0_000000__0H___65190 0.0 65535.0 BIT_MASK 0xffffffff /end CHARACTERISTIC
/begin CHARACTERISTIC MUL_RK_MIN "MUL_RK_MIN" VALUE 0x4868e a_174 100 LINEAR______0_000000__0H___65190 0.0 65535.0 BIT_MASK 0xffffffff /end CHARACTERISTIC
/begin CHARACTERISTIC n_ad_dyf_ll "N_AD_DYF_LL" VALUE 0x482a6 a_173 5 LINEAR______0_000000__0H___25785 0.0 255.0 BIT_MASK 0xffffffff /end CHARACTERISTIC
/begin CHARACTERISTIC n_dif_fak "N_DIF_FAK" VALUE 0x482a7 a_173 20 LINEAR______0_000000__0H___0_129 0.0 0.99599999 BIT_MASK 0xffffffff /end CHARACTERISTIC
/begin CHARACTERISTIC n_dif_fc "N_DIF_FC" VALUE 0x48690 a_174 5 IS_13_RES786 0.0 8160.0 BIT_MASK 0xffffffff /end CHARACTERISTIC
/begin CHARACTERISTIC n_dif_max_diag "N_DIF_MAX_DIAG" VALUE 0x482a8 a_173 100 LINEAR______0_000000__0H___25787 0.0 255.0 BIT_MASK 0xffffffff /end CHARACTERISTIC
/begin CHARACTERISTIC n_dif_max_ll "N_DIF_MAX_LL" VALUE 0x48692 a_174 5 IS_13_RES84 0.0 8160.0 BIT_MASK 0xffffffff /end CHARACTERISTIC
/begin CHARACTERISTIC n_dif_max_ll_tv "N_DIF_MAX_LL_TV" VALUE 0x48694 a_174 5 IS_13_RES84 0.0 8160.0 BIT_MASK 0xffffffff /end CHARACTERISTIC
/begin CHARACTERISTIC n_dif_min_diag "N_DIF_MIN_DIAG" VALUE 0x482a9 a_173 100 LINEAR______0_000000__0H___25787 0.0 255.0 BIT_MASK 0xffffffff /end CHARACTERISTIC
/begin CHARACTERISTIC n_dif_min_gmw "N_DIF_MIN_GMW" VALUE 0x480ee a_172 10 LINEAR_______4080_000000__FFFFF0 -4080.0 0.0 BIT_MASK 0xffffffff /end CHARACTERISTIC
/begin CHARACTERISTIC n_dif_min_well "N_DIF_MIN_WELL" VALUE 0x48696 a_174 10 LINEAR______0_000000__0H___81788 0.0 8160.0 BIT_MASK 0xffffffff /end CHARACTERISTIC
/begin CHARACTERISTIC n_dif_mitko "N_DIF_MITKO" VALUE 0x482aa a_173 20 LINEAR______0_000000__0H___0_129 0.0 0.99599999 BIT_MASK 0xffffffff /end CHARACTERISTIC
/begin CHARACTERISTIC n_dif_ns "N_DIF_NS" VALUE 0x48698 a_174 100 LINEAR______0_000000__0H___10789 0.0 1000.0 BIT_MASK 0xffffffff /end CHARACTERISTIC
/begin CHARACTERISTIC n_dyf "N_DYF" VALUE 0x4869a a_174 2 IS_13_RES84 0.0 8160.0 BIT_MASK 0xffffffff /end CHARACTERISTIC
/begin CHARACTERISTIC n_fc_diag "N_FC_DIAG" VALUE 0x4869c a_174 5 IS_13_RES786 0.0 8160.0 BIT_MASK 0xffffffff /end CHARACTERISTIC
/begin CHARACTERISTIC n_ftp_max "N_FTP_MAX" VALUE 0x482ab a_173 100 LINEAR______480_000000__FH___816 480.0 8160.0 BIT_MASK 0xffffffff /end CHARACTERISTIC
/begin CHARACTERISTIC n_hys_disa "N_HYS_DISA" VALUE 0x4869e a_174 5 IS_13_RES84 0.0 8160.0 BIT_MASK 0xffffffff /end CHARACTERISTIC
/begin CHARACTERISTIC n_hys_max_sa "N_HYS_MAX_SA" VALUE 0x482ac a_173 10 ES_8_RES116 0.0 8160.0 BIT_MASK 0xffffffff /end CHARACTERISTIC
/begin CHARACTERISTIC n_hys_min_sa "N_HYS_MIN_SA" VALUE 0x482ad a_173 10 ES_8_RES116 0.0 8160.0 BIT_MASK 0xffffffff /end CHARACTERISTIC
/begin CHARACTERISTIC n_hys_sa_st "N_HYS_SA_ST" VALUE 0x482ae a_173 10 ES_8_RES116 0.0 8160.0 BIT_MASK 0xffffffff /end CHARACTERISTIC
/begin CHARACTERISTIC n_llfs_diag "N_LLFS_DIAG" VALUE 0x482af a_173 100 ES_8_RES790 0.0 8160.0 BIT_MASK 0xffffffff /end CHARACTERISTIC
/begin CHARACTERISTIC n_max_ar "N_MAX_AR" VALUE 0x482b0 a_173 100 LINEAR______0_000000__0H___5984_ 0.0 5984.0 BIT_MASK 0xffffffff /end CHARACTERISTIC
/begin CHARACTERISTIC n_max_diag "N_MAX_DIAG" VALUE 0x482b1 a_173 10 ES_8_RES41 0.0 8160.0 BIT_MASK 0xffffffff /end CHARACTERISTIC
/begin CHARACTERISTIC n_max_diag_sl "N_MAX_DIAG_SL" VALUE 0x482b2 a_173 10 ES_8_RES41 0.0 8160.0 BIT_MASK 0xffffffff /end CHARACTERISTIC
/begin CHARACTERISTIC n_max_hfm_diag "N_MAX_HFM_DIAG" VALUE 0x482b3 a_173 100 ES_8_RES 0.0 8160.0 BIT_MASK 0xffffffff /end CHARACTERISTIC
/begin CHARACTERISTIC n_max_kat3 "N_MAX_KAT3" VALUE 0x482b4 a_173 100 ES_8_RES17 0.0 8160.0 BIT_MASK 0xffffffff /end CHARACTERISTIC
/begin CHARACTERISTIC n_max_lu "N_MAX_LU" VALUE 0x482b5 a_173 5 LINEAR______480_000000__FH___791 480.0 8160.0 BIT_MASK 0xffffffff /end CHARACTERISTIC
/begin CHARACTERISTIC n_max_mz "N_MAX_MZ" VALUE 0x482b6 a_173 100 LINEAR______0_000000__0H___81792 0.0 8169.0 BIT_MASK 0xffffffff /end CHARACTERISTIC
/begin CHARACTERISTIC n_max_te_vl "N_MAX_TE_VL" VALUE 0x482b7 a_173 100 ES_8_RES 0.0 8160.0 BIT_MASK 0xffffffff /end CHARACTERISTIC
/begin CHARACTERISTIC n_max_ub_gmw "N_MAX_UB_GMW" VALUE 0x486a0 a_174 10 LINEAR______0_000000__0H___81793 0.0 8160.0 BIT_MASK 0xffffffff /end CHARACTERISTIC
/begin CHARACTERISTIC n_max_zw_kor_nw_dif "N_MAX_ZW_KOR_NW_DIF" VALUE 0x482b8 a_173 100 ES_8_RES41 0.0 8160.0 BIT_MASK 0xffffffff /end CHARACTERISTIC
/begin CHARACTERISTIC n_min_aebg_s "N_MIN_AEBG_S" VALUE 0x482b9 a_173 12 ES_8_RES41 0.0 8160.0 BIT_MASK 0xffffffff /end CHARACTERISTIC
/begin CHARACTERISTIC n_min_ar "N_MIN_AR" VALUE 0x482ba a_173 100 ES_8_RES116 0.0 8160.0 BIT_MASK 0xffffffff /end CHARACTERISTIC
/begin CHARACTERISTIC n_min_hfm_diag "N_MIN_HFM_DIAG" VALUE 0x482bb a_173 100 ES_8_RES 0.0 8160.0 BIT_MASK 0xffffffff /end CHARACTERISTIC
/begin CHARACTERISTIC n_min_kr_ad_at "N_MIN_KR_AD_AT" VALUE 0x482bc a_173 100 ES_8_RES 0.0 8160.0 BIT_MASK 0xffffffff /end CHARACTERISTIC
/begin CHARACTERISTIC n_min_lu "N_MIN_LU" VALUE 0x482bd a_173 5 LINEAR______480_000000__FH___791 480.0 8160.0 BIT_MASK 0xffffffff /end CHARACTERISTIC
/begin CHARACTERISTIC n_min_slow_s "N_MIN_SLOW_S" VALUE 0x482be a_173 10 ES_8_RES41 0.0 8160.0 BIT_MASK 0xffffffff /end CHARACTERISTIC
/begin CHARACTERISTIC n_min_v_beg "N_MIN_V_BEG" VALUE 0x482bf a_173 100 ES_8_RES 0.0 8160.0 BIT_MASK 0xffffffff /end CHARACTERISTIC
/begin CHARACTERISTIC n_min_vl "N_MIN_VL" VALUE 0x482c0 a_173 10 ES_8_RES41 0.0 8160.0 BIT_MASK 0xffffffff /end CHARACTERISTIC
/begin CHARACTERISTIC n_nw_ad_max "N_NW_AD_MAX" VALUE 0x482c1 a_173 100 ES_8_RES17 0.0 8160.0 BIT_MASK 0xffffffff /end CHARACTERISTIC
/begin CHARACTERISTIC n_proz_el_aebg "N_PROZ_EL_AEBG" VALUE 0x482c2 a_173 100 LINEAR______0_000000__0H___25_00 0.0 25.0 BIT_MASK 0xffffffff /end CHARACTERISTIC
/begin CHARACTERISTIC n_proz_el_aktiv "N_PROZ_EL_AKTIV" VALUE 0x482c3 a_173 100 LINEAR______0_000000__0H___99_61 0.0 99.610001 BIT_MASK 0xffffffff /end CHARACTERISTIC
/begin CHARACTERISTIC n_proz_el_as "N_PROZ_EL_AS" VALUE 0xe5ab a_173 100 LINEAR_______50_000000__0H___794 -50.0 49.6094 BIT_MASK 0xffffffff /end CHARACTERISTIC
/begin CHARACTERISTIC n_schw_ar "N_SCHW_AR" VALUE 0x482c4 a_173 100 LINEAR______1824_000000__39H___8 1824.0 8160.0 BIT_MASK 0xffffffff /end CHARACTERISTIC
/begin CHARACTERISTIC n_sl_max "N_SL_MAX" VALUE 0x482c5 a_173 10 ES_8_RES116 0.0 8160.0 BIT_MASK 0xffffffff /end CHARACTERISTIC
/begin CHARACTERISTIC n_sl_zyka_diag "N_SL_ZYKA_DIAG" VALUE 0x482c6 a_173 100 LINEAR______0_000000__0H___25795 0.0 255.0 BIT_MASK 0xffffffff /end CHARACTERISTIC
/begin CHARACTERISTIC n_ssp "N_SSP" VALUE 0x482c7 a_173 10 ES_8_RES41 0.0 8160.0 BIT_MASK 0xffffffff /end CHARACTERISTIC
/begin CHARACTERISTIC n_tallfs_add_ein "N_TALLFS_ADD_EIN" VALUE 0x486a2 a_174 1 IS_13_RES62 0.0 8160.0 BIT_MASK 0xffffffff /end CHARACTERISTIC
/begin CHARACTERISTIC n_ti_ad_add_max "N_TI_AD_ADD_MAX" VALUE 0x486a4 a_174 100 LINEAR______1_000000__1H___8160_ 1.0 8160.0 BIT_MASK 0xffffffff /end CHARACTERISTIC
/begin CHARACTERISTIC n_ti_ad_fak_min "N_TI_AD_FAK_MIN" VALUE 0x486a6 a_174 100 IS_13_RES84 0.0 8160.0 BIT_MASK 0xffffffff /end CHARACTERISTIC
/begin CHARACTERISTIC n_tv_min_diag "N_TV_MIN_DIAG" VALUE 0x482c8 a_173 10 ES_8_RES41 0.0 8160.0 BIT_MASK 0xffffffff /end CHARACTERISTIC
/begin CHARACTERISTIC n_ue_min "N_UE_MIN" VALUE 0x486a8 a_174 100 IS_13_RES78 0.0 8160.0 BIT_MASK 0xffffffff /end CHARACTERISTIC
/begin CHARACTERISTIC n_v_max_fgr "N_V_MAX_FGR" VALUE 0x482c9 a_173 10 LINEAR______0_000000__0H___99_84 0.0 99.84 BIT_MASK 0xffffffff /end CHARACTERISTIC
/begin CHARACTERISTIC n_zw_hys_kr "N_ZW_HYS_KR" VALUE 0x482ca a_173 2 ES_8_RES116 0.0 8160.0 BIT_MASK 0xffffffff /end CHARACTERISTIC
/begin CHARACTERISTIC ngrd_min "NGRD_MIN" VALUE 0x487ef a_175 5 LINEAR_______4096_000000__FFFFFF -4096.0 0.0 BIT_MASK 0xffffffff /end CHARACTERISTIC
/begin CHARACTERISTIC ngrd_min_d "NGRD_MIN_D" VALUE 0x487f0 a_175 5 LINEAR_______4096_000000__FFF796 -4096.0 0.0 BIT_MASK 0xffffffff /end CHARACTERISTIC
/begin CHARACTERISTIC ngrd_tallfs_i_add "NGRD_TALLFS_I_ADD" VALUE 0x487f1 a_175 5 LINEAR_______4096_000000__FFF796 -4096.0 0.0 BIT_MASK 0xffffffff /end CHARACTERISTIC
/begin CHARACTERISTIC nmax_aebg_dec "NMAX_AEBG_DEC" VALUE 0x486aa a_174 100 LINEAR______0_000000__0H___81797 0.0 8160.0 BIT_MASK 0xffffffff /end CHARACTERISTIC
/begin CHARACTERISTIC nmax_aebg_diag "NMAX_AEBG_DIAG" VALUE 0x486ac a_174 100 LINEAR______0_000000__0H___81797 0.0 8160.0 BIT_MASK 0xffffffff /end CHARACTERISTIC
/begin CHARACTERISTIC nmax_at_r "NMAX_AT_R" VALUE 0x482cb a_173 100 ES_8_RES41 0.0 8160.0 BIT_MASK 0xffffffff /end CHARACTERISTIC
/begin CHARACTERISTIC nmax_diag_hi "NMAX_DIAG_HI" VALUE 0x482cc a_173 10 ES_8_RES41 0.0 8160.0 BIT_MASK 0xffffffff /end CHARACTERISTIC
/begin CHARACTERISTIC nmax_diag_lo "NMAX_DIAG_LO" VALUE 0x482cd a_173 10 ES_8_RES41 0.0 8160.0 BIT_MASK 0xffffffff /end CHARACTERISTIC
/begin CHARACTERISTIC nmax_diag_tv "NMAX_DIAG_TV" VALUE 0x482ce a_173 10 ES_8_RES41 0.0 8160.0 BIT_MASK 0xffffffff /end CHARACTERISTIC
/begin CHARACTERISTIC nmax_eew_ti_inst "NMAX_EEW_TI_INST" VALUE 0x482cf a_173 20 LINEAR______0_000000__0H___5024_ 0.0 5024.0 BIT_MASK 0xffffffff /end CHARACTERISTIC
/begin CHARACTERISTIC nmax_hys "NMAX_HYS" VALUE 0x482d0 a_173 5 ES_8_RES116 0.0 8160.0 BIT_MASK 0xffffffff /end CHARACTERISTIC
/begin CHARACTERISTIC nmax_hys_diag "NMAX_HYS_DIAG" VALUE 0x482d1 a_173 5 ES_8_RES116 0.0 8160.0 BIT_MASK 0xffffffff /end CHARACTERISTIC
/begin CHARACTERISTIC nmax_hys_max "NMAX_HYS_MAX" VALUE 0x482d2 a_173 5 ES_8_RES116 0.0 8160.0 BIT_MASK 0xffffffff /end CHARACTERISTIC
/begin CHARACTERISTIC nmax_hys_nmax "NMAX_HYS_NMAX" VALUE 0x482d3 a_173 5 ES_8_RES116 0.0 8160.0 BIT_MASK 0xffffffff /end CHARACTERISTIC
/begin CHARACTERISTIC nmax_hys_ti_kor "NMAX_HYS_TI_KOR" VALUE 0x482d4 a_173 5 ES_8_RES116 0.0 8160.0 BIT_MASK 0xffffffff /end CHARACTERISTIC
/begin CHARACTERISTIC nmax_hys_ti_kor_diag "NMAX_HYS_TI_KOR_DIAG" VALUE 0x482d5 a_173 5 ES_8_RES116 0.0 8160.0 BIT_MASK 0xffffffff /end CHARACTERISTIC
/begin CHARACTERISTIC nmax_max_add "NMAX_MAX_ADD" VALUE 0x482d6 a_173 10 ES_8_RES41 0.0 8160.0 BIT_MASK 0xffffffff /end CHARACTERISTIC
/begin CHARACTERISTIC nmax_min_diag "NMAX_MIN_DIAG" VALUE 0x482d7 a_173 10 ES_8_RES41 0.0 8160.0 BIT_MASK 0xffffffff /end CHARACTERISTIC
/begin CHARACTERISTIC nmax_tn_ad_lu "NMAX_TN_AD_LU" VALUE 0x482d8 a_173 5 ES_8_RES41 0.0 8160.0 BIT_MASK 0xffffffff /end CHARACTERISTIC
/begin CHARACTERISTIC nmax_unt_st "NMAX_UNT_ST" VALUE 0x482d9 a_173 5 ES_8_RES116 0.0 8160.0 BIT_MASK 0xffffffff /end CHARACTERISTIC
/begin CHARACTERISTIC nmax_zsi "NMAX_ZSI" VALUE 0x482da a_173 10 ES_8_RES41 0.0 8160.0 BIT_MASK 0xffffffff /end CHARACTERISTIC
/begin CHARACTERISTIC nmax_zsr_diag "NMAX_ZSR_DIAG" VALUE 0x482db a_173 10 ES_8_RES41 0.0 8160.0 BIT_MASK 0xffffffff /end CHARACTERISTIC
/begin CHARACTERISTIC nmin_diag_lm "NMIN_DIAG_LM" VALUE 0x482dc a_173 30 ES_8_RES41 0.0 8160.0 BIT_MASK 0xffffffff /end CHARACTERISTIC
/begin CHARACTERISTIC nmin_dshpt "NMIN_DSHPT" VALUE 0x482dd a_173 12 ES_8_RES41 0.0 8160.0 BIT_MASK 0xffffffff /end CHARACTERISTIC
/begin CHARACTERISTIC nmin_kr_diag "NMIN_KR_DIAG" VALUE 0x482de a_173 100 LINEAR______1024_000000__20H___8 1024.0 8160.0 BIT_MASK 0xffffffff /end CHARACTERISTIC
/begin CHARACTERISTIC nmin_sa_diag "NMIN_SA_DIAG" VALUE 0x482df a_173 100 ES_8_RES41 0.0 8160.0 BIT_MASK 0xffffffff /end CHARACTERISTIC
/begin CHARACTERISTIC nmin_tn_ad_lu "NMIN_TN_AD_LU" VALUE 0x482e0 a_173 5 LINEAR______480_000000__FH___791 480.0 8160.0 BIT_MASK 0xffffffff /end CHARACTERISTIC
/begin CHARACTERISTIC NO_COR_SWING_ACT_LiMIT "NO_COR_SWIMG_ACT_LIMIT" VALUE 0x487f2 a_175 100 SIGNEDCHAR -128.0 127.0 BIT_MASK 0xffffffff /end CHARACTERISTIC
/begin CHARACTERISTIC NO_COR_SWING_SET_LiMIT "NO_COR_SWIMG_SET_LIMIT" VALUE 0x487f3 a_175 100 SIGNEDCHAR -128.0 127.0 BIT_MASK 0xffffffff /end CHARACTERISTIC
/begin CHARACTERISTIC NO_MOTION_GRAD_ACT_LIMIT "NO_MOTION_GRAD_ACT_LIMIT" VALUE 0x487f4 a_175 100 SIGNEDCHAR -128.0 127.0 BIT_MASK 0xffffffff /end CHARACTERISTIC
/begin CHARACTERISTIC nsoll_add_ss_max "NSOLL_ADD_SS_MAX" VALUE 0x482e1 a_173 100 LINEAR_______256_000000__0___254 -256.0 254.0 BIT_MASK 0xffffffff /end CHARACTERISTIC
/begin CHARACTERISTIC nsoll_add_ss_min "NSOLL_ADD_SS_MIN" VALUE 0x482e2 a_173 100 LINEAR_______256_000000__0___254 -256.0 254.0 BIT_MASK 0xffffffff /end CHARACTERISTIC
/begin CHARACTERISTIC nsoll_aebg_ll "NSOLL_AEBG_LL" VALUE 0x482e3 a_173 20 LINEAR______0_250000__1H___63_75 0.25 63.75 BIT_MASK 0xffffffff /end CHARACTERISTIC
/begin CHARACTERISTIC nsoll_dec_kup_swi "NSOLL_DEC_KUP_SWI" VALUE 0x482e4 a_173 20 LINEAR______0_031250__1H___7_798 0.03125 7.96875 BIT_MASK 0xffffffff /end CHARACTERISTIC
/begin CHARACTERISTIC nsoll_inc_kup_swi "NSOLL_INC_KUP_SWI" VALUE 0x482e5 a_173 20 LINEAR______0_031250__1H___7_798 0.03125 7.96875 BIT_MASK 0xffffffff /end CHARACTERISTIC
/begin CHARACTERISTIC nsoll_ll_diag_vanos "NSOLL_LL_DIAG_VANOS" VALUE 0x486ae a_174 100 IS_13_RES78 0.0 8160.0 BIT_MASK 0xffffffff /end CHARACTERISTIC
/begin CHARACTERISTIC nw_dif_kr_ad_max "NW_DIF_KR_AD_MAX" VALUE 0x482e6 a_173 100 LINEAR______0_000000__0H___95799 0.0 95.625 BIT_MASK 0xffffffff /end CHARACTERISTIC
/begin CHARACTERISTIC nw_dif_min_totz "NW_DIF_MIN_TOTZ" VALUE 0x482e7 a_173 100 LINEAR______0_000000__0H___48_00 0.0 48.0 BIT_MASK 0xffffffff /end CHARACTERISTIC
/begin CHARACTERISTIC nw_grd_ad_max "NW_GRD_AD_MAX" VALUE 0x482e8 a_173 100 LINEAR______0_000000__0H___95800 0.0 95.625 BIT_MASK 0xffffffff /end CHARACTERISTIC
/begin CHARACTERISTIC nw_grd_st_max "NW_GRD_ST_MAX" VALUE 0x482e9 a_173 100 LINEAR______0_000000__0H___95800 0.0 95.625 BIT_MASK 0xffffffff /end CHARACTERISTIC
/begin CHARACTERISTIC nw_hys_ad_vanos "NW_HYS_AD_VANOS" VALUE 0x482ea a_173 100 LINEAR______0_000000__0H___47_62 0.0 47.625 BIT_MASK 0xffffffff /end CHARACTERISTIC
/begin CHARACTERISTIC nw_hys_ref "NW_HYS_REF" VALUE 0x482eb a_173 100 LINEAR______0_000000__0H___47_62 0.0 47.625 BIT_MASK 0xffffffff /end CHARACTERISTIC
/begin CHARACTERISTIC nw_ini_a "NW_INI_A" VALUE 0x482ec a_173 100 LINEAR_______155_625000__FFH_801 -155.625 -60.0 BIT_MASK 0xffffffff /end CHARACTERISTIC
/begin CHARACTERISTIC nw_ini_e "NW_INI_E" VALUE 0x482ed a_173 100 LINEAR______60_000000__0H___1802 60.0 155.625 BIT_MASK 0xffffffff /end CHARACTERISTIC
/begin CHARACTERISTIC nw_oew_a "NW_OEW_A" VALUE 0x482ee a_173 100 LINEAR______175_000000__0H___270 175.0 270.60001 BIT_MASK 0xffffffff /end CHARACTERISTIC
/begin CHARACTERISTIC nw_oew_e "NW_OEW_E" VALUE 0x482ef a_173 100 LINEAR______175_000000__0H___270 175.0 270.60001 BIT_MASK 0xffffffff /end CHARACTERISTIC
/begin CHARACTERISTIC nw_verst_dif_diag_a "NW_VERST_DIF_DIAG_A" VALUE 0x482f0 a_173 100 LINEAR______0_000000__0H___95803 0.0 95.625 BIT_MASK 0xffffffff /end CHARACTERISTIC
/begin CHARACTERISTIC nw_verst_dif_diag_e "NW_VERST_DIF_DIAG_E" VALUE 0x482f1 a_173 100 LINEAR______0_000000__0H___95803 0.0 95.625 BIT_MASK 0xffffffff /end CHARACTERISTIC
/begin CHARACTERISTIC nw_verst_max_a "NW_VERST_MAX_A" VALUE 0x482f2 a_173 100 LINEAR______0_000000__0H___48_00 0.0 48.0 BIT_MASK 0xffffffff /end CHARACTERISTIC
/begin CHARACTERISTIC nw_verst_max_e "NW_VERST_MAX_E" VALUE 0x482f3 a_173 100 LINEAR______0_000000__0H___48_00 0.0 48.0 BIT_MASK 0xffffffff /end CHARACTERISTIC
/begin CHARACTERISTIC nwsoll_as_a "NWSOLL_AS_A" VALUE 0xe59c a_175 100 LINEAR______48_000000__FFFFFF80H -47.625 48.0 BIT_MASK 0xffffffff /end CHARACTERISTIC
/begin CHARACTERISTIC nwsoll_as_e "NWSOLL_AS_E" VALUE 0xe59d a_175 100 LINEAR_______48_000000__FFFFFF80 -48.0 47.625 BIT_MASK 0xffffffff /end CHARACTERISTIC
/begin CHARACTERISTIC nwsoll_dif_max "NWSOLL_DIF_MAX" VALUE 0x482f4 a_173 100 LINEAR______0_000000__0H___47_62 0.0 47.625 BIT_MASK 0xffffffff /end CHARACTERISTIC
/begin CHARACTERISTIC nwsoll_e_tallfs_min_aebg "NWSOLL_E_TALLFS_MIN_AEBG" VALUE 0x486b0 a_174 10 LINEAR______0_001460__1H___47168 0.00146 47.998501 BIT_MASK 0xffffffff /end CHARACTERISTIC
/begin CHARACTERISTIC omega_v_fil "OMEGA_V_FIL" VALUE 0x482f5 a_173 10 LINEAR______0_000000__0H___25142 0.0 255.0 BIT_MASK 0xffffffff /end CHARACTERISTIC
/begin CHARACTERISTIC p_umg_ini "P_UMG_INI" VALUE 0x486b2 a_174 100 LINEAR______0_000000__0H___5434_ 0.0 5434.2598 BIT_MASK 0xffffffff /end CHARACTERISTIC
/begin CHARACTERISTIC PERIOD_CNT_LIMIT "PERIOD_CNT_LIMIT" VALUE 0x480f0 a_172 100 LINEAR_______32768_000000__FF180 -32768.0 32767.0 BIT_MASK 0xffffffff /end CHARACTERISTIC
/begin CHARACTERISTIC PERIOD_COUNT_LIMIT "PERIOD_COUNT_LIMIT" VALUE 0x487f5 a_175 100 SIGNEDCHAR -128.0 127.0 BIT_MASK 0xffffffff /end CHARACTERISTIC
/begin CHARACTERISTIC poti_ad_diag "POTI_ADD_DIAG" VALUE 0x486b4 a_174 100 MTC_NORM_16_RES51 0.0 119.99817 BIT_MASK 0xffffffff /end CHARACTERISTIC
/begin CHARACTERISTIC pq_ts_llfs_diag "PQ_TS_LLFS_DIAG" VALUE 0x482f6 a_173 100 LINEAR______0_000000__0H___0_804 0.0 0.99610001 BIT_MASK 0xffffffff /end CHARACTERISTIC
/begin CHARACTERISTIC ps_min_ldp "PS_MIN_LDP" VALUE 0x486b6 a_174 10 LINEAR______0_000000__0H___54805 0.0 5434.2598 BIT_MASK 0xffffffff /end CHARACTERISTIC
/begin CHARACTERISTIC pu_fak_mitko "PU_FAK_MITKO" VALUE 0x486b8 a_174 100 LINEAR______0_000000__0H___0_916 0.0 0.99998474 BIT_MASK 0xffffffff /end CHARACTERISTIC
/begin CHARACTERISTIC pwg_ad_max "PWG_AD_MAX" VALUE 0x486ba a_174 5 MTC_IN_DK_16_RES 0.0 239.99634 BIT_MASK 0xffffffff /end CHARACTERISTIC
/begin CHARACTERISTIC pwg_ad_min "PWG_AD_MIN" VALUE 0x486bc a_174 100 MTC_IN_DK_16_RES202 0.0 239.99634 BIT_MASK 0xffffffff /end CHARACTERISTIC
/begin CHARACTERISTIC pwg_aebg_fgr "PWG_AEBG_FGR" VALUE 0x486be a_174 100 LINEAR______0_000000__0H___11806 0.0 119.5 BIT_MASK 0xffffffff /end CHARACTERISTIC
/begin CHARACTERISTIC pwg_fak "PWG_FAK" VALUE 0x486c0 a_174 100 LINEAR______0_000000__0H___1_999 0.0 1.99997 BIT_MASK 0xffffffff /end CHARACTERISTIC
/begin CHARACTERISTIC pwg_hys_ak "PWG_HYS_AK" VALUE 0x482f7 a_173 100 LINEAR______0_000000__0H___11125 0.0 119.5 BIT_MASK 0xffffffff /end CHARACTERISTIC
/begin CHARACTERISTIC pwg_hys_fgr "PWG_HYS_FGR" VALUE 0x486c2 a_174 100 MTC_NORM_16_RES10 0.0 119.99817 BIT_MASK 0xffffffff /end CHARACTERISTIC
/begin CHARACTERISTIC pwg_notl_max "PWG_NOTL_MAX" VALUE 0x486c4 a_174 100 MTC_NORM_16_RES778 0.0 119.99817 BIT_MASK 0xffffffff /end CHARACTERISTIC
/begin CHARACTERISTIC pwg1_max_diag "PWG1_MAX_DIAG" VALUE 0x486c6 a_174 100 MTC_IN_DK_16_RES202 0.0 239.99634 BIT_MASK 0xffffffff /end CHARACTERISTIC
/begin CHARACTERISTIC pwg1_min_diag "PWG1_MIN_DIAG" VALUE 0x486c8 a_174 100 MTC_IN_DK_16_RES202 0.0 239.99634 BIT_MASK 0xffffffff /end CHARACTERISTIC
/begin CHARACTERISTIC pwg2_max_diag "PWG2_MAX_DIAG" VALUE 0x486ca a_174 100 MTC_IN_DK_16_RES202 0.0 239.99634 BIT_MASK 0xffffffff /end CHARACTERISTIC
/begin CHARACTERISTIC pwg2_min_diag "PWG2_MIN_DIAG" VALUE 0x486cc a_174 100 MTC_IN_DK_16_RES202 0.0 239.99634 BIT_MASK 0xffffffff /end CHARACTERISTIC
/begin CHARACTERISTIC PWM_MAX "PWM_MAX" VALUE 0x480f2 a_172 100 LINEAR_______32768_000000__FF180 -32768.0 32767.0 BIT_MASK 0xffffffff /end CHARACTERISTIC
/begin CHARACTERISTIC R_KOMP "R_KOMP" VALUE 0x480f4 a_172 100 LINEAR_______32768_000000__FFFF8 -32768.0 32767.0 BIT_MASK 0xffffffff /end CHARACTERISTIC
/begin CHARACTERISTIC r_kor "R_KOR" VALUE 0x486ce a_174 100 LINEAR______0_000000__0H___25807 0.0 255.996 BIT_MASK 0xffffffff /end CHARACTERISTIC
/begin CHARACTERISTIC r_max_lsh_diag "R_MAX_LSH_DIAG" VALUE 0x486d0 a_174 100 LINEAR______0_000000__0H___25808 0.0 255.996 BIT_MASK 0xffffffff /end CHARACTERISTIC
/begin CHARACTERISTIC r_min_lsh_diag "R_MIN_LSH_DIAG" VALUE 0x486d2 a_174 100 LINEAR______0_000000__0H___25808 0.0 255.996 BIT_MASK 0xffffffff /end CHARACTERISTIC
/begin CHARACTERISTIC rad_grd_mitko_sws "RAD_GRD_MITKO_SWS" VALUE 0x486d4 a_174 100 LINEAR______0_000000__0H___1_809 0.0 1.0 BIT_MASK 0xffffffff /end CHARACTERISTIC
/begin CHARACTERISTIC ram_address_ke "RAM_ADDRESS_KE" VALUE 0x486d6 a_174 100 LINEAR______0_000000__0H___65163 0.0 65535.0 BIT_MASK 0xffffffff /end CHARACTERISTIC
/begin CHARACTERISTIC rlsh_max_diag "RLSH_MAX_DIAG" VALUE 0x486d8 a_174 100 LINEAR______0_000000__0H___25808 0.0 255.996 BIT_MASK 0xffffffff /end CHARACTERISTIC
/begin CHARACTERISTIC roz_ad_fak_cold "ROZ_AD_FAK_COLD" VALUE 0x482f8 a_173 100 LINEAR______0_000000__0H___1_992 0.0 1.9922 BIT_MASK 0xffffffff /end CHARACTERISTIC
/begin CHARACTERISTIC roz_ad_fak_hot "ROZ_AD_FAK_HOT" VALUE 0x482f9 a_173 100 LINEAR______0_000000__0H___1_992 0.0 1.9922 BIT_MASK 0xffffffff /end CHARACTERISTIC
/begin CHARACTERISTIC s_wk_auf "S_WK_AUF" VALUE 0x482fa a_173 100 LINEAR______0_000000__0H___1_167 0.0 1.0 BIT_MASK 0xffffffff /end CHARACTERISTIC
/begin CHARACTERISTIC s_wk_nd "S_WK_ND" VALUE 0x482fb a_173 100 LINEAR______0_000000__0H___1_167 0.0 1.0 BIT_MASK 0xffffffff /end CHARACTERISTIC
/begin CHARACTERISTIC s_wk_reg "S_WK_REG" VALUE 0x482fc a_173 100 LINEAR______0_000000__0H___1_167 0.0 1.0 BIT_MASK 0xffffffff /end CHARACTERISTIC
/begin CHARACTERISTIC s_wk_zu "S_WK_ZU" VALUE 0x482fd a_173 100 LINEAR______0_000000__0H___1_167 0.0 1.0 BIT_MASK 0xffffffff /end CHARACTERISTIC
/begin CHARACTERISTIC schw_auss_a "SCHW_AUSS_A" VALUE 0x486da a_174 5 LINEAR______0_000000__0H___65187 0.0 65535.0 BIT_MASK 0xffffffff /end CHARACTERISTIC
/begin CHARACTERISTIC schw_auss_b1 "SCHW_AUSS_B1" VALUE 0x486dc a_174 5 LINEAR______0_000000__0H___3000_ 0.0 3000.0 BIT_MASK 0xffffffff /end CHARACTERISTIC
/begin CHARACTERISTIC schw_auss_b4 "SCHW_AUSS_B4" VALUE 0x486de a_174 5 LINEAR______0_000000__0H___3000_ 0.0 3000.0 BIT_MASK 0xffffffff /end CHARACTERISTIC
/begin CHARACTERISTIC SET_VALUE_CHANGE_LIMIT "SET_VALUE_CHANGE_LIMIT" VALUE 0x480f6 a_172 100 LINEAR_______32768_000000__FFFF8 -32768.0 32767.0 BIT_MASK 0xffffffff /end CHARACTERISTIC
/begin CHARACTERISTIC sk_mdk_max_diag "SK_MDK_MAX_DIAG" VALUE 0x486e0 a_174 100 MTC_IN_DK_16_RES202 0.0 239.99634 BIT_MASK 0xffffffff /end CHARACTERISTIC
/begin CHARACTERISTIC sk_mdk_min_diag "SK_MDK_MIN_DIAG" VALUE 0x486e2 a_174 100 MTC_IN_DK_16_RES202 0.0 239.99634 BIT_MASK 0xffffffff /end CHARACTERISTIC
/begin CHARACTERISTIC sk_pwg_max_diag "SK_PWG_MAX_DIAG" VALUE 0x486e4 a_174 100 MTC_IN_DK_16_RES202 0.0 239.99634 BIT_MASK 0xffffffff /end CHARACTERISTIC
/begin CHARACTERISTIC sk_pwg_min_diag "SK_PWG_MIN_DIAG" VALUE 0x486e6 a_174 100 MTC_IN_DK_16_RES202 0.0 239.99634 BIT_MASK 0xffffffff /end CHARACTERISTIC
/begin CHARACTERISTIC sl_diag_anz_p "SL_DIAG_ANZ_P" VALUE 0x482fe a_173 10 LINEAR______2_000000__2H___255_0 2.0 255.0 BIT_MASK 0xffffffff /end CHARACTERISTIC
/begin CHARACTERISTIC sl_diag_anz_p_1 "SL_DIAG_ANZ_P_1" VALUE 0x482ff a_173 100 LINEAR______2_000000__2H___25810 2.0 255.0 BIT_MASK 0xffffffff /end CHARACTERISTIC
/begin CHARACTERISTIC SPRING_0_TOLERANCE "SPRING_0_TOLERANCE" VALUE 0x480f8 a_172 100 LINEAR_______32768_000000__FFFF8 -32768.0 32767.0 BIT_MASK 0xffffffff /end CHARACTERISTIC
/begin CHARACTERISTIC ssp_at "SSP_AT" VALUE 0x48300 a_173 100 LINEAR______0_000000__0H___1_167 0.0 1.0 BIT_MASK 0xffffffff /end CHARACTERISTIC
/begin CHARACTERISTIC ssp_at_fs "SSP_AT_FS" VALUE 0x48301 a_173 100 LINEAR______0_000000__0H___1_167 0.0 1.0 BIT_MASK 0xffffffff /end CHARACTERISTIC
/begin CHARACTERISTIC ssp_at_rl_kk "SSP_AT_RL_KK" VALUE 0x48302 a_173 100 LINEAR______0_000000__0H___1_167 0.0 1.0 BIT_MASK 0xffffffff /end CHARACTERISTIC
/begin CHARACTERISTIC ssp_at_rl_kk_fs "SSP_AT_RL_KK_FS" VALUE 0x48303 a_173 100 LINEAR______0_000000__0H___1_167 0.0 1.0 BIT_MASK 0xffffffff /end CHARACTERISTIC
/begin CHARACTERISTIC ssp_mt "SSP_MT" VALUE 0x48304 a_173 100 LINEAR______0_000000__0H___1_167 0.0 1.0 BIT_MASK 0xffffffff /end CHARACTERISTIC
/begin CHARACTERISTIC ssp_mt_rl_kk "SSP_MT_RL_KK" VALUE 0x48305 a_173 100 LINEAR______0_000000__0H___1_167 0.0 1.0 BIT_MASK 0xffffffff /end CHARACTERISTIC
/begin CHARACTERISTIC START_O_CROSS_DETECTION "START_O_CROSS_DETECTION" VALUE 0x480fa a_172 100 LINEAR_______32768_000000__FFFF8 -32768.0 32767.0 BIT_MASK 0xffffffff /end CHARACTERISTIC
/begin CHARACTERISTIC stgdirC0D "" VALUE 0x48306 a_173 100 defaultConversion811 0 255 BIT_MASK 0xffffffff /end CHARACTERISTIC
/begin CHARACTERISTIC stgdirC1D "" VALUE 0x48307 a_173 100 defaultConversion812 0 255 BIT_MASK 0xffffffff /end CHARACTERISTIC
/begin CHARACTERISTIC stgdirC2D "" VALUE 0x48308 a_173 100 defaultConversion813 0 255 BIT_MASK 0xffffffff /end CHARACTERISTIC
/begin CHARACTERISTIC stgdirC3D "" VALUE 0x48309 a_173 100 defaultConversion814 0 255 BIT_MASK 0xffffffff /end CHARACTERISTIC
/begin CHARACTERISTIC stgdirC4D "" VALUE 0x4830a a_173 100 defaultConversion815 0 255 BIT_MASK 0xffffffff /end CHARACTERISTIC
/begin CHARACTERISTIC stgdirC5D "" VALUE 0x4830b a_173 100 defaultConversion816 0 255 BIT_MASK 0xffffffff /end CHARACTERISTIC
/begin CHARACTERISTIC stgdirC6D "" VALUE 0x4830c a_173 100 defaultConversion817 0 255 BIT_MASK 0xffffffff /end CHARACTERISTIC
/begin CHARACTERISTIC stgdirC7D "" VALUE 0x4830d a_173 100 defaultConversion818 0 255 BIT_MASK 0xffffffff /end CHARACTERISTIC
/begin CHARACTERISTIC stgversionC0D "" VALUE 0x4830e a_173 100 defaultConversion819 0 255 BIT_MASK 0xffffffff /end CHARACTERISTIC
/begin CHARACTERISTIC stgversionC1D "" VALUE 0x4830f a_173 100 defaultConversion820 0 255 BIT_MASK 0xffffffff /end CHARACTERISTIC
/begin CHARACTERISTIC stgversionC2D "" VALUE 0x48310 a_173 100 defaultConversion821 0 255 BIT_MASK 0xffffffff /end CHARACTERISTIC
/begin CHARACTERISTIC stgversionC3D "" VALUE 0x48311 a_173 100 defaultConversion822 0 255 BIT_MASK 0xffffffff /end CHARACTERISTIC
/begin CHARACTERISTIC SWING_DEC_1 "SWIMG_DEC_1" VALUE 0x480fc a_172 100 LINEAR_______32768_000000__FF180 -32768.0 32767.0 BIT_MASK 0xffffffff /end CHARACTERISTIC
/begin CHARACTERISTIC SWING_ON_DEMAND_LIMIT1 "SWING_ON_DEMAND_LIMIT1" VALUE 0x480fe a_172 100 LINEAR_______32768_000000__FF180 -32768.0 32767.0 BIT_MASK 0xffffffff /end CHARACTERISTIC
/begin CHARACTERISTIC SWING_ON_DEMAND_LIMIT2 "SWING_ON_DEMAND_LIMIT2" VALUE 0x48100 a_172 100 LINEAR_______32768_000000__FF180 -32768.0 32767.0 BIT_MASK 0xffffffff /end CHARACTERISTIC
/begin CHARACTERISTIC sz_as "SZ_AS" VALUE 0xe59e a_175 100 LINEAR_______8_192000__FFFFFF80H -8.192 8.128 BIT_MASK 0xffffffff /end CHARACTERISTIC
/begin CHARACTERISTIC t_0taste_fgr_bt "T_0TASTE_FGR_BT" VALUE 0x48312 a_173 10 LINEAR______0_000000__0H___2550_ 0.0 2550.0 BIT_MASK 0xffffffff /end CHARACTERISTIC
/begin CHARACTERISTIC t_0taste_fgr_ubt "T_0TASTE_FGR_UBT" VALUE 0x48313 a_173 10 LINEAR______0_000000__0H___2550_ 0.0 2550.0 BIT_MASK 0xffffffff /end CHARACTERISTIC
/begin CHARACTERISTIC t_akt_max_ldp "T_AKT_MAX_LDP" VALUE 0x486e8 a_174 100 LINEAR______0_000000__0H___6553_ 0.0 6553.5 BIT_MASK 0xffffffff /end CHARACTERISTIC
/begin CHARACTERISTIC t_bts_plaus_max "T_BTS_PLAUS_MAX" VALUE 0x48314 a_173 100 LINEAR______0_000000__0H___25735 0.0 25.5 BIT_MASK 0xffffffff /end CHARACTERISTIC
/begin CHARACTERISTIC t_diag_ldp "T_DIAG_LDP" VALUE 0x486ea a_174 100 LINEAR______0_000000__0H___25823 0.0 25.5 BIT_MASK 0xffffffff /end CHARACTERISTIC
/begin CHARACTERISTIC t_diag_sl "T_DIAG_SL" VALUE 0x486ec a_174 100 LINEAR______0_020000__1H___13824 0.02 1310.0 BIT_MASK 0xffffffff /end CHARACTERISTIC
/begin CHARACTERISTIC t_diag_slv "T_DIAG_SLV" VALUE 0x486ee a_174 10 LINEAR______0_100000__1H___65825 0.1 6553.5 BIT_MASK 0xffffffff /end CHARACTERISTIC
/begin CHARACTERISTIC t_dk_grd_min_ar "T_DK_GRD_MIN_AR" VALUE 0x48315 a_173 100 LINEAR______0_100000__1H___25826 0.1 25.5 BIT_MASK 0xffffffff /end CHARACTERISTIC
/begin CHARACTERISTIC T_ebw_as "T_EBW_AS" VALUE 0x48092 a_175 100 LINEAR_______768_000000__FFFFFF8 -768.0 762.0 BIT_MASK 0xffffffff /end CHARACTERISTIC
/begin CHARACTERISTIC t_ekp "T_EKP" VALUE 0x486f0 a_174 15 LINEAR______0_100000__1H___65827 0.1 6553.5 BIT_MASK 0xffffffff /end CHARACTERISTIC
/begin CHARACTERISTIC t_ekp_vorl "T_EKP_VORL" VALUE 0x48316 a_173 15 LINEAR______0_100000__1H___25157 0.1 25.5 BIT_MASK 0xffffffff /end CHARACTERISTIC
/begin CHARACTERISTIC t_eml_predrive "T_EML_PREDRIVE" VALUE 0x48317 a_173 100 LINEAR______0_000000__0H___10_00 0.0 10.0 BIT_MASK 0xffffffff /end CHARACTERISTIC
/begin CHARACTERISTIC t_fgr_asc_aus "T_FGR_ASC_AUS" VALUE 0x48318 a_173 100 LINEAR______0_000000__0H___25735 0.0 25.5 BIT_MASK 0xffffffff /end CHARACTERISTIC
/begin CHARACTERISTIC t_fgr_dsc_aus "T_FGR_DSC_AUS" VALUE 0x48319 a_173 100 LINEAR______0_000000__0H___25735 0.0 25.5 BIT_MASK 0xffffffff /end CHARACTERISTIC
/begin CHARACTERISTIC t_fgr_dsc_brake_aus "T_FGR_DSC_BRAKE_AUS" VALUE 0x4831a a_173 100 LINEAR______0_000000__0H___25735 0.0 25.5 BIT_MASK 0xffffffff /end CHARACTERISTIC
/begin CHARACTERISTIC t_fgr_verz "T_FGR_VERZ" VALUE 0x4831b a_173 10 LINEAR______1000_000000__64H___2 1000.0 2550.0 BIT_MASK 0xffffffff /end CHARACTERISTIC
/begin CHARACTERISTIC t_fp_ldp "T_FP_LDP" VALUE 0x486f2 a_174 100 LINEAR______0_000000__0H___6553_ 0.0 6553.5 BIT_MASK 0xffffffff /end CHARACTERISTIC
/begin CHARACTERISTIC t_fwl_ein "T_FWL_EIN" VALUE 0x486f4 a_174 10 LINEAR______0_100000__1H___65825 0.1 6553.5 BIT_MASK 0xffffffff /end CHARACTERISTIC
/begin CHARACTERISTIC t_fwl_ein_ll "T_FWL_EIN_LL" VALUE 0x486f6 a_174 10 LINEAR______0_100000__1H___65825 0.1 6553.5 BIT_MASK 0xffffffff /end CHARACTERISTIC
/begin CHARACTERISTIC t_gkk_auss_rul "T_GKK_AUSS_RUL" VALUE 0x486f8 a_174 100 LINEAR______1_000000__1H___25828 1.0 255.0 BIT_MASK 0xffffffff /end CHARACTERISTIC
/begin CHARACTERISTIC t_gkk_st_rul "T_GKK_ST_RUL" VALUE 0x486fa a_174 100 LINEAR______1_000000__1H___25828 1.0 255.0 BIT_MASK 0xffffffff /end CHARACTERISTIC
/begin CHARACTERISTIC t_hbridge_max "T_HBRIDGE_MAX" VALUE 0x4831c a_173 100 LINEAR______0_000000__0H___1275_ 0.0 1275.0 BIT_MASK 0xffffffff /end CHARACTERISTIC
/begin CHARACTERISTIC t_hbridge_tamdk_max "T_HBRIDGE_TAMDK_MAX" VALUE 0x4831d a_173 100 LINEAR______0_000000__0H___1275_ 0.0 1275.0 BIT_MASK 0xffffffff /end CHARACTERISTIC
/begin CHARACTERISTIC t_ks2 "T_KS2" VALUE 0x4831e a_173 100 LINEAR______1_000000__1H___25184 1.0 255.0 BIT_MASK 0xffffffff /end CHARACTERISTIC
/begin CHARACTERISTIC t_ksd_dc_max "T_KSD_DC_MAX" VALUE 0x486fc a_174 100 LINEAR______0_000000__0H___65829 0.0 65535.0 BIT_MASK 0xffffffff /end CHARACTERISTIC
/begin CHARACTERISTIC t_ksd_max_max "T_KSD_MAX_MAX" VALUE 0x486fe a_174 100 LINEAR______0_000000__0H___1310_ 0.0 1310.7 BIT_MASK 0xffffffff /end CHARACTERISTIC
/begin CHARACTERISTIC t_ksd_min_max "T_KSD_MIN_MAX" VALUE 0x48700 a_174 100 LINEAR______0_000000__0H___1310_ 0.0 1310.7 BIT_MASK 0xffffffff /end CHARACTERISTIC
/begin CHARACTERISTIC t_l_max_rs "T_L_MAX_RS" VALUE 0x48702 a_174 100 LINEAR______0_000000__0H___655_3 0.0 655.34998 BIT_MASK 0xffffffff /end CHARACTERISTIC
/begin CHARACTERISTIC t_l_rs "T_L_RS" VALUE 0x48704 a_174 100 LINEAR______0_000000__0H___655_3 0.0 655.34998 BIT_MASK 0xffffffff /end CHARACTERISTIC
/begin CHARACTERISTIC t_lam_s "T_LAM_S" VALUE 0x4831f a_173 100 LINEAR______1_000000__1H___25_50 1.0 25.5 BIT_MASK 0xffffffff /end CHARACTERISTIC
/begin CHARACTERISTIC t_ldp "T_LDP" VALUE 0x48706 a_174 100 LINEAR______0_000000__0H___655_3 0.0 655.34998 BIT_MASK 0xffffffff /end CHARACTERISTIC
/begin CHARACTERISTIC t_lsh_1khz_max "T_LSH_1KHZ_MAX" VALUE 0x48320 a_173 100 LINEAR______1_000000__1H___25184 1.0 255.0 BIT_MASK 0xffffffff /end CHARACTERISTIC
/begin CHARACTERISTIC t_max_kf_ar "T_MAX_KF_AR" VALUE 0x48321 a_173 100 LINEAR______10_000000__1H___2550 10.0 2550.0 BIT_MASK 0xffffffff /end CHARACTERISTIC
/begin CHARACTERISTIC t_max_kup_swi "T_MAX_KUP_SWI" VALUE 0x48322 a_173 100 LINEAR______0_000000__0H___2540_ 0.0 2540.0 BIT_MASK 0xffffffff /end CHARACTERISTIC
/begin CHARACTERISTIC t_max_lam_be "T_MAX_LAM_BE" VALUE 0x48323 a_173 20 LINEAR______1_000000__1H___25830 1.0 255.0 BIT_MASK 0xffffffff /end CHARACTERISTIC
/begin CHARACTERISTIC t_max_ll "T_MAX_LL" VALUE 0x48708 a_174 1 LINEAR______0_010000__1H___65768 0.01 655.34998 BIT_MASK 0xffffffff /end CHARACTERISTIC
/begin CHARACTERISTIC t_max_lsh_ms "T_MAX_LSH_MS" VALUE 0x48324 a_173 100 LINEAR______2_000000__2H___254_0 2.0 254.0 BIT_MASK 0xffffffff /end CHARACTERISTIC
/begin CHARACTERISTIC t_max_mdz_egs_diag "T_MAX_MDZ_EGS_DIAG" VALUE 0x4870a a_174 10 LINEAR______0_010000__1H___65831 0.01 655.34998 BIT_MASK 0xffffffff /end CHARACTERISTIC
/begin CHARACTERISTIC t_max_mfl_bit_diag "T_MAX_MFL_BIT_DIAG" VALUE 0x48325 a_173 100 LINEAR______10_000000__0H___2560 10.0 2560.0 BIT_MASK 0xffffffff /end CHARACTERISTIC
/begin CHARACTERISTIC t_max_mfl_imp "T_MAX_MFL_IMP" VALUE 0x48326 a_173 100 LINEAR______10_000000__0H___450_ 10.0 450.0 BIT_MASK 0xffffffff /end CHARACTERISTIC
/begin CHARACTERISTIC t_max_stg "T_MAX_STG" VALUE 0x4870c a_174 1 LINEAR______2_000000__1H___65536 2.0 65536.0 BIT_MASK 0xffffffff /end CHARACTERISTIC
/begin CHARACTERISTIC t_max_tl_kat2 "T_MAX_TL_KAT2" VALUE 0x4870e a_174 100 LINEAR______0_000000__0H___6553_ 0.0 6553.5 BIT_MASK 0xffffffff /end CHARACTERISTIC
/begin CHARACTERISTIC t_max_vl "T_MAX_VL" VALUE 0x48327 a_173 100 LINEAR______0_100000__1H___25832 0.1 25.5 BIT_MASK 0xffffffff /end CHARACTERISTIC
/begin CHARACTERISTIC t_max_wst "T_MAX_WST" VALUE 0x48328 a_173 10 LINEAR______1_000000__1H___25833 1.0 255.0 BIT_MASK 0xffffffff /end CHARACTERISTIC
/begin CHARACTERISTIC t_mdk_ad_ini "T_MDK_AD_INI" VALUE 0x48329 a_173 100 LINEAR______0_000000__0H___1275_ 0.0 1275.0 BIT_MASK 0xffffffff /end CHARACTERISTIC
/begin CHARACTERISTIC t_mdk_zu "T_MDK_ZU" VALUE 0x4832a a_173 100 LINEAR______0_000000__0H___1275_ 0.0 1275.0 BIT_MASK 0xffffffff /end CHARACTERISTIC
/begin CHARACTERISTIC t_min_can_diag "T_MIN_CAN_DIAG" VALUE 0x4832b a_173 100 LINEAR______0_000000__0H___2550_ 0.0 2550.0 BIT_MASK 0xffffffff /end CHARACTERISTIC
/begin CHARACTERISTIC t_min_d_llfs "T_MIN_D_LLFS" VALUE 0x48710 a_174 10 LINEAR______0_010000__1H___65768 0.01 655.34998 BIT_MASK 0xffffffff /end CHARACTERISTIC
/begin CHARACTERISTIC t_min_dk_dif "T_MIN_DK_DIF" VALUE 0x4832c a_173 10 LINEAR______10_000000__1H___2834 10.0 2550.0 BIT_MASK 0xffffffff /end CHARACTERISTIC
/begin CHARACTERISTIC t_min_eml "T_MIN_EML" VALUE 0x4832d a_173 100 LINEAR______0_000000__0H___20_40 0.0 20.4 BIT_MASK 0xffffffff /end CHARACTERISTIC
/begin CHARACTERISTIC t_min_fgr_const "T_MIN_FGR_CONST" VALUE 0x4832e a_173 100 LINEAR______0_000000__0H___25735 0.0 25.5 BIT_MASK 0xffffffff /end CHARACTERISTIC
/begin CHARACTERISTIC t_min_ll_kat3 "T_MIN_LL_KAT3" VALUE 0x48712 a_174 100 LINEAR______0_000000__0H___6553_ 0.0 6553.5 BIT_MASK 0xffffffff /end CHARACTERISTIC
/begin CHARACTERISTIC t_min_ls "T_MIN_LS" VALUE 0x4832f a_173 100 LINEAR______0_000000__0H___25835 0.0 254.0 BIT_MASK 0xffffffff /end CHARACTERISTIC
/begin CHARACTERISTIC t_min_mdk_diag "T_MIN_MDK_DIAG" VALUE 0x48330 a_173 100 LINEAR______10_000000__1H___2834 10.0 2550.0 BIT_MASK 0xffffffff /end CHARACTERISTIC
/begin CHARACTERISTIC t_min_mfl_bit_diag "T_MIN_MFL_BIT_DIAG" VALUE 0x48331 a_173 100 LINEAR______10_000000__0H___2560 10.0 2560.0 BIT_MASK 0xffffffff /end CHARACTERISTIC
/begin CHARACTERISTIC t_min_mfl_imp "T_MIN_MFL_IMP" VALUE 0x48332 a_173 100 LINEAR______10_000000__0H___2560 10.0 2560.0 BIT_MASK 0xffffffff /end CHARACTERISTIC
/begin CHARACTERISTIC t_min_sa_auss "T_MIN_SA_AUSS" VALUE 0x48714 a_174 5 LINEAR______100_000000__1H___100 100.0 100000.0 BIT_MASK 0xffffffff /end CHARACTERISTIC
/begin CHARACTERISTIC t_min_sa_zv "T_MIN_SA_ZV" VALUE 0x48333 a_173 100 LINEAR______0_010000__1H___2_550 0.01 2.55 BIT_MASK 0xffffffff /end CHARACTERISTIC
/begin CHARACTERISTIC t_min_tl_kat3_a "T_MIN_TL_KAT3_A" VALUE 0x48716 a_174 100 LINEAR______0_000000__0H___6553_ 0.0 6553.5 BIT_MASK 0xffffffff /end CHARACTERISTIC
/begin CHARACTERISTIC t_min_tl_kat3_p "T_MIN_TL_KAT3_P" VALUE 0x48718 a_174 100 LINEAR______0_000000__0H___6553_ 0.0 6553.5 BIT_MASK 0xffffffff /end CHARACTERISTIC
/begin CHARACTERISTIC t_min_well "T_MIN_WELL" VALUE 0x4871a a_174 1 LINEAR______0_010000__0H___655_3 0.01 655.34998 BIT_MASK 0xffffffff /end CHARACTERISTIC
/begin CHARACTERISTIC t_n_dif_ns "T_N_DIF_NS" VALUE 0x48334 a_173 100 LINEAR______0_000000__0H___25735 0.0 25.5 BIT_MASK 0xffffffff /end CHARACTERISTIC
/begin CHARACTERISTIC t_n_el_ns "T_N_EL_NS" VALUE 0x48335 a_173 100 LINEAR______0_200000__0H___51_00 0.2 51.0 BIT_MASK 0xffffffff /end CHARACTERISTIC
/begin CHARACTERISTIC t_n_proz_el_aktiv "T_N_PROZ_EL_AKTIV" VALUE 0x48336 a_173 100 LINEAR______0_200000__1H___51_00 0.2 51.0 BIT_MASK 0xffffffff /end CHARACTERISTIC
/begin CHARACTERISTIC T_n_proz_el_as "T_N_PROZ_EL_AS" VALUE 0x480a2 a_173 100 LINEAR_______50_000000__0H___794 -50.0 49.6094 BIT_MASK 0xffffffff /end CHARACTERISTIC
/begin CHARACTERISTIC t_n_window "T_IMMOB_N_WINDOW" VALUE 0x48337 a_173 100 LINEAR______0_100000__1H___10_00 0.1 10.0 BIT_MASK 0xffffffff /end CHARACTERISTIC
/begin CHARACTERISTIC t_nach_st_min_ldp "T_NACH_ST_MIN_LDP" VALUE 0x4871c a_174 100 LINEAR______0_000000__0H___6553_ 0.0 6553.5 BIT_MASK 0xffffffff /end CHARACTERISTIC
/begin CHARACTERISTIC t_nf_ldp "T_NF_LDP" VALUE 0x4871e a_174 100 LINEAR______0_000000__0H___6553_ 0.0 6553.5 BIT_MASK 0xffffffff /end CHARACTERISTIC
/begin CHARACTERISTIC t_ns_ak "T_NS_AK" VALUE 0x48338 a_173 20 LINEAR______0_000000__0H___25836 0.0 25.5 BIT_MASK 0xffffffff /end CHARACTERISTIC
/begin CHARACTERISTIC t_ns_swi_wl "T_NS_SWI_WL" VALUE 0x48720 a_174 100 LINEAR______0_000000__0H___65837 0.0 6553.5 BIT_MASK 0xffffffff /end CHARACTERISTIC
/begin CHARACTERISTIC t_ns_vanos "T_NS_VANOS" VALUE 0x48722 a_174 100 LINEAR______0_100000__1H___65825 0.1 6553.5 BIT_MASK 0xffffffff /end CHARACTERISTIC
/begin CHARACTERISTIC t_nw_soll_aebg "T_NW_SOLL_AEBG" VALUE 0x48339 a_173 100 LINEAR______10_000000__1H___2550 10.0 2550.0 BIT_MASK 0xffffffff /end CHARACTERISTIC
/begin CHARACTERISTIC T_nwsoll_as_a "T_NWSOLL_AS_A" VALUE 0x48093 a_175 100 LINEAR______48_000000__FFFFFF80H -47.625 48.0 BIT_MASK 0xffffffff /end CHARACTERISTIC
/begin CHARACTERISTIC T_nwsoll_as_e "T_NWSOLL_AS_E" VALUE 0x48094 a_175 100 LINEAR_______48_000000__FFFFFF80 -48.0 47.625 BIT_MASK 0xffffffff /end CHARACTERISTIC
/begin CHARACTERISTIC t_per_ldp_fuc "T_PER_LDP_FUC" VALUE 0x48724 a_174 100 LINEAR______0_000000__0H___655_3 0.0 655.34998 BIT_MASK 0xffffffff /end CHARACTERISTIC
/begin CHARACTERISTIC t_per_ldp_max_ctc "T_PER_LDP_MAX_CTC" VALUE 0x48726 a_174 100 LINEAR______0_000000__0H___655_3 0.0 655.34998 BIT_MASK 0xffffffff /end CHARACTERISTIC
/begin CHARACTERISTIC t_per_ldp_schw "T_PER_LDP_SCHW" VALUE 0x48728 a_174 100 LINEAR______0_000000__0H___655_3 0.0 655.34998 BIT_MASK 0xffffffff /end CHARACTERISTIC
/begin CHARACTERISTIC t_pwg_fak_kup_swi "T_PWG_FAK_KUP_SWI" VALUE 0x4833a a_173 20 LINEAR______1_000000__1H___25838 1.0 255.0 BIT_MASK 0xffffffff /end CHARACTERISTIC
/begin CHARACTERISTIC t_sa_min_fgr "T_SA_MIN_FGR" VALUE 0x4833b a_173 5 LINEAR______0_000000__0H___25735 0.0 25.5 BIT_MASK 0xffffffff /end CHARACTERISTIC
/begin CHARACTERISTIC t_slp_wait_max "T_SLP_WAIT_MAX" VALUE 0x4833c a_173 100 LINEAR______1_000000__1H___25184 1.0 255.0 BIT_MASK 0xffffffff /end CHARACTERISTIC
/begin CHARACTERISTIC T_sz_as "T_SZ_AS" VALUE 0x48095 a_175 100 LINEAR_______8_192000__FFFFFF80H -8.192 8.128 BIT_MASK 0xffffffff /end CHARACTERISTIC
/begin CHARACTERISTIC t_tal_tka_diag "T_TAL_TKA_DIAG" VALUE 0x4872a a_174 10 LINEAR______0_100000__1H___65825 0.1 6553.5 BIT_MASK 0xffffffff /end CHARACTERISTIC
/begin CHARACTERISTIC t_tal_tkw_diag "T_TAL_TKW_DIAG" VALUE 0x4872c a_174 10 LINEAR______0_100000__1H___65825 0.1 6553.5 BIT_MASK 0xffffffff /end CHARACTERISTIC
/begin CHARACTERISTIC T_tallfs_erg_as "T_TALLFS_ERG_AS" VALUE 0x48096 a_175 100 LINEAR_______50_000000__FFFFFF80 -50.0 49.610001 BIT_MASK 0xffffffff /end CHARACTERISTIC
/begin CHARACTERISTIC T_talsh_as_nkat1 "T_TALSH_AS_NKAT1" VALUE 0x48097 a_175 100 LINEAR_______50_000000__FFFFFF80 -50.0 49.610001 BIT_MASK 0xffffffff /end CHARACTERISTIC
/begin CHARACTERISTIC T_talsh_as_nkat2 "T_TALSH_AS_NKAT2" VALUE 0x48098 a_175 100 LINEAR_______50_000000__FFFFFF80 -50.0 49.610001 BIT_MASK 0xffffffff /end CHARACTERISTIC
/begin CHARACTERISTIC T_talsh_as_vkat1 "T_TALSH_AS_VKAT1" VALUE 0x48099 a_175 100 LINEAR_______50_000000__FFFFFF80 -50.0 49.610001 BIT_MASK 0xffffffff /end CHARACTERISTIC
/begin CHARACTERISTIC T_talsh_as_vkat2 "T_TALSH_AS_VKAT2" VALUE 0x4809a a_175 100 LINEAR_______50_000000__FFFFFF80 -50.0 49.610001 BIT_MASK 0xffffffff /end CHARACTERISTIC
/begin CHARACTERISTIC t_tamdk_max_diag "T_TAMDK_MAX_DIAG" VALUE 0x4833d a_173 100 LINEAR______10_000000__1H___2834 10.0 2550.0 BIT_MASK 0xffffffff /end CHARACTERISTIC
/begin CHARACTERISTIC T_tate_as "T_TATE_AS" VALUE 0x4809b a_175 100 LINEAR_______50_000000__FFFFF839 -50.0 49.610001 BIT_MASK 0xffffffff /end CHARACTERISTIC
/begin CHARACTERISTIC t_tate_fc_2 "T_TATE_FC_2" VALUE 0x4833e a_173 20 LINEAR______0_020000__1H___5_100 0.02 5.0999999 BIT_MASK 0xffffffff /end CHARACTERISTIC
/begin CHARACTERISTIC t_tate_fc_3 "T_TATE_FC_3" VALUE 0x4833f a_173 10 LINEAR______0_100000__1H___25157 0.1 25.5 BIT_MASK 0xffffffff /end CHARACTERISTIC
/begin CHARACTERISTIC t_tate_fc_diag_2 "T_TATE_FC_DIAG_2" VALUE 0x48340 a_173 10 LINEAR______0_100000__1H___25157 0.1 25.5 BIT_MASK 0xffffffff /end CHARACTERISTIC
/begin CHARACTERISTIC t_tate_fc_zyk_2 "T_TATE_FC_ZYK_2" VALUE 0x4872e a_174 10 LINEAR______0_020000__1H___25_50 0.02 25.5 BIT_MASK 0xffffffff /end CHARACTERISTIC
/begin CHARACTERISTIC t_te_1 "T_TE_1" VALUE 0x48730 a_174 1 LINEAR______0_100000__1H___65840 0.1 6553.5 BIT_MASK 0xffffffff /end CHARACTERISTIC
/begin CHARACTERISTIC t_te_2 "T_TE_2" VALUE 0x48732 a_174 1 LINEAR______0_100000__1H___65840 0.1 6553.5 BIT_MASK 0xffffffff /end CHARACTERISTIC
/begin CHARACTERISTIC t_te_3 "T_TE_3" VALUE 0x48734 a_174 1 LINEAR______0_100000__1H___65840 0.1 6553.5 BIT_MASK 0xffffffff /end CHARACTERISTIC
/begin CHARACTERISTIC t_te_3_katv "T_TE_3_KATV" VALUE 0x48736 a_174 1 LINEAR______0_100000__1H___65840 0.1 6553.5 BIT_MASK 0xffffffff /end CHARACTERISTIC
/begin CHARACTERISTIC t_ti_ad_1 "T_TI_AD_1" VALUE 0x48738 a_174 1 LINEAR______0_100000__1H___65840 0.1 6553.5 BIT_MASK 0xffffffff /end CHARACTERISTIC
/begin CHARACTERISTIC t_ti_ad_1_katv "T_TI_AD_1_KATV" VALUE 0x4873a a_174 1 LINEAR______0_100000__1H___65840 0.1 6553.5 BIT_MASK 0xffffffff /end CHARACTERISTIC
/begin CHARACTERISTIC T_ti_as_0 "T_TI_AS_1" VALUE 0x480a3 a_173 100 TI_AS 0.5 1.5 BIT_MASK 0xffffffff /end CHARACTERISTIC
/begin CHARACTERISTIC T_ti_as_1 "T_TI_AS_5" VALUE 0x480a4 a_173 100 TI_AS 0.5 1.5 BIT_MASK 0xffffffff /end CHARACTERISTIC
/begin CHARACTERISTIC T_ti_as_2 "T_TI_AS_3" VALUE 0x480a5 a_173 100 TI_AS 0.5 1.5 BIT_MASK 0xffffffff /end CHARACTERISTIC
/begin CHARACTERISTIC T_ti_as_3 "T_TI_AS_6" VALUE 0x480a6 a_173 100 TI_AS 0.5 1.5 BIT_MASK 0xffffffff /end CHARACTERISTIC
/begin CHARACTERISTIC T_ti_as_4 "T_TI_AS_2" VALUE 0x480a7 a_173 100 TI_AS 0.5 1.5 BIT_MASK 0xffffffff /end CHARACTERISTIC
/begin CHARACTERISTIC T_ti_as_5 "T_TI_AS_4" VALUE 0x480a8 a_173 100 TI_AS 0.5 1.5 BIT_MASK 0xffffffff /end CHARACTERISTIC
/begin CHARACTERISTIC t_ti_inst_pas "T_TI_INST_PAS" VALUE 0x48341 a_173 100 LINEAR______0_000000__0H___2550_ 0.0 2550.0 BIT_MASK 0xffffffff /end CHARACTERISTIC
/begin CHARACTERISTIC t_tkw_can_ns "T_TKW_CAN_NS" VALUE 0x4873c a_174 100 LINEAR______0_000000__0H___65837 0.0 6553.5 BIT_MASK 0xffffffff /end CHARACTERISTIC
/begin CHARACTERISTIC t_tkw_ers_ll_1 "T_TKW_ERS_LL_1" VALUE 0x48342 a_173 100 LINEAR______0_000000__0H___25841 0.0 2550.0 BIT_MASK 0xffffffff /end CHARACTERISTIC
/begin CHARACTERISTIC t_tkw_ers_ll_2 "T_TKW_ERS_LL_2" VALUE 0x48343 a_173 100 LINEAR______0_000000__0H___25841 0.0 2550.0 BIT_MASK 0xffffffff /end CHARACTERISTIC
/begin CHARACTERISTIC t_tkw_ers_sa "T_TKW_ERS_SA" VALUE 0x48344 a_173 100 LINEAR______0_000000__0H___25841 0.0 2550.0 BIT_MASK 0xffffffff /end CHARACTERISTIC
/begin CHARACTERISTIC t_totz_ar "T_TOTZ_AR" VALUE 0x48345 a_173 100 LINEAR______0_000000__0H___25119 0.0 2550.0 BIT_MASK 0xffffffff /end CHARACTERISTIC
/begin CHARACTERISTIC t_totz_diag_sl "T_TOTZ_DIAG_SL" VALUE 0x4873e a_174 10 LINEAR______0_020000__1H___10_00 0.02 10.0 BIT_MASK 0xffffffff /end CHARACTERISTIC
/begin CHARACTERISTIC t_totz_fc "T_TOTZ_FC" VALUE 0x48346 a_173 10 LINEAR______0_100000__1H___25157 0.1 25.5 BIT_MASK 0xffffffff /end CHARACTERISTIC
/begin CHARACTERISTIC t_totz_ksd_we "T_TOTZ_KSD_WE" VALUE 0x48740 a_174 100 LINEAR______0_000000__0H___65842 0.0 655.34998 BIT_MASK 0xffffffff /end CHARACTERISTIC
/begin CHARACTERISTIC t_totz_max_fgr "T_TOTZ_MAX_FGR" VALUE 0x48742 a_174 10 LINEAR______0_000000__0H___655_3 0.0 655.34998 BIT_MASK 0xffffffff /end CHARACTERISTIC
/begin CHARACTERISTIC t_totz_sl "T_TOTZ_SL" VALUE 0x48744 a_174 10 LINEAR______0_100000__1H___65825 0.1 6553.5 BIT_MASK 0xffffffff /end CHARACTERISTIC
/begin CHARACTERISTIC t_tv_dif "T_TV_DIF" VALUE 0x48347 a_173 100 LINEAR______0_100000__0H___25_50 0.1 25.5 BIT_MASK 0xffffffff /end CHARACTERISTIC
/begin CHARACTERISTIC t_tv_min_diag "T_TV_MIN_DIAG" VALUE 0x48746 a_174 10 LINEAR______1_000000__1H___65535 1.0 65535.0 BIT_MASK 0xffffffff /end CHARACTERISTIC
/begin CHARACTERISTIC t_uls_auf_nkat_diag "T_ULS_AUF_NKAT_DIAG" VALUE 0x48748 a_174 100 LINEAR______0_000000__0H___327_6 0.0 327.68 BIT_MASK 0xffffffff /end CHARACTERISTIC
/begin CHARACTERISTIC t_uls_auf_vkat_diag "T_ULS_AUF_VKAT_DIAG" VALUE 0x4874a a_174 100 LINEAR______0_000000__0H___32843 0.0 327.68 BIT_MASK 0xffffffff /end CHARACTERISTIC
/begin CHARACTERISTIC t_uls_gnd_nkat_diag "T_ULS_GND_NKAT_DIAG" VALUE 0x4874c a_174 100 LINEAR______0_000000__0H___327_6 0.0 327.68 BIT_MASK 0xffffffff /end CHARACTERISTIC
/begin CHARACTERISTIC t_uls_gnd_vkat_diag "T_ULS_GND_VKAT_DIAG" VALUE 0x4874e a_174 100 LINEAR______0_000000__0H___32843 0.0 327.68 BIT_MASK 0xffffffff /end CHARACTERISTIC
/begin CHARACTERISTIC t_van_diag_fak_1 "T_VAN_DIAG_FAK_1" VALUE 0x48348 a_173 100 LINEAR______0_000000__0H___15_93 0.0 15.9375 BIT_MASK 0xffffffff /end CHARACTERISTIC
/begin CHARACTERISTIC t_van_diag_fak_2 "T_VAN_DIAG_FAK_2" VALUE 0x48349 a_173 100 LINEAR______0_000000__0H___15_93 0.0 15.9375 BIT_MASK 0xffffffff /end CHARACTERISTIC
/begin CHARACTERISTIC t_vzg_ls_diag "T_VZG_LS_DIAG" VALUE 0x48750 a_174 100 LINEAR______1_000000__1H___65534 1.0 65534.0 BIT_MASK 0xffffffff /end CHARACTERISTIC
/begin CHARACTERISTIC t_wait_bab "T_WAIT_BAB" VALUE 0x4834a a_173 100 LINEAR______0_000000__0H___25735 0.0 25.5 BIT_MASK 0xffffffff /end CHARACTERISTIC
/begin CHARACTERISTIC t_wait_bab_ll "T_WAIT_BAB_LL" VALUE 0x4834b a_173 100 LINEAR______0_000000__0H___25735 0.0 25.5 BIT_MASK 0xffffffff /end CHARACTERISTIC
/begin CHARACTERISTIC t_wait_ldp_wst "T_WAIT_LDP_WST" VALUE 0x48752 a_174 10 LINEAR______0_000000__0H___6553_ 0.0 6553.5 BIT_MASK 0xffffffff /end CHARACTERISTIC
/begin CHARACTERISTIC t_wait_max_ldp "T_WAIT_MAX_LDP" VALUE 0x4834c a_173 100 LINEAR______0_000000__0H___25735 0.0 25.5 BIT_MASK 0xffffffff /end CHARACTERISTIC
/begin CHARACTERISTIC t_wait_tal_ref "T_WAIT_TAL_REF" VALUE 0x4834d a_173 10 LINEAR______0_000000__0H___12844 0.0 127.5 BIT_MASK 0xffffffff /end CHARACTERISTIC
/begin CHARACTERISTIC t_zu_rs "T_ZU_RS" VALUE 0x48754 a_174 100 LINEAR______0_000000__0H___655_3 0.0 655.34998 BIT_MASK 0xffffffff /end CHARACTERISTIC
/begin CHARACTERISTIC t_zv_lr_neg_ll "T_ZV_LR_NEG_LL" VALUE 0x48756 a_174 100 LINEAR______0_000000__0H___1_279 0.0 1.2799 BIT_MASK 0xffffffff /end CHARACTERISTIC
/begin CHARACTERISTIC t_zv_lr_pos_ll "T_ZV_LR_POS_LL" VALUE 0x48758 a_174 100 LINEAR______0_000000__0H___1_279 0.0 1.2799 BIT_MASK 0xffffffff /end CHARACTERISTIC
/begin CHARACTERISTIC t_zw_aebg_sa_msr "T_ZW_AEBG_SA_MSR" VALUE 0x4875a a_174 100 LINEAR______0_000000__0H___8_388 0.0 8.38848 BIT_MASK 0xffffffff /end CHARACTERISTIC
/begin CHARACTERISTIC T_zw_as_0 "T_ZW_AS_1" VALUE 0x4809c a_175 5 LINEAR_______48_000000__FFFFFF80 -48.0 47.625 BIT_MASK 0xffffffff /end CHARACTERISTIC
/begin CHARACTERISTIC T_zw_as_1 "T_ZW_AS_5" VALUE 0x4809d a_175 5 LINEAR_______48_000000__FFFFFF80 -48.0 47.625 BIT_MASK 0xffffffff /end CHARACTERISTIC
/begin CHARACTERISTIC T_zw_as_2 "T_ZW_AS_3" VALUE 0x4809e a_175 5 LINEAR_______48_000000__FFFFFF80 -48.0 47.625 BIT_MASK 0xffffffff /end CHARACTERISTIC
/begin CHARACTERISTIC T_zw_as_3 "T_ZW_AS_6" VALUE 0x4809f a_175 5 LINEAR_______48_000000__FFFFFF80 -48.0 47.625 BIT_MASK 0xffffffff /end CHARACTERISTIC
/begin CHARACTERISTIC T_zw_as_4 "T_ZW_AS_2" VALUE 0x480a0 a_175 5 LINEAR_______48_000000__FFFFFF80 -48.0 47.625 BIT_MASK 0xffffffff /end CHARACTERISTIC
/begin CHARACTERISTIC T_zw_as_5 "T_ZW_AS_4" VALUE 0x480a1 a_175 5 LINEAR_______48_000000__FFFFFF80 -48.0 47.625 BIT_MASK 0xffffffff /end CHARACTERISTIC
/begin CHARACTERISTIC t_zyk_ldp "T_ZYK_LDP" VALUE 0x4875c a_174 100 LINEAR______0_000000__0H___655_3 0.0 655.34998 BIT_MASK 0xffffffff /end CHARACTERISTIC
/begin CHARACTERISTIC t_zyka_ll "T_ZYKA_LL" VALUE 0x4834e a_173 100 LINEAR______0_100000__1H___25845 0.1 25.5 BIT_MASK 0xffffffff /end CHARACTERISTIC
/begin CHARACTERISTIC ta_fr_vanos_a "TA_FR_VANOS_A" VALUE 0x4834f a_173 100 LINEAR______0_000000__0H___99_59 0.0 99.599998 BIT_MASK 0xffffffff /end CHARACTERISTIC
/begin CHARACTERISTIC ta_fr_vanos_e "TA_FR_VANOS_E" VALUE 0x48350 a_173 100 LINEAR______0_000000__0H___99_59 0.0 99.599998 BIT_MASK 0xffffffff /end CHARACTERISTIC
/begin CHARACTERISTIC ta_sp_vanos_a "TA_SP_VANOS_A" VALUE 0x48351 a_173 100 LINEAR______0_000000__0H___99_59 0.0 99.599998 BIT_MASK 0xffffffff /end CHARACTERISTIC
/begin CHARACTERISTIC ta_sp_vanos_e "TA_SP_VANOS_E" VALUE 0x48352 a_173 100 LINEAR______0_000000__0H___99_59 0.0 99.599998 BIT_MASK 0xffffffff /end CHARACTERISTIC
/begin CHARACTERISTIC tael_el_aktiv "TAEL_EL_AKTIV" VALUE 0x48353 a_173 100 LINEAR______0_000000__0H___99_61 0.0 99.610001 BIT_MASK 0xffffffff /end CHARACTERISTIC
/begin CHARACTERISTIC tael_max "TAEL_MAX" VALUE 0x48354 a_173 100 LINEAR______0_000000__0H___99_61 0.0 99.610001 BIT_MASK 0xffffffff /end CHARACTERISTIC
/begin CHARACTERISTIC tael_min "TAEL_MIN" VALUE 0x48355 a_173 100 LINEAR______0_000000__0H___99_61 0.0 99.610001 BIT_MASK 0xffffffff /end CHARACTERISTIC
/begin CHARACTERISTIC tah_ad_off_a "TAH_AD_OFF_A" VALUE 0x487f6 a_175 100 LINEAR_______50_000000__FFFFFF80 -50.0 49.610001 BIT_MASK 0xffffffff /end CHARACTERISTIC
/begin CHARACTERISTIC tal_diag "TAL_DIAG" VALUE 0x48356 a_173 15 LINEAR_______48_000000__0H___142 -48.0 142.5 BIT_MASK 0xffffffff /end CHARACTERISTIC
/begin CHARACTERISTIC tal_ers_lsh "TAL_ERS_LSH" VALUE 0x48357 a_173 15 LINEAR_______48_000000__0H___142 -48.0 142.5 BIT_MASK 0xffffffff /end CHARACTERISTIC
/begin CHARACTERISTIC tal_ers_ob "TAL_ERS_OB" VALUE 0x48358 a_173 15 LINEAR_______48_000000__0H___142 -48.0 142.5 BIT_MASK 0xffffffff /end CHARACTERISTIC
/begin CHARACTERISTIC tal_ers_unt "TAL_ERS_UNT" VALUE 0x48359 a_173 15 LINEAR_______48_000000__0H___142 -48.0 142.5 BIT_MASK 0xffffffff /end CHARACTERISTIC
/begin CHARACTERISTIC tal_grd_max_diag "TAL_GRD_MAX_DIAG" VALUE 0x4835a a_173 20 LINEAR______0_000000__0H___190_5 0.0 190.5 BIT_MASK 0xffffffff /end CHARACTERISTIC
/begin CHARACTERISTIC tal_kfk_hys "TAL_KFK_HYS" VALUE 0x4835b a_173 15 LINEAR______0_000000__0H___19846 0.0 190.5 BIT_MASK 0xffffffff /end CHARACTERISTIC
/begin CHARACTERISTIC tal_kfk_max "TAL_KFK_MAX" VALUE 0x4835c a_173 15 LINEAR_______48_000000__0H___189 -48.0 142.5 BIT_MASK 0xffffffff /end CHARACTERISTIC
/begin CHARACTERISTIC tal_max_diag "TAL_MAX_DIAG" VALUE 0x4835d a_173 15 LINEAR_______48_000000__0H___142 -48.0 142.5 BIT_MASK 0xffffffff /end CHARACTERISTIC
/begin CHARACTERISTIC tal_max_ldp "TAL_MAX_LDP" VALUE 0x4835e a_173 100 LINEAR_______48_000000__0H___142 -48.0 142.5 BIT_MASK 0xffffffff /end CHARACTERISTIC
/begin CHARACTERISTIC tal_min_diag "TAL_MIN_DIAG" VALUE 0x4835f a_173 15 LINEAR_______48_000000__0H___142 -48.0 142.5 BIT_MASK 0xffffffff /end CHARACTERISTIC
/begin CHARACTERISTIC tal_min_ldp "TAL_MIN_LDP" VALUE 0x48360 a_173 100 LINEAR_______48_000000__0H___142 -48.0 142.5 BIT_MASK 0xffffffff /end CHARACTERISTIC
/begin CHARACTERISTIC tal_ref_max_ldp "TAL_REF_MAX_LDP" VALUE 0x48361 a_173 100 LINEAR_______48_000000__0H___189 -48.0 142.5 BIT_MASK 0xffffffff /end CHARACTERISTIC
/begin CHARACTERISTIC tal_ref_min_ldp "TAL_REF_MIN_LDP" VALUE 0x48362 a_173 100 LINEAR_______48_000000__0H___189 -48.0 142.5 BIT_MASK 0xffffffff /end CHARACTERISTIC
/begin CHARACTERISTIC tal_ti_ad_max "TAL_TI_AD_MAX" VALUE 0x48363 a_173 15 LINEAR_______48_000000__0H___121 -48.0 142.5 BIT_MASK 0xffffffff /end CHARACTERISTIC
/begin CHARACTERISTIC tal_tkw_diag "TAL_TKW_DIAG" VALUE 0x48364 a_173 15 LINEAR_______48_000000__0H___142 -48.0 142.5 BIT_MASK 0xffffffff /end CHARACTERISTIC
/begin CHARACTERISTIC tallfs_ad_max_ll "TALLFS_AD_MAX_LL" VALUE 0x4875e a_174 10 LINEAR______0_000000__0H___49_99 0.0 49.998501 BIT_MASK 0xffffffff /end CHARACTERISTIC
/begin CHARACTERISTIC tallfs_ad_max_ll_kk "TALLFS_AD_MAX_LL_KK" VALUE 0x48760 a_174 10 LINEAR______0_000000__0H___49_99 0.0 49.998501 BIT_MASK 0xffffffff /end CHARACTERISTIC
/begin CHARACTERISTIC tallfs_ad_max_llfs "TALLFS_AD_MAX_LLFS" VALUE 0x48365 a_173 10 LINEAR______0_000000__0H___99_61 0.0 99.610001 BIT_MASK 0xffffffff /end CHARACTERISTIC
/begin CHARACTERISTIC tallfs_ad_min_ll "TALLFS_AD_MIN_LL" VALUE 0x48102 a_172 10 LINEAR_______50_000000__FFFF8000 -50.0 0.0 BIT_MASK 0xffffffff /end CHARACTERISTIC
/begin CHARACTERISTIC tallfs_ad_min_ll_kk "TALLFS_AD_MIN_LL_KK" VALUE 0x48104 a_172 10 LINEAR_______50_000000__FFFF8000 -50.0 0.0 BIT_MASK 0xffffffff /end CHARACTERISTIC
/begin CHARACTERISTIC tallfs_ad_min_llfs "TALLFS_AD_MIN_LLFS" VALUE 0x48366 a_173 10 LINEAR______0_000000__0H___99_61 0.0 99.610001 BIT_MASK 0xffffffff /end CHARACTERISTIC
/begin CHARACTERISTIC tallfs_aebg "TALLFS_AEBG" VALUE 0x48367 a_173 10 LINEAR______0_097700__1H___24_90 0.0977 24.902 BIT_MASK 0xffffffff /end CHARACTERISTIC
/begin CHARACTERISTIC tallfs_aebg_d "TALLFS_AEBG_D" VALUE 0x48368 a_173 4 LINEAR______0_000000__0H___24_90 0.0 24.902 BIT_MASK 0xffffffff /end CHARACTERISTIC
/begin CHARACTERISTIC tallfs_aebg_el "TALLFS_AEBG_EL" VALUE 0x48762 a_174 100 TALLFS_IN_10MS90 0.0061 24.9938 BIT_MASK 0xffffffff /end CHARACTERISTIC
/begin CHARACTERISTIC tallfs_aebg_kk "TALLFS_AEBG_KK" VALUE 0x48369 a_173 0 LINEAR______0_0066100__1H___1_55 0.00661 1.5564 BIT_MASK 0xffffffff /end CHARACTERISTIC
/begin CHARACTERISTIC tallfs_dyf_fc "TALLFS_DYF_FC" VALUE 0x4836a a_173 5 LINEAR______0_000000__0H___99159 0.0 99.610001 BIT_MASK 0xffffffff /end CHARACTERISTIC
/begin CHARACTERISTIC tallfs_dyf_ll "TALLFS_DYF_LL" VALUE 0x48764 a_174 5 LINEAR______0_000000__0H___99847 0.0 99.998497 BIT_MASK 0xffffffff /end CHARACTERISTIC
/begin CHARACTERISTIC tallfs_dyf_ndif "TALLFS_DYF_NDIF" VALUE 0x4836b a_173 100 LINEAR______0_000000__0H___99159 0.0 99.610001 BIT_MASK 0xffffffff /end CHARACTERISTIC
/begin CHARACTERISTIC tallfs_erg_as "TALLFS_ERG_AS" VALUE 0xe59f a_175 100 LINEAR_______50_000000__FFFFFF80 -50.0 49.610001 BIT_MASK 0xffffffff /end CHARACTERISTIC
/begin CHARACTERISTIC tallfs_i_add "TALLFS_I_ADD" VALUE 0x48766 a_174 2 LINEAR______0_000000__0H___99848 0.0 99.610001 BIT_MASK 0xffffffff /end CHARACTERISTIC
/begin CHARACTERISTIC tallfs_ka_aebg_ll "TALLFS_KA_AEBG_LL" VALUE 0x48768 a_174 20 TALLFS_IN_10MS90 0.0061 24.9938 BIT_MASK 0xffffffff /end CHARACTERISTIC
/begin CHARACTERISTIC tallfs_kk_dec_inst "TALLFS_KK_DEC_INST" VALUE 0x4876a a_174 20 LINEAR______0_000200__1H___6_248 0.0002 6.24847 BIT_MASK 0xffffffff /end CHARACTERISTIC
/begin CHARACTERISTIC tallfs_llfs_diag "TALLFS_LLFS_DIAG" VALUE 0x4876c a_174 5 LINEAR______0_000000__0H___99849 0.0 99.998474 BIT_MASK 0xffffffff /end CHARACTERISTIC
/begin CHARACTERISTIC tallfs_llfs_min_diag_lm "TALLFS_LLFS_MIN_DIAG_LM" VALUE 0x4876e a_174 30 LINEAR______0_000000__0H___99847 0.0 99.998497 BIT_MASK 0xffffffff /end CHARACTERISTIC
/begin CHARACTERISTIC tallfs_max_i "TALLFS_MAX_I" VALUE 0x48106 a_172 10 LINEAR_______50_000004__FFFF8000 -50.000004 49.998489 BIT_MASK 0xffffffff /end CHARACTERISTIC
/begin CHARACTERISTIC tallfs_max_i_kk "TALLFS_MAX_I_KK" VALUE 0x48108 a_172 10 LINEAR_______50_000004__FFFF8000 -50.000004 49.998489 BIT_MASK 0xffffffff /end CHARACTERISTIC
/begin CHARACTERISTIC tallfs_max_i_ll "TALLFS_MAX_I_LL" VALUE 0x4810a a_172 10 LINEAR_______50_000004__FFFF8000 -50.000004 49.998489 BIT_MASK 0xffffffff /end CHARACTERISTIC
/begin CHARACTERISTIC tallfs_min_i "TALLFS_MIN_I" VALUE 0x4810c a_172 10 LINEAR_______50_000004__FFFF8000 -50.000004 49.998489 BIT_MASK 0xffffffff /end CHARACTERISTIC
/begin CHARACTERISTIC tallfs_min_i_kk "TALLFS_MIN_I_KK" VALUE 0x4810e a_172 10 LINEAR_______50_000004__FFFF8000 -50.000004 49.998489 BIT_MASK 0xffffffff /end CHARACTERISTIC
/begin CHARACTERISTIC tallfs_min_i_ll "TALLFS_MIN_I_LL" VALUE 0x48110 a_172 10 LINEAR_______50_000004__FFFF8000 -50.000004 49.998489 BIT_MASK 0xffffffff /end CHARACTERISTIC
/begin CHARACTERISTIC tallfs_mitko_ll "TALLFS_MITKO_LL" VALUE 0x4836c a_173 20 LINEAR______0_000000__0H___0_996 0.0 0.99610001 BIT_MASK 0xffffffff /end CHARACTERISTIC
/begin CHARACTERISTIC tallfs_slow_s_dec "TALLFS_SLOW_S_DEC" VALUE 0x48770 a_174 10 TALLFS_IN_10MS90 0.0061 24.9938 BIT_MASK 0xffffffff /end CHARACTERISTIC
/begin CHARACTERISTIC tallfs_slp_dec_inst "TALLFS_SLP_DEC_INST" VALUE 0x48772 a_174 16 LINEAR______0_000200__1H___6_248 0.0002 6.24847 BIT_MASK 0xffffffff /end CHARACTERISTIC
/begin CHARACTERISTIC tallfs_tv_max_i_ll "TALLFS_TV_MAX_I_LL" VALUE 0x48112 a_172 10 LINEAR_______50_000004__FFFF8000 -50.000004 49.998489 BIT_MASK 0xffffffff /end CHARACTERISTIC
/begin CHARACTERISTIC tallfs_tv_max_i_ll_kk "TALLFS_TV_MAX_I_LL_KK" VALUE 0x48114 a_172 10 LINEAR_______50_000004__FFFF8000 -50.000004 49.998489 BIT_MASK 0xffffffff /end CHARACTERISTIC
/begin CHARACTERISTIC tallfs_tv_min_i_ll "TALLFS_TV_MIN_I_LL" VALUE 0x48116 a_172 10 LINEAR_______50_000004__FFFF8000 -50.000004 49.998489 BIT_MASK 0xffffffff /end CHARACTERISTIC
/begin CHARACTERISTIC tallfs_tv_min_i_ll_kk "TALLFS_TV_MIN_I_LL_KK" VALUE 0x48118 a_172 10 LINEAR_______50_000004__FFFF8000 -50.000004 49.998489 BIT_MASK 0xffffffff /end CHARACTERISTIC
/begin CHARACTERISTIC talsh_as_nkat1 "TALSH_AS_NKAT1" VALUE 0xe5a0 a_175 100 LINEAR_______50_000000__FFFFFF80 -50.0 49.610001 BIT_MASK 0xffffffff /end CHARACTERISTIC
/begin CHARACTERISTIC talsh_as_nkat2 "TALSH_AS_NKAT2" VALUE 0xe5a1 a_175 100 LINEAR_______50_000000__FFFFFF80 -50.0 49.610001 BIT_MASK 0xffffffff /end CHARACTERISTIC
/begin CHARACTERISTIC talsh_as_vkat1 "TALSH_AS_VKAT1" VALUE 0xe5a2 a_175 100 LINEAR_______50_000000__FFFFFF80 -50.0 49.610001 BIT_MASK 0xffffffff /end CHARACTERISTIC
/begin CHARACTERISTIC talsh_as_vkat2 "TALSH_AS_VKAT2" VALUE 0xe5a3 a_175 100 LINEAR_______50_000000__FFFFFF80 -50.0 49.610001 BIT_MASK 0xffffffff /end CHARACTERISTIC
/begin CHARACTERISTIC talsh_dec_nkat "TALSH_DEC_NKAT" VALUE 0x4836d a_173 100 LINEAR______0_391000__1H___99_61 0.391 99.610001 BIT_MASK 0xffffffff /end CHARACTERISTIC
/begin CHARACTERISTIC talsh_dec_vkat "TALSH_DEC_VKAT" VALUE 0x4836e a_173 100 LINEAR______0_391000__1H___99_61 0.391 99.610001 BIT_MASK 0xffffffff /end CHARACTERISTIC
/begin CHARACTERISTIC talsh_inc_nkat "TALSH_INC_NKAT" VALUE 0x4836f a_173 100 LINEAR______0_391000__1H___99_61 0.391 99.610001 BIT_MASK 0xffffffff /end CHARACTERISTIC
/begin CHARACTERISTIC talsh_inc_vkat "TALSH_INC_VKAT" VALUE 0x48370 a_173 100 LINEAR______0_391000__1H___99_61 0.391 99.610001 BIT_MASK 0xffffffff /end CHARACTERISTIC
/begin CHARACTERISTIC talsh_min_diag "TALSH_MIN_DIAG" VALUE 0x48371 a_173 100 LINEAR______0_000000__0H___99_61 0.0 99.610001 BIT_MASK 0xffffffff /end CHARACTERISTIC
/begin CHARACTERISTIC talsh_sa_nkat "TALSH_SA_NKAT" VALUE 0x48372 a_173 100 LINEAR______0_000000__0H___99_61 0.0 99.610001 BIT_MASK 0xffffffff /end CHARACTERISTIC
/begin CHARACTERISTIC talsh_sa_vkat1 "TALSH_SA_VKAT1" VALUE 0x48373 a_173 100 LINEAR______0_000000__0H___99_61 0.0 99.610001 BIT_MASK 0xffffffff /end CHARACTERISTIC
/begin CHARACTERISTIC talsh_sa_vkat2 "TALSH_SA_VKAT2" VALUE 0x48374 a_173 100 LINEAR______0_000000__0H___99_61 0.0 99.610001 BIT_MASK 0xffffffff /end CHARACTERISTIC
/begin CHARACTERISTIC tamdk_aebg "TAMDK_AEBG" VALUE 0x48774 a_174 100 LINEAR______0_000000__0H___99850 0.0 99.998474 BIT_MASK 0xffffffff /end CHARACTERISTIC
/begin CHARACTERISTIC tamdk_max_add "TAMDK_MAX_ADD" VALUE 0x48776 a_174 100 LINEAR______0_000000__0H___10851 0.0 100.0 BIT_MASK 0xffffffff /end CHARACTERISTIC
/begin CHARACTERISTIC tate_ad_max "TATE_AD_MAX" VALUE 0x48778 a_174 10 LINEAR______0_000000__0H___800_0 0.0 800.0 BIT_MASK 0xffffffff /end CHARACTERISTIC
/begin CHARACTERISTIC tate_ad_min "TATE_AD_MIN" VALUE 0x4877a a_174 10 LINEAR______0_000000__0H___99852 0.0 99.97559 BIT_MASK 0xffffffff /end CHARACTERISTIC
/begin CHARACTERISTIC tate_as "TATE_AS" VALUE 0xe5a4 a_175 100 LINEAR_______50_000000__FFFFF839 -50.0 49.610001 BIT_MASK 0xffffffff /end CHARACTERISTIC
/begin CHARACTERISTIC tate_fc_2 "TATE_FC_2" VALUE 0x4877c a_174 10 LINEAR______0_000000__0H___99852 0.0 99.97559 BIT_MASK 0xffffffff /end CHARACTERISTIC
/begin CHARACTERISTIC tate_fc_3 "TATE_FC_3" VALUE 0x4877e a_174 10 LINEAR______0_000000__0H___99852 0.0 99.97559 BIT_MASK 0xffffffff /end CHARACTERISTIC
/begin CHARACTERISTIC tate_max_diag_ll "TATE_MAX_DIAG_LL" VALUE 0x48780 a_174 10 LINEAR______0_000000__0H___99852 0.0 99.97559 BIT_MASK 0xffffffff /end CHARACTERISTIC
/begin CHARACTERISTIC tate_max_kor_max "TATE_MAX_KOR_MAX" VALUE 0x48782 a_174 10 LINEAR______0_000000__0H___800_0 0.0 800.0 BIT_MASK 0xffffffff /end CHARACTERISTIC
/begin CHARACTERISTIC te_anz_p "TE_ANZ_P" VALUE 0x48375 a_173 10 LINEAR______0_000000__0H___25182 0.0 255.0 BIT_MASK 0xffffffff /end CHARACTERISTIC
/begin CHARACTERISTIC temp_ers_kat_el_sa "TEMP_ERS_KAT_EL_SA" VALUE 0x48376 a_173 100 LINEAR_______33_000000__0H___853 -33.0 987.0 BIT_MASK 0xffffffff /end CHARACTERISTIC
/begin CHARACTERISTIC temp_ers_kat_min_ks "TEMP_ERS_KAT_MIN_KS" VALUE 0x48377 a_173 100 LINEAR_______33_000000__0H___853 -33.0 987.0 BIT_MASK 0xffffffff /end CHARACTERISTIC
/begin CHARACTERISTIC temp_min_ers_kat_ms "TEMP_MIN_ERS_KAT_MS" VALUE 0x48784 a_174 100 LINEAR_______33_000000__0H___854 -33.0 990.0 BIT_MASK 0xffffffff /end CHARACTERISTIC
/begin CHARACTERISTIC temp_min_ers_kat_red "TEMP_MIN_ERS_KAT_RED" VALUE 0x48786 a_174 100 LINEAR_______33_000000__0H___854 -33.0 990.0 BIT_MASK 0xffffffff /end CHARACTERISTIC
/begin CHARACTERISTIC temp_sond_ers_min "TEMP_SOND_ERS_MIN" VALUE 0x48378 a_173 100 LINEAR_______48_000000__0H___142 -48.0 142.5 BIT_MASK 0xffffffff /end CHARACTERISTIC
/begin CHARACTERISTIC TENDENCY_LIMIT "TENDENCY_LIMIT" VALUE 0x4811a a_172 100 LINEAR_______32768_000000__FFFF8 -32768.0 32767.0 BIT_MASK 0xffffffff /end CHARACTERISTIC
/begin CHARACTERISTIC ti_abr_lwf "TI_ABR_LWF" VALUE 0x48379 a_173 100 LINEAR______0_000000__0H___0_855 0.0 0.12451 BIT_MASK 0xffffffff /end CHARACTERISTIC
/begin CHARACTERISTIC ti_abr_swf_ll "TI_ABR_SWF_LL" VALUE 0x4837a a_173 100 LINEAR______0_000000__0H___0_856 0.0 0.49805 BIT_MASK 0xffffffff /end CHARACTERISTIC
/begin CHARACTERISTIC ti_ad_add_gmw_dif "TI_AD_ADD_GMW_DIF" VALUE 0x48788 a_174 100 LINEAR______0_000000__0H___10857 0.0 10.0 BIT_MASK 0xffffffff /end CHARACTERISTIC
/begin CHARACTERISTIC ti_ad_add_max "TI_AD_ADD_MAX" VALUE 0x4878a a_174 20 LINEAR______0_000000__8000H___5_ 0.0 5.0 BIT_MASK 0xffffffff /end CHARACTERISTIC
/begin CHARACTERISTIC ti_ad_add_min "TI_AD_ADD_MIN" VALUE 0x4878c a_174 20 LINEAR_______5_000000__7B1EH___0 -5.0 0.0 BIT_MASK 0xffffffff /end CHARACTERISTIC
/begin CHARACTERISTIC ti_ad_fak_gmw_dif "TI_AD_FAK_GMW_DIF" VALUE 0x4878e a_174 100 LINEAR______0_000000__0H___10858 0.0 10.0 BIT_MASK 0xffffffff /end CHARACTERISTIC
/begin CHARACTERISTIC ti_ad_fak_max "TI_AD_FAK_MAX" VALUE 0x48790 a_174 10 LINEAR______0_000000__8000H__859 0.0 31.25 BIT_MASK 0xffffffff /end CHARACTERISTIC
/begin CHARACTERISTIC ti_ad_fak_min "TI_AD_FAK_MIN" VALUE 0x48792 a_174 10 LINEAR_______31_250000__3000H860 -31.25 0.0 BIT_MASK 0xffffffff /end CHARACTERISTIC
/begin CHARACTERISTIC ti_ad_kor_mitko "TI_AD_KOR_MITKO" VALUE 0x4837b a_173 10 LINEAR______0_000000__0H___0_996 0.0 0.99610001 BIT_MASK 0xffffffff /end CHARACTERISTIC
/begin CHARACTERISTIC ti_ad_kor_mitko_ll "TI_AD_KOR_MITKO_LL" VALUE 0x4837c a_173 10 LINEAR______0_000000__0H___0_996 0.0 0.99610001 BIT_MASK 0xffffffff /end CHARACTERISTIC
/begin CHARACTERISTIC ti_ad_kor_mitko_te "TI_AD_KOR_MITKO_TE" VALUE 0x4837d a_173 10 LINEAR______0_000000__0H___0_996 0.0 0.99610001 BIT_MASK 0xffffffff /end CHARACTERISTIC
/begin CHARACTERISTIC ti_add_wf_inst "TI_ADD_WF_INST" VALUE 0x48794 a_174 100 LINEAR______0_000000__0H___131_0 0.0 131.068 BIT_MASK 0xffffffff /end CHARACTERISTIC
/begin CHARACTERISTIC ti_add_wf_max_sl_diag "TI_ADD_WF_MAX_SL_DIAG" VALUE 0x48796 a_174 100 LINEAR______0_000000__0H___131_0 0.0 131.068 BIT_MASK 0xffffffff /end CHARACTERISTIC
/begin CHARACTERISTIC ti_add_wf_min_sl_diag "TI_ADD_WF_MIN_SL_DIAG" VALUE 0x4811c a_172 100 LINEAR_______131_072000__FFFF800 -131.072 0.0 BIT_MASK 0xffffffff /end CHARACTERISTIC
/begin CHARACTERISTIC ti_as_0 "TI_AS_1" VALUE 0xe5ac a_173 100 TI_AS 0.5 1.5 BIT_MASK 0xffffffff /end CHARACTERISTIC
/begin CHARACTERISTIC ti_as_1 "TI_AS_5" VALUE 0xe5ad a_173 100 TI_AS 0.5 1.5 BIT_MASK 0xffffffff /end CHARACTERISTIC
/begin CHARACTERISTIC ti_as_2 "TI_AS_3" VALUE 0xe5ae a_173 100 TI_AS 0.5 1.5 BIT_MASK 0xffffffff /end CHARACTERISTIC
/begin CHARACTERISTIC ti_as_3 "TI_AS_6" VALUE 0xe5af a_173 100 TI_AS 0.5 1.5 BIT_MASK 0xffffffff /end CHARACTERISTIC
/begin CHARACTERISTIC ti_as_4 "TI_AS_2" VALUE 0xe5b0 a_173 100 TI_AS 0.5 1.5 BIT_MASK 0xffffffff /end CHARACTERISTIC
/begin CHARACTERISTIC ti_as_5 "TI_AS_4" VALUE 0xe5b1 a_173 100 TI_AS 0.5 1.5 BIT_MASK 0xffffffff /end CHARACTERISTIC
/begin CHARACTERISTIC ti_dec_ks "TI_DEC_KS" VALUE 0x4837e a_173 10 LINEAR______0_000000__0H___0_500 0.0 0.5 BIT_MASK 0xffffffff /end CHARACTERISTIC
/begin CHARACTERISTIC ti_kor_ks "TI_KOR_KS" VALUE 0x48798 a_174 10 LINEAR______0_000000__0H___1_861 0.0 1.0 BIT_MASK 0xffffffff /end CHARACTERISTIC
/begin CHARACTERISTIC ti_kor_v_max "TI_KOR_V_MAX" VALUE 0x4879a a_174 10 LINEAR______0_000000__0H___1_166 0.0 1.0 BIT_MASK 0xffffffff /end CHARACTERISTIC
/begin CHARACTERISTIC ti_korr_bep "TI_KORR_BEP" VALUE 0x4879c a_174 25 LINEAR______0_000000__0H___2_984 0.0 2.9844 BIT_MASK 0xffffffff /end CHARACTERISTIC
/begin CHARACTERISTIC ti_ks2_aebg "TI_KS2_AEBG" VALUE 0x4837f a_173 100 LINEAR______0_003900__1H___0_996 0.0039 0.99599999 BIT_MASK 0xffffffff /end CHARACTERISTIC
/begin CHARACTERISTIC ti_min_ev "TI_MIN_EV" VALUE 0x4879e a_174 10 TI_BAS_16_RES862 0.0 262.14 BIT_MASK 0xffffffff /end CHARACTERISTIC
/begin CHARACTERISTIC ti_min_ks "TI_MIN_KS" VALUE 0x48380 a_173 100 LINEAR______0_003900__1H___0_996 0.0039 0.99599999 BIT_MASK 0xffffffff /end CHARACTERISTIC
/begin CHARACTERISTIC TIME_WINDOW_SWING_DETECTION "TIME_WINDOW_SWING_DETECTION" VALUE 0x4811e a_172 100 LINEAR_______32768_000000__FFFF8 -32768.0 32767.0 BIT_MASK 0xffffffff /end CHARACTERISTIC
/begin CHARACTERISTIC timeout_ekp_crash "TIMEOUT_EKP_CRASH" VALUE 0x48381 a_173 100 LINEAR______0_000000__0H___51000 0.0 51000.0 BIT_MASK 0xffffffff /end CHARACTERISTIC
/begin CHARACTERISTIC timeout_ews "TIMEOUT_EWS" VALUE 0x48382 a_173 100 LINEAR______0_100000__1H___25157 0.1 25.5 BIT_MASK 0xffffffff /end CHARACTERISTIC
/begin CHARACTERISTIC tka_dif_diag "TKA_DIF_DIAG" VALUE 0x487f7 a_175 15 LINEAR_______48_000000__FFFFFFC0 -48.0 48.0 BIT_MASK 0xffffffff /end CHARACTERISTIC
/begin CHARACTERISTIC tka_kfk_hys "TKA_KFK_HYS" VALUE 0x48383 a_173 15 LINEAR______0_000000__0H___19846 0.0 190.5 BIT_MASK 0xffffffff /end CHARACTERISTIC
/begin CHARACTERISTIC tka_kfk_max "TKA_KFK_MAX" VALUE 0x48384 a_173 15 LINEAR_______48_000000__0H___189 -48.0 142.5 BIT_MASK 0xffffffff /end CHARACTERISTIC
/begin COMPU_METHOD ES_8_RES "" FORM "%4.0" "[1/min]" FORMULA "32.0*X" FORMULA_INV "0.03125*X" /end COMPU_METHOD
/begin COMPU_METHOD LINEAR______0_000000__0H___99_61 "" FORM "%4.1" "[%]" FORMULA "0.39062745*X" FORMULA_INV "2.5599839*X" /end COMPU_METHOD
/begin COMPU_METHOD LINEAR______0_000000__0H___1_992 "" FORM "%5.3" "[-]" FORMULA "0.0078125491*X" FORMULA_INV "127.9992*X" /end COMPU_METHOD
/begin COMPU_METHOD MTC_NORM_16_RES10 "" FORM "%6.2" "[°DK]" FORMULA "0.0018310547*X" FORMULA_INV "546.13333*X" /end COMPU_METHOD
/begin COMPU_METHOD LINEAR_______48_000000__0H___142 "" FORM "%5.1" "[°C]" FORMULA "0.75*X-48.0" FORMULA_INV "1.3333333*X+64.0" /end COMPU_METHOD
/begin COMPU_METHOD LINEAR______0_000000__0H___0_916 "" FORM "%5.3" "[-]" FORMULA "1.5258789e-005*X" FORMULA_INV "65536.0*X" /end COMPU_METHOD
/begin COMPU_METHOD LINEAR______0_000000__0H___255_9 "" FORM "%7.3" "[-]" FORMULA "0.0039062486*X" FORMULA_INV "256.00009*X" /end COMPU_METHOD
/begin COMPU_METHOD ES_8_RES17 "" FORM "%4.0" "[U/min]" FORMULA "32.0*X" FORMULA_INV "0.03125*X" /end COMPU_METHOD
/begin COMPU_METHOD LINEAR______0_000000__0H___0_996 "" FORM "%5.3" "[-]" FORMULA "0.0039062745*X" FORMULA_INV "255.99839*X" /end COMPU_METHOD
/begin COMPU_METHOD LINEAR______0_000000__0H___0_920 "" FORM "%5.3" "[-]" FORMULA "0.0039058823*X" FORMULA_INV "256.0241*X" /end COMPU_METHOD
/begin COMPU_METHOD LINEAR_______48_000000__0H___121 "" FORM "%4.0" "[°C]" FORMULA "0.75*X-48.0" FORMULA_INV "1.3333333*X+64.0" /end COMPU_METHOD
/begin COMPU_METHOD LINEAR______0_000000__0H___0_924 "" FORM "%5.3" "[-]" FORMULA "1.5258716e-005*X" FORMULA_INV "65536.313*X" /end COMPU_METHOD
/begin COMPU_METHOD MAF_KGH_16_RES28 "" FORM "%8.2" "[kg/h]" FORMULA "0.25*X" FORMULA_INV "4.0*X" /end COMPU_METHOD
/begin COMPU_METHOD LINEAR______0_000000__0H___1_999 "" FORM "%7.5" "[-]" FORMULA "3.0517585e-005*X" FORMULA_INV "32767.992*X" /end COMPU_METHOD
/begin COMPU_METHOD LINEAR______0_000000__0H___2550_ "" FORM "%4.0" "[ms]" FORMULA "10.0*X" FORMULA_INV "0.1*X" /end COMPU_METHOD
/begin COMPU_METHOD LINEAR______1_000000__1H___255_0 "" FORM "%4.0" "[-]" FORMULA "1.0*X" FORMULA_INV "1.0*X" /end COMPU_METHOD
/begin COMPU_METHOD MAF_8_RES37 "" FORM "%4.0" "[mg/Hub]" FORMULA "5.4470588*X" FORMULA_INV "0.18358531*X" /end COMPU_METHOD
/begin COMPU_METHOD MAF_8_RES40 "" FORM "%5.0" "[mg/Hub]" FORMULA "5.4470588*X" FORMULA_INV "0.18358531*X" /end COMPU_METHOD
/begin COMPU_METHOD ES_8_RES41 "" FORM "%5.0" "[1/min]" FORMULA "32.0*X" FORMULA_INV "0.03125*X" /end COMPU_METHOD
/begin COMPU_METHOD MAF_16_RES46 "" FORM "%4.0" "[mg/Hub]" FORMULA "0.021194781*X" FORMULA_INV "47.181425*X" /end COMPU_METHOD
/begin COMPU_METHOD MAF_16_RES47 "" FORM "%6.1" "[mg/Hub]" FORMULA "0.021194781*X" FORMULA_INV "47.181425*X" /end COMPU_METHOD
/begin COMPU_METHOD MAF_16_RES49 "" FORM "%5.0" "[mg/Hub]" FORMULA "0.021194781*X" FORMULA_INV "47.181425*X" /end COMPU_METHOD
/begin COMPU_METHOD LINEAR______0_000000__0H___5434_ "" FORM "%5.0" "[hPa]" FORMULA "0.082921489*X" FORMULA_INV "12.0596*X" /end COMPU_METHOD
/begin COMPU_METHOD LINEAR______0_000000__0H___1023_ "" FORM "%4.0" "[Nm]" FORMULA "1.0*X" FORMULA_INV "1.0*X" /end COMPU_METHOD
/begin COMPU_METHOD MTC_NORM_16_RES51 "" FORM "%7.3" "[°DK]" FORMULA "0.0018310547*X" FORMULA_INV "546.13333*X" /end COMPU_METHOD
/begin COMPU_METHOD LINEAR______0_000000__0H___0_956 "" FORM "%7.5" "[-]" FORMULA "1.5258789e-005*X" FORMULA_INV "65536.0*X" /end COMPU_METHOD
/begin COMPU_METHOD IS_13_RES62 "" FORM "%5.0" "[1/min]" FORMULA "1.0*X" FORMULA_INV "1.0*X" /end COMPU_METHOD
/begin COMPU_METHOD LINEAR______0_000000__0H___0_965 "" FORM "%5.3" "[-]" FORMULA "0.00390625*X" FORMULA_INV "256.0*X" /end COMPU_METHOD
/begin COMPU_METHOD LINEAR______0_000000__0H___1_275 "" FORM "%5.3" "[V]" FORMULA "0.005*X" FORMULA_INV "200.0*X" /end COMPU_METHOD
/begin COMPU_METHOD LINEAR______0_000000__0H___0_967 "" FORM "%4.3" "[-]" FORMULA "0.00390625*X" FORMULA_INV "256.0*X" /end COMPU_METHOD
/begin COMPU_METHOD IS_13_RES78 "" FORM "%4.0" "[1/min]" FORMULA "1.0*X" FORMULA_INV "1.0*X" /end COMPU_METHOD
/begin COMPU_METHOD LINEAR______0_000000__0H___1275_ "" FORM "%4.0" "[ms]" FORMULA "5.0*X" FORMULA_INV "0.2*X" /end COMPU_METHOD
/begin COMPU_METHOD LINEAR______0_000000__0H___8_388 "" FORM "%5.3" "[s]" FORMULA "0.000128*X" FORMULA_INV "7812.5*X" /end COMPU_METHOD
/begin COMPU_METHOD IS_13_RES84 "" FORM "%5.0" "[U/min]" FORMULA "1.0*X" FORMULA_INV "1.0*X" /end COMPU_METHOD
/begin COMPU_METHOD LINEAR______0_000000__0H___1_279 "" FORM "%6.4" "[s]" FORMULA "7.8123665e-005*X" FORMULA_INV "12800.219*X" /end COMPU_METHOD
/begin COMPU_METHOD LINEAR______0_000000__0H___99_59 "" FORM "%4.1" "[%]" FORMULA "0.39058823*X" FORMULA_INV "2.560241*X" /end COMPU_METHOD
/begin COMPU_METHOD LINEAR_______48_000000__0H___189 "" FORM "%3.0" "[°C]" FORMULA "0.75*X-48.0" FORMULA_INV "1.3333333*X+64.0" /end COMPU_METHOD
/begin COMPU_METHOD TALLFS_IN_10MS90 "" FORM "%7.3" "[%/10ms]" FORMULA "0.0061034929*X-3.4929165e-006" FORMULA_INV "163.84061*X+0.00057228156" /end COMPU_METHOD
/begin COMPU_METHOD LINEAR______0_000000__0H___0_993 "" FORM "%7.5" "[-]" FORMULA "1.5258716e-005*X" FORMULA_INV "65536.313*X" /end COMPU_METHOD
/begin COMPU_METHOD LINEAR_______256_000000__0___254 "" FORM "%3.0" "[1/min]" FORMULA "2.0*X-256.0" FORMULA_INV "0.5*X+128.0" /end COMPU_METHOD
/begin COMPU_METHOD LINEAR______0_000000__0H___800_0 "" FORM "%6.2" "[%]" FORMULA "0.024414063*X" FORMULA_INV "40.96*X" /end COMPU_METHOD
/begin COMPU_METHOD LINEAR______0_000000__0H___6553_ "" FORM "%6.1" "[s]" FORMULA "0.1*X" FORMULA_INV "10.0*X" /end COMPU_METHOD
/begin COMPU_METHOD ES_8_RES116 "" FORM "%5.0" "[U/min]" FORMULA "32.0*X" FORMULA_INV "0.03125*X" /end COMPU_METHOD
/begin COMPU_METHOD MAF_KGH_16_RES117 "" FORM "%6.1" "[kg/h]" FORMULA "0.25*X" FORMULA_INV "4.0*X" /end COMPU_METHOD
/begin COMPU_METHOD LINEAR______0_000000__0H___25119 "" FORM "%5.0" "[ms]" FORMULA "10.0*X" FORMULA_INV "0.1*X" /end COMPU_METHOD
/begin COMPU_METHOD LINEAR______0_000000__0H___11125 "" FORM "%5.1" "[°DK]" FORMULA "0.46862745*X" FORMULA_INV "2.1338912*X" /end COMPU_METHOD
/begin COMPU_METHOD LINEAR______0_000000__0H___0_129 "" FORM "%5.3" "[]" FORMULA "0.0039058823*X" FORMULA_INV "256.0241*X" /end COMPU_METHOD
/begin COMPU_METHOD LINEAR______0_000000__0H___25142 "" FORM "%3.0" "[-]" FORMULA "1.0*X" FORMULA_INV "1.0*X" /end COMPU_METHOD
/begin COMPU_METHOD LINEAR______0_000000__0H___655_3 "" FORM "%6.2" "[s]" FORMULA "0.0099999996*X" FORMULA_INV "100.0*X" /end COMPU_METHOD
/begin COMPU_METHOD LINEAR______0_000000__0H___1_155 "" FORM "%5.3" "[-]" FORMULA "0.0078278431*X" FORMULA_INV "127.74911*X" /end COMPU_METHOD
/begin COMPU_METHOD LINEAR______10_000000__1H___2550 "" FORM "%5.0" "[ms]" FORMULA "10.0*X" FORMULA_INV "0.1*X" /end COMPU_METHOD
/begin COMPU_METHOD LINEAR______0_100000__1H___25157 "" FORM "%4.1" "[s]" FORMULA "0.1*X+1.3877788e-017" FORMULA_INV "10.0*X-1.3877788e-016" /end COMPU_METHOD
/begin COMPU_METHOD LINEAR______0_000000__0H___99159 "" FORM "%5.2" "[%]" FORMULA "0.39062745*X" FORMULA_INV "2.5599839*X" /end COMPU_METHOD
/begin COMPU_METHOD LINEAR______0_000000__0H___65163 "" FORM "%5.0" "[-]" FORMULA "1.0*X" FORMULA_INV "1.0*X" /end COMPU_METHOD
/begin COMPU_METHOD LINEAR______0_000000__0H___65164 "" FORM "%5.0" "[-]" FORMULA "1.0*X" FORMULA_INV "1.0*X" /end COMPU_METHOD
/begin COMPU_METHOD LINEAR______0_000000__0H___1_166 "" FORM "%5.3" "[-]" FORMULA "0.00024414063*X" FORMULA_INV "4096.0*X" /end COMPU_METHOD
/begin COMPU_METHOD LINEAR______0_000000__0H___1_167 "" FORM "%2.0" "[-]" FORMULA "1.0*X" FORMULA_INV "1.0*X" /end COMPU_METHOD
/begin COMPU_METHOD LINEAR______0_001460__1H___47168 "" FORM "%6.3" "[°KW/120°KW]" FORMULA "0.0014648428*X-4.8428499e-006" FORMULA_INV "682.66709*X+0.0033060542" /end COMPU_METHOD
/begin COMPU_METHOD LINEAR______0_000000__0H___48_00 "" FORM "%5.2" "[°KW]" FORMULA "0.375*X" FORMULA_INV "2.6666667*X" /end COMPU_METHOD
/begin COMPU_METHOD LINEAR_______32768_000000__FFFF8 "" FORM "%6.0" "" FORMULA "1.0*X" FORMULA_INV "1.0*X" /end COMPU_METHOD
/begin COMPU_METHOD LINEAR_______32768_000000__FF180 "" FORM "%6.0" "[-]" FORMULA "1.0*X" FORMULA_INV "1.0*X" /end COMPU_METHOD
/begin COMPU_METHOD SIGNEDCHAR "" FORM "%4.0" "[-]" FORMULA "1.0*X" FORMULA_INV "1.0*X" /end COMPU_METHOD
/begin COMPU_METHOD LINEAR______0_000000__0H___25182 "" FORM "%4.0" "[-]" FORMULA "1.0*X" FORMULA_INV "1.0*X" /end COMPU_METHOD
/begin COMPU_METHOD LINEAR______1_000000__1H___25184 "" FORM "%3.0" "[s]" FORMULA "1.0*X" FORMULA_INV "1.0*X" /end COMPU_METHOD
/begin COMPU_METHOD LINEAR______1_000000__1H___25186 "" FORM "%3.0" "[-]" FORMULA "1.0*X" FORMULA_INV "1.0*X" /end COMPU_METHOD
/begin COMPU_METHOD LINEAR______0_000000__0H___65187 "" FORM "%6.0" "[1/200KW_Umdr.]" FORMULA "1.0*X" FORMULA_INV "1.0*X" /end COMPU_METHOD
/begin COMPU_METHOD LINEAR______0_000000__0H___65190 "" FORM "%5.0" "" FORMULA "1.0*X" FORMULA_INV "1.0*X" /end COMPU_METHOD
/begin COMPU_METHOD MTC_IN_DK_16_RES "" FORM "%6.2" "[°DK]" FORMULA "0.0036621094*X" FORMULA_INV "273.06667*X" /end COMPU_METHOD
/begin COMPU_METHOD LINEAR______0_010000__0H___655_3 "" FORM "%6.2" "[s]" FORMULA "0.009999847*X+0.01" FORMULA_INV "100.00153*X-1.0000153" /end COMPU_METHOD
/begin COMPU_METHOD MTC_IN_DK_16_RES202 "" FORM "%5.1" "[°DK]" FORMULA "0.0036621094*X" FORMULA_INV "273.06667*X" /end COMPU_METHOD
/begin COMPU_METHOD LINEAR_______768_000000__FFFFFF8 "" FORM "%5.0" "[°KW ZOT]" FORMULA "6.0*X" FORMULA_INV "0.16666667*X" /end COMPU_METHOD
/begin COMPU_METHOD LINEAR______0_000000__0H___0_203 "" FORM "%4.2" "[-]" FORMULA "0.0039058823*X" FORMULA_INV "256.0241*X" /end COMPU_METHOD
/begin COMPU_METHOD LINEAR______0_000000__0H___47_62 "" FORM "%6.3" "[_KW]" FORMULA "0.375*X" FORMULA_INV "2.6666667*X" /end COMPU_METHOD
/begin COMPU_METHOD defaultConversion707 "" FORM "%8.4" "[]" FORMULA "1.0*X" FORMULA_INV "1.0*X" /end COMPU_METHOD
/begin COMPU_METHOD defaultConversion708 "" FORM "%8.4" "[]" FORMULA "1.0*X" FORMULA_INV "1.0*X" /end COMPU_METHOD
/begin COMPU_METHOD defaultConversion709 "" FORM "%8.4" "[]" FORMULA "1.0*X" FORMULA_INV "1.0*X" /end COMPU_METHOD
/begin COMPU_METHOD defaultConversion710 "" FORM "%8.4" "[]" FORMULA "1.0*X" FORMULA_INV "1.0*X" /end COMPU_METHOD
/begin COMPU_METHOD defaultConversion711 "" FORM "%8.4" "[]" FORMULA "1.0*X" FORMULA_INV "1.0*X" /end COMPU_METHOD
/begin COMPU_METHOD defaultConversion712 "" FORM "%8.4" "[]" FORMULA "1.0*X" FORMULA_INV "1.0*X" /end COMPU_METHOD
/begin COMPU_METHOD defaultConversion713 "" FORM "%8.4" "[]" FORMULA "1.0*X" FORMULA_INV "1.0*X" /end COMPU_METHOD
/begin COMPU_METHOD defaultConversion714 "" FORM "%8.4" "[]" FORMULA "1.0*X" FORMULA_INV "1.0*X" /end COMPU_METHOD
/begin COMPU_METHOD defaultConversion715 "" FORM "%8.4" "[]" FORMULA "1.0*X" FORMULA_INV "1.0*X" /end COMPU_METHOD
/begin COMPU_METHOD defaultConversion716 "" FORM "%8.4" "[]" FORMULA "1.0*X" FORMULA_INV "1.0*X" /end COMPU_METHOD
/begin COMPU_METHOD defaultConversion717 "" FORM "%8.4" "[]" FORMULA "1.0*X" FORMULA_INV "1.0*X" /end COMPU_METHOD
/begin COMPU_METHOD defaultConversion718 "" FORM "%8.4" "[]" FORMULA "1.0*X" FORMULA_INV "1.0*X" /end COMPU_METHOD
/begin COMPU_METHOD defaultConversion719 "" FORM "%8.4" "[]" FORMULA "1.0*X" FORMULA_INV "1.0*X" /end COMPU_METHOD
/begin COMPU_METHOD defaultConversion720 "" FORM "%8.4" "[]" FORMULA "1.0*X" FORMULA_INV "1.0*X" /end COMPU_METHOD
/begin COMPU_METHOD defaultConversion721 "" FORM "%8.4" "[]" FORMULA "1.0*X" FORMULA_INV "1.0*X" /end COMPU_METHOD
/begin COMPU_METHOD defaultConversion722 "" FORM "%8.4" "[]" FORMULA "1.0*X" FORMULA_INV "1.0*X" /end COMPU_METHOD
/begin COMPU_METHOD defaultConversion723 "" FORM "%8.4" "[]" FORMULA "1.0*X" FORMULA_INV "1.0*X" /end COMPU_METHOD
/begin COMPU_METHOD LINEAR______0_000000__0H___29724 "" FORM "%4.0" "[°DK]" FORMULA "11.717647*X" FORMULA_INV "0.085341365*X" /end COMPU_METHOD
/begin COMPU_METHOD LINEAR______0_000000__0H___5_725 "" FORM "%4.2" "[s]" FORMULA "0.02*X" FORMULA_INV "50.000001*X" /end COMPU_METHOD
/begin COMPU_METHOD LINEAR______0_000000__0H___25726 "" FORM "%4.2" "[s]" FORMULA "0.1*X" FORMULA_INV "10.0*X" /end COMPU_METHOD
/begin COMPU_METHOD LINEAR______0_000000__0H___76791 "" FORM "%6.0" "[°DK/sec]" FORMULA "11.717647*X" FORMULA_INV "0.085341365*X" /end COMPU_METHOD
/begin COMPU_METHOD LINEAR______0_000000__0H___1_727 "" FORM "%6.4" "[-]" FORMULA "3.0517815e-005*X" FORMULA_INV "32767.746*X" /end COMPU_METHOD
/begin COMPU_METHOD LINEAR______0_000000__0H___300_0 "" FORM "%4.0" "[U/min]" FORMULA "1.0*X" FORMULA_INV "1.0*X" /end COMPU_METHOD
/begin COMPU_METHOD LINEAR_______31_250000__FFFFB000 "" FORM "%6.2" "[-]" FORMULA "0.0015258789*X" FORMULA_INV "655.36*X" /end COMPU_METHOD
/begin COMPU_METHOD LINEAR_______31_250000__3000H728 "" FORM "%5.2" "[-]" FORMULA "0.0015258789*X-50.0" FORMULA_INV "655.36*X+32768.0" /end COMPU_METHOD
/begin COMPU_METHOD LINEAR_______31_250000__3000H729 "" FORM "%6.2" "[-]" FORMULA "0.0015258789*X-50.0" FORMULA_INV "655.36*X+32768.0" /end COMPU_METHOD
/begin COMPU_METHOD LINEAR______0_000000__0H___31_25 "" FORM "%4.1" "[%]" FORMULA "0.0015258789*X" FORMULA_INV "655.36*X" /end COMPU_METHOD
/begin COMPU_METHOD MAF_16_RES730 "" FORM "%7.2" "[mg/Hub]" FORMULA "0.021194781*X" FORMULA_INV "47.181425*X" /end COMPU_METHOD
/begin COMPU_METHOD LM_INT_SA_RANGE731 "" FORM "%5.0" "[g]" FORMULA "0.027777829*X" FORMULA_INV "35.999934*X" /end COMPU_METHOD
/begin COMPU_METHOD LM_INT_SA_RANGE732 "" FORM "%7.1" "[g]" FORMULA "0.027777829*X" FORMULA_INV "35.999934*X" /end COMPU_METHOD
/begin COMPU_METHOD LM_INT_SA_RANGE733 "" FORM "%7.2" "[g]" FORMULA "0.027777829*X" FORMULA_INV "35.999934*X" /end COMPU_METHOD
/begin COMPU_METHOD LINEAR______0_000000__0H___0_983 "" FORM "%7.5" "[]" FORMULA "1.5000077e-005*X" FORMULA_INV "66666.326*X" /end COMPU_METHOD
/begin COMPU_METHOD LINEAR______0_000000__0H___1_734 "" FORM "%7.5" "[-]" FORMULA "1.5259022e-005*X" FORMULA_INV "65535.0*X" /end COMPU_METHOD
/begin COMPU_METHOD LINEAR______0_000000__0H___2040_ "" FORM "%5.0" "[U/min]" FORMULA "1.0*X" FORMULA_INV "1.0*X" /end COMPU_METHOD
/begin COMPU_METHOD LINEAR______0_000000__0H___25735 "" FORM "%4.1" "[s]" FORMULA "0.1*X" FORMULA_INV "10.0*X" /end COMPU_METHOD
/begin COMPU_METHOD LINEAR_______640_020000__FFFF800 "" FORM "%7.2" "[ms]" FORMULA "0.019531548*X-0.010234226" FORMULA_INV "51.199219*X+0.52398437" /end COMPU_METHOD
/begin COMPU_METHOD LINEAR_______640_000000__8000000 "" FORM "%12.7" "[ms]" FORMULA "2.9802322e-007*X-1.509884e-007" FORMULA_INV "3355443.2*X+0.506633" /end COMPU_METHOD
/begin COMPU_METHOD LINEAR_______33_000000__0H___736 "" FORM "%3.0" "[°C]" FORMULA "4.0117647*X-33.0" FORMULA_INV "0.24926686*X+8.2258065" /end COMPU_METHOD
/begin COMPU_METHOD LINEAR_______33_000000__0H___737 "" FORM "%6.2" "[°C]" FORMULA "4.0117647*X-33.0" FORMULA_INV "0.24926686*X+8.2258065" /end COMPU_METHOD
/begin COMPU_METHOD LINEAR______0_000000__0H___25738 "" FORM "%4.0" "[km/h]" FORMULA "1.0*X" FORMULA_INV "1.0*X" /end COMPU_METHOD
/begin COMPU_METHOD LINEAR______0_000000__0H___1_739 "" FORM "%6.4" "[-]" FORMULA "3.0517585e-005*X" FORMULA_INV "32767.992*X" /end COMPU_METHOD
/begin COMPU_METHOD LINEAR______0_000000__0H___51740 "" FORM "%4.0" "[ms]" FORMULA "20.0*X" FORMULA_INV "0.05*X" /end COMPU_METHOD
/begin COMPU_METHOD LINEAR______0_000000__0H___25741 "" FORM "%7.3" "[-]" FORMULA "0.0039062486*X" FORMULA_INV "256.00009*X" /end COMPU_METHOD
/begin COMPU_METHOD defaultConversion742 "" FORM "%8.4" "[]" FORMULA "1.0*X" FORMULA_INV "1.0*X" /end COMPU_METHOD
/begin COMPU_METHOD defaultConversion743 "" FORM "%8.4" "[]" FORMULA "1.0*X" FORMULA_INV "1.0*X" /end COMPU_METHOD
/begin COMPU_METHOD defaultConversion744 "" FORM "%8.4" "[]" FORMULA "1.0*X" FORMULA_INV "1.0*X" /end COMPU_METHOD
/begin COMPU_METHOD defaultConversion745 "" FORM "%8.4" "[]" FORMULA "1.0*X" FORMULA_INV "1.0*X" /end COMPU_METHOD
/begin COMPU_METHOD defaultConversion746 "" FORM "%8.4" "[]" FORMULA "1.0*X" FORMULA_INV "1.0*X" /end COMPU_METHOD
/begin COMPU_METHOD defaultConversion747 "" FORM "%8.4" "[]" FORMULA "1.0*X" FORMULA_INV "1.0*X" /end COMPU_METHOD
/begin COMPU_METHOD defaultConversion748 "" FORM "%8.4" "[]" FORMULA "1.0*X" FORMULA_INV "1.0*X" /end COMPU_METHOD
/begin COMPU_METHOD defaultConversion749 "" FORM "%8.4" "[]" FORMULA "1.0*X" FORMULA_INV "1.0*X" /end COMPU_METHOD
/begin COMPU_METHOD defaultConversion750 "" FORM "%8.4" "[]" FORMULA "1.0*X" FORMULA_INV "1.0*X" /end COMPU_METHOD
/begin COMPU_METHOD defaultConversion751 "" FORM "%8.4" "[]" FORMULA "1.0*X" FORMULA_INV "1.0*X" /end COMPU_METHOD
/begin COMPU_METHOD defaultConversion752 "" FORM "%8.4" "[]" FORMULA "1.0*X" FORMULA_INV "1.0*X" /end COMPU_METHOD
/begin COMPU_METHOD defaultConversion753 "" FORM "%8.4" "[]" FORMULA "1.0*X" FORMULA_INV "1.0*X" /end COMPU_METHOD
/begin COMPU_METHOD LINEAR______0_100000__1H___25754 "" FORM "%6.2" "[s]" FORMULA "0.1*X+1.3877788e-017" FORMULA_INV "10.0*X-1.3877788e-016" /end COMPU_METHOD
/begin COMPU_METHOD LINEAR______0_000000__0H___25755 "" FORM "%6.2" "[s]" FORMULA "1.0*X" FORMULA_INV "1.0*X" /end COMPU_METHOD
/begin COMPU_METHOD LINEAR______0_000000__0H___3_000 "" FORM "%2.0" "[-]" FORMULA "1.0*X" FORMULA_INV "1.0*X" /end COMPU_METHOD
/begin COMPU_METHOD LINEAR______0_000000__0H___1_756 "" FORM "%2.0" "[]" FORMULA "1.0*X" FORMULA_INV "1.0*X" /end COMPU_METHOD
/begin COMPU_METHOD LINEAR_______18_000000__FFFFFFD0 "" FORM "%4.1" "[°KW]" FORMULA "0.375*X" FORMULA_INV "2.6666667*X" /end COMPU_METHOD
/begin COMPU_METHOD LINEAR_______31_250000__3000H757 "" FORM "%6.2" "[%]" FORMULA "0.0015258789*X-50.0" FORMULA_INV "655.36*X+32768.0" /end COMPU_METHOD
/begin COMPU_METHOD LINEAR______0_000000__0H___7_812 "" FORM "%5.3" "[%.]" FORMULA "0.01528865*X" FORMULA_INV "65.408*X" /end COMPU_METHOD
/begin COMPU_METHOD LINEAR______0_000000__0H___25758 "" FORM "%3.0" "[Anzahl]" FORMULA "1.0*X" FORMULA_INV "1.0*X" /end COMPU_METHOD
/begin COMPU_METHOD LINEAR______1_000000__1H___25759 "" FORM "%4.0" "[Anzahl]" FORMULA "1.0*X" FORMULA_INV "1.0*X" /end COMPU_METHOD
/begin COMPU_METHOD LINEAR______0_000000__8000H___31 "" FORM "%5.2" "[%]" FORMULA "0.0015258789*X-50.0" FORMULA_INV "655.36*X+32768.0" /end COMPU_METHOD
/begin COMPU_METHOD LINEAR______0_000000__0H___31760 "" FORM "%5.2" "[%]" FORMULA "0.0015258789*X" FORMULA_INV "655.36*X" /end COMPU_METHOD
/begin COMPU_METHOD LINEAR______0_000000__0H___31761 "" FORM "%6.2" "[%]" FORMULA "0.0015258789*X" FORMULA_INV "655.36*X" /end COMPU_METHOD
/begin COMPU_METHOD LINEAR______0_000015__1H___0_762 "" FORM "%7.5" "[-]" FORMULA "1.5258787e-005*X+4.1213453e-008" FORMULA_INV "65536.011*X-0.0027009653" /end COMPU_METHOD
/begin COMPU_METHOD MAF_KGH_16_RES763 "" FORM "%7.1" "[kg/h]" FORMULA "0.25*X" FORMULA_INV "4.0*X" /end COMPU_METHOD
/begin COMPU_METHOD LINEAR______0_000000__0H___25764 "" FORM "%4.0" "[* 20ms]" FORMULA "1.0*X" FORMULA_INV "1.0*X" /end COMPU_METHOD
/begin COMPU_METHOD LINEAR_______31_250000__3000H765 "" FORM "%5.2" "[%]" FORMULA "0.0015258789*X-50.0" FORMULA_INV "655.36*X+32768.0" /end COMPU_METHOD
/begin COMPU_METHOD LINEAR_______31_250000__3000H766 "" FORM "%5.1" "[%]" FORMULA "0.0015258789*X-50.0" FORMULA_INV "655.36*X+32768.0" /end COMPU_METHOD
/begin COMPU_METHOD LINEAR______0_000000__0H___0_767 "" FORM "%5.3" "[-]" FORMULA "0.0039062204*X" FORMULA_INV "256.00194*X" /end COMPU_METHOD
/begin COMPU_METHOD LINEAR______0_010000__1H___65768 "" FORM "%6.2" "[s]" FORMULA "0.0099999996*X+3.7247841e-010" FORMULA_INV "100.0*X-3.7247842e-008" /end COMPU_METHOD
/begin COMPU_METHOD LINEAR______0_000000__0H___65769 "" FORM "%6.0" "[* 20ms]" FORMULA "1.0*X" FORMULA_INV "1.0*X" /end COMPU_METHOD
/begin COMPU_METHOD LINEAR______0_000000__0H___31770 "" FORM "%5.1" "[%]" FORMULA "0.0015258789*X" FORMULA_INV "655.36*X" /end COMPU_METHOD
/begin COMPU_METHOD LINEAR______0_000000__0H___31771 "" FORM "%5.1" "[%]" FORMULA "0.0015258789*X" FORMULA_INV "655.36*X" /end COMPU_METHOD
/begin COMPU_METHOD LINEAR______0_000000__8000H__772 "" FORM "%4.1" "[%]" FORMULA "0.0015258789*X-50.0" FORMULA_INV "655.36*X+32768.0" /end COMPU_METHOD
/begin COMPU_METHOD LINEAR_______31_250000__3000H773 "" FORM "%6.1" "[%]" FORMULA "0.0015258789*X-50.0" FORMULA_INV "655.36*X+32768.0" /end COMPU_METHOD
/begin COMPU_METHOD LINEAR______0_000000__0H___63_75 "" FORM "%5.2" "[kg/h]" FORMULA "0.25*X" FORMULA_INV "4.0*X" /end COMPU_METHOD
/begin COMPU_METHOD LINEAR______0_000000__0H___5_426 "" FORM "%4.3" "[mg/Hub]" FORMULA "0.021278431*X" FORMULA_INV "46.995945*X" /end COMPU_METHOD
/begin COMPU_METHOD MAF_16_RES774 "" FORM "%8.3" "[mg/Hub]" FORMULA "0.021194781*X" FORMULA_INV "47.181425*X" /end COMPU_METHOD
/begin COMPU_METHOD MAF_KGH_16_RES775 "" FORM "%5.0" "[kg/h]" FORMULA "0.25*X" FORMULA_INV "4.0*X" /end COMPU_METHOD
/begin COMPU_METHOD LINEAR______0_000000__0H___694_5 "" FORM "%5.0" "[mg/Hub]" FORMULA "0.021195105*X" FORMULA_INV "47.180706*X" /end COMPU_METHOD
/begin COMPU_METHOD LINEAR______0_000000__0H___10776 "" FORM "%7.3" "[%/10ms]" FORMULA "0.0015259022*X" FORMULA_INV "655.35*X" /end COMPU_METHOD
/begin COMPU_METHOD LINEAR______0_000000__0H___11777 "" FORM "%5.1" "[_]" FORMULA "0.0018252077*X" FORMULA_INV "547.88285*X" /end COMPU_METHOD
/begin COMPU_METHOD MTC_NORM_16_RES778 "" FORM "%7.2" "[°DK]" FORMULA "0.0018310547*X" FORMULA_INV "546.13333*X" /end COMPU_METHOD
/begin COMPU_METHOD MTC_NORM_16_RES779 "" FORM "%7.3" "[°DK/10ms]" FORMULA "0.0018310547*X" FORMULA_INV "546.13333*X" /end COMPU_METHOD
/begin COMPU_METHOD LINEAR______0_000000__0H___11780 "" FORM "%6.3" "[°DK]" FORMULA "0.0018234531*X" FORMULA_INV "548.41004*X" /end COMPU_METHOD
/begin COMPU_METHOD LINEAR______0_000000__0H___0_781 "" FORM "%4.3" "" FORMULA "0.0039058823*X" FORMULA_INV "256.0241*X" /end COMPU_METHOD
/begin COMPU_METHOD LINEAR______0_000000__0H___0_782 "" FORM "%4.2" "[]" FORMULA "0.0039058823*X" FORMULA_INV "256.0241*X" /end COMPU_METHOD
/begin COMPU_METHOD LINEAR______0_000000__0H___25783 "" FORM "%6.3" "[-]" FORMULA "0.00390625*X" FORMULA_INV "256.0*X" /end COMPU_METHOD
/begin COMPU_METHOD LINEAR______0_000000__0H___1_784 "" FORM "%5.3" "[]" FORMULA "1.5259022e-005*X" FORMULA_INV "65535.0*X" /end COMPU_METHOD
/begin COMPU_METHOD LINEAR______0_000000__0H___25785 "" FORM "%5.0" "[U/min]" FORMULA "1.0*X" FORMULA_INV "1.0*X" /end COMPU_METHOD
/begin COMPU_METHOD IS_13_RES786 "" FORM "%6.1" "[U/min]" FORMULA "1.0*X" FORMULA_INV "1.0*X" /end COMPU_METHOD
/begin COMPU_METHOD LINEAR______0_000000__0H___25787 "" FORM "%3.0" "[U/min]" FORMULA "1.0*X" FORMULA_INV "1.0*X" /end COMPU_METHOD
/begin COMPU_METHOD LINEAR_______4080_000000__FFFFF0 "" FORM "%6.0" "[min-1]" FORMULA "1.0*X" FORMULA_INV "1.0*X" /end COMPU_METHOD
/begin COMPU_METHOD LINEAR______0_000000__0H___81788 "" FORM "%4.0" "[min-1]" FORMULA "1.0*X" FORMULA_INV "1.0*X" /end COMPU_METHOD
/begin COMPU_METHOD LINEAR______0_000000__0H___10789 "" FORM "%5.0" "[U/min]" FORMULA "1.0*X" FORMULA_INV "1.0*X" /end COMPU_METHOD
/begin COMPU_METHOD LINEAR______480_000000__FH___816 "" FORM "%4.0" "[1/min]" FORMULA "32.0*X" FORMULA_INV "0.03125*X" /end COMPU_METHOD
/begin COMPU_METHOD ES_8_RES790 "" FORM "%4.2" "[1/min]" FORMULA "32.0*X" FORMULA_INV "0.03125*X" /end COMPU_METHOD
/begin COMPU_METHOD LINEAR______0_000000__0H___5984_ "" FORM "%5.0" "[U/min]" FORMULA "32.0*X" FORMULA_INV "0.03125*X" /end COMPU_METHOD
/begin COMPU_METHOD LINEAR______480_000000__FH___791 "" FORM "%5.0" "[1/min]" FORMULA "32.0*X" FORMULA_INV "0.03125*X" /end COMPU_METHOD
/begin COMPU_METHOD LINEAR______0_000000__0H___81792 "" FORM "%4.0" "[1/min]" FORMULA "32.035294*X" FORMULA_INV "0.031215571*X" /end COMPU_METHOD
/begin COMPU_METHOD LINEAR______0_000000__0H___81793 "" FORM "%4.0" "[U/min]" FORMULA "1.0*X" FORMULA_INV "1.0*X" /end COMPU_METHOD
/begin COMPU_METHOD LINEAR______0_000000__0H___25_00 "" FORM "%4.1" "[%/200ms]" FORMULA "0.098039216*X" FORMULA_INV "10.2*X" /end COMPU_METHOD
/begin COMPU_METHOD LINEAR_______50_000000__0H___794 "" FORM "%4.1" "[%]" FORMULA "0.3906251*X-50.0" FORMULA_INV "2.5599994*X+127.99997" /end COMPU_METHOD
/begin COMPU_METHOD LINEAR______1824_000000__39H___8 "" FORM "%5.0" "[1/min]" FORMULA "32.0*X" FORMULA_INV "0.03125*X" /end COMPU_METHOD
/begin COMPU_METHOD LINEAR______0_000000__0H___25795 "" FORM "%4.0" "[[*100ms]]" FORMULA "1.0*X" FORMULA_INV "1.0*X" /end COMPU_METHOD
/begin COMPU_METHOD LINEAR______1_000000__1H___8160_ "" FORM "%5.0" "[U/min]" FORMULA "1.0*X" FORMULA_INV "1.0*X" /end COMPU_METHOD
/begin COMPU_METHOD LINEAR______0_000000__0H___99_84 "" FORM "%6.2" "[%]" FORMULA "0.39152941*X" FORMULA_INV "2.5540865*X" /end COMPU_METHOD
/begin COMPU_METHOD LINEAR_______4096_000000__FFFFFF "" FORM "%7.0" "[U/min/s]" FORMULA "32.0*X" FORMULA_INV "0.03125*X" /end COMPU_METHOD
/begin COMPU_METHOD LINEAR_______4096_000000__FFF796 "" FORM "%7.0" "[1/min/s]" FORMULA "32.0*X" FORMULA_INV "0.03125*X" /end COMPU_METHOD
/begin COMPU_METHOD LINEAR______0_000000__0H___81797 "" FORM "%8.3" "[1/min/10ms]" FORMULA "0.125*X" FORMULA_INV "8.0*X" /end COMPU_METHOD
/begin COMPU_METHOD LINEAR______0_000000__0H___5024_ "" FORM "%5.0" "[U/min]" FORMULA "32.0*X" FORMULA_INV "0.03125*X" /end COMPU_METHOD
/begin COMPU_METHOD LINEAR______1024_000000__20H___8 "" FORM "%5.0" "[1/min]" FORMULA "32.0*X" FORMULA_INV "0.03125*X" /end COMPU_METHOD
/begin COMPU_METHOD LINEAR______0_250000__1H___63_75 "" FORM "%5.2" "[U/min/10ms]" FORMULA "0.25*X" FORMULA_INV "4.0*X" /end COMPU_METHOD
/begin COMPU_METHOD LINEAR______0_031250__1H___7_798 "" FORM "%4.2" "[1/min/10ms]" FORMULA "0.03125*X" FORMULA_INV "32.0*X" /end COMPU_METHOD
/begin COMPU_METHOD LINEAR______0_000000__0H___95799 "" FORM "%4.2" "[°KW]" FORMULA "0.375*X" FORMULA_INV "2.6666667*X" /end COMPU_METHOD
/begin COMPU_METHOD LINEAR______0_000000__0H___95800 "" FORM "%5.2" "[_KW/U]" FORMULA "0.375*X" FORMULA_INV "2.6666667*X" /end COMPU_METHOD
/begin COMPU_METHOD LINEAR_______155_625000__FFH_801 "" FORM "%8.3" "[_KW]" FORMULA "-0.375*X-60.0" FORMULA_INV "-2.6666667*X-160.0" /end COMPU_METHOD
/begin COMPU_METHOD LINEAR______60_000000__0H___1802 "" FORM "%7.3" "[_KW]" FORMULA "0.375*X+60.0" FORMULA_INV "2.6666667*X-160.0" /end COMPU_METHOD
/begin COMPU_METHOD LINEAR______175_000000__0H___270 "" FORM "%5.1" "[°KW]" FORMULA "0.37490198*X+175.0" FORMULA_INV "2.6673638*X-466.78867" /end COMPU_METHOD
/begin COMPU_METHOD LINEAR______0_000000__0H___95803 "" FORM "%6.2" "[°KW]" FORMULA "0.375*X" FORMULA_INV "2.6666667*X" /end COMPU_METHOD
/begin COMPU_METHOD LINEAR______48_000000__FFFFFF80H "" FORM "%5.1" "[°KW]" FORMULA "-0.375*X" FORMULA_INV "-2.6666667*X" /end COMPU_METHOD
/begin COMPU_METHOD LINEAR_______48_000000__FFFFFF80 "" FORM "%5.1" "[°KW]" FORMULA "0.375*X" FORMULA_INV "2.6666667*X" /end COMPU_METHOD
/begin COMPU_METHOD LINEAR______0_000000__0H___0_804 "" FORM "%4.2" "[-]" FORMULA "0.0039062745*X" FORMULA_INV "255.99839*X" /end COMPU_METHOD
/begin COMPU_METHOD LINEAR______0_000000__0H___54805 "" FORM "%6.1" "[hPa]" FORMULA "0.082921489*X" FORMULA_INV "12.0596*X" /end COMPU_METHOD
/begin COMPU_METHOD LINEAR______0_000000__0H___11806 "" FORM "%6.2" "[°DK/100ms]" FORMULA "0.0018252077*X" FORMULA_INV "547.88285*X" /end COMPU_METHOD
/begin COMPU_METHOD LINEAR______0_000000__0H___25807 "" FORM "%7.4" "[V/A]" FORMULA "0.0039062486*X" FORMULA_INV "256.00009*X" /end COMPU_METHOD
/begin COMPU_METHOD LINEAR______0_000000__0H___25808 "" FORM "%7.3" "[Ohm]" FORMULA "0.0039062486*X" FORMULA_INV "256.00009*X" /end COMPU_METHOD
/begin COMPU_METHOD LINEAR______0_000000__0H___1_809 "" FORM "%5.3" "[-]" FORMULA "1.5259022e-005*X" FORMULA_INV "65535.0*X" /end COMPU_METHOD
/begin COMPU_METHOD LINEAR______0_000000__0H___3000_ "" FORM "%5.0" "[1/1000KW_Umdr.]" FORMULA "1.0*X" FORMULA_INV "1.0*X" /end COMPU_METHOD
/begin COMPU_METHOD LINEAR______2_000000__2H___255_0 "" FORM "%4.0" "[]" FORMULA "1.0*X" FORMULA_INV "1.0*X" /end COMPU_METHOD
/begin COMPU_METHOD LINEAR______2_000000__2H___25810 "" FORM "%3.0" "[-]" FORMULA "1.0*X" FORMULA_INV "1.0*X" /end COMPU_METHOD
/begin COMPU_METHOD defaultConversion811 "" FORM "%8.4" "[]" FORMULA "1.0*X" FORMULA_INV "1.0*X" /end COMPU_METHOD
/begin COMPU_METHOD defaultConversion812 "" FORM "%8.4" "[]" FORMULA "1.0*X" FORMULA_INV "1.0*X" /end COMPU_METHOD
/begin COMPU_METHOD defaultConversion813 "" FORM "%8.4" "[]" FORMULA "1.0*X" FORMULA_INV "1.0*X" /end COMPU_METHOD
/begin COMPU_METHOD defaultConversion814 "" FORM "%8.4" "[]" FORMULA "1.0*X" FORMULA_INV "1.0*X" /end COMPU_METHOD
/begin COMPU_METHOD defaultConversion815 "" FORM "%8.4" "[]" FORMULA "1.0*X" FORMULA_INV "1.0*X" /end COMPU_METHOD
/begin COMPU_METHOD defaultConversion816 "" FORM "%8.4" "[]" FORMULA "1.0*X" FORMULA_INV "1.0*X" /end COMPU_METHOD
/begin COMPU_METHOD defaultConversion817 "" FORM "%8.4" "[]" FORMULA "1.0*X" FORMULA_INV "1.0*X" /end COMPU_METHOD
/begin COMPU_METHOD defaultConversion818 "" FORM "%8.4" "[]" FORMULA "1.0*X" FORMULA_INV "1.0*X" /end COMPU_METHOD
/begin COMPU_METHOD defaultConversion819 "" FORM "%8.4" "[]" FORMULA "1.0*X" FORMULA_INV "1.0*X" /end COMPU_METHOD
/begin COMPU_METHOD defaultConversion820 "" FORM "%8.4" "[]" FORMULA "1.0*X" FORMULA_INV "1.0*X" /end COMPU_METHOD
/begin COMPU_METHOD defaultConversion821 "" FORM "%8.4" "[]" FORMULA "1.0*X" FORMULA_INV "1.0*X" /end COMPU_METHOD
/begin COMPU_METHOD defaultConversion822 "" FORM "%8.4" "[]" FORMULA "1.0*X" FORMULA_INV "1.0*X" /end COMPU_METHOD
/begin COMPU_METHOD LINEAR_______8_192000__FFFFFF80H "" FORM "%5.2" "[ms]" FORMULA "0.064*X" FORMULA_INV "15.625*X" /end COMPU_METHOD
/begin COMPU_METHOD LINEAR______0_000000__0H___25823 "" FORM "%5.2" "[s]" FORMULA "0.01*X" FORMULA_INV "100.0*X" /end COMPU_METHOD
/begin COMPU_METHOD LINEAR______0_020000__1H___13824 "" FORM "%7.2" "[s]" FORMULA "0.02*X" FORMULA_INV "50.0*X" /end COMPU_METHOD
/begin COMPU_METHOD LINEAR______0_100000__1H___65825 "" FORM "%6.1" "[s]" FORMULA "0.1*X+1.3877788e-017" FORMULA_INV "10.0*X-1.3877788e-016" /end COMPU_METHOD
/begin COMPU_METHOD LINEAR______0_100000__1H___25826 "" FORM "%5.2" "[s]" FORMULA "0.1*X+1.3877788e-017" FORMULA_INV "10.0*X-1.3877788e-016" /end COMPU_METHOD
/begin COMPU_METHOD LINEAR______0_100000__1H___65827 "" FORM "%6.2" "[s]" FORMULA "0.1*X+1.3877788e-017" FORMULA_INV "10.0*X-1.3877788e-016" /end COMPU_METHOD
/begin COMPU_METHOD LINEAR______0_000000__0H___10_00 "" FORM "%3.0" "[s]" FORMULA "1.0*X" FORMULA_INV "1.0*X" /end COMPU_METHOD
/begin COMPU_METHOD LINEAR______1000_000000__64H___2 "" FORM "%4.0" "[ms]" FORMULA "10.0*X" FORMULA_INV "0.1*X" /end COMPU_METHOD
/begin COMPU_METHOD LINEAR______1_000000__1H___25828 "" FORM "%4.0" "[s]" FORMULA "1.0*X" FORMULA_INV "1.0*X" /end COMPU_METHOD
/begin COMPU_METHOD LINEAR______0_000000__0H___65829 "" FORM "%5.0" "[s]" FORMULA "1.0*X" FORMULA_INV "1.0*X" /end COMPU_METHOD
/begin COMPU_METHOD LINEAR______0_000000__0H___1310_ "" FORM "%5.2" "[s]" FORMULA "0.019999999*X" FORMULA_INV "50.000002*X" /end COMPU_METHOD
/begin COMPU_METHOD LINEAR______1_000000__1H___25_50 "" FORM "%4.1" "[s]" FORMULA "0.096456693*X+0.90354331" FORMULA_INV "10.367347*X-9.3673469" /end COMPU_METHOD
/begin COMPU_METHOD LINEAR______0_000000__0H___2540_ "" FORM "%4.0" "[ms]" FORMULA "10.0*X" FORMULA_INV "0.1*X" /end COMPU_METHOD
/begin COMPU_METHOD LINEAR______1_000000__1H___25830 "" FORM "%5.1" "[s]" FORMULA "1.0*X" FORMULA_INV "1.0*X" /end COMPU_METHOD
/begin COMPU_METHOD LINEAR______2_000000__2H___254_0 "" FORM "%3.0" "[s]" FORMULA "1.0*X" FORMULA_INV "1.0*X" /end COMPU_METHOD
/begin COMPU_METHOD LINEAR______0_010000__1H___65831 "" FORM "%4.1" "[s]" FORMULA "0.0099999996*X+3.7247841e-010" FORMULA_INV "100.0*X-3.7247842e-008" /end COMPU_METHOD
/begin COMPU_METHOD LINEAR______10_000000__0H___2560 "" FORM "%4.0" "[ms]" FORMULA "10.0*X+10.0" FORMULA_INV "0.1*X-1.0" /end COMPU_METHOD
/begin COMPU_METHOD LINEAR______10_000000__0H___450_ "" FORM "%4.0" "[ms]" FORMULA "10.0*X+10.0" FORMULA_INV "0.1*X-1.0" /end COMPU_METHOD
/begin COMPU_METHOD LINEAR______2_000000__1H___65536 "" FORM "%6.2" "[s]" FORMULA "1.0*X+1.0" FORMULA_INV "1.0*X-1.0" /end COMPU_METHOD
/begin COMPU_METHOD LINEAR______0_100000__1H___25832 "" FORM "%3.0" "[s]" FORMULA "0.1*X+1.3877788e-017" FORMULA_INV "10.0*X-1.3877788e-016" /end COMPU_METHOD
/begin COMPU_METHOD LINEAR______1_000000__1H___25833 "" FORM "%4.0" "[sec]" FORMULA "1.0*X" FORMULA_INV "1.0*X" /end COMPU_METHOD
/begin COMPU_METHOD LINEAR______10_000000__1H___2834 "" FORM "%4.0" "[ms]" FORMULA "10.0*X" FORMULA_INV "0.1*X" /end COMPU_METHOD
/begin COMPU_METHOD LINEAR______0_000000__0H___20_40 "" FORM "%5.2" "[s]" FORMULA "0.08*X" FORMULA_INV "12.5*X" /end COMPU_METHOD
/begin COMPU_METHOD LINEAR______0_000000__0H___25835 "" FORM "%3.0" "[s]" FORMULA "1.0*X" FORMULA_INV "1.0*X" /end COMPU_METHOD
/begin COMPU_METHOD LINEAR______100_000000__1H___100 "" FORM "%7.0" "[ms]" FORMULA "100.0*X" FORMULA_INV "0.01*X" /end COMPU_METHOD
/begin COMPU_METHOD LINEAR______0_010000__1H___2_550 "" FORM "%4.2" "[s]" FORMULA "0.01*X" FORMULA_INV "100.0*X" /end COMPU_METHOD
/begin COMPU_METHOD LINEAR______0_200000__0H___51_00 "" FORM "%4.1" "[s]" FORMULA "0.2*X+0.2" FORMULA_INV "5.0*X-1.0" /end COMPU_METHOD
/begin COMPU_METHOD LINEAR______0_200000__1H___51_00 "" FORM "%4.1" "[s]" FORMULA "0.2*X+2.7755576e-017" FORMULA_INV "5.0*X-1.3877788e-016" /end COMPU_METHOD
/begin COMPU_METHOD LINEAR______0_100000__1H___10_00 "" FORM "%3.1" "[s]" FORMULA "0.1*X" FORMULA_INV "10.0*X" /end COMPU_METHOD
/begin COMPU_METHOD LINEAR______0_000000__0H___25836 "" FORM "%4.1" "[sec]" FORMULA "0.1*X" FORMULA_INV "10.0*X" /end COMPU_METHOD
/begin COMPU_METHOD LINEAR______0_000000__0H___65837 "" FORM "%4.0" "[s]" FORMULA "0.1*X" FORMULA_INV "10.0*X" /end COMPU_METHOD
/begin COMPU_METHOD LINEAR______1_000000__1H___25838 "" FORM "%4.1" "[sec]" FORMULA "1.0*X" FORMULA_INV "1.0*X" /end COMPU_METHOD
/begin COMPU_METHOD LINEAR_______50_000000__FFFFFF80 "" FORM "%5.1" "[%]" FORMULA "0.39062745*X+0.00031403169" FORMULA_INV "2.5599839*X-0.00080391607" /end COMPU_METHOD
/begin COMPU_METHOD LINEAR_______50_000000__FFFFF839 "" FORM "%6.2" "[%]" FORMULA "0.39062745*X+0.00031403169" FORMULA_INV "2.5599839*X-0.00080391607" /end COMPU_METHOD
/begin COMPU_METHOD LINEAR______0_020000__1H___5_100 "" FORM "%4.2" "[s]" FORMULA "0.02*X+3.9370078e-010" FORMULA_INV "50.000001*X-1.968504e-008" /end COMPU_METHOD
/begin COMPU_METHOD LINEAR______0_020000__1H___25_50 "" FORM "%4.1" "[s]" FORMULA "0.02*X" FORMULA_INV "50.0*X" /end COMPU_METHOD
/begin COMPU_METHOD LINEAR______0_100000__1H___65840 "" FORM "%6.1" "[sec]" FORMULA "0.1*X+1.3877788e-017" FORMULA_INV "10.0*X-1.3877788e-016" /end COMPU_METHOD
/begin COMPU_METHOD TI_AS "" FORM "%5.3" "[-]" FORMULA "0.0078125*X" FORMULA_INV "128.0*X" /end COMPU_METHOD
/begin COMPU_METHOD LINEAR______0_000000__0H___25841 "" FORM "%4.0" "[s]" FORMULA "10.0*X" FORMULA_INV "0.1*X" /end COMPU_METHOD
/begin COMPU_METHOD LINEAR______0_020000__1H___10_00 "" FORM "%5.2" "[s]" FORMULA "0.02*X" FORMULA_INV "50.0*X" /end COMPU_METHOD
/begin COMPU_METHOD LINEAR______0_000000__0H___65842 "" FORM "%5.2" "[s]" FORMULA "0.0099999996*X" FORMULA_INV "100.0*X" /end COMPU_METHOD
/begin COMPU_METHOD LINEAR______0_100000__0H___25_50 "" FORM "%4.1" "[s]" FORMULA "0.1*X+0.1" FORMULA_INV "10.0*X-1.0" /end COMPU_METHOD
/begin COMPU_METHOD LINEAR______1_000000__1H___65535 "" FORM "%6.0" "[sec]" FORMULA "1.0*X" FORMULA_INV "1.0*X" /end COMPU_METHOD
/begin COMPU_METHOD LINEAR______0_000000__0H___327_6 "" FORM "%6.2" "[s]" FORMULA "0.02*X" FORMULA_INV "50.0*X" /end COMPU_METHOD
/begin COMPU_METHOD LINEAR______0_000000__0H___32843 "" FORM "%6.2" "[s]" FORMULA "0.01*X" FORMULA_INV "100.0*X" /end COMPU_METHOD
/begin COMPU_METHOD LINEAR______0_000000__0H___15_93 "" FORM "%5.2" "[-]" FORMULA "0.0625*X" FORMULA_INV "16.0*X" /end COMPU_METHOD
/begin COMPU_METHOD LINEAR______1_000000__1H___65534 "" FORM "%8.3" "[s]" FORMULA "1.0*X" FORMULA_INV "1.0*X" /end COMPU_METHOD
/begin COMPU_METHOD LINEAR______0_000000__0H___12844 "" FORM "%4.1" "[s]" FORMULA "0.5*X" FORMULA_INV "2.0*X" /end COMPU_METHOD
/begin COMPU_METHOD LINEAR______0_100000__1H___25845 "" FORM "%5.1" "[s]" FORMULA "0.1*X+1.3877788e-017" FORMULA_INV "10.0*X-1.3877788e-016" /end COMPU_METHOD
/begin COMPU_METHOD LINEAR______0_000000__0H___190_5 "" FORM "%5.1" "[°C/500ms]" FORMULA "0.75*X" FORMULA_INV "1.3333333*X" /end COMPU_METHOD
/begin COMPU_METHOD LINEAR______0_000000__0H___19846 "" FORM "%3.0" "[°C]" FORMULA "0.75*X" FORMULA_INV "1.3333333*X" /end COMPU_METHOD
/begin COMPU_METHOD LINEAR______0_000000__0H___49_99 "" FORM "%4.1" "[%]" FORMULA "0.0015258797*X" FORMULA_INV "655.35965*X" /end COMPU_METHOD
/begin COMPU_METHOD LINEAR_______50_000000__FFFF8000 "" FORM "%4.1" "[%]" FORMULA "0.0015258789*X" FORMULA_INV "655.36*X" /end COMPU_METHOD
/begin COMPU_METHOD LINEAR______0_097700__1H___24_90 "" FORM "%4.1" "[%/40ms]" FORMULA "0.097654726*X+4.5273898e-005" FORMULA_INV "10.24016*X-0.00046361195" /end COMPU_METHOD
/begin COMPU_METHOD LINEAR______0_000000__0H___24_90 "" FORM "%4.1" "[%/40ms]" FORMULA "0.097654904*X" FORMULA_INV "10.240141*X" /end COMPU_METHOD
/begin COMPU_METHOD LINEAR______0_0066100__1H___1_55 "" FORM "%5.3" "[%/10ms]" FORMULA "0.0061015354*X+0.00050846457" FORMULA_INV "163.89317*X-0.083333871" /end COMPU_METHOD
/begin COMPU_METHOD LINEAR______0_000000__0H___99847 "" FORM "%4.1" "[%]" FORMULA "0.0015258793*X" FORMULA_INV "655.35985*X" /end COMPU_METHOD
/begin COMPU_METHOD LINEAR______0_000000__0H___99848 "" FORM "%4.1" "[%]" FORMULA "0.0015199512*X" FORMULA_INV "657.91587*X" /end COMPU_METHOD
/begin COMPU_METHOD LINEAR______0_000200__1H___6_248 "" FORM "%7.3" "[%/10ms]" FORMULA "0.0061137671*X-0.0059137671" FORMULA_INV "163.56527*X+0.96728695" /end COMPU_METHOD
/begin COMPU_METHOD LINEAR______0_000000__0H___99849 "" FORM "%7.3" "[%]" FORMULA "0.0015258789*X" FORMULA_INV "655.36*X" /end COMPU_METHOD
/begin COMPU_METHOD LINEAR_______50_000004__FFFF8000 "" FORM "%4.1" "[%]" FORMULA "0.0015258792*X+5.7245986e-006" FORMULA_INV "655.35988*X-0.0037516722" /end COMPU_METHOD
/begin COMPU_METHOD LINEAR______0_391000__1H___99_61 "" FORM "%4.1" "[%/s]" FORMULA "0.39062599*X+0.00037401335" FORMULA_INV "2.5599935*X-0.00095747175" /end COMPU_METHOD
/begin COMPU_METHOD LINEAR______0_000000__0H___99850 "" FORM "%6.2" "[%]" FORMULA "0.0015258789*X" FORMULA_INV "655.36*X" /end COMPU_METHOD
/begin COMPU_METHOD LINEAR______0_000000__0H___10851 "" FORM "%7.3" "[%]" FORMULA "0.0015259022*X" FORMULA_INV "655.35*X" /end COMPU_METHOD
/begin COMPU_METHOD LINEAR______0_000000__0H___99852 "" FORM "%5.2" "[%]" FORMULA "0.024414063*X" FORMULA_INV "40.959998*X" /end COMPU_METHOD
/begin COMPU_METHOD LINEAR_______33_000000__0H___853 "" FORM "%3.0" "[°C]" FORMULA "4.0*X-33.0" FORMULA_INV "0.25*X+8.25" /end COMPU_METHOD
/begin COMPU_METHOD LINEAR_______33_000000__0H___854 "" FORM "%6.2" "[°C]" FORMULA "0.015609979*X-33.0" FORMULA_INV "64.061584*X+2114.0323" /end COMPU_METHOD
/begin COMPU_METHOD LINEAR______0_000000__0H___0_855 "" FORM "%5.3" "[-/120°KW]" FORMULA "0.00048827451*X" FORMULA_INV "2048.0283*X" /end COMPU_METHOD
/begin COMPU_METHOD LINEAR______0_000000__0H___0_856 "" FORM "%5.3" "[-/120°KW]" FORMULA "0.0019531373*X" FORMULA_INV "511.99679*X" /end COMPU_METHOD
/begin COMPU_METHOD LINEAR______0_000000__0H___10857 "" FORM "%4.2" "[ms]" FORMULA "0.004*X" FORMULA_INV "250.0*X" /end COMPU_METHOD
/begin COMPU_METHOD LINEAR______0_000000__8000H___5_ "" FORM "%4.2" "[ms]" FORMULA "0.004*X-131.072" FORMULA_INV "250.0*X+32768.0" /end COMPU_METHOD
/begin COMPU_METHOD LINEAR_______5_000000__7B1EH___0 "" FORM "%5.2" "[ms]" FORMULA "0.004*X-131.072" FORMULA_INV "250.0*X+32768.0" /end COMPU_METHOD
/begin COMPU_METHOD LINEAR______0_000000__0H___10858 "" FORM "%4.1" "[%]" FORMULA "0.0015260186*X" FORMULA_INV "655.3*X" /end COMPU_METHOD
/begin COMPU_METHOD LINEAR______0_000000__8000H__859 "" FORM "%6.2" "[%]" FORMULA "0.0015258789*X-50.0" FORMULA_INV "655.36*X+32768.0" /end COMPU_METHOD
/begin COMPU_METHOD LINEAR_______31_250000__3000H860 "" FORM "%6.2" "[%]" FORMULA "0.0015258789*X-50.0" FORMULA_INV "655.36*X+32768.0" /end COMPU_METHOD
/begin COMPU_METHOD LINEAR______0_000000__0H___131_0 "" FORM "%6.2" "[ms]" FORMULA "0.004*X" FORMULA_INV "250.0*X" /end COMPU_METHOD
/begin COMPU_METHOD LINEAR_______131_072000__FFFF800 "" FORM "%7.2" "[ms]" FORMULA "0.004*X" FORMULA_INV "250.0*X" /end COMPU_METHOD
/begin COMPU_METHOD LINEAR______0_000000__0H___0_500 "" FORM "%5.3" "[-]" FORMULA "0.00390625*X" FORMULA_INV "256.0*X" /end COMPU_METHOD
/begin COMPU_METHOD LINEAR______0_000000__0H___1_861 "" FORM "%5.3" "[]" FORMULA "0.00024414063*X" FORMULA_INV "4096.0*X" /end COMPU_METHOD
/begin COMPU_METHOD LINEAR______0_000000__0H___2_984 "" FORM "%5.3" "[]" FORMULA "0.00024414267*X" FORMULA_INV "4095.9657*X" /end COMPU_METHOD
/begin COMPU_METHOD LINEAR______0_003900__1H___0_996 "" FORM "%5.3" "[-]" FORMULA "0.0039059055*X-5.9054724e-006" FORMULA_INV "256.02258*X+0.0015119343" /end COMPU_METHOD
/begin COMPU_METHOD TI_BAS_16_RES862 "" FORM "%7.3" "[ms]" FORMULA "0.004*X" FORMULA_INV "250.0*X" /end COMPU_METHOD
/begin COMPU_METHOD LINEAR______0_000000__0H___51000 "" FORM "%5.0" "[ms]" FORMULA "200.0*X" FORMULA_INV "0.005*X" /end COMPU_METHOD
/begin COMPU_METHOD LINEAR_______48_000000__FFFFFFC0 "" FORM "%5.1" "[°C]" FORMULA "0.75*X" FORMULA_INV "1.3333333*X" /end COMPU_METHOD
/begin RECORD_LAYOUT a_172 FNC_VALUES 1 SWORD ROW_DIR DIRECT /end RECORD_LAYOUT
/begin RECORD_LAYOUT a_173 FNC_VALUES 1 UBYTE ROW_DIR DIRECT /end RECORD_LAYOUT
/begin RECORD_LAYOUT a_174 FNC_VALUES 1 UWORD ROW_DIR DIRECT /end RECORD_LAYOUT
/begin RECORD_LAYOUT a_175 FNC_VALUES 1 SBYTE ROW_DIR DIRECT /end RECORD_LAYOUT
/begin RECORD_LAYOUT a_189 FNC_VALUES 1 SLONG ROW_DIR DIRECT /end RECORD_LAYOUT
/end MODULE
/end PROJECT
