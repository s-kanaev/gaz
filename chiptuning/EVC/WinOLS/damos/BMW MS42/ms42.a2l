ASAP2_VERSION 1 2
/begin PROJECT Z42D "011"
/begin HEADER "" VERSION "0AD.03" PROJECT_NO Z011 /end HEADER
/begin MODULE BMW-EASY ""
/begin MOD_PAR "memory layout" VERSION "" SUPPLIER "" CUSTOMER "" CUSTOMER_NO "" USER "" CPU_TYPE "SIEMENS 80C167 CR" MEMORY_LAYOUT PRG_DATA 0x108000 0x8000 -1 -1 -1 -1 -1 MEMORY_LAYOUT PRG_CODE 0x110000 0x8000 -1 -1 -1 -1 -1 MEMORY_LAYOUT PRG_CODE 0x118000 0x8000 -1 -1 -1 -1 -1 MEMORY_LAYOUT PRG_CODE 0x120000 0x8000 -1 -1 -1 -1 -1 MEMORY_LAYOUT PRG_CODE 0x128000 0x8000 -1 -1 -1 -1 -1 MEMORY_LAYOUT PRG_CODE 0x130000 0x8000 -1 -1 -1 -1 -1 MEMORY_LAYOUT PRG_CODE 0x138000 0x8000 -1 -1 -1 -1 -1 /end MOD_PAR
/begin MOD_COMMON "common attributes" DEPOSIT ABSOLUT BYTE_ORDER BIG_ENDIAN /end MOD_COMMON
/begin CHARACTERISTIC id_maf_tab "TAB_LMM" MAP 0x4970e a_1 100 LINEAR______0_000000__0H___65535 0.0 65535.0 READ_ONLY
 /begin AXIS_DESCR COM_AXIS dummy LINEAR______0_000000__0H___255_0 16 0.0 255.0 AXIS_PTS_REF sst_tab_lmm_2 MAX_GRAD 100 MONOTONY MON_INCREASE /end AXIS_DESCR
 /begin AXIS_DESCR COM_AXIS dummy LINEAR______0_000000__0H___255_0 16 0.0 255.0 AXIS_PTS_REF sst_tab_lmm_1 MAX_GRAD 100 MONOTONY MON_INCREASE /end AXIS_DESCR
/end CHARACTERISTIC
/begin CHARACTERISTIC kf_abr_pwg_dif_neg__pwg_max__n "KF_ABR_PWG_DIF_NEG" MAP 0x4ccf4 a_2 100 LINEAR______0_000000__0H___0_498 0.0 0.49805
 /begin AXIS_DESCR COM_AXIS n_32 ES_8_RES 8 0.0 8160.0 AXIS_PTS_REF sstm_n_8_1 MAX_GRAD 100 MONOTONY MON_INCREASE /end AXIS_DESCR
 /begin AXIS_DESCR COM_AXIS pwg_max MTC_NORM_16_RES 12 0.0 119.99817 AXIS_PTS_REF sstm_pwg_max_12_1 MAX_GRAD 100 MONOTONY MON_INCREASE /end AXIS_DESCR
/end CHARACTERISTIC
/begin CHARACTERISTIC kf_ad_gmw_max_llfs_diag__tallfs "KF_AD_GMW_MAX_LLFS_DIAG" CURVE 0x4cd54 a_3 10 LINEAR______0_000000__0H___3_984 0.0 3.984375
 /begin AXIS_DESCR COM_AXIS tallfs LINEAR______0_000000__0H___99_61 4 0.0 99.610001 AXIS_PTS_REF sstm_tallfs_4_1 MAX_GRAD 100 MONOTONY MON_INCREASE /end AXIS_DESCR
/end CHARACTERISTIC
/begin CHARACTERISTIC kf_ad_gmw_min_llfs_diag__tallfs "KF_AD_GMW_MIN_LLFS_DIAG" CURVE 0x4cd58 a_3 10 LINEAR______0_000000__0H___3_984 0.0 3.984375
 /begin AXIS_DESCR COM_AXIS tallfs LINEAR______0_000000__0H___99_61 4 0.0 99.610001 AXIS_PTS_REF sstm_tallfs_4_1 MAX_GRAD 100 MONOTONY MON_INCREASE /end AXIS_DESCR
/end CHARACTERISTIC
/begin CHARACTERISTIC kf_add_ers_kat_el__toel__tumg "KF_ADD_ERS_KAT_EL" MAP 0x4cd5c a_4 100 LINEAR_______33_000000__0H___987 -33.0 987.0
 /begin AXIS_DESCR COM_AXIS tumg LINEAR_______128_000000__0H___12 6 -128.0 127.0 AXIS_PTS_REF sst_tumg_kf_add_ers_kat_el MAX_GRAD 100 MONOTONY MON_INCREASE /end AXIS_DESCR
 /begin AXIS_DESCR COM_AXIS toel LINEAR_______48_000000__0H___155 6 -48.0 155.0 AXIS_PTS_REF sst_toel_kf_add_ers_kat_el MAX_GRAD 100 MONOTONY MON_INCREASE /end AXIS_DESCR
/end CHARACTERISTIC
/begin CHARACTERISTIC kf_add_m_reib__toel "KF_ADD_M_REIB" CURVE 0x4cd80 a_3 100 LINEAR______0_000000__0H___255_5 0.0 255.0
 /begin AXIS_DESCR COM_AXIS toel LINEAR_______48_000000__0H___156 8 -48.0 155.0 AXIS_PTS_REF sst_toel_kf_add_m_reib MAX_GRAD 100 MONOTONY MON_INCREASE /end AXIS_DESCR
/end CHARACTERISTIC
/begin CHARACTERISTIC kf_add_m_reib_kk__can_lm_kk "KF_ADD_M_REIB_KK" CURVE 0x4cd88 a_3 100 LINEAR______0_000000__0H___255_5 0.0 255.0
 /begin AXIS_DESCR COM_AXIS dummy LINEAR______0_000000__0H___31_00 4 0.0 31.0 AXIS_PTS_REF sstm_can_lm_kk_4_1 MAX_GRAD 100 MONOTONY MON_INCREASE /end AXIS_DESCR
/end CHARACTERISTIC
/begin CHARACTERISTIC kf_be_anst_fak_fgr__t_anst_fgr "KF_BE_ANST_FAK_FGR" CURVE 0x4cd96 a_3 10 LINEAR______0_000000__0H___1_992 0.0 1.9922
 /begin AXIS_DESCR COM_AXIS t_anst_fgr LINEAR______0_000000__0H___25_50 5 0.0 25.5 AXIS_PTS_REF sstm_t_anst_fgr MAX_GRAD 100 MONOTONY MON_INCREASE /end AXIS_DESCR
/end CHARACTERISTIC
/begin CHARACTERISTIC kf_dec_roz__n "KF_DEC_ROZ" CURVE 0x4990e a_7 10 LINEAR______0_000000__0H___0_999 0.0 0.99998474
 /begin AXIS_DESCR COM_AXIS n_32 ES_8_RES8 4 0.0 8160.0 AXIS_PTS_REF sstm_n_kf_aebg_roz MAX_GRAD 100 MONOTONY MON_INCREASE /end AXIS_DESCR
/end CHARACTERISTIC
/begin CHARACTERISTIC kf_dk_dif_auf__pwg_ist_roh "KF_DK_DIF_AUF" CURVE 0x49916 a_9 100 MTC_NORM_16_RES10 0.0 119.99817
 /begin AXIS_DESCR COM_AXIS pwg_ist_roh MTC_NORM_16_RES10 4 0.0 119.99817 AXIS_PTS_REF sstm_pwg_ist_roh_4_2 MAX_GRAD 100 MONOTONY MON_INCREASE /end AXIS_DESCR
/end CHARACTERISTIC
/begin CHARACTERISTIC kf_dk_dif_zu__pwg_ist_roh "KF_DK_DIF_ZU" CURVE 0x4991e a_9 100 MTC_NORM_16_RES10 0.0 119.99817
 /begin AXIS_DESCR COM_AXIS pwg_ist_roh MTC_NORM_16_RES10 4 0.0 119.99817 AXIS_PTS_REF sstm_pwg_ist_roh_4_2 MAX_GRAD 100 MONOTONY MON_INCREASE /end AXIS_DESCR
/end CHARACTERISTIC
/begin CHARACTERISTIC kf_dk_ers__n__lm_dk_diag "KF_DK_ERS" MAP 0x4cda0 a_11 25 PVS_NORM_8_RES 0.0 119.5
 /begin AXIS_DESCR COM_AXIS dummy MAF_KGH_16_RES 8 0.0 16383.75 AXIS_PTS_REF sst_lm_dk_diag_kf_dk_ers MAX_GRAD 100 MONOTONY MON_INCREASE /end AXIS_DESCR
 /begin AXIS_DESCR COM_AXIS drehzahl ES_8_RES8 6 0.0 8160.0 AXIS_PTS_REF sst_n_kf_dk_ers MAX_GRAD 100 MONOTONY MON_INCREASE /end AXIS_DESCR
/end CHARACTERISTIC
/begin CHARACTERISTIC kf_dk_grd_max_lu_neg__pwg_max "KF_DK_GRD_MAX_LU_NEG" CURVE 0x4cdd0 a_3 5 LINEAR______0_000000__0H___2988_ 0.0 2988.0
 /begin AXIS_DESCR COM_AXIS pwg_max MTC_NORM_8_RES 6 0.0 119.53125 AXIS_PTS_REF sstm_pwg_max_6_1 MAX_GRAD 100 MONOTONY MON_INCREASE /end AXIS_DESCR
/end CHARACTERISTIC
/begin CHARACTERISTIC kf_dk_grd_max_lu_pos__pwg_max "KF_DK_GRD_MAX_LU_POS" CURVE 0x4cdd6 a_3 5 LINEAR______0_000000__0H___2988_ 0.0 2988.0
 /begin AXIS_DESCR COM_AXIS pwg_max MTC_NORM_8_RES 6 0.0 119.53125 AXIS_PTS_REF sstm_pwg_max_6_1 MAX_GRAD 100 MONOTONY MON_INCREASE /end AXIS_DESCR
/end CHARACTERISTIC
/begin CHARACTERISTIC kf_dummy__dummy1 "KF_DUMMY" CURVE 0x4cddc a_3 100 LINEAR_______48_000000__0H___142 -48.0 142.5
 /begin AXIS_DESCR COM_AXIS tkw LINEAR_______48_000000__0H___112 8 -48.0 142.5 AXIS_PTS_REF sst_dummy1_kf_dummy MAX_GRAD 100 MONOTONY MON_INCREASE /end AXIS_DESCR
/end CHARACTERISTIC
/begin CHARACTERISTIC kf_ebw_st__n__ti "KF_EBW_ST" MAP 0x4cde4 a_11 10 LINEAR_______180_000000__0H___50 -180.0 504.0
 /begin AXIS_DESCR COM_AXIS ti_ges TI_BAS_16_RES 4 0.0 262.14 AXIS_PTS_REF sst_ti_kf_ebw_st MAX_GRAD 100 MONOTONY MON_INCREASE /end AXIS_DESCR
 /begin AXIS_DESCR COM_AXIS drehzahl ES_8_RES8 4 0.0 8160.0 AXIS_PTS_REF sst_n_kf_ebw_st MAX_GRAD 100 MONOTONY MON_INCREASE /end AXIS_DESCR
/end CHARACTERISTIC
/begin CHARACTERISTIC kf_ebw_tkw1_ll__n__ti "KF_EBW_TKW1_LL" MAP 0x4cdf4 a_13 10 LINEAR_______180_000000__0H___50 -180.0 504.0
 /begin AXIS_DESCR COM_AXIS ti_ges TI_BAS_16_RES 6 0.0 262.14 AXIS_PTS_REF sstm_ti_ebw_van MAX_GRAD 100 MONOTONY MON_INCREASE /end AXIS_DESCR
 /begin AXIS_DESCR COM_AXIS drehzahl IS_13_RES 6 0.0 8160.0 AXIS_PTS_REF sstm_n_1_28 MAX_GRAD 100 MONOTONY MON_INCREASE /end AXIS_DESCR
/end CHARACTERISTIC
/begin CHARACTERISTIC kf_ebw_tkw1_tl__n__ti "KF_EBW_TKW1_TL" MAP 0x4ce18 a_13 10 LINEAR_______180_000000__0H___50 -180.0 504.0
 /begin AXIS_DESCR COM_AXIS ti_ges TI_BAS_16_RES 10 0.0 262.14 AXIS_PTS_REF sstm_ti_1_2 MAX_GRAD 100 MONOTONY MON_INCREASE /end AXIS_DESCR
 /begin AXIS_DESCR COM_AXIS drehzahl IS_13_RES 8 0.0 8160.0 AXIS_PTS_REF sstm_n_1_2 MAX_GRAD 100 MONOTONY MON_INCREASE /end AXIS_DESCR
/end CHARACTERISTIC
/begin CHARACTERISTIC kf_ebw_tkw2_ll__n__ti "KF_EBW_TKW2_LL" MAP 0x4ce68 a_13 10 LINEAR_______180_000000__0H___50 -180.0 504.0
 /begin AXIS_DESCR COM_AXIS ti_ges TI_BAS_16_RES 6 0.0 262.14 AXIS_PTS_REF sstm_ti_ebw_van MAX_GRAD 100 MONOTONY MON_INCREASE /end AXIS_DESCR
 /begin AXIS_DESCR COM_AXIS drehzahl IS_13_RES 6 0.0 8160.0 AXIS_PTS_REF sstm_n_1_28 MAX_GRAD 100 MONOTONY MON_INCREASE /end AXIS_DESCR
/end CHARACTERISTIC
/begin CHARACTERISTIC kf_ebw_tkw2_tl__n__ti "KF_EBW_TKW2_TL" MAP 0x4ce8c a_13 10 LINEAR_______180_000000__0H___50 -180.0 504.0
 /begin AXIS_DESCR COM_AXIS ti_ges TI_BAS_16_RES 10 0.0 262.14 AXIS_PTS_REF sstm_ti_1_2 MAX_GRAD 100 MONOTONY MON_INCREASE /end AXIS_DESCR
 /begin AXIS_DESCR COM_AXIS drehzahl IS_13_RES 8 0.0 8160.0 AXIS_PTS_REF sstm_n_1_2 MAX_GRAD 100 MONOTONY MON_INCREASE /end AXIS_DESCR
/end CHARACTERISTIC
/begin CHARACTERISTIC kf_eew_ti_inst_van__n__nwist_e "KF_EEW_TI_INST_VAN" MAP 0x4cedc a_4 20 LINEAR______300_000000__14H___54 300.0 540.0
 /begin AXIS_DESCR COM_AXIS ivvt_ivpos_act LINEAR______60_000000__0H___155_ 6 60.0 155.625 AXIS_PTS_REF sst_nwist_e_eew_ti_inst_van MAX_GRAD 100 MONOTONY MON_INCREASE /end AXIS_DESCR
 /begin AXIS_DESCR COM_AXIS drehzahl ES_8_RES8 6 0.0 8160.0 AXIS_PTS_REF sstm_n_12_7 MAX_GRAD 100 MONOTONY MON_INCREASE /end AXIS_DESCR
/end CHARACTERISTIC
/begin CHARACTERISTIC kf_eew_vti__tkw "KF_EEW_VTI" CURVE 0x4cf00 a_3 10 LINEAR______540_000000__0H___300 300.0 540.0
 /begin AXIS_DESCR COM_AXIS tkw LINEAR_______48_000000__0H___114 8 -48.0 142.5 AXIS_PTS_REF sstm_tkw_1_5 MAX_GRAD 100 MONOTONY MON_INCREASE /end AXIS_DESCR
/end CHARACTERISTIC
/begin CHARACTERISTIC kf_fak_dec_te__lm_kg_h "KF_FAK_DEC_TE" CURVE 0x49926 a_9 10 LINEAR______0_000000__0H___1_000 0.0 1.0
 /begin AXIS_DESCR COM_AXIS lm_kg_h MAF_KGH_16_RES15 8 0.0 16383.75 AXIS_PTS_REF sstm_lm_kg_h_1_10 MAX_GRAD 100 MONOTONY MON_INCREASE /end AXIS_DESCR
/end CHARACTERISTIC
/begin CHARACTERISTIC kf_fak_inc_te__lm_kg_h "KF_FAK_INC_TE" CURVE 0x49936 a_9 10 LINEAR______0_000000__0H___1_000 0.0 1.0
 /begin AXIS_DESCR COM_AXIS lm_kg_h MAF_KGH_16_RES15 8 0.0 16383.75 AXIS_PTS_REF sstm_lm_kg_h_1_10 MAX_GRAD 100 MONOTONY MON_INCREASE /end AXIS_DESCR
/end CHARACTERISTIC
/begin CHARACTERISTIC kf_fak_kat_diag_zv__kat_diag "KF_FAK_KAT_DIAG_ZV" CURVE 0x49946 a_9 100 LINEAR______0_000000__0H___0_916 0.0 0.99998474
 /begin AXIS_DESCR COM_AXIS dummy LINEAR______0_000000__0H___255_9 6 0.0 255.996 AXIS_PTS_REF sst_kat_diag_kf_fak_kat_diag MAX_GRAD 100 MONOTONY MON_INCREASE /end AXIS_DESCR
/end CHARACTERISTIC
/begin CHARACTERISTIC kf_fak_kr_0__n__lm "KF_FAK_KR - Zylinder 1" MAP 0x4cf08 a_4 3 LINEAR______0_000000__0H___7_968 0.0 7.9679999
 /begin AXIS_DESCR COM_AXIS lm_kr MAF_8_RES 4 0.0 1389.0 AXIS_PTS_REF sstm_lm_1_9 MAX_GRAD 100 MONOTONY MON_INCREASE /end AXIS_DESCR
 /begin AXIS_DESCR COM_AXIS n_kr ES_8_RES8 16 0.0 8160.0 AXIS_PTS_REF sstm_n_2_9 MAX_GRAD 100 MONOTONY MON_INCREASE /end AXIS_DESCR
/end CHARACTERISTIC
/begin CHARACTERISTIC kf_fak_kr_1__n__lm "KF_FAK_KR - Zylinder 5" MAP 0x4cf48 a_4 3 LINEAR______0_000000__0H___7_968 0.0 7.9679999
 /begin AXIS_DESCR COM_AXIS lm_kr MAF_8_RES 4 0.0 1389.0 AXIS_PTS_REF sstm_lm_1_9 MAX_GRAD 100 MONOTONY MON_INCREASE /end AXIS_DESCR
 /begin AXIS_DESCR COM_AXIS n_kr ES_8_RES8 16 0.0 8160.0 AXIS_PTS_REF sstm_n_2_9 MAX_GRAD 100 MONOTONY MON_INCREASE /end AXIS_DESCR
/end CHARACTERISTIC
/begin CHARACTERISTIC kf_fak_kr_2__n__lm "KF_FAK_KR - Zylinder 3" MAP 0x4cf88 a_4 3 LINEAR______0_000000__0H___7_968 0.0 7.9679999
 /begin AXIS_DESCR COM_AXIS lm_kr MAF_8_RES 4 0.0 1389.0 AXIS_PTS_REF sstm_lm_1_9 MAX_GRAD 100 MONOTONY MON_INCREASE /end AXIS_DESCR
 /begin AXIS_DESCR COM_AXIS n_kr ES_8_RES8 16 0.0 8160.0 AXIS_PTS_REF sstm_n_2_9 MAX_GRAD 100 MONOTONY MON_INCREASE /end AXIS_DESCR
/end CHARACTERISTIC
/begin CHARACTERISTIC kf_fak_kr_3__n__lm "KF_FAK_KR - Zylinder 6" MAP 0x4cfc8 a_4 3 LINEAR______0_000000__0H___7_968 0.0 7.9679999
 /begin AXIS_DESCR COM_AXIS lm_kr MAF_8_RES 4 0.0 1389.0 AXIS_PTS_REF sstm_lm_1_9 MAX_GRAD 100 MONOTONY MON_INCREASE /end AXIS_DESCR
 /begin AXIS_DESCR COM_AXIS n_kr ES_8_RES8 16 0.0 8160.0 AXIS_PTS_REF sstm_n_2_9 MAX_GRAD 100 MONOTONY MON_INCREASE /end AXIS_DESCR
/end CHARACTERISTIC
/begin CHARACTERISTIC kf_fak_kr_4__n__lm "KF_FAK_KR - Zylinder 2" MAP 0x4d008 a_4 3 LINEAR______0_000000__0H___7_968 0.0 7.9679999
 /begin AXIS_DESCR COM_AXIS lm_kr MAF_8_RES 4 0.0 1389.0 AXIS_PTS_REF sstm_lm_1_9 MAX_GRAD 100 MONOTONY MON_INCREASE /end AXIS_DESCR
 /begin AXIS_DESCR COM_AXIS n_kr ES_8_RES8 16 0.0 8160.0 AXIS_PTS_REF sstm_n_2_9 MAX_GRAD 100 MONOTONY MON_INCREASE /end AXIS_DESCR
/end CHARACTERISTIC
/begin CHARACTERISTIC kf_fak_kr_5__n__lm "KF_FAK _KR - Zylinder 4" MAP 0x4d048 a_4 3 LINEAR______0_000000__0H___7_968 0.0 7.9679999
 /begin AXIS_DESCR COM_AXIS lm_kr MAF_8_RES 4 0.0 1389.0 AXIS_PTS_REF sstm_lm_1_9 MAX_GRAD 100 MONOTONY MON_INCREASE /end AXIS_DESCR
 /begin AXIS_DESCR COM_AXIS n_kr ES_8_RES8 16 0.0 8160.0 AXIS_PTS_REF sstm_n_2_9 MAX_GRAD 100 MONOTONY MON_INCREASE /end AXIS_DESCR
/end CHARACTERISTIC
/begin CHARACTERISTIC kf_fak_kru_lu_at__n "KF_FAK_KRU_LU_AT" CURVE 0x49952 a_7 100 LINEAR______0_000000__0H___3_996 0.0 3.9960001
 /begin AXIS_DESCR COM_AXIS n_32 ES_8_RES17 4 0.0 8160.0 AXIS_PTS_REF sstm_n_kf_xxxx_kru_lu_at MAX_GRAD 100 MONOTONY MON_INCREASE /end AXIS_DESCR
/end CHARACTERISTIC
/begin CHARACTERISTIC kf_fak_kru_lu_mt__n "KF_FAK_KRU_LU_MT" CURVE 0x4995a a_7 100 LINEAR______0_000000__0H___3_996 0.0 3.9960001
 /begin AXIS_DESCR COM_AXIS n_32 ES_8_RES17 4 0.0 8160.0 AXIS_PTS_REF sstm_n_kf_xxxx_kru_lu_mt MAX_GRAD 100 MONOTONY MON_INCREASE /end AXIS_DESCR
/end CHARACTERISTIC
/begin CHARACTERISTIC kf_fak_lam_s__tkw "KF_FAK_LAM_S" CURVE 0x4d088 a_3 100 LINEAR______0_000000__0H___0_996 0.0 0.99610001
 /begin AXIS_DESCR COM_AXIS tkw LINEAR_______48_000000__0H___142 3 -48.0 142.5 AXIS_PTS_REF sst_tkw_kf_fak_lam_s MAX_GRAD 100 MONOTONY MON_INCREASE /end AXIS_DESCR
/end CHARACTERISTIC
/begin CHARACTERISTIC kf_fak_lm_ers_van__lm_ers_diag "KF_FAK_LM_ERS_VAN" CURVE 0x4d08b a_3 100 LINEAR______0_000000__0H___0_996 0.0 0.99610001
 /begin AXIS_DESCR COM_AXIS lm_ers_diag MAF_8_RES 6 0.0 1389.0 AXIS_PTS_REF sst_lm_ers_diag_kf_fak_lm_van MAX_GRAD 100 MONOTONY MON_INCREASE /end AXIS_DESCR
/end CHARACTERISTIC
/begin CHARACTERISTIC kf_fak_md_kat__pwg_ist "KF_FAK_MD_KAT" CURVE 0x49962 a_7 100 LINEAR______0_000000__0H___0_918 0.0 0.99998474
 /begin AXIS_DESCR COM_AXIS pwg_ist LINEAR______0_000000__0H___119_5 4 0.0 119.5 AXIS_PTS_REF sstm_pwg_ist_4_1 MAX_GRAD 100 MONOTONY MON_INCREASE /end AXIS_DESCR
/end CHARACTERISTIC
/begin CHARACTERISTIC kf_fak_md_kor__md_ind_asc "KF_FAK_MD_KOR" CURVE 0x4996a a_7 100 LINEAR______0_000000__0H___0_916 0.0 0.99998474
 /begin AXIS_DESCR COM_AXIS md_ind_asc LINEAR______0_000000__0H___100_0 4 0.0 100.0 AXIS_PTS_REF sst_md_ind_asc_kf_fak_md_kor MAX_GRAD 100 MONOTONY MON_INCREASE /end AXIS_DESCR
/end CHARACTERISTIC
/begin CHARACTERISTIC kf_fak_md_mdk_ob_diag__mdk_ist "KF_FAK_MD_MDK_OB_DIAG" CURVE 0x49972 a_9 100 LINEAR______0_000000__0H___64_00 0.0 64.0
 /begin AXIS_DESCR COM_AXIS mdk_ist MTC_NORM_16_RES 4 0.0 119.99817 AXIS_PTS_REF sstm_mdk_ist_4_1 MAX_GRAD 100 MONOTONY MON_INCREASE /end AXIS_DESCR
/end CHARACTERISTIC
/begin CHARACTERISTIC kf_fak_md_mdk_unt_diag__mdk_ist "KF_FAK_MD_MDK_UNT_DIAG" CURVE 0x4997a a_9 100 LINEAR______0_000000__0H___64_00 0.0 64.0
 /begin AXIS_DESCR COM_AXIS mdk_ist MTC_NORM_16_RES 4 0.0 119.99817 AXIS_PTS_REF sstm_mdk_ist_4_1 MAX_GRAD 100 MONOTONY MON_INCREASE /end AXIS_DESCR
/end CHARACTERISTIC
/begin CHARACTERISTIC kf_fak_md_pwg_ob_diag__pwg_ist "KF_FAK_MD_PWG_OB_DIAG" CURVE 0x49982 a_9 100 LINEAR______0_000000__0H___64_00 0.0 64.0
 /begin AXIS_DESCR COM_AXIS pwg_ist MTC_NORM_16_RES 4 0.0 119.99817 AXIS_PTS_REF sstm_pwg_ist_4_2 MAX_GRAD 100 MONOTONY MON_INCREASE /end AXIS_DESCR
/end CHARACTERISTIC
/begin CHARACTERISTIC kf_fak_md_pwg_unt_diag__pwg_ist "KF_FAK_MD_PWG_UNT_DIAG" CURVE 0x4998a a_9 100 LINEAR______0_000000__0H___64_00 0.0 64.0
 /begin AXIS_DESCR COM_AXIS pwg_ist MTC_NORM_16_RES 4 0.0 119.99817 AXIS_PTS_REF sstm_pwg_ist_4_2 MAX_GRAD 100 MONOTONY MON_INCREASE /end AXIS_DESCR
/end CHARACTERISTIC
/begin CHARACTERISTIC kf_fak_mdk_llfs__mdk_ist "KF_FAK_MDK_LLFS" CURVE 0x4d091 a_19 100 LINEAR______0_000000__0H___106_2 0.0 106.24
 /begin AXIS_DESCR COM_AXIS mdk_ist LINEAR______0_000000__0H___119_9 6 0.0 119.9982 AXIS_PTS_REF sst_mdk_ist_kf_fak_mdk_llfs MAX_GRAD 100 MONOTONY MON_INCREASE /end AXIS_DESCR
/end CHARACTERISTIC
/begin CHARACTERISTIC kf_fak_nsoll_add_ss__tkw "KF_FAK_NSOLL_ADD_SS" CURVE 0x4d097 a_3 100 LINEAR______0_000000__0H___0_920 0.0 0.99599999
 /begin AXIS_DESCR COM_AXIS tkw LINEAR_______48_000000__0H___121 6 -48.0 142.5 AXIS_PTS_REF sstm_tkw_1_6 MAX_GRAD 100 MONOTONY MON_INCREASE /end AXIS_DESCR
/end CHARACTERISTIC
/begin CHARACTERISTIC kf_fak_pq_llfs__tallfs "KF_FAK_PQ_LLFS" CURVE 0x4d09d a_19 10 LINEAR______0_000000__0H___1_922 0.0 1.992
 /begin AXIS_DESCR COM_AXIS tallfs LINEAR______0_000000__0H___99_99 4 0.0 99.998001 AXIS_PTS_REF sst_tallfs_kf_fak_pq_llfs MAX_GRAD 100 MONOTONY MON_INCREASE /end AXIS_DESCR
/end CHARACTERISTIC
/begin CHARACTERISTIC kf_fak_ramp_te__lamwdifte__fakte "KF_FAK_RAMP_TE" MAP 0x4d0a1 a_2 100 LINEAR______0_000000__0H___15_94 0.0 15.94
 /begin AXIS_DESCR COM_AXIS fak_te LINEAR______0_000000__0H___0_923 3 0.0 0.99610001 AXIS_PTS_REF sst_fak_te_kf_fak_ramp_te MAX_GRAD 100 MONOTONY MON_INCREASE /end AXIS_DESCR
 /begin AXIS_DESCR COM_AXIS lrvlammw_dif_te LINEAR_______50_000000__0H___49_ 3 -50.0 49.998501 AXIS_PTS_REF sst_lammw_dif_te_kf_fak_ramp_te MAX_GRAD 100 MONOTONY MON_INCREASE /end AXIS_DESCR
/end CHARACTERISTIC
/begin CHARACTERISTIC kf_fak_schw_ev_aus_lu__n "KF_FAK_SCHW_EV_AUS_LU" CURVE 0x49992 a_7 100 LINEAR______0_000000__0H___0_924 0.0 0.99997997
 /begin AXIS_DESCR COM_AXIS n_32 ES_8_RES 6 0.0 8160.0 AXIS_PTS_REF sst_n_kf_fak_schw_ev_aus_lu MAX_GRAD 100 MONOTONY MON_INCREASE /end AXIS_DESCR
/end CHARACTERISTIC
/begin CHARACTERISTIC kf_fak_schw_ll_lu_diag__tkw "KF_FAK_SCHW_LL_LU_DIAG (TKW)" CURVE 0x4d0aa a_3 10 LINEAR______1_000000__80H___1_99 1.0 1.992
 /begin AXIS_DESCR COM_AXIS tkw LINEAR_______48_000000__0H___142 8 -48.0 142.5 AXIS_PTS_REF sst_tkw_kf_fak_schw_ll_lu_diag MAX_GRAD 25 MONOTONY MON_INCREASE /end AXIS_DESCR
/end CHARACTERISTIC
/begin CHARACTERISTIC kf_fak_schw_lu__tkw "KF_FAK_SCHW_LU" CURVE 0x4999e a_7 5 LINEAR______1_000000__100H___1_9 1.0 1.9961
 /begin AXIS_DESCR COM_AXIS tkw LINEAR_______48_000000__0H___114 8 -48.0 142.5 AXIS_PTS_REF sst_tkw_schw_lu MAX_GRAD 100 MONOTONY MON_INCREASE /end AXIS_DESCR
/end CHARACTERISTIC
/begin CHARACTERISTIC kf_fak_schw_lu_kat__zwdifkt3 "KF_FAK_SCHW_LU_KAT" CURVE 0x4d0b2 a_3 5 LINEAR______0_003900__0H___1_000 0.0039 1.0
 /begin AXIS_DESCR COM_AXIS zw_kat3 LINEAR_______48_000000__0H___0_0 4 -48.0 0.0 AXIS_PTS_REF sst_zwdifkt3_schw_lu MAX_GRAD 100 MONOTONY MON_INCREASE /end AXIS_DESCR
/end CHARACTERISTIC
/begin CHARACTERISTIC kf_fak_t_kk_inc__n "KF_FAK_T_KK_INC" CURVE 0x499ae a_9 5 LINEAR______0_000200__1H___0_062 0.0002 0.06248
 /begin AXIS_DESCR COM_AXIS drehzahl LINEAR______0_000000__0H___8160_ 4 0.0 8160.0 AXIS_PTS_REF sst_n_kf_fak_t_kk_inc MAX_GRAD 25 /end AXIS_DESCR
/end CHARACTERISTIC
/begin CHARACTERISTIC kf_fak_tal_tkw__tkw__tal "KF_FAK_TAL_TKW" MAP 0x4d0b6 a_4 5 LINEAR______0_000000__0H___0_925 0.0 0.99599999
 /begin AXIS_DESCR COM_AXIS tal LINEAR_______48_000000__0H___114 6 -48.0 142.5 AXIS_PTS_REF sst_tal_kf_fak_tal_tkw MAX_GRAD 100 MONOTONY MON_INCREASE /end AXIS_DESCR
 /begin AXIS_DESCR COM_AXIS tkw LINEAR_______48_000000__0H___121 6 -48.0 142.5 AXIS_PTS_REF sst_tkw_kf_fak_tal_tkw MAX_GRAD 100 MONOTONY MON_INCREASE /end AXIS_DESCR
/end CHARACTERISTIC
/begin CHARACTERISTIC kf_fak_tal_tkw_kr_dg__tal__tkw "KF_FAK_TAL_TKW_KR_DG" MAP 0x4d0da a_4 100 LINEAR______0_003900__0H___1_026 0.0039 1.0
 /begin AXIS_DESCR COM_AXIS tkw LINEAR_______48_000000__0H___121 4 -48.0 142.5 AXIS_PTS_REF sst_tkw_kf_fak_tal_tkw_kr_dg MAX_GRAD 100 MONOTONY MON_INCREASE /end AXIS_DESCR
 /begin AXIS_DESCR COM_AXIS tal LINEAR_______48_000000__0H___121 4 -48.0 142.5 AXIS_PTS_REF sst_tal_kf_fak_tal_tkw_kr_dg MAX_GRAD 100 MONOTONY MON_INCREASE /end AXIS_DESCR
/end CHARACTERISTIC
/begin CHARACTERISTIC kf_fak_tal_tkw_ll__tkw__tal "KF_FAK_TAL_TKW_LL" MAP 0x4d0ea a_4 5 LINEAR______0_000000__0H___0_920 0.0 0.99599999
 /begin AXIS_DESCR COM_AXIS tal LINEAR_______48_000000__0H___121 4 -48.0 142.5 AXIS_PTS_REF sst_tal_kf_fak_tal_tkw_ll MAX_GRAD 100 MONOTONY MON_INCREASE /end AXIS_DESCR
 /begin AXIS_DESCR COM_AXIS tkw LINEAR_______48_000000__0H___121 4 -48.0 142.5 AXIS_PTS_REF sst_tkw_kf_fak_tal_tkw_ll MAX_GRAD 100 MONOTONY MON_INCREASE /end AXIS_DESCR
/end CHARACTERISTIC
/begin CHARACTERISTIC kf_fak_tamdk_min__lm_kgh__mdk "KF_FAK_TAMDK_MIN" MAP 0x4d0fa a_13 100 LINEAR______0_000000__0H___3_927 0.0 3.984375
 /begin AXIS_DESCR COM_AXIS mdk_ist MTC_NORM_16_RES10 6 0.0 119.99817 AXIS_PTS_REF sstm_mdk_ist_6_1 MAX_GRAD 100 MONOTONY MON_INCREASE /end AXIS_DESCR
 /begin AXIS_DESCR COM_AXIS lm_kg_h MAF_KGH_16_RES28 6 0.0 16383.75 AXIS_PTS_REF sstm_lm_kg_h_6_2 MAX_GRAD 100 MONOTONY MON_INCREASE /end AXIS_DESCR
/end CHARACTERISTIC
/begin CHARACTERISTIC kf_fak_vanos_ll__tkw__tkw_st "KF_FAK_VANOS_LL" MAP 0x4d11e a_4 100 LINEAR_______4_000000__0H___3_97 -4.0 3.97
 /begin AXIS_DESCR COM_AXIS tkw_st LINEAR_______48_000000__0H___142 8 -48.0 142.5 AXIS_PTS_REF sstm_tkw_st_6_7 MAX_GRAD 100 MONOTONY MON_INCREASE /end AXIS_DESCR
 /begin AXIS_DESCR COM_AXIS tkw LINEAR_______48_000000__0H___142 8 -48.0 142.5 AXIS_PTS_REF sstm_tkw_6_7 MAX_GRAD 100 MONOTONY MON_INCREASE /end AXIS_DESCR
/end CHARACTERISTIC
/begin CHARACTERISTIC kf_fak_vanos_tl__tkw__tkw_st "KF_FAK_VANOS_TL" MAP 0x4d15e a_4 100 LINEAR_______4_000000__0H___3_97 -4.0 3.97
 /begin AXIS_DESCR COM_AXIS tkw_st LINEAR_______48_000000__0H___142 8 -48.0 142.5 AXIS_PTS_REF sstm_tkw_st_6_7 MAX_GRAD 100 MONOTONY MON_INCREASE /end AXIS_DESCR
 /begin AXIS_DESCR COM_AXIS tkw LINEAR_______48_000000__0H___142 8 -48.0 142.5 AXIS_PTS_REF sstm_tkw_6_7 MAX_GRAD 100 MONOTONY MON_INCREASE /end AXIS_DESCR
/end CHARACTERISTIC
/begin CHARACTERISTIC kf_fak_zv_lam__n__lm "KF_FAK_ZV_LAM" MAP 0x499b6 a_29 100 LINEAR______0_000000__0H___1_999 0.0 1.99997
 /begin AXIS_DESCR COM_AXIS lm MAF_8_RES 8 0.0 1389.0 AXIS_PTS_REF sstm_lm_1_8 MAX_GRAD 100 MONOTONY MON_INCREASE /end AXIS_DESCR
 /begin AXIS_DESCR COM_AXIS drehzahl IS_13_RES 8 0.0 8160.0 AXIS_PTS_REF sstm_n_2_8 MAX_GRAD 100 MONOTONY MON_INCREASE /end AXIS_DESCR
/end CHARACTERISTIC
/begin CHARACTERISTIC kf_fak_zv_p__lm_kg_h "KF_FAK_ZV_P" CURVE 0x49a36 a_9 100 LINEAR______0_000000__0H___1_999 0.0 1.99997
 /begin AXIS_DESCR COM_AXIS lm_kg_h MAF_KGH_16_RES28 6 0.0 16383.75 AXIS_PTS_REF sstm_lm_kg_h_6_1 MAX_GRAD 100 MONOTONY MON_INCREASE /end AXIS_DESCR
/end CHARACTERISTIC
/begin CHARACTERISTIC kf_fak_zw_mdz__zw_dif "KF_FAK_ZW_MDZ" CURVE 0x49a42 a_7 20 LINEAR______0_000000__0H___0_916 0.0 0.99998474
 /begin AXIS_DESCR COM_AXIS dummy LINEAR_______48_000000__80H___0_ 8 -48.0 0.0 AXIS_PTS_REF sst_zw_dif_kf_fak_zw_mdz MAX_GRAD 100 MONOTONY MON_INCREASE /end AXIS_DESCR
/end CHARACTERISTIC
/begin CHARACTERISTIC kf_fr_totz_vanos_a__n__toel "KF_FR_TOTZ_VANOS_A" MAP 0x4d19e a_4 100 LINEAR______0_000000__0H___2550_ 0.0 2550.0
 /begin AXIS_DESCR COM_AXIS toel LINEAR_______48_000000__0H___130 8 -48.0 155.0 AXIS_PTS_REF sstm_toel_7_7 MAX_GRAD 100 MONOTONY MON_INCREASE /end AXIS_DESCR
 /begin AXIS_DESCR COM_AXIS drehzahl ES_8_RES8 8 0.0 8160.0 AXIS_PTS_REF sstm_n_7_7 MAX_GRAD 100 MONOTONY MON_INCREASE /end AXIS_DESCR
/end CHARACTERISTIC
/begin CHARACTERISTIC kf_fr_totz_vanos_e__n__toel "KF_FR_TOTZ_VANOS_E" MAP 0x4d1de a_4 100 LINEAR______0_000000__0H___2550_ 0.0 2550.0
 /begin AXIS_DESCR COM_AXIS toel LINEAR_______48_000000__0H___130 8 -48.0 155.0 AXIS_PTS_REF sstm_toel_7_7 MAX_GRAD 100 MONOTONY MON_INCREASE /end AXIS_DESCR
 /begin AXIS_DESCR COM_AXIS drehzahl ES_8_RES8 8 0.0 8160.0 AXIS_PTS_REF sstm_n_7_7 MAX_GRAD 100 MONOTONY MON_INCREASE /end AXIS_DESCR
/end CHARACTERISTIC
/begin CHARACTERISTIC kf_fs_ka_nsoll_ll__tkw "KF_FS_KA_NSOLL_LL" CURVE 0x49a52 a_7 3 LINEAR______0_000000__0H___81631 0.0 8160.0
 /begin AXIS_DESCR COM_AXIS tkw LINEAR_______48_000000__0H___121 6 -48.0 142.5 AXIS_PTS_REF sstm_tkw_1_6 MAX_GRAD 100 MONOTONY MON_INCREASE /end AXIS_DESCR
/end CHARACTERISTIC
/begin CHARACTERISTIC kf_fs_nsoll_add_heiz__tkw "KF_FS_NSOLL_ADD_HEIZ" CURVE 0x49a5e a_7 100 LINEAR______0_000000__0H___1000_ 0.0 1000.0
 /begin AXIS_DESCR COM_AXIS tkw LINEAR_______48_000000__0H___121 6 -48.0 142.5 AXIS_PTS_REF sstm_tkw_1_6 MAX_GRAD 100 MONOTONY MON_INCREASE /end AXIS_DESCR
/end CHARACTERISTIC
/begin CHARACTERISTIC kf_fs_nsoll_add_kat2__tkw_st "KF_FS_NSOLL_ADD_KAT2" CURVE 0x49a6a a_7 100 LINEAR______0_000000__0H___10032 0.0 1000.0
 /begin AXIS_DESCR COM_AXIS tkw_st LINEAR_______48_000000__0H___133 8 -48.0 142.5 AXIS_PTS_REF sstm_tkw_st_2_8 MAX_GRAD 100 MONOTONY MON_INCREASE /end AXIS_DESCR
/end CHARACTERISTIC
/begin CHARACTERISTIC kf_fs_nsoll_ll__tkw "KF_FS_NSOLL_LL" CURVE 0x49a7a a_7 3 LINEAR______0_000000__0H___81631 0.0 8160.0
 /begin AXIS_DESCR COM_AXIS tkw LINEAR_______48_000000__0H___121 6 -48.0 142.5 AXIS_PTS_REF sstm_tkw_1_6 MAX_GRAD 100 MONOTONY MON_INCREASE /end AXIS_DESCR
/end CHARACTERISTIC
/begin CHARACTERISTIC kf_gw_soll__n "KF_GW_SOLL" CURVE 0x4d21e a_3 5 LINEAR______0_000000__0H___5_100 0.0 5.0999999
 /begin AXIS_DESCR COM_AXIS drehzahl ES_8_RES8 8 0.0 8160.0 AXIS_PTS_REF sstm_n_3_9 MAX_GRAD 100 MONOTONY MON_INCREASE /end AXIS_DESCR
/end CHARACTERISTIC
/begin CHARACTERISTIC kf_gws__tkw_st "KF_GWS" CURVE 0x49a86 a_7 100 LINEAR______0_000000__0H___65534 0.0 65535.0
 /begin AXIS_DESCR COM_AXIS dummy LINEAR_______48_000000__0H___133 8 -48.0 142.5 AXIS_PTS_REF sst_tkw_st_kf_gws MAX_GRAD 100 MONOTONY MON_INCREASE /end AXIS_DESCR
/end CHARACTERISTIC
/begin CHARACTERISTIC kf_i_aero_tmdk_fak__tmdk "KF_I_AERO_TMDK_FAK" CURVE 0x4d226 a_3 100 LINEAR______0_00000__0H___7_9687 0.0 7.96875
 /begin AXIS_DESCR COM_AXIS tmdk LINEAR_______48_000000__0H___142 4 -48.0 142.5 AXIS_PTS_REF sstm_tmdk_4_2 MAX_GRAD 100 MONOTONY MON_INCREASE /end AXIS_DESCR
/end CHARACTERISTIC
/begin CHARACTERISTIC kf_i_part_aero__lm_kgh__mdk_ist "KF_I_PART_AERO" MAP 0x4d22a a_13 100 LINEAR_______50_000000__0H___435 -50.0 49.610001
 /begin AXIS_DESCR COM_AXIS mdk_ist MTC_NORM_16_RES10 6 0.0 119.99817 AXIS_PTS_REF sstm_mdk_ist_6_1 MAX_GRAD 100 MONOTONY MON_INCREASE /end AXIS_DESCR
 /begin AXIS_DESCR COM_AXIS lm_kg_h MAF_KGH_16_RES28 6 0.0 16383.75 AXIS_PTS_REF sstm_lm_kg_h_6_2 MAX_GRAD 100 MONOTONY MON_INCREASE /end AXIS_DESCR
/end CHARACTERISTIC
/begin CHARACTERISTIC kf_imp_mdk_min_diag__ub "KF_IMP_MDK_MIN_DIAG" CURVE 0x49a96 a_7 100 LINEAR______0_000000__0H___11936 0.0 119.9982
 /begin AXIS_DESCR COM_AXIS ubatt LINEAR______0_000000__0H___26_00 4 0.0 26.0 AXIS_PTS_REF sst_ub_kf_imp_mdk_min_diag MAX_GRAD 100 MONOTONY MON_INCREASE /end AXIS_DESCR
/end CHARACTERISTIC
/begin CHARACTERISTIC kf_inc_roz__n "KF_INC_ROZ" CURVE 0x49a9e a_7 10 LINEAR______0_000000__0H___0_999 0.0 0.99998474
 /begin AXIS_DESCR COM_AXIS n_32 ES_8_RES8 4 0.0 8160.0 AXIS_PTS_REF sstm_n_kf_aebg_roz MAX_GRAD 100 MONOTONY MON_INCREASE /end AXIS_DESCR
/end CHARACTERISTIC
/begin CHARACTERISTIC kf_ka_nsoll_ll__tkw "KF_KA_NSOLL_LL" CURVE 0x49aa6 a_7 3 LINEAR______0_000000__0H___81631 0.0 8160.0
 /begin AXIS_DESCR COM_AXIS tkw LINEAR_______48_000000__0H___121 6 -48.0 142.5 AXIS_PTS_REF sstm_tkw_1_6 MAX_GRAD 100 MONOTONY MON_INCREASE /end AXIS_DESCR
/end CHARACTERISTIC
/begin CHARACTERISTIC kf_kk_totz_2__n "KF_KK_TOTZ_2" CURVE 0x49ab2 a_7 1 LINEAR______0_010000__1H___655_3 0.01 655.34998
 /begin AXIS_DESCR COM_AXIS drehzahl ES_8_RES8 3 0.0 8160.0 AXIS_PTS_REF sstm_n_4_6 MAX_GRAD 100 MONOTONY MON_INCREASE /end AXIS_DESCR
/end CHARACTERISTIC
/begin CHARACTERISTIC kf_kk_totz_3__n "KF_KK_TOTZ_3" CURVE 0x49ab8 a_7 1 LINEAR______0_010000__1H___655_3 0.01 655.34998
 /begin AXIS_DESCR COM_AXIS drehzahl ES_8_RES8 3 0.0 8160.0 AXIS_PTS_REF sstm_n_4_6 MAX_GRAD 100 MONOTONY MON_INCREASE /end AXIS_DESCR
/end CHARACTERISTIC
/begin CHARACTERISTIC kf_kns_zyka_stns__n__lm "KF_KNS_ZYKA_STNS" MAP 0x4d24e a_4 100 LINEAR______1_000000__1H___255_0 1.0 255.0
 /begin AXIS_DESCR COM_AXIS lm MAF_8_RES37 6 0.0 1389.0 AXIS_PTS_REF sst_lm_kf_kns_zyka_stns MAX_GRAD 100 MONOTONY MON_INCREASE /end AXIS_DESCR
 /begin AXIS_DESCR COM_AXIS n_32 ES_8_RES17 6 0.0 8160.0 AXIS_PTS_REF sst_n_kf_kns_zyka_stns MAX_GRAD 100 MONOTONY MON_INCREASE /end AXIS_DESCR
/end CHARACTERISTIC
/begin CHARACTERISTIC kf_kp2_fgr__vsoll_fgr__v_dif_fgr "KF_KP2_FGR" MAP 0x49abe a_38 10 LINEAR______0_014648__1H___959_9 0.014648 959.854
 /begin AXIS_DESCR COM_AXIS v_dif_fgr LINEAR_______256_000000__0H___25 4 -256.0 255.99218 AXIS_PTS_REF sst_v_dif_fgr MAX_GRAD 100 MONOTONY MON_INCREASE /end AXIS_DESCR
 /begin AXIS_DESCR COM_AXIS v_soll_fgr LINEAR______0_000000__0H___511_9 5 0.0 511.99218 AXIS_PTS_REF sstm_vsoll_fgr MAX_GRAD 100 MONOTONY MON_INCREASE /end AXIS_DESCR
/end CHARACTERISTIC
/begin CHARACTERISTIC kf_kva_ps_kor__pq_hs "KF_KVA_PS_KOR" CURVE 0x49ae6 a_7 100 LINEAR______0_000000__0H___16_00 0.0 16.0
 /begin AXIS_DESCR COM_AXIS pq_hs LINEAR______0_000000__0H___1_039 6 0.0 1.0 AXIS_PTS_REF sst_pq_hs_kf_kva_ps_kor MAX_GRAD 100 MONOTONY MON_INCREASE /end AXIS_DESCR
/end CHARACTERISTIC
/begin CHARACTERISTIC kf_lam_dif_max_te__n__lm "KF_LAM_DIF_MAX_TE" MAP 0x49af2 a_1 100 LINEAR______1_000000__28FH___31_ 1.0 31.25
 /begin AXIS_DESCR COM_AXIS lm MAF_8_RES40 5 0.0 1389.0 AXIS_PTS_REF sst_lm_kf_lam_dif_max_te MAX_GRAD 100 MONOTONY MON_INCREASE /end AXIS_DESCR
 /begin AXIS_DESCR COM_AXIS n_32 ES_8_RES41 5 0.0 8160.0 AXIS_PTS_REF sst_n_kf_lam_dif_max_te MAX_GRAD 100 MONOTONY MON_INCREASE /end AXIS_DESCR
/end CHARACTERISTIC
/begin CHARACTERISTIC kf_lam_i__n__lm "KF_LAM_I" MAP 0x4d272 a_2 5 LINEAR______0_000000__0H___0_496 0.0 0.49608999
 /begin AXIS_DESCR COM_AXIS lm MAF_8_RES 8 0.0 1389.0 AXIS_PTS_REF sstm_lm_1_8 MAX_GRAD 100 MONOTONY MON_INCREASE /end AXIS_DESCR
 /begin AXIS_DESCR COM_AXIS drehzahl IS_13_RES 8 0.0 8160.0 AXIS_PTS_REF sstm_n_2_8 MAX_GRAD 100 MONOTONY MON_INCREASE /end AXIS_DESCR
/end CHARACTERISTIC
/begin CHARACTERISTIC kf_lam_inst_aebg__lm_kg_h "KF_LAM_INST_AEBG" CURVE 0x49b24 a_9 1 LINEAR______0_000015__0H___0_250 1.5e-005 0.25
 /begin AXIS_DESCR COM_AXIS lm_kg_h MAF_KGH_16_RES15 8 0.0 16383.75 AXIS_PTS_REF sstm_lm_kg_h_1_10 MAX_GRAD 100 MONOTONY MON_INCREASE /end AXIS_DESCR
/end CHARACTERISTIC
/begin CHARACTERISTIC kf_lam_neg_p__n__lm "KF_LAM_NEG_P" MAP 0x4d2b2 a_2 10 LINEAR______0_000000__0H___0_496 0.0 0.49608999
 /begin AXIS_DESCR COM_AXIS lm MAF_8_RES 8 0.0 1389.0 AXIS_PTS_REF sstm_lm_1_8 MAX_GRAD 100 MONOTONY MON_INCREASE /end AXIS_DESCR
 /begin AXIS_DESCR COM_AXIS drehzahl IS_13_RES 8 0.0 8160.0 AXIS_PTS_REF sstm_n_2_8 MAX_GRAD 100 MONOTONY MON_INCREASE /end AXIS_DESCR
/end CHARACTERISTIC
/begin CHARACTERISTIC kf_lam_pos_p__n__lm "KF_LAM_POS_P" MAP 0x4d2f2 a_2 10 LINEAR______0_000000__0H___0_496 0.0 0.49608999
 /begin AXIS_DESCR COM_AXIS lm MAF_8_RES 8 0.0 1389.0 AXIS_PTS_REF sstm_lm_1_8 MAX_GRAD 100 MONOTONY MON_INCREASE /end AXIS_DESCR
 /begin AXIS_DESCR COM_AXIS drehzahl IS_13_RES 8 0.0 8160.0 AXIS_PTS_REF sstm_n_2_8 MAX_GRAD 100 MONOTONY MON_INCREASE /end AXIS_DESCR
/end CHARACTERISTIC
/begin CHARACTERISTIC kf_lam_te__n__lm_add_kor "KF_LAM_TE" MAP 0x49b34 a_1 2 LINEAR______0_000015__1H___0_250 1.53e-005 0.25
 /begin AXIS_DESCR COM_AXIS lm_add_kor MAF_8_RES 12 0.0 1389.0 AXIS_PTS_REF sstm_lm_add_kor_1_12 MAX_GRAD 100 MONOTONY MON_INCREASE /end AXIS_DESCR
 /begin AXIS_DESCR COM_AXIS drehzahl ES_8_RES41 10 0.0 8160.0 AXIS_PTS_REF sstm_n_2_10 MAX_GRAD 100 MONOTONY MON_INCREASE /end AXIS_DESCR
/end CHARACTERISTIC
/begin CHARACTERISTIC kf_lm_add_tal_fak__tal "KF_LM_ADD_TAL_FAK" CURVE 0x4d332 a_3 100 LINEAR______0_000000__0H___1_942 0.0 1.9922
 /begin AXIS_DESCR COM_AXIS tal LINEAR_______48_000000__0H___114 6 -48.0 142.5 AXIS_PTS_REF sstm_tal_2_6 MAX_GRAD 100 MONOTONY MON_INCREASE /end AXIS_DESCR
/end CHARACTERISTIC
/begin CHARACTERISTIC kf_lm_diag_1__n__mdk_ist "KF_LM_DIAG_1" MAP 0x49c24 a_43 5 MAF_16_RES 0.0 1389.0
 /begin AXIS_DESCR COM_AXIS dummy MTC_NORM_16_RES44 16 0.0 119.99817 AXIS_PTS_REF sst_mdk_ist_kf_lm_diag_1 MAX_GRAD 100 MONOTONY MON_INCREASE /end AXIS_DESCR
 /begin AXIS_DESCR COM_AXIS drehzahl ES_8_RES8 16 0.0 8160.0 AXIS_PTS_REF sstm_n_16_1 MAX_GRAD 100 MONOTONY MON_INCREASE /end AXIS_DESCR
/end CHARACTERISTIC
/begin CHARACTERISTIC kf_lm_diag_2__n "KF_LM_DIAG_2" CURVE 0x4d338 a_3 10 MAF_8_RES 0.0 1389.0
 /begin AXIS_DESCR COM_AXIS drehzahl ES_8_RES8 6 0.0 8160.0 AXIS_PTS_REF sst_n_kf_lm_diag_2 MAX_GRAD 100 MONOTONY MON_INCREASE /end AXIS_DESCR
/end CHARACTERISTIC
/begin CHARACTERISTIC kf_lm_dif_max_lu__lm "KF_LM_DIF_MAX_LU" CURVE 0x49e24 a_7 5 MAF_16_RES45 0.0 1389.0
 /begin AXIS_DESCR COM_AXIS lm MAF_8_RES 6 0.0 1389.0 AXIS_PTS_REF sst_lm_kf_lm_dif_max_lu MAX_GRAD 100 MONOTONY MON_INCREASE /end AXIS_DESCR
/end CHARACTERISTIC
/begin CHARACTERISTIC kf_lm_gmw_s__n "KF_LM_GMW_S" CURVE 0x4d33e a_3 14 MAF_8_RES 0.0 1389.0
 /begin AXIS_DESCR COM_AXIS drehzahl ES_8_RES8 6 0.0 8160.0 AXIS_PTS_REF sst_n_kf_lm_gmw_s MAX_GRAD 100 MONOTONY MON_INCREASE /end AXIS_DESCR
/end CHARACTERISTIC
/begin CHARACTERISTIC kf_lm_int_zv_sa_max__lm_int_sa "KF_LM_INT_ZV_SA_MAX" CURVE 0x49e30 a_9 100 LM_INT_SA_RANGE 0.0 1820.42
 /begin AXIS_DESCR COM_AXIS dummy LM_INT_SA_RANGE 6 0.0 1820.42 AXIS_PTS_REF sst_lm_int_sa_kf_lm_int_zv_sa MAX_GRAD 100 MONOTONY MON_INCREASE /end AXIS_DESCR
/end CHARACTERISTIC
/begin CHARACTERISTIC kf_lm_kg_h_max_diag_sl__fak_pu "KF_LM_KG_H_MAX_DIAG_SL" CURVE 0x49e3c a_9 10 LINEAR______0_000000__0H___16383 0.0 16383.25
 /begin AXIS_DESCR COM_AXIS fak_pu LINEAR______0_000000__0H___2_000 6 0.0 2.0 AXIS_PTS_REF sstm_fak_pu_5_22 MAX_GRAD 10 MONOTONY MON_INCREASE /end AXIS_DESCR
/end CHARACTERISTIC
/begin CHARACTERISTIC kf_lm_lam_kat_max__n "KF_LM_LAM_KAT_MAX" CURVE 0x49e48 a_7 100 MAF_16_RES46 0.0 1389.0
 /begin AXIS_DESCR COM_AXIS n_32 ES_8_RES41 6 0.0 8160.0 AXIS_PTS_REF sstm_n_kf_lm_lam_zeit_mxx MAX_GRAD 100 MONOTONY MON_INCREASE /end AXIS_DESCR
/end CHARACTERISTIC
/begin CHARACTERISTIC kf_lm_lam_kat_min__n "KF_LM_LAM_KAT_MIN" CURVE 0x49e54 a_7 100 MAF_16_RES46 0.0 1389.0
 /begin AXIS_DESCR COM_AXIS n_32 ES_8_RES41 6 0.0 8160.0 AXIS_PTS_REF sstm_n_kf_lm_lam_zeit_mxx MAX_GRAD 100 MONOTONY MON_INCREASE /end AXIS_DESCR
/end CHARACTERISTIC
/begin CHARACTERISTIC kf_lm_lam_zv_max__n "KF_LM_LAM_ZV_MAX" CURVE 0x49e60 a_7 100 MAF_16_RES47 0.0 1389.0
 /begin AXIS_DESCR COM_AXIS n_32 ES_8_RES 6 0.0 8160.0 AXIS_PTS_REF sstm_n_6_1 MAX_GRAD 100 MONOTONY MON_INCREASE /end AXIS_DESCR
/end CHARACTERISTIC
/begin CHARACTERISTIC kf_lm_lam_zv_min__n "KF_LM_LAM_ZV_MIN" CURVE 0x49e6c a_7 100 MAF_16_RES47 0.0 1389.0
 /begin AXIS_DESCR COM_AXIS n_32 ES_8_RES 6 0.0 8160.0 AXIS_PTS_REF sstm_n_6_1 MAX_GRAD 100 MONOTONY MON_INCREASE /end AXIS_DESCR
/end CHARACTERISTIC
/begin CHARACTERISTIC kf_lm_max_diag_sl__n "KF_LM_MAX_DIAG_SL" CURVE 0x4d344 a_3 10 MAF_8_RES40 0.0 1389.0
 /begin AXIS_DESCR COM_AXIS n_32 ES_8_RES41 8 0.0 8160.0 AXIS_PTS_REF sst_n_kf_lm_max_diag_sl MAX_GRAD 100 MONOTONY MON_INCREASE /end AXIS_DESCR
/end CHARACTERISTIC
/begin CHARACTERISTIC kf_lm_max_llfs__pq_ts "KF_LM_MAX_LLFS" CURVE 0x49e78 a_7 100 MAF_KGH_16_RES28 0.0 16383.75
 /begin AXIS_DESCR COM_AXIS pq_ts LINEAR______0_000000__0H___0_920 6 0.0 0.99599999 AXIS_PTS_REF sstm_pq_ts MAX_GRAD 100 MONOTONY MON_INCREASE /end AXIS_DESCR
/end CHARACTERISTIC
/begin CHARACTERISTIC kf_lm_min_diag_sl__fak_pu "KF_LM_MIN_DIAG_SL" CURVE 0x4d34c a_19 10 MAF_8_RES37 0.0 1389.0
 /begin AXIS_DESCR COM_AXIS fak_pu LINEAR______0_000000__0H___2_000 6 0.0 2.0 AXIS_PTS_REF sstm_fak_pu_5_22 MAX_GRAD 10 MONOTONY MON_INCREASE /end AXIS_DESCR
/end CHARACTERISTIC
/begin CHARACTERISTIC kf_lm_min_kr__n__tkw "KF_LM_MIN_KR" MAP 0x4d352 a_4 3 MAF_8_RES 0.0 1389.0
 /begin AXIS_DESCR COM_AXIS tkw LINEAR_______48_000000__0H___114 4 -48.0 142.5 AXIS_PTS_REF sst_tkw_kf_lm_min_kr MAX_GRAD 100 MONOTONY MON_INCREASE /end AXIS_DESCR
 /begin AXIS_DESCR COM_AXIS drehzahl ES_8_RES8 8 0.0 8160.0 AXIS_PTS_REF sstm_n_3_9 MAX_GRAD 100 MONOTONY MON_INCREASE /end AXIS_DESCR
/end CHARACTERISTIC
/begin CHARACTERISTIC kf_lm_min_ks__n__zw_dif "KF_LM_MIN_KS" MAP 0x4d372 a_4 10 MAF_8_RES40 0.0 1389.0
 /begin AXIS_DESCR COM_AXIS dummy LINEAR______0_000000__0H___95_62 6 0.0 95.625 AXIS_PTS_REF sstm_zw_dif_6_1 MAX_GRAD 100 MONOTONY MON_INCREASE /end AXIS_DESCR
 /begin AXIS_DESCR COM_AXIS drehzahl ES_8_RES8 10 0.0 8160.0 AXIS_PTS_REF sstm_n_1_8 MAX_GRAD 100 MONOTONY MON_INCREASE /end AXIS_DESCR
/end CHARACTERISTIC
/begin CHARACTERISTIC kf_lm_min_lu__n "KF_LM_MIN_LU" CURVE 0x4d3ae a_3 5 MAF_8_RES40 0.0 1389.0
 /begin AXIS_DESCR COM_AXIS drehzahl ES_8_RES8 6 0.0 8160.0 AXIS_PTS_REF sst_n_lm_min_lu MAX_GRAD 100 MONOTONY MON_INCREASE /end AXIS_DESCR
/end CHARACTERISTIC
/begin CHARACTERISTIC kf_lm_min_pu_fak__n "KF_LM_MIN_PU_FAK" CURVE 0x4d3b4 a_3 100 LINEAR______0_000000__0H___1389_ 0.0 1389.5
 /begin AXIS_DESCR COM_AXIS n_32 ES_8_RES 4 0.0 8160.0 AXIS_PTS_REF sst_n_kf_lm_min_pu_fak MAX_GRAD 100 MONOTONY MON_INCREASE /end AXIS_DESCR
/end CHARACTERISTIC
/begin CHARACTERISTIC kf_lm_tkw_kor__tkw "KF_LM_TKW_KOR" CURVE 0x4d3b8 a_3 100 LINEAR______0_000000__0H___1_948 0.0 1.992
 /begin AXIS_DESCR COM_AXIS tkw LINEAR_______48_000000__0H___114 8 -48.0 142.5 AXIS_PTS_REF sstm_tkw_21_7 MAX_GRAD 100 MONOTONY MON_INCREASE /end AXIS_DESCR
/end CHARACTERISTIC
/begin CHARACTERISTIC kf_lm_vue1__p__n "KF_LM_VUE1" MAP 0x49e84 a_29 100 MAF_16_RES49 0.0 1389.0
 /begin AXIS_DESCR COM_AXIS drehzahl ES_8_RES8 12 0.0 8160.0 AXIS_PTS_REF sstm_n_22_7 MAX_GRAD 100 MONOTONY MON_INCREASE /end AXIS_DESCR
 /begin AXIS_DESCR COM_AXIS p LINEAR______0_000000__0H___5434_ 8 0.0 5434.2598 AXIS_PTS_REF sstm_p_21_7 MAX_GRAD 100 MONOTONY MON_INCREASE /end AXIS_DESCR
/end CHARACTERISTIC
/begin CHARACTERISTIC kf_lm_vue2__p__n "KF_LM_VUE2" MAP 0x49f44 a_29 100 MAF_16_RES49 0.0 1389.0
 /begin AXIS_DESCR COM_AXIS drehzahl ES_8_RES8 12 0.0 8160.0 AXIS_PTS_REF sstm_n_22_7 MAX_GRAD 100 MONOTONY MON_INCREASE /end AXIS_DESCR
 /begin AXIS_DESCR COM_AXIS p LINEAR______0_000000__0H___5434_ 8 0.0 5434.2598 AXIS_PTS_REF sstm_p_21_7 MAX_GRAD 100 MONOTONY MON_INCREASE /end AXIS_DESCR
/end CHARACTERISTIC
/begin CHARACTERISTIC kf_lm_vue3__p__n "KF_LM_VUE3" MAP 0x4a004 a_29 100 MAF_16_RES49 0.0 1389.0
 /begin AXIS_DESCR COM_AXIS drehzahl ES_8_RES8 12 0.0 8160.0 AXIS_PTS_REF sstm_n_22_7 MAX_GRAD 100 MONOTONY MON_INCREASE /end AXIS_DESCR
 /begin AXIS_DESCR COM_AXIS p LINEAR______0_000000__0H___5434_ 8 0.0 5434.2598 AXIS_PTS_REF sstm_p_21_7 MAX_GRAD 100 MONOTONY MON_INCREASE /end AXIS_DESCR
/end CHARACTERISTIC
/begin CHARACTERISTIC kf_lm_vue4__p__n "KF_LM_VUE4" MAP 0x4a0c4 a_29 100 MAF_16_RES49 0.0 1389.0
 /begin AXIS_DESCR COM_AXIS drehzahl ES_8_RES8 12 0.0 8160.0 AXIS_PTS_REF sstm_n_22_7 MAX_GRAD 100 MONOTONY MON_INCREASE /end AXIS_DESCR
 /begin AXIS_DESCR COM_AXIS p LINEAR______0_000000__0H___5434_ 8 0.0 5434.2598 AXIS_PTS_REF sstm_p_21_7 MAX_GRAD 100 MONOTONY MON_INCREASE /end AXIS_DESCR
/end CHARACTERISTIC
/begin CHARACTERISTIC kf_lm_vue5__p__n "KF_LM_VUE5" MAP 0x4a184 a_29 100 MAF_16_RES49 0.0 1389.0
 /begin AXIS_DESCR COM_AXIS drehzahl ES_8_RES8 12 0.0 8160.0 AXIS_PTS_REF sstm_n_22_7 MAX_GRAD 100 MONOTONY MON_INCREASE /end AXIS_DESCR
 /begin AXIS_DESCR COM_AXIS p LINEAR______0_000000__0H___5434_ 8 0.0 5434.2598 AXIS_PTS_REF sstm_p_21_7 MAX_GRAD 100 MONOTONY MON_INCREASE /end AXIS_DESCR
/end CHARACTERISTIC
/begin CHARACTERISTIC kf_lm_vue6__p__n "KF_LM_VUE6" MAP 0x4a244 a_29 100 MAF_16_RES49 0.0 1389.0
 /begin AXIS_DESCR COM_AXIS drehzahl ES_8_RES8 12 0.0 8160.0 AXIS_PTS_REF sstm_n_22_7 MAX_GRAD 100 MONOTONY MON_INCREASE /end AXIS_DESCR
 /begin AXIS_DESCR COM_AXIS p LINEAR______0_000000__0H___5434_ 8 0.0 5434.2598 AXIS_PTS_REF sstm_p_21_7 MAX_GRAD 100 MONOTONY MON_INCREASE /end AXIS_DESCR
/end CHARACTERISTIC
/begin CHARACTERISTIC kf_lm_vue7__p__n "KF_LM_VUE7" MAP 0x4a304 a_29 100 MAF_16_RES49 0.0 1389.0
 /begin AXIS_DESCR COM_AXIS drehzahl ES_8_RES8 12 0.0 8160.0 AXIS_PTS_REF sstm_n_22_7 MAX_GRAD 100 MONOTONY MON_INCREASE /end AXIS_DESCR
 /begin AXIS_DESCR COM_AXIS p LINEAR______0_000000__0H___5434_ 8 0.0 5434.2598 AXIS_PTS_REF sstm_p_21_7 MAX_GRAD 100 MONOTONY MON_INCREASE /end AXIS_DESCR
/end CHARACTERISTIC
/begin CHARACTERISTIC kf_lm_vue8__p__n "KF_LM_VUE8" MAP 0x4a3c4 a_29 100 MAF_16_RES49 0.0 1389.0
 /begin AXIS_DESCR COM_AXIS drehzahl ES_8_RES8 12 0.0 8160.0 AXIS_PTS_REF sstm_n_22_7 MAX_GRAD 100 MONOTONY MON_INCREASE /end AXIS_DESCR
 /begin AXIS_DESCR COM_AXIS p LINEAR______0_000000__0H___5434_ 8 0.0 5434.2598 AXIS_PTS_REF sstm_p_21_7 MAX_GRAD 100 MONOTONY MON_INCREASE /end AXIS_DESCR
/end CHARACTERISTIC
/begin CHARACTERISTIC kf_lm_zdg_mitko__n__lm_gem "KF_LM_ZDG_MITKO" MAP 0x4d3c0 a_4 100 LINEAR______0_000000__0H___0_996 0.0 0.99610001
 /begin AXIS_DESCR COM_AXIS lm_gem MAF_8_RES40 6 0.0 1389.0 AXIS_PTS_REF sst_lm_gem_kf_lm_zdg_mitko MAX_GRAD 15 MONOTONY MON_INCREASE /end AXIS_DESCR
 /begin AXIS_DESCR COM_AXIS n_32 ES_8_RES41 6 0.0 8160.0 AXIS_PTS_REF sst_n_kf_lm_zdg_mitko MAX_GRAD 100 MONOTONY MON_INCREASE /end AXIS_DESCR
/end CHARACTERISTIC
/begin CHARACTERISTIC kf_lm_zv_ad_max__n "KF_LM_ZV_AD_MAX" CURVE 0x4a484 a_7 100 MAF_16_RES47 0.0 1389.0
 /begin AXIS_DESCR COM_AXIS n_32 ES_8_RES 6 0.0 8160.0 AXIS_PTS_REF sstm_n_6_1 MAX_GRAD 100 MONOTONY MON_INCREASE /end AXIS_DESCR
/end CHARACTERISTIC
/begin CHARACTERISTIC kf_lm_zv_ad_min__n "KF_LM_ZV_AD_MIN" CURVE 0x4a490 a_7 100 MAF_16_RES47 0.0 1389.0
 /begin AXIS_DESCR COM_AXIS n_32 ES_8_RES 6 0.0 8160.0 AXIS_PTS_REF sstm_n_6_1 MAX_GRAD 100 MONOTONY MON_INCREASE /end AXIS_DESCR
/end CHARACTERISTIC
/begin CHARACTERISTIC kf_lu_tors_0_at__n__lm "KF_LU_TORS_0_AT" MAP 0x4a49c a_1 100 LINEAR_______32767_000000__1H___ -32767.0 32767.0
 /begin AXIS_DESCR COM_AXIS lm MAF_8_RES37 6 0.0 1389.0 AXIS_PTS_REF sst_lm_kf_lu_tors_0_at MAX_GRAD 10 MONOTONY MON_INCREASE /end AXIS_DESCR
 /begin AXIS_DESCR COM_AXIS n_32 ES_8_RES17 6 0.0 8160.0 AXIS_PTS_REF sstm_n_kf_tors_0_at MAX_GRAD 100 MONOTONY MON_INCREASE /end AXIS_DESCR
/end CHARACTERISTIC
/begin CHARACTERISTIC kf_lu_tors_0_mt__n__lm "KF_LU_TORS_0_MT" MAP 0x4a4e4 a_1 100 LINEAR_______32767_000000__1H___ -32767.0 32767.0
 /begin AXIS_DESCR COM_AXIS lm MAF_8_RES37 6 0.0 1389.0 AXIS_PTS_REF sst_lm_kf_lu_tors_0_mt MAX_GRAD 10 MONOTONY MON_INCREASE /end AXIS_DESCR
 /begin AXIS_DESCR COM_AXIS n_32 ES_8_RES17 6 0.0 8160.0 AXIS_PTS_REF sstm_n_kf_tors_0_mt MAX_GRAD 100 MONOTONY MON_INCREASE /end AXIS_DESCR
/end CHARACTERISTIC
/begin CHARACTERISTIC kf_lu_tors_1_at__n__lm "KF_LU_TORS_1_AT" MAP 0x4a52c a_1 100 LINEAR_______32767_000000__1H___ -32767.0 32767.0
 /begin AXIS_DESCR COM_AXIS lm MAF_8_RES37 6 0.0 1389.0 AXIS_PTS_REF sst_lm_kf_lu_tors_1_at MAX_GRAD 10 MONOTONY MON_INCREASE /end AXIS_DESCR
 /begin AXIS_DESCR COM_AXIS n_32 ES_8_RES17 6 0.0 8160.0 AXIS_PTS_REF sstm_n_kf_tors_1_at MAX_GRAD 100 MONOTONY MON_INCREASE /end AXIS_DESCR
/end CHARACTERISTIC
/begin CHARACTERISTIC kf_lu_tors_1_mt__n__lm "KF_LU_TORS_1_MT" MAP 0x4a574 a_1 100 LINEAR_______32767_000000__1H___ -32767.0 32767.0
 /begin AXIS_DESCR COM_AXIS lm MAF_8_RES37 6 0.0 1389.0 AXIS_PTS_REF sst_lm_kf_lu_tors_1_mt MAX_GRAD 10 MONOTONY MON_INCREASE /end AXIS_DESCR
 /begin AXIS_DESCR COM_AXIS n_32 ES_8_RES17 6 0.0 8160.0 AXIS_PTS_REF sstm_n_kf_tors_1_mt MAX_GRAD 100 MONOTONY MON_INCREASE /end AXIS_DESCR
/end CHARACTERISTIC
/begin CHARACTERISTIC kf_lu_tors_2_at__n__lm "KF_LU_TORS_2_AT" MAP 0x4a5bc a_1 100 LINEAR_______32767_000000__1H___ -32767.0 32767.0
 /begin AXIS_DESCR COM_AXIS lm MAF_8_RES37 6 0.0 1389.0 AXIS_PTS_REF sst_lm_kf_lu_tors_2_at MAX_GRAD 10 MONOTONY MON_INCREASE /end AXIS_DESCR
 /begin AXIS_DESCR COM_AXIS n_32 ES_8_RES17 6 0.0 8160.0 AXIS_PTS_REF sstm_n_kf_tors_2_at MAX_GRAD 100 MONOTONY MON_INCREASE /end AXIS_DESCR
/end CHARACTERISTIC
/begin CHARACTERISTIC kf_lu_tors_2_mt__n__lm "KF_LU_TORS_2_MT" MAP 0x4a604 a_1 100 LINEAR_______32767_000000__1H___ -32767.0 32767.0
 /begin AXIS_DESCR COM_AXIS lm MAF_8_RES37 6 0.0 1389.0 AXIS_PTS_REF sst_lm_kf_lu_tors_2_mt MAX_GRAD 10 MONOTONY MON_INCREASE /end AXIS_DESCR
 /begin AXIS_DESCR COM_AXIS n_32 ES_8_RES17 6 0.0 8160.0 AXIS_PTS_REF sstm_n_kf_tors_2_mt MAX_GRAD 100 MONOTONY MON_INCREASE /end AXIS_DESCR
/end CHARACTERISTIC
/begin CHARACTERISTIC kf_lu_tors_3_at__n__lm "KF_LU_TORS_3_AT" MAP 0x4a64c a_1 100 LINEAR_______32767_000000__1H___ -32767.0 32767.0
 /begin AXIS_DESCR COM_AXIS lm MAF_8_RES37 6 0.0 1389.0 AXIS_PTS_REF sst_lm_kf_lu_tors_3_at MAX_GRAD 10 MONOTONY MON_INCREASE /end AXIS_DESCR
 /begin AXIS_DESCR COM_AXIS n_32 ES_8_RES17 6 0.0 8160.0 AXIS_PTS_REF sstm_n_kf_tors_3_at MAX_GRAD 100 MONOTONY MON_INCREASE /end AXIS_DESCR
/end CHARACTERISTIC
/begin CHARACTERISTIC kf_lu_tors_3_mt__n__lm "KF_LU_TORS_3_MT" MAP 0x4a694 a_1 100 LINEAR_______32767_000000__1H___ -32767.0 32767.0
 /begin AXIS_DESCR COM_AXIS lm MAF_8_RES37 6 0.0 1389.0 AXIS_PTS_REF sst_lm_kf_lu_tors_3_mt MAX_GRAD 10 MONOTONY MON_INCREASE /end AXIS_DESCR
 /begin AXIS_DESCR COM_AXIS n_32 ES_8_RES17 6 0.0 8160.0 AXIS_PTS_REF sstm_n_kf_tors_3_mt MAX_GRAD 100 MONOTONY MON_INCREASE /end AXIS_DESCR
/end CHARACTERISTIC
/begin CHARACTERISTIC kf_lu_tors_4_at__n__lm "KF_LU_TORS_4_AT" MAP 0x4a6dc a_1 100 LINEAR_______32767_000000__1H___ -32767.0 32767.0
 /begin AXIS_DESCR COM_AXIS lm MAF_8_RES37 6 0.0 1389.0 AXIS_PTS_REF sst_lm_kf_lu_tors_4_at MAX_GRAD 10 MONOTONY MON_INCREASE /end AXIS_DESCR
 /begin AXIS_DESCR COM_AXIS n_32 ES_8_RES17 6 0.0 8160.0 AXIS_PTS_REF sstm_n_kf_tors_4_at MAX_GRAD 100 MONOTONY MON_INCREASE /end AXIS_DESCR
/end CHARACTERISTIC
/begin CHARACTERISTIC kf_lu_tors_4_mt__n__lm "KF_LU_TORS_4_MT" MAP 0x4a724 a_1 100 LINEAR_______32767_000000__1H___ -32767.0 32767.0
 /begin AXIS_DESCR COM_AXIS lm MAF_8_RES37 6 0.0 1389.0 AXIS_PTS_REF sst_lm_kf_lu_tors_4_mt MAX_GRAD 10 MONOTONY MON_INCREASE /end AXIS_DESCR
 /begin AXIS_DESCR COM_AXIS n_32 ES_8_RES17 6 0.0 8160.0 AXIS_PTS_REF sstm_n_kf_tors_4_mt MAX_GRAD 100 MONOTONY MON_INCREASE /end AXIS_DESCR
/end CHARACTERISTIC
/begin CHARACTERISTIC kf_lu_tors_5_at__n__lm "KF_LU_TORS_5_AT" MAP 0x4a76c a_1 100 LINEAR_______32767_000000__1H___ -32767.0 32767.0
 /begin AXIS_DESCR COM_AXIS lm MAF_8_RES37 6 0.0 1389.0 AXIS_PTS_REF sst_lm_kf_lu_tors_5_at MAX_GRAD 10 MONOTONY MON_INCREASE /end AXIS_DESCR
 /begin AXIS_DESCR COM_AXIS n_32 ES_8_RES17 6 0.0 8160.0 AXIS_PTS_REF sstm_n_kf_tors_5_at MAX_GRAD 100 MONOTONY MON_INCREASE /end AXIS_DESCR
/end CHARACTERISTIC
/begin CHARACTERISTIC kf_lu_tors_5_mt__n__lm "KF_LU_TORS_5_MT" MAP 0x4a7b4 a_1 100 LINEAR_______32767_000000__1H___ -32767.0 32767.0
 /begin AXIS_DESCR COM_AXIS lm MAF_8_RES37 6 0.0 1389.0 AXIS_PTS_REF sst_lm_kf_lu_tors_5_mt MAX_GRAD 10 MONOTONY MON_INCREASE /end AXIS_DESCR
 /begin AXIS_DESCR COM_AXIS n_32 ES_8_RES17 6 0.0 8160.0 AXIS_PTS_REF sstm_n_kf_tors_5_mt MAX_GRAD 100 MONOTONY MON_INCREASE /end AXIS_DESCR
/end CHARACTERISTIC
/begin CHARACTERISTIC kf_m_ind_lm__n__lm "KF_M_IND_LM" MAP 0x4a7fc a_1 100 LINEAR______0_000000__0H___1023_ 0.0 1023.0
 /begin AXIS_DESCR COM_AXIS lm MAF_8_RES50 2 0.0 1389.0 AXIS_PTS_REF sst_lm_kf_m_ind_lm MAX_GRAD 100 MONOTONY MON_INCREASE /end AXIS_DESCR
 /begin AXIS_DESCR COM_AXIS drehzahl ES_8_RES8 16 0.0 8160.0 AXIS_PTS_REF sstm_n_16_1 MAX_GRAD 100 MONOTONY MON_INCREASE /end AXIS_DESCR
/end CHARACTERISTIC
/begin CHARACTERISTIC kf_m_ind_pwg_tkw1__n__pwg "KF_M_IND_PWG_TKW1" MAP 0x4a83c a_1 100 LINEAR______0_000000__0H___1023_ 0.0 1023.0
 /begin AXIS_DESCR COM_AXIS dummy LINEAR______0_000000__0H___119_5 12 0.0 119.5 AXIS_PTS_REF sstm_pwg_12_1 MAX_GRAD 100 MONOTONY MON_INCREASE /end AXIS_DESCR
 /begin AXIS_DESCR COM_AXIS n_32 ES_8_RES17 12 0.0 8160.0 AXIS_PTS_REF sstm_n_4_2 MAX_GRAD 100 MONOTONY MON_INCREASE /end AXIS_DESCR
/end CHARACTERISTIC
/begin CHARACTERISTIC kf_m_ind_pwg_tkw2__n__pwg "KF_M_IND_PWG_TKW2" MAP 0x4a95c a_1 100 LINEAR______0_000000__0H___1023_ 0.0 1023.0
 /begin AXIS_DESCR COM_AXIS dummy LINEAR______0_000000__0H___119_5 12 0.0 119.5 AXIS_PTS_REF sstm_pwg_12_1 MAX_GRAD 100 MONOTONY MON_INCREASE /end AXIS_DESCR
 /begin AXIS_DESCR COM_AXIS n_32 ES_8_RES17 12 0.0 8160.0 AXIS_PTS_REF sstm_n_4_2 MAX_GRAD 100 MONOTONY MON_INCREASE /end AXIS_DESCR
/end CHARACTERISTIC
/begin CHARACTERISTIC kf_m_ldp_schw__v__gang "KF_M_LDP_SCHW" MAP 0x4aa7c a_29 100 LINEAR_______1024_000000__0H___1 -1024.0 1024.0
 /begin AXIS_DESCR COM_AXIS gang LINEAR______0_000000__0H___7_000 6 0.0 7.0 AXIS_PTS_REF sstm_gang_6_1 MAX_GRAD 100 MONOTONY MON_INCREASE /end AXIS_DESCR
 /begin AXIS_DESCR COM_AXIS v_fil LINEAR______0_000000__0H___511_9 6 0.0 511.99218 AXIS_PTS_REF sstm_v_fil_6_1 MAX_GRAD 100 MONOTONY MON_INCREASE /end AXIS_DESCR
/end CHARACTERISTIC
/begin CHARACTERISTIC kf_m_ldp_schw_at__v__gang "KF_M_LDP_SCHW_AT" MAP 0x4aac4 a_29 100 LINEAR_______1024_000000__0H___1 -1024.0 1024.0
 /begin AXIS_DESCR COM_AXIS gang LINEAR______0_000000__0H___7_000 6 0.0 7.0 AXIS_PTS_REF sstm_gang_6_1 MAX_GRAD 100 MONOTONY MON_INCREASE /end AXIS_DESCR
 /begin AXIS_DESCR COM_AXIS v_fil LINEAR______0_000000__0H___511_9 6 0.0 511.99218 AXIS_PTS_REF sstm_v_fil_6_1 MAX_GRAD 100 MONOTONY MON_INCREASE /end AXIS_DESCR
/end CHARACTERISTIC
/begin CHARACTERISTIC kf_m_mdk_auf_mitko__mdk_ist "KF_M_MDK_AUF_MITKO" CURVE 0x4d3e4 a_19 100 LINEAR______0_000000__0H___0_996 0.0 0.99610001
 /begin AXIS_DESCR COM_AXIS mdk_ist MTC_NORM_16_RES51 6 0.0 119.99817 AXIS_PTS_REF sstm_mdk_ist_kf_mitko MAX_GRAD 100 MONOTONY MON_INCREASE /end AXIS_DESCR
/end CHARACTERISTIC
/begin CHARACTERISTIC kf_m_mdk_zu_mitko__mdk_ist "KF_M_MDK_ZU_MITKO" CURVE 0x4d3ea a_19 100 LINEAR______0_000000__0H___0_996 0.0 0.99610001
 /begin AXIS_DESCR COM_AXIS mdk_ist MTC_NORM_16_RES51 6 0.0 119.99817 AXIS_PTS_REF sstm_mdk_ist_kf_mitko MAX_GRAD 100 MONOTONY MON_INCREASE /end AXIS_DESCR
/end CHARACTERISTIC
/begin CHARACTERISTIC kf_m_reib__n__lm "KF_M_REIB" MAP 0x4d3f0 a_4 100 LINEAR______0_000000__0H___255_5 0.0 255.0
 /begin AXIS_DESCR COM_AXIS dummy MAF_8_RES37 2 0.0 1389.0 AXIS_PTS_REF sst_lm_kf_m_reib MAX_GRAD 100 MONOTONY MON_INCREASE /end AXIS_DESCR
 /begin AXIS_DESCR COM_AXIS n_32 ES_8_RES17 8 0.0 8160.0 AXIS_PTS_REF sst_n_kf_m_reib MAX_GRAD 100 MONOTONY MON_INCREASE /end AXIS_DESCR
/end CHARACTERISTIC
/begin CHARACTERISTIC kf_mdk_fak__tkw__tkw_st "KF_MDK_FAK" MAP 0x4d400 a_4 100 LINEAR_______4_000000__0H___3_96 -4.0 3.96875
 /begin AXIS_DESCR COM_AXIS dummy LINEAR_______48_000000__0H___114 4 -48.0 142.5 AXIS_PTS_REF sstm_tkw_st_1_6 MAX_GRAD 100 MONOTONY MON_INCREASE /end AXIS_DESCR
 /begin AXIS_DESCR COM_AXIS tkw LINEAR_______48_000000__0H___114 12 -48.0 142.5 AXIS_PTS_REF sstm_tkw_3_6 MAX_GRAD 100 MONOTONY MON_INCREASE /end AXIS_DESCR
/end CHARACTERISTIC
/begin CHARACTERISTIC kf_mdk_mech_ob_diag__pwgistroh "KF_MDK_MECH_OB_DIAG" CURVE 0x4ab0c a_9 100 MTC_NORM_16_RES10 0.0 119.99817
 /begin AXIS_DESCR COM_AXIS pwg_ist_roh MTC_NORM_16_RES10 6 0.0 119.99817 AXIS_PTS_REF sstm_pwg_ist_roh_6_1 MAX_GRAD 100 MONOTONY MON_INCREASE /end AXIS_DESCR
/end CHARACTERISTIC
/begin CHARACTERISTIC kf_mdk_mech_unt_diag__pwgistroh "KF_MDK_MECH_UNT_DIAG" CURVE 0x4ab18 a_9 100 MTC_NORM_16_RES10 0.0 119.99817
 /begin AXIS_DESCR COM_AXIS pwg_ist_roh MTC_NORM_16_RES10 6 0.0 119.99817 AXIS_PTS_REF sstm_pwg_ist_roh_6_1 MAX_GRAD 100 MONOTONY MON_INCREASE /end AXIS_DESCR
/end CHARACTERISTIC
/begin CHARACTERISTIC kf_mdk_soll_auf_mitko__dk__dkd "KF_MDK_SOLL_AUF_MITKO" MAP 0x4d430 a_13 100 LINEAR______0_000000__0H___0_996 0.0 0.99610001
 /begin AXIS_DESCR COM_AXIS mdk_ist MTC_NORM_16_RES51 6 0.0 119.99817 AXIS_PTS_REF sstm_dk_dif_kf_mdk_soll_mitko MAX_GRAD 100 MONOTONY MON_INCREASE /end AXIS_DESCR
 /begin AXIS_DESCR COM_AXIS mdk_ist MTC_NORM_16_RES51 4 0.0 119.99817 AXIS_PTS_REF sst_dk_kf_mdk_soll_auf_mitko MAX_GRAD 100 MONOTONY MON_INCREASE /end AXIS_DESCR
/end CHARACTERISTIC
/begin CHARACTERISTIC kf_mdk_soll_mitko__mdk_ist "KF_MDK_SOLL_MITKO" CURVE 0x4ab24 a_9 100 LINEAR______0_005005__148H___0_9 0.005005 0.999985
 /begin AXIS_DESCR COM_AXIS mdk_ist MTC_NORM_16_RES51 6 0.0 119.99817 AXIS_PTS_REF sstm_mdk_ist_kf_mitko MAX_GRAD 100 MONOTONY MON_INCREASE /end AXIS_DESCR
/end CHARACTERISTIC
/begin CHARACTERISTIC kf_mdk_soll_pwg_tkw1__pwg__n "KF_MDK_SOLL_PWG_TKW1" MAP 0x4ab30 a_29 100 MTC_NORM_16_RES52 0.0 119.99817
 /begin AXIS_DESCR COM_AXIS drehzahl ES_8_RES8 12 0.0 8160.0 AXIS_PTS_REF sstm_n_1_6 MAX_GRAD 100 MONOTONY MON_INCREASE /end AXIS_DESCR
 /begin AXIS_DESCR COM_AXIS dummy LINEAR______0_000000__0H___119_8 12 0.0 119.8828 AXIS_PTS_REF sstm_pwg_mdk_soll_pwg MAX_GRAD 100 MONOTONY MON_INCREASE /end AXIS_DESCR
/end CHARACTERISTIC
/begin CHARACTERISTIC kf_mdk_soll_pwg_tkw2__pwg__n "KF_MDK_SOLL_PWG_TKW2" MAP 0x4ac50 a_29 100 MTC_NORM_16_RES52 0.0 119.99817
 /begin AXIS_DESCR COM_AXIS drehzahl ES_8_RES8 12 0.0 8160.0 AXIS_PTS_REF sstm_n_1_6 MAX_GRAD 100 MONOTONY MON_INCREASE /end AXIS_DESCR
 /begin AXIS_DESCR COM_AXIS dummy LINEAR______0_000000__0H___119_8 12 0.0 119.8828 AXIS_PTS_REF sstm_pwg_mdk_soll_pwg MAX_GRAD 100 MONOTONY MON_INCREASE /end AXIS_DESCR
/end CHARACTERISTIC
/begin CHARACTERISTIC kf_mdk_soll_zu_mitko__dk__dkd "KF_MDK_SOLL_ZU_MITKO" MAP 0x4d448 a_13 100 LINEAR______0_000000__0H___0_953 0.0 0.99610001
 /begin AXIS_DESCR COM_AXIS mdk_ist MTC_NORM_16_RES51 6 0.0 119.99817 AXIS_PTS_REF sstm_dk_dif_kf_mdk_soll_mitko MAX_GRAD 100 MONOTONY MON_INCREASE /end AXIS_DESCR
 /begin AXIS_DESCR COM_AXIS mdk_ist LINEAR______0_000000__0H___11954 4 0.0 119.5 AXIS_PTS_REF sst_dk_kf_mdk_soll_zu_mitko MAX_GRAD 100 MONOTONY MON_INCREASE /end AXIS_DESCR
/end CHARACTERISTIC
/begin CHARACTERISTIC kf_mitko_kru_lu_at__n "KF_MITKO_KRU_LU_AT" CURVE 0x4ad70 a_7 100 LINEAR______0_000000__0H___0_955 0.0 0.99998474
 /begin AXIS_DESCR COM_AXIS n_32 ES_8_RES17 4 0.0 8160.0 AXIS_PTS_REF sstm_n_kf_xxxx_kru_lu_at MAX_GRAD 100 MONOTONY MON_INCREASE /end AXIS_DESCR
/end CHARACTERISTIC
/begin CHARACTERISTIC kf_mitko_kru_lu_mt__n "KF_MITKO_KRU_LU_MT" CURVE 0x4ad78 a_7 100 LINEAR______0_000000__0H___0_955 0.0 0.99998474
 /begin AXIS_DESCR COM_AXIS n_32 ES_8_RES17 4 0.0 8160.0 AXIS_PTS_REF sstm_n_kf_xxxx_kru_lu_mt MAX_GRAD 100 MONOTONY MON_INCREASE /end AXIS_DESCR
/end CHARACTERISTIC
/begin CHARACTERISTIC kf_mitko_lm_van__n__lm_ers_diag "KF_MITKO_LM_VAN" MAP 0x4d460 a_4 100 LINEAR______0_000000__0H___0_925 0.0 0.99599999
 /begin AXIS_DESCR COM_AXIS dummy MAF_8_RES 6 0.0 1389.0 AXIS_PTS_REF sst_lm_ers_diag_kf_mitko_lm_van MAX_GRAD 100 MONOTONY MON_INCREASE /end AXIS_DESCR
 /begin AXIS_DESCR COM_AXIS drehzahl ES_8_RES8 6 0.0 8160.0 AXIS_PTS_REF sst_n_kf_mitko_lm_van MAX_GRAD 100 MONOTONY MON_INCREASE /end AXIS_DESCR
/end CHARACTERISTIC
/begin CHARACTERISTIC kf_mitko_zv_i__lm_kg_h "KF_MITKO_ZV_I" CURVE 0x4ad80 a_9 100 LINEAR______0_000000__0H___0_956 0.0 0.99998474
 /begin AXIS_DESCR COM_AXIS lm_kg_h MAF_KGH_16_RES28 6 0.0 16383.75 AXIS_PTS_REF sstm_lm_kg_h_6_1 MAX_GRAD 100 MONOTONY MON_INCREASE /end AXIS_DESCR
/end CHARACTERISTIC
/begin CHARACTERISTIC kf_n_disa_tal__tal "KF_N_DISA_TAL" CURVE 0x4ad8c a_7 10 LINEAR_______1024_000000__0H__57 -1024.0 1024.0
 /begin AXIS_DESCR COM_AXIS tal LINEAR_______48_000000__0H___121 8 -48.0 142.5 AXIS_PTS_REF sst_tal_kf_n_disa_tal MAX_GRAD 100 MONOTONY MON_INCREASE /end AXIS_DESCR
/end CHARACTERISTIC
/begin CHARACTERISTIC kf_n_el__tka "KF_N_EL" CURVE 0x4d484 a_3 100 LINEAR______0_000000__0H___15_94 0.0 15.94
 /begin AXIS_DESCR COM_AXIS tco_ex LINEAR_______48_000000__0H___142 6 -48.0 142.5 AXIS_PTS_REF sst_tka_kf_n_el MAX_GRAD 100 MONOTONY MON_INCREASE /end AXIS_DESCR
/end CHARACTERISTIC
/begin CHARACTERISTIC kf_n_el_temp_kat__temp_kat "KF_N_EL_TEMP_KAT" CURVE 0x4d48a a_3 100 LINEAR______0_000000__0H___15_94 0.0 15.94
 /begin AXIS_DESCR COM_AXIS temp_gmw_ers_kat LINEAR_______33_000000__0H___990 6 -33.0 990.0 AXIS_PTS_REF sstm_temp_kat_6_1 MAX_GRAD 100 MONOTONY MON_INCREASE /end AXIS_DESCR
/end CHARACTERISTIC
/begin CHARACTERISTIC kf_n_el_tv_kor__tv "KF_N_EL_TV_KOR" CURVE 0x4d490 a_3 100 LINEAR______0_000000__0H___0_996 0.0 0.99610001
 /begin AXIS_DESCR COM_AXIS geschwind LINEAR______0_000000__0H___25558 5 0.0 255.0 AXIS_PTS_REF sst_tv_kf_n_el_tv_kor MAX_GRAD 100 MONOTONY MON_INCREASE /end AXIS_DESCR
/end CHARACTERISTIC
/begin CHARACTERISTIC kf_n_min_diag_sl__fak_pu "KF_N_MIN_DIAG_SL" CURVE 0x4d495 a_19 10 ES_8_RES 0.0 8160.0
 /begin AXIS_DESCR COM_AXIS fak_pu LINEAR______0_000000__0H___2_000 6 0.0 2.0 AXIS_PTS_REF sstm_fak_pu_5_22 MAX_GRAD 10 MONOTONY MON_INCREASE /end AXIS_DESCR
/end CHARACTERISTIC
/begin CHARACTERISTIC kf_n_proz_el__n_el_kor_fil "KF_N_PROZ_EL" CURVE 0x4d49b a_3 100 LINEAR______0_000000__0H___99_61 0.0 99.610001
 /begin AXIS_DESCR COM_AXIS n_el_kor_fil LINEAR______0_000000__0H___15_94 6 0.0 15.94 AXIS_PTS_REF sst_n_el_kor_kf_n_proz_el_fil MAX_GRAD 100 MONOTONY MON_INCREASE /end AXIS_DESCR
/end CHARACTERISTIC
/begin CHARACTERISTIC kf_nmax_abf__tkw "KF_NMAX_ABF" CURVE 0x4d4a1 a_3 100 ES_8_RES 0.0 8160.0
 /begin AXIS_DESCR COM_AXIS tkw LINEAR_______48_000000__0H___142 3 -48.0 142.5 AXIS_PTS_REF sst_tkw_kf_nmax_abf MAX_GRAD 100 MONOTONY MON_INCREASE /end AXIS_DESCR
/end CHARACTERISTIC
/begin CHARACTERISTIC kf_nmax_diag__dk "KF_NMAX_DIAG" CURVE 0x4d4a4 a_3 10 ES_8_RES41 0.0 8160.0
 /begin AXIS_DESCR COM_AXIS pwg_ist LINEAR______0_000000__0H___11959 3 0.0 119.5 AXIS_PTS_REF sstm_dk_kf_nmax_diag_x MAX_GRAD 100 MONOTONY MON_INCREASE /end AXIS_DESCR
/end CHARACTERISTIC
/begin CHARACTERISTIC kf_nmax_ob_st__tkw "KF_NMAX_OB_ST" CURVE 0x4d4a7 a_3 10 ES_8_RES8 0.0 8160.0
 /begin AXIS_DESCR COM_AXIS tkw LINEAR_______48_000000__0H___114 4 -48.0 142.5 AXIS_PTS_REF sstm_tkw_2_6 MAX_GRAD 100 MONOTONY MON_INCREASE /end AXIS_DESCR
/end CHARACTERISTIC
/begin CHARACTERISTIC kf_nmin_sa__tkw "KF_NMIN_SA" CURVE 0x4d4ab a_3 100 ES_8_RES8 0.0 8160.0
 /begin AXIS_DESCR COM_AXIS tkw LINEAR_______48_000000__0H___121 6 -48.0 142.5 AXIS_PTS_REF sstm_tkw_1_6 MAX_GRAD 100 MONOTONY MON_INCREASE /end AXIS_DESCR
/end CHARACTERISTIC
/begin CHARACTERISTIC kf_nmin_sa_kk__tkw "KF_NMIN_SA_KK" CURVE 0x4d4b1 a_3 100 ES_8_RES8 0.0 8160.0
 /begin AXIS_DESCR COM_AXIS tkw LINEAR_______48_000000__0H___121 6 -48.0 142.5 AXIS_PTS_REF sstm_tkw_1_6 MAX_GRAD 100 MONOTONY MON_INCREASE /end AXIS_DESCR
/end CHARACTERISTIC
/begin CHARACTERISTIC kf_nr_kf_lm__vue "KF_NR_KF_LM" CURVE 0x4ad9c a_9 100 LINEAR______1_000000__100H___8_0 1.0 8.0
 /begin AXIS_DESCR COM_AXIS vue LINEAR______0_000000__0H___120_0 8 0.0 120.0 AXIS_PTS_REF sst_vue_kf_nr_kf_lm MAX_GRAD 100 MONOTONY MON_INCREASE /end AXIS_DESCR
/end CHARACTERISTIC
/begin CHARACTERISTIC kf_nr_ti_ks__zw_dif "KF_NR_TI_KS" CURVE 0x4adac a_7 10 LINEAR______1_000000__100H___5_0 1.0 5.0
 /begin AXIS_DESCR COM_AXIS dummy LINEAR______0_000000__0H___95_62 5 0.0 95.625 AXIS_PTS_REF sst_zw_dif_kf_nr_ti_ks MAX_GRAD 100 MONOTONY MON_INCREASE /end AXIS_DESCR
/end CHARACTERISTIC
/begin CHARACTERISTIC kf_nsoll_add_heiz__tkw "KF_NSOLL_ADD_HEIZ" CURVE 0x4adb6 a_7 100 LINEAR______0_000000__0H___1000_ 0.0 1000.0
 /begin AXIS_DESCR COM_AXIS tkw LINEAR_______48_000000__0H___121 6 -48.0 142.5 AXIS_PTS_REF sstm_tkw_1_6 MAX_GRAD 100 MONOTONY MON_INCREASE /end AXIS_DESCR
/end CHARACTERISTIC
/begin CHARACTERISTIC kf_nsoll_add_kat2__tkw_st "KF_NSOLL_ADD_KAT2" CURVE 0x4adc2 a_7 100 LINEAR______0_000000__0H___10032 0.0 1000.0
 /begin AXIS_DESCR COM_AXIS tkw_st LINEAR_______48_000000__0H___133 8 -48.0 142.5 AXIS_PTS_REF sstm_tkw_st_2_8 MAX_GRAD 100 MONOTONY MON_INCREASE /end AXIS_DESCR
/end CHARACTERISTIC
/begin CHARACTERISTIC kf_nsoll_add_kup_swi__tkw "KF_NSOLL_ADD_KUP_SWI" CURVE 0x4add2 a_7 100 LINEAR______0_000000__0H___10060 0.0 1000.0
 /begin AXIS_DESCR COM_AXIS tkw LINEAR_______48_000000__0H___121 6 -48.0 142.5 AXIS_PTS_REF sstm_tkw_1_6 MAX_GRAD 100 MONOTONY MON_INCREASE /end AXIS_DESCR
/end CHARACTERISTIC
/begin CHARACTERISTIC kf_nsoll_aebg_kat2__tkw "KF_NSOLL_AEBG_KAT2" CURVE 0x4d4b7 a_3 10 LINEAR______0_031250__1H___7_968 0.03125 7.96875
 /begin AXIS_DESCR COM_AXIS tkw LINEAR_______48_000000__0H___142 8 -48.0 142.5 AXIS_PTS_REF sst_tkw_kf_nsoll_aebg_kat2 MAX_GRAD 100 MONOTONY MON_INCREASE /end AXIS_DESCR
/end CHARACTERISTIC
/begin CHARACTERISTIC kf_nsoll_ll__tkw "KF_NSOLL_LL" CURVE 0x4adde a_7 3 LINEAR______0_000000__0H___81631 0.0 8160.0
 /begin AXIS_DESCR COM_AXIS tkw LINEAR_______48_000000__0H___121 6 -48.0 142.5 AXIS_PTS_REF sstm_tkw_1_6 MAX_GRAD 100 MONOTONY MON_INCREASE /end AXIS_DESCR
/end CHARACTERISTIC
/begin CHARACTERISTIC kf_nwsoll_add_kat2_ll_a__tkw_st "KF_NWSOLL_ADD_KAT2_LL_A" CURVE 0x4d4bf a_3 100 LINEAR_______47_625000__1H___47_ -47.625 47.625
 /begin AXIS_DESCR COM_AXIS tkw_st LINEAR_______48_000000__0H___142 8 -48.0 142.5 AXIS_PTS_REF sstm_tkw_st_kf_nwsoll_add_kat2 MAX_GRAD 100 MONOTONY MON_INCREASE /end AXIS_DESCR
/end CHARACTERISTIC
/begin CHARACTERISTIC kf_nwsoll_add_kat2_ll_e__tkw_st "KF_NWSOLL_ADD_KAT2_LL_E" CURVE 0x4d4c7 a_3 100 LINEAR_______48_000000__0H___47_ -48.0 47.625
 /begin AXIS_DESCR COM_AXIS tkw_st LINEAR_______48_000000__0H___142 8 -48.0 142.5 AXIS_PTS_REF sstm_tkw_st_kf_nwsoll_add_kat2 MAX_GRAD 100 MONOTONY MON_INCREASE /end AXIS_DESCR
/end CHARACTERISTIC
/begin CHARACTERISTIC kf_nwsoll_fak_ll_a__tkw__tkw_st "KF_NWSOLL_FAK_LL_A" MAP 0x4d4d9 a_4 100 LINEAR_______4_000000__0H___3_97 -4.0 3.97
 /begin AXIS_DESCR COM_AXIS tkw_st LINEAR_______48_000000__0H___142 8 -48.0 142.5 AXIS_PTS_REF sstm_tkw_st_6_7 MAX_GRAD 100 MONOTONY MON_INCREASE /end AXIS_DESCR
 /begin AXIS_DESCR COM_AXIS tkw LINEAR_______48_000000__0H___142 8 -48.0 142.5 AXIS_PTS_REF sstm_tkw_6_7 MAX_GRAD 100 MONOTONY MON_INCREASE /end AXIS_DESCR
/end CHARACTERISTIC
/begin CHARACTERISTIC kf_nwsoll_fak_ll_e__tkw__tkw_st "KF_NWSOLL_FAK_LL_E" MAP 0x4d519 a_4 100 LINEAR_______4_000000__0H___3_61 -4.0 3.97
 /begin AXIS_DESCR COM_AXIS tkw_st LINEAR_______48_000000__0H___142 8 -48.0 142.5 AXIS_PTS_REF sstm_tkw_st_6_7 MAX_GRAD 100 MONOTONY MON_INCREASE /end AXIS_DESCR
 /begin AXIS_DESCR COM_AXIS tkw LINEAR_______48_000000__0H___142 8 -48.0 142.5 AXIS_PTS_REF sstm_tkw_6_7 MAX_GRAD 100 MONOTONY MON_INCREASE /end AXIS_DESCR
/end CHARACTERISTIC
/begin CHARACTERISTIC kf_nwsoll_fak_tl_a__tkw__tkw_st "KF_NWSOLL_FAK_TL_A" MAP 0x4d559 a_4 100 LINEAR_______4_000000__0H___3_97 -4.0 3.97
 /begin AXIS_DESCR COM_AXIS tkw_st LINEAR_______48_000000__0H___142 8 -48.0 142.5 AXIS_PTS_REF sstm_tkw_st_6_7 MAX_GRAD 100 MONOTONY MON_INCREASE /end AXIS_DESCR
 /begin AXIS_DESCR COM_AXIS tkw LINEAR_______48_000000__0H___142 8 -48.0 142.5 AXIS_PTS_REF sstm_tkw_6_7 MAX_GRAD 100 MONOTONY MON_INCREASE /end AXIS_DESCR
/end CHARACTERISTIC
/begin CHARACTERISTIC kf_nwsoll_fak_tl_e__tkw__tkw_st "KF_NWSOLL_FAK_TL_E" MAP 0x4d599 a_4 100 LINEAR_______4_000000__0H___3_97 -4.0 3.97
 /begin AXIS_DESCR COM_AXIS tkw_st LINEAR_______48_000000__0H___142 8 -48.0 142.5 AXIS_PTS_REF sstm_tkw_st_6_7 MAX_GRAD 100 MONOTONY MON_INCREASE /end AXIS_DESCR
 /begin AXIS_DESCR COM_AXIS tkw LINEAR_______48_000000__0H___142 8 -48.0 142.5 AXIS_PTS_REF sstm_tkw_6_7 MAX_GRAD 100 MONOTONY MON_INCREASE /end AXIS_DESCR
/end CHARACTERISTIC
/begin CHARACTERISTIC kf_nwsoll_tkw1_ll_a__n__lm_van "KF_NWSOLL_TKW1_LL_A" MAP 0x4d5d9 a_13 100 LINEAR_______155_625000__FFH____ -155.625 -60.0
 /begin AXIS_DESCR COM_AXIS lm_van MAF_16_RES49 6 0.0 1389.0 AXIS_PTS_REF sstm_lm_van_kf_nwsoll_tkwx_ll_y MAX_GRAD 100 MONOTONY MON_INCREASE /end AXIS_DESCR
 /begin AXIS_DESCR COM_AXIS drehzahl IS_13_RES62 6 0.0 8160.0 AXIS_PTS_REF sstm_n_kf_nwsoll_tkwx_ll_y MAX_GRAD 100 MONOTONY MON_INCREASE /end AXIS_DESCR
/end CHARACTERISTIC
/begin CHARACTERISTIC kf_nwsoll_tkw1_ll_e__n__lm_van "KF_NWSOLL_TKW1_LL_E" MAP 0x4d5fd a_13 100 LINEAR______60_000000__0H___155_ 60.0 155.625
 /begin AXIS_DESCR COM_AXIS lm_van MAF_16_RES49 6 0.0 1389.0 AXIS_PTS_REF sstm_lm_van_kf_nwsoll_tkwx_ll_y MAX_GRAD 100 MONOTONY MON_INCREASE /end AXIS_DESCR
 /begin AXIS_DESCR COM_AXIS drehzahl IS_13_RES62 6 0.0 8160.0 AXIS_PTS_REF sstm_n_kf_nwsoll_tkwx_ll_y MAX_GRAD 100 MONOTONY MON_INCREASE /end AXIS_DESCR
/end CHARACTERISTIC
/begin CHARACTERISTIC kf_nwsoll_tkw1_tl_a__n__lm_van "KF_NWSOLL_TKW1_TL_A" MAP 0x4d621 a_13 100 LINEAR_______155_625000__FFH____ -155.625 -60.0
 /begin AXIS_DESCR COM_AXIS lm_van MAF_16_RES49 12 0.0 1389.0 AXIS_PTS_REF sstm_lm_van_kf_nwsoll_tkwx_tl_y MAX_GRAD 100 MONOTONY MON_INCREASE /end AXIS_DESCR
 /begin AXIS_DESCR COM_AXIS drehzahl IS_13_RES62 16 0.0 8160.0 AXIS_PTS_REF sstm_n_16_3 MAX_GRAD 100 MONOTONY MON_INCREASE /end AXIS_DESCR
/end CHARACTERISTIC
/begin CHARACTERISTIC kf_nwsoll_tkw1_tl_e__n__lm_van "KF_NWSOLL_TKW1_TL_E" MAP 0x4d6e1 a_13 100 LINEAR______60_000000__0H___155_ 60.0 155.625
 /begin AXIS_DESCR COM_AXIS lm_van MAF_16_RES49 12 0.0 1389.0 AXIS_PTS_REF sstm_lm_van_kf_nwsoll_tkwx_tl_y MAX_GRAD 100 MONOTONY MON_INCREASE /end AXIS_DESCR
 /begin AXIS_DESCR COM_AXIS drehzahl IS_13_RES62 16 0.0 8160.0 AXIS_PTS_REF sstm_n_16_3 MAX_GRAD 100 MONOTONY MON_INCREASE /end AXIS_DESCR
/end CHARACTERISTIC
/begin CHARACTERISTIC kf_nwsoll_tkw1_vl_a__n "KF_NWSOLL_TKW1_VL_A" CURVE 0x4d7a1 a_19 100 LINEAR_______155_625000__FFH__63 -155.625 -60.0
 /begin AXIS_DESCR COM_AXIS drehzahl IS_13_RES62 16 0.0 8160.0 AXIS_PTS_REF sstm_n_16_3 MAX_GRAD 100 MONOTONY MON_INCREASE /end AXIS_DESCR
/end CHARACTERISTIC
/begin CHARACTERISTIC kf_nwsoll_tkw1_vl_e__n "KF_NWSOLL_TKW1_VL_E" CURVE 0x4d7b1 a_19 100 LINEAR______60_000000__0H___1564 60.0 155.625
 /begin AXIS_DESCR COM_AXIS drehzahl IS_13_RES62 16 0.0 8160.0 AXIS_PTS_REF sstm_n_16_3 MAX_GRAD 100 MONOTONY MON_INCREASE /end AXIS_DESCR
/end CHARACTERISTIC
/begin CHARACTERISTIC kf_nwsoll_tkw2_ll_a__n__lm_van "KF_NWSOLL_TKW2_LL_A" MAP 0x4d7c1 a_13 100 LINEAR_______155_625000__FFH____ -155.625 -60.0
 /begin AXIS_DESCR COM_AXIS lm_van MAF_16_RES49 6 0.0 1389.0 AXIS_PTS_REF sstm_lm_van_kf_nwsoll_tkwx_ll_y MAX_GRAD 100 MONOTONY MON_INCREASE /end AXIS_DESCR
 /begin AXIS_DESCR COM_AXIS drehzahl IS_13_RES62 6 0.0 8160.0 AXIS_PTS_REF sstm_n_kf_nwsoll_tkwx_ll_y MAX_GRAD 100 MONOTONY MON_INCREASE /end AXIS_DESCR
/end CHARACTERISTIC
/begin CHARACTERISTIC kf_nwsoll_tkw2_ll_e__n__lm_van "KF_NWSOLL_TKW2_LL_E" MAP 0x4d7e5 a_13 100 LINEAR______60_000000__0H___155_ 60.0 155.625
 /begin AXIS_DESCR COM_AXIS lm_van MAF_16_RES49 6 0.0 1389.0 AXIS_PTS_REF sstm_lm_van_kf_nwsoll_tkwx_ll_y MAX_GRAD 100 MONOTONY MON_INCREASE /end AXIS_DESCR
 /begin AXIS_DESCR COM_AXIS drehzahl IS_13_RES62 6 0.0 8160.0 AXIS_PTS_REF sstm_n_kf_nwsoll_tkwx_ll_y MAX_GRAD 100 MONOTONY MON_INCREASE /end AXIS_DESCR
/end CHARACTERISTIC
/begin CHARACTERISTIC kf_nwsoll_tkw2_tl_a__n__lm_van "KF_NWSOLL_TKW2_TL_A" MAP 0x4d809 a_13 100 LINEAR_______155_625000__FFH____ -155.625 -60.0
 /begin AXIS_DESCR COM_AXIS lm_van MAF_16_RES49 12 0.0 1389.0 AXIS_PTS_REF sstm_lm_van_kf_nwsoll_tkwx_tl_y MAX_GRAD 100 MONOTONY MON_INCREASE /end AXIS_DESCR
 /begin AXIS_DESCR COM_AXIS drehzahl IS_13_RES62 16 0.0 8160.0 AXIS_PTS_REF sstm_n_16_3 MAX_GRAD 100 MONOTONY MON_INCREASE /end AXIS_DESCR
/end CHARACTERISTIC
/begin CHARACTERISTIC kf_nwsoll_tkw2_tl_e__n__lm_van "KF_NWSOLL_TKW2_TL_E" MAP 0x4d8c9 a_13 100 LINEAR______60_000000__0H___155_ 60.0 155.625
 /begin AXIS_DESCR COM_AXIS lm_van MAF_16_RES49 12 0.0 1389.0 AXIS_PTS_REF sstm_lm_van_kf_nwsoll_tkwx_tl_y MAX_GRAD 100 MONOTONY MON_INCREASE /end AXIS_DESCR
 /begin AXIS_DESCR COM_AXIS drehzahl IS_13_RES62 16 0.0 8160.0 AXIS_PTS_REF sstm_n_16_3 MAX_GRAD 100 MONOTONY MON_INCREASE /end AXIS_DESCR
/end CHARACTERISTIC
/begin CHARACTERISTIC kf_nwsoll_tkw2_vl_a__n "KF_NWSOLL_TKW2_VL_A" CURVE 0x4d989 a_19 100 LINEAR_______155_625000__FFH__63 -155.625 -60.0
 /begin AXIS_DESCR COM_AXIS drehzahl IS_13_RES62 16 0.0 8160.0 AXIS_PTS_REF sstm_n_16_3 MAX_GRAD 100 MONOTONY MON_INCREASE /end AXIS_DESCR
/end CHARACTERISTIC
/begin CHARACTERISTIC kf_nwsoll_tkw2_vl_e__n "KF_NWSOLL_TKW2_VL_E" CURVE 0x4d999 a_19 100 LINEAR______60_000000__0H___1564 60.0 155.625
 /begin AXIS_DESCR COM_AXIS drehzahl IS_13_RES62 16 0.0 8160.0 AXIS_PTS_REF sstm_n_16_3 MAX_GRAD 100 MONOTONY MON_INCREASE /end AXIS_DESCR
/end CHARACTERISTIC
/begin CHARACTERISTIC kf_o2_kat1__uls_kat1 "KF_O2_KAT1" CURVE 0x4d9af a_3 100 LINEAR______0_000000__0H___0_965 0.0 0.99609375
 /begin AXIS_DESCR COM_AXIS dummy LINEAR______0_000000__0H___1_275 6 0.0 1.275 AXIS_PTS_REF sstm_uls_kat_6_1 MAX_GRAD 100 MONOTONY MON_INCREASE /end AXIS_DESCR
/end CHARACTERISTIC
/begin CHARACTERISTIC kf_o2_kat2__uls_kat2 "KF_O2_KAT2" CURVE 0x4d9b5 a_3 100 LINEAR______0_000000__0H___0_965 0.0 0.99609375
 /begin AXIS_DESCR COM_AXIS dummy LINEAR______0_000000__0H___1_275 6 0.0 1.275 AXIS_PTS_REF sstm_uls_kat_6_1 MAX_GRAD 100 MONOTONY MON_INCREASE /end AXIS_DESCR
/end CHARACTERISTIC
/begin CHARACTERISTIC kf_p_ini_ns__tkw "KF_P_INI_NS" CURVE 0x4adea a_7 100 LINEAR______0_000000__0H___54366 0.0 5434.2598
 /begin AXIS_DESCR COM_AXIS tkw LINEAR_______48_000000__0H___142 4 -48.0 142.5 AXIS_PTS_REF sst_tkw_kf_p_ini_ns MAX_GRAD 100 MONOTONY MON_INCREASE /end AXIS_DESCR
/end CHARACTERISTIC
/begin CHARACTERISTIC kf_pq_hs_m__n__mdk_sum "KF_PQ_HS_M" MAP 0x4d9bb a_11 100 LINEAR______0_000000__0H___0_967 0.0 0.99609375
 /begin AXIS_DESCR COM_AXIS dummy MTC_NORM_16_RES68 8 0.0 119.99817 AXIS_PTS_REF sst_mdk_sum_kf_pq_hs_m MAX_GRAD 100 MONOTONY MON_INCREASE /end AXIS_DESCR
 /begin AXIS_DESCR COM_AXIS n_32 ES_8_RES8 8 0.0 8160.0 AXIS_PTS_REF sst_n_kf_pq_hs_m MAX_GRAD 100 MONOTONY MON_INCREASE /end AXIS_DESCR
/end CHARACTERISTIC
/begin CHARACTERISTIC kf_pwg_dec_fgr__n_32 "KF_PWG_DEC_FGR" CURVE 0x4adf2 a_7 10 MTC_NORM_16_RES10 0.0 119.99817
 /begin AXIS_DESCR COM_AXIS n_32 LINEAR______0_000000__0H___81669 5 0.0 8169.0 AXIS_PTS_REF sst_n_32 MAX_GRAD 100 MONOTONY MON_INCREASE /end AXIS_DESCR
/end CHARACTERISTIC
/begin CHARACTERISTIC kf_pwg_dif_neg_fak__pwg_max__n "KF_PWG_DIF_NEG_FAK" MAP 0x4d9fb a_2 100 LINEAR______0_000000__0H___15_70 0.0 15.94
 /begin AXIS_DESCR COM_AXIS n_32 ES_8_RES 8 0.0 8160.0 AXIS_PTS_REF sstm_n_8_1 MAX_GRAD 100 MONOTONY MON_INCREASE /end AXIS_DESCR
 /begin AXIS_DESCR COM_AXIS pwg_max MTC_NORM_16_RES 12 0.0 119.99817 AXIS_PTS_REF sstm_pwg_max_12_1 MAX_GRAD 100 MONOTONY MON_INCREASE /end AXIS_DESCR
/end CHARACTERISTIC
/begin CHARACTERISTIC kf_pwg_fak_kat_zw__zwdifkt__pwg "KF_PWG_FAK_KAT_ZW" MAP 0x4da5b a_4 100 LINEAR______1_000000__80H___1_71 1.0 1.992
 /begin AXIS_DESCR COM_AXIS pwg_ist LINEAR______0_000000__0H___11972 2 0.0 119.5 AXIS_PTS_REF sst_pwg_fak_kat_zw MAX_GRAD 100 MONOTONY MON_INCREASE /end AXIS_DESCR
 /begin AXIS_DESCR COM_AXIS iga_ch_offsetvbyteC1D LINEAR_______48_000000__0H___0_0 6 -48.0 0.0 AXIS_PTS_REF sstm_zwdifkt_1_6 MAX_GRAD 100 MONOTONY MON_INCREASE /end AXIS_DESCR
/end CHARACTERISTIC
/begin CHARACTERISTIC kf_pwg_fak_kup_swi__ndif__pwgist "KF_PWG_FAK_KUP_SWI" MAP 0x4da67 a_13 100 LINEAR______0_000000__0H___0_953 0.0 0.99610001
 /begin AXIS_DESCR COM_AXIS pwg_ist MTC_NORM_16_RES73 2 0.0 119.99817 AXIS_PTS_REF sst_pwg_ist_kf_pwg_fak_kup_swi MAX_GRAD 100 MONOTONY MON_INCREASE /end AXIS_DESCR
 /begin AXIS_DESCR COM_AXIS n_dif LINEAR_______32768_000000__0H___ 6 -32768.0 32767.0 AXIS_PTS_REF sst_n_dif_kf_pwg_fak_kup_swi MAX_GRAD 100 MONOTONY MON_INCREASE /end AXIS_DESCR
/end CHARACTERISTIC
/begin CHARACTERISTIC kf_pwg_fgr_max__v_fil "KF_PWG_FGR_MAX" CURVE 0x4adfc a_9 100 MTC_NORM_16_RES10 0.0 119.99817
 /begin AXIS_DESCR COM_AXIS v_fil LINEAR______0_000000__0H___51174 4 0.0 511.99218 AXIS_PTS_REF sst_v_fil_kf_pwg_fgr_max MAX_GRAD 100 MONOTONY MON_INCREASE /end AXIS_DESCR
/end CHARACTERISTIC
/begin CHARACTERISTIC kf_pwg_fgr_min_set__vsoll_fgr "KF_PWG_FGR_MIN_SET" CURVE 0x4ae04 a_9 100 MTC_NORM_16_RES10 0.0 119.99817
 /begin AXIS_DESCR COM_AXIS v_soll_fgr LINEAR______0_000000__0H___511_9 5 0.0 511.99218 AXIS_PTS_REF sstm_vsoll_fgr MAX_GRAD 100 MONOTONY MON_INCREASE /end AXIS_DESCR
/end CHARACTERISTIC
/begin CHARACTERISTIC kf_pwg_llfs_fak__pwg_kor__n "KF_PWG_LLFS_FAK" MAP 0x4da73 a_2 100 LINEAR______0_000000__0H___3_975 0.0 3.984375
 /begin AXIS_DESCR COM_AXIS drehzahl ES_8_RES8 12 0.0 8160.0 AXIS_PTS_REF sst_n_kf_pwg_llfs_fak MAX_GRAD 100 MONOTONY MON_INCREASE /end AXIS_DESCR
 /begin AXIS_DESCR COM_AXIS dummy LINEAR______0_000000__0H___11976 12 0.0 119.5 AXIS_PTS_REF sst_pwg_kor_kf_pwg_llfs_fak MAX_GRAD 100 MONOTONY MON_INCREASE /end AXIS_DESCR
/end CHARACTERISTIC
/begin CHARACTERISTIC kf_pwg_llfs_tallfs__tallfs "KF_PWG_LLFS_TALLFS" CURVE 0x4ae0e a_9 100 LINEAR______0_000000__0H___102_0 0.0 102.0
 /begin AXIS_DESCR COM_AXIS tallfs_last_ges TALLFS 12 0.0 399.9938 AXIS_PTS_REF sst_tallfs_kf_pwg_llfs_tallfs MAX_GRAD 100 MONOTONY MON_INCREASE /end AXIS_DESCR
/end CHARACTERISTIC
/begin CHARACTERISTIC kf_pwg_m_ind_tkw1__n__m_ind "KF_PWG_M_IND_TKW1" MAP 0x4ae26 a_43 100 LINEAR______0_000000__0H___11977 0.0 119.8828
 /begin AXIS_DESCR COM_AXIS dummy LINEAR______0_000000__0H___1023_ 12 0.0 1023.0 AXIS_PTS_REF sstm_m_ind_4_2 MAX_GRAD 100 MONOTONY MON_INCREASE /end AXIS_DESCR
 /begin AXIS_DESCR COM_AXIS n_32 ES_8_RES17 12 0.0 8160.0 AXIS_PTS_REF sstm_n_4_2 MAX_GRAD 100 MONOTONY MON_INCREASE /end AXIS_DESCR
/end CHARACTERISTIC
/begin CHARACTERISTIC kf_pwg_m_ind_tkw2__n__m_ind "KF_PWG_M_IND_TKW2" MAP 0x4af46 a_43 100 LINEAR______0_000000__0H___11977 0.0 119.8828
 /begin AXIS_DESCR COM_AXIS dummy LINEAR______0_000000__0H___1023_ 12 0.0 1023.0 AXIS_PTS_REF sstm_m_ind_4_2 MAX_GRAD 100 MONOTONY MON_INCREASE /end AXIS_DESCR
 /begin AXIS_DESCR COM_AXIS n_32 ES_8_RES17 12 0.0 8160.0 AXIS_PTS_REF sstm_n_4_2 MAX_GRAD 100 MONOTONY MON_INCREASE /end AXIS_DESCR
/end CHARACTERISTIC
/begin CHARACTERISTIC kf_pwg_min_ak_at_1__n "KF_PWG_MIN_AK_AT_1" CURVE 0x4db03 a_3 100 MTC_NORM_8_RES 0.0 119.53125
 /begin AXIS_DESCR COM_AXIS n_32 ES_8_RES41 5 0.0 8160.0 AXIS_PTS_REF sstm_n_5_1 MAX_GRAD 100 MONOTONY MON_INCREASE /end AXIS_DESCR
/end CHARACTERISTIC
/begin CHARACTERISTIC kf_pwg_min_ak_at_2__n "KF_PWG_MIN_AK_AT_2" CURVE 0x4db08 a_3 100 MTC_NORM_8_RES 0.0 119.53125
 /begin AXIS_DESCR COM_AXIS n_32 ES_8_RES41 5 0.0 8160.0 AXIS_PTS_REF sstm_n_5_1 MAX_GRAD 100 MONOTONY MON_INCREASE /end AXIS_DESCR
/end CHARACTERISTIC
/begin CHARACTERISTIC kf_pwg_min_ak_at_3__n "KF_PWG_MIN_AK_AT_3" CURVE 0x4db0d a_3 100 MTC_NORM_8_RES 0.0 119.53125
 /begin AXIS_DESCR COM_AXIS n_32 ES_8_RES41 5 0.0 8160.0 AXIS_PTS_REF sstm_n_5_1 MAX_GRAD 100 MONOTONY MON_INCREASE /end AXIS_DESCR
/end CHARACTERISTIC
/begin CHARACTERISTIC kf_pwg_min_ak_at_4__n "KF_PWG_MIN_AK_AT_4" CURVE 0x4db12 a_3 100 MTC_NORM_8_RES 0.0 119.53125
 /begin AXIS_DESCR COM_AXIS n_32 ES_8_RES41 5 0.0 8160.0 AXIS_PTS_REF sstm_n_5_1 MAX_GRAD 100 MONOTONY MON_INCREASE /end AXIS_DESCR
/end CHARACTERISTIC
/begin CHARACTERISTIC kf_pwg_min_ak_at_5__n "KF_PWG_MIN_AK_AT_5" CURVE 0x4db17 a_3 100 MTC_NORM_8_RES 0.0 119.53125
 /begin AXIS_DESCR COM_AXIS n_32 ES_8_RES41 5 0.0 8160.0 AXIS_PTS_REF sstm_n_5_1 MAX_GRAD 100 MONOTONY MON_INCREASE /end AXIS_DESCR
/end CHARACTERISTIC
/begin CHARACTERISTIC kf_pwg_min_ak_mt_1__n "KF_PWG_MIN_AK_MT_1" CURVE 0x4db1c a_3 100 MTC_NORM_8_RES 0.0 119.53125
 /begin AXIS_DESCR COM_AXIS n_32 ES_8_RES41 5 0.0 8160.0 AXIS_PTS_REF sstm_n_5_1 MAX_GRAD 100 MONOTONY MON_INCREASE /end AXIS_DESCR
/end CHARACTERISTIC
/begin CHARACTERISTIC kf_pwg_min_ak_mt_2__n "KF_PWG_MIN_AK_MT_2" CURVE 0x4db21 a_3 100 MTC_NORM_8_RES 0.0 119.53125
 /begin AXIS_DESCR COM_AXIS n_32 ES_8_RES41 5 0.0 8160.0 AXIS_PTS_REF sstm_n_5_1 MAX_GRAD 100 MONOTONY MON_INCREASE /end AXIS_DESCR
/end CHARACTERISTIC
/begin CHARACTERISTIC kf_pwg_min_ak_mt_3__n "KF_PWG_MIN_AK_MT_3" CURVE 0x4db26 a_3 100 MTC_NORM_8_RES 0.0 119.53125
 /begin AXIS_DESCR COM_AXIS n_32 ES_8_RES41 5 0.0 8160.0 AXIS_PTS_REF sstm_n_5_1 MAX_GRAD 100 MONOTONY MON_INCREASE /end AXIS_DESCR
/end CHARACTERISTIC
/begin CHARACTERISTIC kf_pwg_min_ak_mt_4__n "KF_PWG_MIN_AK_MT_4" CURVE 0x4db2b a_3 100 MTC_NORM_8_RES 0.0 119.53125
 /begin AXIS_DESCR COM_AXIS n_32 ES_8_RES41 5 0.0 8160.0 AXIS_PTS_REF sstm_n_5_1 MAX_GRAD 100 MONOTONY MON_INCREASE /end AXIS_DESCR
/end CHARACTERISTIC
/begin CHARACTERISTIC kf_pwg_min_ak_mt_5__n "KF_PWG_MIN_AK_MT_5" CURVE 0x4db30 a_3 100 MTC_NORM_8_RES 0.0 119.53125
 /begin AXIS_DESCR COM_AXIS n_32 ES_8_RES41 5 0.0 8160.0 AXIS_PTS_REF sstm_n_5_1 MAX_GRAD 100 MONOTONY MON_INCREASE /end AXIS_DESCR
/end CHARACTERISTIC
/begin CHARACTERISTIC kf_schw_ll_lu_diag__n__lm "KF_SCHW_LL_LU_DIAG" MAP 0x4b066 a_29 5 INVERS_MIS_16_RES -32767.0 -1.0
 /begin AXIS_DESCR COM_AXIS lm MAF_8_RES37 4 0.0 1389.0 AXIS_PTS_REF sst_lm_kf_schw_ll_lu_diag MAX_GRAD 7 MONOTONY MON_INCREASE /end AXIS_DESCR
 /begin AXIS_DESCR COM_AXIS drehzahl IS_13_RES78 4 0.0 8160.0 AXIS_PTS_REF sst_n_kf_schw_ll_lu_diag MAX_GRAD 12 MONOTONY MON_INCREASE /end AXIS_DESCR
/end CHARACTERISTIC
/begin CHARACTERISTIC kf_schw_lu_at__n__lm "KF_SCHW_LU_AT" MAP 0x4b086 a_43 5 INVERS_MIS_16_RES -32767.0 -1.0
 /begin AXIS_DESCR COM_AXIS lm MAF_16_RES79 6 0.0 1389.0 AXIS_PTS_REF sstm_lm_1_22 MAX_GRAD 100 MONOTONY MON_INCREASE /end AXIS_DESCR
 /begin AXIS_DESCR COM_AXIS drehzahl ES_8_RES8 12 0.0 8160.0 AXIS_PTS_REF sst_n_kf_schw_lu_at MAX_GRAD 100 MONOTONY MON_INCREASE /end AXIS_DESCR
/end CHARACTERISTIC
/begin CHARACTERISTIC kf_schw_lu_mt__n__lm "KF_SCHW_LU_MT" MAP 0x4b116 a_43 5 INVERS_MIS_16_RES -32767.0 -1.0
 /begin AXIS_DESCR COM_AXIS lm MAF_16_RES79 6 0.0 1389.0 AXIS_PTS_REF sstm_lm_1_22 MAX_GRAD 100 MONOTONY MON_INCREASE /end AXIS_DESCR
 /begin AXIS_DESCR COM_AXIS drehzahl ES_8_RES8 12 0.0 8160.0 AXIS_PTS_REF sst_n_kf_schw_lu_mt MAX_GRAD 100 MONOTONY MON_INCREASE /end AXIS_DESCR
/end CHARACTERISTIC
/begin CHARACTERISTIC kf_schw_rad_grd_sws__tv "KF_SCHW_RAD_GRD_SWS" CURVE 0x4b1a6 a_7 100 LINEAR______0_000000__0H___25580 0.0 255.0
 /begin AXIS_DESCR COM_AXIS geschwind LINEAR______0_000000__0H___25558 8 0.0 255.0 AXIS_PTS_REF sst_tv_kf_schw_rad_grd_sws MAX_GRAD 100 MONOTONY MON_INCREASE /end AXIS_DESCR
/end CHARACTERISTIC
/begin CHARACTERISTIC kf_schw_rad_grd_sws_ldp__tv "KF_SCHW_RAD_GRD_SWS_LDP" CURVE 0x4b1b6 a_7 100 LINEAR______0_000000__0H___25580 0.0 255.0
 /begin AXIS_DESCR COM_AXIS geschwind LINEAR______0_000000__0H___25558 8 0.0 255.0 AXIS_PTS_REF sst_tv_kf_schw_rad_grd_sws_ldp MAX_GRAD 100 MONOTONY MON_INCREASE /end AXIS_DESCR
/end CHARACTERISTIC
/begin CHARACTERISTIC kf_slp_totz_2__n "KF_SLP_TOTZ_2" CURVE 0x4b1c6 a_7 1 LINEAR______0_010000__1H___655_3 0.01 655.34998
 /begin AXIS_DESCR COM_AXIS drehzahl ES_8_RES8 3 0.0 8160.0 AXIS_PTS_REF sstm_n_4_22 MAX_GRAD 100 MONOTONY MON_INCREASE /end AXIS_DESCR
/end CHARACTERISTIC
/begin CHARACTERISTIC kf_slp_totz_3__n "KF_SLP_TOTZ_3" CURVE 0x4b1cc a_7 1 LINEAR______0_010000__1H___655_3 0.01 655.34998
 /begin AXIS_DESCR COM_AXIS drehzahl ES_8_RES8 3 0.0 8160.0 AXIS_PTS_REF sstm_n_4_22 MAX_GRAD 100 MONOTONY MON_INCREASE /end AXIS_DESCR
/end CHARACTERISTIC
/begin CHARACTERISTIC kf_sp_totz_vanos_a__n__toel "KF_SP_TOTZ_VANOS_A" MAP 0x4db35 a_4 100 LINEAR______0_000000__0H___2550_ 0.0 2550.0
 /begin AXIS_DESCR COM_AXIS toel LINEAR_______48_000000__0H___130 8 -48.0 155.0 AXIS_PTS_REF sstm_toel_7_7 MAX_GRAD 100 MONOTONY MON_INCREASE /end AXIS_DESCR
 /begin AXIS_DESCR COM_AXIS drehzahl ES_8_RES8 8 0.0 8160.0 AXIS_PTS_REF sstm_n_7_7 MAX_GRAD 100 MONOTONY MON_INCREASE /end AXIS_DESCR
/end CHARACTERISTIC
/begin CHARACTERISTIC kf_sp_totz_vanos_e__n__toel "KF_SP_TOTZ_VANOS_E" MAP 0x4db75 a_4 100 LINEAR______0_000000__0H___2550_ 0.0 2550.0
 /begin AXIS_DESCR COM_AXIS toel LINEAR_______48_000000__0H___130 8 -48.0 155.0 AXIS_PTS_REF sstm_toel_7_7 MAX_GRAD 100 MONOTONY MON_INCREASE /end AXIS_DESCR
 /begin AXIS_DESCR COM_AXIS drehzahl ES_8_RES8 8 0.0 8160.0 AXIS_PTS_REF sstm_n_7_7 MAX_GRAD 100 MONOTONY MON_INCREASE /end AXIS_DESCR
/end CHARACTERISTIC
/begin CHARACTERISTIC kf_sz__ub "KF_SZ" CURVE 0x4b1d2 a_7 2 LINEAR______0_000000__0H___50_00 0.0 50.0
 /begin AXIS_DESCR COM_AXIS ubatt LINEAR______0_000000__0H___26_81 8 0.0 26.0 AXIS_PTS_REF sstm_ub_1_2 MAX_GRAD 100 MONOTONY MON_INCREASE /end AXIS_DESCR
/end CHARACTERISTIC
/begin CHARACTERISTIC kf_sz_mz__ub "KF_SZ_MZ" CURVE 0x4b1e2 a_7 2 LINEAR______0_000000__0H___30_00 0.0 30.0
 /begin AXIS_DESCR COM_AXIS ubatt LINEAR______0_000000__0H___26_81 8 0.0 26.0 AXIS_PTS_REF sstm_ub_1_2 MAX_GRAD 100 MONOTONY MON_INCREASE /end AXIS_DESCR
/end CHARACTERISTIC
/begin CHARACTERISTIC kf_t_fak_fr_vanos_a__n__toel "KF_T_FAK_FR_VANOS_A" MAP 0x4b1f2 a_1 100 LINEAR______0_000000__0H___639_9 0.0 639.99
 /begin AXIS_DESCR COM_AXIS toel LINEAR_______48_000000__0H___130 8 -48.0 155.0 AXIS_PTS_REF sstm_toel_7_7 MAX_GRAD 100 MONOTONY MON_INCREASE /end AXIS_DESCR
 /begin AXIS_DESCR COM_AXIS drehzahl ES_8_RES8 8 0.0 8160.0 AXIS_PTS_REF sstm_n_7_7 MAX_GRAD 100 MONOTONY MON_INCREASE /end AXIS_DESCR
/end CHARACTERISTIC
/begin CHARACTERISTIC kf_t_fak_fr_vanos_e__n__toel "KF_T_FAK_FR_VANOS_E" MAP 0x4b272 a_1 100 LINEAR______0_000000__0H___639_9 0.0 639.99
 /begin AXIS_DESCR COM_AXIS toel LINEAR_______48_000000__0H___130 8 -48.0 155.0 AXIS_PTS_REF sstm_toel_7_7 MAX_GRAD 100 MONOTONY MON_INCREASE /end AXIS_DESCR
 /begin AXIS_DESCR COM_AXIS drehzahl ES_8_RES8 8 0.0 8160.0 AXIS_PTS_REF sstm_n_7_7 MAX_GRAD 100 MONOTONY MON_INCREASE /end AXIS_DESCR
/end CHARACTERISTIC
/begin CHARACTERISTIC kf_t_fak_sp_vanos_a__n__toel "KF_T_FAK_SP_VANOS_A" MAP 0x4b2f2 a_1 100 LINEAR______0_000000__0H___639_9 0.0 639.99
 /begin AXIS_DESCR COM_AXIS toel LINEAR_______48_000000__0H___130 8 -48.0 155.0 AXIS_PTS_REF sstm_toel_7_7 MAX_GRAD 100 MONOTONY MON_INCREASE /end AXIS_DESCR
 /begin AXIS_DESCR COM_AXIS drehzahl ES_8_RES8 8 0.0 8160.0 AXIS_PTS_REF sstm_n_7_7 MAX_GRAD 100 MONOTONY MON_INCREASE /end AXIS_DESCR
/end CHARACTERISTIC
/begin CHARACTERISTIC kf_t_fak_sp_vanos_e__n__toel "KF_T_FAK_SP_VANOS_E" MAP 0x4b372 a_1 100 LINEAR______0_000000__0H___639_9 0.0 639.99
 /begin AXIS_DESCR COM_AXIS toel LINEAR_______48_000000__0H___130 8 -48.0 155.0 AXIS_PTS_REF sstm_toel_7_7 MAX_GRAD 100 MONOTONY MON_INCREASE /end AXIS_DESCR
 /begin AXIS_DESCR COM_AXIS drehzahl ES_8_RES8 8 0.0 8160.0 AXIS_PTS_REF sstm_n_7_7 MAX_GRAD 100 MONOTONY MON_INCREASE /end AXIS_DESCR
/end CHARACTERISTIC
/begin CHARACTERISTIC kf_t_imp_mdk__ub__tmdk "KF_T_IMP_MDK" MAP 0x4dbb5 a_4 100 LINEAR______0_000000__0H___1275_ 0.0 1275.0
 /begin AXIS_DESCR COM_AXIS tmdk LINEAR_______48_000000__0H___142 4 -48.0 142.5 AXIS_PTS_REF sstm_tmdk_1 MAX_GRAD 100 MONOTONY MON_INCREASE /end AXIS_DESCR
 /begin AXIS_DESCR COM_AXIS ubatt LINEAR______0_000000__0H___26_82 6 0.0 26.0 AXIS_PTS_REF sstm_ub_tamdk MAX_GRAD 100 MONOTONY MON_INCREASE /end AXIS_DESCR
/end CHARACTERISTIC
/begin CHARACTERISTIC kf_t_min_van_sum_fr_a__n__toel "KF_T_MIN_VAN_SUM_FR_A" MAP 0x4dbcd a_4 100 LINEAR______0_625000__1H___159_3 0.625 159.375
 /begin AXIS_DESCR COM_AXIS toel LINEAR_______48_000000__0H___155 3 -48.0 155.0 AXIS_PTS_REF sstm_toel_3_1 MAX_GRAD 100 MONOTONY MON_INCREASE /end AXIS_DESCR
 /begin AXIS_DESCR COM_AXIS n_32 ES_8_RES17 3 0.0 8160.0 AXIS_PTS_REF sstm_n_3_1 MAX_GRAD 100 MONOTONY MON_INCREASE /end AXIS_DESCR
/end CHARACTERISTIC
/begin CHARACTERISTIC kf_t_min_van_sum_fr_e__n__toel "KF_T_MIN_VAN_SUM_FR_E" MAP 0x4dbd6 a_4 100 LINEAR______0_625000__1H___159_3 0.625 159.375
 /begin AXIS_DESCR COM_AXIS toel LINEAR_______48_000000__0H___155 3 -48.0 155.0 AXIS_PTS_REF sstm_toel_3_1 MAX_GRAD 100 MONOTONY MON_INCREASE /end AXIS_DESCR
 /begin AXIS_DESCR COM_AXIS n_32 ES_8_RES17 3 0.0 8160.0 AXIS_PTS_REF sstm_n_3_1 MAX_GRAD 100 MONOTONY MON_INCREASE /end AXIS_DESCR
/end CHARACTERISTIC
/begin CHARACTERISTIC kf_t_min_van_sum_sp_a__n__toel "KF_T_MIN_VAN_SUM_SP_A" MAP 0x4dbdf a_4 100 LINEAR______0_625000__1H___159_3 0.625 159.375
 /begin AXIS_DESCR COM_AXIS toel LINEAR_______48_000000__0H___155 3 -48.0 155.0 AXIS_PTS_REF sstm_toel_3_1 MAX_GRAD 100 MONOTONY MON_INCREASE /end AXIS_DESCR
 /begin AXIS_DESCR COM_AXIS n_32 ES_8_RES17 3 0.0 8160.0 AXIS_PTS_REF sstm_n_3_1 MAX_GRAD 100 MONOTONY MON_INCREASE /end AXIS_DESCR
/end CHARACTERISTIC
/begin CHARACTERISTIC kf_t_min_van_sum_sp_e__n__toel "KF_T_MIN_VAN_SUM_SP_E" MAP 0x4dbe8 a_4 100 LINEAR______0_625000__1H___159_3 0.625 159.375
 /begin AXIS_DESCR COM_AXIS toel LINEAR_______48_000000__0H___155 3 -48.0 155.0 AXIS_PTS_REF sstm_toel_3_1 MAX_GRAD 100 MONOTONY MON_INCREASE /end AXIS_DESCR
 /begin AXIS_DESCR COM_AXIS n_32 ES_8_RES17 3 0.0 8160.0 AXIS_PTS_REF sstm_n_3_1 MAX_GRAD 100 MONOTONY MON_INCREASE /end AXIS_DESCR
/end CHARACTERISTIC
/begin CHARACTERISTIC kf_t_sa_verz__n__lm_gmw "KF_T_SA_VERZ" MAP 0x4b3f2 a_38 100 LINEAR______0_000000__0H___8_388 0.0 8.38848
 /begin AXIS_DESCR COM_AXIS lm_gmw MAF_16_RES83 4 0.0 1389.0 AXIS_PTS_REF sst_lm_gmw_kf_t_sa_verz MAX_GRAD 100 MONOTONY MON_INCREASE /end AXIS_DESCR
 /begin AXIS_DESCR COM_AXIS drehzahl IS_13_RES84 6 0.0 8160.0 AXIS_PTS_REF sstm_n_3_4 MAX_GRAD 100 MONOTONY MON_INCREASE /end AXIS_DESCR
/end CHARACTERISTIC
/begin CHARACTERISTIC kf_t_sa_verz_kh__zw_kat "KF_T_SA_VERZ_KH" CURVE 0x4b422 a_7 100 LINEAR______0_000000__0H___8_388 0.0 8.38848
 /begin AXIS_DESCR COM_AXIS iga_ch_offsetvbyteC1D LINEAR_______48_000000__0H___0_0 4 -48.0 0.0 AXIS_PTS_REF sst_zw_kat_kf_t_sa_verz_kh MAX_GRAD 100 MONOTONY MON_INCREASE /end AXIS_DESCR
/end CHARACTERISTIC
/begin CHARACTERISTIC kf_t_van_totz_add_fr_a__toel "KF_T_VAN_TOTZ_ADD_FR_A" CURVE 0x4dcb1 a_3 100 LINEAR______0_000000__0H___159_3 0.0 159.375
 /begin AXIS_DESCR COM_AXIS toel LINEAR_______48_000000__0H___130 8 -48.0 155.0 AXIS_PTS_REF sstm_toel_7_7 MAX_GRAD 100 MONOTONY MON_INCREASE /end AXIS_DESCR
/end CHARACTERISTIC
/begin CHARACTERISTIC kf_t_van_totz_add_fr_e__toel "KF_T_VAN_TOTZ_ADD_FR_E" CURVE 0x4dcb9 a_3 100 LINEAR______0_000000__0H___159_3 0.0 159.375
 /begin AXIS_DESCR COM_AXIS toel LINEAR_______48_000000__0H___130 8 -48.0 155.0 AXIS_PTS_REF sstm_toel_7_7 MAX_GRAD 100 MONOTONY MON_INCREASE /end AXIS_DESCR
/end CHARACTERISTIC
/begin CHARACTERISTIC kf_t_van_totz_add_sp_a__toel "KF_T_VAN_TOTZ_ADD_SP_A" CURVE 0x4dcc1 a_3 100 LINEAR______0_000000__0H___159_3 0.0 159.375
 /begin AXIS_DESCR COM_AXIS toel LINEAR_______48_000000__0H___130 8 -48.0 155.0 AXIS_PTS_REF sstm_toel_7_7 MAX_GRAD 100 MONOTONY MON_INCREASE /end AXIS_DESCR
/end CHARACTERISTIC
/begin CHARACTERISTIC kf_t_van_totz_add_sp_e__toel "KF_T_VAN_TOTZ_ADD_SP_E" CURVE 0x4dcc9 a_3 100 LINEAR______0_000000__0H___159_3 0.0 159.375
 /begin AXIS_DESCR COM_AXIS toel LINEAR_______48_000000__0H___130 8 -48.0 155.0 AXIS_PTS_REF sstm_toel_7_7 MAX_GRAD 100 MONOTONY MON_INCREASE /end AXIS_DESCR
/end CHARACTERISTIC
/begin CHARACTERISTIC kf_t_zv_hst__lm_kgh "KF_T_ZV_HST" CURVE 0x4b42a a_9 100 LINEAR______0_000000__0H___1_279 0.0 1.2799
 /begin AXIS_DESCR COM_AXIS lm_kg_h MAF_KGH_16_RES28 8 0.0 16383.75 AXIS_PTS_REF sstm_lm_kgh_8_1 MAX_GRAD 100 MONOTONY MON_INCREASE /end AXIS_DESCR
/end CHARACTERISTIC
/begin CHARACTERISTIC kf_t_zv_i__uls_dif_zv_i "KF_T_ZV_I" CURVE 0x4b43a a_7 100 LINEAR_______640_020000__0H___63 -640.02 639.98
 /begin AXIS_DESCR COM_AXIS dummy LINEAR_______0_637500__0H___0_63 12 -0.6375 0.6375 AXIS_PTS_REF sstm_uls_dif_x_zv_kf_t_zv_y MAX_GRAD 100 MONOTONY MON_INCREASE /end AXIS_DESCR
/end CHARACTERISTIC
/begin CHARACTERISTIC kf_t_zv_lr_neg_1__n__lm "KF_T_ZV_LR_NEG_1" MAP 0x4b452 a_29 100 LINEAR______0_000000__0H___1_279 0.0 1.2799
 /begin AXIS_DESCR COM_AXIS lm MAF_8_RES 8 0.0 1389.0 AXIS_PTS_REF sstm_lm_1_8 MAX_GRAD 100 MONOTONY MON_INCREASE /end AXIS_DESCR
 /begin AXIS_DESCR COM_AXIS drehzahl IS_13_RES 8 0.0 8160.0 AXIS_PTS_REF sstm_n_2_8 MAX_GRAD 100 MONOTONY MON_INCREASE /end AXIS_DESCR
/end CHARACTERISTIC
/begin CHARACTERISTIC kf_t_zv_lr_neg_2__n__lm "KF_T_ZV_LR_NEG_2" MAP 0x4b4d2 a_29 100 LINEAR______0_000000__0H___1_279 0.0 1.2799
 /begin AXIS_DESCR COM_AXIS lm MAF_8_RES 8 0.0 1389.0 AXIS_PTS_REF sstm_lm_1_8 MAX_GRAD 100 MONOTONY MON_INCREASE /end AXIS_DESCR
 /begin AXIS_DESCR COM_AXIS drehzahl IS_13_RES 8 0.0 8160.0 AXIS_PTS_REF sstm_n_2_8 MAX_GRAD 100 MONOTONY MON_INCREASE /end AXIS_DESCR
/end CHARACTERISTIC
/begin CHARACTERISTIC kf_t_zv_lr_pos_1__n__lm "KF_T_ZV_LR_POS_1" MAP 0x4b552 a_29 100 LINEAR______0_000000__0H___1_279 0.0 1.2799
 /begin AXIS_DESCR COM_AXIS lm MAF_8_RES 8 0.0 1389.0 AXIS_PTS_REF sstm_lm_1_8 MAX_GRAD 100 MONOTONY MON_INCREASE /end AXIS_DESCR
 /begin AXIS_DESCR COM_AXIS drehzahl IS_13_RES 8 0.0 8160.0 AXIS_PTS_REF sstm_n_2_8 MAX_GRAD 100 MONOTONY MON_INCREASE /end AXIS_DESCR
/end CHARACTERISTIC
/begin CHARACTERISTIC kf_t_zv_lr_pos_2__n__lm "KF_T_ZV_LR_POS_2" MAP 0x4b5d2 a_29 100 LINEAR______0_000000__0H___1_279 0.0 1.2799
 /begin AXIS_DESCR COM_AXIS lm MAF_8_RES 8 0.0 1389.0 AXIS_PTS_REF sstm_lm_1_8 MAX_GRAD 100 MONOTONY MON_INCREASE /end AXIS_DESCR
 /begin AXIS_DESCR COM_AXIS drehzahl IS_13_RES 8 0.0 8160.0 AXIS_PTS_REF sstm_n_2_8 MAX_GRAD 100 MONOTONY MON_INCREASE /end AXIS_DESCR
/end CHARACTERISTIC
/begin CHARACTERISTIC kf_t_zv_p__uls_dif_zv_p "KF_T_ZV_P" CURVE 0x4b652 a_7 100 LINEAR_______640_020000__0H___63 -640.02 639.98
 /begin AXIS_DESCR COM_AXIS dummy LINEAR_______0_637500__0H___0_63 12 -0.6375 0.6375 AXIS_PTS_REF sstm_uls_dif_x_zv_kf_t_zv_y MAX_GRAD 100 MONOTONY MON_INCREASE /end AXIS_DESCR
/end CHARACTERISTIC
/begin CHARACTERISTIC kf_t_zv_sa__lm_kgh "KF_T_ZV_SA" CURVE 0x4b66a a_9 100 LINEAR______0_000000__0H___1_279 0.0 1.2799
 /begin AXIS_DESCR COM_AXIS lm_kg_h MAF_KGH_16_RES28 8 0.0 16383.75 AXIS_PTS_REF sstm_lm_kgh_8_1 MAX_GRAD 100 MONOTONY MON_INCREASE /end AXIS_DESCR
/end CHARACTERISTIC
/begin CHARACTERISTIC kf_t_zv_slp__lm_kgh "KF_T_ZV_SLP" CURVE 0x4b67a a_9 100 LINEAR______0_000000__0H___1_279 0.0 1.2799
 /begin AXIS_DESCR COM_AXIS lm_kg_h MAF_KGH_16_RES28 8 0.0 16383.75 AXIS_PTS_REF sstm_lm_kgh_8_1 MAX_GRAD 100 MONOTONY MON_INCREASE /end AXIS_DESCR
/end CHARACTERISTIC
/begin CHARACTERISTIC kf_ta_fak_ub_vanos__ub "KF_TA_FAK_UB_VANOS" CURVE 0x4dcd1 a_3 100 LINEAR______0_000000__0H___1_996 0.0 1.9961
 /begin AXIS_DESCR COM_AXIS ubatt LINEAR______0_000000__0H___26_00 3 0.0 26.0 AXIS_PTS_REF sst_ub_ta_ub_vanos MAX_GRAD 100 MONOTONY MON_INCREASE /end AXIS_DESCR
/end CHARACTERISTIC
/begin CHARACTERISTIC kf_tah_vanos__tmag__ub "KF_TAH_VANOS" MAP 0x4dcd4 a_4 100 LINEAR______0_000000__0H___99_59 0.0 99.599998
 /begin AXIS_DESCR COM_AXIS ubatt LINEAR______0_000000__0H___26_00 4 0.0 26.0 AXIS_PTS_REF sst_ub_kf_tah_vanos MAX_GRAD 100 MONOTONY MON_INCREASE /end AXIS_DESCR
 /begin AXIS_DESCR COM_AXIS tab_tmag LINEAR_______48_000000__0H___155 6 -48.0 155.0 AXIS_PTS_REF sstm_tmag_9_7 MAX_GRAD 100 MONOTONY MON_INCREASE /end AXIS_DESCR
/end CHARACTERISTIC
/begin CHARACTERISTIC kf_takfk_i__tkw_dif "KF_TAKFK_I" CURVE 0x4dcec a_3 100 LINEAR_______6_250000__0H___6_20 -6.25 6.2
 /begin AXIS_DESCR COM_AXIS dummy LINEAR_______96_000000__0H___95_ 8 -96.0 95.25 AXIS_PTS_REF sst_tkw_dif_kf_takfk_i MAX_GRAD 100 MONOTONY MON_INCREASE /end AXIS_DESCR
/end CHARACTERISTIC
/begin CHARACTERISTIC kf_takfk_p__tkw_dif "KF_TAKFK_P" CURVE 0x4dcf4 a_3 100 LINEAR_______50_000000__0H___485 -50.0 49.599998
 /begin AXIS_DESCR COM_AXIS dummy LINEAR_______96_000000__0H___95_ 8 -96.0 95.25 AXIS_PTS_REF sst_tkw_dif_kf_takfk_p MAX_GRAD 100 MONOTONY MON_INCREASE /end AXIS_DESCR
/end CHARACTERISTIC
/begin CHARACTERISTIC kf_tal__utal "KF_TAL" CURVE 0x4dcfc a_3 15 LINEAR_______48_000000__0H___114 -48.0 142.5
 /begin AXIS_DESCR COM_AXIS dummy LINEAR______0_039000__2H___4_986 16 0.039 4.9860001 AXIS_PTS_REF sst_utal_kf_tal MAX_GRAD 100 MONOTONY MON_INCREASE /end AXIS_DESCR
/end CHARACTERISTIC
/begin CHARACTERISTIC kf_tallfs__tkw "KF_TALLFS" CURVE 0x4b68a a_7 10 TALLFS 0.0 399.9938
 /begin AXIS_DESCR COM_AXIS tkw LINEAR_______48_000000__0H___121 6 -48.0 142.5 AXIS_PTS_REF sstm_tkw_1_6 MAX_GRAD 100 MONOTONY MON_INCREASE /end AXIS_DESCR
/end CHARACTERISTIC
/begin CHARACTERISTIC kf_tallfs_at__tkw "KF_TALLFS_AT" CURVE 0x4b696 a_7 100 TALLFS 0.0 399.9938
 /begin AXIS_DESCR COM_AXIS tkw LINEAR_______48_000000__0H___121 6 -48.0 142.5 AXIS_PTS_REF sstm_tkw_1_6 MAX_GRAD 100 MONOTONY MON_INCREASE /end AXIS_DESCR
/end CHARACTERISTIC
/begin CHARACTERISTIC kf_tallfs_at_tv__tv__n_dif "KF_TALLFS_AT_TV" MAP 0x4b6a2 a_43 100 LINEAR______0_000000__0H____200_ -200.0 0.0
 /begin AXIS_DESCR COM_AXIS n_dif LINEAR_______32768_000000__0H_86 4 -32768.0 32767.0 AXIS_PTS_REF sst_n_dif_kf_tallfs_at_tv MAX_GRAD 100 MONOTONY MON_INCREASE /end AXIS_DESCR
 /begin AXIS_DESCR COM_AXIS geschwind LINEAR______0_000000__0H___25558 4 0.0 255.0 AXIS_PTS_REF sst_tv_kf_tallfs_at_tv MAX_GRAD 100 MONOTONY MON_INCREASE /end AXIS_DESCR
/end CHARACTERISTIC
/begin CHARACTERISTIC kf_tallfs_d_ll__ngrd "KF_TALLFS_D_LL" CURVE 0x4dd0c a_3 10 LINEAR_______50_000000__0H___487 -50.0 49.610001
 /begin AXIS_DESCR COM_AXIS dummy LINEAR_______4096_000000__0H___4 4 -4096.0 4064.0 AXIS_PTS_REF sst_ngrd_kf_tallfs_d_ll MAX_GRAD 100 MONOTONY MON_INCREASE /end AXIS_DESCR
/end CHARACTERISTIC
/begin CHARACTERISTIC kf_tallfs_diag__tkw "KF_TALLFS_DIAG" CURVE 0x4dd10 a_3 100 LINEAR______0_000000__0H___10088 0.0 100.0
 /begin AXIS_DESCR COM_AXIS tkw LINEAR_______48_000000__0H___189 4 -48.0 142.5 AXIS_PTS_REF sst_tkw_kf_tallfs_diag MAX_GRAD 100 MONOTONY MON_INCREASE /end AXIS_DESCR
/end CHARACTERISTIC
/begin CHARACTERISTIC kf_tallfs_el_add__tael_el "KF_TALLFS_EL_ADD" CURVE 0x4b6c2 a_7 100 TALLFS 0.0 399.9938
 /begin AXIS_DESCR COM_AXIS tael_el LINEAR______0_000000__0H___99_61 6 0.0 99.610001 AXIS_PTS_REF sst_tael_el_kf_tallfs_el_add MAX_GRAD 100 MONOTONY MON_INCREASE /end AXIS_DESCR
/end CHARACTERISTIC
/begin CHARACTERISTIC kf_tallfs_fak_nsoll_add_ss__tkw "KF_TALLFS_FAK_NSOLL_ADD_SS" CURVE 0x4dd14 a_3 100 LINEAR______0_000000__0H___0_996 0.0 0.99610001
 /begin AXIS_DESCR COM_AXIS tkw LINEAR_______48_000000__0H___121 6 -48.0 142.5 AXIS_PTS_REF sstm_tkw_1_6 MAX_GRAD 100 MONOTONY MON_INCREASE /end AXIS_DESCR
/end CHARACTERISTIC
/begin CHARACTERISTIC kf_tallfs_fs__tkw "KF_TALLFS_FS" CURVE 0x4b6ce a_7 10 TALLFS 0.0 399.9938
 /begin AXIS_DESCR COM_AXIS tkw LINEAR_______48_000000__0H___121 6 -48.0 142.5 AXIS_PTS_REF sstm_tkw_1_6 MAX_GRAD 100 MONOTONY MON_INCREASE /end AXIS_DESCR
/end CHARACTERISTIC
/begin CHARACTERISTIC kf_tallfs_fs_aebg_dec__tkw "KF_TALLFS_FS_AEBG_DEC" CURVE 0x4b6da a_7 10 TALLFS_IN_10MS 0.0061 24.9938
 /begin AXIS_DESCR COM_AXIS tkw LINEAR_______48_000000__0H___121 6 -48.0 142.5 AXIS_PTS_REF sstm_tkw_1_6 MAX_GRAD 100 MONOTONY MON_INCREASE /end AXIS_DESCR
/end CHARACTERISTIC
/begin CHARACTERISTIC kf_tallfs_fs_aebg_inc__tkw "KF_TALLFS_FS_AEBG_INC" CURVE 0x4b6e6 a_7 10 TALLFS_IN_10MS90 0.0061 24.9938
 /begin AXIS_DESCR COM_AXIS tkw LINEAR_______48_000000__0H___121 6 -48.0 142.5 AXIS_PTS_REF sstm_tkw_1_6 MAX_GRAD 100 MONOTONY MON_INCREASE /end AXIS_DESCR
/end CHARACTERISTIC
/begin CHARACTERISTIC kf_tallfs_fs_ka__tkw "KF_TALLFS_FS_KA" CURVE 0x4b6f2 a_7 10 TALLFS 0.0 399.9938
 /begin AXIS_DESCR COM_AXIS tkw LINEAR_______48_000000__0H___121 6 -48.0 142.5 AXIS_PTS_REF sstm_tkw_1_6 MAX_GRAD 100 MONOTONY MON_INCREASE /end AXIS_DESCR
/end CHARACTERISTIC
/begin CHARACTERISTIC kf_tallfs_ini_i_st__tkw "KF_TALLFS_INI_I_ST" CURVE 0x4b6fe a_7 10 LINEAR_______50_000000__0H___491 -50.0 49.998501
 /begin AXIS_DESCR COM_AXIS tkw LINEAR_______48_000000__0H___114 8 -48.0 142.5 AXIS_PTS_REF sstm_tkw_1_5 MAX_GRAD 100 MONOTONY MON_INCREASE /end AXIS_DESCR
/end CHARACTERISTIC
/begin CHARACTERISTIC kf_tallfs_ka__tkw "KF_TALLFS_KA" CURVE 0x4b70e a_7 10 TALLFS 0.0 399.9938
 /begin AXIS_DESCR COM_AXIS tkw LINEAR_______48_000000__0H___121 6 -48.0 142.5 AXIS_PTS_REF sstm_tkw_1_6 MAX_GRAD 100 MONOTONY MON_INCREASE /end AXIS_DESCR
/end CHARACTERISTIC
/begin CHARACTERISTIC kf_tallfs_kat_dec__tkw "KF_TALLFS_KAT_DEC" CURVE 0x4b71a a_7 100 TALLFS_IN_10MS90 0.0061 24.9938
 /begin AXIS_DESCR COM_AXIS tkw LINEAR_______48_000000__0H___121 8 -48.0 142.5 AXIS_PTS_REF sstm_tkw_3_8 MAX_GRAD 100 MONOTONY MON_INCREASE /end AXIS_DESCR
/end CHARACTERISTIC
/begin CHARACTERISTIC kf_tallfs_kat_zw__tkw__zwdifkt "KF_TALLFS_KAT_ZW" MAP 0x4b72a a_1 100 TALLFS 0.0 399.9938
 /begin AXIS_DESCR COM_AXIS iga_ch_offsetvbyteC1D LINEAR_______48_000000__0H___0_0 6 -48.0 0.0 AXIS_PTS_REF sstm_zwdifkt_1_6 MAX_GRAD 100 MONOTONY MON_INCREASE /end AXIS_DESCR
 /begin AXIS_DESCR COM_AXIS tkw LINEAR_______48_000000__0H___121 8 -48.0 142.5 AXIS_PTS_REF sstm_tkw_3_8 MAX_GRAD 100 MONOTONY MON_INCREASE /end AXIS_DESCR
/end CHARACTERISTIC
/begin CHARACTERISTIC kf_tallfs_kat2_n__tkw__ndifkat2 "KF_TALLFS_KAT2_N" MAP 0x4b78a a_43 100 TALLFS 0.0 399.9938
 /begin AXIS_DESCR COM_AXIS nsoll_add_offset LINEAR______0_000000__0H___81692 6 0.0 8160.0 AXIS_PTS_REF sstm_ndifkat2_1_6 MAX_GRAD 3 MONOTONY MON_INCREASE /end AXIS_DESCR
 /begin AXIS_DESCR COM_AXIS tkw LINEAR_______48_000000__0H___121 8 -48.0 142.5 AXIS_PTS_REF sstm_tkw_3_8 MAX_GRAD 100 MONOTONY MON_INCREASE /end AXIS_DESCR
/end CHARACTERISTIC
/begin CHARACTERISTIC kf_tallfs_kk__can_lm_kk__tal "KF_TALLFS_KK" MAP 0x4b7ea a_1 10 TALLFS 0.0 399.9938
 /begin AXIS_DESCR COM_AXIS tal LINEAR_______48_000000__0H___133 4 -48.0 142.5 AXIS_PTS_REF sst_tal_kf_tallfs_kk MAX_GRAD 100 MONOTONY MON_INCREASE /end AXIS_DESCR
 /begin AXIS_DESCR COM_AXIS dummy LINEAR______0_000000__0H___31_00 4 0.0 31.0 AXIS_PTS_REF sstm_can_lm_kk_4_1 MAX_GRAD 100 MONOTONY MON_INCREASE /end AXIS_DESCR
/end CHARACTERISTIC
/begin CHARACTERISTIC kf_tallfs_kk_inst__n "KF_TALLFS_KK_INST" CURVE 0x4b80a a_9 10 TALLFS_NEG_POS_UI -200.0 199.9938
 /begin AXIS_DESCR COM_AXIS drehzahl IS_13_RES 4 0.0 8160.0 AXIS_PTS_REF sstm_n_3_6 MAX_GRAD 100 MONOTONY MON_INCREASE /end AXIS_DESCR
/end CHARACTERISTIC
/begin CHARACTERISTIC kf_tallfs_kk_n_lm__n__pq_ts "KF_TALLFS_KK_N_LM" MAP 0x4b812 a_29 3 LINEAR______0_000000__0H___15_99 0.0 15.99975
 /begin AXIS_DESCR COM_AXIS pq_ts LINEAR______0_000000__0H___0_920 6 0.0 0.99599999 AXIS_PTS_REF sstm_pq_ts MAX_GRAD 100 MONOTONY MON_INCREASE /end AXIS_DESCR
 /begin AXIS_DESCR COM_AXIS drehzahl IS_13_RES 4 0.0 8160.0 AXIS_PTS_REF sstm_n_3_6 MAX_GRAD 100 MONOTONY MON_INCREASE /end AXIS_DESCR
/end CHARACTERISTIC
/begin CHARACTERISTIC kf_tallfs_kor_fak__pwg_kor_n "KF_TALLFS_KOR_FAK" MAP 0x4b842 a_38 100 LINEAR______0_000000__0H___0_993 0.0 0.99997997
 /begin AXIS_DESCR COM_AXIS drehzahl IS_13_RES78 4 0.0 8160.0 AXIS_PTS_REF sst_n_kf_tallfs_kor_fak MAX_GRAD 100 MONOTONY MON_INCREASE /end AXIS_DESCR
 /begin AXIS_DESCR COM_AXIS dummy LINEAR______0_000000__0H___11976 8 0.0 119.5 AXIS_PTS_REF sst_pwg_kor_kf_tallfs_kor_fak MAX_GRAD 100 MONOTONY MON_INCREASE /end AXIS_DESCR
/end CHARACTERISTIC
/begin CHARACTERISTIC kf_tallfs_kor_llfs__tallfs "KF_TALLFS_KOR_LLFS" CURVE 0x4b882 a_9 10 LINEAR______0_000000__0H___99_94 0.0 99.998497
 /begin AXIS_DESCR COM_AXIS tallfs_gmw LINEAR______0_000000__0H___99_94 8 0.0 99.998497 AXIS_PTS_REF sst_tallfs_kf_tallfs_kor_llfs MAX_GRAD 100 MONOTONY MON_INCREASE /end AXIS_DESCR
/end CHARACTERISTIC
/begin CHARACTERISTIC kf_tallfs_mitko__dk_grd "KF_TALLFS_MITKO" CURVE 0x4dd1a a_3 100 LINEAR______0_000000__0H___0_996 0.0 0.99610001
 /begin AXIS_DESCR COM_AXIS dk_grd LINEAR______0_000000__0H___29895 4 0.0 2988.0 AXIS_PTS_REF sst_dk_grd_kf_tallfs_mitko MAX_GRAD 100 MONOTONY MON_INCREASE /end AXIS_DESCR
/end CHARACTERISTIC
/begin CHARACTERISTIC kf_tallfs_neg_i_ll__n_dif_kor "KF_TALLFS_NEG_I_LL" CURVE 0x4b892 a_9 1 LINEAR_______50_000000__0H___491 -50.0 49.998501
 /begin AXIS_DESCR COM_AXIS n_dif_kor LINEAR_______1024_000000__7C00H_ 8 -1024.0 1016.0 AXIS_PTS_REF sstm_n_dif_kor_7_6 MAX_GRAD 100 MONOTONY MON_INCREASE /end AXIS_DESCR
/end CHARACTERISTIC
/begin CHARACTERISTIC kf_tallfs_nsoll_add_ss__ndfss "KF_TALLFS_NSOLL_ADD_SS" CURVE 0x4dd1e a_3 100 LINEAR_______25_000000__0H___24_ -25.0 24.804688
 /begin AXIS_DESCR COM_AXIS nsoll_ll_ser LINEAR_______256_000000__0___254 6 -256.0 254.0 AXIS_PTS_REF sst_ndfss_kf_tallfs_nsoll_add_s MAX_GRAD 100 MONOTONY MON_INCREASE /end AXIS_DESCR
/end CHARACTERISTIC
/begin CHARACTERISTIC kf_tallfs_p_ll__n_dif_kor "KF_TALLFS_P_LL" CURVE 0x4dd24 a_19 10 LINEAR_______50_000000__0H___487 -50.0 49.610001
 /begin AXIS_DESCR COM_AXIS n_dif_kor LINEAR_______1024_000000__7C00H_ 12 -1024.0 1016.0 AXIS_PTS_REF sstm_n_dif_kor_6_6 MAX_GRAD 100 MONOTONY MON_INCREASE /end AXIS_DESCR
/end CHARACTERISTIC
/begin CHARACTERISTIC kf_tallfs_pos_i_ll__n_dif_kor "KF_TALLFS_POS_I_LL" CURVE 0x4b8c2 a_9 1 LINEAR_______50_000000__0H___491 -50.0 49.998501
 /begin AXIS_DESCR COM_AXIS n_dif_kor LINEAR_______1024_000000__7C00H_ 8 -1024.0 1016.0 AXIS_PTS_REF sstm_n_dif_kor_7_6 MAX_GRAD 100 MONOTONY MON_INCREASE /end AXIS_DESCR
/end CHARACTERISTIC
/begin CHARACTERISTIC kf_tallfs_pwg_tkw1__pwg__n "KF_TALLFS_PWG_TKW1" MAP 0x4b8d2 a_29 100 LINEAR______0_000000__0H___99_96 0.0 99.998474
 /begin AXIS_DESCR COM_AXIS drehzahl ES_8_RES8 12 0.0 8160.0 AXIS_PTS_REF sstm_n_1_6 MAX_GRAD 100 MONOTONY MON_INCREASE /end AXIS_DESCR
 /begin AXIS_DESCR COM_AXIS dummy LINEAR______0_000000__0H___119_8 12 0.0 119.8828 AXIS_PTS_REF sstm_pwg_kf_tallfs_pwg MAX_GRAD 100 MONOTONY MON_INCREASE /end AXIS_DESCR
/end CHARACTERISTIC
/begin CHARACTERISTIC kf_tallfs_pwg_tkw2__pwg__n "KF_TALLFS_PWG_TKW2" MAP 0x4b9f2 a_29 100 LINEAR______0_000000__0H___99_96 0.0 99.998474
 /begin AXIS_DESCR COM_AXIS drehzahl ES_8_RES8 12 0.0 8160.0 AXIS_PTS_REF sstm_n_1_6 MAX_GRAD 100 MONOTONY MON_INCREASE /end AXIS_DESCR
 /begin AXIS_DESCR COM_AXIS dummy LINEAR______0_000000__0H___119_8 12 0.0 119.8828 AXIS_PTS_REF sstm_pwg_kf_tallfs_pwg MAX_GRAD 100 MONOTONY MON_INCREASE /end AXIS_DESCR
/end CHARACTERISTIC
/begin CHARACTERISTIC kf_tallfs_slp__n "KF_TALLFS_SLP" CURVE 0x4bb12 a_7 15 TALLFS 0.0 399.9938
 /begin AXIS_DESCR COM_AXIS drehzahl ES_8_RES8 4 0.0 8160.0 AXIS_PTS_REF sstm_n_3_22 MAX_GRAD 100 MONOTONY MON_INCREASE /end AXIS_DESCR
/end CHARACTERISTIC
/begin CHARACTERISTIC kf_tallfs_slp_inst__n "KF_TALLFS_SLP_INST" CURVE 0x4bb1a a_7 15 TALLFS_NEG_POS_UI -200.0 199.9938
 /begin AXIS_DESCR COM_AXIS drehzahl ES_8_RES8 4 0.0 8160.0 AXIS_PTS_REF sstm_n_3_22 MAX_GRAD 100 MONOTONY MON_INCREASE /end AXIS_DESCR
/end CHARACTERISTIC
/begin CHARACTERISTIC kf_tallfs_ssp__tkw "KF_TALLFS_SSP" CURVE 0x4bb22 a_7 10 TALLFS_NEG_0_UI -200.0 0.0
 /begin AXIS_DESCR COM_AXIS tkw LINEAR_______48_000000__0H___121 6 -48.0 142.5 AXIS_PTS_REF sstm_tkw_1_6 MAX_GRAD 100 MONOTONY MON_INCREASE /end AXIS_DESCR
/end CHARACTERISTIC
/begin CHARACTERISTIC kf_tallfs_st__n__tkw "KF_TALLFS_ST" MAP 0x4bb2e a_29 10 TALLFS 0.0 399.9938
 /begin AXIS_DESCR COM_AXIS tkw LINEAR_______48_000000__0H___114 8 -48.0 142.5 AXIS_PTS_REF sstm_tkw_1_5 MAX_GRAD 100 MONOTONY MON_INCREASE /end AXIS_DESCR
 /begin AXIS_DESCR COM_AXIS drehzahl IS_13_RES 3 0.0 8160.0 AXIS_PTS_REF sstm_n_2_5 MAX_GRAD 100 MONOTONY MON_INCREASE /end AXIS_DESCR
/end CHARACTERISTIC
/begin CHARACTERISTIC kf_tallfs_tal_add__tal "KF_TALLFS_TAL_ADD" CURVE 0x4bb5e a_7 16 TALLFS_NEG_POS_UI -200.0 199.9938
 /begin AXIS_DESCR COM_AXIS tal LINEAR_______48_000000__0H___197 4 -48.0 142.5 AXIS_PTS_REF sst_tal_kf_tallfs_tal_add MAX_GRAD 26 MONOTONY MON_INCREASE /end AXIS_DESCR
/end CHARACTERISTIC
/begin CHARACTERISTIC kf_tallfs_tal_fak__tal "KF_TALLFS_TAL_FAK" CURVE 0x4bb66 a_7 10 LINEAR______0_000000__0H___1_999 0.0 1.99997
 /begin AXIS_DESCR COM_AXIS tal LINEAR_______48_000000__0H___114 6 -48.0 142.5 AXIS_PTS_REF sstm_tal_2_6 MAX_GRAD 100 MONOTONY MON_INCREASE /end AXIS_DESCR
/end CHARACTERISTIC
/begin CHARACTERISTIC kf_tallfs_tkw_fak_ll__tkw "KF_TALLFS_TKW_FAK_LL" CURVE 0x4dd30 a_3 20 LINEAR______0_000000__0H___1_998 0.0 1.9922
 /begin AXIS_DESCR COM_AXIS tkw LINEAR_______48_000000__0H___114 4 -48.0 142.5 AXIS_PTS_REF sstm_tkw_2_6 MAX_GRAD 100 MONOTONY MON_INCREASE /end AXIS_DESCR
/end CHARACTERISTIC
/begin CHARACTERISTIC kf_tallfs_toel_add__toel "KF_TALLFS_TOEL_ADD" CURVE 0x4bb72 a_7 100 TALLFS_NEG_POS_UI -200.0 199.9938
 /begin AXIS_DESCR COM_AXIS toel LINEAR_______48_000000__0H___156 6 -48.0 155.0 AXIS_PTS_REF sst_toel_kf_tallfs_toel_add MAX_GRAD 100 MONOTONY MON_INCREASE /end AXIS_DESCR
/end CHARACTERISTIC
/begin CHARACTERISTIC kf_tallfs_ub_fak__ub "KF_TALLFS_UB_FAK" CURVE 0x4dd34 a_3 10 LINEAR______0_000000__0H___1_998 0.0 1.9922
 /begin AXIS_DESCR COM_AXIS ubatt LINEAR______0_000000__0H___26_81 8 0.0 26.0 AXIS_PTS_REF sstm_ub_1_2 MAX_GRAD 100 MONOTONY MON_INCREASE /end AXIS_DESCR
/end CHARACTERISTIC
/begin CHARACTERISTIC kf_tallfs_vue_add__tkw__vue "KF_TALLFS_VUE_ADD" MAP 0x4bb7e a_43 100 TALLFS_NEG_POS_UI -200.0 199.9938
 /begin AXIS_DESCR COM_AXIS vue LINEAR______0_000000__0H___12099 8 0.0 120.0 AXIS_PTS_REF sstm_vue_kf_xxx_vue_xxx MAX_GRAD 100 MONOTONY MON_INCREASE /end AXIS_DESCR
 /begin AXIS_DESCR COM_AXIS tkw LINEAR_______48_000000__0H___100 8 -48.0 142.5 AXIS_PTS_REF sstm_tkw_6_1 MAX_GRAD 100 MONOTONY MON_INCREASE /end AXIS_DESCR
/end CHARACTERISTIC
/begin CHARACTERISTIC kf_tals_fs_kat2_n__tkw__ndifkat2 "KF_TALS_FS_KAT2_N" MAP 0x4bbfe a_43 100 TALLFS 0.0 399.9938
 /begin AXIS_DESCR COM_AXIS nsoll_add_offset LINEAR______0_000000__0H___81692 6 0.0 8160.0 AXIS_PTS_REF sstm_ndifkat2_1_6 MAX_GRAD 3 MONOTONY MON_INCREASE /end AXIS_DESCR
 /begin AXIS_DESCR COM_AXIS tkw LINEAR_______48_000000__0H___121 8 -48.0 142.5 AXIS_PTS_REF sstm_tkw_3_8 MAX_GRAD 100 MONOTONY MON_INCREASE /end AXIS_DESCR
/end CHARACTERISTIC
/begin CHARACTERISTIC kf_talsh_aebg_sa__n "KF_TALSH_AEBG_SA__N" CURVE 0x4dd3c a_3 100 LINEAR______0_390627__1H___99_61 0.390627 99.610001
 /begin AXIS_DESCR COM_AXIS n_32 ES_8_RES 6 0.0 8160.0 AXIS_PTS_REF sst_n_kf_talsh_aebg_sa MAX_GRAD 100 MONOTONY MON_INCREASE /end AXIS_DESCR
/end CHARACTERISTIC
/begin CHARACTERISTIC kf_tamdk_close__tmdk "KF_TAMDK_CLOSE" CURVE 0x4dd42 a_3 100 LINEAR______0_000000__0H___99_61 0.0 99.610001
 /begin AXIS_DESCR COM_AXIS tmdk LINEAR_______48_000000__0H___142 4 -48.0 142.5 AXIS_PTS_REF sstm_tmdk_4_1 MAX_GRAD 100 MONOTONY MON_INCREASE /end AXIS_DESCR
/end CHARACTERISTIC
/begin CHARACTERISTIC kf_tamdk_ini__tmdk "KF_TAMDK_INI" CURVE 0x4dd46 a_3 100 LINEAR______0_000000__0H___99_61 0.0 99.610001
 /begin AXIS_DESCR COM_AXIS tmdk LINEAR_______48_000000__0H___142 4 -48.0 142.5 AXIS_PTS_REF sstm_tmdk_4_1 MAX_GRAD 100 MONOTONY MON_INCREASE /end AXIS_DESCR
/end CHARACTERISTIC
/begin CHARACTERISTIC kf_tamdk_ini_asc__tmdk__lm_kg_h "KF_TAMDK_INI_ASC" MAP 0x4dd4a a_11 100 LINEAR______0_000000__0H___99_61 0.0 99.610001
 /begin AXIS_DESCR COM_AXIS lm_kg_h LINEAR______0_250000__1H___16383 4 0.25 16383.75 AXIS_PTS_REF sst_lm_kg_h_kf_tamdk_ini_asc MAX_GRAD 100 MONOTONY MON_INCREASE /end AXIS_DESCR
 /begin AXIS_DESCR COM_AXIS tmdk LINEAR_______48_000000__0H___142 4 -48.0 142.5 AXIS_PTS_REF sstm_tmdk_4_1 MAX_GRAD 100 MONOTONY MON_INCREASE /end AXIS_DESCR
/end CHARACTERISTIC
/begin CHARACTERISTIC kf_tamdk_max_1__ub__tmdk "KF_TAMDK_MAX_1" MAP 0x4dd5a a_4 100 LINEAR______0_000000__0H___99_61 0.0 99.610001
 /begin AXIS_DESCR COM_AXIS tmdk LINEAR_______48_000000__0H___142 4 -48.0 142.5 AXIS_PTS_REF sstm_tmdk_1 MAX_GRAD 100 MONOTONY MON_INCREASE /end AXIS_DESCR
 /begin AXIS_DESCR COM_AXIS ubatt LINEAR______0_000000__0H___26_82 6 0.0 26.0 AXIS_PTS_REF sstm_ub_tamdk MAX_GRAD 100 MONOTONY MON_INCREASE /end AXIS_DESCR
/end CHARACTERISTIC
/begin CHARACTERISTIC kf_tamdk_min__tmdk "KF_TAMDK_MIN" CURVE 0x4bc5e a_7 100 LINEAR______0_000000__0H___399_9 0.0 399.98779
 /begin AXIS_DESCR COM_AXIS tmdk LINEAR_______48_000000__0H___142 4 -48.0 142.5 AXIS_PTS_REF sstm_tmdk_4_2 MAX_GRAD 100 MONOTONY MON_INCREASE /end AXIS_DESCR
/end CHARACTERISTIC
/begin CHARACTERISTIC kf_tamdk_ub_fak__ub "KF_TAMDK_UB_FAK" CURVE 0x4dd72 a_3 10 LINEAR______0_000000__0H___1_101 0.0 1.9922
 /begin AXIS_DESCR COM_AXIS ubatt LINEAR______0_000000__0H___26_81 8 0.0 26.0 AXIS_PTS_REF sstm_ub_1_2 MAX_GRAD 100 MONOTONY MON_INCREASE /end AXIS_DESCR
/end CHARACTERISTIC
/begin CHARACTERISTIC kf_tate_max__n__lm "KF_TATE_MAX" MAP 0x4bc66 a_1 10 LINEAR______0_000000__0H___800_0 0.0 800.0
 /begin AXIS_DESCR COM_AXIS lm MAF_8_RES40 12 0.0 1389.0 AXIS_PTS_REF sstm_lm_1_10 MAX_GRAD 100 MONOTONY MON_INCREASE /end AXIS_DESCR
 /begin AXIS_DESCR COM_AXIS drehzahl ES_8_RES41 10 0.0 8160.0 AXIS_PTS_REF sstm_n_2_10 MAX_GRAD 100 MONOTONY MON_INCREASE /end AXIS_DESCR
/end CHARACTERISTIC
/begin CHARACTERISTIC kf_tate_min__n__lm "KF_TATE_MIN" MAP 0x4bd56 a_1 10 LINEAR______0_000000__0H___99_97 0.0 99.97559
 /begin AXIS_DESCR COM_AXIS lm MAF_8_RES40 12 0.0 1389.0 AXIS_PTS_REF sstm_lm_1_10 MAX_GRAD 100 MONOTONY MON_INCREASE /end AXIS_DESCR
 /begin AXIS_DESCR COM_AXIS drehzahl ES_8_RES41 10 0.0 8160.0 AXIS_PTS_REF sstm_n_2_10 MAX_GRAD 100 MONOTONY MON_INCREASE /end AXIS_DESCR
/end CHARACTERISTIC
/begin CHARACTERISTIC kf_tate_min_katv__n__lm "KF_TATE_MIN_KATV" MAP 0x4be46 a_1 10 LINEAR______0_000000__0H___99_97 0.0 99.97559
 /begin AXIS_DESCR COM_AXIS lm MAF_8_RES40 12 0.0 1389.0 AXIS_PTS_REF sstm_lm_1_10 MAX_GRAD 100 MONOTONY MON_INCREASE /end AXIS_DESCR
 /begin AXIS_DESCR COM_AXIS drehzahl ES_8_RES41 10 0.0 8160.0 AXIS_PTS_REF sstm_n_2_10 MAX_GRAD 100 MONOTONY MON_INCREASE /end AXIS_DESCR
/end CHARACTERISTIC
/begin CHARACTERISTIC kf_tate_tev__tate "KF_TATE_TEV" CURVE 0x4bf36 a_9 100 LINEAR______0_000000__0H___99_97 0.0 99.97559
 /begin AXIS_DESCR COM_AXIS tate LINEAR______0_000000__0H___99_97 5 0.0 99.97559 AXIS_PTS_REF sst_tate_kf_tate_tev MAX_GRAD 100 MONOTONY MON_INCREASE /end AXIS_DESCR
/end CHARACTERISTIC
/begin CHARACTERISTIC kf_temp_ers_el_ini__tkw__tumg "KF_TEMP_ERS_EL_INI" MAP 0x4dd7a a_4 100 LINEAR_______33_000000__0H___987 -33.0 987.0
 /begin AXIS_DESCR COM_AXIS tumg LINEAR_______128_000000__0H___12 6 -128.0 127.0 AXIS_PTS_REF sst_tumg_kf_temp_ers_el_ini MAX_GRAD 100 MONOTONY MON_INCREASE /end AXIS_DESCR
 /begin AXIS_DESCR COM_AXIS tkw LINEAR_______48_000000__0H___142 6 -48.0 142.5 AXIS_PTS_REF sst_tkw_kf_temp_ers_el_ini MAX_GRAD 100 MONOTONY MON_INCREASE /end AXIS_DESCR
/end CHARACTERISTIC
/begin CHARACTERISTIC kf_temp_ers_kat__lm_kg_h "KF_TEMP_ERS_KAT" CURVE 0x4dd9e a_19 100 LINEAR_______33_000000__0H___102 -33.0 987.0
 /begin AXIS_DESCR COM_AXIS lm_kg_h MAF_KGH_16_RES15 8 0.0 16383.75 AXIS_PTS_REF sstm_lm_kg_h_2_22 MAX_GRAD 100 MONOTONY MON_INCREASE /end AXIS_DESCR
/end CHARACTERISTIC
/begin CHARACTERISTIC kf_temp_sond_ini__tkw__tal "KF_TEMP_SOND_INI" MAP 0x4dda6 a_4 100 LINEAR_______48_000000__0H___142 -48.0 142.5
 /begin AXIS_DESCR COM_AXIS tal LINEAR_______48_000000__0H___142 6 -48.0 142.5 AXIS_PTS_REF sst_tal_kf_temp_sond_ini MAX_GRAD 100 MONOTONY MON_INCREASE /end AXIS_DESCR
 /begin AXIS_DESCR COM_AXIS tkw LINEAR_______48_000000__0H___142 6 -48.0 142.5 AXIS_PTS_REF sst_tkw_kf_temp_sond_ini MAX_GRAD 100 MONOTONY MON_INCREASE /end AXIS_DESCR
/end CHARACTERISTIC
/begin CHARACTERISTIC kf_tev_dif_ps__n__lm_add_kor "KF_TEV_DIF_PS" MAP 0x4c000 a_1 100 LINEAR______0_000000__0H___0_918 0.0 0.99998474
 /begin AXIS_DESCR COM_AXIS lm_add_kor MAF_8_RES 12 0.0 1389.0 AXIS_PTS_REF sstm_lm_add_kor_1_12 MAX_GRAD 100 MONOTONY MON_INCREASE /end AXIS_DESCR
 /begin AXIS_DESCR COM_AXIS drehzahl ES_8_RES41 10 0.0 8160.0 AXIS_PTS_REF sstm_n_2_10 MAX_GRAD 100 MONOTONY MON_INCREASE /end AXIS_DESCR
/end CHARACTERISTIC
/begin CHARACTERISTIC kf_tev_ub_add__ub "KF_TEV_UB_ADD" CURVE 0x4c0f0 a_7 10 LINEAR_______50_000000__0H___103 -50.0 49.97559
 /begin AXIS_DESCR COM_AXIS ubatt LINEAR______0_000000__0H___26_81 8 0.0 26.0 AXIS_PTS_REF sstm_ub_1_2 MAX_GRAD 100 MONOTONY MON_INCREASE /end AXIS_DESCR
/end CHARACTERISTIC
/begin CHARACTERISTIC kf_ti_abr_kns__zyk__tkw "KF_TI_ABR_KNS" MAP 0x4ddca a_2 20 LINEAR______0_000000__0H___0_104 0.0 0.99610001
 /begin AXIS_DESCR COM_AXIS tkw LINEAR_______48_000000__0H___114 8 -48.0 142.5 AXIS_PTS_REF sstm_tkw_1_5 MAX_GRAD 100 MONOTONY MON_INCREASE /end AXIS_DESCR
 /begin AXIS_DESCR COM_AXIS dummy LINEAR______0_000000__0H___65535 6 0.0 65535.0 AXIS_PTS_REF sst_zyk_kf_ti_abr_kns MAX_GRAD 100 MONOTONY MON_INCREASE /end AXIS_DESCR
/end CHARACTERISTIC
/begin CHARACTERISTIC kf_ti_abr_kst__zyk__tkw "KF_TI_ABR_KST" MAP 0x4ddfa a_2 20 LINEAR______0_000000__0H___0_996 0.0 0.99610001
 /begin AXIS_DESCR COM_AXIS tkw LINEAR_______48_000000__0H___114 8 -48.0 142.5 AXIS_PTS_REF sstm_tkw_1_5 MAX_GRAD 100 MONOTONY MON_INCREASE /end AXIS_DESCR
 /begin AXIS_DESCR COM_AXIS dummy LINEAR______0_000000__0H___65535 4 0.0 65535.0 AXIS_PTS_REF sst_zyk_kf_ti_abr_kst MAX_GRAD 100 MONOTONY MON_INCREASE /end AXIS_DESCR
/end CHARACTERISTIC
/begin CHARACTERISTIC kf_ti_abr_neg_swf__n "KF_TI_ABR_NEG_SWF" CURVE 0x4de1a a_3 100 LINEAR______0_000000__0H___0_105 0.0 0.49805
 /begin AXIS_DESCR COM_AXIS drehzahl ES_8_RES8 8 0.0 8160.0 AXIS_PTS_REF sstm_n_21_7 MAX_GRAD 100 MONOTONY MON_INCREASE /end AXIS_DESCR
/end CHARACTERISTIC
/begin CHARACTERISTIC kf_ti_abr_pos_swf__n "KF_TI_ABR_POS_SWF" CURVE 0x4de22 a_3 100 LINEAR______0_000000__0H___0_105 0.0 0.49805
 /begin AXIS_DESCR COM_AXIS drehzahl ES_8_RES8 8 0.0 8160.0 AXIS_PTS_REF sstm_n_21_7 MAX_GRAD 100 MONOTONY MON_INCREASE /end AXIS_DESCR
/end CHARACTERISTIC
/begin CHARACTERISTIC kf_ti_ad_add__tkw__ti_ad_add "KF_TI_AD_ADD_FAK" MAP 0x4de2a a_11 20 LINEAR______0_000000__0H___0_925 0.0 0.99599999
 /begin AXIS_DESCR COM_AXIS dummy LINEAR_______4_995000__7C57H___5 5 -4.9949999 5.0 AXIS_PTS_REF sst_ti_ad_add_gmw MAX_GRAD 100 MONOTONY MON_INCREASE /end AXIS_DESCR
 /begin AXIS_DESCR COM_AXIS tkw LINEAR_______48_000000__0H___133 5 -48.0 142.5 AXIS_PTS_REF sstm_tkw_2_8 MAX_GRAD 100 MONOTONY MON_INCREASE /end AXIS_DESCR
/end CHARACTERISTIC
/begin CHARACTERISTIC kf_ti_ad_fak__tkw__ti_ad_fak "KF_TI_AD_FAK_FAK" MAP 0x4de43 a_11 20 LINEAR______0_000000__0H___0_925 0.0 0.99599999
 /begin AXIS_DESCR COM_AXIS dummy LINEAR_______31_250000__3000H___ 5 -31.25 31.25 AXIS_PTS_REF sst_ti_ad_fak_gmw MAX_GRAD 100 MONOTONY MON_INCREASE /end AXIS_DESCR
 /begin AXIS_DESCR COM_AXIS tkw LINEAR_______48_000000__0H___133 5 -48.0 142.5 AXIS_PTS_REF sstm_tkw_2_8 MAX_GRAD 100 MONOTONY MON_INCREASE /end AXIS_DESCR
/end CHARACTERISTIC
/begin CHARACTERISTIC kf_ti_ad_lm_max__n "KF_TI_AD_LM_MAX" CURVE 0x4de5c a_3 100 MAF_8_RES37 0.0 1389.0
 /begin AXIS_DESCR COM_AXIS n_32 ES_8_RES 6 0.0 8160.0 AXIS_PTS_REF sstm_n_kf_ti_ad_lm MAX_GRAD 100 MONOTONY MON_INCREASE /end AXIS_DESCR
/end CHARACTERISTIC
/begin CHARACTERISTIC kf_ti_ad_lm_min__n "KF_TI_AD_LM_MIN" CURVE 0x4de62 a_3 100 MAF_8_RES37 0.0 1389.0
 /begin AXIS_DESCR COM_AXIS n_32 ES_8_RES 6 0.0 8160.0 AXIS_PTS_REF sstm_n_kf_ti_ad_lm MAX_GRAD 100 MONOTONY MON_INCREASE /end AXIS_DESCR
/end CHARACTERISTIC
/begin CHARACTERISTIC kf_ti_add_totz__ub "KF_TI_ADD_TOTZ" CURVE 0x4de68 a_3 10 LINEAR______0_000000__0H___8_160 0.0 8.16
 /begin AXIS_DESCR COM_AXIS ubatt LINEAR______0_000000__0H___26_81 8 0.0 26.0 AXIS_PTS_REF sstm_ub_1_2 MAX_GRAD 100 MONOTONY MON_INCREASE /end AXIS_DESCR
/end CHARACTERISTIC
/begin AXIS_PTS sst_tab_lmm_2 "" 0x4882a dummy a_892 100 LINEAR______0_000000__0H___255_0 16 0.0 255.0 /end AXIS_PTS
/begin AXIS_PTS sst_tab_lmm_1 "" 0x48819 dummy a_892 100 LINEAR______0_000000__0H___255_0 16 0.0 255.0 /end AXIS_PTS
/begin AXIS_PTS sstm_n_8_1 "N" 0x4883b n_32 a_892 100 ES_8_RES 8 0.0 8160.0 /end AXIS_PTS
/begin AXIS_PTS sstm_pwg_max_12_1 "PWG_MAX" 0x4906c pwg_max a_893 100 MTC_NORM_16_RES 12 0.0 119.99817 /end AXIS_PTS
/begin AXIS_PTS sstm_tallfs_4_1 "TALLFS" 0x48844 tallfs a_892 10 LINEAR______0_000000__0H___99_61 4 0.0 99.610001 /end AXIS_PTS
/begin AXIS_PTS sst_tumg_kf_add_ers_kat_el "TUMG" 0x48850 tumg a_892 100 LINEAR_______128_000000__0H___12 6 -128.0 127.0 /end AXIS_PTS
/begin AXIS_PTS sst_toel_kf_add_ers_kat_el "TOEL" 0x48849 toel a_892 100 LINEAR_______48_000000__0H___155 6 -48.0 155.0 /end AXIS_PTS
/begin AXIS_PTS sst_toel_kf_add_m_reib "TOEL" 0x48857 toel a_892 100 LINEAR_______48_000000__0H___156 8 -48.0 155.0 /end AXIS_PTS
/begin AXIS_PTS sstm_can_lm_kk_4_1 "CAN_LM_KK" 0x48860 dummy a_892 100 LINEAR______0_000000__0H___31_00 4 0.0 31.0 /end AXIS_PTS
/begin AXIS_PTS sstm_t_anst_fgr "T_ANST_FGR" 0x48865 t_anst_fgr a_892 100 LINEAR______0_000000__0H___25_50 5 0.0 25.5 /end AXIS_PTS
/begin AXIS_PTS sstm_n_kf_aebg_roz "N" 0x4886b n_32 a_892 100 ES_8_RES8 4 0.0 8160.0 /end AXIS_PTS
/begin AXIS_PTS sstm_pwg_ist_roh_4_2 "PWG_IST_ROH" 0x49092 pwg_ist_roh a_893 100 MTC_NORM_16_RES10 4 0.0 119.99817 /end AXIS_PTS
/begin AXIS_PTS sst_lm_dk_diag_kf_dk_ers "LM_DK_DIAG" 0x4909c dummy a_893 1 MAF_KGH_16_RES 8 0.0 16383.75 /end AXIS_PTS
/begin AXIS_PTS sst_n_kf_dk_ers "N" 0x48870 drehzahl a_892 10 ES_8_RES8 6 0.0 8160.0 /end AXIS_PTS
/begin AXIS_PTS sstm_pwg_max_6_1 "PWG_MAX" 0x48877 pwg_max a_892 100 MTC_NORM_8_RES 6 0.0 119.53125 /end AXIS_PTS
/begin AXIS_PTS sst_dummy1_kf_dummy "" 0x4887e tkw a_892 100 LINEAR_______48_000000__0H___112 8 -48.0 142.5 /end AXIS_PTS
/begin AXIS_PTS sst_ti_kf_ebw_st "TI" 0x490ae ti_ges a_893 10 TI_BAS_16_RES 4 0.0 262.14 /end AXIS_PTS
/begin AXIS_PTS sst_n_kf_ebw_st "N" 0x48887 drehzahl a_892 5 ES_8_RES8 4 0.0 8160.0 /end AXIS_PTS
/begin AXIS_PTS sstm_ti_ebw_van "TI" 0x490c6 ti_ges a_893 100 TI_BAS_16_RES 6 0.0 262.14 /end AXIS_PTS
/begin AXIS_PTS sstm_n_1_28 "N" 0x490b8 drehzahl a_893 100 IS_13_RES 6 0.0 8160.0 /end AXIS_PTS
/begin AXIS_PTS sstm_ti_1_2 "TI+TI_ADD_TOTZ" 0x490e6 ti_ges a_893 10 TI_BAS_16_RES 10 0.0 262.14 /end AXIS_PTS
/begin AXIS_PTS sstm_n_1_2 "N" 0x490d4 drehzahl a_893 100 IS_13_RES 8 0.0 8160.0 /end AXIS_PTS
/begin AXIS_PTS sst_nwist_e_eew_ti_inst_van "NWIST_E" 0x48893 ivvt_ivpos_act a_892 100 LINEAR______60_000000__0H___155_ 6 60.0 155.625 /end AXIS_PTS
/begin AXIS_PTS sstm_n_12_7 "N" 0x4888c drehzahl a_892 100 ES_8_RES8 6 0.0 8160.0 /end AXIS_PTS
/begin AXIS_PTS sstm_tkw_1_5 "TKW" 0x4889a tkw a_892 15 LINEAR_______48_000000__0H___114 8 -48.0 142.5 /end AXIS_PTS
/begin AXIS_PTS sstm_lm_kg_h_1_10 "LM_KG_H" 0x490fc lm_kg_h a_893 10 MAF_KGH_16_RES15 8 0.0 16383.75 /end AXIS_PTS
/begin AXIS_PTS sst_kat_diag_kf_fak_kat_diag "KAT_DIAG" 0x4910e dummy a_893 100 LINEAR______0_000000__0H___255_9 6 0.0 255.996 /end AXIS_PTS
/begin AXIS_PTS sstm_lm_1_9 "LM" 0x488b4 lm_kr a_892 5 MAF_8_RES 4 0.0 1389.0 /end AXIS_PTS
/begin AXIS_PTS sstm_n_2_9 "N" 0x488a3 n_kr a_892 20 ES_8_RES8 16 0.0 8160.0 /end AXIS_PTS
/begin AXIS_PTS sstm_n_kf_xxxx_kru_lu_at "N" 0x488b9 n_32 a_892 100 ES_8_RES17 4 0.0 8160.0 /end AXIS_PTS
/begin AXIS_PTS sstm_n_kf_xxxx_kru_lu_mt "N" 0x488be n_32 a_892 100 ES_8_RES17 4 0.0 8160.0 /end AXIS_PTS
/begin AXIS_PTS sst_tkw_kf_fak_lam_s "TKW" 0x488c3 tkw a_892 100 LINEAR_______48_000000__0H___142 3 -48.0 142.5 /end AXIS_PTS
/begin AXIS_PTS sst_lm_ers_diag_kf_fak_lm_van "LM_ERS_DIAG" 0x488c7 lm_ers_diag a_892 100 MAF_8_RES 6 0.0 1389.0 /end AXIS_PTS
/begin AXIS_PTS sstm_pwg_ist_4_1 "PWG_IST" 0x488ce pwg_ist a_892 100 LINEAR______0_000000__0H___119_5 4 0.0 119.5 /end AXIS_PTS
/begin AXIS_PTS sst_md_ind_asc_kf_fak_md_kor "MD_IND_ASC" 0x488d3 md_ind_asc a_892 10 LINEAR______0_000000__0H___100_0 4 0.0 100.0 /end AXIS_PTS
/begin AXIS_PTS sstm_mdk_ist_4_1 "MDK_IST" 0x4911c mdk_ist a_893 100 MTC_NORM_16_RES 4 0.0 119.99817 /end AXIS_PTS
/begin AXIS_PTS sstm_pwg_ist_4_2 "PWG_IST" 0x49126 pwg_ist a_893 100 MTC_NORM_16_RES 4 0.0 119.99817 /end AXIS_PTS
/begin AXIS_PTS sst_mdk_ist_kf_fak_mdk_llfs "MDK_IST" 0x49130 mdk_ist a_893 10 LINEAR______0_000000__0H___119_9 6 0.0 119.9982 /end AXIS_PTS
/begin AXIS_PTS sstm_tkw_1_6 "TKW" 0x488d8 tkw a_892 15 LINEAR_______48_000000__0H___121 6 -48.0 142.5 /end AXIS_PTS
/begin AXIS_PTS sst_tallfs_kf_fak_pq_llfs "TALLFS" 0x4913e tallfs a_893 15 LINEAR______0_000000__0H___99_99 4 0.0 99.998001 /end AXIS_PTS
/begin AXIS_PTS sst_fak_te_kf_fak_ramp_te "FAK_TE" 0x488df fak_te a_892 100 LINEAR______0_000000__0H___0_923 3 0.0 0.99610001 /end AXIS_PTS
/begin AXIS_PTS sst_lammw_dif_te_kf_fak_ramp_te "LAMMW_DIF_TE" 0x49148 lrvlammw_dif_te a_893 100 LINEAR_______50_000000__0H___49_ 3 -50.0 49.998501 /end AXIS_PTS
/begin AXIS_PTS sst_n_kf_fak_schw_ev_aus_lu "N" 0x488e3 n_32 a_892 100 ES_8_RES 6 0.0 8160.0 /end AXIS_PTS
/begin AXIS_PTS sst_tkw_kf_fak_schw_ll_lu_diag "TKW" 0x488ea tkw a_892 11 LINEAR_______48_000000__0H___142 8 -48.0 142.5 /end AXIS_PTS
/begin AXIS_PTS sst_tkw_schw_lu "TKW" 0x488f3 tkw a_892 5 LINEAR_______48_000000__0H___114 8 -48.0 142.5 /end AXIS_PTS
/begin AXIS_PTS sst_zwdifkt3_schw_lu "ZWDIFKT3" 0x488fc zw_kat3 a_892 5 LINEAR_______48_000000__0H___0_0 4 -48.0 0.0 /end AXIS_PTS
/begin AXIS_PTS sst_n_kf_fak_t_kk_inc "N" 0x49150 drehzahl a_893 12 LINEAR______0_000000__0H___8160_ 4 0.0 8160.0 /end AXIS_PTS
/begin AXIS_PTS sst_tal_kf_fak_tal_tkw "TAL" 0x48908 tal a_892 15 LINEAR_______48_000000__0H___114 6 -48.0 142.5 /end AXIS_PTS
/begin AXIS_PTS sst_tkw_kf_fak_tal_tkw "TKW" 0x48901 tkw a_892 15 LINEAR_______48_000000__0H___121 6 -48.0 142.5 /end AXIS_PTS
/begin AXIS_PTS sst_tkw_kf_fak_tal_tkw_kr_dg "TKW" 0x48914 tkw a_892 10 LINEAR_______48_000000__0H___121 4 -48.0 142.5 /end AXIS_PTS
/begin AXIS_PTS sst_tal_kf_fak_tal_tkw_kr_dg "TAL" 0x4890f tal a_892 15 LINEAR_______48_000000__0H___121 4 -48.0 142.5 /end AXIS_PTS
/begin AXIS_PTS sst_tal_kf_fak_tal_tkw_ll "TAL" 0x4891e tal a_892 15 LINEAR_______48_000000__0H___121 4 -48.0 142.5 /end AXIS_PTS
/begin AXIS_PTS sst_tkw_kf_fak_tal_tkw_ll "TKW" 0x48919 tkw a_892 15 LINEAR_______48_000000__0H___121 4 -48.0 142.5 /end AXIS_PTS
/begin AXIS_PTS sstm_mdk_ist_6_1 "MDK_IST" 0x49168 mdk_ist a_893 100 MTC_NORM_16_RES10 6 0.0 119.99817 /end AXIS_PTS
/begin AXIS_PTS sstm_lm_kg_h_6_2 "LM_KG_H" 0x4915a lm_kg_h a_893 100 MAF_KGH_16_RES28 6 0.0 16383.75 /end AXIS_PTS
/begin AXIS_PTS sstm_tkw_st_6_7 "TKW_ST" 0x4892c tkw_st a_892 100 LINEAR_______48_000000__0H___142 8 -48.0 142.5 /end AXIS_PTS
/begin AXIS_PTS sstm_tkw_6_7 "TKW" 0x48923 tkw a_892 100 LINEAR_______48_000000__0H___142 8 -48.0 142.5 /end AXIS_PTS
/begin AXIS_PTS sstm_lm_1_8 "LM" 0x48935 lm a_892 5 MAF_8_RES 8 0.0 1389.0 /end AXIS_PTS
/begin AXIS_PTS sstm_n_2_8 "N" 0x49176 drehzahl a_893 10 IS_13_RES 8 0.0 8160.0 /end AXIS_PTS
/begin AXIS_PTS sstm_lm_kg_h_6_1 "LM_KG_H" 0x49188 lm_kg_h a_893 100 MAF_KGH_16_RES28 6 0.0 16383.75 /end AXIS_PTS
/begin AXIS_PTS sst_zw_dif_kf_fak_zw_mdz "ZW_DIF" 0x4893e dummy a_892 20 LINEAR_______48_000000__80H___0_ 8 -48.0 0.0 /end AXIS_PTS
/begin AXIS_PTS sstm_toel_7_7 "TOEL" 0x48950 toel a_892 100 LINEAR_______48_000000__0H___130 8 -48.0 155.0 /end AXIS_PTS
/begin AXIS_PTS sstm_n_7_7 "N" 0x48947 drehzahl a_892 100 ES_8_RES8 8 0.0 8160.0 /end AXIS_PTS
/begin AXIS_PTS sstm_tkw_st_2_8 "TKW_ST" 0x48959 tkw_st a_892 100 LINEAR_______48_000000__0H___133 8 -48.0 142.5 /end AXIS_PTS
/begin AXIS_PTS sstm_n_3_9 "N" 0x48962 drehzahl a_892 20 ES_8_RES8 8 0.0 8160.0 /end AXIS_PTS
/begin AXIS_PTS sst_tkw_st_kf_gws "TKW_ST" 0x4896b dummy a_892 100 LINEAR_______48_000000__0H___133 8 -48.0 142.5 /end AXIS_PTS
/begin AXIS_PTS sstm_tmdk_4_2 "TMDK" 0x48974 tmdk a_892 100 LINEAR_______48_000000__0H___142 4 -48.0 142.5 /end AXIS_PTS
/begin AXIS_PTS sst_ub_kf_imp_mdk_min_diag "UB" 0x48979 ubatt a_892 100 LINEAR______0_000000__0H___26_00 4 0.0 26.0 /end AXIS_PTS
/begin AXIS_PTS sstm_n_4_6 "N" 0x4897e drehzahl a_892 25 ES_8_RES8 3 0.0 8160.0 /end AXIS_PTS
/begin AXIS_PTS sst_lm_kf_kns_zyka_stns "LM" 0x48989 lm a_892 100 MAF_8_RES37 6 0.0 1389.0 /end AXIS_PTS
/begin AXIS_PTS sst_n_kf_kns_zyka_stns "N" 0x48982 n_32 a_892 100 ES_8_RES17 6 0.0 8160.0 /end AXIS_PTS
/begin AXIS_PTS sst_v_dif_fgr "V_DIF_FGR" 0x491a2 v_dif_fgr a_893 100 LINEAR_______256_000000__0H___25 4 -256.0 255.99218 /end AXIS_PTS
/begin AXIS_PTS sstm_vsoll_fgr "VSOLL_FGR" 0x49196 v_soll_fgr a_893 100 LINEAR______0_000000__0H___511_9 5 0.0 511.99218 /end AXIS_PTS
/begin AXIS_PTS sst_pq_hs_kf_kva_ps_kor "PQ_HS" 0x48990 pq_hs a_892 100 LINEAR______0_000000__0H___1_039 6 0.0 1.0 /end AXIS_PTS
/begin AXIS_PTS sst_lm_kf_lam_dif_max_te "LM" 0x4899d lm a_892 100 MAF_8_RES40 5 0.0 1389.0 /end AXIS_PTS
/begin AXIS_PTS sst_n_kf_lam_dif_max_te "N" 0x48997 n_32 a_892 100 ES_8_RES41 5 0.0 8160.0 /end AXIS_PTS
/begin AXIS_PTS sstm_lm_add_kor_1_12 "LM_ADD_KOR" 0x489ae lm_add_kor a_892 10 MAF_8_RES 12 0.0 1389.0 /end AXIS_PTS
/begin AXIS_PTS sstm_n_2_10 "N" 0x489a3 drehzahl a_892 10 ES_8_RES41 10 0.0 8160.0 /end AXIS_PTS
/begin AXIS_PTS sstm_tal_2_6 "TAL" 0x489bb tal a_892 15 LINEAR_______48_000000__0H___114 6 -48.0 142.5 /end AXIS_PTS
/begin AXIS_PTS sst_mdk_ist_kf_lm_diag_1 "MDK_IST" 0x491ac dummy a_893 10 MTC_NORM_16_RES44 16 0.0 119.99817 /end AXIS_PTS
/begin AXIS_PTS sstm_n_16_1 "N" 0x489c2 drehzahl a_892 100 ES_8_RES8 16 0.0 8160.0 /end AXIS_PTS
/begin AXIS_PTS sst_n_kf_lm_diag_2 "N" 0x489d3 drehzahl a_892 10 ES_8_RES8 6 0.0 8160.0 /end AXIS_PTS
/begin AXIS_PTS sst_lm_kf_lm_dif_max_lu "LM" 0x489da lm a_892 100 MAF_8_RES 6 0.0 1389.0 /end AXIS_PTS
/begin AXIS_PTS sst_n_kf_lm_gmw_s "N" 0x489e1 drehzahl a_892 12 ES_8_RES8 6 0.0 8160.0 /end AXIS_PTS
/begin AXIS_PTS sst_lm_int_sa_kf_lm_int_zv_sa "LM_INT_SA" 0x491ce dummy a_893 100 LM_INT_SA_RANGE 6 0.0 1820.42 /end AXIS_PTS
/begin AXIS_PTS sstm_fak_pu_5_22 "FAK_PU" 0x491dc fak_pu a_893 5 LINEAR______0_000000__0H___2_000 6 0.0 2.0 /end AXIS_PTS
/begin AXIS_PTS sstm_n_kf_lm_lam_zeit_mxx "N" 0x489e8 n_32 a_892 10 ES_8_RES41 6 0.0 8160.0 /end AXIS_PTS
/begin AXIS_PTS sstm_n_6_1 "N" 0x489ef n_32 a_892 100 ES_8_RES 6 0.0 8160.0 /end AXIS_PTS
/begin AXIS_PTS sst_n_kf_lm_max_diag_sl "N" 0x489f6 n_32 a_892 100 ES_8_RES41 8 0.0 8160.0 /end AXIS_PTS
/begin AXIS_PTS sstm_pq_ts "PQ_TS" 0x489ff pq_ts a_892 100 LINEAR______0_000000__0H___0_920 6 0.0 0.99599999 /end AXIS_PTS
/begin AXIS_PTS sst_tkw_kf_lm_min_kr "TKW" 0x48a06 tkw a_892 15 LINEAR_______48_000000__0H___114 4 -48.0 142.5 /end AXIS_PTS
/begin AXIS_PTS sstm_zw_dif_6_1 "ZW_DIF" 0x48a16 dummy a_892 100 LINEAR______0_000000__0H___95_62 6 0.0 95.625 /end AXIS_PTS
/begin AXIS_PTS sstm_n_1_8 "N" 0x48a0b drehzahl a_892 10 ES_8_RES8 10 0.0 8160.0 /end AXIS_PTS
/begin AXIS_PTS sst_n_lm_min_lu "N" 0x48a1d drehzahl a_892 5 ES_8_RES8 6 0.0 8160.0 /end AXIS_PTS
/begin AXIS_PTS sst_n_kf_lm_min_pu_fak "N" 0x48a24 n_32 a_892 100 ES_8_RES 4 0.0 8160.0 /end AXIS_PTS
/begin AXIS_PTS sstm_tkw_21_7 "TKW" 0x48a29 tkw a_892 15 LINEAR_______48_000000__0H___114 8 -48.0 142.5 /end AXIS_PTS
/begin AXIS_PTS sstm_n_22_7 "N" 0x48a32 drehzahl a_892 100 ES_8_RES8 12 0.0 8160.0 /end AXIS_PTS
/begin AXIS_PTS sstm_p_21_7 "P" 0x491ea p a_893 100 LINEAR______0_000000__0H___5434_ 8 0.0 5434.2598 /end AXIS_PTS
/begin AXIS_PTS sst_lm_gem_kf_lm_zdg_mitko "LM_GEM" 0x48a46 lm_gem a_892 10 MAF_8_RES40 6 0.0 1389.0 /end AXIS_PTS
/begin AXIS_PTS sst_n_kf_lm_zdg_mitko "N" 0x48a3f n_32 a_892 10 ES_8_RES41 6 0.0 8160.0 /end AXIS_PTS
/begin AXIS_PTS sst_lm_kf_lu_tors_0_at "LM" 0x48a54 lm a_892 100 MAF_8_RES37 6 0.0 1389.0 /end AXIS_PTS
/begin AXIS_PTS sstm_n_kf_tors_0_at "N" 0x48a4d n_32 a_892 100 ES_8_RES17 6 0.0 8160.0 /end AXIS_PTS
/begin AXIS_PTS sst_lm_kf_lu_tors_0_mt "LM" 0x48a62 lm a_892 100 MAF_8_RES37 6 0.0 1389.0 /end AXIS_PTS
/begin AXIS_PTS sstm_n_kf_tors_0_mt "N" 0x48a5b n_32 a_892 100 ES_8_RES17 6 0.0 8160.0 /end AXIS_PTS
/begin AXIS_PTS sst_lm_kf_lu_tors_1_at "LM" 0x48a70 lm a_892 100 MAF_8_RES37 6 0.0 1389.0 /end AXIS_PTS
/begin AXIS_PTS sstm_n_kf_tors_1_at "N" 0x48a69 n_32 a_892 100 ES_8_RES17 6 0.0 8160.0 /end AXIS_PTS
/begin AXIS_PTS sst_lm_kf_lu_tors_1_mt "LM" 0x48a7e lm a_892 100 MAF_8_RES37 6 0.0 1389.0 /end AXIS_PTS
/begin AXIS_PTS sstm_n_kf_tors_1_mt "N" 0x48a77 n_32 a_892 100 ES_8_RES17 6 0.0 8160.0 /end AXIS_PTS
/begin AXIS_PTS sst_lm_kf_lu_tors_2_at "LM" 0x48a8c lm a_892 100 MAF_8_RES37 6 0.0 1389.0 /end AXIS_PTS
/begin AXIS_PTS sstm_n_kf_tors_2_at "N" 0x48a85 n_32 a_892 100 ES_8_RES17 6 0.0 8160.0 /end AXIS_PTS
/begin AXIS_PTS sst_lm_kf_lu_tors_2_mt "LM" 0x48a9a lm a_892 100 MAF_8_RES37 6 0.0 1389.0 /end AXIS_PTS
/begin AXIS_PTS sstm_n_kf_tors_2_mt "N" 0x48a93 n_32 a_892 100 ES_8_RES17 6 0.0 8160.0 /end AXIS_PTS
/begin AXIS_PTS sst_lm_kf_lu_tors_3_at "LM" 0x48aa8 lm a_892 100 MAF_8_RES37 6 0.0 1389.0 /end AXIS_PTS
/begin AXIS_PTS sstm_n_kf_tors_3_at "N" 0x48aa1 n_32 a_892 100 ES_8_RES17 6 0.0 8160.0 /end AXIS_PTS
/begin AXIS_PTS sst_lm_kf_lu_tors_3_mt "LM" 0x48ab6 lm a_892 100 MAF_8_RES37 6 0.0 1389.0 /end AXIS_PTS
/begin AXIS_PTS sstm_n_kf_tors_3_mt "N" 0x48aaf n_32 a_892 100 ES_8_RES17 6 0.0 8160.0 /end AXIS_PTS
/begin AXIS_PTS sst_lm_kf_lu_tors_4_at "LM" 0x48ac4 lm a_892 100 MAF_8_RES37 6 0.0 1389.0 /end AXIS_PTS
/begin AXIS_PTS sstm_n_kf_tors_4_at "N" 0x48abd n_32 a_892 100 ES_8_RES17 6 0.0 8160.0 /end AXIS_PTS
/begin AXIS_PTS sst_lm_kf_lu_tors_4_mt "LM" 0x48ad2 lm a_892 100 MAF_8_RES37 6 0.0 1389.0 /end AXIS_PTS
/begin AXIS_PTS sstm_n_kf_tors_4_mt "N" 0x48acb n_32 a_892 100 ES_8_RES17 6 0.0 8160.0 /end AXIS_PTS
/begin AXIS_PTS sst_lm_kf_lu_tors_5_at "LM" 0x48ae0 lm a_892 100 MAF_8_RES37 6 0.0 1389.0 /end AXIS_PTS
/begin AXIS_PTS sstm_n_kf_tors_5_at "N" 0x48ad9 n_32 a_892 100 ES_8_RES17 6 0.0 8160.0 /end AXIS_PTS
/begin AXIS_PTS sst_lm_kf_lu_tors_5_mt "LM" 0x48aee lm a_892 100 MAF_8_RES37 6 0.0 1389.0 /end AXIS_PTS
/begin AXIS_PTS sstm_n_kf_tors_5_mt "N" 0x48ae7 n_32 a_892 100 ES_8_RES17 6 0.0 8160.0 /end AXIS_PTS
/begin AXIS_PTS sst_lm_kf_m_ind_lm "LM" 0x48af5 lm a_892 100 MAF_8_RES50 2 0.0 1389.0 /end AXIS_PTS
/begin AXIS_PTS sstm_pwg_12_1 "PWG" 0x48b05 dummy a_892 100 LINEAR______0_000000__0H___119_5 12 0.0 119.5 /end AXIS_PTS
/begin AXIS_PTS sstm_n_4_2 "N" 0x48af8 n_32 a_892 100 ES_8_RES17 12 0.0 8160.0 /end AXIS_PTS
/begin AXIS_PTS sstm_gang_6_1 "GANG" 0x48b12 gang a_892 10 LINEAR______0_000000__0H___7_000 6 0.0 7.0 /end AXIS_PTS
/begin AXIS_PTS sstm_v_fil_6_1 "V_FIL" 0x491fc v_fil a_893 100 LINEAR______0_000000__0H___511_9 6 0.0 511.99218 /end AXIS_PTS
/begin AXIS_PTS sstm_mdk_ist_kf_mitko "MDK_IST" 0x4920a mdk_ist a_893 100 MTC_NORM_16_RES51 6 0.0 119.99817 /end AXIS_PTS
/begin AXIS_PTS sst_lm_kf_m_reib "LM" 0x48b22 dummy a_892 100 MAF_8_RES37 2 0.0 1389.0 /end AXIS_PTS
/begin AXIS_PTS sst_n_kf_m_reib "N" 0x48b19 n_32 a_892 100 ES_8_RES17 8 0.0 8160.0 /end AXIS_PTS
/begin AXIS_PTS sstm_tkw_st_1_6 "TKW_ST" 0x48b32 dummy a_892 100 LINEAR_______48_000000__0H___114 4 -48.0 142.5 /end AXIS_PTS
/begin AXIS_PTS sstm_tkw_3_6 "TKW" 0x48b25 tkw a_892 100 LINEAR_______48_000000__0H___114 12 -48.0 142.5 /end AXIS_PTS
/begin AXIS_PTS sstm_pwg_ist_roh_6_1 "PWG_IST_ROH" 0x49218 pwg_ist_roh a_893 100 MTC_NORM_16_RES10 6 0.0 119.99817 /end AXIS_PTS
/begin AXIS_PTS sstm_dk_dif_kf_mdk_soll_mitko "DK_DIF" 0x49230 mdk_ist a_893 100 MTC_NORM_16_RES51 6 0.0 119.99817 /end AXIS_PTS
/begin AXIS_PTS sst_dk_kf_mdk_soll_auf_mitko "MDK_IST" 0x49226 mdk_ist a_893 100 MTC_NORM_16_RES51 4 0.0 119.99817 /end AXIS_PTS
/begin AXIS_PTS sstm_n_1_6 "N" 0x48b37 drehzahl a_892 100 ES_8_RES8 12 0.0 8160.0 /end AXIS_PTS
/begin AXIS_PTS sstm_pwg_mdk_soll_pwg "PWG" 0x4923e dummy a_893 100 LINEAR______0_000000__0H___119_8 12 0.0 119.8828 /end AXIS_PTS
/begin AXIS_PTS sst_dk_kf_mdk_soll_zu_mitko "MDK_IST" 0x49258 mdk_ist a_893 100 LINEAR______0_000000__0H___11954 4 0.0 119.5 /end AXIS_PTS
/begin AXIS_PTS sst_lm_ers_diag_kf_mitko_lm_van "LM_ERS_DIAG" 0x48b4b dummy a_892 100 MAF_8_RES 6 0.0 1389.0 /end AXIS_PTS
/begin AXIS_PTS sst_n_kf_mitko_lm_van "N" 0x48b44 drehzahl a_892 100 ES_8_RES8 6 0.0 8160.0 /end AXIS_PTS
/begin AXIS_PTS sst_tal_kf_n_disa_tal "TAL" 0x48b52 tal a_892 15 LINEAR_______48_000000__0H___121 8 -48.0 142.5 /end AXIS_PTS
/begin AXIS_PTS sst_tka_kf_n_el "TKA" 0x48b5b tco_ex a_892 15 LINEAR_______48_000000__0H___142 6 -48.0 142.5 /end AXIS_PTS
/begin AXIS_PTS sstm_temp_kat_6_1 "TEMP_GMW_ERS_KAT" 0x48b62 temp_gmw_ers_kat a_892 100 LINEAR_______33_000000__0H___990 6 -33.0 990.0 /end AXIS_PTS
/begin AXIS_PTS sst_tv_kf_n_el_tv_kor "TV" 0x48b69 geschwind a_892 100 LINEAR______0_000000__0H___25558 5 0.0 255.0 /end AXIS_PTS
/begin AXIS_PTS sst_n_el_kor_kf_n_proz_el_fil "N_EL_KOR_FIL" 0x48b6f n_el_kor_fil a_892 10 LINEAR______0_000000__0H___15_94 6 0.0 15.94 /end AXIS_PTS
/begin AXIS_PTS sst_tkw_kf_nmax_abf "TKW" 0x48b76 tkw a_892 100 LINEAR_______48_000000__0H___142 3 -48.0 142.5 /end AXIS_PTS
/begin AXIS_PTS sstm_dk_kf_nmax_diag_x "PWG_IST" 0x48b7a pwg_ist a_892 10 LINEAR______0_000000__0H___11959 3 0.0 119.5 /end AXIS_PTS
/begin AXIS_PTS sstm_tkw_2_6 "TKW" 0x48b7e tkw a_892 15 LINEAR_______48_000000__0H___114 4 -48.0 142.5 /end AXIS_PTS
/begin AXIS_PTS sst_vue_kf_nr_kf_lm "VUE" 0x49262 vue a_893 100 LINEAR______0_000000__0H___120_0 8 0.0 120.0 /end AXIS_PTS
/begin AXIS_PTS sst_zw_dif_kf_nr_ti_ks "ZW_DIF" 0x48b83 dummy a_892 100 LINEAR______0_000000__0H___95_62 5 0.0 95.625 /end AXIS_PTS
/begin AXIS_PTS sst_tkw_kf_nsoll_aebg_kat2 "TKW" 0x48b89 tkw a_892 15 LINEAR_______48_000000__0H___142 8 -48.0 142.5 /end AXIS_PTS
/begin AXIS_PTS sstm_tkw_st_kf_nwsoll_add_kat2 "TKW_ST" 0x48b92 tkw_st a_892 100 LINEAR_______48_000000__0H___142 8 -48.0 142.5 /end AXIS_PTS
/begin AXIS_PTS sstm_lm_van_kf_nwsoll_tkwx_ll_y "LM_VAN" 0x49282 lm_van a_893 100 MAF_16_RES49 6 0.0 1389.0 /end AXIS_PTS
/begin AXIS_PTS sstm_n_kf_nwsoll_tkwx_ll_y "N" 0x49274 drehzahl a_893 100 IS_13_RES62 6 0.0 8160.0 /end AXIS_PTS
/begin AXIS_PTS sstm_lm_van_kf_nwsoll_tkwx_tl_y "LM_VANOS" 0x492b2 lm_van a_893 100 MAF_16_RES49 12 0.0 1389.0 /end AXIS_PTS
/begin AXIS_PTS sstm_n_16_3 "N" 0x49290 drehzahl a_893 100 IS_13_RES62 16 0.0 8160.0 /end AXIS_PTS
/begin AXIS_PTS sstm_uls_kat_6_1 "ULS_KAT" 0x48ba4 dummy a_892 10 LINEAR______0_000000__0H___1_275 6 0.0 1.275 /end AXIS_PTS
/begin AXIS_PTS sst_tkw_kf_p_ini_ns "TKW" 0x48bab tkw a_892 100 LINEAR_______48_000000__0H___142 4 -48.0 142.5 /end AXIS_PTS
/begin AXIS_PTS sst_mdk_sum_kf_pq_hs_m "MDK_SUM" 0x492da dummy a_893 100 MTC_NORM_16_RES68 8 0.0 119.99817 /end AXIS_PTS
/begin AXIS_PTS sst_n_kf_pq_hs_m "N" 0x48bb0 n_32 a_892 10 ES_8_RES8 8 0.0 8160.0 /end AXIS_PTS
/begin AXIS_PTS sst_n_32 "N_32" 0x48bb9 n_32 a_892 100 LINEAR______0_000000__0H___81669 5 0.0 8169.0 /end AXIS_PTS
/begin AXIS_PTS sst_pwg_fak_kat_zw "PWG_IST" 0x48bc6 pwg_ist a_892 5 LINEAR______0_000000__0H___11972 2 0.0 119.5 /end AXIS_PTS
/begin AXIS_PTS sstm_zwdifkt_1_6 "ZWDIFKT" 0x48bbf iga_ch_offsetvbyteC1D a_892 5 LINEAR_______48_000000__0H___0_0 6 -48.0 0.0 /end AXIS_PTS
/begin AXIS_PTS sst_pwg_ist_kf_pwg_fak_kup_swi "PWG_IST" 0x492fa pwg_ist a_893 5 MTC_NORM_16_RES73 2 0.0 119.99817 /end AXIS_PTS
/begin AXIS_PTS sst_n_dif_kf_pwg_fak_kup_swi "N_DIF" 0x492ec n_dif a_893 100 LINEAR_______32768_000000__0H___ 6 -32768.0 32767.0 /end AXIS_PTS
/begin AXIS_PTS sst_v_fil_kf_pwg_fgr_max "V_FIL" 0x49300 v_fil a_893 100 LINEAR______0_000000__0H___51174 4 0.0 511.99218 /end AXIS_PTS
/begin AXIS_PTS sst_n_kf_pwg_llfs_fak "N" 0x48bc9 drehzahl a_892 100 ES_8_RES8 12 0.0 8160.0 /end AXIS_PTS
/begin AXIS_PTS sst_pwg_kor_kf_pwg_llfs_fak "PWG_KOR" 0x4930a dummy a_893 100 LINEAR______0_000000__0H___11976 12 0.0 119.5 /end AXIS_PTS
/begin AXIS_PTS sst_tallfs_kf_pwg_llfs_tallfs "TALLFS_LAST_GES" 0x49324 tallfs_last_ges a_893 100 TALLFS 12 0.0 399.9938 /end AXIS_PTS
/begin AXIS_PTS sstm_m_ind_4_2 "M_IND" 0x4933e dummy a_893 100 LINEAR______0_000000__0H___1023_ 12 0.0 1023.0 /end AXIS_PTS
/begin AXIS_PTS sstm_n_5_1 "N" 0x48bd6 n_32 a_892 100 ES_8_RES41 5 0.0 8160.0 /end AXIS_PTS
/begin AXIS_PTS sst_lm_kf_schw_ll_lu_diag "LM" 0x48bdc lm a_892 7 MAF_8_RES37 4 0.0 1389.0 /end AXIS_PTS
/begin AXIS_PTS sst_n_kf_schw_ll_lu_diag "N" 0x49358 drehzahl a_893 12 IS_13_RES78 4 0.0 8160.0 /end AXIS_PTS
/begin AXIS_PTS sstm_lm_1_22 "LM" 0x49362 lm a_893 5 MAF_16_RES79 6 0.0 1389.0 /end AXIS_PTS
/begin AXIS_PTS sst_n_kf_schw_lu_at "N" 0x48be1 drehzahl a_892 5 ES_8_RES8 12 0.0 8160.0 /end AXIS_PTS
/begin AXIS_PTS sst_n_kf_schw_lu_mt "N" 0x48bee drehzahl a_892 5 ES_8_RES8 12 0.0 8160.0 /end AXIS_PTS
/begin AXIS_PTS sst_tv_kf_schw_rad_grd_sws "TV" 0x48bfb geschwind a_892 100 LINEAR______0_000000__0H___25558 8 0.0 255.0 /end AXIS_PTS
/begin AXIS_PTS sst_tv_kf_schw_rad_grd_sws_ldp "TV" 0x48c04 geschwind a_892 100 LINEAR______0_000000__0H___25558 8 0.0 255.0 /end AXIS_PTS
/begin AXIS_PTS sstm_n_4_22 "N" 0x48c0d drehzahl a_892 12 ES_8_RES8 3 0.0 8160.0 /end AXIS_PTS
/begin AXIS_PTS sstm_ub_1_2 "UB" 0x48c11 ubatt a_892 12 LINEAR______0_000000__0H___26_81 8 0.0 26.0 /end AXIS_PTS
/begin AXIS_PTS sstm_tmdk_1 "TMDK" 0x48c21 tmdk a_892 100 LINEAR_______48_000000__0H___142 4 -48.0 142.5 /end AXIS_PTS
/begin AXIS_PTS sstm_ub_tamdk "UB" 0x48c1a ubatt a_892 12 LINEAR______0_000000__0H___26_82 6 0.0 26.0 /end AXIS_PTS
/begin AXIS_PTS sstm_toel_3_1 "TOEL" 0x48c2a toel a_892 100 LINEAR_______48_000000__0H___155 3 -48.0 155.0 /end AXIS_PTS
/begin AXIS_PTS sstm_n_3_1 "N" 0x48c26 n_32 a_892 10 ES_8_RES17 3 0.0 8160.0 /end AXIS_PTS
/begin AXIS_PTS sst_lm_gmw_kf_t_sa_verz "LM_GMW" 0x4937e lm_gmw a_893 10 MAF_16_RES83 4 0.0 1389.0 /end AXIS_PTS
/begin AXIS_PTS sstm_n_3_4 "N" 0x49370 drehzahl a_893 10 IS_13_RES84 6 0.0 8160.0 /end AXIS_PTS
/begin AXIS_PTS sst_zw_kat_kf_t_sa_verz_kh "ZWDIFKAT" 0x48c2e iga_ch_offsetvbyteC1D a_892 10 LINEAR_______48_000000__0H___0_0 4 -48.0 0.0 /end AXIS_PTS
/begin AXIS_PTS sstm_lm_kgh_8_1 "LM_KG_H" 0x49388 lm_kg_h a_893 100 MAF_KGH_16_RES28 8 0.0 16383.75 /end AXIS_PTS
/begin AXIS_PTS sstm_uls_dif_x_zv_kf_t_zv_y "ULS_DIF_ZV" 0x48c43 dummy a_892 100 LINEAR_______0_637500__0H___0_63 12 -0.6375 0.6375 /end AXIS_PTS
/begin AXIS_PTS sst_ub_ta_ub_vanos "UB" 0x48c50 ubatt a_892 100 LINEAR______0_000000__0H___26_00 3 0.0 26.0 /end AXIS_PTS
/begin AXIS_PTS sst_ub_kf_tah_vanos "UB" 0x48c5b ubatt a_892 100 LINEAR______0_000000__0H___26_00 4 0.0 26.0 /end AXIS_PTS
/begin AXIS_PTS sstm_tmag_9_7 "TMAG" 0x48c54 tab_tmag a_892 100 LINEAR_______48_000000__0H___155 6 -48.0 155.0 /end AXIS_PTS
/begin AXIS_PTS sst_tkw_dif_kf_takfk_i "TKW_DIF" 0x48c60 dummy a_892 100 LINEAR_______96_000000__0H___95_ 8 -96.0 95.25 /end AXIS_PTS
/begin AXIS_PTS sst_tkw_dif_kf_takfk_p "TKW_DIF" 0x48c69 dummy a_892 100 LINEAR_______96_000000__0H___95_ 8 -96.0 95.25 /end AXIS_PTS
/begin AXIS_PTS sst_utal_kf_tal "UTAL" 0x48c72 dummy a_892 90 LINEAR______0_039000__2H___4_986 16 0.039 4.9860001 /end AXIS_PTS
/begin AXIS_PTS sst_n_dif_kf_tallfs_at_tv "N_DIF" 0x4939a n_dif a_893 5 LINEAR_______32768_000000__0H_86 4 -32768.0 32767.0 /end AXIS_PTS
/begin AXIS_PTS sst_tv_kf_tallfs_at_tv "TV" 0x48c83 geschwind a_892 100 LINEAR______0_000000__0H___25558 4 0.0 255.0 /end AXIS_PTS
/begin AXIS_PTS sst_ngrd_kf_tallfs_d_ll "NGRD" 0x48c88 dummy a_892 3 LINEAR_______4096_000000__0H___4 4 -4096.0 4064.0 /end AXIS_PTS
/begin AXIS_PTS sst_tkw_kf_tallfs_diag "TKW" 0x48c8d tkw a_892 100 LINEAR_______48_000000__0H___189 4 -48.0 142.5 /end AXIS_PTS
/begin AXIS_PTS sst_tael_el_kf_tallfs_el_add "TAEL_EL" 0x48c92 tael_el a_892 100 LINEAR______0_000000__0H___99_61 6 0.0 99.610001 /end AXIS_PTS
/begin AXIS_PTS sstm_tkw_3_8 "TKW" 0x48c99 tkw a_892 15 LINEAR_______48_000000__0H___121 8 -48.0 142.5 /end AXIS_PTS
/begin AXIS_PTS sstm_ndifkat2_1_6 "NDIFKAT2" 0x493a4 nsoll_add_offset a_893 2 LINEAR______0_000000__0H___81692 6 0.0 8160.0 /end AXIS_PTS
/begin AXIS_PTS sst_tal_kf_tallfs_kk "TAL" 0x48ca2 tal a_892 16 LINEAR_______48_000000__0H___133 4 -48.0 142.5 /end AXIS_PTS
/begin AXIS_PTS sstm_n_3_6 "N" 0x493b2 drehzahl a_893 10 IS_13_RES 4 0.0 8160.0 /end AXIS_PTS
/begin AXIS_PTS sst_n_kf_tallfs_kor_fak "N" 0x493ce drehzahl a_893 100 IS_13_RES78 4 0.0 8160.0 /end AXIS_PTS
/begin AXIS_PTS sst_pwg_kor_kf_tallfs_kor_fak "PWG_KOR" 0x493bc dummy a_893 100 LINEAR______0_000000__0H___11976 8 0.0 119.5 /end AXIS_PTS
/begin AXIS_PTS sst_tallfs_kf_tallfs_kor_llfs "TALLFS_GMW" 0x493d8 tallfs_gmw a_893 10 LINEAR______0_000000__0H___99_94 8 0.0 99.998497 /end AXIS_PTS
/begin AXIS_PTS sst_dk_grd_kf_tallfs_mitko "DK_GRD" 0x48ca7 dk_grd a_892 100 LINEAR______0_000000__0H___29895 4 0.0 2988.0 /end AXIS_PTS
/begin AXIS_PTS sstm_n_dif_kor_7_6 "N_DIF_KOR" 0x493ea n_dif_kor a_893 5 LINEAR_______1024_000000__7C00H_ 8 -1024.0 1016.0 /end AXIS_PTS
/begin AXIS_PTS sst_ndfss_kf_tallfs_nsoll_add_s "NDFSS" 0x48cac nsoll_ll_ser a_892 100 LINEAR_______256_000000__0___254 6 -256.0 254.0 /end AXIS_PTS
/begin AXIS_PTS sstm_n_dif_kor_6_6 "N_DIF_KOR" 0x49406 n_dif_kor a_893 5 LINEAR_______1024_000000__7C00H_ 12 -1024.0 1016.0 /end AXIS_PTS
/begin AXIS_PTS sstm_pwg_kf_tallfs_pwg "PWG" 0x49420 dummy a_893 100 LINEAR______0_000000__0H___119_8 12 0.0 119.8828 /end AXIS_PTS
/begin AXIS_PTS sstm_n_3_22 "N" 0x48cb8 drehzahl a_892 12 ES_8_RES8 4 0.0 8160.0 /end AXIS_PTS
/begin AXIS_PTS sstm_n_2_5 "N" 0x4943a drehzahl a_893 10 IS_13_RES 3 0.0 8160.0 /end AXIS_PTS
/begin AXIS_PTS sst_tal_kf_tallfs_tal_add "TAL" 0x48cbd tal a_892 16 LINEAR_______48_000000__0H___197 4 -48.0 142.5 /end AXIS_PTS
/begin AXIS_PTS sst_toel_kf_tallfs_toel_add "TOEL" 0x48cc2 toel a_892 100 LINEAR_______48_000000__0H___156 6 -48.0 155.0 /end AXIS_PTS
/begin AXIS_PTS sstm_vue_kf_xxx_vue_xxx "VUE" 0x49442 vue a_893 100 LINEAR______0_000000__0H___12099 8 0.0 120.0 /end AXIS_PTS
/begin AXIS_PTS sstm_tkw_6_1 "TKW" 0x48cc9 tkw a_892 100 LINEAR_______48_000000__0H___100 8 -48.0 142.5 /end AXIS_PTS
/begin AXIS_PTS sst_n_kf_talsh_aebg_sa "N" 0x48cd2 n_32 a_892 100 ES_8_RES 6 0.0 8160.0 /end AXIS_PTS
/begin AXIS_PTS sstm_tmdk_4_1 "TMDK" 0x48cd9 tmdk a_892 100 LINEAR_______48_000000__0H___142 4 -48.0 142.5 /end AXIS_PTS
/begin AXIS_PTS sst_lm_kg_h_kf_tamdk_ini_asc "LM_KG_H" 0x49454 lm_kg_h a_893 5 LINEAR______0_250000__1H___16383 4 0.25 16383.75 /end AXIS_PTS
/begin AXIS_PTS sstm_lm_1_10 "LM" 0x48cde lm a_892 5 MAF_8_RES40 12 0.0 1389.0 /end AXIS_PTS
/begin AXIS_PTS sst_tate_kf_tate_tev "TATE" 0x4945e tate a_893 20 LINEAR______0_000000__0H___99_97 5 0.0 99.97559 /end AXIS_PTS
/begin AXIS_PTS sst_tumg_kf_temp_ers_el_ini "TUMG" 0x48cf2 tumg a_892 100 LINEAR_______128_000000__0H___12 6 -128.0 127.0 /end AXIS_PTS
/begin AXIS_PTS sst_tkw_kf_temp_ers_el_ini "TKW" 0x48ceb tkw a_892 100 LINEAR_______48_000000__0H___142 6 -48.0 142.5 /end AXIS_PTS
/begin AXIS_PTS sstm_lm_kg_h_2_22 "LM_KG_H" 0x4946a lm_kg_h a_893 10 MAF_KGH_16_RES15 8 0.0 16383.75 /end AXIS_PTS
/begin AXIS_PTS sst_tal_kf_temp_sond_ini "TAL" 0x48d00 tal a_892 100 LINEAR_______48_000000__0H___142 6 -48.0 142.5 /end AXIS_PTS
/begin AXIS_PTS sst_tkw_kf_temp_sond_ini "TKW" 0x48cf9 tkw a_892 100 LINEAR_______48_000000__0H___142 6 -48.0 142.5 /end AXIS_PTS
/begin AXIS_PTS sst_zyk_kf_ti_abr_kns "ZYK" 0x4947c dummy a_893 1 LINEAR______0_000000__0H___65535 6 0.0 65535.0 /end AXIS_PTS
/begin AXIS_PTS sst_zyk_kf_ti_abr_kst "ZYK" 0x4948a dummy a_893 100 LINEAR______0_000000__0H___65535 4 0.0 65535.0 /end AXIS_PTS
/begin AXIS_PTS sstm_n_21_7 "N" 0x48d07 drehzahl a_892 100 ES_8_RES8 8 0.0 8160.0 /end AXIS_PTS
/begin AXIS_PTS sst_ti_ad_add_gmw "TI_AD_ADD_GMW" 0x49494 dummy a_893 20 LINEAR_______4_995000__7C57H___5 5 -4.9949999 5.0 /end AXIS_PTS
/begin AXIS_PTS sstm_tkw_2_8 "TKW" 0x48d10 tkw a_892 14 LINEAR_______48_000000__0H___133 5 -48.0 142.5 /end AXIS_PTS
/begin AXIS_PTS sst_ti_ad_fak_gmw "TI_AD_FAK_GMW" 0x494a0 dummy a_893 20 LINEAR_______31_250000__3000H___ 5 -31.25 31.25 /end AXIS_PTS
/begin AXIS_PTS sstm_n_kf_ti_ad_lm "N" 0x48d16 n_32 a_892 100 ES_8_RES 6 0.0 8160.0 /end AXIS_PTS
/begin COMPU_METHOD LINEAR______0_000000__0H___65535 "" FORM "%6.0" "" FORMULA "1.0*X" FORMULA_INV "1.0*X" /end COMPU_METHOD
/begin COMPU_METHOD LINEAR______0_000000__0H___255_0 "" FORM "%3.0" "" FORMULA "1.0*X" FORMULA_INV "1.0*X" /end COMPU_METHOD
/begin COMPU_METHOD LINEAR______0_000000__0H___0_498 "" FORM "%5.3" "[-]" FORMULA "0.0019531373*X" FORMULA_INV "511.99679*X" /end COMPU_METHOD
/begin COMPU_METHOD ES_8_RES "" FORM "%4.0" "[1/min]" FORMULA "32.0*X" FORMULA_INV "0.03125*X" /end COMPU_METHOD
/begin COMPU_METHOD MTC_NORM_16_RES "" FORM "%5.1" "[°DK]" FORMULA "0.0018310547*X" FORMULA_INV "546.13333*X" /end COMPU_METHOD
/begin COMPU_METHOD LINEAR______0_000000__0H___3_984 "" FORM "%4.2" "[%]" FORMULA "0.015625*X" FORMULA_INV "64.0*X" /end COMPU_METHOD
/begin COMPU_METHOD LINEAR______0_000000__0H___99_61 "" FORM "%4.1" "[%]" FORMULA "0.39062745*X" FORMULA_INV "2.5599839*X" /end COMPU_METHOD
/begin COMPU_METHOD LINEAR_______33_000000__0H___987 "" FORM "%5.1" "[°C]" FORMULA "4.0*X-33.0" FORMULA_INV "0.25*X+8.25" /end COMPU_METHOD
/begin COMPU_METHOD LINEAR_______128_000000__0H___12 "" FORM "%6.1" "[°C]" FORMULA "1.0*X-128.0" FORMULA_INV "1.0*X+128.0" /end COMPU_METHOD
/begin COMPU_METHOD LINEAR_______48_000000__0H___155 "" FORM "%5.1" "[°C]" FORMULA "0.79607843*X-48.0" FORMULA_INV "1.2561576*X+60.295567" /end COMPU_METHOD
/begin COMPU_METHOD LINEAR______0_000000__0H___255_5 "" FORM "%6.3" "[Nm]" FORMULA "1.0*X" FORMULA_INV "1.0*X" /end COMPU_METHOD
/begin COMPU_METHOD LINEAR_______48_000000__0H___156 "" FORM "%3.0" "[°C]" FORMULA "0.79607843*X-48.0" FORMULA_INV "1.2561576*X+60.295567" /end COMPU_METHOD
/begin COMPU_METHOD LINEAR______0_000000__0H___31_00 "" FORM "%3.0" "[Nm]" FORMULA "1.0*X" FORMULA_INV "1.0*X" /end COMPU_METHOD
/begin COMPU_METHOD LINEAR______0_000000__0H___1_992 "" FORM "%5.3" "[-]" FORMULA "0.0078125491*X" FORMULA_INV "127.9992*X" /end COMPU_METHOD
/begin COMPU_METHOD LINEAR______0_000000__0H___25_50 "" FORM "%5.2" "[s]" FORMULA "0.1*X" FORMULA_INV "10.0*X" /end COMPU_METHOD
/begin COMPU_METHOD LINEAR______0_000000__0H___0_999 "" FORM "%8.5" "[-/120°KW]" FORMULA "1.5258789e-005*X" FORMULA_INV "65536.0*X" /end COMPU_METHOD
/begin COMPU_METHOD ES_8_RES8 "" FORM "%5.0" "" FORMULA "32.0*X" FORMULA_INV "0.03125*X" /end COMPU_METHOD
/begin COMPU_METHOD MTC_NORM_16_RES10 "" FORM "%6.2" "[°DK]" FORMULA "0.0018310547*X" FORMULA_INV "546.13333*X" /end COMPU_METHOD
/begin COMPU_METHOD PVS_NORM_8_RES "" FORM "%5.1" "" FORMULA "0.46862745*X" FORMULA_INV "2.1338912*X" /end COMPU_METHOD
/begin COMPU_METHOD MAF_KGH_16_RES "" FORM "%8.1" "" FORMULA "0.25*X" FORMULA_INV "4.0*X" /end COMPU_METHOD
/begin COMPU_METHOD LINEAR______0_000000__0H___2988_ "" FORM "%6.1" "" FORMULA "11.717647*X" FORMULA_INV "0.085341365*X" /end COMPU_METHOD
/begin COMPU_METHOD MTC_NORM_8_RES "" FORM "%5.1" "[°DK]" FORMULA "0.46875*X" FORMULA_INV "2.1333333*X" /end COMPU_METHOD
/begin COMPU_METHOD LINEAR_______48_000000__0H___142 "" FORM "%5.1" "[°C]" FORMULA "0.75*X-48.0" FORMULA_INV "1.3333333*X+64.0" /end COMPU_METHOD
/begin COMPU_METHOD LINEAR_______48_000000__0H___112 "" FORM "%5.1" "[°]" FORMULA "0.75*X-48.0" FORMULA_INV "1.3333333*X+64.0" /end COMPU_METHOD
/begin COMPU_METHOD LINEAR_______180_000000__0H___50 "" FORM "%5.0" "[°KW]" FORMULA "6.0*X-180.0" FORMULA_INV "0.16666667*X+30.0" /end COMPU_METHOD
/begin COMPU_METHOD TI_BAS_16_RES "" FORM "%7.3" "" FORMULA "0.004*X" FORMULA_INV "250.0*X" /end COMPU_METHOD
/begin COMPU_METHOD IS_13_RES "" FORM "%5.0" "" FORMULA "1.0*X" FORMULA_INV "1.0*X" /end COMPU_METHOD
/begin COMPU_METHOD LINEAR______300_000000__14H___54 "" FORM "%4.0" "" FORMULA "6.0*X+180.0" FORMULA_INV "0.16666667*X-30.0" /end COMPU_METHOD
/begin COMPU_METHOD LINEAR______60_000000__0H___155_ "" FORM "%7.3" "" FORMULA "0.375*X+60.0" FORMULA_INV "2.6666667*X-160.0" /end COMPU_METHOD
/begin COMPU_METHOD LINEAR______540_000000__0H___300 "" FORM "%3.0" "[°KW]" FORMULA "-6.0*X+540.0" FORMULA_INV "-0.16666667*X+90.0" /end COMPU_METHOD
/begin COMPU_METHOD LINEAR_______48_000000__0H___114 "" FORM "%4.0" "" FORMULA "0.75*X-48.0" FORMULA_INV "1.3333333*X+64.0" /end COMPU_METHOD
/begin COMPU_METHOD LINEAR______0_000000__0H___1_000 "" FORM "%7.5" "" FORMULA "1.5259022e-005*X" FORMULA_INV "65535.0*X" /end COMPU_METHOD
/begin COMPU_METHOD MAF_KGH_16_RES15 "" FORM "%6.1" "" FORMULA "0.25*X" FORMULA_INV "4.0*X" /end COMPU_METHOD
/begin COMPU_METHOD LINEAR______0_000000__0H___0_916 "" FORM "%5.3" "[-]" FORMULA "1.5258789e-005*X" FORMULA_INV "65536.0*X" /end COMPU_METHOD
/begin COMPU_METHOD LINEAR______0_000000__0H___255_9 "" FORM "%7.3" "[-]" FORMULA "0.0039062486*X" FORMULA_INV "256.00009*X" /end COMPU_METHOD
/begin COMPU_METHOD LINEAR______0_000000__0H___7_968 "" FORM "%4.2" "" FORMULA "0.031247059*X" FORMULA_INV "32.003012*X" /end COMPU_METHOD
/begin COMPU_METHOD MAF_8_RES "" FORM "%5.0" "" FORMULA "5.4470588*X" FORMULA_INV "0.18358531*X" /end COMPU_METHOD
/begin COMPU_METHOD LINEAR______0_000000__0H___3_996 "" FORM "%4.3" "[-]" FORMULA "0.0039061584*X" FORMULA_INV "256.006*X" /end COMPU_METHOD
/begin COMPU_METHOD ES_8_RES17 "" FORM "%4.0" "[U/min]" FORMULA "32.0*X" FORMULA_INV "0.03125*X" /end COMPU_METHOD
/begin COMPU_METHOD LINEAR______0_000000__0H___0_996 "" FORM "%5.3" "[-]" FORMULA "0.0039062745*X" FORMULA_INV "255.99839*X" /end COMPU_METHOD
/begin COMPU_METHOD LINEAR______0_000000__0H___0_918 "" FORM "%6.4" "[-]" FORMULA "1.5258789e-005*X" FORMULA_INV "65536.0*X" /end COMPU_METHOD
/begin COMPU_METHOD LINEAR______0_000000__0H___119_5 "" FORM "%6.2" "[°DK]" FORMULA "0.46862745*X" FORMULA_INV "2.1338912*X" /end COMPU_METHOD
/begin COMPU_METHOD LINEAR______0_000000__0H___100_0 "" FORM "%5.2" "[%]" FORMULA "0.39215686*X" FORMULA_INV "2.55*X" /end COMPU_METHOD
/begin COMPU_METHOD LINEAR______0_000000__0H___64_00 "" FORM "%5.2" "[-]" FORMULA "0.0009765774*X" FORMULA_INV "1023.9844*X" /end COMPU_METHOD
/begin COMPU_METHOD LINEAR______0_000000__0H___106_2 "" FORM "%5.1" "[%/°DK]" FORMULA "0.41662745*X" FORMULA_INV "2.4002259*X" /end COMPU_METHOD
/begin COMPU_METHOD LINEAR______0_000000__0H___119_9 "" FORM "%6.2" "[°DK]" FORMULA "0.0018310552*X" FORMULA_INV "546.13319*X" /end COMPU_METHOD
/begin COMPU_METHOD LINEAR______0_000000__0H___0_920 "" FORM "%5.3" "[-]" FORMULA "0.0039058823*X" FORMULA_INV "256.0241*X" /end COMPU_METHOD
/begin COMPU_METHOD LINEAR_______48_000000__0H___121 "" FORM "%4.0" "[°C]" FORMULA "0.75*X-48.0" FORMULA_INV "1.3333333*X+64.0" /end COMPU_METHOD
/begin COMPU_METHOD LINEAR______0_000000__0H___1_922 "" FORM "%5.3" "" FORMULA "0.0078117646*X" FORMULA_INV "128.01205*X" /end COMPU_METHOD
/begin COMPU_METHOD LINEAR______0_000000__0H___99_99 "" FORM "%4.1" "[%]" FORMULA "0.0015258717*X" FORMULA_INV "655.3631*X" /end COMPU_METHOD
/begin COMPU_METHOD LINEAR______0_000000__0H___15_94 "" FORM "%5.2" "[-]" FORMULA "0.062509802*X" FORMULA_INV "15.997491*X" /end COMPU_METHOD
/begin COMPU_METHOD LINEAR______0_000000__0H___0_923 "" FORM "%4.3" "[-]" FORMULA "0.0039062745*X" FORMULA_INV "255.99839*X" /end COMPU_METHOD
/begin COMPU_METHOD LINEAR_______50_000000__0H___49_ "" FORM "%4.1" "[%]" FORMULA "0.0015258793*X-50.0" FORMULA_INV "655.35983*X+32767.991" /end COMPU_METHOD
/begin COMPU_METHOD LINEAR______0_000000__0H___0_924 "" FORM "%5.3" "[-]" FORMULA "1.5258716e-005*X" FORMULA_INV "65536.313*X" /end COMPU_METHOD
/begin COMPU_METHOD LINEAR______1_000000__80H___1_99 "" FORM "%5.3" "[-]" FORMULA "0.0078110235*X+0.00018899654" FORMULA_INV "128.0242*X-0.02419613" /end COMPU_METHOD
/begin COMPU_METHOD LINEAR______1_000000__100H___1_9 "" FORM "%5.3" "" FORMULA "0.0039062743*X-6.2243137e-006" FORMULA_INV "255.99841*X+0.0015934144" /end COMPU_METHOD
/begin COMPU_METHOD LINEAR______0_003900__0H___1_000 "" FORM "%6.4" "[-]" FORMULA "0.0039062745*X+0.0039" FORMULA_INV "255.99839*X-0.99839374" /end COMPU_METHOD
/begin COMPU_METHOD LINEAR_______48_000000__0H___0_0 "" FORM "%5.1" "[°KW]" FORMULA "0.375*X-48.0" FORMULA_INV "2.6666667*X+128.0" /end COMPU_METHOD
/begin COMPU_METHOD LINEAR______0_000200__1H___0_062 "" FORM "%7.5" "[-/10ms]" FORMULA "1.5212506e-005*X+0.00018478749" FORMULA_INV "65735.389*X-12.147078" /end COMPU_METHOD
/begin COMPU_METHOD LINEAR______0_000000__0H___8160_ "" FORM "%4.0" "[1/min]" FORMULA "1.0*X" FORMULA_INV "1.0*X" /end COMPU_METHOD
/begin COMPU_METHOD LINEAR______0_000000__0H___0_925 "" FORM "%5.3" "" FORMULA "0.0039058823*X" FORMULA_INV "256.0241*X" /end COMPU_METHOD
/begin COMPU_METHOD LINEAR______0_003900__0H___1_026 "" FORM "%5.3" "[-]" FORMULA "0.0039062745*X+0.0039" FORMULA_INV "255.99839*X-0.99839374" /end COMPU_METHOD
/begin COMPU_METHOD LINEAR______0_000000__0H___3_927 "" FORM "%5.3" "[-]" FORMULA "0.015625*X" FORMULA_INV "64.0*X" /end COMPU_METHOD
/begin COMPU_METHOD MAF_KGH_16_RES28 "" FORM "%8.2" "[kg/h]" FORMULA "0.25*X" FORMULA_INV "4.0*X" /end COMPU_METHOD
/begin COMPU_METHOD LINEAR_______4_000000__0H___3_97 "" FORM "%5.2" "[-]" FORMULA "0.031254902*X-4.0" FORMULA_INV "31.994981*X+127.97992" /end COMPU_METHOD
/begin COMPU_METHOD LINEAR______0_000000__0H___1_999 "" FORM "%7.5" "[-]" FORMULA "3.0517585e-005*X" FORMULA_INV "32767.992*X" /end COMPU_METHOD
/begin COMPU_METHOD LINEAR_______48_000000__80H___0_ "" FORM "%5.3" "" FORMULA "-0.375*X" FORMULA_INV "-2.6666667*X" /end COMPU_METHOD
/begin COMPU_METHOD LINEAR______0_000000__0H___2550_ "" FORM "%4.0" "[ms]" FORMULA "10.0*X" FORMULA_INV "0.1*X" /end COMPU_METHOD
/begin COMPU_METHOD LINEAR_______48_000000__0H___130 "" FORM "%5.1" "" FORMULA "0.79607843*X-48.0" FORMULA_INV "1.2561576*X+60.295567" /end COMPU_METHOD
/begin COMPU_METHOD LINEAR______0_000000__0H___81631 "" FORM "%5.0" "[1/min]" FORMULA "0.25*X" FORMULA_INV "4.0*X" /end COMPU_METHOD
/begin COMPU_METHOD LINEAR______0_000000__0H___1000_ "" FORM "%7.2" "[1/min]" FORMULA "0.25*X" FORMULA_INV "4.0*X" /end COMPU_METHOD
/begin COMPU_METHOD LINEAR______0_000000__0H___10032 "" FORM "%7.2" "[U/min]" FORMULA "0.03125*X" FORMULA_INV "32.0*X" /end COMPU_METHOD
/begin COMPU_METHOD LINEAR_______48_000000__0H___133 "" FORM "%5.1" "" FORMULA "0.75*X-48.0" FORMULA_INV "1.3333333*X+64.0" /end COMPU_METHOD
/begin COMPU_METHOD LINEAR______0_000000__0H___5_100 "" FORM "%4.2" "" FORMULA "0.02*X" FORMULA_INV "50.000001*X" /end COMPU_METHOD
/begin COMPU_METHOD LINEAR______0_000000__0H___65534 "" FORM "%5.0" "[meter]" FORMULA "1.0*X" FORMULA_INV "1.0*X" /end COMPU_METHOD
/begin COMPU_METHOD LINEAR______0_00000__0H___7_9687 "" FORM "%4.2" "[-]" FORMULA "0.03125*X" FORMULA_INV "32.0*X" /end COMPU_METHOD
/begin COMPU_METHOD LINEAR_______50_000000__0H___435 "" FORM "%6.2" "[%PWM]" FORMULA "0.39062745*X-50.0" FORMULA_INV "2.5599839*X+127.9992" /end COMPU_METHOD
/begin COMPU_METHOD LINEAR______0_000000__0H___11936 "" FORM "%5.1" "[°DK]" FORMULA "0.0018310552*X" FORMULA_INV "546.13319*X" /end COMPU_METHOD
/begin COMPU_METHOD LINEAR______0_000000__0H___26_00 "" FORM "%4.1" "[V]" FORMULA "0.10196078*X" FORMULA_INV "9.8076923*X" /end COMPU_METHOD
/begin COMPU_METHOD LINEAR______0_010000__1H___655_3 "" FORM "%6.2" "" FORMULA "0.0099999996*X+3.7247841e-010" FORMULA_INV "100.0*X-3.7247842e-008" /end COMPU_METHOD
/begin COMPU_METHOD LINEAR______1_000000__1H___255_0 "" FORM "%4.0" "[-]" FORMULA "1.0*X" FORMULA_INV "1.0*X" /end COMPU_METHOD
/begin COMPU_METHOD MAF_8_RES37 "" FORM "%4.0" "[mg/Hub]" FORMULA "5.4470588*X" FORMULA_INV "0.18358531*X" /end COMPU_METHOD
/begin COMPU_METHOD LINEAR______0_014648__1H___959_9 "" FORM "%7.3" "[-]" FORMULA "0.014646433*X+1.5668203e-006" FORMULA_INV "68.276009*X-0.00010697623" /end COMPU_METHOD
/begin COMPU_METHOD LINEAR_______256_000000__0H___25 "" FORM "%6.2" "[km/h]" FORMULA "0.0078124999*X-256.0" FORMULA_INV "128.0*X+32768.0" /end COMPU_METHOD
/begin COMPU_METHOD LINEAR______0_000000__0H___511_9 "" FORM "%6.2" "[km/h]" FORMULA "0.0078124999*X" FORMULA_INV "128.0*X" /end COMPU_METHOD
/begin COMPU_METHOD LINEAR______0_000000__0H___16_00 "" FORM "%7.5" "[-]" FORMULA "0.0038149738*X" FORMULA_INV "262.125*X" /end COMPU_METHOD
/begin COMPU_METHOD LINEAR______0_000000__0H___1_039 "" FORM "%5.1" "[-]" FORMULA "0.0039215686*X" FORMULA_INV "255.0*X" /end COMPU_METHOD
/begin COMPU_METHOD LINEAR______1_000000__28FH___31_ "" FORM "%4.1" "[%]" FORMULA "0.0015258512*X+0.00056746532" FORMULA_INV "655.3719*X-0.37190083" /end COMPU_METHOD
/begin COMPU_METHOD MAF_8_RES40 "" FORM "%5.0" "[mg/Hub]" FORMULA "5.4470588*X" FORMULA_INV "0.18358531*X" /end COMPU_METHOD
/begin COMPU_METHOD ES_8_RES41 "" FORM "%5.0" "[1/min]" FORMULA "32.0*X" FORMULA_INV "0.03125*X" /end COMPU_METHOD
/begin COMPU_METHOD LINEAR______0_000000__0H___0_496 "" FORM "%5.3" "" FORMULA "0.0039062204*X" FORMULA_INV "256.00194*X" /end COMPU_METHOD
/begin COMPU_METHOD LINEAR______0_000015__0H___0_250 "" FORM "%7.5" "" FORMULA "1.5258805e-005*X-2.5880486e-007" FORMULA_INV "65535.932*X+0.016961018" /end COMPU_METHOD
/begin COMPU_METHOD LINEAR______0_000015__1H___0_250 "" FORM "%8.5" "" FORMULA "1.5258787e-005*X+4.1213453e-008" FORMULA_INV "65536.011*X-0.0027009653" /end COMPU_METHOD
/begin COMPU_METHOD LINEAR______0_000000__0H___1_942 "" FORM "%5.3" "[]" FORMULA "0.0078125491*X" FORMULA_INV "127.9992*X" /end COMPU_METHOD
/begin COMPU_METHOD MAF_16_RES "" FORM "%6.2" "" FORMULA "0.021194781*X" FORMULA_INV "47.181425*X" /end COMPU_METHOD
/begin COMPU_METHOD MTC_NORM_16_RES44 "" FORM "%6.2" "" FORMULA "0.0018310547*X" FORMULA_INV "546.13333*X" /end COMPU_METHOD
/begin COMPU_METHOD MAF_16_RES45 "" FORM "%6.1" "" FORMULA "0.021194781*X" FORMULA_INV "47.181425*X" /end COMPU_METHOD
/begin COMPU_METHOD LM_INT_SA_RANGE "" FORM "%7.3" "[g]" FORMULA "0.027777829*X" FORMULA_INV "35.999934*X" /end COMPU_METHOD
/begin COMPU_METHOD LINEAR______0_000000__0H___16383 "" FORM "%8.2" "[kg/h]" FORMULA "0.24999237*X" FORMULA_INV "4.0001221*X" /end COMPU_METHOD
/begin COMPU_METHOD LINEAR______0_000000__0H___2_000 "" FORM "%5.3" "[-]" FORMULA "3.0518044e-005*X" FORMULA_INV "32767.5*X" /end COMPU_METHOD
/begin COMPU_METHOD MAF_16_RES46 "" FORM "%4.0" "[mg/Hub]" FORMULA "0.021194781*X" FORMULA_INV "47.181425*X" /end COMPU_METHOD
/begin COMPU_METHOD MAF_16_RES47 "" FORM "%6.1" "[mg/Hub]" FORMULA "0.021194781*X" FORMULA_INV "47.181425*X" /end COMPU_METHOD
/begin COMPU_METHOD LINEAR______0_000000__0H___95_62 "" FORM "%5.2" "[°KW]" FORMULA "0.375*X" FORMULA_INV "2.6666667*X" /end COMPU_METHOD
/begin COMPU_METHOD LINEAR______0_000000__0H___1389_ "" FORM "%4.0" "[mg/Hub]" FORMULA "5.4490196*X" FORMULA_INV "0.18351925*X" /end COMPU_METHOD
/begin COMPU_METHOD LINEAR______0_000000__0H___1_948 "" FORM "%5.3" "[-]" FORMULA "0.0078117646*X" FORMULA_INV "128.01205*X" /end COMPU_METHOD
/begin COMPU_METHOD MAF_16_RES49 "" FORM "%5.0" "[mg/Hub]" FORMULA "0.021194781*X" FORMULA_INV "47.181425*X" /end COMPU_METHOD
/begin COMPU_METHOD LINEAR______0_000000__0H___5434_ "" FORM "%5.0" "[hPa]" FORMULA "0.082921489*X" FORMULA_INV "12.0596*X" /end COMPU_METHOD
/begin COMPU_METHOD LINEAR_______32767_000000__1H___ "" FORM "%7.1" "[µs]" FORMULA "1.0*X-32768.0" FORMULA_INV "1.0*X+32768.0" /end COMPU_METHOD
/begin COMPU_METHOD LINEAR______0_000000__0H___1023_ "" FORM "%4.0" "[Nm]" FORMULA "1.0*X" FORMULA_INV "1.0*X" /end COMPU_METHOD
/begin COMPU_METHOD MAF_8_RES50 "" FORM "%5.2" "[mg/Hub]" FORMULA "5.4470588*X" FORMULA_INV "0.18358531*X" /end COMPU_METHOD
/begin COMPU_METHOD LINEAR_______1024_000000__0H___1 "" FORM "%5.0" "[Nm]" FORMULA "1.0*X-1024.0" FORMULA_INV "1.0*X+1024.0" /end COMPU_METHOD
/begin COMPU_METHOD LINEAR______0_000000__0H___7_000 "" FORM "%2.0" "[-]" FORMULA "1.0*X" FORMULA_INV "1.0*X" /end COMPU_METHOD
/begin COMPU_METHOD MTC_NORM_16_RES51 "" FORM "%7.3" "[°DK]" FORMULA "0.0018310547*X" FORMULA_INV "546.13333*X" /end COMPU_METHOD
/begin COMPU_METHOD LINEAR_______4_000000__0H___3_96 "" FORM "%4.2" "" FORMULA "0.03125*X-4.0" FORMULA_INV "32.0*X+128.0" /end COMPU_METHOD
/begin COMPU_METHOD LINEAR______0_005005__148H___0_9 "" FORM "%4.3" "[-]" FORMULA "1.5258791e-005*X+1.1647523e-007" FORMULA_INV "65535.991*X-0.0076333193" /end COMPU_METHOD
/begin COMPU_METHOD MTC_NORM_16_RES52 "" FORM "%5.1" "" FORMULA "0.0018310547*X" FORMULA_INV "546.13333*X" /end COMPU_METHOD
/begin COMPU_METHOD LINEAR______0_000000__0H___119_8 "" FORM "%5.1" "" FORMULA "0.0018310545*X" FORMULA_INV "546.13339*X" /end COMPU_METHOD
/begin COMPU_METHOD LINEAR______0_000000__0H___0_953 "" FORM "%5.3" "[°DK]" FORMULA "0.0039062745*X" FORMULA_INV "255.99839*X" /end COMPU_METHOD
/begin COMPU_METHOD LINEAR______0_000000__0H___11954 "" FORM "%7.3" "[°DK]" FORMULA "0.0018252077*X" FORMULA_INV "547.88285*X" /end COMPU_METHOD
/begin COMPU_METHOD LINEAR______0_000000__0H___0_955 "" FORM "%4.3" "[-]" FORMULA "1.5258789e-005*X" FORMULA_INV "65536.0*X" /end COMPU_METHOD
/begin COMPU_METHOD LINEAR______0_000000__0H___0_956 "" FORM "%7.5" "[-]" FORMULA "1.5258789e-005*X" FORMULA_INV "65536.0*X" /end COMPU_METHOD
/begin COMPU_METHOD LINEAR_______1024_000000__0H__57 "" FORM "%4.0" "[1/min]" FORMULA "1.0*X-1024.0" FORMULA_INV "1.0*X+1024.0" /end COMPU_METHOD
/begin COMPU_METHOD LINEAR_______33_000000__0H___990 "" FORM "%5.1" "[°C]" FORMULA "4.0117647*X-33.0" FORMULA_INV "0.24926686*X+8.2258065" /end COMPU_METHOD
/begin COMPU_METHOD LINEAR______0_000000__0H___25558 "" FORM "%3.0" "[km/h]" FORMULA "1.0*X" FORMULA_INV "1.0*X" /end COMPU_METHOD
/begin COMPU_METHOD LINEAR______0_000000__0H___11959 "" FORM "%5.1" "" FORMULA "0.46862745*X" FORMULA_INV "2.1338912*X" /end COMPU_METHOD
/begin COMPU_METHOD LINEAR______1_000000__100H___8_0 "" FORM "%3.1" "[-]" FORMULA "0.00390625*X" FORMULA_INV "256.0*X" /end COMPU_METHOD
/begin COMPU_METHOD LINEAR______0_000000__0H___120_0 "" FORM "%5.1" "" FORMULA "0.375*X" FORMULA_INV "2.6666667*X" /end COMPU_METHOD
/begin COMPU_METHOD LINEAR______1_000000__100H___5_0 "" FORM "%3.2" "[-]" FORMULA "0.00390625*X" FORMULA_INV "256.0*X" /end COMPU_METHOD
/begin COMPU_METHOD LINEAR______0_000000__0H___10060 "" FORM "%7.2" "[1/min]" FORMULA "0.03125*X" FORMULA_INV "32.0*X" /end COMPU_METHOD
/begin COMPU_METHOD LINEAR______0_031250__1H___7_968 "" FORM "%5.2" "[1/min/100ms]" FORMULA "0.03125*X" FORMULA_INV "32.0*X" /end COMPU_METHOD
/begin COMPU_METHOD LINEAR_______47_625000__1H___47_ "" FORM "%5.1" "[°KW]" FORMULA "0.375*X-48.0" FORMULA_INV "2.6666667*X+128.0" /end COMPU_METHOD
/begin COMPU_METHOD LINEAR_______48_000000__0H___47_ "" FORM "%5.1" "[°KW]" FORMULA "0.375*X-48.0" FORMULA_INV "2.6666667*X+128.0" /end COMPU_METHOD
/begin COMPU_METHOD LINEAR_______4_000000__0H___3_61 "" FORM "%5.2" "" FORMULA "0.031254902*X-4.0" FORMULA_INV "31.994981*X+127.97992" /end COMPU_METHOD
/begin COMPU_METHOD LINEAR_______155_625000__FFH____ "" FORM "%8.3" "" FORMULA "-0.375*X-60.0" FORMULA_INV "-2.6666667*X-160.0" /end COMPU_METHOD
/begin COMPU_METHOD IS_13_RES62 "" FORM "%5.0" "[1/min]" FORMULA "1.0*X" FORMULA_INV "1.0*X" /end COMPU_METHOD
/begin COMPU_METHOD LINEAR_______155_625000__FFH__63 "" FORM "%7.2" "[°KW]" FORMULA "-0.375*X-60.0" FORMULA_INV "-2.6666667*X-160.0" /end COMPU_METHOD
/begin COMPU_METHOD LINEAR______60_000000__0H___1564 "" FORM "%7.2" "[°KW]" FORMULA "0.375*X+60.0" FORMULA_INV "2.6666667*X-160.0" /end COMPU_METHOD
/begin COMPU_METHOD LINEAR______0_000000__0H___0_965 "" FORM "%5.3" "[-]" FORMULA "0.00390625*X" FORMULA_INV "256.0*X" /end COMPU_METHOD
/begin COMPU_METHOD LINEAR______0_000000__0H___1_275 "" FORM "%5.3" "[V]" FORMULA "0.005*X" FORMULA_INV "200.0*X" /end COMPU_METHOD
/begin COMPU_METHOD LINEAR______0_000000__0H___54366 "" FORM "%4.0" "[hPa]" FORMULA "0.082921489*X" FORMULA_INV "12.0596*X" /end COMPU_METHOD
/begin COMPU_METHOD LINEAR______0_000000__0H___0_967 "" FORM "%4.3" "[-]" FORMULA "0.00390625*X" FORMULA_INV "256.0*X" /end COMPU_METHOD
/begin COMPU_METHOD MTC_NORM_16_RES68 "" FORM "%6.3" "[°DK]" FORMULA "0.0018310547*X" FORMULA_INV "546.13333*X" /end COMPU_METHOD
/begin COMPU_METHOD LINEAR______0_000000__0H___81669 "" FORM "%4.0" "[min-1]" FORMULA "32.035294*X" FORMULA_INV "0.031215571*X" /end COMPU_METHOD
/begin COMPU_METHOD LINEAR______0_000000__0H___15_70 "" FORM "%4.2" "[°DK]" FORMULA "0.062509802*X" FORMULA_INV "15.997491*X" /end COMPU_METHOD
/begin COMPU_METHOD LINEAR______1_000000__80H___1_71 "" FORM "%4.3" "[-]" FORMULA "0.0078110235*X+0.00018899654" FORMULA_INV "128.0242*X-0.02419613" /end COMPU_METHOD
/begin COMPU_METHOD LINEAR______0_000000__0H___11972 "" FORM "%5.2" "[°DK]" FORMULA "0.46862745*X" FORMULA_INV "2.1338912*X" /end COMPU_METHOD
/begin COMPU_METHOD MTC_NORM_16_RES73 "" FORM "%5.2" "[°DK]" FORMULA "0.0018310547*X" FORMULA_INV "546.13333*X" /end COMPU_METHOD
/begin COMPU_METHOD LINEAR_______32768_000000__0H___ "" FORM "%6.0" "[1/min]" FORMULA "1.0*X-32768.0" FORMULA_INV "1.0*X+32768.0" /end COMPU_METHOD
/begin COMPU_METHOD LINEAR______0_000000__0H___51174 "" FORM "%5.1" "[km/h]" FORMULA "0.0078124999*X" FORMULA_INV "128.0*X" /end COMPU_METHOD
/begin COMPU_METHOD LINEAR______0_000000__0H___3_975 "" FORM "%4.2" "" FORMULA "0.015625*X" FORMULA_INV "64.0*X" /end COMPU_METHOD
/begin COMPU_METHOD LINEAR______0_000000__0H___11976 "" FORM "%5.1" "" FORMULA "0.0018252077*X" FORMULA_INV "547.88285*X" /end COMPU_METHOD
/begin COMPU_METHOD LINEAR______0_000000__0H___102_0 "" FORM "%4.1" "[-]" FORMULA "0.0018252094*X" FORMULA_INV "547.88235*X" /end COMPU_METHOD
/begin COMPU_METHOD TALLFS "" FORM "%7.3" "[%]" FORMULA "0.0061035142*X" FORMULA_INV "163.84004*X" /end COMPU_METHOD
/begin COMPU_METHOD LINEAR______0_000000__0H___11977 "" FORM "%6.3" "[°DK]" FORMULA "0.0018310545*X" FORMULA_INV "546.13339*X" /end COMPU_METHOD
/begin COMPU_METHOD INVERS_MIS_16_RES "" FORM "%8.1" "[µs]" FORMULA "-1.0*X" FORMULA_INV "-1.0*X" /end COMPU_METHOD
/begin COMPU_METHOD IS_13_RES78 "" FORM "%4.0" "[1/min]" FORMULA "1.0*X" FORMULA_INV "1.0*X" /end COMPU_METHOD
/begin COMPU_METHOD MAF_16_RES79 "" FORM "%5.0" "" FORMULA "0.021194781*X" FORMULA_INV "47.181425*X" /end COMPU_METHOD
/begin COMPU_METHOD LINEAR______0_000000__0H___25580 "" FORM "%3.0" "[%]" FORMULA "0.015203911*X" FORMULA_INV "65.772549*X" /end COMPU_METHOD
/begin COMPU_METHOD LINEAR______0_000000__0H___50_00 "" FORM "%7.3" "[ms]" FORMULA "0.004*X" FORMULA_INV "250.0*X" /end COMPU_METHOD
/begin COMPU_METHOD LINEAR______0_000000__0H___26_81 "" FORM "%4.1" "" FORMULA "0.10196078*X" FORMULA_INV "9.8076923*X" /end COMPU_METHOD
/begin COMPU_METHOD LINEAR______0_000000__0H___30_00 "" FORM "%7.3" "" FORMULA "0.004*X" FORMULA_INV "250.0*X" /end COMPU_METHOD
/begin COMPU_METHOD LINEAR______0_000000__0H___639_9 "" FORM "%6.2" "[ms/0.375°KW]" FORMULA "0.0097656214*X" FORMULA_INV "102.40004*X" /end COMPU_METHOD
/begin COMPU_METHOD LINEAR______0_000000__0H___1275_ "" FORM "%4.0" "[ms]" FORMULA "5.0*X" FORMULA_INV "0.2*X" /end COMPU_METHOD
/begin COMPU_METHOD LINEAR______0_000000__0H___26_82 "" FORM "%3.1" "[V]" FORMULA "0.10196078*X" FORMULA_INV "9.8076923*X" /end COMPU_METHOD
/begin COMPU_METHOD LINEAR______0_625000__1H___159_3 "" FORM "%5.1" "[ms]" FORMULA "0.625*X" FORMULA_INV "1.6*X" /end COMPU_METHOD
/begin COMPU_METHOD LINEAR______0_000000__0H___8_388 "" FORM "%5.3" "[s]" FORMULA "0.000128*X" FORMULA_INV "7812.5*X" /end COMPU_METHOD
/begin COMPU_METHOD MAF_16_RES83 "" FORM "%5.3" "[mg/Hub]" FORMULA "0.021194781*X" FORMULA_INV "47.181425*X" /end COMPU_METHOD
/begin COMPU_METHOD IS_13_RES84 "" FORM "%5.0" "[U/min]" FORMULA "1.0*X" FORMULA_INV "1.0*X" /end COMPU_METHOD
/begin COMPU_METHOD LINEAR______0_000000__0H___159_3 "" FORM "%6.2" "[ms]" FORMULA "0.625*X" FORMULA_INV "1.6*X" /end COMPU_METHOD
/begin COMPU_METHOD LINEAR______0_000000__0H___1_279 "" FORM "%6.4" "[s]" FORMULA "7.8123665e-005*X" FORMULA_INV "12800.219*X" /end COMPU_METHOD
/begin COMPU_METHOD LINEAR_______640_020000__0H___63 "" FORM "%7.2" "[ms]" FORMULA "0.019531548*X-640.02" FORMULA_INV "51.199219*X+32768.524" /end COMPU_METHOD
/begin COMPU_METHOD LINEAR_______0_637500__0H___0_63 "" FORM "%6.4" "[ms]" FORMULA "0.005*X-0.6375" FORMULA_INV "200.0*X+127.5" /end COMPU_METHOD
/begin COMPU_METHOD LINEAR______0_000000__0H___1_996 "" FORM "%4.2" "" FORMULA "0.0078278431*X" FORMULA_INV "127.74911*X" /end COMPU_METHOD
/begin COMPU_METHOD LINEAR______0_000000__0H___99_59 "" FORM "%4.1" "[%]" FORMULA "0.39058823*X" FORMULA_INV "2.560241*X" /end COMPU_METHOD
/begin COMPU_METHOD LINEAR_______6_250000__0H___6_20 "" FORM "%5.1" "" FORMULA "0.048823529*X-6.25" FORMULA_INV "20.481928*X+128.01205" /end COMPU_METHOD
/begin COMPU_METHOD LINEAR_______96_000000__0H___95_ "" FORM "%5.2" "" FORMULA "0.75*X-96.0" FORMULA_INV "1.3333333*X+128.0" /end COMPU_METHOD
/begin COMPU_METHOD LINEAR_______50_000000__0H___485 "" FORM "%5.1" "" FORMULA "0.39058823*X-50.0" FORMULA_INV "2.560241*X+128.01205" /end COMPU_METHOD
/begin COMPU_METHOD LINEAR______0_039000__2H___4_986 "" TAB_INTP "%5.3" "" COMPU_TAB_REF LINEAR______0_039000__2H___4_986 /end COMPU_METHOD
/begin COMPU_METHOD LINEAR______0_000000__0H____200_ "" FORM "%6.2" "[%]" FORMULA "-0.0061035156*X" FORMULA_INV "-163.84*X" /end COMPU_METHOD
/begin COMPU_METHOD LINEAR_______32768_000000__0H_86 "" FORM "%5.0" "[1/min]" FORMULA "1.0*X-32768.0" FORMULA_INV "1.0*X+32768.0" /end COMPU_METHOD
/begin COMPU_METHOD LINEAR_______50_000000__0H___487 "" FORM "%5.1" "" FORMULA "0.39062745*X-50.0" FORMULA_INV "2.5599839*X+127.9992" /end COMPU_METHOD
/begin COMPU_METHOD LINEAR_______4096_000000__0H___4 "" FORM "%7.0" "" FORMULA "32.0*X-4096.0" FORMULA_INV "0.03125*X+128.0" /end COMPU_METHOD
/begin COMPU_METHOD LINEAR______0_000000__0H___10088 "" FORM "%5.1" "[%]" FORMULA "0.39215686*X" FORMULA_INV "2.55*X" /end COMPU_METHOD
/begin COMPU_METHOD LINEAR_______48_000000__0H___189 "" FORM "%3.0" "[°C]" FORMULA "0.75*X-48.0" FORMULA_INV "1.3333333*X+64.0" /end COMPU_METHOD
/begin COMPU_METHOD TALLFS_IN_10MS "" FORM "%7.3" "[%]" FORMULA "0.0061034929*X-3.4929165e-006" FORMULA_INV "163.84061*X+0.00057228156" /end COMPU_METHOD
/begin COMPU_METHOD TALLFS_IN_10MS90 "" FORM "%7.3" "[%/10ms]" FORMULA "0.0061034929*X-3.4929165e-006" FORMULA_INV "163.84061*X+0.00057228156" /end COMPU_METHOD
/begin COMPU_METHOD LINEAR_______50_000000__0H___491 "" FORM "%7.3" "" FORMULA "0.0015258793*X-50.0" FORMULA_INV "655.35983*X+32767.991" /end COMPU_METHOD
/begin COMPU_METHOD LINEAR______0_000000__0H___81692 "" FORM "%4.0" "[1/min]" FORMULA "0.25*X" FORMULA_INV "4.0*X" /end COMPU_METHOD
/begin COMPU_METHOD TALLFS_NEG_POS_UI "" FORM "%7.3" "[%]" FORMULA "0.0061035142*X-200.0" FORMULA_INV "163.84004*X+32768.008" /end COMPU_METHOD
/begin COMPU_METHOD LINEAR______0_000000__0H___15_99 "" FORM "%7.4" "[-]" FORMULA "0.00024414054*X" FORMULA_INV "4096.0015*X" /end COMPU_METHOD
/begin COMPU_METHOD LINEAR______0_000000__0H___0_993 "" FORM "%7.5" "[-]" FORMULA "1.5258716e-005*X" FORMULA_INV "65536.313*X" /end COMPU_METHOD
/begin COMPU_METHOD LINEAR______0_000000__0H___99_94 "" FORM "%6.3" "" FORMULA "0.0015258793*X" FORMULA_INV "655.35985*X" /end COMPU_METHOD
/begin COMPU_METHOD LINEAR______0_000000__0H___29895 "" FORM "%4.0" "[°DK/s]" FORMULA "11.717647*X" FORMULA_INV "0.085341365*X" /end COMPU_METHOD
/begin COMPU_METHOD LINEAR_______1024_000000__7C00H_ "" FORM "%6.0" "" FORMULA "1.0*X-32768.0" FORMULA_INV "1.0*X+32768.0" /end COMPU_METHOD
/begin COMPU_METHOD LINEAR_______25_000000__0H___24_ "" FORM "%4.1" "[%]" FORMULA "0.1953125*X-25.0" FORMULA_INV "5.1199999*X+128.0" /end COMPU_METHOD
/begin COMPU_METHOD LINEAR_______256_000000__0___254 "" FORM "%3.0" "[1/min]" FORMULA "2.0*X-256.0" FORMULA_INV "0.5*X+128.0" /end COMPU_METHOD
/begin COMPU_METHOD LINEAR______0_000000__0H___99_96 "" FORM "%5.2" "" FORMULA "0.0015258789*X" FORMULA_INV "655.36*X" /end COMPU_METHOD
/begin COMPU_METHOD TALLFS_NEG_0_UI "" FORM "%7.2" "[%]" FORMULA "0.0061035156*X-200.0" FORMULA_INV "163.84*X+32768.0" /end COMPU_METHOD
/begin COMPU_METHOD LINEAR_______48_000000__0H___197 "" FORM "%4.1" "[°C]" FORMULA "0.75*X-48.0" FORMULA_INV "1.3333333*X+64.0" /end COMPU_METHOD
/begin COMPU_METHOD LINEAR______0_000000__0H___1_998 "" FORM "%5.3" "" FORMULA "0.0078125491*X" FORMULA_INV "127.9992*X" /end COMPU_METHOD
/begin COMPU_METHOD LINEAR______0_000000__0H___12099 "" FORM "%5.1" "[°KW]" FORMULA "0.375*X" FORMULA_INV "2.6666667*X" /end COMPU_METHOD
/begin COMPU_METHOD LINEAR_______48_000000__0H___100 "" FORM "%5.2" "[°C]" FORMULA "0.75*X-48.0" FORMULA_INV "1.3333333*X+64.0" /end COMPU_METHOD
/begin COMPU_METHOD LINEAR______0_390627__1H___99_61 "" FORM "%4.1" "[%]" FORMULA "0.39062746*X-4.5669291e-007" FORMULA_INV "2.5599839*X+1.1691265e-006" /end COMPU_METHOD
/begin COMPU_METHOD LINEAR______0_250000__1H___16383 "" FORM "%5.1" "" FORMULA "0.25*X" FORMULA_INV "4.0*X" /end COMPU_METHOD
/begin COMPU_METHOD LINEAR______0_000000__0H___399_9 "" FORM "%6.2" "[%PWM]" FORMULA "0.012207031*X" FORMULA_INV "81.92*X" /end COMPU_METHOD
/begin COMPU_METHOD LINEAR______0_000000__0H___1_101 "" FORM "%5.3" "[V]" FORMULA "0.0078125491*X" FORMULA_INV "127.9992*X" /end COMPU_METHOD
/begin COMPU_METHOD LINEAR______0_000000__0H___800_0 "" FORM "%6.2" "[%]" FORMULA "0.024414063*X" FORMULA_INV "40.96*X" /end COMPU_METHOD
/begin COMPU_METHOD LINEAR______0_000000__0H___99_97 "" FORM "%5.2" "" FORMULA "0.024414063*X" FORMULA_INV "40.959998*X" /end COMPU_METHOD
/begin COMPU_METHOD LINEAR_______33_000000__0H___102 "" FORM "%5.0" "" FORMULA "4.0*X-33.0" FORMULA_INV "0.25*X+8.25" /end COMPU_METHOD
/begin COMPU_METHOD LINEAR_______50_000000__0H___103 "" FORM "%5.2" "[%]" FORMULA "0.024414063*X-50.0" FORMULA_INV "40.959998*X+2047.9999" /end COMPU_METHOD
/begin COMPU_METHOD LINEAR______0_000000__0H___0_104 "" FORM "%5.3" "" FORMULA "0.0039062745*X" FORMULA_INV "255.99839*X" /end COMPU_METHOD
/begin COMPU_METHOD LINEAR______0_000000__0H___0_105 "" FORM "%5.3" "" FORMULA "0.0019531373*X" FORMULA_INV "511.99679*X" /end COMPU_METHOD
/begin COMPU_METHOD LINEAR_______4_995000__7C57H___5 "" FORM "%5.2" "" FORMULA "0.0053335111*X-174.76599" FORMULA_INV "187.49375*X+32767.531" /end COMPU_METHOD
/begin COMPU_METHOD LINEAR_______31_250000__3000H___ "" FORM "%6.2" "" FORMULA "0.0015258789*X-50.0" FORMULA_INV "655.36*X+32768.0" /end COMPU_METHOD
/begin COMPU_METHOD LINEAR______0_000000__0H___8_160 "" FORM "%5.2" "[ms]" FORMULA "0.032*X" FORMULA_INV "31.25*X" /end COMPU_METHOD
/begin COMPU_TAB LINEAR______0_039000__2H___4_986 "" TAB_INTP 3 0x2 0.039 0xff 4.986 0xff 4.9860001 /end COMPU_TAB
/begin FUNCTION hella "" /end FUNCTION
/begin RECORD_LAYOUT a_1 FNC_VALUES 1 UWORD COLUMN_DIR DIRECT /end RECORD_LAYOUT
/begin RECORD_LAYOUT a_2 FNC_VALUES 1 UBYTE COLUMN_DIR DIRECT /end RECORD_LAYOUT
/begin RECORD_LAYOUT a_3 FNC_VALUES 1 UBYTE COLUMN_DIR DIRECT /end RECORD_LAYOUT
/begin RECORD_LAYOUT a_4 FNC_VALUES 1 UBYTE COLUMN_DIR DIRECT /end RECORD_LAYOUT
/begin RECORD_LAYOUT a_7 FNC_VALUES 1 UWORD COLUMN_DIR DIRECT /end RECORD_LAYOUT
/begin RECORD_LAYOUT a_9 FNC_VALUES 1 UWORD COLUMN_DIR DIRECT /end RECORD_LAYOUT
/begin RECORD_LAYOUT a_11 FNC_VALUES 1 UBYTE COLUMN_DIR DIRECT /end RECORD_LAYOUT
/begin RECORD_LAYOUT a_13 FNC_VALUES 1 UBYTE COLUMN_DIR DIRECT /end RECORD_LAYOUT
/begin RECORD_LAYOUT a_19 FNC_VALUES 1 UBYTE COLUMN_DIR DIRECT /end RECORD_LAYOUT
/begin RECORD_LAYOUT a_29 FNC_VALUES 1 UWORD COLUMN_DIR DIRECT /end RECORD_LAYOUT
/begin RECORD_LAYOUT a_38 FNC_VALUES 1 UWORD COLUMN_DIR DIRECT /end RECORD_LAYOUT
/begin RECORD_LAYOUT a_43 FNC_VALUES 1 UWORD COLUMN_DIR DIRECT /end RECORD_LAYOUT
/begin RECORD_LAYOUT a_892 AXIS_PTS_X 1 UBYTE INDEX_INCR DIRECT /end RECORD_LAYOUT
/begin RECORD_LAYOUT a_893 AXIS_PTS_X 1 UWORD INDEX_INCR DIRECT /end RECORD_LAYOUT
/end MODULE
/end PROJECT
