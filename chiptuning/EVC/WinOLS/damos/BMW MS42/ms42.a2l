ASAP2_VERSION 1 2
/begin PROJECT Z42D "011"
/begin HEADER "" VERSION "0AD.03" PROJECT_NO Z011 /end HEADER
/begin MODULE BMW-EASY ""
/begin MOD_COMMON "common attributes" DEPOSIT ABSOLUT BYTE_ORDER BIG_ENDIAN /end MOD_COMMON
/begin CHARACTERISTIC DES_VERSIONC2D "" VALUE 0x2 a_173 100 defaultConversion192 0 255 BIT_MASK 0xffffffff /end CHARACTERISTIC
/begin CHARACTERISTIC DES_VERSIONC3D "" VALUE 0x3 a_173 100 defaultConversion193 0 255 BIT_MASK 0xffffffff /end CHARACTERISTIC
/begin CHARACTERISTIC DES_VERSIONC4D "" VALUE 0x4 a_173 100 defaultConversion194 0 255 BIT_MASK 0xffffffff /end CHARACTERISTIC
/begin CHARACTERISTIC DES_VERSIONC5D "" VALUE 0x5 a_173 100 defaultConversion195 0 255 BIT_MASK 0xffffffff /end CHARACTERISTIC
/begin CHARACTERISTIC DETECTION_LIMIT_FOR_PERIODIC "DETECTION_LIMIT_FOR_PERIODIC" VALUE 0x480c4 a_172 100 LINEAR_______32768_000000__FFFF8 -32768.0 32767.0 BIT_MASK 0xffffffff /end CHARACTERISTIC
/begin CHARACTERISTIC DETECTION_LIMIT_FOR_PERIODIC_2 "DETECTION_LIMIT_FOR_PERIODIC_2" VALUE 0x480c6 a_172 100 LINEAR_______32768_000000__FFFF8 -32768.0 32767.0 BIT_MASK 0xffffffff /end CHARACTERISTIC
/begin CHARACTERISTIC DI "DI" VALUE 0x48808 a_189 100 LINEAR_______2147483647_000000__ -2.1474836e+009 2.1474836e+009 BIT_MASK 0xffffffff FUNCTION_LIST hella /end CHARACTERISTIC
/begin CHARACTERISTIC dif_pwg_kor_fak_diag "DIF_PWG_KOR_FAK_DIAG" VALUE 0x48446 a_174 100 LINEAR______0_000000__0H___1_196 0.0 1.99997 BIT_MASK 0xffffffff /end CHARACTERISTIC
/begin CHARACTERISTIC dk_abst_min "DK_ABST_MIN" VALUE 0x48448 a_174 100 MTC_NORM_16_RES10 0.0 119.99817 BIT_MASK 0xffffffff /end CHARACTERISTIC
/begin CHARACTERISTIC dk_ad_mitko "DK_AD_MITKO" VALUE 0x4818c a_173 10 LINEAR______0_000000__0H___0_996 0.0 0.99610001 BIT_MASK 0xffffffff /end CHARACTERISTIC
/begin CHARACTERISTIC dk_add "DK_ADD" VALUE 0x4844a a_174 2 MTC_IN_DK_16_RES 0.0 239.99634 BIT_MASK 0xffffffff /end CHARACTERISTIC
/begin CHARACTERISTIC dk_dif_diag "DK_DIF_DIAG" VALUE 0x4844c a_174 10 MTC_IN_DK_16_RES 0.0 239.99634 BIT_MASK 0xffffffff /end CHARACTERISTIC
/begin CHARACTERISTIC dk_ers_diag "DK_ERS_DIAG" VALUE 0x4818d a_173 10 PVS_NORM_8_RES197 0.0 119.5 BIT_MASK 0xffffffff /end CHARACTERISTIC
/begin CHARACTERISTIC dk_grd_lam_s "DK_GRD_LAM_S" VALUE 0x4818e a_173 100 LINEAR______0_000000__0H___29198 0.0 2988.0 BIT_MASK 0xffffffff /end CHARACTERISTIC
/begin CHARACTERISTIC dk_grd_max "DK_GRD_MAX" VALUE 0x4844e a_174 4 MTC_IN_DK_16_RES199 0.0 239.99634 BIT_MASK 0xffffffff /end CHARACTERISTIC
/begin CHARACTERISTIC dk_grd_min_ar "DK_GRD_MIN_AR" VALUE 0x4818f a_173 100 LINEAR______0_000000__0H___29200 0.0 2988.0 BIT_MASK 0xffffffff /end CHARACTERISTIC
/begin CHARACTERISTIC dk_grd_min_fs_ar "DK_GRD_MIN_FS_AR" VALUE 0x48190 a_173 100 LINEAR______0_000000__0H___29200 0.0 2988.0 BIT_MASK 0xffffffff /end CHARACTERISTIC
/begin CHARACTERISTIC dk_grd_s "DK_GRD_S" VALUE 0x48191 a_173 4 LINEAR______0_000000__0H___29201 0.0 2988.0 BIT_MASK 0xffffffff /end CHARACTERISTIC
/begin CHARACTERISTIC dk_grd_totz_lu "DK_GRD_TOTZ_LU" VALUE 0x48450 a_174 5 LINEAR______0_010000__0H___655_3 0.01 655.34998 BIT_MASK 0xffffffff /end CHARACTERISTIC
/begin CHARACTERISTIC dk_grd_unt_wetl "DK_GRD_UNT_WETL" VALUE 0x48192 a_173 10 LINEAR______0_000000__0H___29200 0.0 2988.0 BIT_MASK 0xffffffff /end CHARACTERISTIC
/begin CHARACTERISTIC dk_hys "DK_HYS" VALUE 0x48452 a_174 10 MTC_IN_DK_16_RES 0.0 239.99634 BIT_MASK 0xffffffff /end CHARACTERISTIC
/begin CHARACTERISTIC dk_hys_wf "DK_HYS_WF" VALUE 0x48454 a_174 10 LINEAR______0_000000__0H___119_9 0.0 119.9982 BIT_MASK 0xffffffff /end CHARACTERISTIC
/begin CHARACTERISTIC dk_ll "DK_LL" VALUE 0x48193 a_173 5 PVS_NORM_8_RES197 0.0 119.5 BIT_MASK 0xffffffff /end CHARACTERISTIC
/begin CHARACTERISTIC dk_min_diag_lm "DK_MIN_DIAG_LM" VALUE 0x48194 a_173 30 LINEAR______0_000000__0H___11125 0.0 119.5 BIT_MASK 0xffffffff /end CHARACTERISTIC
/begin CHARACTERISTIC dk1_max_diag "DK1_MAX_DIAG" VALUE 0x48456 a_174 100 MTC_IN_DK_16_RES202 0.0 239.99634 BIT_MASK 0xffffffff /end CHARACTERISTIC
/begin CHARACTERISTIC dk1_min_diag "DK1_MIN_DIAG" VALUE 0x48458 a_174 100 MTC_IN_DK_16_RES202 0.0 239.99634 BIT_MASK 0xffffffff /end CHARACTERISTIC
/begin CHARACTERISTIC dk2_max_diag "DK2_MAX_DIAG" VALUE 0x4845a a_174 100 MTC_IN_DK_16_RES202 0.0 239.99634 BIT_MASK 0xffffffff /end CHARACTERISTIC
/begin CHARACTERISTIC dk2_min_diag "DK2_MIN_DIAG" VALUE 0x4845c a_174 100 MTC_IN_DK_16_RES202 0.0 239.99634 BIT_MASK 0xffffffff /end CHARACTERISTIC
/begin CHARACTERISTIC dmdk_ad_mitko "DMDK_AD_MITKO" VALUE 0x4845e a_174 100 LINEAR______0_000000__0H___0_924 0.0 0.99997997 BIT_MASK 0xffffffff /end CHARACTERISTIC
/begin CHARACTERISTIC dmdk_inc "DMDK_INC" VALUE 0x48460 a_174 100 MTC_NORM_16_RES10 0.0 119.99817 BIT_MASK 0xffffffff /end CHARACTERISTIC
/begin CHARACTERISTIC dmdk_max_ini "DMDK_MAX_INI" VALUE 0x48462 a_174 100 MTC_NORM_16_RES10 0.0 119.99817 BIT_MASK 0xffffffff /end CHARACTERISTIC
/begin CHARACTERISTIC dmdk_soll "DMDK_SOLL" VALUE 0x48464 a_174 100 MTC_NORM_16_RES10 0.0 119.99817 BIT_MASK 0xffffffff /end CHARACTERISTIC
/begin CHARACTERISTIC dmdk_soll_diag "DMDK_SOLL_DIAG" VALUE 0x48466 a_174 100 MTC_NORM_16_RES 0.0 119.99817 BIT_MASK 0xffffffff /end CHARACTERISTIC
/begin CHARACTERISTIC DNORMD "DNORMD" VALUE 0x48468 a_174 100 LINEAR______0_000000__0H___65190 0.0 65535.0 BIT_MASK 0xffffffff /end CHARACTERISTIC
/begin CHARACTERISTIC DNORMI "DNORMI" VALUE 0x4846a a_174 100 LINEAR______0_000000__0H___65190 0.0 65535.0 BIT_MASK 0xffffffff /end CHARACTERISTIC
/begin CHARACTERISTIC dyn_max_tn_ad_lu "DYN_MAX_TN_AD_LU" VALUE 0x4846c a_174 5 LINEAR______0_000000__0H___21845 0.0 21845.0 BIT_MASK 0xffffffff /end CHARACTERISTIC
/begin CHARACTERISTIC ebw_as "EBW_AS" VALUE 0xe59b a_175 100 LINEAR_______768_000000__FFFFFF8 -768.0 762.0 BIT_MASK 0xffffffff /end CHARACTERISTIC
/begin CHARACTERISTIC ebw_nw_diag "EBW_NW_DIAG" VALUE 0x48195 a_173 15 LINEAR_______180_000000__0H___50 -180.0 504.0 BIT_MASK 0xffffffff /end CHARACTERISTIC
/begin CHARACTERISTIC egs1_zyka_max "EGS1_ZYKA_MAX" VALUE 0x48196 a_173 19 LINEAR______1_000000__1H___255_0 1.0 255.0 BIT_MASK 0xffffffff /end CHARACTERISTIC
/begin CHARACTERISTIC EK_CALM_LIMIT "EK_CALM_LIMIT" VALUE 0x487e6 a_175 100 SIGNEDCHAR -128.0 127.0 BIT_MASK 0xffffffff /end CHARACTERISTIC
/begin CHARACTERISTIC EK_MAX_LIMIT "EK_MAX_LIMIT" VALUE 0x480c8 a_172 100 LINEAR_______32768_000000__FF180 -32768.0 32767.0 BIT_MASK 0xffffffff /end CHARACTERISTIC
/begin CHARACTERISTIC epz_inc_ak "EPZ_INC_AK" VALUE 0x48197 a_173 10 LINEAR______0_000000__0H___25182 0.0 255.0 BIT_MASK 0xffffffff /end CHARACTERISTIC
/begin CHARACTERISTIC epz_inc_bls "EPZ_INC_BLS" VALUE 0x48198 a_173 4 LINEAR______0_000000__0H___25182 0.0 255.0 BIT_MASK 0xffffffff /end CHARACTERISTIC
/begin CHARACTERISTIC epz_inc_bls_pwg "EPZ_INC_BLS_PWG" VALUE 0x48199 a_173 4 LINEAR______0_000000__0H___25182 0.0 255.0 BIT_MASK 0xffffffff /end CHARACTERISTIC
/begin CHARACTERISTIC epz_inc_can_b_o "EPZ_INC_CAN_B_O" VALUE 0x4819a a_173 4 LINEAR______0_000000__0H___25182 0.0 255.0 BIT_MASK 0xffffffff /end CHARACTERISTIC
/begin CHARACTERISTIC epz_inc_dif_poti_1 "EPZ_INC_DIF_POTI_1" VALUE 0x4819b a_173 10 LINEAR______0_000000__0H___25182 0.0 255.0 BIT_MASK 0xffffffff /end CHARACTERISTIC
/begin CHARACTERISTIC epz_inc_dif_poti_2 "EPZ_INC_DIF_POTI_2" VALUE 0x4819c a_173 10 LINEAR______0_000000__0H___25182 0.0 255.0 BIT_MASK 0xffffffff /end CHARACTERISTIC
/begin CHARACTERISTIC epz_inc_disa "EPZ_INC_DISA" VALUE 0x4819d a_173 4 LINEAR______0_000000__0H___25182 0.0 255.0 BIT_MASK 0xffffffff /end CHARACTERISTIC
/begin CHARACTERISTIC epz_inc_elm "EPZ_INC_ELM" VALUE 0x4819e a_173 4 LINEAR______0_000000__0H___25182 0.0 255.0 BIT_MASK 0xffffffff /end CHARACTERISTIC
/begin CHARACTERISTIC epz_inc_ev "EPZ_INC_EV" VALUE 0x4819f a_173 4 LINEAR______0_000000__0H___25182 0.0 255.0 BIT_MASK 0xffffffff /end CHARACTERISTIC
/begin CHARACTERISTIC epz_inc_ews "EPZ_INC_EWS" VALUE 0x481a0 a_173 4 LINEAR______1_000000__1H___255_0 1.0 255.0 BIT_MASK 0xffffffff /end CHARACTERISTIC
/begin CHARACTERISTIC epz_inc_ews_n "EPZ_INC_EWS_N" VALUE 0x481a1 a_173 4 LINEAR______1_000000__1H___255_0 1.0 255.0 BIT_MASK 0xffffffff /end CHARACTERISTIC
/begin CHARACTERISTIC epz_inc_ews_pe "EPZ_INC_EWS_PE" VALUE 0x481a2 a_173 4 LINEAR______0_000000__0H___25182 0.0 255.0 BIT_MASK 0xffffffff /end CHARACTERISTIC
/begin CHARACTERISTIC epz_inc_gw_kr "EPZ_INC_GW_KR" VALUE 0x481a3 a_173 100 LINEAR______0_000000__0H___25182 0.0 255.0 BIT_MASK 0xffffffff /end CHARACTERISTIC
/begin CHARACTERISTIC epz_inc_kfk "EPZ_INC_KFK" VALUE 0x481a4 a_173 4 LINEAR______0_000000__0H___25182 0.0 255.0 BIT_MASK 0xffffffff /end CHARACTERISTIC
/begin CHARACTERISTIC epz_inc_kw "EPZ_INC_KW" VALUE 0x481a5 a_173 4 LINEAR______0_000000__0H___25182 0.0 255.0 BIT_MASK 0xffffffff /end CHARACTERISTIC
/begin CHARACTERISTIC epz_inc_ldp "EPZ_INC_LDP" VALUE 0x481a6 a_173 4 LINEAR______0_000000__0H___25182 0.0 255.0 BIT_MASK 0xffffffff /end CHARACTERISTIC
/begin CHARACTERISTIC epz_inc_llfs_1 "EPZ_INC_LLFS_1" VALUE 0x481a7 a_173 4 LINEAR______0_000000__0H___25182 0.0 255.0 BIT_MASK 0xffffffff /end CHARACTERISTIC
/begin CHARACTERISTIC epz_inc_llfs_2 "EPZ_INC_LLFS_2" VALUE 0x481a8 a_173 4 LINEAR______0_000000__0H___25182 0.0 255.0 BIT_MASK 0xffffffff /end CHARACTERISTIC
/begin CHARACTERISTIC epz_inc_lm "EPZ_INC_LM" VALUE 0x481a9 a_173 4 LINEAR______0_000000__0H___25182 0.0 255.0 BIT_MASK 0xffffffff /end CHARACTERISTIC
/begin CHARACTERISTIC epz_inc_lsh "EPZ_INC_LSH" VALUE 0x481aa a_173 4 LINEAR______0_000000__0H___25182 0.0 255.0 BIT_MASK 0xffffffff /end CHARACTERISTIC
/begin CHARACTERISTIC epz_inc_lsh_kat "EPZ_INC_LSH_KAT" VALUE 0x481ab a_173 4 LINEAR______0_000000__0H___25182 0.0 255.0 BIT_MASK 0xffffffff /end CHARACTERISTIC
/begin CHARACTERISTIC epz_inc_mdk_2 "EPZ_INC_MDK_2" VALUE 0x481ac a_173 10 LINEAR______0_000000__0H___25182 0.0 255.0 BIT_MASK 0xffffffff /end CHARACTERISTIC
/begin CHARACTERISTIC epz_inc_mdk_ad "EPZ_INC_MDK_AD" VALUE 0x481ad a_173 4 LINEAR______0_000000__0H___127_0 0.0 127.0 BIT_MASK 0xffffffff /end CHARACTERISTIC
/begin CHARACTERISTIC epz_inc_mdk_dif "EPZ_INC_MDK_DIF" VALUE 0x481ae a_173 10 LINEAR______0_000000__0H___25182 0.0 255.0 BIT_MASK 0xffffffff /end CHARACTERISTIC
/begin CHARACTERISTIC epz_inc_mdk_fgr "EPZ_INC_MDK_FGR" VALUE 0x481af a_173 100 LINEAR______0_000000__0H___25182 0.0 255.0 BIT_MASK 0xffffffff /end CHARACTERISTIC
/begin CHARACTERISTIC epz_inc_mdk_mech_notl "EPZ_INC_MDK_MECH_NOTL" VALUE 0x481b0 a_173 10 LINEAR______0_000000__0H___25182 0.0 255.0 BIT_MASK 0xffffffff /end CHARACTERISTIC
/begin CHARACTERISTIC epz_inc_mdk1 "EPZ_INC_MDK1" VALUE 0x481b1 a_173 4 LINEAR______0_000000__0H___25182 0.0 255.0 BIT_MASK 0xffffffff /end CHARACTERISTIC
/begin CHARACTERISTIC epz_inc_mdk2 "EPZ_INC_MDK2" VALUE 0x481b2 a_173 4 LINEAR______0_000000__0H___25182 0.0 255.0 BIT_MASK 0xffffffff /end CHARACTERISTIC
/begin CHARACTERISTIC epz_inc_mfl_2 "EPZ_INC_MFL_2" VALUE 0x481b3 a_173 10 LINEAR______0_000000__0H___25182 0.0 255.0 BIT_MASK 0xffffffff /end CHARACTERISTIC
/begin CHARACTERISTIC epz_inc_mfl_3 "EPZ_INC_MFL_3" VALUE 0x481b4 a_173 10 LINEAR______0_000000__0H___25182 0.0 255.0 BIT_MASK 0xffffffff /end CHARACTERISTIC
/begin CHARACTERISTIC epz_inc_mfl_tb "EPZ_INC_MFL_TB" VALUE 0x481b5 a_173 4 LINEAR______0_000000__0H___25142 0.0 255.0 BIT_MASK 0xffffffff /end CHARACTERISTIC
/begin CHARACTERISTIC epz_inc_nw "EPZ_INC_NW" VALUE 0x481b6 a_173 4 LINEAR______0_000000__0H___25182 0.0 255.0 BIT_MASK 0xffffffff /end CHARACTERISTIC
/begin CHARACTERISTIC epz_inc_nwa "EPZ_INC_NWA" VALUE 0x481b7 a_173 4 LINEAR______0_000000__0H___25182 0.0 255.0 BIT_MASK 0xffffffff /end CHARACTERISTIC
/begin CHARACTERISTIC epz_inc_pwg_ad "EPZ_INC_PWG_AD" VALUE 0x481b8 a_173 4 LINEAR______0_000000__0H___127_0 0.0 127.0 BIT_MASK 0xffffffff /end CHARACTERISTIC
/begin CHARACTERISTIC epz_inc_pwg_dif "EPZ_INC_PWG_DIF" VALUE 0x481b9 a_173 10 LINEAR______0_000000__0H___25182 0.0 255.0 BIT_MASK 0xffffffff /end CHARACTERISTIC
/begin CHARACTERISTIC epz_inc_pwg1 "EPZ_INC_PWG1" VALUE 0x481ba a_173 4 LINEAR______0_000000__0H___25182 0.0 255.0 BIT_MASK 0xffffffff /end CHARACTERISTIC
/begin CHARACTERISTIC epz_inc_pwg2 "EPZ_INC_PWG2" VALUE 0x481bb a_173 4 LINEAR______0_000000__0H___25182 0.0 255.0 BIT_MASK 0xffffffff /end CHARACTERISTIC
/begin CHARACTERISTIC epz_inc_rl_kk "EPZ_INC_RL_KK" VALUE 0x481bc a_173 4 LINEAR______0_000000__0H___25182 0.0 255.0 BIT_MASK 0xffffffff /end CHARACTERISTIC
/begin CHARACTERISTIC epz_inc_rl_kp "EPZ_INC_RL_KP" VALUE 0x481bd a_173 4 LINEAR______0_000000__0H___25182 0.0 255.0 BIT_MASK 0xffffffff /end CHARACTERISTIC
/begin CHARACTERISTIC epz_inc_rul "EPZ_INC_RUL" VALUE 0x481be a_173 4 LINEAR______0_000000__0H___25182 0.0 255.0 BIT_MASK 0xffffffff /end CHARACTERISTIC
/begin CHARACTERISTIC epz_inc_rv_ad_mech_ref "EPZ_INC_RV_AD_MECH_REF" VALUE 0x481bf a_173 4 LINEAR______0_000000__0H___25182 0.0 255.0 BIT_MASK 0xffffffff /end CHARACTERISTIC
/begin CHARACTERISTIC epz_inc_slp "EPZ_INC_SLP" VALUE 0x481c0 a_173 10 LINEAR______0_000000__0H___25182 0.0 255.0 BIT_MASK 0xffffffff /end CHARACTERISTIC
/begin CHARACTERISTIC epz_inc_slv "EPZ_INC_SLV" VALUE 0x481c1 a_173 10 LINEAR______0_000000__0H___25182 0.0 255.0 BIT_MASK 0xffffffff /end CHARACTERISTIC
/begin CHARACTERISTIC epz_inc_spi "EPZ_INC_SPI" VALUE 0x481c2 a_173 10 LINEAR______0_000000__0H___25182 0.0 255.0 BIT_MASK 0xffffffff /end CHARACTERISTIC
/begin CHARACTERISTIC epz_inc_tal "EPZ_INC_TAL" VALUE 0x481c3 a_173 10 LINEAR______0_000000__0H___25182 0.0 255.0 BIT_MASK 0xffffffff /end CHARACTERISTIC
/begin CHARACTERISTIC epz_inc_tamdk "EPZ_INC_TAMDK" VALUE 0x481c4 a_173 4 LINEAR______0_000000__0H___25182 0.0 255.0 BIT_MASK 0xffffffff /end CHARACTERISTIC
/begin CHARACTERISTIC epz_inc_tev "EPZ_INC_TEV" VALUE 0x481c5 a_173 4 LINEAR______0_000000__0H___25182 0.0 255.0 BIT_MASK 0xffffffff /end CHARACTERISTIC
/begin CHARACTERISTIC epz_inc_timeout_asc1 "EPZ_INC_TIMEOUT_ASC1" VALUE 0x481c6 a_173 100 LINEAR______0_000000__0H___25182 0.0 255.0 BIT_MASK 0xffffffff /end CHARACTERISTIC
/begin CHARACTERISTIC epz_inc_timeout_asc3 "EPZ_INC_TIMEOUT_ASC3" VALUE 0x481c7 a_173 100 LINEAR______0_000000__0H___25182 0.0 255.0 BIT_MASK 0xffffffff /end CHARACTERISTIC
/begin CHARACTERISTIC epz_inc_timeout_egs1 "EPZ_INC_TIMEOUT_EGS1" VALUE 0x481c8 a_173 4 LINEAR______0_000000__0H___25182 0.0 255.0 BIT_MASK 0xffffffff /end CHARACTERISTIC
/begin CHARACTERISTIC epz_inc_timeout_instr2 "EPZ_INC_TIMEOUT_INSTR2" VALUE 0x481c9 a_173 100 LINEAR______0_000000__0H___25182 0.0 255.0 BIT_MASK 0xffffffff /end CHARACTERISTIC
/begin CHARACTERISTIC epz_inc_timeout_instr3 "EPZ_INC_TIMEOUT_INSTR3" VALUE 0x481ca a_173 4 LINEAR______0_000000__0H___25182 0.0 255.0 BIT_MASK 0xffffffff /end CHARACTERISTIC
/begin CHARACTERISTIC epz_inc_tka "EPZ_INC_TKA" VALUE 0x481cb a_173 4 LINEAR______0_000000__0H___25182 0.0 255.0 BIT_MASK 0xffffffff /end CHARACTERISTIC
/begin CHARACTERISTIC epz_inc_tkw "EPZ_INC_TKW" VALUE 0x481cc a_173 10 LINEAR______0_000000__0H___25182 0.0 255.0 BIT_MASK 0xffffffff /end CHARACTERISTIC
/begin CHARACTERISTIC epz_inc_tn "EPZ_INC_TN" VALUE 0x481cd a_173 4 LINEAR______0_000000__0H___25185 0.0 255.0 BIT_MASK 0xffffffff /end CHARACTERISTIC
/begin CHARACTERISTIC epz_inc_toel "EPZ_INC_TOEL" VALUE 0x481ce a_173 10 LINEAR______0_000000__0H___25182 0.0 255.0 BIT_MASK 0xffffffff /end CHARACTERISTIC
/begin CHARACTERISTIC epz_inc_uls_gnd_nkat "EPZ_INC_ULS_GND_NKAT" VALUE 0x481cf a_173 100 LINEAR______0_000000__0H___25142 0.0 255.0 BIT_MASK 0xffffffff /end CHARACTERISTIC
/begin CHARACTERISTIC epz_inc_uls_gnd_vkat "EPZ_INC_ULS_GND_VKAT" VALUE 0x481d0 a_173 100 LINEAR______0_000000__0H___25142 0.0 255.0 BIT_MASK 0xffffffff /end CHARACTERISTIC
/begin CHARACTERISTIC epz_inc_uls_nkat "EPZ_INC_ULS_NKAT" VALUE 0x481d1 a_173 100 LINEAR______0_000000__0H___25142 0.0 255.0 BIT_MASK 0xffffffff /end CHARACTERISTIC
/begin CHARACTERISTIC epz_inc_uls_nkat_nsa "EPZ_INC_ULS_NKAT_NSA" VALUE 0x481d2 a_173 100 LINEAR______0_000000__0H___25142 0.0 255.0 BIT_MASK 0xffffffff /end CHARACTERISTIC
/begin CHARACTERISTIC epz_inc_uls_nkat_sa "EPZ_INC_ULS_NKAT_SA" VALUE 0x481d3 a_173 100 LINEAR______0_000000__0H___25142 0.0 255.0 BIT_MASK 0xffffffff /end CHARACTERISTIC
/begin CHARACTERISTIC epz_inc_uls_nkat_time "EPZ_INC_ULS_NKAT_TIME" VALUE 0x481d4 a_173 100 LINEAR______0_000000__0H___25142 0.0 255.0 BIT_MASK 0xffffffff /end CHARACTERISTIC
/begin CHARACTERISTIC epz_inc_uls_vkat "EPZ_INC_ULS_VKAT" VALUE 0x481d5 a_173 100 LINEAR______0_000000__0H___25142 0.0 255.0 BIT_MASK 0xffffffff /end CHARACTERISTIC
/begin CHARACTERISTIC epz_inc_vanos "EPZ_INC_VANOS" VALUE 0x481d6 a_173 4 LINEAR______0_000000__0H___25182 0.0 255.0 BIT_MASK 0xffffffff /end CHARACTERISTIC
/begin CHARACTERISTIC epz_inc_vepu "EPZ_INC_SSP" VALUE 0x481d7 a_173 4 LINEAR______0_000000__0H___25182 0.0 255.0 BIT_MASK 0xffffffff /end CHARACTERISTIC
/begin CHARACTERISTIC epz_inc_zs "EPZ_INC_ZS" VALUE 0x481d8 a_173 5 LINEAR______0_000000__0H___25182 0.0 255.0 BIT_MASK 0xffffffff /end CHARACTERISTIC
/begin CHARACTERISTIC epz_inc_zsr "EPZ_INC_ZSR" VALUE 0x481d9 a_173 5 LINEAR______0_000000__0H___25182 0.0 255.0 BIT_MASK 0xffffffff /end CHARACTERISTIC
/begin CHARACTERISTIC epz_max_ak "EPZ_MAX_AK" VALUE 0x481da a_173 10 LINEAR______1_000000__1H___255_0 1.0 255.0 BIT_MASK 0xffffffff /end CHARACTERISTIC
/begin CHARACTERISTIC epz_max_auf_rs "EPZ_MAX_AUF_RS" VALUE 0x481db a_173 100 LINEAR______0_000000__0H___25142 0.0 255.0 BIT_MASK 0xffffffff /end CHARACTERISTIC
/begin CHARACTERISTIC epz_max_auf_rs_4 "EPZ_MAX_AUF_RS_4" VALUE 0x481dc a_173 100 LINEAR______0_000000__0H___25142 0.0 255.0 BIT_MASK 0xffffffff /end CHARACTERISTIC
/begin CHARACTERISTIC epz_max_bls "EPZ_MAX_BLS" VALUE 0x481dd a_173 4 LINEAR______1_000000__1H___255_0 1.0 255.0 BIT_MASK 0xffffffff /end CHARACTERISTIC
/begin CHARACTERISTIC epz_max_bls_pwg "EPZ_MAX_BLS_PWG" VALUE 0x481de a_173 4 LINEAR______1_000000__1H___255_0 1.0 255.0 BIT_MASK 0xffffffff /end CHARACTERISTIC
/begin CHARACTERISTIC epz_max_bts_1 "EPZ_MAX_BTS_1" VALUE 0x487e7 a_175 100 LINEAR______1_000000__1H___127_0 1.0 127.0 BIT_MASK 0xffffffff /end CHARACTERISTIC
/begin CHARACTERISTIC epz_max_bts_2 "EPZ_MAX_BTS_2" VALUE 0x487e8 a_175 100 LINEAR_______128_000000__FFFFFF8 -128.0 -1.0 BIT_MASK 0xffffffff /end CHARACTERISTIC
/begin CHARACTERISTIC epz_max_can_b_o "EPZ_MAX_CAN_B_O" VALUE 0x481df a_173 4 LINEAR______1_000000__1H___255_0 1.0 255.0 BIT_MASK 0xffffffff /end CHARACTERISTIC
/begin CHARACTERISTIC epz_max_dif_poti_1 "EPZ_MAX_DIF_POTI_1" VALUE 0x481e0 a_173 10 LINEAR______1_000000__1H___255_0 1.0 255.0 BIT_MASK 0xffffffff /end CHARACTERISTIC
/begin CHARACTERISTIC epz_max_dif_poti_2 "EPZ_MAX_DIF_POTI_2" VALUE 0x481e1 a_173 10 LINEAR______1_000000__1H___255_0 1.0 255.0 BIT_MASK 0xffffffff /end CHARACTERISTIC
/begin CHARACTERISTIC epz_max_disa "EPZ_MAX_DISA" VALUE 0x481e2 a_173 4 LINEAR______1_000000__1H___255_0 1.0 255.0 BIT_MASK 0xffffffff /end CHARACTERISTIC
/begin CHARACTERISTIC epz_max_elm "EPZ_MAX_ELM" VALUE 0x481e3 a_173 4 LINEAR______1_000000__1H___255_0 1.0 255.0 BIT_MASK 0xffffffff /end CHARACTERISTIC
/begin CHARACTERISTIC epz_max_ev "EPZ_MAX_EV" VALUE 0x481e4 a_173 4 LINEAR______1_000000__1H___255_0 1.0 255.0 BIT_MASK 0xffffffff /end CHARACTERISTIC
/begin CHARACTERISTIC epz_max_ews "EPZ_MAX_EWS" VALUE 0x481e5 a_173 4 LINEAR______1_000000__1H___255_0 1.0 255.0 BIT_MASK 0xffffffff /end CHARACTERISTIC
/begin CHARACTERISTIC epz_max_ews_n "EPZ_MAX_EWS_N" VALUE 0x481e6 a_173 4 LINEAR______1_000000__1H___255_0 1.0 255.0 BIT_MASK 0xffffffff /end CHARACTERISTIC
/begin CHARACTERISTIC epz_max_ews_pe "EPZ_MAX_EWS_PE" VALUE 0x481e7 a_173 4 LINEAR______1_000000__1H___255_0 1.0 255.0 BIT_MASK 0xffffffff /end CHARACTERISTIC
/begin CHARACTERISTIC epz_max_gw_kr "EPZ_MAX_GW_KR" VALUE 0x481e8 a_173 100 LINEAR______1_000000__1H___255_0 1.0 255.0 BIT_MASK 0xffffffff /end CHARACTERISTIC
/begin CHARACTERISTIC epz_max_kfk "EPZ_MAX_KFK" VALUE 0x481e9 a_173 4 LINEAR______1_000000__1H___255_0 1.0 255.0 BIT_MASK 0xffffffff /end CHARACTERISTIC
/begin CHARACTERISTIC epz_max_kw "EPZ_MAX_KW" VALUE 0x481ea a_173 8 LINEAR______1_000000__1H___255_0 1.0 255.0 BIT_MASK 0xffffffff /end CHARACTERISTIC
/begin CHARACTERISTIC epz_max_lam "EPZ_MAX_LAM" VALUE 0x481eb a_173 2 LINEAR______1_000000__1H___255_0 1.0 255.0 BIT_MASK 0xffffffff /end CHARACTERISTIC
/begin CHARACTERISTIC epz_max_ldp "EPZ_MAX_LDP" VALUE 0x481ec a_173 4 LINEAR______1_000000__1H___255_0 1.0 255.0 BIT_MASK 0xffffffff /end CHARACTERISTIC
/begin CHARACTERISTIC epz_max_llfs_1 "EPZ_MAX_LLFS_1" VALUE 0x481ed a_173 4 LINEAR______1_000000__1H___255_0 1.0 255.0 BIT_MASK 0xffffffff /end CHARACTERISTIC
/begin CHARACTERISTIC epz_max_llfs_2 "EPZ_MAX_LLFS_2" VALUE 0x481ee a_173 4 LINEAR______1_000000__1H___255_0 1.0 255.0 BIT_MASK 0xffffffff /end CHARACTERISTIC
/begin CHARACTERISTIC epz_max_lm "EPZ_MAX_LM" VALUE 0x481ef a_173 4 LINEAR______1_000000__1H___255_0 1.0 255.0 BIT_MASK 0xffffffff /end CHARACTERISTIC
/begin CHARACTERISTIC epz_max_lsh "EPZ_MAX_LSH" VALUE 0x481f0 a_173 4 LINEAR______1_000000__1H___255_0 1.0 255.0 BIT_MASK 0xffffffff /end CHARACTERISTIC
/begin CHARACTERISTIC epz_max_lsh_kat "EPZ_MAX_LSH_KAT" VALUE 0x481f1 a_173 4 LINEAR______1_000000__1H___255_0 1.0 255.0 BIT_MASK 0xffffffff /end CHARACTERISTIC
/begin CHARACTERISTIC epz_max_mdk "EPZ_MAX_MDK" VALUE 0x481f2 a_173 4 LINEAR______1_000000__1H___255_0 1.0 255.0 BIT_MASK 0xffffffff /end CHARACTERISTIC
/begin CHARACTERISTIC epz_max_mdk_2 "EPZ_MAX_MDK_2" VALUE 0x481f3 a_173 10 LINEAR______1_000000__1H___255_0 1.0 255.0 BIT_MASK 0xffffffff /end CHARACTERISTIC
/begin CHARACTERISTIC epz_max_mdk_ad "EPZ_MAX_MDK_AD" VALUE 0x481f4 a_173 4 LINEAR______1_000000__1H___255_0 1.0 255.0 BIT_MASK 0xffffffff /end CHARACTERISTIC
/begin CHARACTERISTIC epz_max_mdk_dif "EPZ_MAX_MDK_DIF" VALUE 0x481f5 a_173 10 LINEAR______1_000000__1H___255_0 1.0 255.0 BIT_MASK 0xffffffff /end CHARACTERISTIC
/begin CHARACTERISTIC epz_max_mdk_fgr "EPZ_MAX_MDK_FGR" VALUE 0x481f6 a_173 100 LINEAR______1_000000__1H___255_0 1.0 255.0 BIT_MASK 0xffffffff /end CHARACTERISTIC
/begin CHARACTERISTIC epz_max_mdk_mech_notl "EPZ_MAX_MDK_MECH_NOTL" VALUE 0x481f7 a_173 10 LINEAR______1_000000__1H___255_0 1.0 255.0 BIT_MASK 0xffffffff /end CHARACTERISTIC
/begin CHARACTERISTIC epz_max_mdk1 "EPZ_MAX_MDK1" VALUE 0x481f8 a_173 4 LINEAR______1_000000__1H___255_0 1.0 255.0 BIT_MASK 0xffffffff /end CHARACTERISTIC
/begin CHARACTERISTIC epz_max_mdk2 "EPZ_MAX_MDK2" VALUE 0x481f9 a_173 4 LINEAR______1_000000__1H___255_0 1.0 255.0 BIT_MASK 0xffffffff /end CHARACTERISTIC
/begin CHARACTERISTIC epz_max_mfl_2 "EPZ_MAX_MFL_2" VALUE 0x481fa a_173 10 LINEAR______1_000000__1H___255_0 1.0 255.0 BIT_MASK 0xffffffff /end CHARACTERISTIC
/begin CHARACTERISTIC epz_max_mfl_3 "EPZ_MAX_MFL_3" VALUE 0x481fb a_173 10 LINEAR______1_000000__1H___255_0 1.0 255.0 BIT_MASK 0xffffffff /end CHARACTERISTIC
/begin CHARACTERISTIC epz_max_mfl_tb "EPZ_MAX_MFL_TB" VALUE 0x481fc a_173 4 LINEAR______1_000000__1H___255_0 1.0 255.0 BIT_MASK 0xffffffff /end CHARACTERISTIC
/begin CHARACTERISTIC epz_max_misf "EPZ_MAX_MISF" VALUE 0x481fd a_173 4 LINEAR______1_000000__1H___255_0 1.0 255.0 BIT_MASK 0xffffffff /end CHARACTERISTIC
/begin CHARACTERISTIC epz_max_nw "EPZ_MAX_NW" VALUE 0x481fe a_173 8 LINEAR______1_000000__1H___255_0 1.0 255.0 BIT_MASK 0xffffffff /end CHARACTERISTIC
/begin CHARACTERISTIC epz_max_nwa "EPZ_MAX_NWA" VALUE 0x481ff a_173 8 LINEAR______1_000000__1H___255_0 1.0 255.0 BIT_MASK 0xffffffff /end CHARACTERISTIC
/begin CHARACTERISTIC epz_max_pwg_ad "EPZ_MAX_PWG_AD" VALUE 0x48200 a_173 4 LINEAR______1_000000__1H___255_0 1.0 255.0 BIT_MASK 0xffffffff /end CHARACTERISTIC
/begin CHARACTERISTIC epz_max_pwg_dif "EPZ_MAX_PWG_DIF" VALUE 0x48201 a_173 10 LINEAR______1_000000__1H___255_0 1.0 255.0 BIT_MASK 0xffffffff /end CHARACTERISTIC
/begin CHARACTERISTIC epz_max_pwg1 "EPZ_MAX_PWG1" VALUE 0x48202 a_173 4 LINEAR______1_000000__1H___255_0 1.0 255.0 BIT_MASK 0xffffffff /end CHARACTERISTIC
/begin CHARACTERISTIC epz_max_pwg2 "EPZ_MAX_PWG2" VALUE 0x48203 a_173 4 LINEAR______1_000000__1H___255_0 1.0 255.0 BIT_MASK 0xffffffff /end CHARACTERISTIC
/begin CHARACTERISTIC epz_max_rl_kk "EPZ_MAX_RL_KK" VALUE 0x48204 a_173 4 LINEAR______1_000000__1H___255_0 1.0 255.0 BIT_MASK 0xffffffff /end CHARACTERISTIC
/begin CHARACTERISTIC epz_max_rl_kp "EPZ_MAX_RL_KP" VALUE 0x48205 a_173 4 LINEAR______1_000000__1H___255_0 1.0 255.0 BIT_MASK 0xffffffff /end CHARACTERISTIC
/begin CHARACTERISTIC epz_max_rul "EPZ_MAX_RUL" VALUE 0x48206 a_173 4 LINEAR______1_000000__1H___255_0 1.0 255.0 BIT_MASK 0xffffffff /end CHARACTERISTIC
/begin CHARACTERISTIC epz_max_rv_ad_mech_ref "EPZ_MAX_RV_AD_MECH_REF" VALUE 0x48207 a_173 4 LINEAR______1_000000__1H___255_0 1.0 255.0 BIT_MASK 0xffffffff /end CHARACTERISTIC
/begin CHARACTERISTIC epz_max_slp "EPZ_MAX_SLP" VALUE 0x48208 a_173 10 LINEAR______1_000000__1H___255_0 1.0 255.0 BIT_MASK 0xffffffff /end CHARACTERISTIC
/begin CHARACTERISTIC epz_max_slv "EPZ_MAX_SLV" VALUE 0x48209 a_173 10 LINEAR______1_000000__1H___255_0 1.0 255.0 BIT_MASK 0xffffffff /end CHARACTERISTIC
/begin CHARACTERISTIC epz_max_spi "EPZ_MAX_SPI" VALUE 0x4820a a_173 10 LINEAR______1_000000__1H___255_0 1.0 255.0 BIT_MASK 0xffffffff /end CHARACTERISTIC
/begin CHARACTERISTIC epz_max_tal "EPZ_MAX_TAL" VALUE 0x4820b a_173 10 LINEAR______1_000000__1H___255_0 1.0 255.0 BIT_MASK 0xffffffff /end CHARACTERISTIC
/begin CHARACTERISTIC epz_max_tamdk "EPZ_MAX_TAMDK" VALUE 0x4820c a_173 4 LINEAR______1_000000__1H___255_0 1.0 255.0 BIT_MASK 0xffffffff /end CHARACTERISTIC
/begin CHARACTERISTIC epz_max_tev "EPZ_MAX_TEV" VALUE 0x4820d a_173 4 LINEAR______1_000000__1H___255_0 1.0 255.0 BIT_MASK 0xffffffff /end CHARACTERISTIC
/begin CHARACTERISTIC epz_max_timeout_asc1 "EPZ_MAX_TIMEOUT_ASC1" VALUE 0x4820e a_173 100 LINEAR______1_000000__1H___255_0 1.0 255.0 BIT_MASK 0xffffffff /end CHARACTERISTIC
/begin CHARACTERISTIC epz_max_timeout_asc3 "EPZ_MAX_TIMEOUT_ASC3" VALUE 0x4820f a_173 100 LINEAR______1_000000__1H___255_0 1.0 255.0 BIT_MASK 0xffffffff /end CHARACTERISTIC
/begin CHARACTERISTIC epz_max_timeout_egs1 "EPZ_MAX_TIMEOUT_EGS1" VALUE 0x48210 a_173 4 LINEAR______1_000000__1H___255_0 1.0 255.0 BIT_MASK 0xffffffff /end CHARACTERISTIC
/begin CHARACTERISTIC epz_max_timeout_instr2 "EPZ_MAX_TIMEOUT_INSTR2" VALUE 0x48211 a_173 100 LINEAR______1_000000__1H___255_0 1.0 255.0 BIT_MASK 0xffffffff /end CHARACTERISTIC
/begin CHARACTERISTIC epz_max_timeout_instr3 "EPZ_MAX_TIMEOUT_INSTR3" VALUE 0x48212 a_173 4 LINEAR______1_000000__1H___255_0 1.0 255.0 BIT_MASK 0xffffffff /end CHARACTERISTIC
/begin CHARACTERISTIC epz_max_tka "EPZ_MAX_TKA" VALUE 0x48213 a_173 4 LINEAR______1_000000__1H___255_0 1.0 255.0 BIT_MASK 0xffffffff /end CHARACTERISTIC
/begin CHARACTERISTIC epz_max_tkat "EPZ_MAX_TKAT" VALUE 0x48214 a_173 4 LINEAR______1_000000__1H___255_0 1.0 255.0 BIT_MASK 0xffffffff /end CHARACTERISTIC
/begin CHARACTERISTIC epz_max_tkw "EPZ_MAX_TKW" VALUE 0x48215 a_173 10 LINEAR______1_000000__1H___255_0 1.0 255.0 BIT_MASK 0xffffffff /end CHARACTERISTIC
/begin CHARACTERISTIC epz_max_tn "EPZ_MAX_TN" VALUE 0x48216 a_173 4 LINEAR______0_000000__0H___25185 0.0 255.0 BIT_MASK 0xffffffff /end CHARACTERISTIC
/begin CHARACTERISTIC epz_max_toel "EPZ_MAX_TOEL" VALUE 0x48217 a_173 10 LINEAR______1_000000__1H___255_0 1.0 255.0 BIT_MASK 0xffffffff /end CHARACTERISTIC
/begin CHARACTERISTIC epz_max_uls_gnd_nkat "EPZ_MAX_ULS_GND_NKAT" VALUE 0x48218 a_173 100 LINEAR______0_000000__0H___25142 0.0 255.0 BIT_MASK 0xffffffff /end CHARACTERISTIC
/begin CHARACTERISTIC epz_max_uls_gnd_vkat "EPZ_MAX_ULS_GND_VKAT" VALUE 0x48219 a_173 100 LINEAR______0_000000__0H___25142 0.0 255.0 BIT_MASK 0xffffffff /end CHARACTERISTIC
/begin CHARACTERISTIC epz_max_uls_nkat "EPZ_MAX_ULS_NKAT" VALUE 0x4821a a_173 100 LINEAR______0_000000__0H___25142 0.0 255.0 BIT_MASK 0xffffffff /end CHARACTERISTIC
/begin CHARACTERISTIC epz_max_uls_nkat_nsa "EPZ_MAX_ULS_NKAT_NSA" VALUE 0x4821b a_173 100 LINEAR______0_000000__0H___25142 0.0 255.0 BIT_MASK 0xffffffff /end CHARACTERISTIC
/begin CHARACTERISTIC epz_max_uls_nkat_sa "EPZ_MAX_ULS_NKAT_SA" VALUE 0x4821c a_173 100 LINEAR______0_000000__0H___25142 0.0 255.0 BIT_MASK 0xffffffff /end CHARACTERISTIC
/begin CHARACTERISTIC epz_max_uls_nkat_time "EPZ_MAX_ULS_NKAT_TIME" VALUE 0x4821d a_173 100 LINEAR______0_000000__0H___25142 0.0 255.0 BIT_MASK 0xffffffff /end CHARACTERISTIC
/begin CHARACTERISTIC epz_max_uls_vkat "EPZ_MAX_ULS_VKAT" VALUE 0x4821e a_173 100 LINEAR______0_000000__0H___25142 0.0 255.0 BIT_MASK 0xffffffff /end CHARACTERISTIC
/begin CHARACTERISTIC epz_max_vanos "EPZ_MAX_VANOS" VALUE 0x4821f a_173 4 LINEAR______1_000000__1H___255_0 1.0 255.0 BIT_MASK 0xffffffff /end CHARACTERISTIC
/begin CHARACTERISTIC epz_max_vepu "EPZ_MAX_SSP" VALUE 0x48220 a_173 4 LINEAR______1_000000__1H___255_0 1.0 255.0 BIT_MASK 0xffffffff /end CHARACTERISTIC
/begin CHARACTERISTIC epz_max_zs "EPZ_MAX_ZS" VALUE 0x48221 a_173 5 LINEAR______1_000000__1H___255_0 1.0 255.0 BIT_MASK 0xffffffff /end CHARACTERISTIC
/begin CHARACTERISTIC epz_max_zsr "EPZ_MAX_ZSR" VALUE 0x48222 a_173 5 LINEAR______1_000000__1H___255_0 1.0 255.0 BIT_MASK 0xffffffff /end CHARACTERISTIC
/begin CHARACTERISTIC FA1 "FA1" VALUE 0x4846e a_174 100 LINEAR______0_000000__0H___65190 0.0 65535.0 BIT_MASK 0xffffffff /end CHARACTERISTIC
/begin CHARACTERISTIC fak_hfm_max_diag "FAK_HFM_MAX_DIAG" VALUE 0x48470 a_174 100 LINEAR______1_000000__100H___16_ 1.0 16.0 BIT_MASK 0xffffffff /end CHARACTERISTIC
/begin CHARACTERISTIC fak_hfm_min_diag "FAK_HFM_MIN_DIAG" VALUE 0x48472 a_174 100 LINEAR______0_062500__10H___1_00 0.0625 1.0 BIT_MASK 0xffffffff /end CHARACTERISTIC
/begin CHARACTERISTIC fak_inst_kr "FAK_INST_KR" VALUE 0x48223 a_173 10 LINEAR______1_000000__20H___7_96 1.0 7.9679999 BIT_MASK 0xffffffff /end CHARACTERISTIC
/begin CHARACTERISTIC fak_nwsoll_e_tallfs_min "FAK_NWSOLL_E_TALLFS_MIN" VALUE 0x48224 a_173 100 LINEAR______0_000000__0H___0_203 0.0 0.99599999 BIT_MASK 0xffffffff /end CHARACTERISTIC
/begin CHARACTERISTIC fak_nwsoll_tl_kat "FAK_NWSOLL_TL_KAT" VALUE 0x48225 a_173 100 LINEAR______0_000000__0H___0_996 0.0 0.99610001 BIT_MASK 0xffffffff /end CHARACTERISTIC
/begin CHARACTERISTIC fak_pu_min_ldp "FAK_PU_MIN_LDP" VALUE 0x48474 a_174 100 LINEAR______0_000000__0H___2_000 0.0 2.0 BIT_MASK 0xffffffff /end CHARACTERISTIC
/begin CHARACTERISTIC fak_pu_te_ll "FAK_PU_TE_LL" VALUE 0x48476 a_174 100 LINEAR______0_000000__0H___2_000 0.0 2.0 BIT_MASK 0xffffffff /end CHARACTERISTIC
/begin CHARACTERISTIC fak_ramp_steig "FAK_RAMP_STEIG" VALUE 0x48478 a_174 100 LINEAR______0_000000__0H___0_916 0.0 0.99998474 BIT_MASK 0xffffffff /end CHARACTERISTIC
/begin CHARACTERISTIC fak_st_ms_vti "FAK_ST_MS_VTI" VALUE 0x48226 a_173 20 LINEAR______0_000000__0H___0_920 0.0 0.99599999 BIT_MASK 0xffffffff /end CHARACTERISTIC
/begin CHARACTERISTIC fak_t_ar_2_at "FAK_T_AR_2_AT" VALUE 0x48227 a_173 100 LINEAR______0_000000__0H___1_992 0.0 1.9922 BIT_MASK 0xffffffff /end CHARACTERISTIC
/begin CHARACTERISTIC fak_t_ar_2_mt "FAK_T_AR_2_MT" VALUE 0x48228 a_173 100 LINEAR______0_000000__0H___1_992 0.0 1.9922 BIT_MASK 0xffffffff /end CHARACTERISTIC
/begin CHARACTERISTIC fak_t_imp_mdk "FAK_T_IMP_MDK" VALUE 0x48229 a_173 100 LINEAR______1_000000__20H___7204 1.0 7.9679999 BIT_MASK 0xffffffff /end CHARACTERISTIC
/begin CHARACTERISTIC fak_t_kk_ein "FAK_T_KK_EIN" VALUE 0x4847a a_174 20 LINEAR______0_000000__0H___0_993 0.0 0.99997997 BIT_MASK 0xffffffff /end CHARACTERISTIC
/begin CHARACTERISTIC fak_tallfs_kk_ad "FAK_TALLFS_KK_AD" VALUE 0x4822a a_173 10 LINEAR______0_000000__0H___0_129 0.0 0.99599999 BIT_MASK 0xffffffff /end CHARACTERISTIC
/begin CHARACTERISTIC fak_talsh_nkat_red "FAK_TALSH_NKAT_RED" VALUE 0x4822b a_173 100 LINEAR______0_000000__0H___0_965 0.0 0.99609375 BIT_MASK 0xffffffff /end CHARACTERISTIC
/begin CHARACTERISTIC fak_te_min_ksd "FAK_TE_MIN_KSD" VALUE 0x4822c a_173 100 LINEAR______0_000000__0H___1_205 0.0 1.0 BIT_MASK 0xffffffff /end CHARACTERISTIC
/begin CHARACTERISTIC fak_te_min_ldp "FAK_TE_MIN_LDP" VALUE 0x4847c a_174 10 LINEAR______0_000000__0H___0_916 0.0 0.99998474 BIT_MASK 0xffffffff /end CHARACTERISTIC
/begin CHARACTERISTIC fak_zw_ar_2 "FAK_ZW_AR_2" VALUE 0x4822d a_173 100 LINEAR______0_000000__0H___0_920 0.0 0.99599999 BIT_MASK 0xffffffff /end CHARACTERISTIC
/begin CHARACTERISTIC fak_zw_ar_3 "FAK_ZW_AR_3" VALUE 0x4822e a_173 100 LINEAR______0_000000__0H___0_920 0.0 0.99599999 BIT_MASK 0xffffffff /end CHARACTERISTIC
/begin CHARACTERISTIC fak_zw_tallfs_min_ll "FAK_ZW_TALLFS_MIN_LL" VALUE 0x4822f a_173 100 LINEAR______0_000000__0H___0_203 0.0 0.99599999 BIT_MASK 0xffffffff /end CHARACTERISTIC
/begin CHARACTERISTIC FEDER_KOMP_ON "FEDER_KOMP_ON" VALUE 0x48230 a_173 100 LINEAR______0_000000__0H___25182 0.0 255.0 BIT_MASK 0xffffffff /end CHARACTERISTIC
/begin CHARACTERISTIC FRICT_CUT_OFF_TIME "FRICT_CUT_OFF_TIME" VALUE 0x4847e a_174 100 LINEAR______0_000000__0H___65190 0.0 65535.0 BIT_MASK 0xffffffff /end CHARACTERISTIC
/begin CHARACTERISTIC funk_inakt "FUNK_INAKT" VALUE 0x48231 a_173 100 LINEAR______0_000000__0H___25182 0.0 255.0 BIT_MASK 0xffffffff /end CHARACTERISTIC
/begin CHARACTERISTIC GAP "GAP" VALUE 0x480ca a_172 100 LINEAR_______32768_000000__FFFF8 -32768.0 32767.0 BIT_MASK 0xffffffff /end CHARACTERISTIC
/begin CHARACTERISTIC GRAD_ACT_CROSS_LIMIT "GRAD_ACT_CROSS_LIMIT" VALUE 0x480cc a_172 100 LINEAR_______32768_000000__FF180 -32768.0 32767.0 BIT_MASK 0xffffffff /end CHARACTERISTIC
/begin CHARACTERISTIC GRAD_ACT_OLD_CROSS_LIMIT "GRAD_ACT_OLD_CROSS_LIMIT" VALUE 0x480ce a_172 100 LINEAR_______32768_000000__FF180 -32768.0 32767.0 BIT_MASK 0xffffffff /end CHARACTERISTIC
/begin CHARACTERISTIC GRAD_DK_ACT_LIMIT2 "GRAD_DK_ACT_LIMIT2" VALUE 0x480d0 a_172 100 LINEAR_______32768_000000__FF180 -32768.0 32767.0 BIT_MASK 0xffffffff /end CHARACTERISTIC
/begin CHARACTERISTIC GRAD_DK_CROSS_LIMIT "GRAD_DK_CROSS_LIMIT" VALUE 0x480d2 a_172 100 LINEAR_______32768_000000__FF180 -32768.0 32767.0 BIT_MASK 0xffffffff /end CHARACTERISTIC
/begin CHARACTERISTIC GRAD_DK_OLD_CROSS_LIMIT "GRAD_DK_OLD_CROSS_LIMIT" VALUE 0x480d4 a_172 100 LINEAR_______32768_000000__FF180 -32768.0 32767.0 BIT_MASK 0xffffffff /end CHARACTERISTIC
/begin CHARACTERISTIC GRAD_DK_SET_LIMIT "GRAD_DK_SET_LIMIT" VALUE 0x487e9 a_175 100 SIGNEDCHAR -128.0 127.0 BIT_MASK 0xffffffff /end CHARACTERISTIC
/begin CHARACTERISTIC GRAD_DK_SET_LIMIT1 "GRAD_DK_SET_LIMIT1" VALUE 0x480d6 a_172 100 LINEAR_______32768_000000__FF180 -32768.0 32767.0 BIT_MASK 0xffffffff /end CHARACTERISTIC
/begin CHARACTERISTIC GRAD_DK_SET_LIMIT2 "GRAD_DK_SET_LIMIT2" VALUE 0x480d8 a_172 100 LINEAR_______32768_000000__FF180 -32768.0 32767.0 BIT_MASK 0xffffffff /end CHARACTERISTIC
/begin CHARACTERISTIC GRAD_PHI_DK_SWITCH_FILTER "GRAD_PHI_DK_SWITCH_FILTER" VALUE 0x48480 a_174 100 LINEAR______0_000000__0H___65190 0.0 65535.0 BIT_MASK 0xffffffff /end CHARACTERISTIC
/begin CHARACTERISTIC GRAD_WHILE_OSZ_LIMIT1 "GRAD_WHILE_OSZ_LIMIT1" VALUE 0x480da a_172 100 LINEAR_______32768_000000__FF180 -32768.0 32767.0 BIT_MASK 0xffffffff /end CHARACTERISTIC
/begin CHARACTERISTIC GRAD_WHILE_OSZ_LIMIT2 "GRAD_WHILE_OSZ_LIMIT2" VALUE 0x480dc a_172 100 LINEAR_______32768_000000__FF180 -32768.0 32767.0 BIT_MASK 0xffffffff /end CHARACTERISTIC
/begin CHARACTERISTIC gv_max_slow_s_at "GV_MAX_SLOW_S_AT" VALUE 0x48482 a_174 10 LINEAR______0_000000__0H___16153 0.0 16320.0 BIT_MASK 0xffffffff /end CHARACTERISTIC
/begin CHARACTERISTIC gv_max_slow_s_mt "GV_MAX_SLOW_S_MT" VALUE 0x48484 a_174 10 LINEAR______0_000000__0H___16153 0.0 16320.0 BIT_MASK 0xffffffff /end CHARACTERISTIC
/begin CHARACTERISTIC gw_fak_gmw_max "GW_FAK_GMW_MAX" VALUE 0x48232 a_173 5 LINEAR______0_000000__0H___1_948 0.0 1.992 BIT_MASK 0xffffffff /end CHARACTERISTIC
/begin CHARACTERISTIC gw_fak_gmw_min "GW_FAK_GMW_MIN" VALUE 0x48233 a_173 5 LINEAR______0_000000__0H___1_948 0.0 1.992 BIT_MASK 0xffffffff /end CHARACTERISTIC
/begin CHARACTERISTIC gw_fak_mitko "GW_FAK_MITKO" VALUE 0x48234 a_173 10 LINEAR______0_000000__0H___0_124 0.0 0.1245 BIT_MASK 0xffffffff /end CHARACTERISTIC
/begin CHARACTERISTIC gw_max "GW_MAX" VALUE 0x48486 a_174 5 LINEAR______0_000000__0H___5_206 0.0 5.1 BIT_MASK 0xffffffff /end CHARACTERISTIC
/begin CHARACTERISTIC gw_min "GW_MIN" VALUE 0x48488 a_174 5 LINEAR______0_000000__0H___5_206 0.0 5.1 BIT_MASK 0xffffffff /end CHARACTERISTIC
/begin CHARACTERISTIC gw_mitko "GW_MITKO" VALUE 0x4848a a_174 5 LINEAR______0_000015__1H___0_999 1.5259e-005 0.99998474 BIT_MASK 0xffffffff /end CHARACTERISTIC
/begin CHARACTERISTIC gw_mitko_inst "GW_MITKO_INST" VALUE 0x4848c a_174 5 LINEAR______0_000015__1H___0_999 1.5259e-005 0.99998474 BIT_MASK 0xffffffff /end CHARACTERISTIC
/begin CHARACTERISTIC hys_ini_vanos "HYS_INI_VANOS" VALUE 0x48235 a_173 100 LINEAR______0_000000__0H___47_62 0.0 47.625 BIT_MASK 0xffffffff /end CHARACTERISTIC
/begin CHARACTERISTIC hys_n_el "HYS_N_EL" VALUE 0x48236 a_173 100 LINEAR______0_000000__0H___15_94 0.0 15.94 BIT_MASK 0xffffffff /end CHARACTERISTIC
/begin CHARACTERISTIC i_lsh_ph_max "I_LSH_PH_MAX" VALUE 0x48237 a_173 100 LINEAR______0_000000__0H___5_207 0.0 5.0 BIT_MASK 0xffffffff /end CHARACTERISTIC
/begin CHARACTERISTIC I_MAX "I_MAX" VALUE 0x4880c a_189 100 LINEAR_______2147483647_000000__ -2.1474836e+009 2.1474836e+009 BIT_MASK 0xffffffff FUNCTION_LIST hella /end CHARACTERISTIC
/begin CHARACTERISTIC ID_ECU_SAM_TIME1C0D "" VALUE 0x4fad8 a_174 100 defaultConversion208 0 65535 BIT_MASK 0xffffffff /end CHARACTERISTIC
/begin CHARACTERISTIC ID_ECU_SAM_TIME1C1D "" VALUE 0x4fada a_174 100 defaultConversion209 0 65535 BIT_MASK 0xffffffff /end CHARACTERISTIC
/begin CHARACTERISTIC ID_ECU_SAM_TIME1C2D "" VALUE 0x4fadc a_174 100 defaultConversion210 0 65535 BIT_MASK 0xffffffff /end CHARACTERISTIC
/begin CHARACTERISTIC ID_ECU_SAM_TIME1C3D "" VALUE 0x4fade a_174 100 defaultConversion211 0 65535 BIT_MASK 0xffffffff /end CHARACTERISTIC
/begin CHARACTERISTIC ID_ECU_SAM_TIME1C4D "" VALUE 0x4fae0 a_174 100 defaultConversion212 0 65535 BIT_MASK 0xffffffff /end CHARACTERISTIC
/begin CHARACTERISTIC ID_ECU_SAM_TIME1C5D "" VALUE 0x4fae2 a_174 100 defaultConversion213 0 65535 BIT_MASK 0xffffffff /end CHARACTERISTIC
/begin CHARACTERISTIC ID_ECU_SAM_TIME1C6D "" VALUE 0x4fae4 a_174 100 defaultConversion214 0 65535 BIT_MASK 0xffffffff /end CHARACTERISTIC
/begin CHARACTERISTIC ID_ECU_SAM_TIME1C7D "" VALUE 0x4fae6 a_174 100 defaultConversion215 0 65535 BIT_MASK 0xffffffff /end CHARACTERISTIC
/begin CHARACTERISTIC ID_ECU_SAM_TIME1C8D "" VALUE 0x4fae8 a_174 100 defaultConversion216 0 65535 BIT_MASK 0xffffffff /end CHARACTERISTIC
/begin CHARACTERISTIC ID_ECU_SAM_TIME1C9D "" VALUE 0x4faea a_174 100 defaultConversion217 0 65535 BIT_MASK 0xffffffff /end CHARACTERISTIC
/begin CHARACTERISTIC ID_ECU_SAM_TIME1C10D "" VALUE 0x4faec a_174 100 defaultConversion218 0 65535 BIT_MASK 0xffffffff /end CHARACTERISTIC
/begin CHARACTERISTIC ID_ECU_SAM_TIME1C11D "" VALUE 0x4faee a_174 100 defaultConversion219 0 65535 BIT_MASK 0xffffffff /end CHARACTERISTIC
/begin CHARACTERISTIC ID_ECU_SAM_TIME1C12D "" VALUE 0x4faf0 a_174 100 defaultConversion220 0 65535 BIT_MASK 0xffffffff /end CHARACTERISTIC
/begin CHARACTERISTIC ID_ECU_SAM_TIME1C13D "" VALUE 0x4faf2 a_174 100 defaultConversion221 0 65535 BIT_MASK 0xffffffff /end CHARACTERISTIC
/begin CHARACTERISTIC ID_ECU_SAM_TIME1C14D "" VALUE 0x4faf4 a_174 100 defaultConversion222 0 65535 BIT_MASK 0xffffffff /end CHARACTERISTIC
/begin CHARACTERISTIC ID_ECU_SAM_TIME1C15D "" VALUE 0x4faf6 a_174 100 defaultConversion223 0 65535 BIT_MASK 0xffffffff /end CHARACTERISTIC
/begin CHARACTERISTIC ID_ECU_SAM_TIME1C16D "" VALUE 0x4faf8 a_174 100 defaultConversion224 0 65535 BIT_MASK 0xffffffff /end CHARACTERISTIC
/begin CHARACTERISTIC ID_ECU_SAM_TIME1C17D "" VALUE 0x4fafa a_174 100 defaultConversion225 0 65535 BIT_MASK 0xffffffff /end CHARACTERISTIC
/begin CHARACTERISTIC ID_ECU_SAM_TIME1C18D "" VALUE 0x4fafc a_174 100 defaultConversion226 0 65535 BIT_MASK 0xffffffff /end CHARACTERISTIC
/begin CHARACTERISTIC ID_ECU_SAM_TIME1C19D "" VALUE 0x4fafe a_174 100 defaultConversion227 0 65535 BIT_MASK 0xffffffff /end CHARACTERISTIC
/begin CHARACTERISTIC ID_ECU_SAM_TIME1C20D "" VALUE 0x4fb00 a_174 100 defaultConversion228 0 65535 BIT_MASK 0xffffffff /end CHARACTERISTIC
/begin CHARACTERISTIC ID_ECU_SAM_TIME1C21D "" VALUE 0x4fb02 a_174 100 defaultConversion229 0 65535 BIT_MASK 0xffffffff /end CHARACTERISTIC
/begin CHARACTERISTIC ID_ECU_SAM_TIME1C22D "" VALUE 0x4fb04 a_174 100 defaultConversion230 0 65535 BIT_MASK 0xffffffff /end CHARACTERISTIC
/begin CHARACTERISTIC ID_ECU_SAM_TIME1C23D "" VALUE 0x4fb06 a_174 100 defaultConversion231 0 65535 BIT_MASK 0xffffffff /end CHARACTERISTIC
/begin CHARACTERISTIC ID_ECU_SAM_TIME1C24D "" VALUE 0x4fb08 a_174 100 defaultConversion232 0 65535 BIT_MASK 0xffffffff /end CHARACTERISTIC
/begin CHARACTERISTIC ID_ECU_SAM_TIME1C25D "" VALUE 0x4fb0a a_174 100 defaultConversion233 0 65535 BIT_MASK 0xffffffff /end CHARACTERISTIC
/begin CHARACTERISTIC ID_ECU_SAM_TIME1C26D "" VALUE 0x4fb0c a_174 100 defaultConversion234 0 65535 BIT_MASK 0xffffffff /end CHARACTERISTIC
/begin CHARACTERISTIC ID_ECU_SAM_TIME1C27D "" VALUE 0x4fb0e a_174 100 defaultConversion235 0 65535 BIT_MASK 0xffffffff /end CHARACTERISTIC
/begin CHARACTERISTIC ID_ECU_SAM_TIME1C28D "" VALUE 0x4fb10 a_174 100 defaultConversion236 0 65535 BIT_MASK 0xffffffff /end CHARACTERISTIC
/begin CHARACTERISTIC ID_ECU_SAM_TIME1C29D "" VALUE 0x4fb12 a_174 100 defaultConversion237 0 65535 BIT_MASK 0xffffffff /end CHARACTERISTIC
/begin CHARACTERISTIC ID_ECU_SAM_TIME1C30D "" VALUE 0x4fb14 a_174 100 defaultConversion238 0 65535 BIT_MASK 0xffffffff /end CHARACTERISTIC
/begin CHARACTERISTIC ID_ECU_SAM_TIME1C31D "" VALUE 0x4fb16 a_174 100 defaultConversion239 0 65535 BIT_MASK 0xffffffff /end CHARACTERISTIC
/begin CHARACTERISTIC ID_ECU_SAM_TIME1C32D "" VALUE 0x4fb18 a_174 100 defaultConversion240 0 65535 BIT_MASK 0xffffffff /end CHARACTERISTIC
/begin CHARACTERISTIC ID_ECU_SAM_TIME1C33D "" VALUE 0x4fb1a a_174 100 defaultConversion241 0 65535 BIT_MASK 0xffffffff /end CHARACTERISTIC
/begin CHARACTERISTIC ID_ECU_SAM_TIME1C34D "" VALUE 0x4fb1c a_174 100 defaultConversion242 0 65535 BIT_MASK 0xffffffff /end CHARACTERISTIC
/begin CHARACTERISTIC ID_ECU_SAM_TIME1C35D "" VALUE 0x4fb1e a_174 100 defaultConversion243 0 65535 BIT_MASK 0xffffffff /end CHARACTERISTIC
/begin CHARACTERISTIC ID_ECU_SAM_TIME1C36D "" VALUE 0x4fb20 a_174 100 defaultConversion244 0 65535 BIT_MASK 0xffffffff /end CHARACTERISTIC
/begin CHARACTERISTIC ID_ECU_SAM_TIME1C37D "" VALUE 0x4fb22 a_174 100 defaultConversion245 0 65535 BIT_MASK 0xffffffff /end CHARACTERISTIC
/begin CHARACTERISTIC ID_ECU_SAM_TIME1C38D "" VALUE 0x4fb24 a_174 100 defaultConversion246 0 65535 BIT_MASK 0xffffffff /end CHARACTERISTIC
/begin CHARACTERISTIC ID_ECU_SAM_TIME1C39D "" VALUE 0x4fb26 a_174 100 defaultConversion247 0 65535 BIT_MASK 0xffffffff /end CHARACTERISTIC
/begin CHARACTERISTIC ID_ECU_SAM_TIME1C40D "" VALUE 0x4fb28 a_174 100 defaultConversion248 0 65535 BIT_MASK 0xffffffff /end CHARACTERISTIC
/begin CHARACTERISTIC ID_ECU_SAM_TIME1C41D "" VALUE 0x4fb2a a_174 100 defaultConversion249 0 65535 BIT_MASK 0xffffffff /end CHARACTERISTIC
/begin CHARACTERISTIC ID_ECU_SAM_TIME1C42D "" VALUE 0x4fb2c a_174 100 defaultConversion250 0 65535 BIT_MASK 0xffffffff /end CHARACTERISTIC
/begin CHARACTERISTIC ID_ECU_SAM_TIME1C43D "" VALUE 0x4fb2e a_174 100 defaultConversion251 0 65535 BIT_MASK 0xffffffff /end CHARACTERISTIC
/begin CHARACTERISTIC ID_ECU_SAM_TIME1C44D "" VALUE 0x4fb30 a_174 100 defaultConversion252 0 65535 BIT_MASK 0xffffffff /end CHARACTERISTIC
/begin CHARACTERISTIC ID_ECU_SAM_TIME1C45D "" VALUE 0x4fb32 a_174 100 defaultConversion253 0 65535 BIT_MASK 0xffffffff /end CHARACTERISTIC
/begin CHARACTERISTIC ID_ECU_SAM_TIME1C46D "" VALUE 0x4fb34 a_174 100 defaultConversion254 0 65535 BIT_MASK 0xffffffff /end CHARACTERISTIC
/begin CHARACTERISTIC ID_ECU_SAM_TIME1C47D "" VALUE 0x4fb36 a_174 100 defaultConversion255 0 65535 BIT_MASK 0xffffffff /end CHARACTERISTIC
/begin CHARACTERISTIC ID_ECU_SAM_TIME1C48D "" VALUE 0x4fb38 a_174 100 defaultConversion256 0 65535 BIT_MASK 0xffffffff /end CHARACTERISTIC
/begin CHARACTERISTIC ID_ECU_SAM_TIME1C49D "" VALUE 0x4fb3a a_174 100 defaultConversion257 0 65535 BIT_MASK 0xffffffff /end CHARACTERISTIC
/begin CHARACTERISTIC ID_ECU_SAM_TIME1C50D "" VALUE 0x4fb3c a_174 100 defaultConversion258 0 65535 BIT_MASK 0xffffffff /end CHARACTERISTIC
/begin CHARACTERISTIC ID_ECU_SAM_TIME1C51D "" VALUE 0x4fb3e a_174 100 defaultConversion259 0 65535 BIT_MASK 0xffffffff /end CHARACTERISTIC
/begin CHARACTERISTIC ID_ECU_SAM_TIME1C52D "" VALUE 0x4fb40 a_174 100 defaultConversion260 0 65535 BIT_MASK 0xffffffff /end CHARACTERISTIC
/begin CHARACTERISTIC ID_ECU_SAM_TIME1C53D "" VALUE 0x4fb42 a_174 100 defaultConversion261 0 65535 BIT_MASK 0xffffffff /end CHARACTERISTIC
/begin CHARACTERISTIC ID_ECU_SAM_TIME1C54D "" VALUE 0x4fb44 a_174 100 defaultConversion262 0 65535 BIT_MASK 0xffffffff /end CHARACTERISTIC
/begin CHARACTERISTIC ID_ECU_SAM_TIME1C55D "" VALUE 0x4fb46 a_174 100 defaultConversion263 0 65535 BIT_MASK 0xffffffff /end CHARACTERISTIC
/begin CHARACTERISTIC ID_ECU_SAM_TIME1C56D "" VALUE 0x4fb48 a_174 100 defaultConversion264 0 65535 BIT_MASK 0xffffffff /end CHARACTERISTIC
/begin CHARACTERISTIC ID_ECU_SAM_TIME1C57D "" VALUE 0x4fb4a a_174 100 defaultConversion265 0 65535 BIT_MASK 0xffffffff /end CHARACTERISTIC
/begin CHARACTERISTIC ID_ECU_SAM_TIME1C58D "" VALUE 0x4fb4c a_174 100 defaultConversion266 0 65535 BIT_MASK 0xffffffff /end CHARACTERISTIC
/begin CHARACTERISTIC ID_ECU_SAM_TIME1C59D "" VALUE 0x4fb4e a_174 100 defaultConversion267 0 65535 BIT_MASK 0xffffffff /end CHARACTERISTIC
/begin CHARACTERISTIC ID_ECU_SAM_TIME1C60D "" VALUE 0x4fb50 a_174 100 defaultConversion268 0 65535 BIT_MASK 0xffffffff /end CHARACTERISTIC
/begin CHARACTERISTIC ID_ECU_SAM_TIME1C61D "" VALUE 0x4fb52 a_174 100 defaultConversion269 0 65535 BIT_MASK 0xffffffff /end CHARACTERISTIC
/begin CHARACTERISTIC ID_ECU_SAM_TIME1C62D "" VALUE 0x4fb54 a_174 100 defaultConversion270 0 65535 BIT_MASK 0xffffffff /end CHARACTERISTIC
/begin CHARACTERISTIC ID_ECU_SAM_TIME1C63D "" VALUE 0x4fb56 a_174 100 defaultConversion271 0 65535 BIT_MASK 0xffffffff /end CHARACTERISTIC
/begin CHARACTERISTIC ID_ECU_SAM_TIME1C64D "" VALUE 0x4fb58 a_174 100 defaultConversion272 0 65535 BIT_MASK 0xffffffff /end CHARACTERISTIC
/begin CHARACTERISTIC ID_ECU_SAM_TIME1C65D "" VALUE 0x4fb5a a_174 100 defaultConversion273 0 65535 BIT_MASK 0xffffffff /end CHARACTERISTIC
/begin CHARACTERISTIC ID_ECU_SAM_TIME1C66D "" VALUE 0x4fb5c a_174 100 defaultConversion274 0 65535 BIT_MASK 0xffffffff /end CHARACTERISTIC
/begin CHARACTERISTIC ID_ECU_SAM_TIME1C67D "" VALUE 0x4fb5e a_174 100 defaultConversion275 0 65535 BIT_MASK 0xffffffff /end CHARACTERISTIC
/begin CHARACTERISTIC ID_ECU_SAM_TIME1C68D "" VALUE 0x4fb60 a_174 100 defaultConversion276 0 65535 BIT_MASK 0xffffffff /end CHARACTERISTIC
/begin CHARACTERISTIC ID_ECU_SAM_TIME1C69D "" VALUE 0x4fb62 a_174 100 defaultConversion277 0 65535 BIT_MASK 0xffffffff /end CHARACTERISTIC
/begin CHARACTERISTIC ID_ECU_SAM_TIME1C70D "" VALUE 0x4fb64 a_174 100 defaultConversion278 0 65535 BIT_MASK 0xffffffff /end CHARACTERISTIC
/begin CHARACTERISTIC ID_ECU_SAM_TIME1C71D "" VALUE 0x4fb66 a_174 100 defaultConversion279 0 65535 BIT_MASK 0xffffffff /end CHARACTERISTIC
/begin CHARACTERISTIC ID_ECU_SAM_TIME1C72D "" VALUE 0x4fb68 a_174 100 defaultConversion280 0 65535 BIT_MASK 0xffffffff /end CHARACTERISTIC
/begin CHARACTERISTIC ID_ECU_SAM_TIME1C73D "" VALUE 0x4fb6a a_174 100 defaultConversion281 0 65535 BIT_MASK 0xffffffff /end CHARACTERISTIC
/begin CHARACTERISTIC ID_ECU_SAM_TIME1C74D "" VALUE 0x4fb6c a_174 100 defaultConversion282 0 65535 BIT_MASK 0xffffffff /end CHARACTERISTIC
/begin CHARACTERISTIC ID_ECU_SAM_TIME1C75D "" VALUE 0x4fb6e a_174 100 defaultConversion283 0 65535 BIT_MASK 0xffffffff /end CHARACTERISTIC
/begin CHARACTERISTIC ID_ECU_SAM_TIME1C76D "" VALUE 0x4fb70 a_174 100 defaultConversion284 0 65535 BIT_MASK 0xffffffff /end CHARACTERISTIC
/begin CHARACTERISTIC ID_ECU_SAM_TIME1C77D "" VALUE 0x4fb72 a_174 100 defaultConversion285 0 65535 BIT_MASK 0xffffffff /end CHARACTERISTIC
/begin CHARACTERISTIC ID_ECU_SAM_TIME1C78D "" VALUE 0x4fb74 a_174 100 defaultConversion286 0 65535 BIT_MASK 0xffffffff /end CHARACTERISTIC
/begin CHARACTERISTIC ID_ECU_SAM_TIME1C79D "" VALUE 0x4fb76 a_174 100 defaultConversion287 0 65535 BIT_MASK 0xffffffff /end CHARACTERISTIC
/begin CHARACTERISTIC ID_ECU_SAM_TIME1C80D "" VALUE 0x4fb78 a_174 100 defaultConversion288 0 65535 BIT_MASK 0xffffffff /end CHARACTERISTIC
/begin CHARACTERISTIC ID_ECU_SAM_TIME1C81D "" VALUE 0x4fb7a a_174 100 defaultConversion289 0 65535 BIT_MASK 0xffffffff /end CHARACTERISTIC
/begin CHARACTERISTIC ID_ECU_SAM_TIME1C82D "" VALUE 0x4fb7c a_174 100 defaultConversion290 0 65535 BIT_MASK 0xffffffff /end CHARACTERISTIC
/begin CHARACTERISTIC ID_ECU_SAM_TIME1C83D "" VALUE 0x4fb7e a_174 100 defaultConversion291 0 65535 BIT_MASK 0xffffffff /end CHARACTERISTIC
/begin CHARACTERISTIC ID_ECU_SAM_TIME1C84D "" VALUE 0x4fb80 a_174 100 defaultConversion292 0 65535 BIT_MASK 0xffffffff /end CHARACTERISTIC
/begin CHARACTERISTIC ID_ECU_SAM_TIME1C85D "" VALUE 0x4fb82 a_174 100 defaultConversion293 0 65535 BIT_MASK 0xffffffff /end CHARACTERISTIC
/begin CHARACTERISTIC ID_ECU_SAM_TIME1C86D "" VALUE 0x4fb84 a_174 100 defaultConversion294 0 65535 BIT_MASK 0xffffffff /end CHARACTERISTIC
/begin CHARACTERISTIC ID_ECU_SAM_TIME1C87D "" VALUE 0x4fb86 a_174 100 defaultConversion295 0 65535 BIT_MASK 0xffffffff /end CHARACTERISTIC
/begin CHARACTERISTIC ID_ECU_SAM_TIME1C88D "" VALUE 0x4fb88 a_174 100 defaultConversion296 0 65535 BIT_MASK 0xffffffff /end CHARACTERISTIC
/begin CHARACTERISTIC ID_ECU_SAM_TIME1C89D "" VALUE 0x4fb8a a_174 100 defaultConversion297 0 65535 BIT_MASK 0xffffffff /end CHARACTERISTIC
/begin CHARACTERISTIC ID_ECU_SAM_TIME1C90D "" VALUE 0x4fb8c a_174 100 defaultConversion298 0 65535 BIT_MASK 0xffffffff /end CHARACTERISTIC
/begin CHARACTERISTIC ID_ECU_SAM_TIME1C91D "" VALUE 0x4fb8e a_174 100 defaultConversion299 0 65535 BIT_MASK 0xffffffff /end CHARACTERISTIC
/begin CHARACTERISTIC ID_ECU_SAM_TIME1C92D "" VALUE 0x4fb90 a_174 100 defaultConversion300 0 65535 BIT_MASK 0xffffffff /end CHARACTERISTIC
/begin CHARACTERISTIC ID_ECU_SAM_TIME1C93D "" VALUE 0x4fb92 a_174 100 defaultConversion301 0 65535 BIT_MASK 0xffffffff /end CHARACTERISTIC
/begin CHARACTERISTIC ID_ECU_SAM_TIME1C94D "" VALUE 0x4fb94 a_174 100 defaultConversion302 0 65535 BIT_MASK 0xffffffff /end CHARACTERISTIC
/begin CHARACTERISTIC ID_ECU_SAM_TIME1C95D "" VALUE 0x4fb96 a_174 100 defaultConversion303 0 65535 BIT_MASK 0xffffffff /end CHARACTERISTIC
/begin CHARACTERISTIC ID_ECU_SAM_TIME1C96D "" VALUE 0x4fb98 a_174 100 defaultConversion304 0 65535 BIT_MASK 0xffffffff /end CHARACTERISTIC
/begin CHARACTERISTIC ID_ECU_SAM_TIME1C97D "" VALUE 0x4fb9a a_174 100 defaultConversion305 0 65535 BIT_MASK 0xffffffff /end CHARACTERISTIC
/begin CHARACTERISTIC ID_ECU_SAM_TIME1C98D "" VALUE 0x4fb9c a_174 100 defaultConversion306 0 65535 BIT_MASK 0xffffffff /end CHARACTERISTIC
/begin CHARACTERISTIC ID_ECU_SAM_TIME1C99D "" VALUE 0x4fb9e a_174 100 defaultConversion307 0 65535 BIT_MASK 0xffffffff /end CHARACTERISTIC
/begin CHARACTERISTIC ID_ECU_SAM_TIME1C100D "" VALUE 0x4fba0 a_174 100 defaultConversion308 0 65535 BIT_MASK 0xffffffff /end CHARACTERISTIC
/begin CHARACTERISTIC ID_ECU_SAM_TIME1C101D "" VALUE 0x4fba2 a_174 100 defaultConversion309 0 65535 BIT_MASK 0xffffffff /end CHARACTERISTIC
/begin CHARACTERISTIC ID_ECU_SAM_TIME1C102D "" VALUE 0x4fba4 a_174 100 defaultConversion310 0 65535 BIT_MASK 0xffffffff /end CHARACTERISTIC
/begin CHARACTERISTIC ID_ECU_SAM_TIME1C103D "" VALUE 0x4fba6 a_174 100 defaultConversion311 0 65535 BIT_MASK 0xffffffff /end CHARACTERISTIC
/begin CHARACTERISTIC ID_ECU_SAM_TIME1C104D "" VALUE 0x4fba8 a_174 100 defaultConversion312 0 65535 BIT_MASK 0xffffffff /end CHARACTERISTIC
/begin CHARACTERISTIC ID_ECU_SAM_TIME1C105D "" VALUE 0x4fbaa a_174 100 defaultConversion313 0 65535 BIT_MASK 0xffffffff /end CHARACTERISTIC
/begin CHARACTERISTIC ID_ECU_SAM_TIME1C106D "" VALUE 0x4fbac a_174 100 defaultConversion314 0 65535 BIT_MASK 0xffffffff /end CHARACTERISTIC
/begin CHARACTERISTIC ID_ECU_SAM_TIME1C107D "" VALUE 0x4fbae a_174 100 defaultConversion315 0 65535 BIT_MASK 0xffffffff /end CHARACTERISTIC
/begin CHARACTERISTIC ID_ECU_SAM_TIME1C108D "" VALUE 0x4fbb0 a_174 100 defaultConversion316 0 65535 BIT_MASK 0xffffffff /end CHARACTERISTIC
/begin CHARACTERISTIC ID_ECU_SAM_TIME1C109D "" VALUE 0x4fbb2 a_174 100 defaultConversion317 0 65535 BIT_MASK 0xffffffff /end CHARACTERISTIC
/begin CHARACTERISTIC ID_ECU_SAM_TIME1C110D "" VALUE 0x4fbb4 a_174 100 defaultConversion318 0 65535 BIT_MASK 0xffffffff /end CHARACTERISTIC
/begin CHARACTERISTIC ID_ECU_SAM_TIME1C111D "" VALUE 0x4fbb6 a_174 100 defaultConversion319 0 65535 BIT_MASK 0xffffffff /end CHARACTERISTIC
/begin CHARACTERISTIC ID_ECU_SAM_TIME1C112D "" VALUE 0x4fbb8 a_174 100 defaultConversion320 0 65535 BIT_MASK 0xffffffff /end CHARACTERISTIC
/begin CHARACTERISTIC ID_ECU_SAM_TIME1C113D "" VALUE 0x4fbba a_174 100 defaultConversion321 0 65535 BIT_MASK 0xffffffff /end CHARACTERISTIC
/begin CHARACTERISTIC ID_ECU_SAM_TIME1C114D "" VALUE 0x4fbbc a_174 100 defaultConversion322 0 65535 BIT_MASK 0xffffffff /end CHARACTERISTIC
/begin CHARACTERISTIC ID_ECU_SAM_TIME1C115D "" VALUE 0x4fbbe a_174 100 defaultConversion323 0 65535 BIT_MASK 0xffffffff /end CHARACTERISTIC
/begin CHARACTERISTIC ID_ECU_SAM_TIME1C116D "" VALUE 0x4fbc0 a_174 100 defaultConversion324 0 65535 BIT_MASK 0xffffffff /end CHARACTERISTIC
/begin CHARACTERISTIC ID_ECU_SAM_TIME1C117D "" VALUE 0x4fbc2 a_174 100 defaultConversion325 0 65535 BIT_MASK 0xffffffff /end CHARACTERISTIC
/begin CHARACTERISTIC ID_ECU_SAM_TIME1C118D "" VALUE 0x4fbc4 a_174 100 defaultConversion326 0 65535 BIT_MASK 0xffffffff /end CHARACTERISTIC
/begin CHARACTERISTIC ID_ECU_SAM_TIME1C119D "" VALUE 0x4fbc6 a_174 100 defaultConversion327 0 65535 BIT_MASK 0xffffffff /end CHARACTERISTIC
/begin CHARACTERISTIC ID_ECU_SAM_TIME1C120D "" VALUE 0x4fbc8 a_174 100 defaultConversion328 0 65535 BIT_MASK 0xffffffff /end CHARACTERISTIC
/begin CHARACTERISTIC ID_ECU_SAM_TIME1C121D "" VALUE 0x4fbca a_174 100 defaultConversion329 0 65535 BIT_MASK 0xffffffff /end CHARACTERISTIC
/begin CHARACTERISTIC ID_ECU_SAM_TIME1C122D "" VALUE 0x4fbcc a_174 100 defaultConversion330 0 65535 BIT_MASK 0xffffffff /end CHARACTERISTIC
/begin CHARACTERISTIC ID_ECU_SAM_TIME1C123D "" VALUE 0x4fbce a_174 100 defaultConversion331 0 65535 BIT_MASK 0xffffffff /end CHARACTERISTIC
/begin CHARACTERISTIC ID_ECU_SAM_TIME1C124D "" VALUE 0x4fbd0 a_174 100 defaultConversion332 0 65535 BIT_MASK 0xffffffff /end CHARACTERISTIC
/begin CHARACTERISTIC ID_ECU_SAM_TIME1C125D "" VALUE 0x4fbd2 a_174 100 defaultConversion333 0 65535 BIT_MASK 0xffffffff /end CHARACTERISTIC
/begin CHARACTERISTIC ID_ECU_SAM_TIME1C126D "" VALUE 0x4fbd4 a_174 100 defaultConversion334 0 65535 BIT_MASK 0xffffffff /end CHARACTERISTIC
/begin CHARACTERISTIC ID_ECU_SAM_TIME1C127D "" VALUE 0x4fbd6 a_174 100 defaultConversion335 0 65535 BIT_MASK 0xffffffff /end CHARACTERISTIC
/begin CHARACTERISTIC ID_ECU_SAM_TIME1C128D "" VALUE 0x4fbd8 a_174 100 defaultConversion336 0 65535 BIT_MASK 0xffffffff /end CHARACTERISTIC
/begin CHARACTERISTIC ID_ECU_SAM_TIME1C129D "" VALUE 0x4fbda a_174 100 defaultConversion337 0 65535 BIT_MASK 0xffffffff /end CHARACTERISTIC
/begin CHARACTERISTIC ID_ECU_SAM_TIME1C130D "" VALUE 0x4fbdc a_174 100 defaultConversion338 0 65535 BIT_MASK 0xffffffff /end CHARACTERISTIC
/begin CHARACTERISTIC ID_ECU_SAM_TIME1C131D "" VALUE 0x4fbde a_174 100 defaultConversion339 0 65535 BIT_MASK 0xffffffff /end CHARACTERISTIC
/begin CHARACTERISTIC ID_ECU_SAM_TIME1C132D "" VALUE 0x4fbe0 a_174 100 defaultConversion340 0 65535 BIT_MASK 0xffffffff /end CHARACTERISTIC
/begin CHARACTERISTIC ID_ECU_SAM_TIME1C133D "" VALUE 0x4fbe2 a_174 100 defaultConversion341 0 65535 BIT_MASK 0xffffffff /end CHARACTERISTIC
/begin CHARACTERISTIC ID_ECU_SAM_TIME1C134D "" VALUE 0x4fbe4 a_174 100 defaultConversion342 0 65535 BIT_MASK 0xffffffff /end CHARACTERISTIC
/begin CHARACTERISTIC ID_ECU_SAM_TIME1C135D "" VALUE 0x4fbe6 a_174 100 defaultConversion343 0 65535 BIT_MASK 0xffffffff /end CHARACTERISTIC
/begin CHARACTERISTIC ID_ECU_SAM_TIME1C136D "" VALUE 0x4fbe8 a_174 100 defaultConversion344 0 65535 BIT_MASK 0xffffffff /end CHARACTERISTIC
/begin CHARACTERISTIC ID_ECU_SAM_TIME1C137D "" VALUE 0x4fbea a_174 100 defaultConversion345 0 65535 BIT_MASK 0xffffffff /end CHARACTERISTIC
/begin CHARACTERISTIC ID_ECU_SAM_TIME1C138D "" VALUE 0x4fbec a_174 100 defaultConversion346 0 65535 BIT_MASK 0xffffffff /end CHARACTERISTIC
/begin CHARACTERISTIC ID_ECU_SAM_TIME1C139D "" VALUE 0x4fbee a_174 100 defaultConversion347 0 65535 BIT_MASK 0xffffffff /end CHARACTERISTIC
/begin CHARACTERISTIC ID_ECU_SAM_TIME1C140D "" VALUE 0x4fbf0 a_174 100 defaultConversion348 0 65535 BIT_MASK 0xffffffff /end CHARACTERISTIC
/begin CHARACTERISTIC ID_ECU_SAM_TIME1C141D "" VALUE 0x4fbf2 a_174 100 defaultConversion349 0 65535 BIT_MASK 0xffffffff /end CHARACTERISTIC
/begin CHARACTERISTIC ID_ECU_SAM_TIME1C142D "" VALUE 0x4fbf4 a_174 100 defaultConversion350 0 65535 BIT_MASK 0xffffffff /end CHARACTERISTIC
/begin CHARACTERISTIC ID_ECU_SAM_TIME1C143D "" VALUE 0x4fbf6 a_174 100 defaultConversion351 0 65535 BIT_MASK 0xffffffff /end CHARACTERISTIC
/begin CHARACTERISTIC ID_ECU_SAM_TIME1C144D "" VALUE 0x4fbf8 a_174 100 defaultConversion352 0 65535 BIT_MASK 0xffffffff /end CHARACTERISTIC
/begin CHARACTERISTIC ID_ECU_SAM_TIME1C145D "" VALUE 0x4fbfa a_174 100 defaultConversion353 0 65535 BIT_MASK 0xffffffff /end CHARACTERISTIC
/begin CHARACTERISTIC ID_ECU_SAM_TIME1C146D "" VALUE 0x4fbfc a_174 100 defaultConversion354 0 65535 BIT_MASK 0xffffffff /end CHARACTERISTIC
/begin CHARACTERISTIC ID_ECU_SAM_TIME1C147D "" VALUE 0x4fbfe a_174 100 defaultConversion355 0 65535 BIT_MASK 0xffffffff /end CHARACTERISTIC
/begin CHARACTERISTIC ID_ECU_SAM_TIME1C148D "" VALUE 0x4fc00 a_174 100 defaultConversion356 0 65535 BIT_MASK 0xffffffff /end CHARACTERISTIC
/begin CHARACTERISTIC ID_ECU_SAM_TIME1C149D "" VALUE 0x4fc02 a_174 100 defaultConversion357 0 65535 BIT_MASK 0xffffffff /end CHARACTERISTIC
/begin CHARACTERISTIC ID_ECU_SAM_TIME1C150D "" VALUE 0x4fc04 a_174 100 defaultConversion358 0 65535 BIT_MASK 0xffffffff /end CHARACTERISTIC
/begin CHARACTERISTIC ID_ECU_SAM_TIME1C151D "" VALUE 0x4fc06 a_174 100 defaultConversion359 0 65535 BIT_MASK 0xffffffff /end CHARACTERISTIC
/begin CHARACTERISTIC ID_ECU_SAM_TIME1C152D "" VALUE 0x4fc08 a_174 100 defaultConversion360 0 65535 BIT_MASK 0xffffffff /end CHARACTERISTIC
/begin CHARACTERISTIC ID_ECU_SAM_TIME1C153D "" VALUE 0x4fc0a a_174 100 defaultConversion361 0 65535 BIT_MASK 0xffffffff /end CHARACTERISTIC
/begin CHARACTERISTIC ID_ECU_SAM_TIME1C154D "" VALUE 0x4fc0c a_174 100 defaultConversion362 0 65535 BIT_MASK 0xffffffff /end CHARACTERISTIC
/begin CHARACTERISTIC ID_ECU_SAM_TIME1C155D "" VALUE 0x4fc0e a_174 100 defaultConversion363 0 65535 BIT_MASK 0xffffffff /end CHARACTERISTIC
/begin CHARACTERISTIC ID_ECU_SAM_TIME1C156D "" VALUE 0x4fc10 a_174 100 defaultConversion364 0 65535 BIT_MASK 0xffffffff /end CHARACTERISTIC
/begin CHARACTERISTIC ID_ECU_SAM_TIME1C157D "" VALUE 0x4fc12 a_174 100 defaultConversion365 0 65535 BIT_MASK 0xffffffff /end CHARACTERISTIC
/begin CHARACTERISTIC ID_ECU_SAM_TIME1C158D "" VALUE 0x4fc14 a_174 100 defaultConversion366 0 65535 BIT_MASK 0xffffffff /end CHARACTERISTIC
/begin CHARACTERISTIC ID_ECU_SAM_TIME1C159D "" VALUE 0x4fc16 a_174 100 defaultConversion367 0 65535 BIT_MASK 0xffffffff /end CHARACTERISTIC
/begin CHARACTERISTIC ID_ECU_SAM_TIME1C160D "" VALUE 0x4fc18 a_174 100 defaultConversion368 0 65535 BIT_MASK 0xffffffff /end CHARACTERISTIC
/begin CHARACTERISTIC ID_ECU_SAM_TIME1C161D "" VALUE 0x4fc1a a_174 100 defaultConversion369 0 65535 BIT_MASK 0xffffffff /end CHARACTERISTIC
/begin CHARACTERISTIC ID_ECU_SAM_TIME1C162D "" VALUE 0x4fc1c a_174 100 defaultConversion370 0 65535 BIT_MASK 0xffffffff /end CHARACTERISTIC
/begin CHARACTERISTIC ID_ECU_SAM_TIME1C163D "" VALUE 0x4fc1e a_174 100 defaultConversion371 0 65535 BIT_MASK 0xffffffff /end CHARACTERISTIC
/begin CHARACTERISTIC ID_ECU_SAM_TIME1C164D "" VALUE 0x4fc20 a_174 100 defaultConversion372 0 65535 BIT_MASK 0xffffffff /end CHARACTERISTIC
/begin CHARACTERISTIC ID_ECU_SAM_TIME1C165D "" VALUE 0x4fc22 a_174 100 defaultConversion373 0 65535 BIT_MASK 0xffffffff /end CHARACTERISTIC
/begin CHARACTERISTIC ID_ECU_SAM_TIME1C166D "" VALUE 0x4fc24 a_174 100 defaultConversion374 0 65535 BIT_MASK 0xffffffff /end CHARACTERISTIC
/begin CHARACTERISTIC ID_ECU_SAM_TIME1C167D "" VALUE 0x4fc26 a_174 100 defaultConversion375 0 65535 BIT_MASK 0xffffffff /end CHARACTERISTIC
/begin CHARACTERISTIC ID_ECU_SAM_TIME1C168D "" VALUE 0x4fc28 a_174 100 defaultConversion376 0 65535 BIT_MASK 0xffffffff /end CHARACTERISTIC
/begin CHARACTERISTIC ID_ECU_SAM_TIME1C169D "" VALUE 0x4fc2a a_174 100 defaultConversion377 0 65535 BIT_MASK 0xffffffff /end CHARACTERISTIC
/begin CHARACTERISTIC ID_ECU_SAM_TIME1C170D "" VALUE 0x4fc2c a_174 100 defaultConversion378 0 65535 BIT_MASK 0xffffffff /end CHARACTERISTIC
/begin CHARACTERISTIC ID_ECU_SAM_TIME1C171D "" VALUE 0x4fc2e a_174 100 defaultConversion379 0 65535 BIT_MASK 0xffffffff /end CHARACTERISTIC
/begin CHARACTERISTIC ID_ECU_SAM_TIME1C172D "" VALUE 0x4fc30 a_174 100 defaultConversion380 0 65535 BIT_MASK 0xffffffff /end CHARACTERISTIC
/begin CHARACTERISTIC ID_ECU_SAM_TIME1C173D "" VALUE 0x4fc32 a_174 100 defaultConversion381 0 65535 BIT_MASK 0xffffffff /end CHARACTERISTIC
/begin CHARACTERISTIC ID_ECU_SAM_TIME1C174D "" VALUE 0x4fc34 a_174 100 defaultConversion382 0 65535 BIT_MASK 0xffffffff /end CHARACTERISTIC
/begin CHARACTERISTIC ID_ECU_SAM_TIME1C175D "" VALUE 0x4fc36 a_174 100 defaultConversion383 0 65535 BIT_MASK 0xffffffff /end CHARACTERISTIC
/begin CHARACTERISTIC ID_ECU_SAM_TIME1C176D "" VALUE 0x4fc38 a_174 100 defaultConversion384 0 65535 BIT_MASK 0xffffffff /end CHARACTERISTIC
/begin CHARACTERISTIC ID_ECU_SAM_TIME1C177D "" VALUE 0x4fc3a a_174 100 defaultConversion385 0 65535 BIT_MASK 0xffffffff /end CHARACTERISTIC
/begin CHARACTERISTIC ID_ECU_SAM_TIME1C178D "" VALUE 0x4fc3c a_174 100 defaultConversion386 0 65535 BIT_MASK 0xffffffff /end CHARACTERISTIC
/begin CHARACTERISTIC ID_ECU_SAM_TIME1C179D "" VALUE 0x4fc3e a_174 100 defaultConversion387 0 65535 BIT_MASK 0xffffffff /end CHARACTERISTIC
/begin CHARACTERISTIC ID_ECU_SAM_TIME1C180D "" VALUE 0x4fc40 a_174 100 defaultConversion388 0 65535 BIT_MASK 0xffffffff /end CHARACTERISTIC
/begin CHARACTERISTIC ID_ECU_SAM_TIME1C181D "" VALUE 0x4fc42 a_174 100 defaultConversion389 0 65535 BIT_MASK 0xffffffff /end CHARACTERISTIC
/begin CHARACTERISTIC ID_ECU_SAM_TIME1C182D "" VALUE 0x4fc44 a_174 100 defaultConversion390 0 65535 BIT_MASK 0xffffffff /end CHARACTERISTIC
/begin CHARACTERISTIC ID_ECU_SAM_TIME1C183D "" VALUE 0x4fc46 a_174 100 defaultConversion391 0 65535 BIT_MASK 0xffffffff /end CHARACTERISTIC
/begin CHARACTERISTIC ID_ECU_SAM_TIME1C184D "" VALUE 0x4fc48 a_174 100 defaultConversion392 0 65535 BIT_MASK 0xffffffff /end CHARACTERISTIC
/begin CHARACTERISTIC ID_ECU_SAM_TIME1C185D "" VALUE 0x4fc4a a_174 100 defaultConversion393 0 65535 BIT_MASK 0xffffffff /end CHARACTERISTIC
/begin CHARACTERISTIC ID_ECU_SAM_TIME1C186D "" VALUE 0x4fc4c a_174 100 defaultConversion394 0 65535 BIT_MASK 0xffffffff /end CHARACTERISTIC
/begin CHARACTERISTIC ID_ECU_SAM_TIME1C187D "" VALUE 0x4fc4e a_174 100 defaultConversion395 0 65535 BIT_MASK 0xffffffff /end CHARACTERISTIC
/begin CHARACTERISTIC ID_ECU_SAM_TIME1C188D "" VALUE 0x4fc50 a_174 100 defaultConversion396 0 65535 BIT_MASK 0xffffffff /end CHARACTERISTIC
/begin CHARACTERISTIC ID_ECU_SAM_TIME1C189D "" VALUE 0x4fc52 a_174 100 defaultConversion397 0 65535 BIT_MASK 0xffffffff /end CHARACTERISTIC
/begin CHARACTERISTIC ID_ECU_SAM_TIME1C190D "" VALUE 0x4fc54 a_174 100 defaultConversion398 0 65535 BIT_MASK 0xffffffff /end CHARACTERISTIC
/begin CHARACTERISTIC ID_ECU_SAM_TIME1C191D "" VALUE 0x4fc56 a_174 100 defaultConversion399 0 65535 BIT_MASK 0xffffffff /end CHARACTERISTIC
/begin CHARACTERISTIC ID_ECU_SAM_TIME1C192D "" VALUE 0x4fc58 a_174 100 defaultConversion400 0 65535 BIT_MASK 0xffffffff /end CHARACTERISTIC
/begin CHARACTERISTIC ID_ECU_SAM_TIME1C193D "" VALUE 0x4fc5a a_174 100 defaultConversion401 0 65535 BIT_MASK 0xffffffff /end CHARACTERISTIC
/begin CHARACTERISTIC ID_ECU_SAM_TIME1C194D "" VALUE 0x4fc5c a_174 100 defaultConversion402 0 65535 BIT_MASK 0xffffffff /end CHARACTERISTIC
/begin CHARACTERISTIC ID_ECU_SAM_TIME1C195D "" VALUE 0x4fc5e a_174 100 defaultConversion403 0 65535 BIT_MASK 0xffffffff /end CHARACTERISTIC
/begin CHARACTERISTIC ID_ECU_SAM_TIME1C196D "" VALUE 0x4fc60 a_174 100 defaultConversion404 0 65535 BIT_MASK 0xffffffff /end CHARACTERISTIC
/begin CHARACTERISTIC ID_ECU_SAM_TIME1C197D "" VALUE 0x4fc62 a_174 100 defaultConversion405 0 65535 BIT_MASK 0xffffffff /end CHARACTERISTIC
/begin CHARACTERISTIC ID_ECU_SAM_TIME1C198D "" VALUE 0x4fc64 a_174 100 defaultConversion406 0 65535 BIT_MASK 0xffffffff /end CHARACTERISTIC
/begin CHARACTERISTIC ID_ECU_SAM_TIME1C199D "" VALUE 0x4fc66 a_174 100 defaultConversion407 0 65535 BIT_MASK 0xffffffff /end CHARACTERISTIC
/begin CHARACTERISTIC ID_ECU_SAM_TIME1C200D "" VALUE 0x4fc68 a_174 100 defaultConversion408 0 65535 BIT_MASK 0xffffffff /end CHARACTERISTIC
/begin CHARACTERISTIC ID_ECU_SAM_TIME1C201D "" VALUE 0x4fc6a a_174 100 defaultConversion409 0 65535 BIT_MASK 0xffffffff /end CHARACTERISTIC
/begin CHARACTERISTIC ID_ECU_SAM_TIME1C202D "" VALUE 0x4fc6c a_174 100 defaultConversion410 0 65535 BIT_MASK 0xffffffff /end CHARACTERISTIC
/begin CHARACTERISTIC ID_ECU_SAM_TIME1C203D "" VALUE 0x4fc6e a_174 100 defaultConversion411 0 65535 BIT_MASK 0xffffffff /end CHARACTERISTIC
/begin CHARACTERISTIC ID_ECU_SAM_TIME1C204D "" VALUE 0x4fc70 a_174 100 defaultConversion412 0 65535 BIT_MASK 0xffffffff /end CHARACTERISTIC
/begin CHARACTERISTIC ID_ECU_SAM_TIME1C205D "" VALUE 0x4fc72 a_174 100 defaultConversion413 0 65535 BIT_MASK 0xffffffff /end CHARACTERISTIC
/begin CHARACTERISTIC ID_ECU_SAM_TIME1C206D "" VALUE 0x4fc74 a_174 100 defaultConversion414 0 65535 BIT_MASK 0xffffffff /end CHARACTERISTIC
/begin CHARACTERISTIC ID_ECU_SAM_TIME1C207D "" VALUE 0x4fc76 a_174 100 defaultConversion415 0 65535 BIT_MASK 0xffffffff /end CHARACTERISTIC
/begin CHARACTERISTIC ID_ECU_SAM_TIME1C208D "" VALUE 0x4fc78 a_174 100 defaultConversion416 0 65535 BIT_MASK 0xffffffff /end CHARACTERISTIC
/begin CHARACTERISTIC ID_ECU_SAM_TIME1C209D "" VALUE 0x4fc7a a_174 100 defaultConversion417 0 65535 BIT_MASK 0xffffffff /end CHARACTERISTIC
/begin CHARACTERISTIC ID_ECU_SAM_TIME1C210D "" VALUE 0x4fc7c a_174 100 defaultConversion418 0 65535 BIT_MASK 0xffffffff /end CHARACTERISTIC
/begin CHARACTERISTIC ID_ECU_SAM_TIME1C211D "" VALUE 0x4fc7e a_174 100 defaultConversion419 0 65535 BIT_MASK 0xffffffff /end CHARACTERISTIC
/begin CHARACTERISTIC ID_ECU_SAM_TIME1C212D "" VALUE 0x4fc80 a_174 100 defaultConversion420 0 65535 BIT_MASK 0xffffffff /end CHARACTERISTIC
/begin CHARACTERISTIC ID_ECU_SAM_TIME1C213D "" VALUE 0x4fc82 a_174 100 defaultConversion421 0 65535 BIT_MASK 0xffffffff /end CHARACTERISTIC
/begin CHARACTERISTIC ID_ECU_SAM_TIME1C214D "" VALUE 0x4fc84 a_174 100 defaultConversion422 0 65535 BIT_MASK 0xffffffff /end CHARACTERISTIC
/begin CHARACTERISTIC ID_ECU_SAM_TIME1C215D "" VALUE 0x4fc86 a_174 100 defaultConversion423 0 65535 BIT_MASK 0xffffffff /end CHARACTERISTIC
/begin CHARACTERISTIC ID_ECU_SAM_TIME1C216D "" VALUE 0x4fc88 a_174 100 defaultConversion424 0 65535 BIT_MASK 0xffffffff /end CHARACTERISTIC
/begin CHARACTERISTIC ID_ECU_SAM_TIME1C217D "" VALUE 0x4fc8a a_174 100 defaultConversion425 0 65535 BIT_MASK 0xffffffff /end CHARACTERISTIC
/begin CHARACTERISTIC ID_ECU_SAM_TIME1C218D "" VALUE 0x4fc8c a_174 100 defaultConversion426 0 65535 BIT_MASK 0xffffffff /end CHARACTERISTIC
/begin CHARACTERISTIC ID_ECU_SAM_TIME1C219D "" VALUE 0x4fc8e a_174 100 defaultConversion427 0 65535 BIT_MASK 0xffffffff /end CHARACTERISTIC
/begin CHARACTERISTIC ID_ECU_SAM_TIME1C220D "" VALUE 0x4fc90 a_174 100 defaultConversion428 0 65535 BIT_MASK 0xffffffff /end CHARACTERISTIC
/begin CHARACTERISTIC ID_ECU_SAM_TIME1C221D "" VALUE 0x4fc92 a_174 100 defaultConversion429 0 65535 BIT_MASK 0xffffffff /end CHARACTERISTIC
/begin CHARACTERISTIC ID_ECU_SAM_TIME1C222D "" VALUE 0x4fc94 a_174 100 defaultConversion430 0 65535 BIT_MASK 0xffffffff /end CHARACTERISTIC
/begin CHARACTERISTIC ID_ECU_SAM_TIME1C223D "" VALUE 0x4fc96 a_174 100 defaultConversion431 0 65535 BIT_MASK 0xffffffff /end CHARACTERISTIC
/begin CHARACTERISTIC ID_ECU_SAM_TIME1C224D "" VALUE 0x4fc98 a_174 100 defaultConversion432 0 65535 BIT_MASK 0xffffffff /end CHARACTERISTIC
/begin CHARACTERISTIC ID_ECU_SAM_TIME1C225D "" VALUE 0x4fc9a a_174 100 defaultConversion433 0 65535 BIT_MASK 0xffffffff /end CHARACTERISTIC
/begin CHARACTERISTIC ID_ECU_SAM_TIME1C226D "" VALUE 0x4fc9c a_174 100 defaultConversion434 0 65535 BIT_MASK 0xffffffff /end CHARACTERISTIC
/begin CHARACTERISTIC ID_ECU_SAM_TIME1C227D "" VALUE 0x4fc9e a_174 100 defaultConversion435 0 65535 BIT_MASK 0xffffffff /end CHARACTERISTIC
/begin CHARACTERISTIC ID_ECU_SAM_TIME1C228D "" VALUE 0x4fca0 a_174 100 defaultConversion436 0 65535 BIT_MASK 0xffffffff /end CHARACTERISTIC
/begin CHARACTERISTIC ID_ECU_SAM_TIME1C229D "" VALUE 0x4fca2 a_174 100 defaultConversion437 0 65535 BIT_MASK 0xffffffff /end CHARACTERISTIC
/begin CHARACTERISTIC ID_ECU_SAM_TIME1C230D "" VALUE 0x4fca4 a_174 100 defaultConversion438 0 65535 BIT_MASK 0xffffffff /end CHARACTERISTIC
/begin CHARACTERISTIC ID_ECU_SAM_TIME1C231D "" VALUE 0x4fca6 a_174 100 defaultConversion439 0 65535 BIT_MASK 0xffffffff /end CHARACTERISTIC
/begin CHARACTERISTIC ID_ECU_SAM_TIME1C232D "" VALUE 0x4fca8 a_174 100 defaultConversion440 0 65535 BIT_MASK 0xffffffff /end CHARACTERISTIC
/begin CHARACTERISTIC ID_ECU_SAM_TIME1C233D "" VALUE 0x4fcaa a_174 100 defaultConversion441 0 65535 BIT_MASK 0xffffffff /end CHARACTERISTIC
/begin CHARACTERISTIC ID_ECU_SAM_TIME1C234D "" VALUE 0x4fcac a_174 100 defaultConversion442 0 65535 BIT_MASK 0xffffffff /end CHARACTERISTIC
/begin CHARACTERISTIC ID_ECU_SAM_TIME1C235D "" VALUE 0x4fcae a_174 100 defaultConversion443 0 65535 BIT_MASK 0xffffffff /end CHARACTERISTIC
/begin CHARACTERISTIC ID_ECU_SAM_TIME1C236D "" VALUE 0x4fcb0 a_174 100 defaultConversion444 0 65535 BIT_MASK 0xffffffff /end CHARACTERISTIC
/begin CHARACTERISTIC ID_ECU_SAM_TIME1C237D "" VALUE 0x4fcb2 a_174 100 defaultConversion445 0 65535 BIT_MASK 0xffffffff /end CHARACTERISTIC
/begin CHARACTERISTIC ID_ECU_SAM_TIME1C238D "" VALUE 0x4fcb4 a_174 100 defaultConversion446 0 65535 BIT_MASK 0xffffffff /end CHARACTERISTIC
/begin CHARACTERISTIC ID_ECU_SAM_TIME1C239D "" VALUE 0x4fcb6 a_174 100 defaultConversion447 0 65535 BIT_MASK 0xffffffff /end CHARACTERISTIC
/begin CHARACTERISTIC ID_ECU_SAM_TIME1C240D "" VALUE 0x4fcb8 a_174 100 defaultConversion448 0 65535 BIT_MASK 0xffffffff /end CHARACTERISTIC
/begin CHARACTERISTIC ID_ECU_SAM_TIME1C241D "" VALUE 0x4fcba a_174 100 defaultConversion449 0 65535 BIT_MASK 0xffffffff /end CHARACTERISTIC
/begin CHARACTERISTIC ID_ECU_SAM_TIME1C242D "" VALUE 0x4fcbc a_174 100 defaultConversion450 0 65535 BIT_MASK 0xffffffff /end CHARACTERISTIC
/begin CHARACTERISTIC ID_ECU_SAM_TIME1C243D "" VALUE 0x4fcbe a_174 100 defaultConversion451 0 65535 BIT_MASK 0xffffffff /end CHARACTERISTIC
/begin CHARACTERISTIC ID_ECU_SAM_TIME1C244D "" VALUE 0x4fcc0 a_174 100 defaultConversion452 0 65535 BIT_MASK 0xffffffff /end CHARACTERISTIC
/begin CHARACTERISTIC ID_ECU_SAM_TIME1C245D "" VALUE 0x4fcc2 a_174 100 defaultConversion453 0 65535 BIT_MASK 0xffffffff /end CHARACTERISTIC
/begin CHARACTERISTIC ID_ECU_SAM_TIME1C246D "" VALUE 0x4fcc4 a_174 100 defaultConversion454 0 65535 BIT_MASK 0xffffffff /end CHARACTERISTIC
/begin CHARACTERISTIC ID_ECU_SAM_TIME1C247D "" VALUE 0x4fcc6 a_174 100 defaultConversion455 0 65535 BIT_MASK 0xffffffff /end CHARACTERISTIC
/begin CHARACTERISTIC ID_ECU_SAM_TIME1C248D "" VALUE 0x4fcc8 a_174 100 defaultConversion456 0 65535 BIT_MASK 0xffffffff /end CHARACTERISTIC
/begin CHARACTERISTIC ID_ECU_SAM_TIME1C249D "" VALUE 0x4fcca a_174 100 defaultConversion457 0 65535 BIT_MASK 0xffffffff /end CHARACTERISTIC
/begin CHARACTERISTIC ID_ECU_SAM_TIME1C250D "" VALUE 0x4fccc a_174 100 defaultConversion458 0 65535 BIT_MASK 0xffffffff /end CHARACTERISTIC
/begin CHARACTERISTIC ID_ECU_SAM_TIME1C251D "" VALUE 0x4fcce a_174 100 defaultConversion459 0 65535 BIT_MASK 0xffffffff /end CHARACTERISTIC
/begin CHARACTERISTIC ID_ECU_SAM_TIME1C252D "" VALUE 0x4fcd0 a_174 100 defaultConversion460 0 65535 BIT_MASK 0xffffffff /end CHARACTERISTIC
/begin CHARACTERISTIC ID_ECU_SAM_TIME1C253D "" VALUE 0x4fcd2 a_174 100 defaultConversion461 0 65535 BIT_MASK 0xffffffff /end CHARACTERISTIC
/begin CHARACTERISTIC ID_ECU_SAM_TIME1C254D "" VALUE 0x4fcd4 a_174 100 defaultConversion462 0 65535 BIT_MASK 0xffffffff /end CHARACTERISTIC
/begin CHARACTERISTIC ID_ECU_SAM_TIME1C255D "" VALUE 0x4fcd6 a_174 100 defaultConversion463 0 65535 BIT_MASK 0xffffffff /end CHARACTERISTIC
/begin CHARACTERISTIC ID_ECU_SAM_TIME1C256D "" VALUE 0x4fcd8 a_174 100 defaultConversion464 0 65535 BIT_MASK 0xffffffff /end CHARACTERISTIC
/begin CHARACTERISTIC ID_ECU_SAM_TIME1C257D "" VALUE 0x4fcda a_174 100 defaultConversion465 0 65535 BIT_MASK 0xffffffff /end CHARACTERISTIC
/begin CHARACTERISTIC ID_ECU_SAM_TIME2C0D "" VALUE 0x4fcdc a_174 100 defaultConversion466 0 65535 BIT_MASK 0xffffffff /end CHARACTERISTIC
/begin CHARACTERISTIC ID_ECU_SAM_TIME2C1D "" VALUE 0x4fcde a_174 100 defaultConversion467 0 65535 BIT_MASK 0xffffffff /end CHARACTERISTIC
/begin CHARACTERISTIC ID_ECU_SAM_TIME2C2D "" VALUE 0x4fce0 a_174 100 defaultConversion468 0 65535 BIT_MASK 0xffffffff /end CHARACTERISTIC
/begin CHARACTERISTIC ID_ECU_SAM_TIME2C3D "" VALUE 0x4fce2 a_174 100 defaultConversion469 0 65535 BIT_MASK 0xffffffff /end CHARACTERISTIC
/begin CHARACTERISTIC ID_ECU_SAM_TIME2C4D "" VALUE 0x4fce4 a_174 100 defaultConversion470 0 65535 BIT_MASK 0xffffffff /end CHARACTERISTIC
/begin CHARACTERISTIC ID_ECU_SAM_TIME2C5D "" VALUE 0x4fce6 a_174 100 defaultConversion471 0 65535 BIT_MASK 0xffffffff /end CHARACTERISTIC
/begin CHARACTERISTIC ID_ECU_SAM_TIME2C6D "" VALUE 0x4fce8 a_174 100 defaultConversion472 0 65535 BIT_MASK 0xffffffff /end CHARACTERISTIC
/begin CHARACTERISTIC ID_ECU_SAM_TIME2C7D "" VALUE 0x4fcea a_174 100 defaultConversion473 0 65535 BIT_MASK 0xffffffff /end CHARACTERISTIC
/begin CHARACTERISTIC ID_ECU_SAM_TIME2C8D "" VALUE 0x4fcec a_174 100 defaultConversion474 0 65535 BIT_MASK 0xffffffff /end CHARACTERISTIC
/begin CHARACTERISTIC ID_ECU_SAM_TIME2C9D "" VALUE 0x4fcee a_174 100 defaultConversion475 0 65535 BIT_MASK 0xffffffff /end CHARACTERISTIC
/begin CHARACTERISTIC ID_ECU_SAM_TIME2C10D "" VALUE 0x4fcf0 a_174 100 defaultConversion476 0 65535 BIT_MASK 0xffffffff /end CHARACTERISTIC
/begin CHARACTERISTIC ID_ECU_SAM_TIME2C11D "" VALUE 0x4fcf2 a_174 100 defaultConversion477 0 65535 BIT_MASK 0xffffffff /end CHARACTERISTIC
/begin CHARACTERISTIC ID_ECU_SAM_TIME2C12D "" VALUE 0x4fcf4 a_174 100 defaultConversion478 0 65535 BIT_MASK 0xffffffff /end CHARACTERISTIC
/begin CHARACTERISTIC ID_ECU_SAM_TIME2C13D "" VALUE 0x4fcf6 a_174 100 defaultConversion479 0 65535 BIT_MASK 0xffffffff /end CHARACTERISTIC
/begin CHARACTERISTIC ID_ECU_SAM_TIME2C14D "" VALUE 0x4fcf8 a_174 100 defaultConversion480 0 65535 BIT_MASK 0xffffffff /end CHARACTERISTIC
/begin CHARACTERISTIC ID_ECU_SAM_TIME2C15D "" VALUE 0x4fcfa a_174 100 defaultConversion481 0 65535 BIT_MASK 0xffffffff /end CHARACTERISTIC
/begin CHARACTERISTIC ID_ECU_SAM_TIME2C16D "" VALUE 0x4fcfc a_174 100 defaultConversion482 0 65535 BIT_MASK 0xffffffff /end CHARACTERISTIC
/begin CHARACTERISTIC ID_ECU_SAM_TIME2C17D "" VALUE 0x4fcfe a_174 100 defaultConversion483 0 65535 BIT_MASK 0xffffffff /end CHARACTERISTIC
/begin CHARACTERISTIC ID_ECU_SAM_TIME2C18D "" VALUE 0x4fd00 a_174 100 defaultConversion484 0 65535 BIT_MASK 0xffffffff /end CHARACTERISTIC
/begin CHARACTERISTIC ID_ECU_SAM_TIME2C19D "" VALUE 0x4fd02 a_174 100 defaultConversion485 0 65535 BIT_MASK 0xffffffff /end CHARACTERISTIC
/begin CHARACTERISTIC ID_ECU_SAM_TIME2C20D "" VALUE 0x4fd04 a_174 100 defaultConversion486 0 65535 BIT_MASK 0xffffffff /end CHARACTERISTIC
/begin CHARACTERISTIC ID_ECU_SAM_TIME2C21D "" VALUE 0x4fd06 a_174 100 defaultConversion487 0 65535 BIT_MASK 0xffffffff /end CHARACTERISTIC
/begin CHARACTERISTIC ID_ECU_SAM_TIME2C22D "" VALUE 0x4fd08 a_174 100 defaultConversion488 0 65535 BIT_MASK 0xffffffff /end CHARACTERISTIC
/begin CHARACTERISTIC ID_ECU_SAM_TIME2C23D "" VALUE 0x4fd0a a_174 100 defaultConversion489 0 65535 BIT_MASK 0xffffffff /end CHARACTERISTIC
/begin CHARACTERISTIC ID_ECU_SAM_TIME2C24D "" VALUE 0x4fd0c a_174 100 defaultConversion490 0 65535 BIT_MASK 0xffffffff /end CHARACTERISTIC
/begin CHARACTERISTIC ID_ECU_SAM_TIME2C25D "" VALUE 0x4fd0e a_174 100 defaultConversion491 0 65535 BIT_MASK 0xffffffff /end CHARACTERISTIC
/begin CHARACTERISTIC ID_ECU_SAM_TIME2C26D "" VALUE 0x4fd10 a_174 100 defaultConversion492 0 65535 BIT_MASK 0xffffffff /end CHARACTERISTIC
/begin CHARACTERISTIC ID_ECU_SAM_TIME2C27D "" VALUE 0x4fd12 a_174 100 defaultConversion493 0 65535 BIT_MASK 0xffffffff /end CHARACTERISTIC
/begin CHARACTERISTIC ID_ECU_SAM_TIME2C28D "" VALUE 0x4fd14 a_174 100 defaultConversion494 0 65535 BIT_MASK 0xffffffff /end CHARACTERISTIC
/begin CHARACTERISTIC ID_ECU_SAM_TIME2C29D "" VALUE 0x4fd16 a_174 100 defaultConversion495 0 65535 BIT_MASK 0xffffffff /end CHARACTERISTIC
/begin CHARACTERISTIC ID_ECU_SAM_TIME2C30D "" VALUE 0x4fd18 a_174 100 defaultConversion496 0 65535 BIT_MASK 0xffffffff /end CHARACTERISTIC
/begin CHARACTERISTIC ID_ECU_SAM_TIME2C31D "" VALUE 0x4fd1a a_174 100 defaultConversion497 0 65535 BIT_MASK 0xffffffff /end CHARACTERISTIC
/begin CHARACTERISTIC ID_ECU_SAM_TIME2C32D "" VALUE 0x4fd1c a_174 100 defaultConversion498 0 65535 BIT_MASK 0xffffffff /end CHARACTERISTIC
/begin CHARACTERISTIC ID_ECU_SAM_TIME2C33D "" VALUE 0x4fd1e a_174 100 defaultConversion499 0 65535 BIT_MASK 0xffffffff /end CHARACTERISTIC
/begin CHARACTERISTIC ID_ECU_SAM_TIME2C34D "" VALUE 0x4fd20 a_174 100 defaultConversion500 0 65535 BIT_MASK 0xffffffff /end CHARACTERISTIC
/begin CHARACTERISTIC ID_ECU_SAM_TIME2C35D "" VALUE 0x4fd22 a_174 100 defaultConversion501 0 65535 BIT_MASK 0xffffffff /end CHARACTERISTIC
/begin CHARACTERISTIC ID_ECU_SAM_TIME2C36D "" VALUE 0x4fd24 a_174 100 defaultConversion502 0 65535 BIT_MASK 0xffffffff /end CHARACTERISTIC
/begin CHARACTERISTIC ID_ECU_SAM_TIME2C37D "" VALUE 0x4fd26 a_174 100 defaultConversion503 0 65535 BIT_MASK 0xffffffff /end CHARACTERISTIC
/begin CHARACTERISTIC ID_ECU_SAM_TIME2C38D "" VALUE 0x4fd28 a_174 100 defaultConversion504 0 65535 BIT_MASK 0xffffffff /end CHARACTERISTIC
/begin CHARACTERISTIC ID_ECU_SAM_TIME2C39D "" VALUE 0x4fd2a a_174 100 defaultConversion505 0 65535 BIT_MASK 0xffffffff /end CHARACTERISTIC
/begin CHARACTERISTIC ID_ECU_SAM_TIME2C40D "" VALUE 0x4fd2c a_174 100 defaultConversion506 0 65535 BIT_MASK 0xffffffff /end CHARACTERISTIC
/begin CHARACTERISTIC ID_ECU_SAM_TIME2C41D "" VALUE 0x4fd2e a_174 100 defaultConversion507 0 65535 BIT_MASK 0xffffffff /end CHARACTERISTIC
/begin CHARACTERISTIC ID_ECU_SAM_TIME2C42D "" VALUE 0x4fd30 a_174 100 defaultConversion508 0 65535 BIT_MASK 0xffffffff /end CHARACTERISTIC
/begin CHARACTERISTIC ID_ECU_SAM_TIME2C43D "" VALUE 0x4fd32 a_174 100 defaultConversion509 0 65535 BIT_MASK 0xffffffff /end CHARACTERISTIC
/begin CHARACTERISTIC ID_ECU_SAM_TIME2C44D "" VALUE 0x4fd34 a_174 100 defaultConversion510 0 65535 BIT_MASK 0xffffffff /end CHARACTERISTIC
/begin CHARACTERISTIC ID_ECU_SAM_TIME2C45D "" VALUE 0x4fd36 a_174 100 defaultConversion511 0 65535 BIT_MASK 0xffffffff /end CHARACTERISTIC
/begin CHARACTERISTIC ID_ECU_SAM_TIME2C46D "" VALUE 0x4fd38 a_174 100 defaultConversion512 0 65535 BIT_MASK 0xffffffff /end CHARACTERISTIC
/begin CHARACTERISTIC ID_ECU_SAM_TIME2C47D "" VALUE 0x4fd3a a_174 100 defaultConversion513 0 65535 BIT_MASK 0xffffffff /end CHARACTERISTIC
/begin CHARACTERISTIC ID_ECU_SAM_TIME2C48D "" VALUE 0x4fd3c a_174 100 defaultConversion514 0 65535 BIT_MASK 0xffffffff /end CHARACTERISTIC
/begin CHARACTERISTIC ID_ECU_SAM_TIME2C49D "" VALUE 0x4fd3e a_174 100 defaultConversion515 0 65535 BIT_MASK 0xffffffff /end CHARACTERISTIC
/begin CHARACTERISTIC ID_ECU_SAM_TIME2C50D "" VALUE 0x4fd40 a_174 100 defaultConversion516 0 65535 BIT_MASK 0xffffffff /end CHARACTERISTIC
/begin CHARACTERISTIC ID_ECU_SAM_TIME2C51D "" VALUE 0x4fd42 a_174 100 defaultConversion517 0 65535 BIT_MASK 0xffffffff /end CHARACTERISTIC
/begin CHARACTERISTIC ID_ECU_SAM_TIME2C52D "" VALUE 0x4fd44 a_174 100 defaultConversion518 0 65535 BIT_MASK 0xffffffff /end CHARACTERISTIC
/begin CHARACTERISTIC ID_ECU_SAM_TIME2C53D "" VALUE 0x4fd46 a_174 100 defaultConversion519 0 65535 BIT_MASK 0xffffffff /end CHARACTERISTIC
/begin CHARACTERISTIC ID_ECU_SAM_TIME2C54D "" VALUE 0x4fd48 a_174 100 defaultConversion520 0 65535 BIT_MASK 0xffffffff /end CHARACTERISTIC
/begin CHARACTERISTIC ID_ECU_SAM_TIME2C55D "" VALUE 0x4fd4a a_174 100 defaultConversion521 0 65535 BIT_MASK 0xffffffff /end CHARACTERISTIC
/begin CHARACTERISTIC ID_ECU_SAM_TIME2C56D "" VALUE 0x4fd4c a_174 100 defaultConversion522 0 65535 BIT_MASK 0xffffffff /end CHARACTERISTIC
/begin CHARACTERISTIC ID_ECU_SAM_TIME2C57D "" VALUE 0x4fd4e a_174 100 defaultConversion523 0 65535 BIT_MASK 0xffffffff /end CHARACTERISTIC
/begin CHARACTERISTIC ID_ECU_SAM_TIME2C58D "" VALUE 0x4fd50 a_174 100 defaultConversion524 0 65535 BIT_MASK 0xffffffff /end CHARACTERISTIC
/begin CHARACTERISTIC ID_ECU_SAM_TIME2C59D "" VALUE 0x4fd52 a_174 100 defaultConversion525 0 65535 BIT_MASK 0xffffffff /end CHARACTERISTIC
/begin CHARACTERISTIC ID_ECU_SAM_TIME2C60D "" VALUE 0x4fd54 a_174 100 defaultConversion526 0 65535 BIT_MASK 0xffffffff /end CHARACTERISTIC
/begin CHARACTERISTIC ID_ECU_SAM_TIME2C61D "" VALUE 0x4fd56 a_174 100 defaultConversion527 0 65535 BIT_MASK 0xffffffff /end CHARACTERISTIC
/begin CHARACTERISTIC ID_ECU_SAM_TIME2C62D "" VALUE 0x4fd58 a_174 100 defaultConversion528 0 65535 BIT_MASK 0xffffffff /end CHARACTERISTIC
/begin CHARACTERISTIC ID_ECU_SAM_TIME2C63D "" VALUE 0x4fd5a a_174 100 defaultConversion529 0 65535 BIT_MASK 0xffffffff /end CHARACTERISTIC
/begin CHARACTERISTIC ID_ECU_SAM_TIME2C64D "" VALUE 0x4fd5c a_174 100 defaultConversion530 0 65535 BIT_MASK 0xffffffff /end CHARACTERISTIC
/begin CHARACTERISTIC ID_ECU_SAM_TIME2C65D "" VALUE 0x4fd5e a_174 100 defaultConversion531 0 65535 BIT_MASK 0xffffffff /end CHARACTERISTIC
/begin CHARACTERISTIC ID_ECU_SAM_TIME2C66D "" VALUE 0x4fd60 a_174 100 defaultConversion532 0 65535 BIT_MASK 0xffffffff /end CHARACTERISTIC
/begin CHARACTERISTIC ID_ECU_SAM_TIME2C67D "" VALUE 0x4fd62 a_174 100 defaultConversion533 0 65535 BIT_MASK 0xffffffff /end CHARACTERISTIC
/begin CHARACTERISTIC ID_ECU_SAM_TIME2C68D "" VALUE 0x4fd64 a_174 100 defaultConversion534 0 65535 BIT_MASK 0xffffffff /end CHARACTERISTIC
/begin CHARACTERISTIC ID_ECU_SAM_TIME2C69D "" VALUE 0x4fd66 a_174 100 defaultConversion535 0 65535 BIT_MASK 0xffffffff /end CHARACTERISTIC
/begin CHARACTERISTIC ID_ECU_SAM_TIME2C70D "" VALUE 0x4fd68 a_174 100 defaultConversion536 0 65535 BIT_MASK 0xffffffff /end CHARACTERISTIC
/begin CHARACTERISTIC ID_ECU_SAM_TIME2C71D "" VALUE 0x4fd6a a_174 100 defaultConversion537 0 65535 BIT_MASK 0xffffffff /end CHARACTERISTIC
/begin CHARACTERISTIC ID_ECU_SAM_TIME2C72D "" VALUE 0x4fd6c a_174 100 defaultConversion538 0 65535 BIT_MASK 0xffffffff /end CHARACTERISTIC
/begin CHARACTERISTIC ID_ECU_SAM_TIME2C73D "" VALUE 0x4fd6e a_174 100 defaultConversion539 0 65535 BIT_MASK 0xffffffff /end CHARACTERISTIC
/begin CHARACTERISTIC ID_ECU_SAM_TIME2C74D "" VALUE 0x4fd70 a_174 100 defaultConversion540 0 65535 BIT_MASK 0xffffffff /end CHARACTERISTIC
/begin CHARACTERISTIC ID_ECU_SAM_TIME2C75D "" VALUE 0x4fd72 a_174 100 defaultConversion541 0 65535 BIT_MASK 0xffffffff /end CHARACTERISTIC
/begin CHARACTERISTIC ID_ECU_SAM_TIME2C76D "" VALUE 0x4fd74 a_174 100 defaultConversion542 0 65535 BIT_MASK 0xffffffff /end CHARACTERISTIC
/begin CHARACTERISTIC ID_ECU_SAM_TIME2C77D "" VALUE 0x4fd76 a_174 100 defaultConversion543 0 65535 BIT_MASK 0xffffffff /end CHARACTERISTIC
/begin CHARACTERISTIC ID_ECU_SAM_TIME2C78D "" VALUE 0x4fd78 a_174 100 defaultConversion544 0 65535 BIT_MASK 0xffffffff /end CHARACTERISTIC
/begin CHARACTERISTIC ID_ECU_SAM_TIME2C79D "" VALUE 0x4fd7a a_174 100 defaultConversion545 0 65535 BIT_MASK 0xffffffff /end CHARACTERISTIC
/begin CHARACTERISTIC ID_ECU_SAM_TIME2C80D "" VALUE 0x4fd7c a_174 100 defaultConversion546 0 65535 BIT_MASK 0xffffffff /end CHARACTERISTIC
/begin CHARACTERISTIC ID_ECU_SAM_TIME2C81D "" VALUE 0x4fd7e a_174 100 defaultConversion547 0 65535 BIT_MASK 0xffffffff /end CHARACTERISTIC
/begin CHARACTERISTIC ID_ECU_SAM_TIME2C82D "" VALUE 0x4fd80 a_174 100 defaultConversion548 0 65535 BIT_MASK 0xffffffff /end CHARACTERISTIC
/begin CHARACTERISTIC ID_ECU_SAM_TIME2C83D "" VALUE 0x4fd82 a_174 100 defaultConversion549 0 65535 BIT_MASK 0xffffffff /end CHARACTERISTIC
/begin CHARACTERISTIC ID_ECU_SAM_TIME2C84D "" VALUE 0x4fd84 a_174 100 defaultConversion550 0 65535 BIT_MASK 0xffffffff /end CHARACTERISTIC
/begin CHARACTERISTIC ID_ECU_SAM_TIME2C85D "" VALUE 0x4fd86 a_174 100 defaultConversion551 0 65535 BIT_MASK 0xffffffff /end CHARACTERISTIC
/begin CHARACTERISTIC ID_ECU_SAM_TIME2C86D "" VALUE 0x4fd88 a_174 100 defaultConversion552 0 65535 BIT_MASK 0xffffffff /end CHARACTERISTIC
/begin CHARACTERISTIC ID_ECU_SAM_TIME2C87D "" VALUE 0x4fd8a a_174 100 defaultConversion553 0 65535 BIT_MASK 0xffffffff /end CHARACTERISTIC
/begin CHARACTERISTIC ID_ECU_SAM_TIME2C88D "" VALUE 0x4fd8c a_174 100 defaultConversion554 0 65535 BIT_MASK 0xffffffff /end CHARACTERISTIC
/begin CHARACTERISTIC ID_ECU_SAM_TIME2C89D "" VALUE 0x4fd8e a_174 100 defaultConversion555 0 65535 BIT_MASK 0xffffffff /end CHARACTERISTIC
/begin CHARACTERISTIC ID_ECU_SAM_TIME2C90D "" VALUE 0x4fd90 a_174 100 defaultConversion556 0 65535 BIT_MASK 0xffffffff /end CHARACTERISTIC
/begin CHARACTERISTIC ID_ECU_SAM_TIME2C91D "" VALUE 0x4fd92 a_174 100 defaultConversion557 0 65535 BIT_MASK 0xffffffff /end CHARACTERISTIC
/begin CHARACTERISTIC ID_ECU_SAM_TIME2C92D "" VALUE 0x4fd94 a_174 100 defaultConversion558 0 65535 BIT_MASK 0xffffffff /end CHARACTERISTIC
/begin CHARACTERISTIC ID_ECU_SAM_TIME2C93D "" VALUE 0x4fd96 a_174 100 defaultConversion559 0 65535 BIT_MASK 0xffffffff /end CHARACTERISTIC
/begin CHARACTERISTIC ID_ECU_SAM_TIME2C94D "" VALUE 0x4fd98 a_174 100 defaultConversion560 0 65535 BIT_MASK 0xffffffff /end CHARACTERISTIC
/begin CHARACTERISTIC ID_ECU_SAM_TIME2C95D "" VALUE 0x4fd9a a_174 100 defaultConversion561 0 65535 BIT_MASK 0xffffffff /end CHARACTERISTIC
/begin CHARACTERISTIC ID_ECU_SAM_TIME2C96D "" VALUE 0x4fd9c a_174 100 defaultConversion562 0 65535 BIT_MASK 0xffffffff /end CHARACTERISTIC
/begin CHARACTERISTIC ID_ECU_SAM_TIME2C97D "" VALUE 0x4fd9e a_174 100 defaultConversion563 0 65535 BIT_MASK 0xffffffff /end CHARACTERISTIC
/begin CHARACTERISTIC ID_ECU_SAM_TIME2C98D "" VALUE 0x4fda0 a_174 100 defaultConversion564 0 65535 BIT_MASK 0xffffffff /end CHARACTERISTIC
/begin CHARACTERISTIC ID_ECU_SAM_TIME2C99D "" VALUE 0x4fda2 a_174 100 defaultConversion565 0 65535 BIT_MASK 0xffffffff /end CHARACTERISTIC
/begin CHARACTERISTIC ID_ECU_SAM_TIME2C100D "" VALUE 0x4fda4 a_174 100 defaultConversion566 0 65535 BIT_MASK 0xffffffff /end CHARACTERISTIC
/begin CHARACTERISTIC ID_ECU_SAM_TIME2C101D "" VALUE 0x4fda6 a_174 100 defaultConversion567 0 65535 BIT_MASK 0xffffffff /end CHARACTERISTIC
/begin CHARACTERISTIC ID_ECU_SAM_TIME2C102D "" VALUE 0x4fda8 a_174 100 defaultConversion568 0 65535 BIT_MASK 0xffffffff /end CHARACTERISTIC
/begin CHARACTERISTIC ID_ECU_SAM_TIME2C103D "" VALUE 0x4fdaa a_174 100 defaultConversion569 0 65535 BIT_MASK 0xffffffff /end CHARACTERISTIC
/begin CHARACTERISTIC ID_ECU_SAM_TIME2C104D "" VALUE 0x4fdac a_174 100 defaultConversion570 0 65535 BIT_MASK 0xffffffff /end CHARACTERISTIC
/begin CHARACTERISTIC ID_ECU_SAM_TIME2C105D "" VALUE 0x4fdae a_174 100 defaultConversion571 0 65535 BIT_MASK 0xffffffff /end CHARACTERISTIC
/begin CHARACTERISTIC ID_ECU_SAM_TIME2C106D "" VALUE 0x4fdb0 a_174 100 defaultConversion572 0 65535 BIT_MASK 0xffffffff /end CHARACTERISTIC
/begin CHARACTERISTIC ID_ECU_SAM_TIME2C107D "" VALUE 0x4fdb2 a_174 100 defaultConversion573 0 65535 BIT_MASK 0xffffffff /end CHARACTERISTIC
/begin CHARACTERISTIC ID_ECU_SAM_TIME2C108D "" VALUE 0x4fdb4 a_174 100 defaultConversion574 0 65535 BIT_MASK 0xffffffff /end CHARACTERISTIC
/begin CHARACTERISTIC ID_ECU_SAM_TIME2C109D "" VALUE 0x4fdb6 a_174 100 defaultConversion575 0 65535 BIT_MASK 0xffffffff /end CHARACTERISTIC
/begin CHARACTERISTIC ID_ECU_SAM_TIME2C110D "" VALUE 0x4fdb8 a_174 100 defaultConversion576 0 65535 BIT_MASK 0xffffffff /end CHARACTERISTIC
/begin CHARACTERISTIC ID_ECU_SAM_TIME2C111D "" VALUE 0x4fdba a_174 100 defaultConversion577 0 65535 BIT_MASK 0xffffffff /end CHARACTERISTIC
/begin CHARACTERISTIC ID_ECU_SAM_TIME2C112D "" VALUE 0x4fdbc a_174 100 defaultConversion578 0 65535 BIT_MASK 0xffffffff /end CHARACTERISTIC
/begin CHARACTERISTIC ID_ECU_SAM_TIME2C113D "" VALUE 0x4fdbe a_174 100 defaultConversion579 0 65535 BIT_MASK 0xffffffff /end CHARACTERISTIC
/begin CHARACTERISTIC ID_ECU_SAM_TIME2C114D "" VALUE 0x4fdc0 a_174 100 defaultConversion580 0 65535 BIT_MASK 0xffffffff /end CHARACTERISTIC
/begin CHARACTERISTIC ID_ECU_SAM_TIME2C115D "" VALUE 0x4fdc2 a_174 100 defaultConversion581 0 65535 BIT_MASK 0xffffffff /end CHARACTERISTIC
/begin CHARACTERISTIC ID_ECU_SAM_TIME2C116D "" VALUE 0x4fdc4 a_174 100 defaultConversion582 0 65535 BIT_MASK 0xffffffff /end CHARACTERISTIC
/begin CHARACTERISTIC ID_ECU_SAM_TIME2C117D "" VALUE 0x4fdc6 a_174 100 defaultConversion583 0 65535 BIT_MASK 0xffffffff /end CHARACTERISTIC
/begin CHARACTERISTIC ID_ECU_SAM_TIME2C118D "" VALUE 0x4fdc8 a_174 100 defaultConversion584 0 65535 BIT_MASK 0xffffffff /end CHARACTERISTIC
/begin CHARACTERISTIC ID_ECU_SAM_TIME2C119D "" VALUE 0x4fdca a_174 100 defaultConversion585 0 65535 BIT_MASK 0xffffffff /end CHARACTERISTIC
/begin CHARACTERISTIC ID_ECU_SAM_TIME2C120D "" VALUE 0x4fdcc a_174 100 defaultConversion586 0 65535 BIT_MASK 0xffffffff /end CHARACTERISTIC
/begin CHARACTERISTIC ID_ECU_SAM_TIME2C121D "" VALUE 0x4fdce a_174 100 defaultConversion587 0 65535 BIT_MASK 0xffffffff /end CHARACTERISTIC
/begin CHARACTERISTIC ID_ECU_SAM_TIME2C122D "" VALUE 0x4fdd0 a_174 100 defaultConversion588 0 65535 BIT_MASK 0xffffffff /end CHARACTERISTIC
/begin CHARACTERISTIC ID_ECU_SAM_TIME2C123D "" VALUE 0x4fdd2 a_174 100 defaultConversion589 0 65535 BIT_MASK 0xffffffff /end CHARACTERISTIC
/begin CHARACTERISTIC ID_ECU_SAM_TIME2C124D "" VALUE 0x4fdd4 a_174 100 defaultConversion590 0 65535 BIT_MASK 0xffffffff /end CHARACTERISTIC
/begin CHARACTERISTIC ID_ECU_SAM_TIME2C125D "" VALUE 0x4fdd6 a_174 100 defaultConversion591 0 65535 BIT_MASK 0xffffffff /end CHARACTERISTIC
/begin CHARACTERISTIC ID_ECU_SAM_TIME2C126D "" VALUE 0x4fdd8 a_174 100 defaultConversion592 0 65535 BIT_MASK 0xffffffff /end CHARACTERISTIC
/begin CHARACTERISTIC ID_ECU_SAM_TIME2C127D "" VALUE 0x4fdda a_174 100 defaultConversion593 0 65535 BIT_MASK 0xffffffff /end CHARACTERISTIC
/begin CHARACTERISTIC ID_ECU_SAM_TIME2C128D "" VALUE 0x4fddc a_174 100 defaultConversion594 0 65535 BIT_MASK 0xffffffff /end CHARACTERISTIC
/begin CHARACTERISTIC ID_ECU_SAM_TIME2C129D "" VALUE 0x4fdde a_174 100 defaultConversion595 0 65535 BIT_MASK 0xffffffff /end CHARACTERISTIC
/begin CHARACTERISTIC ID_ECU_SAM_TIME2C130D "" VALUE 0x4fde0 a_174 100 defaultConversion596 0 65535 BIT_MASK 0xffffffff /end CHARACTERISTIC
/begin CHARACTERISTIC ID_ECU_SAM_TIME2C131D "" VALUE 0x4fde2 a_174 100 defaultConversion597 0 65535 BIT_MASK 0xffffffff /end CHARACTERISTIC
/begin CHARACTERISTIC ID_ECU_SAM_TIME2C132D "" VALUE 0x4fde4 a_174 100 defaultConversion598 0 65535 BIT_MASK 0xffffffff /end CHARACTERISTIC
/begin CHARACTERISTIC ID_ECU_SAM_TIME2C133D "" VALUE 0x4fde6 a_174 100 defaultConversion599 0 65535 BIT_MASK 0xffffffff /end CHARACTERISTIC
/begin CHARACTERISTIC ID_ECU_SAM_TIME2C134D "" VALUE 0x4fde8 a_174 100 defaultConversion600 0 65535 BIT_MASK 0xffffffff /end CHARACTERISTIC
/begin CHARACTERISTIC ID_ECU_SAM_TIME2C135D "" VALUE 0x4fdea a_174 100 defaultConversion601 0 65535 BIT_MASK 0xffffffff /end CHARACTERISTIC
/begin CHARACTERISTIC ID_ECU_SAM_TIME2C136D "" VALUE 0x4fdec a_174 100 defaultConversion602 0 65535 BIT_MASK 0xffffffff /end CHARACTERISTIC
/begin CHARACTERISTIC ID_ECU_SAM_TIME2C137D "" VALUE 0x4fdee a_174 100 defaultConversion603 0 65535 BIT_MASK 0xffffffff /end CHARACTERISTIC
/begin CHARACTERISTIC ID_ECU_SAM_TIME2C138D "" VALUE 0x4fdf0 a_174 100 defaultConversion604 0 65535 BIT_MASK 0xffffffff /end CHARACTERISTIC
/begin CHARACTERISTIC ID_ECU_SAM_TIME2C139D "" VALUE 0x4fdf2 a_174 100 defaultConversion605 0 65535 BIT_MASK 0xffffffff /end CHARACTERISTIC
/begin CHARACTERISTIC ID_ECU_SAM_TIME2C140D "" VALUE 0x4fdf4 a_174 100 defaultConversion606 0 65535 BIT_MASK 0xffffffff /end CHARACTERISTIC
/begin CHARACTERISTIC ID_ECU_SAM_TIME2C141D "" VALUE 0x4fdf6 a_174 100 defaultConversion607 0 65535 BIT_MASK 0xffffffff /end CHARACTERISTIC
/begin CHARACTERISTIC ID_ECU_SAM_TIME2C142D "" VALUE 0x4fdf8 a_174 100 defaultConversion608 0 65535 BIT_MASK 0xffffffff /end CHARACTERISTIC
/begin CHARACTERISTIC ID_ECU_SAM_TIME2C143D "" VALUE 0x4fdfa a_174 100 defaultConversion609 0 65535 BIT_MASK 0xffffffff /end CHARACTERISTIC
/begin CHARACTERISTIC ID_ECU_SAM_TIME2C144D "" VALUE 0x4fdfc a_174 100 defaultConversion610 0 65535 BIT_MASK 0xffffffff /end CHARACTERISTIC
/begin CHARACTERISTIC ID_ECU_SAM_TIME2C145D "" VALUE 0x4fdfe a_174 100 defaultConversion611 0 65535 BIT_MASK 0xffffffff /end CHARACTERISTIC
/begin CHARACTERISTIC ID_ECU_SAM_TIME2C146D "" VALUE 0x4fe00 a_174 100 defaultConversion612 0 65535 BIT_MASK 0xffffffff /end CHARACTERISTIC
/begin CHARACTERISTIC ID_ECU_SAM_TIME2C147D "" VALUE 0x4fe02 a_174 100 defaultConversion613 0 65535 BIT_MASK 0xffffffff /end CHARACTERISTIC
/begin CHARACTERISTIC ID_ECU_SAM_TIME2C148D "" VALUE 0x4fe04 a_174 100 defaultConversion614 0 65535 BIT_MASK 0xffffffff /end CHARACTERISTIC
/begin CHARACTERISTIC ID_ECU_SAM_TIME2C149D "" VALUE 0x4fe06 a_174 100 defaultConversion615 0 65535 BIT_MASK 0xffffffff /end CHARACTERISTIC
/begin CHARACTERISTIC ID_ECU_SAM_TIME2C150D "" VALUE 0x4fe08 a_174 100 defaultConversion616 0 65535 BIT_MASK 0xffffffff /end CHARACTERISTIC
/begin CHARACTERISTIC ID_ECU_SAM_TIME2C151D "" VALUE 0x4fe0a a_174 100 defaultConversion617 0 65535 BIT_MASK 0xffffffff /end CHARACTERISTIC
/begin CHARACTERISTIC ID_ECU_SAM_TIME2C152D "" VALUE 0x4fe0c a_174 100 defaultConversion618 0 65535 BIT_MASK 0xffffffff /end CHARACTERISTIC
/begin CHARACTERISTIC ID_ECU_SAM_TIME2C153D "" VALUE 0x4fe0e a_174 100 defaultConversion619 0 65535 BIT_MASK 0xffffffff /end CHARACTERISTIC
/begin CHARACTERISTIC ID_ECU_SAM_TIME2C154D "" VALUE 0x4fe10 a_174 100 defaultConversion620 0 65535 BIT_MASK 0xffffffff /end CHARACTERISTIC
/begin CHARACTERISTIC ID_ECU_SAM_TIME2C155D "" VALUE 0x4fe12 a_174 100 defaultConversion621 0 65535 BIT_MASK 0xffffffff /end CHARACTERISTIC
/begin CHARACTERISTIC ID_ECU_SAM_TIME2C156D "" VALUE 0x4fe14 a_174 100 defaultConversion622 0 65535 BIT_MASK 0xffffffff /end CHARACTERISTIC
/begin CHARACTERISTIC ID_ECU_SAM_TIME2C157D "" VALUE 0x4fe16 a_174 100 defaultConversion623 0 65535 BIT_MASK 0xffffffff /end CHARACTERISTIC
/begin CHARACTERISTIC ID_ECU_SAM_TIME2C158D "" VALUE 0x4fe18 a_174 100 defaultConversion624 0 65535 BIT_MASK 0xffffffff /end CHARACTERISTIC
/begin CHARACTERISTIC ID_ECU_SAM_TIME2C159D "" VALUE 0x4fe1a a_174 100 defaultConversion625 0 65535 BIT_MASK 0xffffffff /end CHARACTERISTIC
/begin CHARACTERISTIC ID_ECU_SAM_TIME2C160D "" VALUE 0x4fe1c a_174 100 defaultConversion626 0 65535 BIT_MASK 0xffffffff /end CHARACTERISTIC
/begin CHARACTERISTIC ID_ECU_SAM_TIME2C161D "" VALUE 0x4fe1e a_174 100 defaultConversion627 0 65535 BIT_MASK 0xffffffff /end CHARACTERISTIC
/begin CHARACTERISTIC ID_ECU_SAM_TIME2C162D "" VALUE 0x4fe20 a_174 100 defaultConversion628 0 65535 BIT_MASK 0xffffffff /end CHARACTERISTIC
/begin CHARACTERISTIC ID_ECU_SAM_TIME2C163D "" VALUE 0x4fe22 a_174 100 defaultConversion629 0 65535 BIT_MASK 0xffffffff /end CHARACTERISTIC
/begin CHARACTERISTIC ID_ECU_SAM_TIME2C164D "" VALUE 0x4fe24 a_174 100 defaultConversion630 0 65535 BIT_MASK 0xffffffff /end CHARACTERISTIC
/begin CHARACTERISTIC ID_ECU_SAM_TIME2C165D "" VALUE 0x4fe26 a_174 100 defaultConversion631 0 65535 BIT_MASK 0xffffffff /end CHARACTERISTIC
/begin CHARACTERISTIC ID_ECU_SAM_TIME2C166D "" VALUE 0x4fe28 a_174 100 defaultConversion632 0 65535 BIT_MASK 0xffffffff /end CHARACTERISTIC
/begin CHARACTERISTIC ID_ECU_SAM_TIME2C167D "" VALUE 0x4fe2a a_174 100 defaultConversion633 0 65535 BIT_MASK 0xffffffff /end CHARACTERISTIC
/begin CHARACTERISTIC ID_ECU_SAM_TIME2C168D "" VALUE 0x4fe2c a_174 100 defaultConversion634 0 65535 BIT_MASK 0xffffffff /end CHARACTERISTIC
/begin CHARACTERISTIC ID_ECU_SAM_TIME2C169D "" VALUE 0x4fe2e a_174 100 defaultConversion635 0 65535 BIT_MASK 0xffffffff /end CHARACTERISTIC
/begin CHARACTERISTIC ID_ECU_SAM_TIME2C170D "" VALUE 0x4fe30 a_174 100 defaultConversion636 0 65535 BIT_MASK 0xffffffff /end CHARACTERISTIC
/begin CHARACTERISTIC ID_ECU_SAM_TIME2C171D "" VALUE 0x4fe32 a_174 100 defaultConversion637 0 65535 BIT_MASK 0xffffffff /end CHARACTERISTIC
/begin CHARACTERISTIC ID_ECU_SAM_TIME2C172D "" VALUE 0x4fe34 a_174 100 defaultConversion638 0 65535 BIT_MASK 0xffffffff /end CHARACTERISTIC
/begin CHARACTERISTIC ID_ECU_SAM_TIME2C173D "" VALUE 0x4fe36 a_174 100 defaultConversion639 0 65535 BIT_MASK 0xffffffff /end CHARACTERISTIC
/begin CHARACTERISTIC ID_ECU_SAM_TIME2C174D "" VALUE 0x4fe38 a_174 100 defaultConversion640 0 65535 BIT_MASK 0xffffffff /end CHARACTERISTIC
/begin CHARACTERISTIC ID_ECU_SAM_TIME2C175D "" VALUE 0x4fe3a a_174 100 defaultConversion641 0 65535 BIT_MASK 0xffffffff /end CHARACTERISTIC
/begin CHARACTERISTIC ID_ECU_SAM_TIME2C176D "" VALUE 0x4fe3c a_174 100 defaultConversion642 0 65535 BIT_MASK 0xffffffff /end CHARACTERISTIC
/begin CHARACTERISTIC ID_ECU_SAM_TIME2C177D "" VALUE 0x4fe3e a_174 100 defaultConversion643 0 65535 BIT_MASK 0xffffffff /end CHARACTERISTIC
/begin CHARACTERISTIC ID_ECU_SAM_TIME2C178D "" VALUE 0x4fe40 a_174 100 defaultConversion644 0 65535 BIT_MASK 0xffffffff /end CHARACTERISTIC
/begin CHARACTERISTIC ID_ECU_SAM_TIME2C179D "" VALUE 0x4fe42 a_174 100 defaultConversion645 0 65535 BIT_MASK 0xffffffff /end CHARACTERISTIC
/begin CHARACTERISTIC ID_ECU_SAM_TIME2C180D "" VALUE 0x4fe44 a_174 100 defaultConversion646 0 65535 BIT_MASK 0xffffffff /end CHARACTERISTIC
/begin CHARACTERISTIC ID_ECU_SAM_TIME2C181D "" VALUE 0x4fe46 a_174 100 defaultConversion647 0 65535 BIT_MASK 0xffffffff /end CHARACTERISTIC
/begin CHARACTERISTIC ID_ECU_SAM_TIME2C182D "" VALUE 0x4fe48 a_174 100 defaultConversion648 0 65535 BIT_MASK 0xffffffff /end CHARACTERISTIC
/begin CHARACTERISTIC ID_ECU_SAM_TIME2C183D "" VALUE 0x4fe4a a_174 100 defaultConversion649 0 65535 BIT_MASK 0xffffffff /end CHARACTERISTIC
/begin CHARACTERISTIC ID_ECU_SAM_TIME2C184D "" VALUE 0x4fe4c a_174 100 defaultConversion650 0 65535 BIT_MASK 0xffffffff /end CHARACTERISTIC
/begin CHARACTERISTIC ID_ECU_SAM_TIME2C185D "" VALUE 0x4fe4e a_174 100 defaultConversion651 0 65535 BIT_MASK 0xffffffff /end CHARACTERISTIC
/begin CHARACTERISTIC ID_ECU_SAM_TIME2C186D "" VALUE 0x4fe50 a_174 100 defaultConversion652 0 65535 BIT_MASK 0xffffffff /end CHARACTERISTIC
/begin CHARACTERISTIC ID_ECU_SAM_TIME2C187D "" VALUE 0x4fe52 a_174 100 defaultConversion653 0 65535 BIT_MASK 0xffffffff /end CHARACTERISTIC
/begin CHARACTERISTIC ID_ECU_SAM_TIME2C188D "" VALUE 0x4fe54 a_174 100 defaultConversion654 0 65535 BIT_MASK 0xffffffff /end CHARACTERISTIC
/begin CHARACTERISTIC ID_ECU_SAM_TIME2C189D "" VALUE 0x4fe56 a_174 100 defaultConversion655 0 65535 BIT_MASK 0xffffffff /end CHARACTERISTIC
/begin CHARACTERISTIC ID_ECU_SAM_TIME2C190D "" VALUE 0x4fe58 a_174 100 defaultConversion656 0 65535 BIT_MASK 0xffffffff /end CHARACTERISTIC
/begin CHARACTERISTIC ID_ECU_SAM_TIME2C191D "" VALUE 0x4fe5a a_174 100 defaultConversion657 0 65535 BIT_MASK 0xffffffff /end CHARACTERISTIC
/begin CHARACTERISTIC ID_ECU_SAM_TIME2C192D "" VALUE 0x4fe5c a_174 100 defaultConversion658 0 65535 BIT_MASK 0xffffffff /end CHARACTERISTIC
/begin CHARACTERISTIC ID_ECU_SAM_TIME2C193D "" VALUE 0x4fe5e a_174 100 defaultConversion659 0 65535 BIT_MASK 0xffffffff /end CHARACTERISTIC
/begin CHARACTERISTIC ID_ECU_SAM_TIME2C194D "" VALUE 0x4fe60 a_174 100 defaultConversion660 0 65535 BIT_MASK 0xffffffff /end CHARACTERISTIC
/begin CHARACTERISTIC ID_ECU_SAM_TIME2C195D "" VALUE 0x4fe62 a_174 100 defaultConversion661 0 65535 BIT_MASK 0xffffffff /end CHARACTERISTIC
/begin CHARACTERISTIC ID_ECU_SAM_TIME2C196D "" VALUE 0x4fe64 a_174 100 defaultConversion662 0 65535 BIT_MASK 0xffffffff /end CHARACTERISTIC
/begin CHARACTERISTIC ID_ECU_SAM_TIME2C197D "" VALUE 0x4fe66 a_174 100 defaultConversion663 0 65535 BIT_MASK 0xffffffff /end CHARACTERISTIC
/begin CHARACTERISTIC ID_ECU_SAM_TIME2C198D "" VALUE 0x4fe68 a_174 100 defaultConversion664 0 65535 BIT_MASK 0xffffffff /end CHARACTERISTIC
/begin CHARACTERISTIC ID_ECU_SAM_TIME2C199D "" VALUE 0x4fe6a a_174 100 defaultConversion665 0 65535 BIT_MASK 0xffffffff /end CHARACTERISTIC
/begin CHARACTERISTIC ID_ECU_SAM_TIME2C200D "" VALUE 0x4fe6c a_174 100 defaultConversion666 0 65535 BIT_MASK 0xffffffff /end CHARACTERISTIC
/begin CHARACTERISTIC ID_ECU_SAM_TIME2C201D "" VALUE 0x4fe6e a_174 100 defaultConversion667 0 65535 BIT_MASK 0xffffffff /end CHARACTERISTIC
/begin CHARACTERISTIC ID_ECU_SAM_TIME2C202D "" VALUE 0x4fe70 a_174 100 defaultConversion668 0 65535 BIT_MASK 0xffffffff /end CHARACTERISTIC
/begin CHARACTERISTIC ID_ECU_SAM_TIME2C203D "" VALUE 0x4fe72 a_174 100 defaultConversion669 0 65535 BIT_MASK 0xffffffff /end CHARACTERISTIC
/begin CHARACTERISTIC ID_ECU_SAM_TIME2C204D "" VALUE 0x4fe74 a_174 100 defaultConversion670 0 65535 BIT_MASK 0xffffffff /end CHARACTERISTIC
/begin CHARACTERISTIC ID_ECU_SAM_TIME2C205D "" VALUE 0x4fe76 a_174 100 defaultConversion671 0 65535 BIT_MASK 0xffffffff /end CHARACTERISTIC
/begin CHARACTERISTIC ID_ECU_SAM_TIME2C206D "" VALUE 0x4fe78 a_174 100 defaultConversion672 0 65535 BIT_MASK 0xffffffff /end CHARACTERISTIC
/begin CHARACTERISTIC ID_ECU_SAM_TIME2C207D "" VALUE 0x4fe7a a_174 100 defaultConversion673 0 65535 BIT_MASK 0xffffffff /end CHARACTERISTIC
/begin CHARACTERISTIC ID_ECU_SAM_TIME2C208D "" VALUE 0x4fe7c a_174 100 defaultConversion674 0 65535 BIT_MASK 0xffffffff /end CHARACTERISTIC
/begin CHARACTERISTIC ID_ECU_SAM_TIME2C209D "" VALUE 0x4fe7e a_174 100 defaultConversion675 0 65535 BIT_MASK 0xffffffff /end CHARACTERISTIC
/begin CHARACTERISTIC ID_ECU_SAM_TIME2C210D "" VALUE 0x4fe80 a_174 100 defaultConversion676 0 65535 BIT_MASK 0xffffffff /end CHARACTERISTIC
/begin CHARACTERISTIC ID_ECU_SAM_TIME2C211D "" VALUE 0x4fe82 a_174 100 defaultConversion677 0 65535 BIT_MASK 0xffffffff /end CHARACTERISTIC
/begin CHARACTERISTIC ID_ECU_SAM_TIME2C212D "" VALUE 0x4fe84 a_174 100 defaultConversion678 0 65535 BIT_MASK 0xffffffff /end CHARACTERISTIC
/begin CHARACTERISTIC ID_ECU_SAM_TIME2C213D "" VALUE 0x4fe86 a_174 100 defaultConversion679 0 65535 BIT_MASK 0xffffffff /end CHARACTERISTIC
/begin CHARACTERISTIC ID_ECU_SAM_TIME2C214D "" VALUE 0x4fe88 a_174 100 defaultConversion680 0 65535 BIT_MASK 0xffffffff /end CHARACTERISTIC
/begin CHARACTERISTIC ID_ECU_SAM_TIME2C215D "" VALUE 0x4fe8a a_174 100 defaultConversion681 0 65535 BIT_MASK 0xffffffff /end CHARACTERISTIC
/begin CHARACTERISTIC ID_ECU_SAM_TIME2C216D "" VALUE 0x4fe8c a_174 100 defaultConversion682 0 65535 BIT_MASK 0xffffffff /end CHARACTERISTIC
/begin CHARACTERISTIC ID_ECU_SAM_TIME2C217D "" VALUE 0x4fe8e a_174 100 defaultConversion683 0 65535 BIT_MASK 0xffffffff /end CHARACTERISTIC
/begin CHARACTERISTIC ID_ECU_SAM_TIME2C218D "" VALUE 0x4fe90 a_174 100 defaultConversion684 0 65535 BIT_MASK 0xffffffff /end CHARACTERISTIC
/begin CHARACTERISTIC ID_ECU_SAM_TIME2C219D "" VALUE 0x4fe92 a_174 100 defaultConversion685 0 65535 BIT_MASK 0xffffffff /end CHARACTERISTIC
/begin CHARACTERISTIC ID_ECU_SAM_TIME2C220D "" VALUE 0x4fe94 a_174 100 defaultConversion686 0 65535 BIT_MASK 0xffffffff /end CHARACTERISTIC
/begin CHARACTERISTIC ID_ECU_SAM_TIME2C221D "" VALUE 0x4fe96 a_174 100 defaultConversion687 0 65535 BIT_MASK 0xffffffff /end CHARACTERISTIC
/begin CHARACTERISTIC ID_ECU_SAM_TIME2C222D "" VALUE 0x4fe98 a_174 100 defaultConversion688 0 65535 BIT_MASK 0xffffffff /end CHARACTERISTIC
/begin CHARACTERISTIC ID_ECU_SAM_TIME2C223D "" VALUE 0x4fe9a a_174 100 defaultConversion689 0 65535 BIT_MASK 0xffffffff /end CHARACTERISTIC
/begin CHARACTERISTIC ID_ECU_SAM_TIME2C224D "" VALUE 0x4fe9c a_174 100 defaultConversion690 0 65535 BIT_MASK 0xffffffff /end CHARACTERISTIC
/begin CHARACTERISTIC ID_ECU_SAM_TIME2C225D "" VALUE 0x4fe9e a_174 100 defaultConversion691 0 65535 BIT_MASK 0xffffffff /end CHARACTERISTIC
/begin CHARACTERISTIC ID_ECU_SAM_TIME2C226D "" VALUE 0x4fea0 a_174 100 defaultConversion692 0 65535 BIT_MASK 0xffffffff /end CHARACTERISTIC
/begin CHARACTERISTIC ID_ECU_SAM_TIME2C227D "" VALUE 0x4fea2 a_174 100 defaultConversion693 0 65535 BIT_MASK 0xffffffff /end CHARACTERISTIC
/begin CHARACTERISTIC ID_ECU_SAM_TIME2C228D "" VALUE 0x4fea4 a_174 100 defaultConversion694 0 65535 BIT_MASK 0xffffffff /end CHARACTERISTIC
/begin CHARACTERISTIC ID_ECU_SAM_TIME2C229D "" VALUE 0x4fea6 a_174 100 defaultConversion695 0 65535 BIT_MASK 0xffffffff /end CHARACTERISTIC
/begin CHARACTERISTIC ID_ECU_SAM_TIME2C230D "" VALUE 0x4fea8 a_174 100 defaultConversion696 0 65535 BIT_MASK 0xffffffff /end CHARACTERISTIC
/begin CHARACTERISTIC ID_ECU_SAM_TIME2C231D "" VALUE 0x4feaa a_174 100 defaultConversion697 0 65535 BIT_MASK 0xffffffff /end CHARACTERISTIC
/begin CHARACTERISTIC ID_ECU_SAM_TIME2C232D "" VALUE 0x4feac a_174 100 defaultConversion698 0 65535 BIT_MASK 0xffffffff /end CHARACTERISTIC
/begin CHARACTERISTIC ID_ECU_SAM_TIME2C233D "" VALUE 0x4feae a_174 100 defaultConversion699 0 65535 BIT_MASK 0xffffffff /end CHARACTERISTIC
/begin CHARACTERISTIC ID_ECU_SAM_TIME2C234D "" VALUE 0x4feb0 a_174 100 defaultConversion700 0 65535 BIT_MASK 0xffffffff /end CHARACTERISTIC
/begin CHARACTERISTIC ID_ECU_SAM_TIME2C235D "" VALUE 0x4feb2 a_174 100 defaultConversion701 0 65535 BIT_MASK 0xffffffff /end CHARACTERISTIC
/begin CHARACTERISTIC ID_ECU_SAM_TIME2C236D "" VALUE 0x4feb4 a_174 100 defaultConversion702 0 65535 BIT_MASK 0xffffffff /end CHARACTERISTIC
/begin CHARACTERISTIC ID_ECU_SAM_TIME2C237D "" VALUE 0x4feb6 a_174 100 defaultConversion703 0 65535 BIT_MASK 0xffffffff /end CHARACTERISTIC
/begin CHARACTERISTIC ID_ECU_SAM_TIME2C238D "" VALUE 0x4feb8 a_174 100 defaultConversion704 0 65535 BIT_MASK 0xffffffff /end CHARACTERISTIC
/begin CHARACTERISTIC ID_ECU_SAM_TIME2C239D "" VALUE 0x4feba a_174 100 defaultConversion705 0 65535 BIT_MASK 0xffffffff /end CHARACTERISTIC
/begin CHARACTERISTIC ID_ECU_SAM_TIME2C240D "" VALUE 0x4febc a_174 100 defaultConversion706 0 65535 BIT_MASK 0xffffffff /end CHARACTERISTIC
/begin COMPU_METHOD MTC_NORM_16_RES "" FORM "%5.1" "[°DK]" FORMULA "0.0018310547*X" FORMULA_INV "546.13333*X" /end COMPU_METHOD
/begin COMPU_METHOD LINEAR______0_000000__0H___1_992 "" FORM "%5.3" "[-]" FORMULA "0.0078125491*X" FORMULA_INV "127.9992*X" /end COMPU_METHOD
/begin COMPU_METHOD MTC_NORM_16_RES10 "" FORM "%6.2" "[°DK]" FORMULA "0.0018310547*X" FORMULA_INV "546.13333*X" /end COMPU_METHOD
/begin COMPU_METHOD LINEAR_______180_000000__0H___50 "" FORM "%5.0" "[°KW]" FORMULA "6.0*X-180.0" FORMULA_INV "0.16666667*X+30.0" /end COMPU_METHOD
/begin COMPU_METHOD LINEAR______0_000000__0H___0_916 "" FORM "%5.3" "[-]" FORMULA "1.5258789e-005*X" FORMULA_INV "65536.0*X" /end COMPU_METHOD
/begin COMPU_METHOD LINEAR______0_000000__0H___0_996 "" FORM "%5.3" "[-]" FORMULA "0.0039062745*X" FORMULA_INV "255.99839*X" /end COMPU_METHOD
/begin COMPU_METHOD LINEAR______0_000000__0H___119_9 "" FORM "%6.2" "[°DK]" FORMULA "0.0018310552*X" FORMULA_INV "546.13319*X" /end COMPU_METHOD
/begin COMPU_METHOD LINEAR______0_000000__0H___0_920 "" FORM "%5.3" "[-]" FORMULA "0.0039058823*X" FORMULA_INV "256.0241*X" /end COMPU_METHOD
/begin COMPU_METHOD LINEAR______0_000000__0H___15_94 "" FORM "%5.2" "[-]" FORMULA "0.062509802*X" FORMULA_INV "15.997491*X" /end COMPU_METHOD
/begin COMPU_METHOD LINEAR______0_000000__0H___0_924 "" FORM "%5.3" "[-]" FORMULA "1.5258716e-005*X" FORMULA_INV "65536.313*X" /end COMPU_METHOD
/begin COMPU_METHOD LINEAR______1_000000__1H___255_0 "" FORM "%4.0" "[-]" FORMULA "1.0*X" FORMULA_INV "1.0*X" /end COMPU_METHOD
/begin COMPU_METHOD LINEAR______0_000000__0H___2_000 "" FORM "%5.3" "[-]" FORMULA "3.0518044e-005*X" FORMULA_INV "32767.5*X" /end COMPU_METHOD
/begin COMPU_METHOD LINEAR______0_000000__0H___1_948 "" FORM "%5.3" "[-]" FORMULA "0.0078117646*X" FORMULA_INV "128.01205*X" /end COMPU_METHOD
/begin COMPU_METHOD LINEAR______0_000000__0H___0_965 "" FORM "%5.3" "[-]" FORMULA "0.00390625*X" FORMULA_INV "256.0*X" /end COMPU_METHOD
/begin COMPU_METHOD LINEAR______0_000000__0H___0_993 "" FORM "%7.5" "[-]" FORMULA "1.5258716e-005*X" FORMULA_INV "65536.313*X" /end COMPU_METHOD
/begin COMPU_METHOD LINEAR______0_000000__0H___11125 "" FORM "%5.1" "[°DK]" FORMULA "0.46862745*X" FORMULA_INV "2.1338912*X" /end COMPU_METHOD
/begin COMPU_METHOD LINEAR______0_000000__0H___0_129 "" FORM "%5.3" "[]" FORMULA "0.0039058823*X" FORMULA_INV "256.0241*X" /end COMPU_METHOD
/begin COMPU_METHOD LINEAR______0_000000__0H___25142 "" FORM "%3.0" "[-]" FORMULA "1.0*X" FORMULA_INV "1.0*X" /end COMPU_METHOD
/begin COMPU_METHOD LINEAR______0_000000__0H___16153 "" FORM "%5.0" "[1/min / km/h]" FORMULA "2.0*X" FORMULA_INV "0.5*X" /end COMPU_METHOD
/begin COMPU_METHOD LINEAR_______32768_000000__FFFF8 "" FORM "%6.0" "" FORMULA "1.0*X" FORMULA_INV "1.0*X" /end COMPU_METHOD
/begin COMPU_METHOD LINEAR_______32768_000000__FF180 "" FORM "%6.0" "[-]" FORMULA "1.0*X" FORMULA_INV "1.0*X" /end COMPU_METHOD
/begin COMPU_METHOD SIGNEDCHAR "" FORM "%4.0" "[-]" FORMULA "1.0*X" FORMULA_INV "1.0*X" /end COMPU_METHOD
/begin COMPU_METHOD LINEAR______0_000000__0H___25182 "" FORM "%4.0" "[-]" FORMULA "1.0*X" FORMULA_INV "1.0*X" /end COMPU_METHOD
/begin COMPU_METHOD LINEAR______0_000000__0H___25185 "" FORM "%4.0" "[]" FORMULA "1.0*X" FORMULA_INV "1.0*X" /end COMPU_METHOD
/begin COMPU_METHOD LINEAR_______2147483647_000000__ "" FORM "%11.0" "" FORMULA "1.9922179*X-2.1307717e+009" FORMULA_INV "0.50195312*X+1.0695475e+009" /end COMPU_METHOD
/begin COMPU_METHOD LINEAR______0_000000__0H___65190 "" FORM "%5.0" "" FORMULA "1.0*X" FORMULA_INV "1.0*X" /end COMPU_METHOD
/begin COMPU_METHOD defaultConversion192 "" FORM "%8.4" "[]" FORMULA "1.0*X" FORMULA_INV "1.0*X" /end COMPU_METHOD
/begin COMPU_METHOD defaultConversion193 "" FORM "%8.4" "[]" FORMULA "1.0*X" FORMULA_INV "1.0*X" /end COMPU_METHOD
/begin COMPU_METHOD defaultConversion194 "" FORM "%8.4" "[]" FORMULA "1.0*X" FORMULA_INV "1.0*X" /end COMPU_METHOD
/begin COMPU_METHOD defaultConversion195 "" FORM "%8.4" "[]" FORMULA "1.0*X" FORMULA_INV "1.0*X" /end COMPU_METHOD
/begin COMPU_METHOD LINEAR______0_000000__0H___1_196 "" FORM "%5.3" "[-]" FORMULA "3.0517585e-005*X" FORMULA_INV "32767.992*X" /end COMPU_METHOD
/begin COMPU_METHOD MTC_IN_DK_16_RES "" FORM "%6.2" "[°DK]" FORMULA "0.0036621094*X" FORMULA_INV "273.06667*X" /end COMPU_METHOD
/begin COMPU_METHOD PVS_NORM_8_RES197 "" FORM "%5.1" "[°DK]" FORMULA "0.46862745*X" FORMULA_INV "2.1338912*X" /end COMPU_METHOD
/begin COMPU_METHOD LINEAR______0_000000__0H___29198 "" FORM "%6.1" "[°DK]" FORMULA "11.717647*X" FORMULA_INV "0.085341365*X" /end COMPU_METHOD
/begin COMPU_METHOD MTC_IN_DK_16_RES199 "" FORM "%6.2" "[Grad DK/10ms]" FORMULA "0.0036621094*X" FORMULA_INV "273.06667*X" /end COMPU_METHOD
/begin COMPU_METHOD LINEAR______0_000000__0H___29200 "" FORM "%5.0" "[°DK/s]" FORMULA "11.717647*X" FORMULA_INV "0.085341365*X" /end COMPU_METHOD
/begin COMPU_METHOD LINEAR______0_000000__0H___29201 "" FORM "%5.0" "[°DK/sec]" FORMULA "11.717647*X" FORMULA_INV "0.085341365*X" /end COMPU_METHOD
/begin COMPU_METHOD LINEAR______0_010000__0H___655_3 "" FORM "%6.2" "[s]" FORMULA "0.009999847*X+0.01" FORMULA_INV "100.00153*X-1.0000153" /end COMPU_METHOD
/begin COMPU_METHOD MTC_IN_DK_16_RES202 "" FORM "%5.1" "[°DK]" FORMULA "0.0036621094*X" FORMULA_INV "273.06667*X" /end COMPU_METHOD
/begin COMPU_METHOD LINEAR______0_000000__0H___21845 "" FORM "%7.0" "[us]" FORMULA "0.66667684*X" FORMULA_INV "1.4999771*X" /end COMPU_METHOD
/begin COMPU_METHOD LINEAR_______768_000000__FFFFFF8 "" FORM "%5.0" "[°KW ZOT]" FORMULA "6.0*X" FORMULA_INV "0.16666667*X" /end COMPU_METHOD
/begin COMPU_METHOD LINEAR______0_000000__0H___127_0 "" FORM "%4.0" "[-]" FORMULA "1.0*X" FORMULA_INV "1.0*X" /end COMPU_METHOD
/begin COMPU_METHOD LINEAR______1_000000__1H___127_0 "" FORM "%4.0" "[-]" FORMULA "1.0*X" FORMULA_INV "1.0*X" /end COMPU_METHOD
/begin COMPU_METHOD LINEAR_______128_000000__FFFFFF8 "" FORM "%4.0" "[-]" FORMULA "1.0*X" FORMULA_INV "1.0*X" /end COMPU_METHOD
/begin COMPU_METHOD LINEAR______1_000000__100H___16_ "" FORM "%6.3" "[-]" FORMULA "0.00390625*X" FORMULA_INV "256.0*X" /end COMPU_METHOD
/begin COMPU_METHOD LINEAR______0_062500__10H___1_00 "" FORM "%6.3" "[-]" FORMULA "0.00390625*X" FORMULA_INV "256.0*X" /end COMPU_METHOD
/begin COMPU_METHOD LINEAR______1_000000__20H___7_96 "" FORM "%4.2" "[-]" FORMULA "0.031246637*X+0.00010763193" FORMULA_INV "32.003445*X-0.0034445925" /end COMPU_METHOD
/begin COMPU_METHOD LINEAR______0_000000__0H___0_203 "" FORM "%4.2" "[-]" FORMULA "0.0039058823*X" FORMULA_INV "256.0241*X" /end COMPU_METHOD
/begin COMPU_METHOD LINEAR______1_000000__20H___7204 "" FORM "%4.1" "[-]" FORMULA "0.031246637*X+0.00010763193" FORMULA_INV "32.003445*X-0.0034445925" /end COMPU_METHOD
/begin COMPU_METHOD LINEAR______0_000000__0H___1_205 "" FORM "%5.3" "[-]" FORMULA "0.0039215686*X" FORMULA_INV "255.0*X" /end COMPU_METHOD
/begin COMPU_METHOD LINEAR______0_000000__0H___0_124 "" FORM "%6.5" "[-]" FORMULA "0.00048823529*X" FORMULA_INV "2048.1928*X" /end COMPU_METHOD
/begin COMPU_METHOD LINEAR______0_000000__0H___5_206 "" FORM "%5.3" "[V]" FORMULA "7.7821012e-005*X" FORMULA_INV "12850.0*X" /end COMPU_METHOD
/begin COMPU_METHOD LINEAR______0_000015__1H___0_999 "" FORM "%7.5" "[-]" FORMULA "1.5258789e-005*X+2.109592e-010" FORMULA_INV "65536.0*X-1.3825422e-005" /end COMPU_METHOD
/begin COMPU_METHOD LINEAR______0_000000__0H___47_62 "" FORM "%6.3" "[_KW]" FORMULA "0.375*X" FORMULA_INV "2.6666667*X" /end COMPU_METHOD
/begin COMPU_METHOD LINEAR______0_000000__0H___5_207 "" FORM "%4.2" "[A]" FORMULA "0.032258065*X" FORMULA_INV "31.0*X" /end COMPU_METHOD
/begin COMPU_METHOD defaultConversion208 "" FORM "%8.4" "[]" FORMULA "1.0*X" FORMULA_INV "1.0*X" /end COMPU_METHOD
/begin COMPU_METHOD defaultConversion209 "" FORM "%8.4" "[]" FORMULA "1.0*X" FORMULA_INV "1.0*X" /end COMPU_METHOD
/begin COMPU_METHOD defaultConversion210 "" FORM "%8.4" "[]" FORMULA "1.0*X" FORMULA_INV "1.0*X" /end COMPU_METHOD
/begin COMPU_METHOD defaultConversion211 "" FORM "%8.4" "[]" FORMULA "1.0*X" FORMULA_INV "1.0*X" /end COMPU_METHOD
/begin COMPU_METHOD defaultConversion212 "" FORM "%8.4" "[]" FORMULA "1.0*X" FORMULA_INV "1.0*X" /end COMPU_METHOD
/begin COMPU_METHOD defaultConversion213 "" FORM "%8.4" "[]" FORMULA "1.0*X" FORMULA_INV "1.0*X" /end COMPU_METHOD
/begin COMPU_METHOD defaultConversion214 "" FORM "%8.4" "[]" FORMULA "1.0*X" FORMULA_INV "1.0*X" /end COMPU_METHOD
/begin COMPU_METHOD defaultConversion215 "" FORM "%8.4" "[]" FORMULA "1.0*X" FORMULA_INV "1.0*X" /end COMPU_METHOD
/begin COMPU_METHOD defaultConversion216 "" FORM "%8.4" "[]" FORMULA "1.0*X" FORMULA_INV "1.0*X" /end COMPU_METHOD
/begin COMPU_METHOD defaultConversion217 "" FORM "%8.4" "[]" FORMULA "1.0*X" FORMULA_INV "1.0*X" /end COMPU_METHOD
/begin COMPU_METHOD defaultConversion218 "" FORM "%8.4" "[]" FORMULA "1.0*X" FORMULA_INV "1.0*X" /end COMPU_METHOD
/begin COMPU_METHOD defaultConversion219 "" FORM "%8.4" "[]" FORMULA "1.0*X" FORMULA_INV "1.0*X" /end COMPU_METHOD
/begin COMPU_METHOD defaultConversion220 "" FORM "%8.4" "[]" FORMULA "1.0*X" FORMULA_INV "1.0*X" /end COMPU_METHOD
/begin COMPU_METHOD defaultConversion221 "" FORM "%8.4" "[]" FORMULA "1.0*X" FORMULA_INV "1.0*X" /end COMPU_METHOD
/begin COMPU_METHOD defaultConversion222 "" FORM "%8.4" "[]" FORMULA "1.0*X" FORMULA_INV "1.0*X" /end COMPU_METHOD
/begin COMPU_METHOD defaultConversion223 "" FORM "%8.4" "[]" FORMULA "1.0*X" FORMULA_INV "1.0*X" /end COMPU_METHOD
/begin COMPU_METHOD defaultConversion224 "" FORM "%8.4" "[]" FORMULA "1.0*X" FORMULA_INV "1.0*X" /end COMPU_METHOD
/begin COMPU_METHOD defaultConversion225 "" FORM "%8.4" "[]" FORMULA "1.0*X" FORMULA_INV "1.0*X" /end COMPU_METHOD
/begin COMPU_METHOD defaultConversion226 "" FORM "%8.4" "[]" FORMULA "1.0*X" FORMULA_INV "1.0*X" /end COMPU_METHOD
/begin COMPU_METHOD defaultConversion227 "" FORM "%8.4" "[]" FORMULA "1.0*X" FORMULA_INV "1.0*X" /end COMPU_METHOD
/begin COMPU_METHOD defaultConversion228 "" FORM "%8.4" "[]" FORMULA "1.0*X" FORMULA_INV "1.0*X" /end COMPU_METHOD
/begin COMPU_METHOD defaultConversion229 "" FORM "%8.4" "[]" FORMULA "1.0*X" FORMULA_INV "1.0*X" /end COMPU_METHOD
/begin COMPU_METHOD defaultConversion230 "" FORM "%8.4" "[]" FORMULA "1.0*X" FORMULA_INV "1.0*X" /end COMPU_METHOD
/begin COMPU_METHOD defaultConversion231 "" FORM "%8.4" "[]" FORMULA "1.0*X" FORMULA_INV "1.0*X" /end COMPU_METHOD
/begin COMPU_METHOD defaultConversion232 "" FORM "%8.4" "[]" FORMULA "1.0*X" FORMULA_INV "1.0*X" /end COMPU_METHOD
/begin COMPU_METHOD defaultConversion233 "" FORM "%8.4" "[]" FORMULA "1.0*X" FORMULA_INV "1.0*X" /end COMPU_METHOD
/begin COMPU_METHOD defaultConversion234 "" FORM "%8.4" "[]" FORMULA "1.0*X" FORMULA_INV "1.0*X" /end COMPU_METHOD
/begin COMPU_METHOD defaultConversion235 "" FORM "%8.4" "[]" FORMULA "1.0*X" FORMULA_INV "1.0*X" /end COMPU_METHOD
/begin COMPU_METHOD defaultConversion236 "" FORM "%8.4" "[]" FORMULA "1.0*X" FORMULA_INV "1.0*X" /end COMPU_METHOD
/begin COMPU_METHOD defaultConversion237 "" FORM "%8.4" "[]" FORMULA "1.0*X" FORMULA_INV "1.0*X" /end COMPU_METHOD
/begin COMPU_METHOD defaultConversion238 "" FORM "%8.4" "[]" FORMULA "1.0*X" FORMULA_INV "1.0*X" /end COMPU_METHOD
/begin COMPU_METHOD defaultConversion239 "" FORM "%8.4" "[]" FORMULA "1.0*X" FORMULA_INV "1.0*X" /end COMPU_METHOD
/begin COMPU_METHOD defaultConversion240 "" FORM "%8.4" "[]" FORMULA "1.0*X" FORMULA_INV "1.0*X" /end COMPU_METHOD
/begin COMPU_METHOD defaultConversion241 "" FORM "%8.4" "[]" FORMULA "1.0*X" FORMULA_INV "1.0*X" /end COMPU_METHOD
/begin COMPU_METHOD defaultConversion242 "" FORM "%8.4" "[]" FORMULA "1.0*X" FORMULA_INV "1.0*X" /end COMPU_METHOD
/begin COMPU_METHOD defaultConversion243 "" FORM "%8.4" "[]" FORMULA "1.0*X" FORMULA_INV "1.0*X" /end COMPU_METHOD
/begin COMPU_METHOD defaultConversion244 "" FORM "%8.4" "[]" FORMULA "1.0*X" FORMULA_INV "1.0*X" /end COMPU_METHOD
/begin COMPU_METHOD defaultConversion245 "" FORM "%8.4" "[]" FORMULA "1.0*X" FORMULA_INV "1.0*X" /end COMPU_METHOD
/begin COMPU_METHOD defaultConversion246 "" FORM "%8.4" "[]" FORMULA "1.0*X" FORMULA_INV "1.0*X" /end COMPU_METHOD
/begin COMPU_METHOD defaultConversion247 "" FORM "%8.4" "[]" FORMULA "1.0*X" FORMULA_INV "1.0*X" /end COMPU_METHOD
/begin COMPU_METHOD defaultConversion248 "" FORM "%8.4" "[]" FORMULA "1.0*X" FORMULA_INV "1.0*X" /end COMPU_METHOD
/begin COMPU_METHOD defaultConversion249 "" FORM "%8.4" "[]" FORMULA "1.0*X" FORMULA_INV "1.0*X" /end COMPU_METHOD
/begin COMPU_METHOD defaultConversion250 "" FORM "%8.4" "[]" FORMULA "1.0*X" FORMULA_INV "1.0*X" /end COMPU_METHOD
/begin COMPU_METHOD defaultConversion251 "" FORM "%8.4" "[]" FORMULA "1.0*X" FORMULA_INV "1.0*X" /end COMPU_METHOD
/begin COMPU_METHOD defaultConversion252 "" FORM "%8.4" "[]" FORMULA "1.0*X" FORMULA_INV "1.0*X" /end COMPU_METHOD
/begin COMPU_METHOD defaultConversion253 "" FORM "%8.4" "[]" FORMULA "1.0*X" FORMULA_INV "1.0*X" /end COMPU_METHOD
/begin COMPU_METHOD defaultConversion254 "" FORM "%8.4" "[]" FORMULA "1.0*X" FORMULA_INV "1.0*X" /end COMPU_METHOD
/begin COMPU_METHOD defaultConversion255 "" FORM "%8.4" "[]" FORMULA "1.0*X" FORMULA_INV "1.0*X" /end COMPU_METHOD
/begin COMPU_METHOD defaultConversion256 "" FORM "%8.4" "[]" FORMULA "1.0*X" FORMULA_INV "1.0*X" /end COMPU_METHOD
/begin COMPU_METHOD defaultConversion257 "" FORM "%8.4" "[]" FORMULA "1.0*X" FORMULA_INV "1.0*X" /end COMPU_METHOD
/begin COMPU_METHOD defaultConversion258 "" FORM "%8.4" "[]" FORMULA "1.0*X" FORMULA_INV "1.0*X" /end COMPU_METHOD
/begin COMPU_METHOD defaultConversion259 "" FORM "%8.4" "[]" FORMULA "1.0*X" FORMULA_INV "1.0*X" /end COMPU_METHOD
/begin COMPU_METHOD defaultConversion260 "" FORM "%8.4" "[]" FORMULA "1.0*X" FORMULA_INV "1.0*X" /end COMPU_METHOD
/begin COMPU_METHOD defaultConversion261 "" FORM "%8.4" "[]" FORMULA "1.0*X" FORMULA_INV "1.0*X" /end COMPU_METHOD
/begin COMPU_METHOD defaultConversion262 "" FORM "%8.4" "[]" FORMULA "1.0*X" FORMULA_INV "1.0*X" /end COMPU_METHOD
/begin COMPU_METHOD defaultConversion263 "" FORM "%8.4" "[]" FORMULA "1.0*X" FORMULA_INV "1.0*X" /end COMPU_METHOD
/begin COMPU_METHOD defaultConversion264 "" FORM "%8.4" "[]" FORMULA "1.0*X" FORMULA_INV "1.0*X" /end COMPU_METHOD
/begin COMPU_METHOD defaultConversion265 "" FORM "%8.4" "[]" FORMULA "1.0*X" FORMULA_INV "1.0*X" /end COMPU_METHOD
/begin COMPU_METHOD defaultConversion266 "" FORM "%8.4" "[]" FORMULA "1.0*X" FORMULA_INV "1.0*X" /end COMPU_METHOD
/begin COMPU_METHOD defaultConversion267 "" FORM "%8.4" "[]" FORMULA "1.0*X" FORMULA_INV "1.0*X" /end COMPU_METHOD
/begin COMPU_METHOD defaultConversion268 "" FORM "%8.4" "[]" FORMULA "1.0*X" FORMULA_INV "1.0*X" /end COMPU_METHOD
/begin COMPU_METHOD defaultConversion269 "" FORM "%8.4" "[]" FORMULA "1.0*X" FORMULA_INV "1.0*X" /end COMPU_METHOD
/begin COMPU_METHOD defaultConversion270 "" FORM "%8.4" "[]" FORMULA "1.0*X" FORMULA_INV "1.0*X" /end COMPU_METHOD
/begin COMPU_METHOD defaultConversion271 "" FORM "%8.4" "[]" FORMULA "1.0*X" FORMULA_INV "1.0*X" /end COMPU_METHOD
/begin COMPU_METHOD defaultConversion272 "" FORM "%8.4" "[]" FORMULA "1.0*X" FORMULA_INV "1.0*X" /end COMPU_METHOD
/begin COMPU_METHOD defaultConversion273 "" FORM "%8.4" "[]" FORMULA "1.0*X" FORMULA_INV "1.0*X" /end COMPU_METHOD
/begin COMPU_METHOD defaultConversion274 "" FORM "%8.4" "[]" FORMULA "1.0*X" FORMULA_INV "1.0*X" /end COMPU_METHOD
/begin COMPU_METHOD defaultConversion275 "" FORM "%8.4" "[]" FORMULA "1.0*X" FORMULA_INV "1.0*X" /end COMPU_METHOD
/begin COMPU_METHOD defaultConversion276 "" FORM "%8.4" "[]" FORMULA "1.0*X" FORMULA_INV "1.0*X" /end COMPU_METHOD
/begin COMPU_METHOD defaultConversion277 "" FORM "%8.4" "[]" FORMULA "1.0*X" FORMULA_INV "1.0*X" /end COMPU_METHOD
/begin COMPU_METHOD defaultConversion278 "" FORM "%8.4" "[]" FORMULA "1.0*X" FORMULA_INV "1.0*X" /end COMPU_METHOD
/begin COMPU_METHOD defaultConversion279 "" FORM "%8.4" "[]" FORMULA "1.0*X" FORMULA_INV "1.0*X" /end COMPU_METHOD
/begin COMPU_METHOD defaultConversion280 "" FORM "%8.4" "[]" FORMULA "1.0*X" FORMULA_INV "1.0*X" /end COMPU_METHOD
/begin COMPU_METHOD defaultConversion281 "" FORM "%8.4" "[]" FORMULA "1.0*X" FORMULA_INV "1.0*X" /end COMPU_METHOD
/begin COMPU_METHOD defaultConversion282 "" FORM "%8.4" "[]" FORMULA "1.0*X" FORMULA_INV "1.0*X" /end COMPU_METHOD
/begin COMPU_METHOD defaultConversion283 "" FORM "%8.4" "[]" FORMULA "1.0*X" FORMULA_INV "1.0*X" /end COMPU_METHOD
/begin COMPU_METHOD defaultConversion284 "" FORM "%8.4" "[]" FORMULA "1.0*X" FORMULA_INV "1.0*X" /end COMPU_METHOD
/begin COMPU_METHOD defaultConversion285 "" FORM "%8.4" "[]" FORMULA "1.0*X" FORMULA_INV "1.0*X" /end COMPU_METHOD
/begin COMPU_METHOD defaultConversion286 "" FORM "%8.4" "[]" FORMULA "1.0*X" FORMULA_INV "1.0*X" /end COMPU_METHOD
/begin COMPU_METHOD defaultConversion287 "" FORM "%8.4" "[]" FORMULA "1.0*X" FORMULA_INV "1.0*X" /end COMPU_METHOD
/begin COMPU_METHOD defaultConversion288 "" FORM "%8.4" "[]" FORMULA "1.0*X" FORMULA_INV "1.0*X" /end COMPU_METHOD
/begin COMPU_METHOD defaultConversion289 "" FORM "%8.4" "[]" FORMULA "1.0*X" FORMULA_INV "1.0*X" /end COMPU_METHOD
/begin COMPU_METHOD defaultConversion290 "" FORM "%8.4" "[]" FORMULA "1.0*X" FORMULA_INV "1.0*X" /end COMPU_METHOD
/begin COMPU_METHOD defaultConversion291 "" FORM "%8.4" "[]" FORMULA "1.0*X" FORMULA_INV "1.0*X" /end COMPU_METHOD
/begin COMPU_METHOD defaultConversion292 "" FORM "%8.4" "[]" FORMULA "1.0*X" FORMULA_INV "1.0*X" /end COMPU_METHOD
/begin COMPU_METHOD defaultConversion293 "" FORM "%8.4" "[]" FORMULA "1.0*X" FORMULA_INV "1.0*X" /end COMPU_METHOD
/begin COMPU_METHOD defaultConversion294 "" FORM "%8.4" "[]" FORMULA "1.0*X" FORMULA_INV "1.0*X" /end COMPU_METHOD
/begin COMPU_METHOD defaultConversion295 "" FORM "%8.4" "[]" FORMULA "1.0*X" FORMULA_INV "1.0*X" /end COMPU_METHOD
/begin COMPU_METHOD defaultConversion296 "" FORM "%8.4" "[]" FORMULA "1.0*X" FORMULA_INV "1.0*X" /end COMPU_METHOD
/begin COMPU_METHOD defaultConversion297 "" FORM "%8.4" "[]" FORMULA "1.0*X" FORMULA_INV "1.0*X" /end COMPU_METHOD
/begin COMPU_METHOD defaultConversion298 "" FORM "%8.4" "[]" FORMULA "1.0*X" FORMULA_INV "1.0*X" /end COMPU_METHOD
/begin COMPU_METHOD defaultConversion299 "" FORM "%8.4" "[]" FORMULA "1.0*X" FORMULA_INV "1.0*X" /end COMPU_METHOD
/begin COMPU_METHOD defaultConversion300 "" FORM "%8.4" "[]" FORMULA "1.0*X" FORMULA_INV "1.0*X" /end COMPU_METHOD
/begin COMPU_METHOD defaultConversion301 "" FORM "%8.4" "[]" FORMULA "1.0*X" FORMULA_INV "1.0*X" /end COMPU_METHOD
/begin COMPU_METHOD defaultConversion302 "" FORM "%8.4" "[]" FORMULA "1.0*X" FORMULA_INV "1.0*X" /end COMPU_METHOD
/begin COMPU_METHOD defaultConversion303 "" FORM "%8.4" "[]" FORMULA "1.0*X" FORMULA_INV "1.0*X" /end COMPU_METHOD
/begin COMPU_METHOD defaultConversion304 "" FORM "%8.4" "[]" FORMULA "1.0*X" FORMULA_INV "1.0*X" /end COMPU_METHOD
/begin COMPU_METHOD defaultConversion305 "" FORM "%8.4" "[]" FORMULA "1.0*X" FORMULA_INV "1.0*X" /end COMPU_METHOD
/begin COMPU_METHOD defaultConversion306 "" FORM "%8.4" "[]" FORMULA "1.0*X" FORMULA_INV "1.0*X" /end COMPU_METHOD
/begin COMPU_METHOD defaultConversion307 "" FORM "%8.4" "[]" FORMULA "1.0*X" FORMULA_INV "1.0*X" /end COMPU_METHOD
/begin COMPU_METHOD defaultConversion308 "" FORM "%8.4" "[]" FORMULA "1.0*X" FORMULA_INV "1.0*X" /end COMPU_METHOD
/begin COMPU_METHOD defaultConversion309 "" FORM "%8.4" "[]" FORMULA "1.0*X" FORMULA_INV "1.0*X" /end COMPU_METHOD
/begin COMPU_METHOD defaultConversion310 "" FORM "%8.4" "[]" FORMULA "1.0*X" FORMULA_INV "1.0*X" /end COMPU_METHOD
/begin COMPU_METHOD defaultConversion311 "" FORM "%8.4" "[]" FORMULA "1.0*X" FORMULA_INV "1.0*X" /end COMPU_METHOD
/begin COMPU_METHOD defaultConversion312 "" FORM "%8.4" "[]" FORMULA "1.0*X" FORMULA_INV "1.0*X" /end COMPU_METHOD
/begin COMPU_METHOD defaultConversion313 "" FORM "%8.4" "[]" FORMULA "1.0*X" FORMULA_INV "1.0*X" /end COMPU_METHOD
/begin COMPU_METHOD defaultConversion314 "" FORM "%8.4" "[]" FORMULA "1.0*X" FORMULA_INV "1.0*X" /end COMPU_METHOD
/begin COMPU_METHOD defaultConversion315 "" FORM "%8.4" "[]" FORMULA "1.0*X" FORMULA_INV "1.0*X" /end COMPU_METHOD
/begin COMPU_METHOD defaultConversion316 "" FORM "%8.4" "[]" FORMULA "1.0*X" FORMULA_INV "1.0*X" /end COMPU_METHOD
/begin COMPU_METHOD defaultConversion317 "" FORM "%8.4" "[]" FORMULA "1.0*X" FORMULA_INV "1.0*X" /end COMPU_METHOD
/begin COMPU_METHOD defaultConversion318 "" FORM "%8.4" "[]" FORMULA "1.0*X" FORMULA_INV "1.0*X" /end COMPU_METHOD
/begin COMPU_METHOD defaultConversion319 "" FORM "%8.4" "[]" FORMULA "1.0*X" FORMULA_INV "1.0*X" /end COMPU_METHOD
/begin COMPU_METHOD defaultConversion320 "" FORM "%8.4" "[]" FORMULA "1.0*X" FORMULA_INV "1.0*X" /end COMPU_METHOD
/begin COMPU_METHOD defaultConversion321 "" FORM "%8.4" "[]" FORMULA "1.0*X" FORMULA_INV "1.0*X" /end COMPU_METHOD
/begin COMPU_METHOD defaultConversion322 "" FORM "%8.4" "[]" FORMULA "1.0*X" FORMULA_INV "1.0*X" /end COMPU_METHOD
/begin COMPU_METHOD defaultConversion323 "" FORM "%8.4" "[]" FORMULA "1.0*X" FORMULA_INV "1.0*X" /end COMPU_METHOD
/begin COMPU_METHOD defaultConversion324 "" FORM "%8.4" "[]" FORMULA "1.0*X" FORMULA_INV "1.0*X" /end COMPU_METHOD
/begin COMPU_METHOD defaultConversion325 "" FORM "%8.4" "[]" FORMULA "1.0*X" FORMULA_INV "1.0*X" /end COMPU_METHOD
/begin COMPU_METHOD defaultConversion326 "" FORM "%8.4" "[]" FORMULA "1.0*X" FORMULA_INV "1.0*X" /end COMPU_METHOD
/begin COMPU_METHOD defaultConversion327 "" FORM "%8.4" "[]" FORMULA "1.0*X" FORMULA_INV "1.0*X" /end COMPU_METHOD
/begin COMPU_METHOD defaultConversion328 "" FORM "%8.4" "[]" FORMULA "1.0*X" FORMULA_INV "1.0*X" /end COMPU_METHOD
/begin COMPU_METHOD defaultConversion329 "" FORM "%8.4" "[]" FORMULA "1.0*X" FORMULA_INV "1.0*X" /end COMPU_METHOD
/begin COMPU_METHOD defaultConversion330 "" FORM "%8.4" "[]" FORMULA "1.0*X" FORMULA_INV "1.0*X" /end COMPU_METHOD
/begin COMPU_METHOD defaultConversion331 "" FORM "%8.4" "[]" FORMULA "1.0*X" FORMULA_INV "1.0*X" /end COMPU_METHOD
/begin COMPU_METHOD defaultConversion332 "" FORM "%8.4" "[]" FORMULA "1.0*X" FORMULA_INV "1.0*X" /end COMPU_METHOD
/begin COMPU_METHOD defaultConversion333 "" FORM "%8.4" "[]" FORMULA "1.0*X" FORMULA_INV "1.0*X" /end COMPU_METHOD
/begin COMPU_METHOD defaultConversion334 "" FORM "%8.4" "[]" FORMULA "1.0*X" FORMULA_INV "1.0*X" /end COMPU_METHOD
/begin COMPU_METHOD defaultConversion335 "" FORM "%8.4" "[]" FORMULA "1.0*X" FORMULA_INV "1.0*X" /end COMPU_METHOD
/begin COMPU_METHOD defaultConversion336 "" FORM "%8.4" "[]" FORMULA "1.0*X" FORMULA_INV "1.0*X" /end COMPU_METHOD
/begin COMPU_METHOD defaultConversion337 "" FORM "%8.4" "[]" FORMULA "1.0*X" FORMULA_INV "1.0*X" /end COMPU_METHOD
/begin COMPU_METHOD defaultConversion338 "" FORM "%8.4" "[]" FORMULA "1.0*X" FORMULA_INV "1.0*X" /end COMPU_METHOD
/begin COMPU_METHOD defaultConversion339 "" FORM "%8.4" "[]" FORMULA "1.0*X" FORMULA_INV "1.0*X" /end COMPU_METHOD
/begin COMPU_METHOD defaultConversion340 "" FORM "%8.4" "[]" FORMULA "1.0*X" FORMULA_INV "1.0*X" /end COMPU_METHOD
/begin COMPU_METHOD defaultConversion341 "" FORM "%8.4" "[]" FORMULA "1.0*X" FORMULA_INV "1.0*X" /end COMPU_METHOD
/begin COMPU_METHOD defaultConversion342 "" FORM "%8.4" "[]" FORMULA "1.0*X" FORMULA_INV "1.0*X" /end COMPU_METHOD
/begin COMPU_METHOD defaultConversion343 "" FORM "%8.4" "[]" FORMULA "1.0*X" FORMULA_INV "1.0*X" /end COMPU_METHOD
/begin COMPU_METHOD defaultConversion344 "" FORM "%8.4" "[]" FORMULA "1.0*X" FORMULA_INV "1.0*X" /end COMPU_METHOD
/begin COMPU_METHOD defaultConversion345 "" FORM "%8.4" "[]" FORMULA "1.0*X" FORMULA_INV "1.0*X" /end COMPU_METHOD
/begin COMPU_METHOD defaultConversion346 "" FORM "%8.4" "[]" FORMULA "1.0*X" FORMULA_INV "1.0*X" /end COMPU_METHOD
/begin COMPU_METHOD defaultConversion347 "" FORM "%8.4" "[]" FORMULA "1.0*X" FORMULA_INV "1.0*X" /end COMPU_METHOD
/begin COMPU_METHOD defaultConversion348 "" FORM "%8.4" "[]" FORMULA "1.0*X" FORMULA_INV "1.0*X" /end COMPU_METHOD
/begin COMPU_METHOD defaultConversion349 "" FORM "%8.4" "[]" FORMULA "1.0*X" FORMULA_INV "1.0*X" /end COMPU_METHOD
/begin COMPU_METHOD defaultConversion350 "" FORM "%8.4" "[]" FORMULA "1.0*X" FORMULA_INV "1.0*X" /end COMPU_METHOD
/begin COMPU_METHOD defaultConversion351 "" FORM "%8.4" "[]" FORMULA "1.0*X" FORMULA_INV "1.0*X" /end COMPU_METHOD
/begin COMPU_METHOD defaultConversion352 "" FORM "%8.4" "[]" FORMULA "1.0*X" FORMULA_INV "1.0*X" /end COMPU_METHOD
/begin COMPU_METHOD defaultConversion353 "" FORM "%8.4" "[]" FORMULA "1.0*X" FORMULA_INV "1.0*X" /end COMPU_METHOD
/begin COMPU_METHOD defaultConversion354 "" FORM "%8.4" "[]" FORMULA "1.0*X" FORMULA_INV "1.0*X" /end COMPU_METHOD
/begin COMPU_METHOD defaultConversion355 "" FORM "%8.4" "[]" FORMULA "1.0*X" FORMULA_INV "1.0*X" /end COMPU_METHOD
/begin COMPU_METHOD defaultConversion356 "" FORM "%8.4" "[]" FORMULA "1.0*X" FORMULA_INV "1.0*X" /end COMPU_METHOD
/begin COMPU_METHOD defaultConversion357 "" FORM "%8.4" "[]" FORMULA "1.0*X" FORMULA_INV "1.0*X" /end COMPU_METHOD
/begin COMPU_METHOD defaultConversion358 "" FORM "%8.4" "[]" FORMULA "1.0*X" FORMULA_INV "1.0*X" /end COMPU_METHOD
/begin COMPU_METHOD defaultConversion359 "" FORM "%8.4" "[]" FORMULA "1.0*X" FORMULA_INV "1.0*X" /end COMPU_METHOD
/begin COMPU_METHOD defaultConversion360 "" FORM "%8.4" "[]" FORMULA "1.0*X" FORMULA_INV "1.0*X" /end COMPU_METHOD
/begin COMPU_METHOD defaultConversion361 "" FORM "%8.4" "[]" FORMULA "1.0*X" FORMULA_INV "1.0*X" /end COMPU_METHOD
/begin COMPU_METHOD defaultConversion362 "" FORM "%8.4" "[]" FORMULA "1.0*X" FORMULA_INV "1.0*X" /end COMPU_METHOD
/begin COMPU_METHOD defaultConversion363 "" FORM "%8.4" "[]" FORMULA "1.0*X" FORMULA_INV "1.0*X" /end COMPU_METHOD
/begin COMPU_METHOD defaultConversion364 "" FORM "%8.4" "[]" FORMULA "1.0*X" FORMULA_INV "1.0*X" /end COMPU_METHOD
/begin COMPU_METHOD defaultConversion365 "" FORM "%8.4" "[]" FORMULA "1.0*X" FORMULA_INV "1.0*X" /end COMPU_METHOD
/begin COMPU_METHOD defaultConversion366 "" FORM "%8.4" "[]" FORMULA "1.0*X" FORMULA_INV "1.0*X" /end COMPU_METHOD
/begin COMPU_METHOD defaultConversion367 "" FORM "%8.4" "[]" FORMULA "1.0*X" FORMULA_INV "1.0*X" /end COMPU_METHOD
/begin COMPU_METHOD defaultConversion368 "" FORM "%8.4" "[]" FORMULA "1.0*X" FORMULA_INV "1.0*X" /end COMPU_METHOD
/begin COMPU_METHOD defaultConversion369 "" FORM "%8.4" "[]" FORMULA "1.0*X" FORMULA_INV "1.0*X" /end COMPU_METHOD
/begin COMPU_METHOD defaultConversion370 "" FORM "%8.4" "[]" FORMULA "1.0*X" FORMULA_INV "1.0*X" /end COMPU_METHOD
/begin COMPU_METHOD defaultConversion371 "" FORM "%8.4" "[]" FORMULA "1.0*X" FORMULA_INV "1.0*X" /end COMPU_METHOD
/begin COMPU_METHOD defaultConversion372 "" FORM "%8.4" "[]" FORMULA "1.0*X" FORMULA_INV "1.0*X" /end COMPU_METHOD
/begin COMPU_METHOD defaultConversion373 "" FORM "%8.4" "[]" FORMULA "1.0*X" FORMULA_INV "1.0*X" /end COMPU_METHOD
/begin COMPU_METHOD defaultConversion374 "" FORM "%8.4" "[]" FORMULA "1.0*X" FORMULA_INV "1.0*X" /end COMPU_METHOD
/begin COMPU_METHOD defaultConversion375 "" FORM "%8.4" "[]" FORMULA "1.0*X" FORMULA_INV "1.0*X" /end COMPU_METHOD
/begin COMPU_METHOD defaultConversion376 "" FORM "%8.4" "[]" FORMULA "1.0*X" FORMULA_INV "1.0*X" /end COMPU_METHOD
/begin COMPU_METHOD defaultConversion377 "" FORM "%8.4" "[]" FORMULA "1.0*X" FORMULA_INV "1.0*X" /end COMPU_METHOD
/begin COMPU_METHOD defaultConversion378 "" FORM "%8.4" "[]" FORMULA "1.0*X" FORMULA_INV "1.0*X" /end COMPU_METHOD
/begin COMPU_METHOD defaultConversion379 "" FORM "%8.4" "[]" FORMULA "1.0*X" FORMULA_INV "1.0*X" /end COMPU_METHOD
/begin COMPU_METHOD defaultConversion380 "" FORM "%8.4" "[]" FORMULA "1.0*X" FORMULA_INV "1.0*X" /end COMPU_METHOD
/begin COMPU_METHOD defaultConversion381 "" FORM "%8.4" "[]" FORMULA "1.0*X" FORMULA_INV "1.0*X" /end COMPU_METHOD
/begin COMPU_METHOD defaultConversion382 "" FORM "%8.4" "[]" FORMULA "1.0*X" FORMULA_INV "1.0*X" /end COMPU_METHOD
/begin COMPU_METHOD defaultConversion383 "" FORM "%8.4" "[]" FORMULA "1.0*X" FORMULA_INV "1.0*X" /end COMPU_METHOD
/begin COMPU_METHOD defaultConversion384 "" FORM "%8.4" "[]" FORMULA "1.0*X" FORMULA_INV "1.0*X" /end COMPU_METHOD
/begin COMPU_METHOD defaultConversion385 "" FORM "%8.4" "[]" FORMULA "1.0*X" FORMULA_INV "1.0*X" /end COMPU_METHOD
/begin COMPU_METHOD defaultConversion386 "" FORM "%8.4" "[]" FORMULA "1.0*X" FORMULA_INV "1.0*X" /end COMPU_METHOD
/begin COMPU_METHOD defaultConversion387 "" FORM "%8.4" "[]" FORMULA "1.0*X" FORMULA_INV "1.0*X" /end COMPU_METHOD
/begin COMPU_METHOD defaultConversion388 "" FORM "%8.4" "[]" FORMULA "1.0*X" FORMULA_INV "1.0*X" /end COMPU_METHOD
/begin COMPU_METHOD defaultConversion389 "" FORM "%8.4" "[]" FORMULA "1.0*X" FORMULA_INV "1.0*X" /end COMPU_METHOD
/begin COMPU_METHOD defaultConversion390 "" FORM "%8.4" "[]" FORMULA "1.0*X" FORMULA_INV "1.0*X" /end COMPU_METHOD
/begin COMPU_METHOD defaultConversion391 "" FORM "%8.4" "[]" FORMULA "1.0*X" FORMULA_INV "1.0*X" /end COMPU_METHOD
/begin COMPU_METHOD defaultConversion392 "" FORM "%8.4" "[]" FORMULA "1.0*X" FORMULA_INV "1.0*X" /end COMPU_METHOD
/begin COMPU_METHOD defaultConversion393 "" FORM "%8.4" "[]" FORMULA "1.0*X" FORMULA_INV "1.0*X" /end COMPU_METHOD
/begin COMPU_METHOD defaultConversion394 "" FORM "%8.4" "[]" FORMULA "1.0*X" FORMULA_INV "1.0*X" /end COMPU_METHOD
/begin COMPU_METHOD defaultConversion395 "" FORM "%8.4" "[]" FORMULA "1.0*X" FORMULA_INV "1.0*X" /end COMPU_METHOD
/begin COMPU_METHOD defaultConversion396 "" FORM "%8.4" "[]" FORMULA "1.0*X" FORMULA_INV "1.0*X" /end COMPU_METHOD
/begin COMPU_METHOD defaultConversion397 "" FORM "%8.4" "[]" FORMULA "1.0*X" FORMULA_INV "1.0*X" /end COMPU_METHOD
/begin COMPU_METHOD defaultConversion398 "" FORM "%8.4" "[]" FORMULA "1.0*X" FORMULA_INV "1.0*X" /end COMPU_METHOD
/begin COMPU_METHOD defaultConversion399 "" FORM "%8.4" "[]" FORMULA "1.0*X" FORMULA_INV "1.0*X" /end COMPU_METHOD
/begin COMPU_METHOD defaultConversion400 "" FORM "%8.4" "[]" FORMULA "1.0*X" FORMULA_INV "1.0*X" /end COMPU_METHOD
/begin COMPU_METHOD defaultConversion401 "" FORM "%8.4" "[]" FORMULA "1.0*X" FORMULA_INV "1.0*X" /end COMPU_METHOD
/begin COMPU_METHOD defaultConversion402 "" FORM "%8.4" "[]" FORMULA "1.0*X" FORMULA_INV "1.0*X" /end COMPU_METHOD
/begin COMPU_METHOD defaultConversion403 "" FORM "%8.4" "[]" FORMULA "1.0*X" FORMULA_INV "1.0*X" /end COMPU_METHOD
/begin COMPU_METHOD defaultConversion404 "" FORM "%8.4" "[]" FORMULA "1.0*X" FORMULA_INV "1.0*X" /end COMPU_METHOD
/begin COMPU_METHOD defaultConversion405 "" FORM "%8.4" "[]" FORMULA "1.0*X" FORMULA_INV "1.0*X" /end COMPU_METHOD
/begin COMPU_METHOD defaultConversion406 "" FORM "%8.4" "[]" FORMULA "1.0*X" FORMULA_INV "1.0*X" /end COMPU_METHOD
/begin COMPU_METHOD defaultConversion407 "" FORM "%8.4" "[]" FORMULA "1.0*X" FORMULA_INV "1.0*X" /end COMPU_METHOD
/begin COMPU_METHOD defaultConversion408 "" FORM "%8.4" "[]" FORMULA "1.0*X" FORMULA_INV "1.0*X" /end COMPU_METHOD
/begin COMPU_METHOD defaultConversion409 "" FORM "%8.4" "[]" FORMULA "1.0*X" FORMULA_INV "1.0*X" /end COMPU_METHOD
/begin COMPU_METHOD defaultConversion410 "" FORM "%8.4" "[]" FORMULA "1.0*X" FORMULA_INV "1.0*X" /end COMPU_METHOD
/begin COMPU_METHOD defaultConversion411 "" FORM "%8.4" "[]" FORMULA "1.0*X" FORMULA_INV "1.0*X" /end COMPU_METHOD
/begin COMPU_METHOD defaultConversion412 "" FORM "%8.4" "[]" FORMULA "1.0*X" FORMULA_INV "1.0*X" /end COMPU_METHOD
/begin COMPU_METHOD defaultConversion413 "" FORM "%8.4" "[]" FORMULA "1.0*X" FORMULA_INV "1.0*X" /end COMPU_METHOD
/begin COMPU_METHOD defaultConversion414 "" FORM "%8.4" "[]" FORMULA "1.0*X" FORMULA_INV "1.0*X" /end COMPU_METHOD
/begin COMPU_METHOD defaultConversion415 "" FORM "%8.4" "[]" FORMULA "1.0*X" FORMULA_INV "1.0*X" /end COMPU_METHOD
/begin COMPU_METHOD defaultConversion416 "" FORM "%8.4" "[]" FORMULA "1.0*X" FORMULA_INV "1.0*X" /end COMPU_METHOD
/begin COMPU_METHOD defaultConversion417 "" FORM "%8.4" "[]" FORMULA "1.0*X" FORMULA_INV "1.0*X" /end COMPU_METHOD
/begin COMPU_METHOD defaultConversion418 "" FORM "%8.4" "[]" FORMULA "1.0*X" FORMULA_INV "1.0*X" /end COMPU_METHOD
/begin COMPU_METHOD defaultConversion419 "" FORM "%8.4" "[]" FORMULA "1.0*X" FORMULA_INV "1.0*X" /end COMPU_METHOD
/begin COMPU_METHOD defaultConversion420 "" FORM "%8.4" "[]" FORMULA "1.0*X" FORMULA_INV "1.0*X" /end COMPU_METHOD
/begin COMPU_METHOD defaultConversion421 "" FORM "%8.4" "[]" FORMULA "1.0*X" FORMULA_INV "1.0*X" /end COMPU_METHOD
/begin COMPU_METHOD defaultConversion422 "" FORM "%8.4" "[]" FORMULA "1.0*X" FORMULA_INV "1.0*X" /end COMPU_METHOD
/begin COMPU_METHOD defaultConversion423 "" FORM "%8.4" "[]" FORMULA "1.0*X" FORMULA_INV "1.0*X" /end COMPU_METHOD
/begin COMPU_METHOD defaultConversion424 "" FORM "%8.4" "[]" FORMULA "1.0*X" FORMULA_INV "1.0*X" /end COMPU_METHOD
/begin COMPU_METHOD defaultConversion425 "" FORM "%8.4" "[]" FORMULA "1.0*X" FORMULA_INV "1.0*X" /end COMPU_METHOD
/begin COMPU_METHOD defaultConversion426 "" FORM "%8.4" "[]" FORMULA "1.0*X" FORMULA_INV "1.0*X" /end COMPU_METHOD
/begin COMPU_METHOD defaultConversion427 "" FORM "%8.4" "[]" FORMULA "1.0*X" FORMULA_INV "1.0*X" /end COMPU_METHOD
/begin COMPU_METHOD defaultConversion428 "" FORM "%8.4" "[]" FORMULA "1.0*X" FORMULA_INV "1.0*X" /end COMPU_METHOD
/begin COMPU_METHOD defaultConversion429 "" FORM "%8.4" "[]" FORMULA "1.0*X" FORMULA_INV "1.0*X" /end COMPU_METHOD
/begin COMPU_METHOD defaultConversion430 "" FORM "%8.4" "[]" FORMULA "1.0*X" FORMULA_INV "1.0*X" /end COMPU_METHOD
/begin COMPU_METHOD defaultConversion431 "" FORM "%8.4" "[]" FORMULA "1.0*X" FORMULA_INV "1.0*X" /end COMPU_METHOD
/begin COMPU_METHOD defaultConversion432 "" FORM "%8.4" "[]" FORMULA "1.0*X" FORMULA_INV "1.0*X" /end COMPU_METHOD
/begin COMPU_METHOD defaultConversion433 "" FORM "%8.4" "[]" FORMULA "1.0*X" FORMULA_INV "1.0*X" /end COMPU_METHOD
/begin COMPU_METHOD defaultConversion434 "" FORM "%8.4" "[]" FORMULA "1.0*X" FORMULA_INV "1.0*X" /end COMPU_METHOD
/begin COMPU_METHOD defaultConversion435 "" FORM "%8.4" "[]" FORMULA "1.0*X" FORMULA_INV "1.0*X" /end COMPU_METHOD
/begin COMPU_METHOD defaultConversion436 "" FORM "%8.4" "[]" FORMULA "1.0*X" FORMULA_INV "1.0*X" /end COMPU_METHOD
/begin COMPU_METHOD defaultConversion437 "" FORM "%8.4" "[]" FORMULA "1.0*X" FORMULA_INV "1.0*X" /end COMPU_METHOD
/begin COMPU_METHOD defaultConversion438 "" FORM "%8.4" "[]" FORMULA "1.0*X" FORMULA_INV "1.0*X" /end COMPU_METHOD
/begin COMPU_METHOD defaultConversion439 "" FORM "%8.4" "[]" FORMULA "1.0*X" FORMULA_INV "1.0*X" /end COMPU_METHOD
/begin COMPU_METHOD defaultConversion440 "" FORM "%8.4" "[]" FORMULA "1.0*X" FORMULA_INV "1.0*X" /end COMPU_METHOD
/begin COMPU_METHOD defaultConversion441 "" FORM "%8.4" "[]" FORMULA "1.0*X" FORMULA_INV "1.0*X" /end COMPU_METHOD
/begin COMPU_METHOD defaultConversion442 "" FORM "%8.4" "[]" FORMULA "1.0*X" FORMULA_INV "1.0*X" /end COMPU_METHOD
/begin COMPU_METHOD defaultConversion443 "" FORM "%8.4" "[]" FORMULA "1.0*X" FORMULA_INV "1.0*X" /end COMPU_METHOD
/begin COMPU_METHOD defaultConversion444 "" FORM "%8.4" "[]" FORMULA "1.0*X" FORMULA_INV "1.0*X" /end COMPU_METHOD
/begin COMPU_METHOD defaultConversion445 "" FORM "%8.4" "[]" FORMULA "1.0*X" FORMULA_INV "1.0*X" /end COMPU_METHOD
/begin COMPU_METHOD defaultConversion446 "" FORM "%8.4" "[]" FORMULA "1.0*X" FORMULA_INV "1.0*X" /end COMPU_METHOD
/begin COMPU_METHOD defaultConversion447 "" FORM "%8.4" "[]" FORMULA "1.0*X" FORMULA_INV "1.0*X" /end COMPU_METHOD
/begin COMPU_METHOD defaultConversion448 "" FORM "%8.4" "[]" FORMULA "1.0*X" FORMULA_INV "1.0*X" /end COMPU_METHOD
/begin COMPU_METHOD defaultConversion449 "" FORM "%8.4" "[]" FORMULA "1.0*X" FORMULA_INV "1.0*X" /end COMPU_METHOD
/begin COMPU_METHOD defaultConversion450 "" FORM "%8.4" "[]" FORMULA "1.0*X" FORMULA_INV "1.0*X" /end COMPU_METHOD
/begin COMPU_METHOD defaultConversion451 "" FORM "%8.4" "[]" FORMULA "1.0*X" FORMULA_INV "1.0*X" /end COMPU_METHOD
/begin COMPU_METHOD defaultConversion452 "" FORM "%8.4" "[]" FORMULA "1.0*X" FORMULA_INV "1.0*X" /end COMPU_METHOD
/begin COMPU_METHOD defaultConversion453 "" FORM "%8.4" "[]" FORMULA "1.0*X" FORMULA_INV "1.0*X" /end COMPU_METHOD
/begin COMPU_METHOD defaultConversion454 "" FORM "%8.4" "[]" FORMULA "1.0*X" FORMULA_INV "1.0*X" /end COMPU_METHOD
/begin COMPU_METHOD defaultConversion455 "" FORM "%8.4" "[]" FORMULA "1.0*X" FORMULA_INV "1.0*X" /end COMPU_METHOD
/begin COMPU_METHOD defaultConversion456 "" FORM "%8.4" "[]" FORMULA "1.0*X" FORMULA_INV "1.0*X" /end COMPU_METHOD
/begin COMPU_METHOD defaultConversion457 "" FORM "%8.4" "[]" FORMULA "1.0*X" FORMULA_INV "1.0*X" /end COMPU_METHOD
/begin COMPU_METHOD defaultConversion458 "" FORM "%8.4" "[]" FORMULA "1.0*X" FORMULA_INV "1.0*X" /end COMPU_METHOD
/begin COMPU_METHOD defaultConversion459 "" FORM "%8.4" "[]" FORMULA "1.0*X" FORMULA_INV "1.0*X" /end COMPU_METHOD
/begin COMPU_METHOD defaultConversion460 "" FORM "%8.4" "[]" FORMULA "1.0*X" FORMULA_INV "1.0*X" /end COMPU_METHOD
/begin COMPU_METHOD defaultConversion461 "" FORM "%8.4" "[]" FORMULA "1.0*X" FORMULA_INV "1.0*X" /end COMPU_METHOD
/begin COMPU_METHOD defaultConversion462 "" FORM "%8.4" "[]" FORMULA "1.0*X" FORMULA_INV "1.0*X" /end COMPU_METHOD
/begin COMPU_METHOD defaultConversion463 "" FORM "%8.4" "[]" FORMULA "1.0*X" FORMULA_INV "1.0*X" /end COMPU_METHOD
/begin COMPU_METHOD defaultConversion464 "" FORM "%8.4" "[]" FORMULA "1.0*X" FORMULA_INV "1.0*X" /end COMPU_METHOD
/begin COMPU_METHOD defaultConversion465 "" FORM "%8.4" "[]" FORMULA "1.0*X" FORMULA_INV "1.0*X" /end COMPU_METHOD
/begin COMPU_METHOD defaultConversion466 "" FORM "%8.4" "[]" FORMULA "1.0*X" FORMULA_INV "1.0*X" /end COMPU_METHOD
/begin COMPU_METHOD defaultConversion467 "" FORM "%8.4" "[]" FORMULA "1.0*X" FORMULA_INV "1.0*X" /end COMPU_METHOD
/begin COMPU_METHOD defaultConversion468 "" FORM "%8.4" "[]" FORMULA "1.0*X" FORMULA_INV "1.0*X" /end COMPU_METHOD
/begin COMPU_METHOD defaultConversion469 "" FORM "%8.4" "[]" FORMULA "1.0*X" FORMULA_INV "1.0*X" /end COMPU_METHOD
/begin COMPU_METHOD defaultConversion470 "" FORM "%8.4" "[]" FORMULA "1.0*X" FORMULA_INV "1.0*X" /end COMPU_METHOD
/begin COMPU_METHOD defaultConversion471 "" FORM "%8.4" "[]" FORMULA "1.0*X" FORMULA_INV "1.0*X" /end COMPU_METHOD
/begin COMPU_METHOD defaultConversion472 "" FORM "%8.4" "[]" FORMULA "1.0*X" FORMULA_INV "1.0*X" /end COMPU_METHOD
/begin COMPU_METHOD defaultConversion473 "" FORM "%8.4" "[]" FORMULA "1.0*X" FORMULA_INV "1.0*X" /end COMPU_METHOD
/begin COMPU_METHOD defaultConversion474 "" FORM "%8.4" "[]" FORMULA "1.0*X" FORMULA_INV "1.0*X" /end COMPU_METHOD
/begin COMPU_METHOD defaultConversion475 "" FORM "%8.4" "[]" FORMULA "1.0*X" FORMULA_INV "1.0*X" /end COMPU_METHOD
/begin COMPU_METHOD defaultConversion476 "" FORM "%8.4" "[]" FORMULA "1.0*X" FORMULA_INV "1.0*X" /end COMPU_METHOD
/begin COMPU_METHOD defaultConversion477 "" FORM "%8.4" "[]" FORMULA "1.0*X" FORMULA_INV "1.0*X" /end COMPU_METHOD
/begin COMPU_METHOD defaultConversion478 "" FORM "%8.4" "[]" FORMULA "1.0*X" FORMULA_INV "1.0*X" /end COMPU_METHOD
/begin COMPU_METHOD defaultConversion479 "" FORM "%8.4" "[]" FORMULA "1.0*X" FORMULA_INV "1.0*X" /end COMPU_METHOD
/begin COMPU_METHOD defaultConversion480 "" FORM "%8.4" "[]" FORMULA "1.0*X" FORMULA_INV "1.0*X" /end COMPU_METHOD
/begin COMPU_METHOD defaultConversion481 "" FORM "%8.4" "[]" FORMULA "1.0*X" FORMULA_INV "1.0*X" /end COMPU_METHOD
/begin COMPU_METHOD defaultConversion482 "" FORM "%8.4" "[]" FORMULA "1.0*X" FORMULA_INV "1.0*X" /end COMPU_METHOD
/begin COMPU_METHOD defaultConversion483 "" FORM "%8.4" "[]" FORMULA "1.0*X" FORMULA_INV "1.0*X" /end COMPU_METHOD
/begin COMPU_METHOD defaultConversion484 "" FORM "%8.4" "[]" FORMULA "1.0*X" FORMULA_INV "1.0*X" /end COMPU_METHOD
/begin COMPU_METHOD defaultConversion485 "" FORM "%8.4" "[]" FORMULA "1.0*X" FORMULA_INV "1.0*X" /end COMPU_METHOD
/begin COMPU_METHOD defaultConversion486 "" FORM "%8.4" "[]" FORMULA "1.0*X" FORMULA_INV "1.0*X" /end COMPU_METHOD
/begin COMPU_METHOD defaultConversion487 "" FORM "%8.4" "[]" FORMULA "1.0*X" FORMULA_INV "1.0*X" /end COMPU_METHOD
/begin COMPU_METHOD defaultConversion488 "" FORM "%8.4" "[]" FORMULA "1.0*X" FORMULA_INV "1.0*X" /end COMPU_METHOD
/begin COMPU_METHOD defaultConversion489 "" FORM "%8.4" "[]" FORMULA "1.0*X" FORMULA_INV "1.0*X" /end COMPU_METHOD
/begin COMPU_METHOD defaultConversion490 "" FORM "%8.4" "[]" FORMULA "1.0*X" FORMULA_INV "1.0*X" /end COMPU_METHOD
/begin COMPU_METHOD defaultConversion491 "" FORM "%8.4" "[]" FORMULA "1.0*X" FORMULA_INV "1.0*X" /end COMPU_METHOD
/begin COMPU_METHOD defaultConversion492 "" FORM "%8.4" "[]" FORMULA "1.0*X" FORMULA_INV "1.0*X" /end COMPU_METHOD
/begin COMPU_METHOD defaultConversion493 "" FORM "%8.4" "[]" FORMULA "1.0*X" FORMULA_INV "1.0*X" /end COMPU_METHOD
/begin COMPU_METHOD defaultConversion494 "" FORM "%8.4" "[]" FORMULA "1.0*X" FORMULA_INV "1.0*X" /end COMPU_METHOD
/begin COMPU_METHOD defaultConversion495 "" FORM "%8.4" "[]" FORMULA "1.0*X" FORMULA_INV "1.0*X" /end COMPU_METHOD
/begin COMPU_METHOD defaultConversion496 "" FORM "%8.4" "[]" FORMULA "1.0*X" FORMULA_INV "1.0*X" /end COMPU_METHOD
/begin COMPU_METHOD defaultConversion497 "" FORM "%8.4" "[]" FORMULA "1.0*X" FORMULA_INV "1.0*X" /end COMPU_METHOD
/begin COMPU_METHOD defaultConversion498 "" FORM "%8.4" "[]" FORMULA "1.0*X" FORMULA_INV "1.0*X" /end COMPU_METHOD
/begin COMPU_METHOD defaultConversion499 "" FORM "%8.4" "[]" FORMULA "1.0*X" FORMULA_INV "1.0*X" /end COMPU_METHOD
/begin COMPU_METHOD defaultConversion500 "" FORM "%8.4" "[]" FORMULA "1.0*X" FORMULA_INV "1.0*X" /end COMPU_METHOD
/begin COMPU_METHOD defaultConversion501 "" FORM "%8.4" "[]" FORMULA "1.0*X" FORMULA_INV "1.0*X" /end COMPU_METHOD
/begin COMPU_METHOD defaultConversion502 "" FORM "%8.4" "[]" FORMULA "1.0*X" FORMULA_INV "1.0*X" /end COMPU_METHOD
/begin COMPU_METHOD defaultConversion503 "" FORM "%8.4" "[]" FORMULA "1.0*X" FORMULA_INV "1.0*X" /end COMPU_METHOD
/begin COMPU_METHOD defaultConversion504 "" FORM "%8.4" "[]" FORMULA "1.0*X" FORMULA_INV "1.0*X" /end COMPU_METHOD
/begin COMPU_METHOD defaultConversion505 "" FORM "%8.4" "[]" FORMULA "1.0*X" FORMULA_INV "1.0*X" /end COMPU_METHOD
/begin COMPU_METHOD defaultConversion506 "" FORM "%8.4" "[]" FORMULA "1.0*X" FORMULA_INV "1.0*X" /end COMPU_METHOD
/begin COMPU_METHOD defaultConversion507 "" FORM "%8.4" "[]" FORMULA "1.0*X" FORMULA_INV "1.0*X" /end COMPU_METHOD
/begin COMPU_METHOD defaultConversion508 "" FORM "%8.4" "[]" FORMULA "1.0*X" FORMULA_INV "1.0*X" /end COMPU_METHOD
/begin COMPU_METHOD defaultConversion509 "" FORM "%8.4" "[]" FORMULA "1.0*X" FORMULA_INV "1.0*X" /end COMPU_METHOD
/begin COMPU_METHOD defaultConversion510 "" FORM "%8.4" "[]" FORMULA "1.0*X" FORMULA_INV "1.0*X" /end COMPU_METHOD
/begin COMPU_METHOD defaultConversion511 "" FORM "%8.4" "[]" FORMULA "1.0*X" FORMULA_INV "1.0*X" /end COMPU_METHOD
/begin COMPU_METHOD defaultConversion512 "" FORM "%8.4" "[]" FORMULA "1.0*X" FORMULA_INV "1.0*X" /end COMPU_METHOD
/begin COMPU_METHOD defaultConversion513 "" FORM "%8.4" "[]" FORMULA "1.0*X" FORMULA_INV "1.0*X" /end COMPU_METHOD
/begin COMPU_METHOD defaultConversion514 "" FORM "%8.4" "[]" FORMULA "1.0*X" FORMULA_INV "1.0*X" /end COMPU_METHOD
/begin COMPU_METHOD defaultConversion515 "" FORM "%8.4" "[]" FORMULA "1.0*X" FORMULA_INV "1.0*X" /end COMPU_METHOD
/begin COMPU_METHOD defaultConversion516 "" FORM "%8.4" "[]" FORMULA "1.0*X" FORMULA_INV "1.0*X" /end COMPU_METHOD
/begin COMPU_METHOD defaultConversion517 "" FORM "%8.4" "[]" FORMULA "1.0*X" FORMULA_INV "1.0*X" /end COMPU_METHOD
/begin COMPU_METHOD defaultConversion518 "" FORM "%8.4" "[]" FORMULA "1.0*X" FORMULA_INV "1.0*X" /end COMPU_METHOD
/begin COMPU_METHOD defaultConversion519 "" FORM "%8.4" "[]" FORMULA "1.0*X" FORMULA_INV "1.0*X" /end COMPU_METHOD
/begin COMPU_METHOD defaultConversion520 "" FORM "%8.4" "[]" FORMULA "1.0*X" FORMULA_INV "1.0*X" /end COMPU_METHOD
/begin COMPU_METHOD defaultConversion521 "" FORM "%8.4" "[]" FORMULA "1.0*X" FORMULA_INV "1.0*X" /end COMPU_METHOD
/begin COMPU_METHOD defaultConversion522 "" FORM "%8.4" "[]" FORMULA "1.0*X" FORMULA_INV "1.0*X" /end COMPU_METHOD
/begin COMPU_METHOD defaultConversion523 "" FORM "%8.4" "[]" FORMULA "1.0*X" FORMULA_INV "1.0*X" /end COMPU_METHOD
/begin COMPU_METHOD defaultConversion524 "" FORM "%8.4" "[]" FORMULA "1.0*X" FORMULA_INV "1.0*X" /end COMPU_METHOD
/begin COMPU_METHOD defaultConversion525 "" FORM "%8.4" "[]" FORMULA "1.0*X" FORMULA_INV "1.0*X" /end COMPU_METHOD
/begin COMPU_METHOD defaultConversion526 "" FORM "%8.4" "[]" FORMULA "1.0*X" FORMULA_INV "1.0*X" /end COMPU_METHOD
/begin COMPU_METHOD defaultConversion527 "" FORM "%8.4" "[]" FORMULA "1.0*X" FORMULA_INV "1.0*X" /end COMPU_METHOD
/begin COMPU_METHOD defaultConversion528 "" FORM "%8.4" "[]" FORMULA "1.0*X" FORMULA_INV "1.0*X" /end COMPU_METHOD
/begin COMPU_METHOD defaultConversion529 "" FORM "%8.4" "[]" FORMULA "1.0*X" FORMULA_INV "1.0*X" /end COMPU_METHOD
/begin COMPU_METHOD defaultConversion530 "" FORM "%8.4" "[]" FORMULA "1.0*X" FORMULA_INV "1.0*X" /end COMPU_METHOD
/begin COMPU_METHOD defaultConversion531 "" FORM "%8.4" "[]" FORMULA "1.0*X" FORMULA_INV "1.0*X" /end COMPU_METHOD
/begin COMPU_METHOD defaultConversion532 "" FORM "%8.4" "[]" FORMULA "1.0*X" FORMULA_INV "1.0*X" /end COMPU_METHOD
/begin COMPU_METHOD defaultConversion533 "" FORM "%8.4" "[]" FORMULA "1.0*X" FORMULA_INV "1.0*X" /end COMPU_METHOD
/begin COMPU_METHOD defaultConversion534 "" FORM "%8.4" "[]" FORMULA "1.0*X" FORMULA_INV "1.0*X" /end COMPU_METHOD
/begin COMPU_METHOD defaultConversion535 "" FORM "%8.4" "[]" FORMULA "1.0*X" FORMULA_INV "1.0*X" /end COMPU_METHOD
/begin COMPU_METHOD defaultConversion536 "" FORM "%8.4" "[]" FORMULA "1.0*X" FORMULA_INV "1.0*X" /end COMPU_METHOD
/begin COMPU_METHOD defaultConversion537 "" FORM "%8.4" "[]" FORMULA "1.0*X" FORMULA_INV "1.0*X" /end COMPU_METHOD
/begin COMPU_METHOD defaultConversion538 "" FORM "%8.4" "[]" FORMULA "1.0*X" FORMULA_INV "1.0*X" /end COMPU_METHOD
/begin COMPU_METHOD defaultConversion539 "" FORM "%8.4" "[]" FORMULA "1.0*X" FORMULA_INV "1.0*X" /end COMPU_METHOD
/begin COMPU_METHOD defaultConversion540 "" FORM "%8.4" "[]" FORMULA "1.0*X" FORMULA_INV "1.0*X" /end COMPU_METHOD
/begin COMPU_METHOD defaultConversion541 "" FORM "%8.4" "[]" FORMULA "1.0*X" FORMULA_INV "1.0*X" /end COMPU_METHOD
/begin COMPU_METHOD defaultConversion542 "" FORM "%8.4" "[]" FORMULA "1.0*X" FORMULA_INV "1.0*X" /end COMPU_METHOD
/begin COMPU_METHOD defaultConversion543 "" FORM "%8.4" "[]" FORMULA "1.0*X" FORMULA_INV "1.0*X" /end COMPU_METHOD
/begin COMPU_METHOD defaultConversion544 "" FORM "%8.4" "[]" FORMULA "1.0*X" FORMULA_INV "1.0*X" /end COMPU_METHOD
/begin COMPU_METHOD defaultConversion545 "" FORM "%8.4" "[]" FORMULA "1.0*X" FORMULA_INV "1.0*X" /end COMPU_METHOD
/begin COMPU_METHOD defaultConversion546 "" FORM "%8.4" "[]" FORMULA "1.0*X" FORMULA_INV "1.0*X" /end COMPU_METHOD
/begin COMPU_METHOD defaultConversion547 "" FORM "%8.4" "[]" FORMULA "1.0*X" FORMULA_INV "1.0*X" /end COMPU_METHOD
/begin COMPU_METHOD defaultConversion548 "" FORM "%8.4" "[]" FORMULA "1.0*X" FORMULA_INV "1.0*X" /end COMPU_METHOD
/begin COMPU_METHOD defaultConversion549 "" FORM "%8.4" "[]" FORMULA "1.0*X" FORMULA_INV "1.0*X" /end COMPU_METHOD
/begin COMPU_METHOD defaultConversion550 "" FORM "%8.4" "[]" FORMULA "1.0*X" FORMULA_INV "1.0*X" /end COMPU_METHOD
/begin COMPU_METHOD defaultConversion551 "" FORM "%8.4" "[]" FORMULA "1.0*X" FORMULA_INV "1.0*X" /end COMPU_METHOD
/begin COMPU_METHOD defaultConversion552 "" FORM "%8.4" "[]" FORMULA "1.0*X" FORMULA_INV "1.0*X" /end COMPU_METHOD
/begin COMPU_METHOD defaultConversion553 "" FORM "%8.4" "[]" FORMULA "1.0*X" FORMULA_INV "1.0*X" /end COMPU_METHOD
/begin COMPU_METHOD defaultConversion554 "" FORM "%8.4" "[]" FORMULA "1.0*X" FORMULA_INV "1.0*X" /end COMPU_METHOD
/begin COMPU_METHOD defaultConversion555 "" FORM "%8.4" "[]" FORMULA "1.0*X" FORMULA_INV "1.0*X" /end COMPU_METHOD
/begin COMPU_METHOD defaultConversion556 "" FORM "%8.4" "[]" FORMULA "1.0*X" FORMULA_INV "1.0*X" /end COMPU_METHOD
/begin COMPU_METHOD defaultConversion557 "" FORM "%8.4" "[]" FORMULA "1.0*X" FORMULA_INV "1.0*X" /end COMPU_METHOD
/begin COMPU_METHOD defaultConversion558 "" FORM "%8.4" "[]" FORMULA "1.0*X" FORMULA_INV "1.0*X" /end COMPU_METHOD
/begin COMPU_METHOD defaultConversion559 "" FORM "%8.4" "[]" FORMULA "1.0*X" FORMULA_INV "1.0*X" /end COMPU_METHOD
/begin COMPU_METHOD defaultConversion560 "" FORM "%8.4" "[]" FORMULA "1.0*X" FORMULA_INV "1.0*X" /end COMPU_METHOD
/begin COMPU_METHOD defaultConversion561 "" FORM "%8.4" "[]" FORMULA "1.0*X" FORMULA_INV "1.0*X" /end COMPU_METHOD
/begin COMPU_METHOD defaultConversion562 "" FORM "%8.4" "[]" FORMULA "1.0*X" FORMULA_INV "1.0*X" /end COMPU_METHOD
/begin COMPU_METHOD defaultConversion563 "" FORM "%8.4" "[]" FORMULA "1.0*X" FORMULA_INV "1.0*X" /end COMPU_METHOD
/begin COMPU_METHOD defaultConversion564 "" FORM "%8.4" "[]" FORMULA "1.0*X" FORMULA_INV "1.0*X" /end COMPU_METHOD
/begin COMPU_METHOD defaultConversion565 "" FORM "%8.4" "[]" FORMULA "1.0*X" FORMULA_INV "1.0*X" /end COMPU_METHOD
/begin COMPU_METHOD defaultConversion566 "" FORM "%8.4" "[]" FORMULA "1.0*X" FORMULA_INV "1.0*X" /end COMPU_METHOD
/begin COMPU_METHOD defaultConversion567 "" FORM "%8.4" "[]" FORMULA "1.0*X" FORMULA_INV "1.0*X" /end COMPU_METHOD
/begin COMPU_METHOD defaultConversion568 "" FORM "%8.4" "[]" FORMULA "1.0*X" FORMULA_INV "1.0*X" /end COMPU_METHOD
/begin COMPU_METHOD defaultConversion569 "" FORM "%8.4" "[]" FORMULA "1.0*X" FORMULA_INV "1.0*X" /end COMPU_METHOD
/begin COMPU_METHOD defaultConversion570 "" FORM "%8.4" "[]" FORMULA "1.0*X" FORMULA_INV "1.0*X" /end COMPU_METHOD
/begin COMPU_METHOD defaultConversion571 "" FORM "%8.4" "[]" FORMULA "1.0*X" FORMULA_INV "1.0*X" /end COMPU_METHOD
/begin COMPU_METHOD defaultConversion572 "" FORM "%8.4" "[]" FORMULA "1.0*X" FORMULA_INV "1.0*X" /end COMPU_METHOD
/begin COMPU_METHOD defaultConversion573 "" FORM "%8.4" "[]" FORMULA "1.0*X" FORMULA_INV "1.0*X" /end COMPU_METHOD
/begin COMPU_METHOD defaultConversion574 "" FORM "%8.4" "[]" FORMULA "1.0*X" FORMULA_INV "1.0*X" /end COMPU_METHOD
/begin COMPU_METHOD defaultConversion575 "" FORM "%8.4" "[]" FORMULA "1.0*X" FORMULA_INV "1.0*X" /end COMPU_METHOD
/begin COMPU_METHOD defaultConversion576 "" FORM "%8.4" "[]" FORMULA "1.0*X" FORMULA_INV "1.0*X" /end COMPU_METHOD
/begin COMPU_METHOD defaultConversion577 "" FORM "%8.4" "[]" FORMULA "1.0*X" FORMULA_INV "1.0*X" /end COMPU_METHOD
/begin COMPU_METHOD defaultConversion578 "" FORM "%8.4" "[]" FORMULA "1.0*X" FORMULA_INV "1.0*X" /end COMPU_METHOD
/begin COMPU_METHOD defaultConversion579 "" FORM "%8.4" "[]" FORMULA "1.0*X" FORMULA_INV "1.0*X" /end COMPU_METHOD
/begin COMPU_METHOD defaultConversion580 "" FORM "%8.4" "[]" FORMULA "1.0*X" FORMULA_INV "1.0*X" /end COMPU_METHOD
/begin COMPU_METHOD defaultConversion581 "" FORM "%8.4" "[]" FORMULA "1.0*X" FORMULA_INV "1.0*X" /end COMPU_METHOD
/begin COMPU_METHOD defaultConversion582 "" FORM "%8.4" "[]" FORMULA "1.0*X" FORMULA_INV "1.0*X" /end COMPU_METHOD
/begin COMPU_METHOD defaultConversion583 "" FORM "%8.4" "[]" FORMULA "1.0*X" FORMULA_INV "1.0*X" /end COMPU_METHOD
/begin COMPU_METHOD defaultConversion584 "" FORM "%8.4" "[]" FORMULA "1.0*X" FORMULA_INV "1.0*X" /end COMPU_METHOD
/begin COMPU_METHOD defaultConversion585 "" FORM "%8.4" "[]" FORMULA "1.0*X" FORMULA_INV "1.0*X" /end COMPU_METHOD
/begin COMPU_METHOD defaultConversion586 "" FORM "%8.4" "[]" FORMULA "1.0*X" FORMULA_INV "1.0*X" /end COMPU_METHOD
/begin COMPU_METHOD defaultConversion587 "" FORM "%8.4" "[]" FORMULA "1.0*X" FORMULA_INV "1.0*X" /end COMPU_METHOD
/begin COMPU_METHOD defaultConversion588 "" FORM "%8.4" "[]" FORMULA "1.0*X" FORMULA_INV "1.0*X" /end COMPU_METHOD
/begin COMPU_METHOD defaultConversion589 "" FORM "%8.4" "[]" FORMULA "1.0*X" FORMULA_INV "1.0*X" /end COMPU_METHOD
/begin COMPU_METHOD defaultConversion590 "" FORM "%8.4" "[]" FORMULA "1.0*X" FORMULA_INV "1.0*X" /end COMPU_METHOD
/begin COMPU_METHOD defaultConversion591 "" FORM "%8.4" "[]" FORMULA "1.0*X" FORMULA_INV "1.0*X" /end COMPU_METHOD
/begin COMPU_METHOD defaultConversion592 "" FORM "%8.4" "[]" FORMULA "1.0*X" FORMULA_INV "1.0*X" /end COMPU_METHOD
/begin COMPU_METHOD defaultConversion593 "" FORM "%8.4" "[]" FORMULA "1.0*X" FORMULA_INV "1.0*X" /end COMPU_METHOD
/begin COMPU_METHOD defaultConversion594 "" FORM "%8.4" "[]" FORMULA "1.0*X" FORMULA_INV "1.0*X" /end COMPU_METHOD
/begin COMPU_METHOD defaultConversion595 "" FORM "%8.4" "[]" FORMULA "1.0*X" FORMULA_INV "1.0*X" /end COMPU_METHOD
/begin COMPU_METHOD defaultConversion596 "" FORM "%8.4" "[]" FORMULA "1.0*X" FORMULA_INV "1.0*X" /end COMPU_METHOD
/begin COMPU_METHOD defaultConversion597 "" FORM "%8.4" "[]" FORMULA "1.0*X" FORMULA_INV "1.0*X" /end COMPU_METHOD
/begin COMPU_METHOD defaultConversion598 "" FORM "%8.4" "[]" FORMULA "1.0*X" FORMULA_INV "1.0*X" /end COMPU_METHOD
/begin COMPU_METHOD defaultConversion599 "" FORM "%8.4" "[]" FORMULA "1.0*X" FORMULA_INV "1.0*X" /end COMPU_METHOD
/begin COMPU_METHOD defaultConversion600 "" FORM "%8.4" "[]" FORMULA "1.0*X" FORMULA_INV "1.0*X" /end COMPU_METHOD
/begin COMPU_METHOD defaultConversion601 "" FORM "%8.4" "[]" FORMULA "1.0*X" FORMULA_INV "1.0*X" /end COMPU_METHOD
/begin COMPU_METHOD defaultConversion602 "" FORM "%8.4" "[]" FORMULA "1.0*X" FORMULA_INV "1.0*X" /end COMPU_METHOD
/begin COMPU_METHOD defaultConversion603 "" FORM "%8.4" "[]" FORMULA "1.0*X" FORMULA_INV "1.0*X" /end COMPU_METHOD
/begin COMPU_METHOD defaultConversion604 "" FORM "%8.4" "[]" FORMULA "1.0*X" FORMULA_INV "1.0*X" /end COMPU_METHOD
/begin COMPU_METHOD defaultConversion605 "" FORM "%8.4" "[]" FORMULA "1.0*X" FORMULA_INV "1.0*X" /end COMPU_METHOD
/begin COMPU_METHOD defaultConversion606 "" FORM "%8.4" "[]" FORMULA "1.0*X" FORMULA_INV "1.0*X" /end COMPU_METHOD
/begin COMPU_METHOD defaultConversion607 "" FORM "%8.4" "[]" FORMULA "1.0*X" FORMULA_INV "1.0*X" /end COMPU_METHOD
/begin COMPU_METHOD defaultConversion608 "" FORM "%8.4" "[]" FORMULA "1.0*X" FORMULA_INV "1.0*X" /end COMPU_METHOD
/begin COMPU_METHOD defaultConversion609 "" FORM "%8.4" "[]" FORMULA "1.0*X" FORMULA_INV "1.0*X" /end COMPU_METHOD
/begin COMPU_METHOD defaultConversion610 "" FORM "%8.4" "[]" FORMULA "1.0*X" FORMULA_INV "1.0*X" /end COMPU_METHOD
/begin COMPU_METHOD defaultConversion611 "" FORM "%8.4" "[]" FORMULA "1.0*X" FORMULA_INV "1.0*X" /end COMPU_METHOD
/begin COMPU_METHOD defaultConversion612 "" FORM "%8.4" "[]" FORMULA "1.0*X" FORMULA_INV "1.0*X" /end COMPU_METHOD
/begin COMPU_METHOD defaultConversion613 "" FORM "%8.4" "[]" FORMULA "1.0*X" FORMULA_INV "1.0*X" /end COMPU_METHOD
/begin COMPU_METHOD defaultConversion614 "" FORM "%8.4" "[]" FORMULA "1.0*X" FORMULA_INV "1.0*X" /end COMPU_METHOD
/begin COMPU_METHOD defaultConversion615 "" FORM "%8.4" "[]" FORMULA "1.0*X" FORMULA_INV "1.0*X" /end COMPU_METHOD
/begin COMPU_METHOD defaultConversion616 "" FORM "%8.4" "[]" FORMULA "1.0*X" FORMULA_INV "1.0*X" /end COMPU_METHOD
/begin COMPU_METHOD defaultConversion617 "" FORM "%8.4" "[]" FORMULA "1.0*X" FORMULA_INV "1.0*X" /end COMPU_METHOD
/begin COMPU_METHOD defaultConversion618 "" FORM "%8.4" "[]" FORMULA "1.0*X" FORMULA_INV "1.0*X" /end COMPU_METHOD
/begin COMPU_METHOD defaultConversion619 "" FORM "%8.4" "[]" FORMULA "1.0*X" FORMULA_INV "1.0*X" /end COMPU_METHOD
/begin COMPU_METHOD defaultConversion620 "" FORM "%8.4" "[]" FORMULA "1.0*X" FORMULA_INV "1.0*X" /end COMPU_METHOD
/begin COMPU_METHOD defaultConversion621 "" FORM "%8.4" "[]" FORMULA "1.0*X" FORMULA_INV "1.0*X" /end COMPU_METHOD
/begin COMPU_METHOD defaultConversion622 "" FORM "%8.4" "[]" FORMULA "1.0*X" FORMULA_INV "1.0*X" /end COMPU_METHOD
/begin COMPU_METHOD defaultConversion623 "" FORM "%8.4" "[]" FORMULA "1.0*X" FORMULA_INV "1.0*X" /end COMPU_METHOD
/begin COMPU_METHOD defaultConversion624 "" FORM "%8.4" "[]" FORMULA "1.0*X" FORMULA_INV "1.0*X" /end COMPU_METHOD
/begin COMPU_METHOD defaultConversion625 "" FORM "%8.4" "[]" FORMULA "1.0*X" FORMULA_INV "1.0*X" /end COMPU_METHOD
/begin COMPU_METHOD defaultConversion626 "" FORM "%8.4" "[]" FORMULA "1.0*X" FORMULA_INV "1.0*X" /end COMPU_METHOD
/begin COMPU_METHOD defaultConversion627 "" FORM "%8.4" "[]" FORMULA "1.0*X" FORMULA_INV "1.0*X" /end COMPU_METHOD
/begin COMPU_METHOD defaultConversion628 "" FORM "%8.4" "[]" FORMULA "1.0*X" FORMULA_INV "1.0*X" /end COMPU_METHOD
/begin COMPU_METHOD defaultConversion629 "" FORM "%8.4" "[]" FORMULA "1.0*X" FORMULA_INV "1.0*X" /end COMPU_METHOD
/begin COMPU_METHOD defaultConversion630 "" FORM "%8.4" "[]" FORMULA "1.0*X" FORMULA_INV "1.0*X" /end COMPU_METHOD
/begin COMPU_METHOD defaultConversion631 "" FORM "%8.4" "[]" FORMULA "1.0*X" FORMULA_INV "1.0*X" /end COMPU_METHOD
/begin COMPU_METHOD defaultConversion632 "" FORM "%8.4" "[]" FORMULA "1.0*X" FORMULA_INV "1.0*X" /end COMPU_METHOD
/begin COMPU_METHOD defaultConversion633 "" FORM "%8.4" "[]" FORMULA "1.0*X" FORMULA_INV "1.0*X" /end COMPU_METHOD
/begin COMPU_METHOD defaultConversion634 "" FORM "%8.4" "[]" FORMULA "1.0*X" FORMULA_INV "1.0*X" /end COMPU_METHOD
/begin COMPU_METHOD defaultConversion635 "" FORM "%8.4" "[]" FORMULA "1.0*X" FORMULA_INV "1.0*X" /end COMPU_METHOD
/begin COMPU_METHOD defaultConversion636 "" FORM "%8.4" "[]" FORMULA "1.0*X" FORMULA_INV "1.0*X" /end COMPU_METHOD
/begin COMPU_METHOD defaultConversion637 "" FORM "%8.4" "[]" FORMULA "1.0*X" FORMULA_INV "1.0*X" /end COMPU_METHOD
/begin COMPU_METHOD defaultConversion638 "" FORM "%8.4" "[]" FORMULA "1.0*X" FORMULA_INV "1.0*X" /end COMPU_METHOD
/begin COMPU_METHOD defaultConversion639 "" FORM "%8.4" "[]" FORMULA "1.0*X" FORMULA_INV "1.0*X" /end COMPU_METHOD
/begin COMPU_METHOD defaultConversion640 "" FORM "%8.4" "[]" FORMULA "1.0*X" FORMULA_INV "1.0*X" /end COMPU_METHOD
/begin COMPU_METHOD defaultConversion641 "" FORM "%8.4" "[]" FORMULA "1.0*X" FORMULA_INV "1.0*X" /end COMPU_METHOD
/begin COMPU_METHOD defaultConversion642 "" FORM "%8.4" "[]" FORMULA "1.0*X" FORMULA_INV "1.0*X" /end COMPU_METHOD
/begin COMPU_METHOD defaultConversion643 "" FORM "%8.4" "[]" FORMULA "1.0*X" FORMULA_INV "1.0*X" /end COMPU_METHOD
/begin COMPU_METHOD defaultConversion644 "" FORM "%8.4" "[]" FORMULA "1.0*X" FORMULA_INV "1.0*X" /end COMPU_METHOD
/begin COMPU_METHOD defaultConversion645 "" FORM "%8.4" "[]" FORMULA "1.0*X" FORMULA_INV "1.0*X" /end COMPU_METHOD
/begin COMPU_METHOD defaultConversion646 "" FORM "%8.4" "[]" FORMULA "1.0*X" FORMULA_INV "1.0*X" /end COMPU_METHOD
/begin COMPU_METHOD defaultConversion647 "" FORM "%8.4" "[]" FORMULA "1.0*X" FORMULA_INV "1.0*X" /end COMPU_METHOD
/begin COMPU_METHOD defaultConversion648 "" FORM "%8.4" "[]" FORMULA "1.0*X" FORMULA_INV "1.0*X" /end COMPU_METHOD
/begin COMPU_METHOD defaultConversion649 "" FORM "%8.4" "[]" FORMULA "1.0*X" FORMULA_INV "1.0*X" /end COMPU_METHOD
/begin COMPU_METHOD defaultConversion650 "" FORM "%8.4" "[]" FORMULA "1.0*X" FORMULA_INV "1.0*X" /end COMPU_METHOD
/begin COMPU_METHOD defaultConversion651 "" FORM "%8.4" "[]" FORMULA "1.0*X" FORMULA_INV "1.0*X" /end COMPU_METHOD
/begin COMPU_METHOD defaultConversion652 "" FORM "%8.4" "[]" FORMULA "1.0*X" FORMULA_INV "1.0*X" /end COMPU_METHOD
/begin COMPU_METHOD defaultConversion653 "" FORM "%8.4" "[]" FORMULA "1.0*X" FORMULA_INV "1.0*X" /end COMPU_METHOD
/begin COMPU_METHOD defaultConversion654 "" FORM "%8.4" "[]" FORMULA "1.0*X" FORMULA_INV "1.0*X" /end COMPU_METHOD
/begin COMPU_METHOD defaultConversion655 "" FORM "%8.4" "[]" FORMULA "1.0*X" FORMULA_INV "1.0*X" /end COMPU_METHOD
/begin COMPU_METHOD defaultConversion656 "" FORM "%8.4" "[]" FORMULA "1.0*X" FORMULA_INV "1.0*X" /end COMPU_METHOD
/begin COMPU_METHOD defaultConversion657 "" FORM "%8.4" "[]" FORMULA "1.0*X" FORMULA_INV "1.0*X" /end COMPU_METHOD
/begin COMPU_METHOD defaultConversion658 "" FORM "%8.4" "[]" FORMULA "1.0*X" FORMULA_INV "1.0*X" /end COMPU_METHOD
/begin COMPU_METHOD defaultConversion659 "" FORM "%8.4" "[]" FORMULA "1.0*X" FORMULA_INV "1.0*X" /end COMPU_METHOD
/begin COMPU_METHOD defaultConversion660 "" FORM "%8.4" "[]" FORMULA "1.0*X" FORMULA_INV "1.0*X" /end COMPU_METHOD
/begin COMPU_METHOD defaultConversion661 "" FORM "%8.4" "[]" FORMULA "1.0*X" FORMULA_INV "1.0*X" /end COMPU_METHOD
/begin COMPU_METHOD defaultConversion662 "" FORM "%8.4" "[]" FORMULA "1.0*X" FORMULA_INV "1.0*X" /end COMPU_METHOD
/begin COMPU_METHOD defaultConversion663 "" FORM "%8.4" "[]" FORMULA "1.0*X" FORMULA_INV "1.0*X" /end COMPU_METHOD
/begin COMPU_METHOD defaultConversion664 "" FORM "%8.4" "[]" FORMULA "1.0*X" FORMULA_INV "1.0*X" /end COMPU_METHOD
/begin COMPU_METHOD defaultConversion665 "" FORM "%8.4" "[]" FORMULA "1.0*X" FORMULA_INV "1.0*X" /end COMPU_METHOD
/begin COMPU_METHOD defaultConversion666 "" FORM "%8.4" "[]" FORMULA "1.0*X" FORMULA_INV "1.0*X" /end COMPU_METHOD
/begin COMPU_METHOD defaultConversion667 "" FORM "%8.4" "[]" FORMULA "1.0*X" FORMULA_INV "1.0*X" /end COMPU_METHOD
/begin COMPU_METHOD defaultConversion668 "" FORM "%8.4" "[]" FORMULA "1.0*X" FORMULA_INV "1.0*X" /end COMPU_METHOD
/begin COMPU_METHOD defaultConversion669 "" FORM "%8.4" "[]" FORMULA "1.0*X" FORMULA_INV "1.0*X" /end COMPU_METHOD
/begin COMPU_METHOD defaultConversion670 "" FORM "%8.4" "[]" FORMULA "1.0*X" FORMULA_INV "1.0*X" /end COMPU_METHOD
/begin COMPU_METHOD defaultConversion671 "" FORM "%8.4" "[]" FORMULA "1.0*X" FORMULA_INV "1.0*X" /end COMPU_METHOD
/begin COMPU_METHOD defaultConversion672 "" FORM "%8.4" "[]" FORMULA "1.0*X" FORMULA_INV "1.0*X" /end COMPU_METHOD
/begin COMPU_METHOD defaultConversion673 "" FORM "%8.4" "[]" FORMULA "1.0*X" FORMULA_INV "1.0*X" /end COMPU_METHOD
/begin COMPU_METHOD defaultConversion674 "" FORM "%8.4" "[]" FORMULA "1.0*X" FORMULA_INV "1.0*X" /end COMPU_METHOD
/begin COMPU_METHOD defaultConversion675 "" FORM "%8.4" "[]" FORMULA "1.0*X" FORMULA_INV "1.0*X" /end COMPU_METHOD
/begin COMPU_METHOD defaultConversion676 "" FORM "%8.4" "[]" FORMULA "1.0*X" FORMULA_INV "1.0*X" /end COMPU_METHOD
/begin COMPU_METHOD defaultConversion677 "" FORM "%8.4" "[]" FORMULA "1.0*X" FORMULA_INV "1.0*X" /end COMPU_METHOD
/begin COMPU_METHOD defaultConversion678 "" FORM "%8.4" "[]" FORMULA "1.0*X" FORMULA_INV "1.0*X" /end COMPU_METHOD
/begin COMPU_METHOD defaultConversion679 "" FORM "%8.4" "[]" FORMULA "1.0*X" FORMULA_INV "1.0*X" /end COMPU_METHOD
/begin COMPU_METHOD defaultConversion680 "" FORM "%8.4" "[]" FORMULA "1.0*X" FORMULA_INV "1.0*X" /end COMPU_METHOD
/begin COMPU_METHOD defaultConversion681 "" FORM "%8.4" "[]" FORMULA "1.0*X" FORMULA_INV "1.0*X" /end COMPU_METHOD
/begin COMPU_METHOD defaultConversion682 "" FORM "%8.4" "[]" FORMULA "1.0*X" FORMULA_INV "1.0*X" /end COMPU_METHOD
/begin COMPU_METHOD defaultConversion683 "" FORM "%8.4" "[]" FORMULA "1.0*X" FORMULA_INV "1.0*X" /end COMPU_METHOD
/begin COMPU_METHOD defaultConversion684 "" FORM "%8.4" "[]" FORMULA "1.0*X" FORMULA_INV "1.0*X" /end COMPU_METHOD
/begin COMPU_METHOD defaultConversion685 "" FORM "%8.4" "[]" FORMULA "1.0*X" FORMULA_INV "1.0*X" /end COMPU_METHOD
/begin COMPU_METHOD defaultConversion686 "" FORM "%8.4" "[]" FORMULA "1.0*X" FORMULA_INV "1.0*X" /end COMPU_METHOD
/begin COMPU_METHOD defaultConversion687 "" FORM "%8.4" "[]" FORMULA "1.0*X" FORMULA_INV "1.0*X" /end COMPU_METHOD
/begin COMPU_METHOD defaultConversion688 "" FORM "%8.4" "[]" FORMULA "1.0*X" FORMULA_INV "1.0*X" /end COMPU_METHOD
/begin COMPU_METHOD defaultConversion689 "" FORM "%8.4" "[]" FORMULA "1.0*X" FORMULA_INV "1.0*X" /end COMPU_METHOD
/begin COMPU_METHOD defaultConversion690 "" FORM "%8.4" "[]" FORMULA "1.0*X" FORMULA_INV "1.0*X" /end COMPU_METHOD
/begin COMPU_METHOD defaultConversion691 "" FORM "%8.4" "[]" FORMULA "1.0*X" FORMULA_INV "1.0*X" /end COMPU_METHOD
/begin COMPU_METHOD defaultConversion692 "" FORM "%8.4" "[]" FORMULA "1.0*X" FORMULA_INV "1.0*X" /end COMPU_METHOD
/begin COMPU_METHOD defaultConversion693 "" FORM "%8.4" "[]" FORMULA "1.0*X" FORMULA_INV "1.0*X" /end COMPU_METHOD
/begin COMPU_METHOD defaultConversion694 "" FORM "%8.4" "[]" FORMULA "1.0*X" FORMULA_INV "1.0*X" /end COMPU_METHOD
/begin COMPU_METHOD defaultConversion695 "" FORM "%8.4" "[]" FORMULA "1.0*X" FORMULA_INV "1.0*X" /end COMPU_METHOD
/begin COMPU_METHOD defaultConversion696 "" FORM "%8.4" "[]" FORMULA "1.0*X" FORMULA_INV "1.0*X" /end COMPU_METHOD
/begin COMPU_METHOD defaultConversion697 "" FORM "%8.4" "[]" FORMULA "1.0*X" FORMULA_INV "1.0*X" /end COMPU_METHOD
/begin COMPU_METHOD defaultConversion698 "" FORM "%8.4" "[]" FORMULA "1.0*X" FORMULA_INV "1.0*X" /end COMPU_METHOD
/begin COMPU_METHOD defaultConversion699 "" FORM "%8.4" "[]" FORMULA "1.0*X" FORMULA_INV "1.0*X" /end COMPU_METHOD
/begin COMPU_METHOD defaultConversion700 "" FORM "%8.4" "[]" FORMULA "1.0*X" FORMULA_INV "1.0*X" /end COMPU_METHOD
/begin COMPU_METHOD defaultConversion701 "" FORM "%8.4" "[]" FORMULA "1.0*X" FORMULA_INV "1.0*X" /end COMPU_METHOD
/begin COMPU_METHOD defaultConversion702 "" FORM "%8.4" "[]" FORMULA "1.0*X" FORMULA_INV "1.0*X" /end COMPU_METHOD
/begin COMPU_METHOD defaultConversion703 "" FORM "%8.4" "[]" FORMULA "1.0*X" FORMULA_INV "1.0*X" /end COMPU_METHOD
/begin COMPU_METHOD defaultConversion704 "" FORM "%8.4" "[]" FORMULA "1.0*X" FORMULA_INV "1.0*X" /end COMPU_METHOD
/begin COMPU_METHOD defaultConversion705 "" FORM "%8.4" "[]" FORMULA "1.0*X" FORMULA_INV "1.0*X" /end COMPU_METHOD
/begin COMPU_METHOD defaultConversion706 "" FORM "%8.4" "[]" FORMULA "1.0*X" FORMULA_INV "1.0*X" /end COMPU_METHOD
/begin RECORD_LAYOUT a_172 FNC_VALUES 1 SWORD ROW_DIR DIRECT /end RECORD_LAYOUT
/begin RECORD_LAYOUT a_173 FNC_VALUES 1 UBYTE ROW_DIR DIRECT /end RECORD_LAYOUT
/begin RECORD_LAYOUT a_174 FNC_VALUES 1 UWORD ROW_DIR DIRECT /end RECORD_LAYOUT
/begin RECORD_LAYOUT a_175 FNC_VALUES 1 SBYTE ROW_DIR DIRECT /end RECORD_LAYOUT
/begin RECORD_LAYOUT a_189 FNC_VALUES 1 SLONG ROW_DIR DIRECT /end RECORD_LAYOUT
/end MODULE
/end PROJECT
